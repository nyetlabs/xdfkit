/begin PROJECT X505S24EX "4016.32"
/begin HEADER "" VERSION "X505S24EX" PROJECT_NO X505S24EX /end HEADER
/begin MODULE DIM ""
/begin MOD_COMMON "" BYTE_ORDER BIG_ENDIAN S_REC_LAYOUT DAMOS /end MOD_COMMON
/begin AXIS_PTS SEZ04LLUB "Stützstellenverteilung Zündwinkelwirkungsgrad für PD-Regler" 0x811D9B etazws SstAUbSstUb 127.5 rel_ub_b127p5 4 0.00 127.5 FUNCTION_LIST LLRRM DEPOSIT ABSOLUT IF_DATA DIM_X DIRECT 0x811D9B /end AXIS_PTS
/begin AXIS_PTS SML06TEUB "ml abhängige Stützstellen (Anzahl 6)" 0x8181DC ml SstAUbSstUb 1020. m_ub_b1020 6 0.00 1020. FUNCTION_LIST SSTB TEB DEPOSIT ABSOLUT IF_DATA DIM_X DIRECT 0x8181DC /end AXIS_PTS
/begin AXIS_PTS SNM05NWUB "Drehzahlstützstellen Nockenwellensollwinkel" 0x8181EC nmot SstAUbSstUb 10200. nmot_ub_q40 5 0.00 10200. FUNCTION_LIST SSTB NWSOLLE DEPOSIT ABSOLUT IF_DATA DIM_X DIRECT 0x8181EC /end AXIS_PTS
/begin AXIS_PTS SNM07ESUB "Stützstellenverteilung Drehzahl, 7 Sst." 0x818200 nmot SstAUbSstUb 10200. nmot_ub_q40 7 0.00 10200. FUNCTION_LIST SSTB ESUK LAMFAW DEPOSIT ABSOLUT IF_DATA DIM_X DIRECT 0x818200 /end AXIS_PTS
/begin AXIS_PTS SNM08GKUB "Stützstellenverteilung Gemischkontrolle 8 nmot Stützstellen" 0x818FF9 nmot SstAUbSstUb 10200. nmot_ub_q40 8 0.00 10200. FUNCTION_LIST ESVW DEPOSIT ABSOLUT IF_DATA DIM_X DIRECT 0x818FF9 /end AXIS_PTS
/begin AXIS_PTS SNM08KOUB "Stützstellenverteilung für Klimakompressorsteuerung  8  nmot" 0x812D9A nmot SstAUbSstUb 10200. nmot_ub_q40 8 0.00 10200. FUNCTION_LIST KOS DEPOSIT ABSOLUT IF_DATA DIM_X DIRECT 0x812D9A /end AXIS_PTS
/begin AXIS_PTS SNM08LDUW "Stützstellenverteilung für Ladedruckregelung" 0x813A8A nmot_w SstAUwSstUw 16383.75 nmot_uw_q0p25 8 0.00 16383.75 FUNCTION_LIST SSTB BGPLGU LDRLMX LDRPID DEPOSIT ABSOLUT IF_DATA DIM_X DIRECT 0x813A8A /end AXIS_PTS
/begin AXIS_PTS SNM08__UB "Stützstellenverteilung Drehzahl, 8 Sst." 0x81821A nmot SstAUbSstUb 10200. nmot_ub_q40 8 0.00 10200. FUNCTION_LIST SSTB BBSAWE ZUE DEPOSIT ABSOLUT IF_DATA DIM_X DIRECT 0x81821A /end AXIS_PTS
/begin AXIS_PTS SNM12FEUB "Stützstellen für WDKSMX, WDKUGDN" 0x8100AF nmot SstAUbSstUb 10200. nmot_ub_q40 12 0.00 10200. FUNCTION_LIST SSTB BGMSZS MDFUE DEPOSIT ABSOLUT IF_DATA DIM_X DIRECT 0x8100AF /end AXIS_PTS
/begin AXIS_PTS SNM16KRUB "Stützstellenverteilung Drehzahl, 16 Sst." 0x818250 nmot SstAUbSstUb 10200. nmot_ub_q40 16 0.00 10200. FUNCTION_LIST SSTB DKRS GGKS KRDY KRKE KRRA DEPOSIT ABSOLUT IF_DATA DIM_X DIRECT 0x818250 /end AXIS_PTS
/begin AXIS_PTS STM09ESUB "Stützstellenverteilung Motortemperatur, 9 Sst." 0x8182C0 tmot SstAUbSstUb 191.3 temp_ub_q0p75_o48 9 -48.00 143.3 FUNCTION_LIST SSTB ESUK ESUKAS DEPOSIT ABSOLUT IF_DATA DIM_X DIRECT 0x8182C0 /end AXIS_PTS
/begin AXIS_PTS STS08LDUB "Stützstellenverteilung tsel für Ladedruckregelung" 0x81013D tsel SstAUbSstUb 191.3 temp_ub_q0p75_o48 8 -48.00 143.3 FUNCTION_LIST SSTB BGPLGU DEPOSIT ABSOLUT IF_DATA DIM_X DIRECT 0x81013D /end AXIS_PTS
/begin AXIS_PTS STU05TMUB "Stützstellenverteilung, Ersatz-Umgebungstemperatur" 0x81864D tatu SstAUbSstUb 191.3 temp_ub_q0p75_o48 5 -48.00 143.3 FUNCTION_LIST ATM DEPOSIT ABSOLUT IF_DATA DIM_X DIRECT 0x81864D /end AXIS_PTS
/begin AXIS_PTS STW08MDUB "Stützstellenverteilung  Temperatur des Drehmomentenwandlers" 0x81A0DE twnd SstAUbSstUb 191.3 temp_ub_q0p75_o48 8 -48.00 143.3 FUNCTION_LIST MDWAN DEPOSIT ABSOLUT IF_DATA DIM_X DIRECT 0x81A0DE /end AXIS_PTS
/begin CHARACTERISTIC TMOTKRMX "Maximale Motortemperatur für" VALUE 0x81AF49 KwUb 191.3 temp_ub_q0p75_o48 -48.00 143.3 FUNCTION_LIST KMTR IF_DATA DIM_X DIRECT 0x81AF49 /end CHARACTERISTIC
/begin CHARACTERISTIC TMOTNLDG "Temperaturschwelle für Drehzahlgeber-Notlauf" VALUE 0x81848E KwUb 191.3 temp_ub_q0p75_o48 -48.00 143.3 FUNCTION_LIST DDG IF_DATA DIM_X DIRECT 0x81848E /end CHARACTERISTIC
/begin CHARACTERISTIC TMOTNMX "Motortemperatur-Schwelle für Aktivierung der erhöhten Drehzahlgrenze" VALUE 0x82950C KwUb 191.3 temp_ub_q0p75_o48 -48.00 143.3 FUNCTION_LIST NMAXMD IF_DATA DIM_X DIRECT 0x82950C /end CHARACTERISTIC
/begin CHARACTERISTIC TMOTSH "Motortemperaturschwelle für die Sondenheizung LSU" VALUE 0x812687 KwUb 191.3 temp_ub_q0p75_o48 -48.00 143.3 FUNCTION_LIST HLSU IF_DATA DIM_X DIRECT 0x812687 /end CHARACTERISTIC
/begin CHARACTERISTIC TMOTWRM "Motortemperatur für warmen Motor" VALUE 0x81896F KwUb 191.3 temp_ub_q0p75_o48 -48.00 143.3 FUNCTION_LIST BGTEMPK IF_DATA DIM_X DIRECT 0x81896F /end CHARACTERISTIC
/begin CHARACTERISTIC TMPUPOFF "untere Motortemperaturschwelle für pullup-Abschaltung" VALUE 0x819788 KwUb 191.3 temp_ub_q0p75_o48 -48.00 143.3 FUNCTION_LIST GGTFM IF_DATA DIM_X DIRECT 0x819788 /end CHARACTERISTIC
/begin CHARACTERISTIC TMPUPON "obere Motortemperaturschwelle für pullup-Zuschaltung" VALUE 0x819789 KwUb 191.3 temp_ub_q0p75_o48 -48.00 143.3 FUNCTION_LIST GGTFM IF_DATA DIM_X DIRECT 0x819789 /end CHARACTERISTIC
/begin CHARACTERISTIC TMQSYN "Motortemperaturschwelle zur Freigabe PG-Schnellstart" VALUE 0x810FC6 KwUb 191.3 temp_ub_q0p75_o48 -48.00 143.3 FUNCTION_LIST GGDPG IF_DATA DIM_X DIRECT 0x810FC6 /end CHARACTERISTIC
/begin CHARACTERISTIC TMRA1 "Ausschaltbedingung (S_LL = 0)" VALUE 0x81270F KwUb 191.3 temp_ub_q0p75_o48 -48.00 143.3 FUNCTION_LIST LRSEB IF_DATA DIM_X DIRECT 0x81270F /end CHARACTERISTIC
/begin CHARACTERISTIC TMRA2 "Ausschaltbedingung (S_LL = 1)" VALUE 0x812710 KwUb 191.3 temp_ub_q0p75_o48 -48.00 143.3 FUNCTION_LIST LRSEB IF_DATA DIM_X DIRECT 0x812710 /end CHARACTERISTIC
/begin CHARACTERISTIC TMRAA "Einschalttemperatur LRA" VALUE 0x81930B KwUb 191.3 temp_ub_q0p75_o48 -48.00 143.3 FUNCTION_LIST LRAEB LRA IF_DATA DIM_X DIRECT 0x81930B /end CHARACTERISTIC
/begin CHARACTERISTIC TMRAK "Ausschaltschwelle der Lambda - Regelung bei niedriger Starttemperatur" VALUE 0x812711 KwUb 191.3 temp_ub_q0p75_o48 -48.00 143.3 FUNCTION_LIST LRSEB IF_DATA DIM_X DIRECT 0x812711 /end CHARACTERISTIC
/begin CHARACTERISTIC TMRZHLL "Motortemperaturschwelle für Reset des Zeitzählers für Heiß-Leerlauf" VALUE 0x81A07B KwUb 191.3 temp_ub_q0p75_o48 -48.00 143.3 FUNCTION_LIST LLRNS IF_DATA DIM_X DIRECT 0x81A07B /end CHARACTERISTIC
/begin CHARACTERISTIC TMSDTHMO "obere Motorstart-Temp.-Schwelle für Thermostatdiagnose" VALUE 0x8197D7 KwUb 191.3 temp_ub_q0p75_o48 -48.00 143.3 FUNCTION_LIST DTHM IF_DATA DIM_X DIRECT 0x8197D7 /end CHARACTERISTIC
/begin CHARACTERISTIC TMSDTHMU "untere Motorstart-Temp.-Schwelle für Thermostatdiagnose" VALUE 0x8197D8 KwUb 191.3 temp_ub_q0p75_o48 -48.00 143.3 FUNCTION_LIST DTHM IF_DATA DIM_X DIRECT 0x8197D8 /end CHARACTERISTIC
/begin CHARACTERISTIC TMSH "Motortemperaturschwelle für Erkennung Kaltstart für Messung Sonde hinter KAT" VALUE 0x818668 KwUb 191.3 temp_ub_q0p75_o48 -48.00 143.3 FUNCTION_LIST DLSH IF_DATA DIM_X DIRECT 0x818668 /end CHARACTERISTIC
/begin CHARACTERISTIC TMSHA "Motorabstelltemperaturschwelle für Messung Abkühlung Sonde hinter KAT" VALUE 0x818669 KwUb 191.3 temp_ub_q0p75_o48 -48.00 143.3 FUNCTION_LIST DLSH IF_DATA DIM_X DIRECT 0x818669 /end CHARACTERISTIC
/begin CHARACTERISTIC TMSHS "Schwelle Motortemp. für Auslösung TLRHS - Sperrzeit LR bei Heißstart" VALUE 0x812712 KwUb 191.3 temp_ub_q0p75_o48 -48.00 143.3 FUNCTION_LIST LRSEB IF_DATA DIM_X DIRECT 0x812712 /end CHARACTERISTIC
/begin CHARACTERISTIC TMSKLH "Motortemperaturschwelle für kurze LRA-Anfangsphase bei Heißstart" VALUE 0x8191D8 KwUb 191.3 temp_ub_q0p75_o48 -48.00 143.3 FUNCTION_LIST BBTEGA IF_DATA DIM_X DIRECT 0x8191D8 /end CHARACTERISTIC
/begin CHARACTERISTIC TMSKS "Motortemperaturschwelle für Erkennung Benzin im Öl" VALUE 0x81970C KwUb 191.3 temp_ub_q0p75_o48 -48.00 143.3 FUNCTION_LIST BBBO IF_DATA DIM_X DIRECT 0x81970C /end CHARACTERISTIC
/begin CHARACTERISTIC TMSLADAP "Sperrzeit für Wiederholung Adaption" VALUE 0x81B2C4 KwUw 6553.500 t100msxs_uw_b6553p5 0.00 6553.500 FUNCTION_LIST DSLSLRS IF_DATA DIM_X DIRECT 0x81B2C4 /end CHARACTERISTIC
/begin CHARACTERISTIC TMSLIFT "Wartezeit für für mslift-Filter (Aufbau Drehmomentenreserve)" VALUE 0x81B2C6 KwUw 6553.500 t100msxs_uw_b6553p5 0.00 6553.500 FUNCTION_LIST DSLSLRS IF_DATA DIM_X DIRECT 0x81B2C6 /end CHARACTERISTIC
/begin CHARACTERISTIC TMSLIFT1 "Wartezeit für mslift-Filter (Aufbau Drehmomentenreserve) in Phase 1" VALUE 0x81B2C8 KwUw 6553.500 t100msxs_uw_b6553p5 0.00 6553.500 FUNCTION_LIST DSLSLRS IF_DATA DIM_X DIRECT 0x81B2C8 /end CHARACTERISTIC
/begin CHARACTERISTIC TMSLIFTK "Wartezeit für mslift-Filter (Aufbau Drehmomentenreserve) in Phase 1 während Kurz" VALUE 0x81B2CA KwUw 6553.500 t100msxs_uw_b6553p5 0.00 6553.500 FUNCTION_LIST DSLSLRS IF_DATA DIM_X DIRECT 0x81B2CA /end CHARACTERISTIC
/begin CHARACTERISTIC TMSNOGA "Schwelle tms für Dauerspülen nach Fahrzyklus mit erfolgter Gemischadaption" VALUE 0x8191D9 KwUb 191.3 temp_ub_q0p75_o48 -48.00 143.3 FUNCTION_LIST BBTEGA IF_DATA DIM_X DIRECT 0x8191D9 /end CHARACTERISTIC
/begin CHARACTERISTIC TMSO5INI "Initialisierungswert Sollwert Motortemperatur 5" VALUE 0x81AF4A KwUb 191.3 temp_ub_q0p75_o48 -48.00 143.3 FUNCTION_LIST KMTR IF_DATA DIM_X DIRECT 0x81AF4A /end CHARACTERISTIC
/begin CHARACTERISTIC TMSOINI "Initilaisierungswert Tiefpaß Motor-Soll-Temperatur" VALUE 0x81AF4B KwUb 191.3 temp_ub_q0p75_o48 -48.00 143.3 FUNCTION_LIST KMTR IF_DATA DIM_X DIRECT 0x81AF4B /end CHARACTERISTIC
/begin CHARACTERISTIC TMSOLLEW "KMTR Ersatzwert Motor-Solltemperatur" VALUE 0x81AF4C KwUb 191.3 temp_ub_q0p75_o48 -48.00 143.3 FUNCTION_LIST KMTR IF_DATA DIM_X DIRECT 0x81AF4C /end CHARACTERISTIC
/begin CHARACTERISTIC TMSOTOEL "Solltemperatur abhängig von Öltemperatur" CURVE 0x81AF4D KlAUbSstUbWUb 191.3 temp_ub_q0p75_o48 -48.00 143.3 FUNCTION_LIST KMTR IF_DATA DIM_X DIRECT 0x81AF4D
 /begin AXIS_DESCR STD_AXIS toelkmtr temp_ub_q1_o60 5 -60.00 195.0 DEPOSIT ABSOLUT /end AXIS_DESCR
/end CHARACTERISTIC
/begin CHARACTERISTIC TMSRCERR "Entprellzeit für irreversible ASR/MSR-Abschaltung bei Botschaftsfehler" VALUE 0x8101A1 KwUb 2.550 t10msxs_ub_b2p55 0.00 2.550 FUNCTION_LIST GGCASR IF_DATA DIM_X DIRECT 0x8101A1 /end CHARACTERISTIC
/begin CHARACTERISTIC TMSRCNU "Entprellzeit zur Berücksichtigung von Rasterversätzen im Botschaftszähler" VALUE 0x8101A2 KwUb 2.550 t10msxs_ub_b2p55 0.00 2.550 FUNCTION_LIST GGCASR IF_DATA DIM_X DIRECT 0x8101A2 /end CHARACTERISTIC
/begin CHARACTERISTIC TMSSLO "obere Starttemperaturschwelle für Sekundärluft" VALUE 0x818354 KwUb 191.3 temp_ub_q0p75_o48 -48.00 143.3 FUNCTION_LIST SLS IF_DATA DIM_X DIRECT 0x818354 /end CHARACTERISTIC
/begin CHARACTERISTIC TMSSLSTO "obere Temperaturschwelle für Sekundärluft im Start" VALUE 0x818355 KwUb 191.3 temp_ub_q0p75_o48 -48.00 143.3 FUNCTION_LIST SLS IF_DATA DIM_X DIRECT 0x818355 /end CHARACTERISTIC
/begin CHARACTERISTIC TMSSLSTU "untere Temperaturschwelle für Sekundärluft im Start" VALUE 0x818356 KwUb 191.3 temp_ub_q0p75_o48 -48.00 143.3 FUNCTION_LIST SLS IF_DATA DIM_X DIRECT 0x818356 /end CHARACTERISTIC
/begin CHARACTERISTIC TMSSLU "untere Starttemperaturschwelle für Sekundärluft" VALUE 0x818357 KwUb 191.3 temp_ub_q0p75_o48 -48.00 143.3 FUNCTION_LIST SLS IF_DATA DIM_X DIRECT 0x818357 /end CHARACTERISTIC
/begin CHARACTERISTIC TMSTABO "Kennlinie für Hochzählen des ABO-Zählers abhängig von der Starttemperatur" CURVE 0x81970D KlAUbSstUbWUb 255.0 dez 0.00 255.0 FUNCTION_LIST BBBO IF_DATA DIM_X DIRECT 0x81970D
 /begin AXIS_DESCR STD_AXIS tmst temp_ub_q0p75_o48 4 -48.00 143.3 DEPOSIT ABSOLUT /end AXIS_DESCR
/end CHARACTERISTIC
/begin CHARACTERISTIC TMSTMAD "Schwelle für tmot im Start für Bedarfsadaption" VALUE 0x812DE2 KwUb 191.3 temp_ub_q0p75_o48 -48.00 143.3 FUNCTION_LIST KOS IF_DATA DIM_X DIRECT 0x812DE2 /end CHARACTERISTIC
/begin CHARACTERISTIC TMSTTE "Starttemperaturschwelle, bei der die TE sofort aktiv werden kann" VALUE 0x81A542 KwUb 191.3 temp_ub_q0p75_o48 -48.00 143.3 FUNCTION_LIST TEBEB IF_DATA DIM_X DIRECT 0x81A542 /end CHARACTERISTIC
/begin CHARACTERISTIC TMSUKTDS "Minimale tmot-Start-Temperatur für Katdiagnose" VALUE 0x811025 KwUb 191.3 temp_ub_q0p75_o48 -48.00 143.3 FUNCTION_LIST DKATSP DKATSPEB STADK IF_DATA DIM_X DIRECT 0x811025 /end CHARACTERISTIC
/begin CHARACTERISTIC TMSUTMUMA "untere Tmot-Schwelle für temporäre UMA-Adaption" VALUE 0x81114D KwUb 191.3 temp_ub_q0p75_o48 -48.00 143.3 FUNCTION_LIST BGDVE IF_DATA DIM_X DIRECT 0x81114D /end CHARACTERISTIC
/begin CHARACTERISTIC TMTE "TMOT - Schwelle für Tankentlüftung" VALUE 0x81A543 KwUb 191.3 temp_ub_q0p75_o48 -48.00 143.3 FUNCTION_LIST TEBEB IF_DATA DIM_X DIRECT 0x81A543 /end CHARACTERISTIC
/begin CHARACTERISTIC TMTKS "Temperaturschwelle für  integrierten Luftmassenstrom für Erkennung Benzin im Öl" VALUE 0x819716 KwUb 191.3 temp_ub_q0p75_o48 -48.00 143.3 FUNCTION_LIST BBBO IF_DATA DIM_X DIRECT 0x819716 /end CHARACTERISTIC
/begin CHARACTERISTIC TMUKAK "Temperaturbereich kalter Motor für ÜK-Adaption" VALUE 0x811BF7 KwUb 191.3 temp_ub_q0p75_o48 -48.00 143.3 FUNCTION_LIST ESUKAS IF_DATA DIM_X DIRECT 0x811BF7 /end CHARACTERISTIC
/begin CHARACTERISTIC TMUKAU "untere Motortemperatur-Grenze für ÜK-Adaption" VALUE 0x811BF8 KwUb 191.3 temp_ub_q0p75_o48 -48.00 143.3 FUNCTION_LIST ESUKAS IF_DATA DIM_X DIRECT 0x811BF8 /end CHARACTERISTIC
/begin CHARACTERISTIC TMUKAW "Temperaturbereich warmer Motor für ÜK-Adaption" VALUE 0x811BF9 KwUb 191.3 temp_ub_q0p75_o48 -48.00 143.3 FUNCTION_LIST ESUKAS IF_DATA DIM_X DIRECT 0x811BF9 /end CHARACTERISTIC
/begin CHARACTERISTIC TMURSTE "Untere Temperaturschwelle resetieren B_stendes bei B_stend = false" VALUE 0x811BC5 KwUb 191.3 temp_ub_q0p75_o48 -48.00 143.3 FUNCTION_LIST ESSTT IF_DATA DIM_X DIRECT 0x811BC5 /end CHARACTERISTIC
/begin CHARACTERISTIC TMWAFMN "Minimale Motortemperatur für Winkeladaption Nockenwelle" VALUE 0x81A8A8 KwUb 191.3 temp_ub_q0p75_o48 -48.00 143.3 FUNCTION_LIST BGARNW IF_DATA DIM_X DIRECT 0x81A8A8 /end CHARACTERISTIC
/begin CHARACTERISTIC TMXKATST "Maximale Kat-Temperatur für Überwachung bei Testerbetrieb" VALUE 0x8186ED KwUb 1275. temp_ub_q5_o50 -50.00 1225. FUNCTION_LIST DKATSPEB IF_DATA DIM_X DIRECT 0x8186ED /end CHARACTERISTIC
/begin CHARACTERISTIC TMZUB2MX "Temperaturschwelle für Winkelpriorität während Kaltstart" VALUE 0x810059 KwUb 191.3 temp_ub_q0p75_o48 -48.00 143.3 FUNCTION_LIST AZUE IF_DATA DIM_X DIRECT 0x810059 /end CHARACTERISTIC
/begin CHARACTERISTIC TN2FGRGA_0_A "Doppelte Nennerzeitkonstante für FGR-Regler" CURVE 0x81CD40 KlAUwSstUwWUw 1310.660 t20msxs_uw_q0p02 0.02000000 1310.680 FUNCTION_LIST FGRREGL IF_DATA DIM_X INDIRECT 0x813BFA /begin AXIS_DESCR STD_AXIS uevges_w fak_q0p1 8 0.00 6553.500 DEPOSIT ABSOLUT /end AXIS_DESCR /end CHARACTERISTIC
/begin CHARACTERISTIC TN2FGRGA_1_A "Doppelte Nennerzeitkonstante für FGR-Regler" CURVE 0x81CD62 KlAUwSstUwWUw 1310.660 t20msxs_uw_q0p02 0.02000000 1310.680 FUNCTION_LIST FGRREGL IF_DATA DIM_X INDIRECT 0x813BFE /begin AXIS_DESCR STD_AXIS uevges_w fak_q0p1 8 0.00 6553.500 DEPOSIT ABSOLUT /end AXIS_DESCR /end CHARACTERISTIC
/begin CHARACTERISTIC TNALU "Testphasenlänge nach erkanntem Aussetzer" VALUE 0x810D0C KwUb 255.0 dez 0.00 255.0 FUNCTION_LIST DMDLU IF_DATA DIM_X DIRECT 0x810D0C /end CHARACTERISTIC
/begin CHARACTERISTIC TNLARAMP "Minimale SG-Nachlaufzeit für rampenförmige Lüfterabsteuerung" VALUE 0x82B188 KwUw 65535.00 t1sxs_uw_b65535 0.00 65535.00 FUNCTION_LIST KMTR IF_DATA DIM_X DIRECT 0x82B188 /end CHARACTERISTIC
/begin CHARACTERISTIC TNLATMTM "bei tmot > Schwellert  SG-Nachlauf-Anforderung B_nlatm = 1" VALUE 0x818662 KwUb 191.3 temp_ub_q0p75_o48 -48.00 143.3 FUNCTION_LIST ATM IF_DATA DIM_X DIRECT 0x818662 /end CHARACTERISTIC
/begin CHARACTERISTIC TNLATMTU "bei tumg (tatu -ATM) > Schwellwert SG-Nachlauf-Anforderung" VALUE 0x818663 KwUb 191.3 temp_ub_q0p75_o48 -48.00 143.3 FUNCTION_LIST ATM IF_DATA DIM_X DIRECT 0x818663 /end CHARACTERISTIC
/begin CHARACTERISTIC TNLEKPVL "Schwelle SG-Nachlaufzeit für EKP-Vorlauf" VALUE 0x82B042 KwUw 6553.500 t100msxs_uw_b6553p6 0.00 6553.500 FUNCTION_LIST AEKP IF_DATA DIM_X DIRECT 0x82B042 /end CHARACTERISTIC
/begin CHARACTERISTIC TNLETM "Nachlaufzeitverlaengerung fuer E_tm" VALUE 0x81EA28 KwUw 65535.00 t1sxs_uw_q1 0.00 65535.00 FUNCTION_LIST GGTFM IF_DATA DIM_X DIRECT 0x81EA28 /end CHARACTERISTIC
/begin CHARACTERISTIC TNLKMTRMN "Minimal notwendige SG-Nachlaufzeit zur Freigabe der Lüfteransteuerung" VALUE 0x82B18A KwUw 65535.00 t1sxs_uw_b65535 0.00 65535.00 FUNCTION_LIST KMTR IF_DATA DIM_X DIRECT 0x82B18A /end CHARACTERISTIC
/begin CHARACTERISTIC TNLSGM "Nachlaufzeit für SG abschalten" CURVE 0x81E49E KlAUbSstUbWUw 65535.00 t1sxs_uw_q1 0.00 65535.00 FUNCTION_LIST BGTABST IF_DATA DIM_X DIRECT 0x81E49E
 /begin AXIS_DESCR STD_AXIS tmotab temp_ub_q0p75_o48 6 -48.00 143.3 DEPOSIT ABSOLUT /end AXIS_DESCR
/end CHARACTERISTIC
/begin CHARACTERISTIC TNLSTMX "Max. SG-Laufzeit nach Startende für Reset Lüfternachlauftimer" VALUE 0x82B18C KwUw 6553.500 t100msxs_uw_b6553p5 0.00 6553.500 FUNCTION_LIST KMTR IF_DATA DIM_X DIRECT 0x82B18C /end CHARACTERISTIC
/begin CHARACTERISTIC TNLSTP "Abbruchbedingung Nachlaufzeit für Lüfteransteuerung" VALUE 0x82B18E KwUw 65535.00 t1sxs_uw_b65535 0.00 65535.00 FUNCTION_LIST KMTR IF_DATA DIM_X DIRECT 0x82B18E /end CHARACTERISTIC
/begin CHARACTERISTIC TNMXH "Maximale Zeitdauer für erhöhte Drehzahlgrenze" VALUE 0x817308 KwUw 655.3500 t10msxs_uw_b655p35 0.00 655.3500 FUNCTION_LIST NMAXMD IF_DATA DIM_X DIRECT 0x817308 /end CHARACTERISTIC
/begin CHARACTERISTIC TNOMF2 "zulässige Zeit außerhalb Meßfenster, Phase 2" VALUE 0x818393 KwUb 25.50 t100msxs_ub_b25p5 0.00 25.50 FUNCTION_LIST DSLSLRS IF_DATA DIM_X DIRECT 0x818393 /end CHARACTERISTIC
/begin CHARACTERISTIC TNOMF3 "zulässige Zeit außerhalb Meßfenster, Phase 3" VALUE 0x818394 KwUb 25.50 t100msxs_ub_b25p5 0.00 25.50 FUNCTION_LIST DSLSLRS IF_DATA DIM_X DIRECT 0x818394 /end CHARACTERISTIC
/begin CHARACTERISTIC TNOMF5 "zulässige Zeit außerhalb Meßfenster, Phase 5" VALUE 0x818395 KwUb 25.50 t100msxs_ub_b25p5 0.00 25.50 FUNCTION_LIST DSLSLRS IF_DATA DIM_X DIRECT 0x818395 /end CHARACTERISTIC
/begin CHARACTERISTIC TNSC "Nachstartüberwachungszeit" VALUE 0x81730C KwUw 1310.700 t20msxs_uw_q0p02 0.00 1310.700 FUNCTION_LIST MDZUL IF_DATA DIM_X DIRECT 0x81730C /end CHARACTERISTIC
/begin CHARACTERISTIC TNSDMRKH "Zeit nach Start für Drehmomentenreserve Katheizen" VALUE 0x81EDDC KwUw 655.3500 t10msxs_uw_b655p35 0.00 655.3500 FUNCTION_LIST BBKHZ IF_DATA DIM_X DIRECT 0x81EDDC /end CHARACTERISTIC
/begin CHARACTERISTIC TNSEUHRCMP "Schwelle Abweichung Vergleich Zeit nach Start" VALUE 0x81E4B2 KwUw 6553.500 t100msxs_uw_b6553p5 0.00 6553.500 FUNCTION_LIST BGTABST IF_DATA DIM_X DIRECT 0x81E4B2 /end CHARACTERISTIC
/begin CHARACTERISTIC TNSLFA "Filterzeitkonstante für nslfa" VALUE 0x81A23D KwUb 5.08000 zk20msxs_ub_b5p1 0.0200000 5.10000 FUNCTION_LIST LLRNFA IF_DATA DIM_X DIRECT 0x81A23D /end CHARACTERISTIC
/begin CHARACTERISTIC TNSOF "Entprellzeit zur Abschaltung der Nachstartaufweitung" VALUE 0x812240 KwUb 5.100 t20msxs_ub_b5p1 0.00 5.100 FUNCTION_LIST MDZUL IF_DATA DIM_X DIRECT 0x812240 /end CHARACTERISTIC
/begin CHARACTERISTIC TNSRT "Max.-Zeit ab Start für Retriggerung Berechnung Motortemperaturmodell" VALUE 0x81978A KwUb 255.0 t1sxs_ub_b255 0.00 255.0 FUNCTION_LIST GGTFM IF_DATA DIM_X DIRECT 0x81978A /end CHARACTERISTIC
/begin CHARACTERISTIC TNSTBKV "Zeit nach Startende und nichtfreigabe bis die Pumpe aktiv angesteuert wird" VALUE 0x82B2BC KwUw 655.3500 t10msxs_uw_b655p35 0.00 655.3500 FUNCTION_LIST DBKVP IF_DATA DIM_X DIRECT 0x82B2BC /end CHARACTERISTIC
/begin CHARACTERISTIC TNSTDNH "Zeit nach Start für Diagnose Adernschluß (Monoflop)" VALUE 0x811013 KwUb 5.100 t20msxs_ub_b5p1 0.00 5.100 FUNCTION_LIST DLSH IF_DATA DIM_X DIRECT 0x811013 /end CHARACTERISTIC
/begin CHARACTERISTIC TNSTDSL "Schwelle Zeit nach Start für aktivieren Phase 4" VALUE 0x81B2CC KwUw 6553.500 t100msxs_uw_b6553p5 0.00 6553.500 FUNCTION_LIST DSLSLRS IF_DATA DIM_X DIRECT 0x81B2CC /end CHARACTERISTIC
/begin CHARACTERISTIC TNSTFON "Zeit nach Start Adaptionsstop (Heilung) freigegeben" VALUE 0x813D40 KwUw 655.3500 t10msxs_uw_b655p35 0.00 655.3500 FUNCTION_LIST DMDFON IF_DATA DIM_X DIRECT 0x813D40 /end CHARACTERISTIC
/begin CHARACTERISTIC TNSTKO "Unterdrückungszeit des Kompressors nach dem Start" VALUE 0x812DE3 KwUb 51.00 t200msxs_ub_b51 0.00 51.00 FUNCTION_LIST KOS IF_DATA DIM_X DIRECT 0x812DE3 /end CHARACTERISTIC
/begin CHARACTERISTIC TNSTZWG "Zeit nach Start bis zur Freigabe des Zündwinkels für NWS-Verstellung" VALUE 0x82AFD6 KwUw 655.3500 t10msxs_uw_b655p35 0.00 655.3500 FUNCTION_LIST ZWGRU IF_DATA DIM_X DIRECT 0x82AFD6 /end CHARACTERISTIC
/begin CHARACTERISTIC TNSURLP "Zeit rl-Praediktions-Unterdrueckung im Nachstart" VALUE 0x811503 KwUb 25.50 t100msxs_ub_b25p5 0.00 25.50 FUNCTION_LIST BGRLP IF_DATA DIM_X DIRECT 0x811503 /end CHARACTERISTIC
/begin CHARACTERISTIC TNSUUK "Zeit UK-Unterdrückung im Nachstart" VALUE 0x811BEC KwUb 25.50 t100msxs_ub_b25p5 0.00 25.50 FUNCTION_LIST ESUK IF_DATA DIM_X DIRECT 0x811BEC /end CHARACTERISTIC
/begin CHARACTERISTIC TNWAPTE "Zeit Einlassnockenwelle in Aktivposition bei Testereingriff" VALUE 0x81A8C9 KwUb 12.75 t50msxs_q0p05 0.00 12.75 FUNCTION_LIST NWSFAT IF_DATA DIM_X DIRECT 0x81A8C9 /end CHARACTERISTIC
/begin CHARACTERISTIC TNWPPTE "Zeit Einlassnockenwelle in Passivposition bei Testereingriff" VALUE 0x81A8CA KwUb 12.75 t50msxs_q0p05 0.00 12.75 FUNCTION_LIST NWSFAT IF_DATA DIM_X DIRECT 0x81A8CA /end CHARACTERISTIC
/begin CHARACTERISTIC TNWSABGKE "Zeitkonstante für Sollwertänderungsbegrenzung Einlaßnockenwelle kalt" CURVE 0x81A8ED GklWUb 12.7498039 zk50msxs_ub_b12p8 0.0501960784 12.8000000 FUNCTION_LIST NWSOLLE IF_DATA DIM_X DIRECT 0x81A8ED
 /begin AXIS_DESCR COM_AXIS nmot nmot_ub_q40 5 0.00 10200. AXIS_PTS_REF SNM05NWUB /end AXIS_DESCR
/end CHARACTERISTIC
/begin CHARACTERISTIC TNWSNABGE "Zeitkonstante für negative Sollwertänderungsbegrenzung Einlaßnockenwelle" CURVE 0x81A8F2 GklWUb 12.7498039 zk50msxs_ub_b12p8 0.0501960784 12.8000000 FUNCTION_LIST NWSOLLE IF_DATA DIM_X DIRECT 0x81A8F2
 /begin AXIS_DESCR COM_AXIS nmot nmot_ub_q40 5 0.00 10200. AXIS_PTS_REF SNM05NWUB /end AXIS_DESCR
/end CHARACTERISTIC
/begin CHARACTERISTIC TNWSPABGE "Zeitkonstante für positive Sollwertänderungsbegrenzung Einlaßnockenwelle" CURVE 0x81A8F7 GklWUb 12.7498039 zk50msxs_ub_b12p8 0.0501960784 12.8000000 FUNCTION_LIST NWSOLLE IF_DATA DIM_X DIRECT 0x81A8F7
 /begin AXIS_DESCR COM_AXIS nmot nmot_ub_q40 5 0.00 10200. AXIS_PTS_REF SNM05NWUB /end AXIS_DESCR
/end CHARACTERISTIC
/begin CHARACTERISTIC TNWVBGNE "Zeit bis Verstellung der Einlassnockenwelle durch Tester beginnt" VALUE 0x81A8CB KwUb 12.75 t50msxs_q0p05 0.00 12.75 FUNCTION_LIST NWSFAT IF_DATA DIM_X DIRECT 0x81A8CB /end CHARACTERISTIC
/begin CHARACTERISTIC TOELNWMN "Minimal Öltemperaturschwelle zur Freigabe der Nockenwellenverstellung" VALUE 0x829E50 KwUw 1535.977 temp_q0p0234_o273 -273.1500 1262.827 FUNCTION_LIST BBNWS IF_DATA DIM_X DIRECT 0x829E50 /end CHARACTERISTIC
/begin CHARACTERISTIC TOLDMN "Öltemperatur min." VALUE 0x81A8B0 KwUb 255.0 temp_ub_q1_o60 -60.00 195.0 FUNCTION_LIST BGTOL IF_DATA DIM_X DIRECT 0x81A8B0 /end CHARACTERISTIC
/begin CHARACTERISTIC TOLDMX "Öltemperatur max." VALUE 0x81A8B1 KwUb 255.0 temp_ub_q1_o60 -60.00 195.0 FUNCTION_LIST BGTOL IF_DATA DIM_X DIRECT 0x81A8B1 /end CHARACTERISTIC
/begin CHARACTERISTIC TOLE "Ersatzwert für Öltemperatur" VALUE 0x81A8B2 KwUb 255.0 temp_ub_q1_o60 -60.00 195.0 FUNCTION_LIST BGTOL IF_DATA DIM_X DIRECT 0x81A8B2 /end CHARACTERISTIC
/begin CHARACTERISTIC TOLELI "(Motor-)Oeltemperatur Erfassung u. Linearisierung, Inverskennlinie" CURVE 0x81A8B3 KlAUbSstUbWUb 255.0 temp_ub_q1_o60 -60.00 195.0 FUNCTION_LIST BGTOL IF_DATA DIM_X DIRECT 0x81A8B3 /begin AXIS_DESCR STD_AXIS wtol dez 10 0.00 255.0 DEPOSIT ABSOLUT /end AXIS_DESCR /end CHARACTERISTIC
/begin CHARACTERISTIC TOLEWKMTR "Ersatzwert Öltemperatur in KMTR" VALUE 0x81AF58 KwUb 255.0 temp_ub_q1_o60 -60.00 195.0 FUNCTION_LIST KMTR IF_DATA DIM_X DIRECT 0x81AF58 /end CHARACTERISTIC
/begin CHARACTERISTIC TOOTAUS "Zeit für Nicht-Betätigung ON/OFF-Taster GRA zur erneuten Freigabe" VALUE 0x81871F KwUb 5.100 t20msxs_ub_b5p1 0.00 5.100 FUNCTION_LIST GGFGRH IF_DATA DIM_X DIRECT 0x81871F /end CHARACTERISTIC
/begin CHARACTERISTIC TOOTEIN "Zeit für Hauptschalter ein bei ON/OFF-Taster GRA" VALUE 0x818720 KwUb 5.100 t20msxs_ub_b5p1 0.00 5.100 FUNCTION_LIST GGFGRH IF_DATA DIM_X DIRECT 0x818720 /end CHARACTERISTIC
/begin CHARACTERISTIC TOOTULB "Zeit für Erkennung unplausibel lange Betätigung ON/OFF-Taster GRA" VALUE 0x81C7CE KwUw 1310.700 t20msxs_uw_b1310 0.00 1310.700 FUNCTION_LIST GGFGRH IF_DATA DIM_X DIRECT 0x81C7CE /end CHARACTERISTIC
/begin CHARACTERISTIC TPERDTE "Zeit für Wiederholung DTEV bei Dauerleerlauf" VALUE 0x81A785 KwUb 25.50 t100msxs_ub_b25p5 0.00 25.50 FUNCTION_LIST DTEV IF_DATA DIM_X DIRECT 0x81A785 /end CHARACTERISTIC
/begin CHARACTERISTIC TPFIFOANZ "Anzahl FIFO-Einträge für Berechnung Periodendauer-Mittelwert" VALUE 0x81278B KwUb 3.000 dez 1.000 4.000 FUNCTION_LIST DLDP IF_DATA DIM_X DIRECT 0x81278B /end CHARACTERISTIC
/begin CHARACTERISTIC TPHERKMN "minimale Motortemperatur für Phasensuche" VALUE 0x810FBE KwUb 191.3 temp_ub_q0p75_o48 -48.00 143.3 FUNCTION_LIST NLPH IF_DATA DIM_X DIRECT 0x810FBE /end CHARACTERISTIC
/begin CHARACTERISTIC TPHSABSP "Sperrzeit für die Phasensuche, wenn der geeignete Betriebsbereich verl. wurde" VALUE 0x810FBF KwUb 255.0 t1sxs_ub_b255 0.00 255.0 FUNCTION_LIST NLPH IF_DATA DIM_X DIRECT 0x810FBF /end CHARACTERISTIC
/begin CHARACTERISTIC TPHSSP "Sperrzeit für Phasensuche nach erfolgloser Suche" VALUE 0x810FC0 KwUb 255.0 t1sxs_ub_b255 0.00 255.0 FUNCTION_LIST NLPH IF_DATA DIM_X DIRECT 0x810FC0 /end CHARACTERISTIC
/begin CHARACTERISTIC TPNSE "Prüfzeit nach Startende für DVE-Diagnose" VALUE 0x81873F KwUb 25.40 t100msxs_ub_b25p5 0.1000 25.50 FUNCTION_LIST DDVE IF_DATA DIM_X DIRECT 0x81873F /end CHARACTERISTIC
/begin CHARACTERISTIC TPNSE1 "Prüfzeit nach Startende für PWG-Diagnose" VALUE 0x818732 KwUb 12.70 t50msxs_ub_b12p75 0.05000 12.75 FUNCTION_LIST GGPED IF_DATA DIM_X DIRECT 0x818732 /end CHARACTERISTIC
/begin CHARACTERISTIC TPREL "Zahnentprellzeit in der Initialisierung" VALUE 0x810FC7 KwUb 0.1000 t10msxs_ub_b2p55 0.00 0.1000 FUNCTION_LIST GGDPG IF_DATA DIM_X DIRECT 0x810FC7 /end CHARACTERISTIC
/begin CHARACTERISTIC TPSSWE "Sollwert Periodendauer Schlechtwegsignal" VALUE 0x81845D KwUb 255.0 t1msxms_q1 0.00 255.0 FUNCTION_LIST GGSWEA DSWEA IF_DATA DIM_X DIRECT 0x81845D /end CHARACTERISTIC
/begin CHARACTERISTIC TPSVKMN "minimale Periodendauer der Lambdasonde vor Kat, DLSSA" VALUE 0x810160 KwUb 1.330 spg_ub_b1p33 0.00 1.330 FUNCTION_LIST DUMMY IF_DATA DIM_X DIRECT 0x810160 /end CHARACTERISTIC
/begin CHARACTERISTIC TPTEVMN "Periodendauerschwelle bei LDP-TEV-Check" VALUE 0x817862 KwUw 655.3500 t10msxs_uw_b655p35 0.00 655.3500 FUNCTION_LIST DLDP IF_DATA DIM_X DIRECT 0x817862 /end CHARACTERISTIC
/begin CHARACTERISTIC TPUKOR "Filterzeit für PUKORF" VALUE 0x81A817 KwUb 25.4996 zk100msxs_ub_b25p5 0.100392 25.6000 FUNCTION_LIST BGPUK IF_DATA DIM_X DIRECT 0x81A817 /end CHARACTERISTIC
/begin CHARACTERISTIC TPUKUKA "Entprellzeit für Erkennung ÜK-Eingriff (ÜK-Adaption)" VALUE 0x811BFA KwUb 2.550 t10msxs_ub_b2p55 0.00 2.550 FUNCTION_LIST ESUKAS IF_DATA DIM_X DIRECT 0x811BFA /end CHARACTERISTIC
/begin CHARACTERISTIC TPUPH "Kennlinie für die Pumpzeit abhängig von den vorherigen Durchläufen" VAL_BLK 0x817864 KwbUw 655.3500 t10msxs_uw_b655p35 0.00 655.3500 NUMBER 30 FUNCTION_LIST DLDP IF_DATA DIM_X DIRECT 0x817864 /end CHARACTERISTIC
/begin CHARACTERISTIC TPWMST "Zeit nach Start für PWM-Signal" VALUE 0x81845E KwUb 25.50 t100msxs_ub_b25p5 0.00 25.50 FUNCTION_LIST GGSWEA IF_DATA DIM_X DIRECT 0x81845E /end CHARACTERISTIC
/begin CHARACTERISTIC TQTEAB "Zeit für Absteuerung Spülrate Tankentlüftung" VALUE 0x812765 KwUb 81.28 t20msxs_ub_q0p32 0.3200 81.60 FUNCTION_LIST TEB IF_DATA DIM_X DIRECT 0x812765 /end CHARACTERISTIC
/begin CHARACTERISTIC TQTEDAB "Zeit für schnelle Absteuerung Spülrate Tankentlüftung" VALUE 0x812766 KwUb 81.28 t20msxs_ub_q0p32 0.3200 81.60 FUNCTION_LIST TEB IF_DATA DIM_X DIRECT 0x812766 /end CHARACTERISTIC
/begin CHARACTERISTIC TRAU "Überwachungszeit für untere Lastschwelle der Lambdaregelung" VALUE 0x81A4A5 KwUb 25.50 t100msxs_ub_b25p5 0.00 25.50 FUNCTION_LIST LRSEB IF_DATA DIM_X DIRECT 0x81A4A5 /end CHARACTERISTIC
/begin CHARACTERISTIC TRD "Zahnperiodenzeit für Rückdrehen im Auslauf" VALUE 0x810FB5 KwUb 100.0 t1msxms_q1 0.00 100.0 FUNCTION_LIST ALE IF_DATA DIM_X DIRECT 0x810FB5 /end CHARACTERISTIC
/begin CHARACTERISTIC TRETRY "" VALUE 0x8197DD KwUb 255.0 t1sxs_ub_b255 0.00 255.0 FUNCTION_LIST ims_501 IF_DATA DIM_X DIRECT 0x8197DD /end CHARACTERISTIC
/begin CHARACTERISTIC TRKA "Erkennungszeit für eingeschwungene Grundadaption von rkat bzw. rkaz" VALUE 0x819554 KwUb 51.00 t200msxs_ub_b51 0.00 51.00 FUNCTION_LIST DKVS IF_DATA DIM_X DIRECT 0x819554 /end CHARACTERISTIC
/begin CHARACTERISTIC TRKATZ "Aktivierungszeit von rkat bis Setzen Zyklusflag, wenn B_gae = FALSE" VALUE 0x819555 KwUb 51.00 t200msxs_ub_b51 0.00 51.00 FUNCTION_LIST DKVS IF_DATA DIM_X DIRECT 0x819555 /end CHARACTERISTIC
/begin CHARACTERISTIC TRKAUF "Überwachungszeit Reedkontakt öffnet während Fast Pulse" VALUE 0x8178A0 KwUw 655.3500 t10msxs_uw_b655p35 0.00 655.3500 FUNCTION_LIST DLDP IF_DATA DIM_X DIRECT 0x8178A0 /end CHARACTERISTIC
/begin CHARACTERISTIC TRKAZZ "Aktivierungszeit von rkaz bis Setzen Zyklusflag, wenn B_gae = FALSE" VALUE 0x819556 KwUb 51.00 t200msxs_ub_b51 0.00 51.00 FUNCTION_LIST DKVS IF_DATA DIM_X DIRECT 0x819556 /end CHARACTERISTIC
/begin CHARACTERISTIC TRSE "Überwachungszeit -> Regelung ein" VALUE 0x81866A KwUb 25.50 t100msxs_ub_b25p5 0.00 25.50 FUNCTION_LIST DLSH IF_DATA DIM_X DIRECT 0x81866A /end CHARACTERISTIC
/begin CHARACTERISTIC TRSECMX "Max. Wert für relativen Sekundenzähler" VALUE 0x81E464 KwUl 4294967295.00 t1sxs_uw_q1 0.00 4294967295.00 FUNCTION_LIST BGTABST IF_DATA DIM_X DIRECT 0x81E464 /end CHARACTERISTIC
/begin CHARACTERISTIC TSAKAMN "Mindestdauer SA für Funktion Katalysator-Ausräumen" VALUE 0x812751 KwUb 5.100 t20msxs_ub_b5p1 0.00 5.100 FUNCTION_LIST LRSKA IF_DATA DIM_X DIRECT 0x812751 /end CHARACTERISTIC
/begin CHARACTERISTIC TSALASH "Zeit nach Schub für Überprüfung Sonde hinter KAT" VALUE 0x818671 KwUb 25.50 t100msxs_ub_b25p5 0.00 25.50 FUNCTION_LIST DLSAHK IF_DATA DIM_X DIRECT 0x818671 /end CHARACTERISTIC
/begin CHARACTERISTIC TSBVDSLTMS "Verzögerung Messbeginn DSLSLRS nach Sondenbetriebsbereitschaft" CURVE 0x81B2CE KlAUbSstUbWUw 6553.500 t100msxs_uw_b6553p5 0.00 6553.500 FUNCTION_LIST DSLSLRS IF_DATA DIM_X DIRECT 0x81B2CE
 /begin AXIS_DESCR STD_AXIS tmst temp_ub_q0p75_o48 6 -48.00 143.3 DEPOSIT ABSOLUT /end AXIS_DESCR
/end CHARACTERISTIC
/begin CHARACTERISTIC TSFBKVP "" VALUE 0x810F16 KwUb 255.0 dez 0.00 255.0 FUNCTION_LIST DFPM_DBKVP IF_DATA DIM_X DIRECT 0x810F16 /end CHARACTERISTIC
/begin CHARACTERISTIC TSFBKVPE "" VALUE 0x810F17 KwUb 255.0 dez 0.00 255.0 FUNCTION_LIST DFPM_DEKON IF_DATA DIM_X DIRECT 0x810F17 /end CHARACTERISTIC
/begin CHARACTERISTIC TSFBM "Fehlersummenzeit: Bezugsmarkengeber" VALUE 0x810F18 KwUb 255.0 dez 0.00 255.0 FUNCTION_LIST DFPM_DDG IF_DATA DIM_X DIRECT 0x810F18 /end CHARACTERISTIC
/begin CHARACTERISTIC TSFBREMS "Fehlersummenzeit: BREMS (Bremsschalter)" VALUE 0x810F19 KwUb 255.0 dez 0.00 255.0 FUNCTION_LIST DFPM_GGEGAS IF_DATA DIM_X DIRECT 0x810F19 /end CHARACTERISTIC
/begin CHARACTERISTIC TSFBWF "Fehlersummenzeit: PWG Bewegung" VALUE 0x810F1A KwUb 255.0 dez 0.00 255.0 FUNCTION_LIST DFPM_GGPED IF_DATA DIM_X DIRECT 0x810F1A /end CHARACTERISTIC
/begin CHARACTERISTIC TSFCAIR "Fehlersummenzeit: Airbag-Botschaft" VALUE 0x810F1B KwUb 255.0 dez 0.00 255.0 FUNCTION_LIST DFPM_CAIR IF_DATA DIM_X DIRECT 0x810F1B /end CHARACTERISTIC
/begin CHARACTERISTIC TSFCAIRP "Fehlersummenzeit: unpl. Airbag-Botschaft" VALUE 0x810F1C KwUb 255.0 dez 0.00 255.0 FUNCTION_LIST DFPM_GGCS IF_DATA DIM_X DIRECT 0x810F1C /end CHARACTERISTIC
/begin CHARACTERISTIC TSFCAS "Fehlersummenzeit: CAN-Schnittstelle, Timeout ASC" VALUE 0x810F1D KwUb 255.0 dez 0.00 255.0 FUNCTION_LIST DFPM_CAS IF_DATA DIM_X DIRECT 0x810F1D /end CHARACTERISTIC
/begin CHARACTERISTIC TSFCAT "Fehlersummenzeit: CAN-Schnittstelle, Timeout ASR" VALUE 0x810F1E KwUb 255.0 dez 0.00 255.0 FUNCTION_LIST DFPM_CAT IF_DATA DIM_X DIRECT 0x810F1E /end CHARACTERISTIC
/begin CHARACTERISTIC TSFCGRA "Fehlersummenzeit: GRA-Botschaft (Empfang)" VALUE 0x810F20 KwUb 255.0 dez 0.00 255.0 FUNCTION_LIST DFPM_CGRA IF_DATA DIM_X DIRECT 0x810F20 /end CHARACTERISTIC
/begin CHARACTERISTIC TSFCIF "Fehlersummenzeit: CAN-Schnittstelle, interner Fehler" VALUE 0x810F21 KwUb 255.0 dez 0.00 255.0 FUNCTION_LIST DFPM_CIF IF_DATA DIM_X DIRECT 0x810F21 /end CHARACTERISTIC
/begin CHARACTERISTIC TSFCINS "Fehlersummenzeit: CAN-Schnittstelle, Timeout Instrument" VALUE 0x810F22 KwUb 255.0 dez 0.00 255.0 FUNCTION_LIST DFPM_CINS IF_DATA DIM_X DIRECT 0x810F22 /end CHARACTERISTIC
/begin CHARACTERISTIC TSFCKLA "" VALUE 0x810F23 KwUb 255.0 dez 0.00 255.0 FUNCTION_LIST DFPM_CKLA IF_DATA DIM_X DIRECT 0x810F23 /end CHARACTERISTIC
/begin CHARACTERISTIC TSFCLWS "Fehlersummenzeit: CAN-Schnittstelle, Timeout Botschaft Lenkwinkelsensor" VALUE 0x810F24 KwUb 255.0 dez 0.00 255.0 FUNCTION_LIST DFPM_CLWS IF_DATA DIM_X DIRECT 0x810F24 /end CHARACTERISTIC
/begin CHARACTERISTIC TSFDK "Fehlersummenzeit: DK - Potentiometer" VALUE 0x810F25 KwUb 255.0 dez 0.00 255.0 FUNCTION_LIST DFPM_DDVE IF_DATA DIM_X DIRECT 0x810F25 /end CHARACTERISTIC
/begin CHARACTERISTIC TSFDK2P "Fehlersummenzeit: Drosselklappenpotentiometer 2" VALUE 0x810F27 KwUb 255.0 dez 0.00 255.0 FUNCTION_LIST DFPM_DDVE IF_DATA DIM_X DIRECT 0x810F27 /end CHARACTERISTIC
/begin CHARACTERISTIC TSKRLDAB "Zeitkonstante für schnelle LDR-Absenkung" CURVE 0x827FA4 GklWUw 3276.7499992 zk50msxs_uw_b3276p8 0.050000762951 3276.8000000 FUNCTION_LIST LDRLMX IF_DATA DIM_X DIRECT 0x827FA4
 /begin AXIS_DESCR COM_AXIS nmot_w nmot_uw_q0p25 8 0.00 16383.75 AXIS_PTS_REF SNM08LDUW /end AXIS_DESCR
/end CHARACTERISTIC
/begin CHARACTERISTIC TSKRLDAU "Zeitkonstante für schnelle LDR-Aufregelung" CURVE 0x827FB4 GklWUw 3276.7499992 zk50msxs_uw_b3276p8 0.050000762951 3276.8000000 FUNCTION_LIST LDRLMX IF_DATA DIM_X DIRECT 0x827FB4
 /begin AXIS_DESCR COM_AXIS nmot_w nmot_uw_q0p25 8 0.00 16383.75 AXIS_PTS_REF SNM08LDUW /end AXIS_DESCR
/end CHARACTERISTIC
/begin CHARACTERISTIC TSKTDTK "Temperaturabhängige Verzögerungszeit für Katdiagnose" CURVE 0x81C70A KlAUbSstUwWUw 13107.00 t200msxs_uw_q0p2 0.00 13107.00 FUNCTION_LIST DKATSPEB IF_DATA DIM_X DIRECT 0x81C70A
 /begin AXIS_DESCR STD_AXIS tkdkthps temp_ub_q5 4 0.00 1275.000 DEPOSIT ABSOLUT /end AXIS_DESCR
/end CHARACTERISTIC
/begin CHARACTERISTIC TSLABB "Verweilzeit für Sekundärluft- Abbruchbedingung" VALUE 0x818358 KwUb 25.40 t100msxs_ub_b25p5 0.1000 25.50 FUNCTION_LIST SLS IF_DATA DIM_X DIRECT 0x818358 /end CHARACTERISTIC
/begin CHARACTERISTIC TSLDPV "Entprellzeit für Unterschreiten der Fz-Geschwindigkeitsschwelle für Übergang nac" VALUE 0x81A807 KwUb 25.50 t_q0p1 0.00 25.50 FUNCTION_LIST DLDP IF_DATA DIM_X DIRECT 0x81A807 /end CHARACTERISTIC
/begin CHARACTERISTIC TSLPMN "Mindesteinschaltdauer der Sekundärluftpumpe" VALUE 0x818359 KwUb 25.40 t100msxs_ub_b25p5 0.1000 25.50 FUNCTION_LIST SLS IF_DATA DIM_X DIRECT 0x818359 /end CHARACTERISTIC
/begin CHARACTERISTIC TSLUBST "Entprellzeit für Sekundärluft ein im Start bei UBSLSTMN" VALUE 0x81835A KwUb 25.50 t100msxs_ub_b25p5 0.00 25.50 FUNCTION_LIST SLS IF_DATA DIM_X DIRECT 0x81835A /end CHARACTERISTIC
/begin CHARACTERISTIC TSMNSA "Ladezeit bei SA" VALUE 0x81ABE2 KwUb 25.50 txms_ub_q0p1 0.00 25.50 FUNCTION_LIST ZUESZ IF_DATA DIM_X DIRECT 0x81ABE2 /end CHARACTERISTIC
/begin CHARACTERISTIC TSMX "Ladezeitbegrenzung" VALUE 0x81ABE3 KwUb 25.50 txms_ub_q0p1 0.00 25.50 FUNCTION_LIST ZUESZ IF_DATA DIM_X DIRECT 0x81ABE3 /end CHARACTERISTIC
/begin CHARACTERISTIC TSMXNL "Ladezeitbegrenzung im Fehlerfall" VALUE 0x81ABE4 KwUb 25.50 txms_ub_q0p1 0.00 25.50 FUNCTION_LIST ZUESZ IF_DATA DIM_X DIRECT 0x81ABE4 /end CHARACTERISTIC
/begin CHARACTERISTIC TSPUUKA "Sperrzeit fuer Freigabe UK-Adaption" VALUE 0x811BFB KwUb 24.50 t100msxs_ub_b25p5 1.000 25.50 FUNCTION_LIST ESUKAS IF_DATA DIM_X DIRECT 0x811BFB /end CHARACTERISTIC
/begin CHARACTERISTIC TSRFPAB "Mindestschaltzeit Reed-Kontakt für Abbruch Fast Pulse" VALUE 0x8178A2 KwUw 655.3500 t10msxs_uw_b655p35 0.00 655.3500 FUNCTION_LIST DLDP IF_DATA DIM_X DIRECT 0x8178A2 /end CHARACTERISTIC
/begin CHARACTERISTIC TSTBB "Störunterdrückungszeit für Erkennung Betriebsbereitschaft LSU" VALUE 0x811023 KwUb 2.550 t10msxs_ub_b2p55 0.00 2.550 FUNCTION_LIST GGLSU IF_DATA DIM_X DIRECT 0x811023 /end CHARACTERISTIC
/begin CHARACTERISTIC TSTLDOBA "Maximalzeit bis Start Overboost Aktiv Zeit" VALUE 0x819DA0 KwUb 255.0 t1sxs_ub_b255 0.00 255.0 FUNCTION_LIST LDOB IF_DATA DIM_X DIRECT 0x819DA0 /end CHARACTERISTIC
/begin CHARACTERISTIC TSTZUMN "Zeit nach Start für zwangsgeschlossenes TEV" VALUE 0x8178A4 KwUw 65535.00 t1sxs_uw_b65535 0.00 65535.00 FUNCTION_LIST DLDP IF_DATA DIM_X DIRECT 0x8178A4 /end CHARACTERISTIC
/begin CHARACTERISTIC TSWKNBGA_0_A "Zeit bis Setzwertkorrektur nach Ende Beschleunigen" CURVE 0x8187F9 KlAUbSstUbWUb 5.100 t20msxs_ub_q0p02 0.00 5.100 FUNCTION_LIST FGRFULO IF_DATA DIM_X INDIRECT 0x813BA4 /begin AXIS_DESCR STD_AXIS uevges fak_q0p1 8 0.00 25.50 DEPOSIT ABSOLUT /end AXIS_DESCR /end CHARACTERISTIC
/begin CHARACTERISTIC TSWKNBGA_1_A "Zeit bis Setzwertkorrektur nach Ende Beschleunigen" CURVE 0x81880A KlAUbSstUbWUb 5.100 t20msxs_ub_q0p02 0.00 5.100 FUNCTION_LIST FGRFULO IF_DATA DIM_X INDIRECT 0x813BA8 /begin AXIS_DESCR STD_AXIS uevges fak_q0p1 8 0.00 25.50 DEPOSIT ABSOLUT /end AXIS_DESCR /end CHARACTERISTIC
/begin CHARACTERISTIC TSWKNVGA_0_A "Zeit bis Setzwertkorrektur nach Ende Verzögern" CURVE 0x81882C KlAUbSstUbWUb 5.100 t20msxs_ub_q0p02 0.00 5.100 FUNCTION_LIST FGRFULO IF_DATA DIM_X INDIRECT 0x813BAC /begin AXIS_DESCR STD_AXIS uevges fak_q0p1 8 0.00 25.50 DEPOSIT ABSOLUT /end AXIS_DESCR /end CHARACTERISTIC
/begin CHARACTERISTIC TSWKNVGA_1_A "Zeit bis Setzwertkorrektur nach Ende Verzögern" CURVE 0x81883D KlAUbSstUbWUb 5.100 t20msxs_ub_q0p02 0.00 5.100 FUNCTION_LIST FGRFULO IF_DATA DIM_X INDIRECT 0x813BB0 /begin AXIS_DESCR STD_AXIS uevges fak_q0p1 8 0.00 25.50 DEPOSIT ABSOLUT /end AXIS_DESCR /end CHARACTERISTIC
/begin CHARACTERISTIC TSWZK "Entprellzeit für Erkennung Niederoktankraftstoff" VALUE 0x81AA43 KwUb 51.00 t200msxs_ub_b51 0.00 51.00 FUNCTION_LIST ZWGRU IF_DATA DIM_X DIRECT 0x81AA43 /end CHARACTERISTIC
/begin CHARACTERISTIC TSWZKR "Entprellzeit für Erkennun !Nideroktankraftstoff" VALUE 0x81AA44 KwUb 51.00 t200msxs_ub_b51 0.00 51.00 FUNCTION_LIST ZWGRU IF_DATA DIM_X DIRECT 0x81AA44 /end CHARACTERISTIC
/begin CHARACTERISTIC TTE "Zeit für Tankentlüftungsphase" VALUE 0x81E342 KwUw 6553.500 t100msxs_uw_b6553p6 0.00 6553.500 FUNCTION_LIST BBTEGA IF_DATA DIM_X DIRECT 0x81E342 /end CHARACTERISTIC
/begin CHARACTERISTIC TTEAE "Zeit für Tankentlüftungsphase bei eingeschwungener Gemischadaption" VALUE 0x81E344 KwUw 6553.500 t100msxs_uw_b6553p6 0.00 6553.500 FUNCTION_LIST BBTEGA IF_DATA DIM_X DIRECT 0x81E344 /end CHARACTERISTIC
/begin CHARACTERISTIC TTEAUS "Zeit nach Start bis TEB aktiv wird" VALUE 0x829C56 KwUw 195.0000 t100msxs_uw_q100 5.000000 200.0000 FUNCTION_LIST TEBEB IF_DATA DIM_X DIRECT 0x829C56 /end CHARACTERISTIC
/begin CHARACTERISTIC TTEBSTP "Maximal Zeit für TE-Stop im Leerlauf bei nicht gesetzten Zyklusflags" VALUE 0x81E346 KwUw 6553.500 t100msxs_uw_b6553p6 0.00 6553.500 FUNCTION_LIST BBTEGA IF_DATA DIM_X DIRECT 0x81E346 /end CHARACTERISTIC
/begin CHARACTERISTIC TTEGA "Zeit bei der Tankentlüftung für Grundadaption" VALUE 0x81E348 KwUw 6553.500 t100msxs_uw_b6553p6 0.00 6553.500 FUNCTION_LIST BBTEGA IF_DATA DIM_X DIRECT 0x81E348 /end CHARACTERISTIC
/begin CHARACTERISTIC TTEGAI "Zeitdauer der ersten  Gemischadaptionsphase" VALUE 0x81E34A KwUw 6553.500 t100msxs_uw_b6553p6 0.00 6553.500 FUNCTION_LIST BBTEGA IF_DATA DIM_X DIRECT 0x81E34A /end CHARACTERISTIC
/begin CHARACTERISTIC TTEGAIH "Zeitdauer der ersten  Gemischadaptionsphase bei Heißstart" VALUE 0x81E34C KwUw 6553.500 t100msxs_uw_b6553p6 0.00 6553.500 FUNCTION_LIST BBTEGA IF_DATA DIM_X DIRECT 0x81E34C /end CHARACTERISTIC
/begin CHARACTERISTIC TTEGAZO "Zeit für Tankentlüftungsstop wg. Gemischadaption, obere Schwelle" VALUE 0x81E34E KwUw 6553.500 t100msxs_uw_b6553p6 0.00 6553.500 FUNCTION_LIST BBTEGA IF_DATA DIM_X DIRECT 0x81E34E /end CHARACTERISTIC
/begin CHARACTERISTIC TTEGAZU "Zeit für Tankentlüftungsstop wg. Gemischadaption, untere Schwelle" VALUE 0x81E350 KwUw 6553.500 t100msxs_uw_b6553p6 0.00 6553.500 FUNCTION_LIST BBTEGA IF_DATA DIM_X DIRECT 0x81E350 /end CHARACTERISTIC
/begin CHARACTERISTIC TTEINI "Zeit für Tankentlüftung in erster TE-Phase nach Initialisierung (B_ini)" VALUE 0x81E352 KwUw 6553.500 t100msxs_uw_b6553p6 0.00 6553.500 FUNCTION_LIST BBTEGA IF_DATA DIM_X DIRECT 0x81E352 /end CHARACTERISTIC
/begin CHARACTERISTIC TTEMN "Zeit für Tankentlüftungsphase minimal" VALUE 0x81E354 KwUw 6553.500 t100msxs_uw_b6553p6 0.00 6553.500 FUNCTION_LIST BBTEGA IF_DATA DIM_X DIRECT 0x81E354 /end CHARACTERISTIC
/begin CHARACTERISTIC TTEPRIO "Zeit ab Start für Umschalten auf Dauertankentlüftung" VALUE 0x81E356 KwUw 6553.500 t100msxs_uw_b6553p6 0.00 6553.500 FUNCTION_LIST BBTEGA IF_DATA DIM_X DIRECT 0x81E356 /end CHARACTERISTIC
/begin CHARACTERISTIC TTEVAZ "Verweilzeit für TEV Aufsteuern bei nicht eingeschwungen frm" VALUE 0x81A786 KwUb 10.00 t100msxs_ub_b25p5 0.00 10.00 FUNCTION_LIST DTEV IF_DATA DIM_X DIRECT 0x81A786 /end CHARACTERISTIC
/begin CHARACTERISTIC TTEZAO "Zeit für Tankentlüftung Daueraktivierung, obere Schwelle" VALUE 0x81E358 KwUw 6553.500 t100msxs_uw_b6553p6 0.00 6553.500 FUNCTION_LIST BBTEGA IF_DATA DIM_X DIRECT 0x81E358 /end CHARACTERISTIC
/begin CHARACTERISTIC TTEZAU "Zeit für Tankentlüftung Daueraktivierung, untere Schwelle" VALUE 0x81E35A KwUw 6553.500 t100msxs_uw_b6553p6 0.00 6553.500 FUNCTION_LIST BBTEGA IF_DATA DIM_X DIRECT 0x81E35A /end CHARACTERISTIC
/begin CHARACTERISTIC TTIPINEN "Zeit bis zur Abfrage auf Kraftschluß bei Drehzahldynamik" VALUE 0x812ACC KwUb 2.550 t10msxs_ub_b2p55 0.00 2.550 FUNCTION_LIST ZWMIN IF_DATA DIM_X DIRECT 0x812ACC /end CHARACTERISTIC
/begin CHARACTERISTIC TTIPINON "Einschaltzeit Tip-In Offset auf spätesten Zündwinkel" VALUE 0x812ACD KwUb 12.75 t50msxs_ub_b12p75 0.00 12.75 FUNCTION_LIST ZWMIN IF_DATA DIM_X DIRECT 0x812ACD /end CHARACTERISTIC
/begin CHARACTERISTIC TTOTLDP "Totzeit LDP- Sofortansteuerung während Fast Pulse" VALUE 0x8178A6 KwUw 655.3500 t10msxs_uw_b655p35 0.00 655.3500 FUNCTION_LIST DLDP IF_DATA DIM_X DIRECT 0x8178A6 /end CHARACTERISTIC
/begin CHARACTERISTIC TUBKL15 "Filterzeit für redundante KL15-Erfassung" VALUE 0x81A44D KwUb 2.550 t10msxs_ub_b2p55 0.00 2.550 FUNCTION_LIST GGZDGON IF_DATA DIM_X DIRECT 0x81A44D /end CHARACTERISTIC
/begin CHARACTERISTIC TUHEMN "Minimale Solltemperatur abhängig vom Heizungspoti" CURVE 0x81AF59 KlAUbSstUbWUb 191.3 temp_ub_q0p75_o48 -48.00 143.3 FUNCTION_LIST KMTR IF_DATA DIM_X DIRECT 0x81AF59 /begin AXIS_DESCR STD_AXIS uhepoti dez 5 0.00 255.0 DEPOSIT ABSOLUT /end AXIS_DESCR /end CHARACTERISTIC
/begin CHARACTERISTIC TUHEMX "Maximale Solltemperatur abhängig vom Heizungspoti" CURVE 0x81AF64 KlAUbSstUbWUb 191.3 temp_ub_q0p75_o48 -48.00 143.3 FUNCTION_LIST KMTR IF_DATA DIM_X DIRECT 0x81AF64 /begin AXIS_DESCR STD_AXIS uhepoti dez 5 0.00 255.0 DEPOSIT ABSOLUT /end AXIS_DESCR /end CHARACTERISTIC
/begin CHARACTERISTIC TULV3 "Verzögerungszeit für Heilung Überladefehler" VALUE 0x819E5E KwUb 12.75 t50msxs_ub_b12p75 0.00 12.75 FUNCTION_LIST DLDR IF_DATA DIM_X DIRECT 0x819E5E /end CHARACTERISTIC
/begin CHARACTERISTIC TUMDETM "Umgebungslufttemperatur-Ersatzwert für Motortemperatur-Modell" VALUE 0x81978B KwUb 191.3 temp_ub_q0p75_o48 -48.00 143.3 FUNCTION_LIST GGTFM IF_DATA DIM_X DIRECT 0x81978B /end CHARACTERISTIC
/begin CHARACTERISTIC TUMEWKMTR "Ersatzwert Umgebungstemperatur in KMTR" VALUE 0x81AF6F KwUb 191.3 temp_ub_q0p75_o48 -48.00 143.3 FUNCTION_LIST KMTR IF_DATA DIM_X DIRECT 0x81AF6F /end CHARACTERISTIC
/begin CHARACTERISTIC TUMKLIHDV "Umgebgungstemperatur-Schwelle für Lüfter schnell-Hochlauf" VALUE 0x81AF70 KwUb 191.3 temp_ub_q0p75_o48 -48.00 143.3 FUNCTION_LIST KMTR IF_DATA DIM_X DIRECT 0x81AF70 /end CHARACTERISTIC
/begin CHARACTERISTIC TUMLUESEW "Ersatzwert Umgebungstemperatur" VALUE 0x81AF71 KwUb 191.3 temp_ub_q0p75_o48 -48.00 143.3 FUNCTION_LIST KMTR IF_DATA DIM_X DIRECT 0x81AF71 /end CHARACTERISTIC
/begin CHARACTERISTIC TUMTAI "Initialisierungswert Umgebungstemperatur" VALUE 0x819547 KwUb 191.3 temp_ub_q0p75_o48 -48.00 143.3 FUNCTION_LIST BGTUMG IF_DATA DIM_X DIRECT 0x819547 /end CHARACTERISTIC
/begin CHARACTERISTIC TUMTAIT "Initialisierungswert Umgebungstemperatur aus TANS" VALUE 0x818664 KwUb 191.3 temp_ub_q0p75_o48 -48.00 143.3 FUNCTION_LIST ATM IF_DATA DIM_X DIRECT 0x818664 /end CHARACTERISTIC
/begin CHARACTERISTIC TUPOTMN "Minimale Solltemperatur abhängig von Climatronic" CURVE 0x81AF72 KlAUbSstUbWUb 191.3 temp_ub_q0p75_o48 -48.00 143.3 FUNCTION_LIST KMTR IF_DATA DIM_X DIRECT 0x81AF72 /begin AXIS_DESCR STD_AXIS upotpwm spg_ub_b5 5 0.00 4.980 DEPOSIT ABSOLUT /end AXIS_DESCR /end CHARACTERISTIC
/begin CHARACTERISTIC TUPOTMX "Maximale Solltemperatur abhängig von Climatronic" CURVE 0x81AF7D KlAUbSstUbWUb 191.3 temp_ub_q0p75_o48 -48.00 143.3 FUNCTION_LIST KMTR IF_DATA DIM_X DIRECT 0x81AF7D /begin AXIS_DESCR STD_AXIS upotpwm spg_ub_b5 5 0.00 4.980 DEPOSIT ABSOLUT /end AXIS_DESCR /end CHARACTERISTIC
/begin CHARACTERISTIC TUPWBWV "Zeitverzögerung zum Einspeichern eines neuen Poti 2 Wertes" VALUE 0x811041 KwUb 2.550 t10msxs_ub_b2p55 0.00 2.550 FUNCTION_LIST GGPED IF_DATA DIM_X DIRECT 0x811041 /end CHARACTERISTIC
/begin CHARACTERISTIC TUPWG12 "Fehlerzeit bei Vergleich von PWG-Poti 1 und 2" VALUE 0x811042 KwUb 2.550 t10msxs_ub_b2p55 0.00 2.550 FUNCTION_LIST GGPED IF_DATA DIM_X DIRECT 0x811042 /end CHARACTERISTIC
/begin CHARACTERISTIC TUPWG1O "Fehlerzeit bei Bereichsverletzung von PWG-Poti 1 nach oben" VALUE 0x811043 KwUb 2.550 t10msxs_ub_b2p55 0.00 2.550 FUNCTION_LIST GGPED IF_DATA DIM_X DIRECT 0x811043 /end CHARACTERISTIC
/begin CHARACTERISTIC TUPWG1U "Fehlerzeit bei Bereichsverletzung von PWG-Poti 1 nach unten" VALUE 0x811044 KwUb 2.550 t10msxs_ub_b2p55 0.00 2.550 FUNCTION_LIST GGPED IF_DATA DIM_X DIRECT 0x811044 /end CHARACTERISTIC
/begin CHARACTERISTIC TUPWG2O "Fehlerzeit bei Bereichsverletzung von PWG-Poti 2 nach oben" VALUE 0x811045 KwUb 2.550 t10msxs_ub_b2p55 0.00 2.550 FUNCTION_LIST GGPED IF_DATA DIM_X DIRECT 0x811045 /end CHARACTERISTIC
/begin CHARACTERISTIC TUPWG2U "Fehlerzeit bei Bereichsverletzung von PWG-Poti 2 nach unten" VALUE 0x811046 KwUb 2.550 t10msxs_ub_b2p55 0.00 2.550 FUNCTION_LIST GGPED IF_DATA DIM_X DIRECT 0x811046 /end CHARACTERISTIC
/begin CHARACTERISTIC TUPWLLU "Entprellzeit zur Fehlererkennung ""unerwartete Leerlaufspannungen""" VALUE 0x811047 KwUb 2.550 t10msxs_ub_b2p55 0.00 2.550 FUNCTION_LIST GGPED IF_DATA DIM_X DIRECT 0x811047 /end CHARACTERISTIC
/begin CHARACTERISTIC TUSBELH "Zeit für Festhaltung der Sondenspannung nach Impulsbelastung  hinter KAT" VALUE 0x811019 KwUb 2.550 t10msxs_ub_b2p55 0.00 2.550 FUNCTION_LIST GGLSH IF_DATA DIM_X DIRECT 0x811019 /end CHARACTERISTIC
/begin CHARACTERISTIC TUSCHUB "Verzögerungszeit für Störspitzen bei Schubprüfung der Sonde hinter KAT" VALUE 0x818672 KwUb 25.50 t100msxs_ub_b25p5 0.00 25.50 FUNCTION_LIST DLSAHK IF_DATA DIM_X DIRECT 0x818672 /end CHARACTERISTIC
/begin CHARACTERISTIC TUSHKVL "Verzögerungszeit für Störspitzen bei Vollastprüfung der Sonde hinter KAT" VALUE 0x818673 KwUb 25.50 t100msxs_ub_b25p5 0.00 25.50 FUNCTION_LIST DLSAHK IF_DATA DIM_X DIRECT 0x818673 /end CHARACTERISTIC
/begin CHARACTERISTIC TUSHSMIN "Mindestdauer für Steigungsmessung für enable Filter hinter Kat" VALUE 0x818674 KwUb 25.50 t100msxs_ub_b25p5 0.00 25.50 FUNCTION_LIST DLSAHK IF_DATA DIM_X DIRECT 0x818674 /end CHARACTERISTIC
/begin CHARACTERISTIC TUSHZFH "Zeitfenster für Messung Heizertakt-Einkopplung  auf Sondensignal hinter  KAT" VALUE 0x811014 KwUb 2.550 t10msxs_ub_b2p55 0.00 2.550 FUNCTION_LIST DLSH IF_DATA DIM_X DIRECT 0x811014 /end CHARACTERISTIC
/begin CHARACTERISTIC TUSKS "Entstörzeit für Abschalten einzelner Funktionen Sonde hinter KAT" VALUE 0x811015 KwUb 5.100 t20msxs_ub_b5p1 0.00 5.100 FUNCTION_LIST DLSH IF_DATA DIM_X DIRECT 0x811015 /end CHARACTERISTIC
/begin CHARACTERISTIC TUSMAX "Überwachungszeit für Usmax" VALUE 0x81866B KwUb 25.50 t100msxs_ub_b25p5 0.00 25.50 FUNCTION_LIST DLSH IF_DATA DIM_X DIRECT 0x81866B /end CHARACTERISTIC
/begin CHARACTERISTIC TUSMSVL "Zeit nach Vollast für Überprüfung Sonde hinter KAT" VALUE 0x818675 KwUb 25.50 t100msxs_ub_b25p5 0.00 25.50 FUNCTION_LIST DLSAHK IF_DATA DIM_X DIRECT 0x818675 /end CHARACTERISTIC
/begin CHARACTERISTIC TUSSA "Verzögerungszeit nach Über/Unterschreiten der Regelschwelle hinter KAT" VALUE 0x818676 KwUb 25.50 t100msxs_ub_b25p5 0.00 25.50 FUNCTION_LIST DLSAHK IF_DATA DIM_X DIRECT 0x818676 /end CHARACTERISTIC
/begin CHARACTERISTIC TVABST "Verzugszeit Funktionsabschaltung nach Startende" VALUE 0x819541 KwUb 12.75 t50msxs_ub_b12p75 0.00 12.75 FUNCTION_LIST BGTABST IF_DATA DIM_X DIRECT 0x819541 /end CHARACTERISTIC
/begin CHARACTERISTIC TVAG "Zeit für Gewichtungsfaktor VA aktiv" VALUE 0x81951B KwUb 25.50 t100msxs_ub_b25p5 0.00 25.50 FUNCTION_LIST ESUK IF_DATA DIM_X DIRECT 0x81951B /end CHARACTERISTIC
/begin CHARACTERISTIC TVAGRFTE "Verzögerungszeit für Freigabe der AGR nach einer Sperrung" VALUE 0x81A6A8 KwUb 25.50 t100msxs_ub_b25p5 0.00 25.50 FUNCTION_LIST TEB IF_DATA DIM_X DIRECT 0x81A6A8 /end CHARACTERISTIC
/begin CHARACTERISTIC TVARS "Verzoegerungszeit fuer AR wieder inaktiv" VALUE 0x811F17 KwUb 2.550 t10msxs_ub_b2p55 0.00 2.550 FUNCTION_LIST ARMD IF_DATA DIM_X DIRECT 0x811F17 /end CHARACTERISTIC
/begin CHARACTERISTIC TVARSA "Zeit für Aktivierung dynamischer Antiruckel-Eingriff nach Schubabschalten" VALUE 0x811F18 KwUb 2.550 t10msxs_ub_b2p55 0.00 2.550 FUNCTION_LIST ARMD IF_DATA DIM_X DIRECT 0x811F18 /end CHARACTERISTIC
/begin CHARACTERISTIC TVARSS "Verzögerungszeit für AR wieder inaktiv im Stationärfall" VALUE 0x811F19 KwUb 2.550 t10msxs_ub_b2p55 0.00 2.550 FUNCTION_LIST ARMD IF_DATA DIM_X DIRECT 0x811F19 /end CHARACTERISTIC
/begin CHARACTERISTIC TVCAMSR "Entprellzeit nach Start Startende bei ASR/MSR-Fehler" VALUE 0x813D2E KwUw 655.3500 t10msxs_uw_b655p35 0.00 655.3500 FUNCTION_LIST GGCASR IF_DATA DIM_X DIRECT 0x813D2E /end CHARACTERISTIC
/begin CHARACTERISTIC TVCJLSU "Verzögerungszeit für Fehler CJ110" VALUE 0x8186F8 KwUb 25.50 t100msxs_ub_b25p5 0.00 25.50 FUNCTION_LIST DLSU IF_DATA DIM_X DIRECT 0x8186F8 /end CHARACTERISTIC
/begin CHARACTERISTIC TVDK "Verzögerungszeit nach Schließen der Drosselklappe" VALUE 0x811C9F KwUb 5.100 t20msxs_ub_b5p1 0.00 5.100 FUNCTION_LIST LLRBB IF_DATA DIM_X DIRECT 0x811C9F /end CHARACTERISTIC
/begin CHARACTERISTIC TVDRL "Verzögerungszeit für Dynamikmessung LSU" VALUE 0x8186F9 KwUb 25.50 t100msxs_ub_b25p5 0.00 25.50 FUNCTION_LIST DLSU IF_DATA DIM_X DIRECT 0x8186F9 /end CHARACTERISTIC
/begin CHARACTERISTIC TVDSLOFF "Zeitverzögerung Schließen Sekundärluftventil bei Adaption/Kurztrip" VALUE 0x81835B KwUb 25.50 t100msxs_ub_b25p5 0.00 25.50 FUNCTION_LIST SLS IF_DATA DIM_X DIRECT 0x81835B /end CHARACTERISTIC
/begin CHARACTERISTIC TVDTEABG "Verzögerungszeit zwischen Motor und Lambdasonde" VALUE 0x81A787 KwUb 2.000 t100msxs_ub_b25p5 0.00 2.000 FUNCTION_LIST DTEV IF_DATA DIM_X DIRECT 0x81A787 /end CHARACTERISTIC
/begin CHARACTERISTIC TVDTEB "Verzögerungszeit ab TEV offen für Aussage TEV i.O./defekt in Diagnose DTEV" VALUE 0x81A788 KwUb 10.00 t100msxs_ub_b25p5 0.00 10.00 FUNCTION_LIST DTEV IF_DATA DIM_X DIRECT 0x81A788 /end CHARACTERISTIC
/begin CHARACTERISTIC TVDTEE "Zeitdauer ab TEV offen für Prüfung DTEV" VALUE 0x81A789 KwUb 12.00 t100msxs_ub_b25p5 3.000 15.00 FUNCTION_LIST DTEV IF_DATA DIM_X DIRECT 0x81A789 /end CHARACTERISTIC
/begin CHARACTERISTIC TVDTELLA "Mindestzzeit für Aktivierungsbedingungen für Aufsteuerprüfung DTEV erfüllt" VALUE 0x81A78A KwUb 9.500 t100msxs_ub_b25p5 0.5000 10.00 FUNCTION_LIST DTEV IF_DATA DIM_X DIRECT 0x81A78A /end CHARACTERISTIC
/begin CHARACTERISTIC TVDTEVP "Entprellung für Setzen Flip-Flop Passiv-Prüfung DTEV i.O." VALUE 0x81A78B KwUb 19.00 t100msxs_ub_b25p5 1.000 20.00 FUNCTION_LIST DTEV IF_DATA DIM_X DIRECT 0x81A78B /end CHARACTERISTIC
/begin CHARACTERISTIC TVDTEVPM "Entprellung für Setzen Flip-Flop ""Diagnose passiv möglich""" VALUE 0x81A78C KwUb 19.00 t100msxs_ub_b25p5 1.000 20.00 FUNCTION_LIST DTEV IF_DATA DIM_X DIRECT 0x81A78C /end CHARACTERISTIC
/begin CHARACTERISTIC TVDTEVZ "Verzögerungszeit für Schließen TEV für Aufsteuerprüfung DTEV" VALUE 0x81A78D KwUb 10.00 t100msxs_ub_b25p5 0.00 10.00 FUNCTION_LIST DTEV IF_DATA DIM_X DIRECT 0x81A78D /end CHARACTERISTIC
/begin CHARACTERISTIC TVERBR "Verzögerungszeit für Bremsschalter-Plausibilitätsprüfung" VALUE 0x81873D KwUb 25.50 t100msxs_ub_b25p5 0.00 25.50 FUNCTION_LIST GGEGAS IF_DATA DIM_X DIRECT 0x81873D /end CHARACTERISTIC
/begin CHARACTERISTIC TVESWER "Verzögerungszeit für Erkennung fehlerfreies Schlechtwegsignal" VALUE 0x818459 KwUb 25.50 t100msxs_ub_b25p5 0.00 25.50 FUNCTION_LIST DSWEA IF_DATA DIM_X DIRECT 0x818459 /end CHARACTERISTIC
/begin CHARACTERISTIC TVESWES "Verzögerungszeit für Erkennung fehlerhaften Schlechtwegsignal" VALUE 0x81845A KwUb 25.50 t100msxs_ub_b25p5 0.00 25.50 FUNCTION_LIST DSWEA IF_DATA DIM_X DIRECT 0x81845A /end CHARACTERISTIC
/begin CHARACTERISTIC TVETREW "Ersatzwert Tastverhältnis Thermostat" VALUE 0x81AF88 KwUb 99.61 tv_ub_b100 0.00 99.61 FUNCTION_LIST KMTR IF_DATA DIM_X DIRECT 0x81AF88 /end CHARACTERISTIC
/begin CHARACTERISTIC TVETRMN "Minimales Tastverhältnis Thermostat" VALUE 0x81AF89 KwUb 99.61 tv_ub_b100 0.00 99.61 FUNCTION_LIST KMTR TKMWL IF_DATA DIM_X DIRECT 0x81AF89 /end CHARACTERISTIC
/begin CHARACTERISTIC TVETRMX "Maximales Tastverhältnis Thermostat" VALUE 0x81AF8A KwUb 99.61 tv_ub_b100 0.00 99.61 FUNCTION_LIST KMTR IF_DATA DIM_X DIRECT 0x81AF8A /end CHARACTERISTIC
/begin CHARACTERISTIC TVFKMSDK "Zeitverzögerung bis min. oder max. fkmsdk-Anschlag weitergegeben werden" VALUE 0x811326 KwUb 2.550 t10msxs_ub_b2p55 0.00 2.550 FUNCTION_LIST DEGFE IF_DATA DIM_X DIRECT 0x811326 /end CHARACTERISTIC
/begin CHARACTERISTIC TVFRG "Verzögerundszeit nach Satrtende bis zur Freigabe des Füllungsreglers" VALUE 0x811327 KwUb 12.75 t50msxs_ub_b12p75 0.00 12.75 FUNCTION_LIST FUEREG IF_DATA DIM_X DIRECT 0x811327 /end CHARACTERISTIC
/begin CHARACTERISTIC TVFSAM "Temperaturabhängige Verzögerungszeit für Fahrstufe AUS" CURVE 0x81A0E7 GklWUb 5.100 t20msxs_ub_b5p1 0.00 5.100 FUNCTION_LIST MDWAN IF_DATA DIM_X DIRECT 0x81A0E7
 /begin AXIS_DESCR COM_AXIS twnd temp_ub_q0p75_o48 8 -48.00 143.3 AXIS_PTS_REF STW08MDUB /end AXIS_DESCR
/end CHARACTERISTIC
/begin CHARACTERISTIC TVFSAWE "Verzögerungszeit für Rücksetzen von B_fil" VALUE 0x817060 KwUw 655.3500 t10msxs_uw_b655p35 0.00 655.3500 FUNCTION_LIST MDFAW IF_DATA DIM_X DIRECT 0x817060 /end CHARACTERISTIC
/begin CHARACTERISTIC TVFSEM "Temperaturabhängige Verzögerungszeit für Fahrstufe EIN" CURVE 0x81A0F7 GklWUb 5.100 t20msxs_ub_b5p1 0.00 5.100 FUNCTION_LIST MDWAN IF_DATA DIM_X DIRECT 0x81A0F7
 /begin AXIS_DESCR COM_AXIS twnd temp_ub_q0p75_o48 8 -48.00 143.3 AXIS_PTS_REF STW08MDUB /end AXIS_DESCR
/end CHARACTERISTIC
/begin CHARACTERISTIC TVFSRAM "motortemperaturabhängige Verzögerungszeit für Fahrstufe aus (R)" CURVE 0x81A0FF GklWUb 5.100 t20msxs_ub_b5p1 0.00 5.100 FUNCTION_LIST MDWAN IF_DATA DIM_X DIRECT 0x81A0FF
 /begin AXIS_DESCR COM_AXIS twnd temp_ub_q0p75_o48 8 -48.00 143.3 AXIS_PTS_REF STW08MDUB /end AXIS_DESCR
/end CHARACTERISTIC
/begin CHARACTERISTIC TVFSREM "motortemperaturabhängige Verzögerungszeit für Fahrstufe ein (R)" CURVE 0x81A107 GklWUb 5.100 t20msxs_ub_b5p1 0.00 5.100 FUNCTION_LIST MDWAN IF_DATA DIM_X DIRECT 0x81A107
 /begin AXIS_DESCR COM_AXIS twnd temp_ub_q0p75_o48 8 -48.00 143.3 AXIS_PTS_REF STW08MDUB /end AXIS_DESCR
/end CHARACTERISTIC
/begin CHARACTERISTIC TVFUE "Verzögerungszeit für den Aufbau der Füllung" VALUE 0x811E43 KwUb 5.100 t20msxs_ub_b5p1 0.00 5.100 FUNCTION_LIST MDWAN IF_DATA DIM_X DIRECT 0x811E43 /end CHARACTERISTIC
/begin CHARACTERISTIC TVFZDIF "Zeitintervall für vfz-Differenzberechnung" VALUE 0x81A808 KwUb 25.50 t100msxs_ub_b25p5 0.00 25.50 FUNCTION_LIST DLDP IF_DATA DIM_X DIRECT 0x81A808 /end CHARACTERISTIC
/begin CHARACTERISTIC TVFZNW "Vezögerungszeit für Aktivierung der CIFI-Faktoren nach NoWe-Umschaltung" VALUE 0x81120E KwUb 2.550 t10msxs_ub_b2p55 0.00 2.550 FUNCTION_LIST ACIFI IF_DATA DIM_X DIRECT 0x81120E /end CHARACTERISTIC
/begin CHARACTERISTIC TVHKLSU "Verzögerungszeit für Diagnose Heizerkopplung" VALUE 0x81C79E KwUw 6553.500 t100msxs_uw_b6553p5 0.00 6553.500 FUNCTION_LIST DLSU IF_DATA DIM_X DIRECT 0x81C79E /end CHARACTERISTIC
/begin CHARACTERISTIC TVHKLSUV "Zeit für Diagnose Heizerkopplung" VALUE 0x811026 KwUb 2.550 t10msxs_ub_b2p55 0.00 2.550 FUNCTION_LIST DLSU IF_DATA DIM_X DIRECT 0x811026 /end CHARACTERISTIC
/begin CHARACTERISTIC TVHSHEE "Entprellzeit für Heizerendstufdiagnose hinter Kat" VALUE 0x81849F KwUb 12.75 t50msxs_ub_b12p75 0.00 12.75 FUNCTION_LIST DHLSHK IF_DATA DIM_X DIRECT 0x81849F /end CHARACTERISTIC
/begin CHARACTERISTIC TVHSHRI "Verzögerungszeit für Ri-Fehler hinter Kat" VALUE 0x8184A0 KwUb 255.0 t1sxs_ub_b255 0.00 255.0 FUNCTION_LIST DHLSHK IF_DATA DIM_X DIRECT 0x8184A0 /end CHARACTERISTIC
/begin CHARACTERISTIC TVHSHRIHEL "Verzögerungszeit für Heilung Ri-Fehler hinter Kat, wenn B_npfhsh =1" VALUE 0x8184A1 KwUb 255.0 t1sxs_ub_b255 0.00 255.0 FUNCTION_LIST DHLSHK IF_DATA DIM_X DIRECT 0x8184A1 /end CHARACTERISTIC
/begin CHARACTERISTIC TVHSHRIZ "Verzögerungszeit für Heilung Ri-Fehler hinter Kat" VALUE 0x8184A2 KwUb 255.0 t1sxs_ub_b255 0.00 255.0 FUNCTION_LIST DHLSHK IF_DATA DIM_X DIRECT 0x8184A2 /end CHARACTERISTIC
/begin CHARACTERISTIC TVKLIHDV1 "Tastverhältnis für Lüfter schnell-Hochlauf" VALUE 0x81AF8B KwUb 99.61 tv_ub_b100 0.00 99.61 FUNCTION_LIST KMTR IF_DATA DIM_X DIRECT 0x81AF8B /end CHARACTERISTIC
/begin CHARACTERISTIC TVKLIHDV2 "Tastverhältnis für Lüfter schnell-Hochlauf" VALUE 0x81AF8C KwUb 99.61 tv_ub_b100 0.00 99.61 FUNCTION_LIST KMTR IF_DATA DIM_X DIRECT 0x81AF8C /end CHARACTERISTIC
/begin CHARACTERISTIC TVKOE1 "Verzögerungszeit für Kompressor EIN ( zur Momentreserve)" VALUE 0x812DE4 KwUb 5.100 t20msxs_ub_b5p1 0.00 5.100 FUNCTION_LIST KOS IF_DATA DIM_X DIRECT 0x812DE4 /end CHARACTERISTIC
/begin CHARACTERISTIC TVKOEOF "Verzögerungszeit für B_koe AUS" VALUE 0x812DE5 KwUb 5.100 t20msxs_ub_b5p1 0.00 5.100 FUNCTION_LIST KOS IF_DATA DIM_X DIRECT 0x812DE5 /end CHARACTERISTIC
/begin CHARACTERISTIC TVKOEP "Verzögerungszeit für Kompressor EIN ( zur Momentreserve)" CURVE 0x81ABE6 KlAUbSstUbWUb 5.100 t20msxs_ub_b5p1 0.00 5.100 FUNCTION_LIST KOS IF_DATA DIM_X DIRECT 0x81ABE6 /begin AXIS_DESCR STD_AXIS pkodrc p_q0p2 8 0.00 51.00 DEPOSIT ABSOLUT /end AXIS_DESCR /end CHARACTERISTIC
/begin CHARACTERISTIC TVKOEV "Verzögerungszeit für Kompressoreinschalten (totzeit)" VALUE 0x812DE6 KwUb 5.100 t20msxs_ub_b5p1 0.00 5.100 FUNCTION_LIST KOS IF_DATA DIM_X DIRECT 0x812DE6 /end CHARACTERISTIC
/begin CHARACTERISTIC TVKOGANDEL "Verzögerungszeit für Kompressor EIN ( zur Momentreserve)" VALUE 0x812DE7 KwUb 5.100 t20msxs_ub_b5p1 0.00 5.100 FUNCTION_LIST KOS IF_DATA DIM_X DIRECT 0x812DE7 /end CHARACTERISTIC
/begin CHARACTERISTIC TVKOSSIM "Verzögerungszeit für Simulation einer eingeschalteten Klimaanlage im Start" VALUE 0x81ABF7 KwUb 51.00 t200msxs_ub_b51 0.00 51.00 FUNCTION_LIST KOS IF_DATA DIM_X DIRECT 0x81ABF7 /end CHARACTERISTIC
/begin CHARACTERISTIC TVKRSTAT "Verzögerungszeit KR stationär Betrieb" VALUE 0x811C2D KwUb 25.50 t100msxs_ub_b25p5 0.00 25.50 FUNCTION_LIST KRRA IF_DATA DIM_X DIRECT 0x811C2D /end CHARACTERISTIC
/begin CHARACTERISTIC TVKTDLE "Verzögerungszeit bis Lambda eingeschwungen bei Katdiagnose" VALUE 0x8186DD KwUb 12.75 t_q0p05 0.00 12.75 FUNCTION_LIST DKATSP IF_DATA DIM_X DIRECT 0x8186DD /end CHARACTERISTIC
/begin CHARACTERISTIC TVKTDRX "Maximale Fettzeit für hintere Sondenspannung bei Katdiagnose" VALUE 0x8186DE KwUb 5.100 t_q0p02 0.00 5.100 FUNCTION_LIST DKATSP IF_DATA DIM_X DIRECT 0x8186DE /end CHARACTERISTIC
/begin CHARACTERISTIC TVKUP "Verzögerungszeit für B_kupplv" VALUE 0x811209 KwUb 5.100 t20msxs_ub_b5p1 0.00 5.100 FUNCTION_LIST GGEGAS IF_DATA DIM_X DIRECT 0x811209 /end CHARACTERISTIC
/begin CHARACTERISTIC TVKUPAR "Verzögerungszeit Kupplung für Antiruckelfunktion" VALUE 0x811F1A KwUb 5.100 t20msxs_ub_b5p1 0.00 5.100 FUNCTION_LIST ARMD IF_DATA DIM_X DIRECT 0x811F1A /end CHARACTERISTIC
/begin CHARACTERISTIC TVKUPHS "Verzögerungszeit Kupplungsschalter beim Hochschalten" CURVE 0x811F1B FklWUb 2.550 t10msxs_ub_b2p55 0.00 2.550 FUNCTION_LIST ARMD IF_DATA DIM_X DIRECT 0x811F1B /begin AXIS_DESCR FIX_AXIS gangi dez 8 0.00 7.000 FIX_AXIS_PAR 0 0 8 /end AXIS_DESCR /end CHARACTERISTIC
/begin CHARACTERISTIC TVKUPPL "Verzögerungszeit für die Information des Kupplungsschalter" VALUE 0x811CA0 KwUb 5.100 t20msxs_ub_b5p1 0.00 5.100 FUNCTION_LIST LLRBB IF_DATA DIM_X DIRECT 0x811CA0 /end CHARACTERISTIC
/begin CHARACTERISTIC TVKUPRS "Verzögerungszeit Kupplungsschalter beim Runterschalten" CURVE 0x811F23 FklWUb 2.550 t10msxs_ub_b2p55 0.00 2.550 FUNCTION_LIST ARMD IF_DATA DIM_X DIRECT 0x811F23 /begin AXIS_DESCR FIX_AXIS gangi dez 8 0.00 7.000 FIX_AXIS_PAR 0 0 8 /end AXIS_DESCR /end CHARACTERISTIC
/begin CHARACTERISTIC TVLADV_0_A "Zeitkonstante für Integrator bei vlast-Berechnung" CURVE 0x81CDA6 KlAUwSstSwWUw 1310.6999997 zk20msxs_uw_b1310 0.020000305180 1310.7200000 FUNCTION_LIST FGRREGL IF_DATA DIM_X INDIRECT 0x813C02
 /begin AXIS_DESCR STD_AXIS dvzvi_w vfzg_sw_q0p00781 8 -256.0000 255.9922 DEPOSIT ABSOLUT /end AXIS_DESCR
/end CHARACTERISTIC
/begin CHARACTERISTIC TVLADV_1_A "Zeitkonstante für Integrator bei vlast-Berechnung" CURVE 0x81CDC8 KlAUwSstSwWUw 1310.6999997 zk20msxs_uw_b1310 0.020000305180 1310.7200000 FUNCTION_LIST FGRREGL IF_DATA DIM_X INDIRECT 0x813C06
 /begin AXIS_DESCR STD_AXIS dvzvi_w vfzg_sw_q0p00781 8 -256.0000 255.9922 DEPOSIT ABSOLUT /end AXIS_DESCR
/end CHARACTERISTIC
/begin CHARACTERISTIC TVLAMRLMN "Verzögerungszeit für Lambdasollvorsteuerung bei rl < RLLAMMN" CURVE 0x819302 GklWUb 25.50 t100msxs_ub_b25p5 0.00 25.50 FUNCTION_LIST LAMFAW IF_DATA DIM_X DIRECT 0x819302
 /begin AXIS_DESCR COM_AXIS nmot nmot_ub_q40 7 0.00 10200. AXIS_PTS_REF SNM07ESUB /end AXIS_DESCR
/end CHARACTERISTIC
/begin CHARACTERISTIC TVLDMN "Untere Tastverhältnisbegrenzung für LDR" VALUE 0x819E4C KwUb 99.61 tv_ub_b100 0.00 99.61 FUNCTION_LIST LDTVMA IF_DATA DIM_X DIRECT 0x819E4C /end CHARACTERISTIC
/begin CHARACTERISTIC TVLDOBSO "Verzögerungszeit für Abbruch Haltephase" VALUE 0x819DA1 KwUb 12.75 t50msxs_ub_b12p75 0.00 12.75 FUNCTION_LIST LDOB IF_DATA DIM_X DIRECT 0x819DA1 /end CHARACTERISTIC
/begin CHARACTERISTIC TVLDPMN "Minimales TEV-Tastverhältnis für Fortsetzung Leckdiagnose" VALUE 0x81A809 KwUb 99.61 rel_ub_b99p6 0.00 99.61 FUNCTION_LIST DLDP IF_DATA DIM_X DIRECT 0x81A809 /end CHARACTERISTIC
/begin CHARACTERISTIC TVLDPT "Tastverhältnis für Fast Pulse Leckdiagnosepumpe" CURVE 0x81A80A KlAUbSstUbWUb 99.61 rel_ub_b99p6 0.00 99.61 FUNCTION_LIST DLDP IF_DATA DIM_X DIRECT 0x81A80A /begin AXIS_DESCR STD_AXIS tfpg t1sxs_ub_b255 6 0.00 255.0 DEPOSIT ABSOLUT /end AXIS_DESCR /end CHARACTERISTIC
/begin CHARACTERISTIC TVLDSZW "Einschaltdauer Zündwinkelfreigabe bei Nachladeeffekt" VALUE 0x811F58 KwUb 2.550 t10msxs_ub_b2p55 0.00 2.550 FUNCTION_LIST MDKOG IF_DATA DIM_X DIRECT 0x811F58 /end CHARACTERISTIC
/begin CHARACTERISTIC TVLENA "Verzögerungszeit für Lambdakorrektur" VALUE 0x811024 KwUb 2.550 t10msxs_ub_b2p55 0.00 2.550 FUNCTION_LIST GGLSU IF_DATA DIM_X DIRECT 0x811024 /end CHARACTERISTIC
/begin CHARACTERISTIC TVLISTU "Verbotszeit für negativen Integratoranteil nach Start" VALUE 0x811DA8 KwUb 5.100 t20msxs_ub_b5p1 0.00 5.100 FUNCTION_LIST LLRRM IF_DATA DIM_X DIRECT 0x811DA8 /end CHARACTERISTIC
/begin CHARACTERISTIC TVLLNWDIF "Zeitverzögerung bei NW-Differenzerkennung" VALUE 0x81A07C KwUb 5.100 t_q0p02 0.00 5.100 FUNCTION_LIST LLRNS IF_DATA DIM_X DIRECT 0x81A07C /end CHARACTERISTIC
/begin CHARACTERISTIC TVLLR "Einschaltverzögerung: B_llri bei Überdrehzahl" VALUE 0x811CA1 KwUb 5.100 t20msxs_ub_b5p1 0.00 5.100 FUNCTION_LIST LLRBB IF_DATA DIM_X DIRECT 0x811CA1 /end CHARACTERISTIC
/begin CHARACTERISTIC TVLLRI_0_A "Verzögerungszeit für Freigabe I-Anteil nach Start" CURVE 0x811CA2 KlAUbSstUbWUb 5.100 t20msxs_ub_b5p1 0.00 5.100 FUNCTION_LIST LLRBB IF_DATA DIM_X INDIRECT 0x816170
 /begin AXIS_DESCR STD_AXIS tmot temp_ub_q0p75_o48 6 -48.00 143.3 DEPOSIT ABSOLUT /end AXIS_DESCR
/end CHARACTERISTIC
/begin CHARACTERISTIC TVLLRI_1_A "Verzögerungszeit für Freigabe I-Anteil nach Start" CURVE 0x811CAF KlAUbSstUbWUb 5.100 t20msxs_ub_b5p1 0.00 5.100 FUNCTION_LIST LLRBB IF_DATA DIM_X INDIRECT 0x816172
 /begin AXIS_DESCR STD_AXIS tmot temp_ub_q0p75_o48 6 -48.00 143.3 DEPOSIT ABSOLUT /end AXIS_DESCR
/end CHARACTERISTIC
/begin CHARACTERISTIC TVLLRPD "Maximale Verzögerungszeit für Freigabe PD-Anteil nach Start" CURVE 0x811CBC KlAUbSstUbWUb 5.100 t20msxs_ub_b5p1 0.00 5.100 FUNCTION_LIST LLRBB IF_DATA DIM_X DIRECT 0x811CBC
 /begin AXIS_DESCR STD_AXIS tmot temp_ub_q0p75_o48 6 -48.00 143.3 DEPOSIT ABSOLUT /end AXIS_DESCR
/end CHARACTERISTIC
/begin CHARACTERISTIC TVLLRPST "Zeitverzögerung nach Start zum Deaktivieren der P-Verstärkung im Start" VALUE 0x811DA9 KwUb 51.00 t200msxs_ub_b51 0.00 51.00 FUNCTION_LIST LLRRM IF_DATA DIM_X DIRECT 0x811DA9 /end CHARACTERISTIC
/begin CHARACTERISTIC TVLLRSTE_0_A "Zwangsbedingung Leerlaufregelung nach B_stend" VALUE 0x816616 KwUb 5.100 t20msxs_ub_b5p1 0.00 5.100 FUNCTION_LIST LLRBB IF_DATA DIM_X DIRECT 0x816616 /end CHARACTERISTIC
/begin CHARACTERISTIC TVLLRSTE_1_A "Zwangsbedingung Leerlaufregelung nach B_stend" VALUE 0x816617 KwUb 5.100 t20msxs_ub_b5p1 0.00 5.100 FUNCTION_LIST LLRBB IF_DATA DIM_X DIRECT 0x816617 /end CHARACTERISTIC
/begin CHARACTERISTIC TVLRA "Verzögerungszeit für Aktivierung Gemischadaption nach Lambdaregelung aktiv" VALUE 0x81930C KwUb 25.40 t100msxs_ub_b25p5 0.1000 25.50 FUNCTION_LIST LRAEB IF_DATA DIM_X DIRECT 0x81930C /end CHARACTERISTIC
/begin CHARACTERISTIC TVLSUEE "Verzögerungszeit für LSU Heizerendstufenfehler" VALUE 0x81867B KwUb 12.75 t50msxs_ub_b12p75 0.00 12.75 FUNCTION_LIST DHLSU IF_DATA DIM_X DIRECT 0x81867B /end CHARACTERISTIC
/begin CHARACTERISTIC TVLSUEK "Verzögerungszeit für Fehlerkorrektur stetige Lambdasonde LSU" VALUE 0x81C7A0 KwUw 6553.500 t100msxs_uw_b6553p5 0.00 6553.500 FUNCTION_LIST DLSU IF_DATA DIM_X DIRECT 0x81C7A0 /end CHARACTERISTIC
/begin CHARACTERISTIC TVLSUHK "Verzögerungszeit nach Start für Diagnose Heizerkopplung" VALUE 0x81C7A2 KwUw 655.3500 t10msxs_uw_b655p35 0.00 655.3500 FUNCTION_LIST DLSU IF_DATA DIM_X DIRECT 0x81C7A2 /end CHARACTERISTIC
/begin CHARACTERISTIC TVLSULUFT "Verzögerungszeit für Fehler LSU in Luft" VALUE 0x8186FA KwUb 25.50 t100msxs_ub_b25p5 0.00 25.50 FUNCTION_LIST DLSU IF_DATA DIM_X DIRECT 0x8186FA /end CHARACTERISTIC
/begin CHARACTERISTIC TVLSUNP "Verzögerungszeit für Fehler stetige Lambdasonde LSU" VALUE 0x81867C KwUb 12.75 t50msxs_ub_b12p75 0.00 12.75 FUNCTION_LIST DHLSU IF_DATA DIM_X DIRECT 0x81867C /end CHARACTERISTIC
/begin CHARACTERISTIC TVLSUOF "Verzögerungszeit für Fehler stetige Lambdasonde LSU ""Offset""" VALUE 0x81C7A4 KwUw 6553.500 t100msxs_uw_b6553p5 0.00 6553.500 FUNCTION_LIST DLSU IF_DATA DIM_X DIRECT 0x81C7A4 /end CHARACTERISTIC
/begin CHARACTERISTIC TVLSUTRIM "Verzögerungszeit für Fehler LSU Abgleichleitung unterbrochen" VALUE 0x8186FC KwUb 25.50 t100msxs_ub_b25p5 0.00 25.50 FUNCTION_LIST DLSU IF_DATA DIM_X DIRECT 0x8186FC /end CHARACTERISTIC
/begin CHARACTERISTIC TVLSUWU "maximale Zeit für ""warm up"" stetige Lambdasonde LSU" VALUE 0x812688 KwUb 25.50 t100msxs_ub_b25p5 0.00 25.50 FUNCTION_LIST HLSU IF_DATA DIM_X DIRECT 0x812688 /end CHARACTERISTIC
/begin CHARACTERISTIC TVLU1MN "Festwert minimales Tastverhältnis Lüfter 1" VALUE 0x81AF8D KwUb 99.61 tv_ub_b100 0.00 99.61 FUNCTION_LIST KMTR ALUEFT TKMWL IF_DATA DIM_X DIRECT 0x81AF8D /end CHARACTERISTIC
/begin CHARACTERISTIC TVLU1MX "Festwert Maximales Tastverhältnis Lüfter 1" VALUE 0x81AF8E KwUb 99.61 tv_ub_b100 0.00 99.61 FUNCTION_LIST KMTR IF_DATA DIM_X DIRECT 0x81AF8E /end CHARACTERISTIC
/begin CHARACTERISTIC TVLU2MN "Festwert minimales Tastverhältnis Lüfter 2" VALUE 0x81AF8F KwUb 99.61 tv_ub_b100 0.00 99.61 FUNCTION_LIST KMTR TKMWL IF_DATA DIM_X DIRECT 0x81AF8F /end CHARACTERISTIC
/begin CHARACTERISTIC TVLU2MX "Festwert Maximales Tastverhältnis Lüfter 2" VALUE 0x81AF90 KwUb 99.61 tv_ub_b100 0.00 99.61 FUNCTION_LIST KMTR IF_DATA DIM_X DIRECT 0x81AF90 /end CHARACTERISTIC
/begin CHARACTERISTIC TVLUES1MN "Min. Tastverhältnis Lüfter 1" VALUE 0x8187EB KwUb 99.61 tv_ub_b100 0.00 99.61 FUNCTION_LIST DLUES1E IF_DATA DIM_X DIRECT 0x8187EB /end CHARACTERISTIC
/begin CHARACTERISTIC TVLUES1MX "Max. Tastverhältnis Lüfter 1" VALUE 0x8187EC KwUb 99.61 tv_ub_b100 0.00 99.61 FUNCTION_LIST DLUES1E IF_DATA DIM_X DIRECT 0x8187EC /end CHARACTERISTIC
/begin CHARACTERISTIC TVLUESETR "Tastverhältnis Ansteuerung elektr. Thermostatventil bei Lüfterausfall" VALUE 0x81AF91 KwUb 99.61 tv_ub_b100 0.00 99.61 FUNCTION_LIST KMTR IF_DATA DIM_X DIRECT 0x81AF91 /end CHARACTERISTIC
/begin CHARACTERISTIC TVLUESICEW "Ersatzwert Istzustand Lüfteransteuerung bei Endstufenfehler" VALUE 0x81AF92 KwUb 99.61 tv_ub_b100 0.00 99.61 FUNCTION_LIST KMTR IF_DATA DIM_X DIRECT 0x81AF92 /end CHARACTERISTIC
/begin CHARACTERISTIC TVLUESSEW "Ersatzwert Lüfteransteuerung bei schaltbaren Lüftern" VALUE 0x81AF93 KwUb 99.61 tv_ub_b100 0.00 99.61 FUNCTION_LIST KMTR IF_DATA DIM_X DIRECT 0x81AF93 /end CHARACTERISTIC
/begin CHARACTERISTIC TVMDCVTK "Verzögerungzeit zur Sperrung des Verlustmomentfilters beim Kriechen (CVT)" VALUE 0x81A354 KwUb 5.100 t20msxs_ub_b5p1 0.00 5.100 FUNCTION_LIST MDVER IF_DATA DIM_X DIRECT 0x81A354 /end CHARACTERISTIC
/begin CHARACTERISTIC TVMIBEG "Entprellzeit für Zündwinkelfreigabe bei Momentenbegrenzung" VALUE 0x811F59 KwUb 2.550 t10msxs_ub_b2p55 0.00 2.550 FUNCTION_LIST MDKOG IF_DATA DIM_X DIRECT 0x811F59 /end CHARACTERISTIC
/begin CHARACTERISTIC TVMRFT "Verzögerungszeit für Lambdasonde hinter Kat mager oder fett" VALUE 0x8186FD KwUb 25.50 t100msxs_ub_b25p5 0.00 25.50 FUNCTION_LIST DLSU IF_DATA DIM_X DIRECT 0x8186FD /end CHARACTERISTIC
/begin CHARACTERISTIC TVMXPRG "Geschwindigkeits-Prädiktionszeit für VMAX-Regelung" CURVE 0x81A3F1 FklWUb 5.100 t20msxs_ub_q0p02 0.00 5.100 FUNCTION_LIST VMAXMD IF_DATA DIM_X DIRECT 0x81A3F1 /begin AXIS_DESCR FIX_AXIS gangi dez 8 0.00 7.000 FIX_AXIS_PAR 0 0 8 /end AXIS_DESCR /end CHARACTERISTIC
/begin CHARACTERISTIC TVNL1OFF "Ansteuertastverhältnis Lüfter 1 bei Ende Nachlaufzeit KMTR" VALUE 0x81AF94 KwUb 99.61 tv_ub_b100 0.00 99.61 FUNCTION_LIST KMTR IF_DATA DIM_X DIRECT 0x81AF94 /end CHARACTERISTIC
/begin CHARACTERISTIC TVNL2OFF "Ansteuertastverhältnis Lüfter 2 bei Ende Nachlaufzeit KMTR" VALUE 0x81AF95 KwUb 99.61 tv_ub_b100 0.00 99.61 FUNCTION_LIST KMTR IF_DATA DIM_X DIRECT 0x81AF95 /end CHARACTERISTIC
/begin CHARACTERISTIC TVNLETR "Tastverhältnis Thermostat im Nachlauf" VALUE 0x81AF96 KwUb 99.61 tv_ub_b100 0.00 99.61 FUNCTION_LIST KMTR IF_DATA DIM_X DIRECT 0x81AF96 /end CHARACTERISTIC
/begin CHARACTERISTIC TVNLL1 "Tastverhältnis Lüfter 1 im Nachlauf (Initialiserung AccumulatorLimited_1)" VALUE 0x81AF97 KwUb 99.61 tv_ub_b100 0.00 99.61 FUNCTION_LIST KMTR IF_DATA DIM_X DIRECT 0x81AF97 /end CHARACTERISTIC
/begin CHARACTERISTIC TVNLL2 "Tastverhältnis Lüfter 2 im Nachlauf (Initialisierung AccmulatorLimited)" VALUE 0x81AF98 KwUb 99.61 tv_ub_b100 0.00 99.61 FUNCTION_LIST KMTR IF_DATA DIM_X DIRECT 0x81AF98 /end CHARACTERISTIC
/begin CHARACTERISTIC TVNLT1 "Ansteuerung Lüfter 1 im Nachlauf für Hauptrelaisprüfung" VALUE 0x81AF99 KwUb 99.61 tv_ub_b100 0.00 99.61 FUNCTION_LIST KMTR IF_DATA DIM_X DIRECT 0x81AF99 /end CHARACTERISTIC
/begin CHARACTERISTIC TVNLT2 "Ansteuerung Lüfter 2 im Nachlauf für Hauptrelaisprüfung" VALUE 0x81AF9A KwUb 99.61 tv_ub_b100 0.00 99.61 FUNCTION_LIST KMTR IF_DATA DIM_X DIRECT 0x81AF9A /end CHARACTERISTIC
/begin CHARACTERISTIC TVNLTETR "Ansteuerung elektr. Thermostatventil im Nachlauf für Hauptrelaisprüfung" VALUE 0x81AF9B KwUb 99.61 tv_ub_b100 0.00 99.61 FUNCTION_LIST KMTR IF_DATA DIM_X DIRECT 0x81AF9B /end CHARACTERISTIC
/begin CHARACTERISTIC TVNWFE "Verzugszeit zur NW-Umschaltfreigabe nach früh (Einlaß)" VALUE 0x81A8FD KwUb 12.75 t50msxs_ub_b12p75 0.00 12.75 FUNCTION_LIST ANWSE IF_DATA DIM_X DIRECT 0x81A8FD /end CHARACTERISTIC
/begin CHARACTERISTIC TVNWGE "Verzugszeit zur NW-Umschaltfreigabe nach Getriebeeingriff" VALUE 0x81A829 KwUb 12.75 t50msxs_ub_b12p75 0.00 12.75 FUNCTION_LIST BBNWS IF_DATA DIM_X DIRECT 0x81A829 /end CHARACTERISTIC
/begin CHARACTERISTIC TVNWMRAE "Zeitdauer für Aktivierung Momentenreserve beim schalten Einlaßnockenwelle" VALUE 0x81A8FE KwUb 12.75 t50msxs_ub_b12p75 0.00 12.75 FUNCTION_LIST ANWSE IF_DATA DIM_X DIRECT 0x81A8FE /end CHARACTERISTIC
/begin CHARACTERISTIC TVNWMREE "Verzögerungszeit für Anforderung Momentenreserve beim schalten Einlaßnockenwelle" VALUE 0x81A8FF KwUb 12.75 t50msxs_ub_b12p75 0.00 12.75 FUNCTION_LIST ANWSE IF_DATA DIM_X DIRECT 0x81A8FF /end CHARACTERISTIC
/begin CHARACTERISTIC TVNWSE "Verzugszeit zur NW-Umschaltfreigabe nach spät (Einlaß)" VALUE 0x81A900 KwUb 12.75 t50msxs_ub_b12p75 0.00 12.75 FUNCTION_LIST ANWSE IF_DATA DIM_X DIRECT 0x81A900 /end CHARACTERISTIC
/begin CHARACTERISTIC TVNWSTNM "Zeitverzögerung für Nockenwellenverstellung nach Überschreitung der Solldrehzahl" VALUE 0x829E54 KwUw 3276.750 t50msxs_uw_b3276p75 0.00 3276.750 FUNCTION_LIST BBNWS IF_DATA DIM_X DIRECT 0x829E54 /end CHARACTERISTIC
/begin CHARACTERISTIC TVNWSTTM "Zeitverzögerung im Start ab der die Nockenwelle angesteuert werden kann" CURVE 0x829E56 KlAUbSstUbWUw 3276.750 t50msxs_uw_b3276p75 0.00 3276.750 FUNCTION_LIST BBNWS IF_DATA DIM_X DIRECT 0x829E56
 /begin AXIS_DESCR STD_AXIS tmot temp_ub_q0p75_o48 4 -48.00 143.3 DEPOSIT ABSOLUT /end AXIS_DESCR
/end CHARACTERISTIC
/begin CHARACTERISTIC TVNW_S "Verzögerungszeit nach der das Einlaßventil sicher in Spätstellung ist" VALUE 0x81A8A9 KwUb 12.75 t50msxs_ub_b12p75 0.00 12.75 FUNCTION_LIST BGARNW IF_DATA DIM_X DIRECT 0x81A8A9 /end CHARACTERISTIC
/begin CHARACTERISTIC TVPBKVNB "Verzögerungszeit der Bremskraftdruckreaktion nach Bremsen" VALUE 0x81AFF6 KwUb 25.50 t100msxs_ub_b25p5 0.00 25.50 FUNCTION_LIST DDSBKV IF_DATA DIM_X DIRECT 0x81AFF6 /end CHARACTERISTIC
/begin CHARACTERISTIC TVPDKP1 "Fehlertoleranzzeit bei Bereichsprüfung DK-Poti 1" VALUE 0x811119 KwUb 2.540 t10msxs_ub_b2p55 0.01000 2.550 FUNCTION_LIST GGDVE IF_DATA DIM_X DIRECT 0x811119 /end CHARACTERISTIC
/begin CHARACTERISTIC TVPDKP2 "Fehlertoleranzzeit bei Bereichsprüfung DK-Poti 2" VALUE 0x81111A KwUb 2.540 t10msxs_ub_b2p55 0.01000 2.550 FUNCTION_LIST GGDVE IF_DATA DIM_X DIRECT 0x81111A /end CHARACTERISTIC
/begin CHARACTERISTIC TVPKH "Zeitverzögerung: P-Verstärkung bei Katheizen aktiv" VALUE 0x8166C8 KwUw 13107.00 t200msxs_uw_q0p2 0.00 13107.00 FUNCTION_LIST LLRRM IF_DATA DIM_X DIRECT 0x8166C8 /end CHARACTERISTIC
/begin CHARACTERISTIC TVPWDK12 "Fehlertoleranzzeit bei Gleichlaufprüfung der DK-Potis" VALUE 0x81111B KwUb 2.540 t10msxs_ub_b2p55 0.01000 2.550 FUNCTION_LIST GGDVE IF_DATA DIM_X DIRECT 0x81111B /end CHARACTERISTIC
/begin CHARACTERISTIC TVPWDK23 "Fehlertoleranzzeit bei Gleichlaufprüfung DK-Poti 2 und Ersatzwert aus Füllung" VALUE 0x81111D KwUb 2.540 t10msxs_ub_b2p55 0.01000 2.550 FUNCTION_LIST GGDVE IF_DATA DIM_X DIRECT 0x81111D /end CHARACTERISTIC
/begin CHARACTERISTIC TVPWMCSR "Entprellzeit Fehler zurücksetzen" VALUE 0x81AFDB KwUb 6.350 t50msxs_ub_b12p75 0.00 6.350 FUNCTION_LIST GGCS IF_DATA DIM_X DIRECT 0x81AFDB /end CHARACTERISTIC
/begin CHARACTERISTIC TVPWMCSS "Entprellzeit Fehler setzen" VALUE 0x81AFDC KwUb 6.350 t50msxs_ub_b12p75 0.00 6.350 FUNCTION_LIST GGCS IF_DATA DIM_X DIRECT 0x81AFDC /end CHARACTERISTIC
/begin CHARACTERISTIC TVPWMFR "Verzögerungszeit für Erkennung fehlerfreiem PWM-Signal" VALUE 0x81845B KwUb 25.50 t100msxs_ub_b25p5 0.00 25.50 FUNCTION_LIST DSWEA IF_DATA DIM_X DIRECT 0x81845B /end CHARACTERISTIC
/begin CHARACTERISTIC TVPWMFS "Verzögerungszeit für Erkennung fehlerhaftes PWM-Signal" VALUE 0x81845C KwUb 25.50 t100msxs_ub_b25p5 0.00 25.50 FUNCTION_LIST DSWEA IF_DATA DIM_X DIRECT 0x81845C /end CHARACTERISTIC
/begin CHARACTERISTIC TVREABO "Verzugszeit für zurücksetzen des Zählers für Benzin im Öl" VALUE 0x819717 KwUb 25.50 t100msxs_ub_b25p5 0.00 25.50 FUNCTION_LIST BBBO IF_DATA DIM_X DIRECT 0x819717 /end CHARACTERISTIC
/begin CHARACTERISTIC TVRESLL "Haltezeit für die erhöhte Momentenrerserve nach Drehzahleinbruch" VALUE 0x8166D6 KwUw 1310.700 t20msxs_uw_q0p02 0.00 1310.700 FUNCTION_LIST LLRMR IF_DATA DIM_X DIRECT 0x8166D6 /end CHARACTERISTIC
/begin CHARACTERISTIC TVRIHEE "Verzögerungszeit für Ri-Fehler nach Endstufenfehler hinter Kat" VALUE 0x8184A3 KwUb 255.0 t1sxs_ub_b255 0.00 255.0 FUNCTION_LIST DHLSHK IF_DATA DIM_X DIRECT 0x8184A3 /end CHARACTERISTIC
/begin CHARACTERISTIC TVSABFA "SA-Verzugszeit bei Funktionsanforderung (B_fa) und gangi = 0" VALUE 0x8165E6 KwUw 655.3500 t10msxs_uw_b655p35 0.00 655.3500 FUNCTION_LIST BBSAWE IF_DATA DIM_X DIRECT 0x8165E6 /end CHARACTERISTIC
/begin CHARACTERISTIC TVSABTE "Verzugszeit für TEV Schließen vor Schubabschalten" VALUE 0x8165E8 KwUw 655.3500 t10msxs_uw_b655p35 0.00 655.3500 FUNCTION_LIST BBSAWE IF_DATA DIM_X DIRECT 0x8165E8 /end CHARACTERISTIC
/begin CHARACTERISTIC TVSAG0 "Totzeit Schubabschalten bei Gang 0" VALUE 0x8165EA KwUw 655.3500 t10msxs_uw_b655p35 0.00 655.3500 FUNCTION_LIST BBSAWE IF_DATA DIM_X DIRECT 0x8165EA /end CHARACTERISTIC
/begin CHARACTERISTIC TVSATEM "Verzögerungszeit für TEV zu nach SA-Bereitschaft" CURVE 0x812767 KlAUbSstUbWUb 5.100 t20msxs_ub_b5p1 0.00 5.100 FUNCTION_LIST TEB IF_DATA DIM_X DIRECT 0x812767
 /begin AXIS_DESCR STD_AXIS tmot temp_ub_q0p75_o48 6 -48.00 143.3 DEPOSIT ABSOLUT /end AXIS_DESCR
/end CHARACTERISTIC
/begin CHARACTERISTIC TVSATM "Sperrzeit Schubabschalten nach Startende" CURVE 0x819F2A KlAUbSstUbWUb 255.0 t1sxs_ub_b255 0.00 255.0 FUNCTION_LIST BBSAWE IF_DATA DIM_X DIRECT 0x819F2A
 /begin AXIS_DESCR STD_AXIS tmst temp_ub_q0p75_o48 6 -48.00 143.3 DEPOSIT ABSOLUT /end AXIS_DESCR
/end CHARACTERISTIC
/begin CHARACTERISTIC TVSLR "Dauer LRS-Ausschaltung über Ventilhubsteuerung" CURVE 0x81A4A6 KlAUbSstUbWUb 2.550 t10msxs_ub_b2p55 0.00 2.550 FUNCTION_LIST LRSEB IF_DATA DIM_X DIRECT 0x81A4A6 /begin AXIS_DESCR STD_AXIS nmot nmot_ub_q40 8 0.00 10200. DEPOSIT ABSOLUT /end AXIS_DESCR /end CHARACTERISTIC
/begin CHARACTERISTIC TVSLVOFF "Zeitverzögerung Schließen Sekundärluftventil" VALUE 0x81835C KwUb 25.50 t100msxs_ub_b25p5 0.00 25.50 FUNCTION_LIST SLS IF_DATA DIM_X DIRECT 0x81835C /end CHARACTERISTIC
/begin CHARACTERISTIC TVSLVON "Zeitverzögerung Öffnen Sekundärluftventil" VALUE 0x81835D KwUb 25.40 t100msxs_ub_b25p5 0.1000 25.50 FUNCTION_LIST SLS IF_DATA DIM_X DIRECT 0x81835D /end CHARACTERISTIC
/begin CHARACTERISTIC TVSNPF "Verzögerungszeit in der Störungen bei der Entprellung unterdrückt werden" VALUE 0x8186FE KwUb 25.50 t100msxs_ub_b25p5 0.00 25.50 FUNCTION_LIST DLSU IF_DATA DIM_X DIRECT 0x8186FE /end CHARACTERISTIC
/begin CHARACTERISTIC TVSTETR "Tastverhältnis Thermostat im Startbereich" VALUE 0x81AF9C KwUb 99.61 tv_ub_b100 0.00 99.61 FUNCTION_LIST KMTR IF_DATA DIM_X DIRECT 0x81AF9C /end CHARACTERISTIC
/begin CHARACTERISTIC TVSTL1 "Festwert Tastverhältnis Lüfter 1 Zeitspanne nach Start" VALUE 0x81AF9D KwUb 99.61 tv_ub_b100 0.00 99.61 FUNCTION_LIST KMTR IF_DATA DIM_X DIRECT 0x81AF9D /end CHARACTERISTIC
/begin CHARACTERISTIC TVSTL2 "Festwert Tastverhältnis Lüfter 2 Zeitspanne nach Start" VALUE 0x81AF9E KwUb 99.61 tv_ub_b100 0.00 99.61 FUNCTION_LIST KMTR IF_DATA DIM_X DIRECT 0x81AF9E /end CHARACTERISTIC
/begin CHARACTERISTIC TVTANKL "Verzögerungszeit für Information Tank-Leer-Zustand beendet" VALUE 0x810FA7 KwUb 255.0 t1sxs_ub_b255 0.00 255.0 FUNCTION_LIST DTANKL IF_DATA DIM_X DIRECT 0x810FA7 /end CHARACTERISTIC
/begin CHARACTERISTIC TVTEVMN "minimales TEV- Tastverhältnis bei DLDP- TEV- Check" VALUE 0x81278C KwUb 99.61 rel_ub_b99p6 0.00 99.61 FUNCTION_LIST DLDP IF_DATA DIM_X DIRECT 0x81278C /end CHARACTERISTIC
/begin CHARACTERISTIC TVTEVPS "Druckabhängige Verzugszeit Tankentlüftungsventil" CURVE 0x81A70C KlAUbSstUbWUb 127.5 t500usxms_ub_q0p5 0.00 127.5 FUNCTION_LIST ATEV IF_DATA DIM_X DIRECT 0x81A70C /begin AXIS_DESCR STD_AXIS pspu fak_ub_b2 5 0.00 1.992 DEPOSIT ABSOLUT /end AXIS_DESCR /end CHARACTERISTIC
/begin CHARACTERISTIC TVTKLSU "Verzögerungszeit beim Eintragen eines Fehlers aufgrund eines leeren Tanks" VALUE 0x81C7A6 KwUw 6553.500 t100msxs_uw_b6553p5 0.00 6553.500 FUNCTION_LIST DLSU IF_DATA DIM_X DIRECT 0x81C7A6 /end CHARACTERISTIC
/begin CHARACTERISTIC TVTMKIC "Entprellzeit für tmkic-Fehler" VALUE 0x81EA30 KwUw 6553.400 t100msxs_uw_b6553p5 0.1000000 6553.500 FUNCTION_LIST GGGTS IF_DATA DIM_X DIRECT 0x81EA30 /end CHARACTERISTIC
/begin CHARACTERISTIC TVTOLC "Verzögerungszeit für das Eintragen eines Fehlers beim Öltemperatursignal über CA" VALUE 0x81BD32 KwUw 65535.00 t1sxs_uw_b65535 0.00 65535.00 FUNCTION_LIST GGCTOL IF_DATA DIM_X DIRECT 0x81BD32 /end CHARACTERISTIC
/begin CHARACTERISTIC TVTSPEV "Korrektur der Einspritzzeit in Abhängigkeit von evtmod" CURVE 0x81DF90 KlAUwSstUwWUw 174.7600 tinjection_sy 0.00 174.7600 FUNCTION_LIST RKTI IF_DATA DIM_X DIRECT 0x81DF90
 /begin AXIS_DESCR STD_AXIS evtmodev temp_ub_q0p75_o48 4 -48.00000 49103.25 DEPOSIT ABSOLUT /end AXIS_DESCR
/end CHARACTERISTIC
/begin CHARACTERISTIC TVTUMC "Verzögerungszeit für das Setzen eines Fehlers für das CAN-Signal tumc" VALUE 0x81BD34 KwUw 65535.00 t1sxs_uw_b65535 0.00 65535.00 FUNCTION_LIST GGCTUM IF_DATA DIM_X DIRECT 0x81BD34 /end CHARACTERISTIC
/begin CHARACTERISTIC TVTUMTA "Verzugszeit Fahrgeschwindigkeitsbedingung für Bestimmung Umgebungstemperatur" VALUE 0x81E4D0 KwUw 65535.00 t1sxs_uw_b65535 0.00 65535.00 FUNCTION_LIST BGTUMG IF_DATA DIM_X DIRECT 0x81E4D0 /end CHARACTERISTIC
/begin CHARACTERISTIC TVUB "Spannungskorrektur" CURVE 0x815C6E KlAUbSstUbWUw 174.7600 tinjection_sy 0.00 174.7600 FUNCTION_LIST RKTI IF_DATA DIM_X DIRECT 0x815C6E /begin AXIS_DESCR STD_AXIS ub spg_ubatt 5 0.00 17.95 DEPOSIT ABSOLUT /end AXIS_DESCR /end CHARACTERISTIC
/begin CHARACTERISTIC TVUHR "Maximale Wartezeit für neue Uhrinformation" VALUE 0x819542 KwUb 255.0 t1sxs_uw_q1 0.00 255.0 FUNCTION_LIST BGTABST IF_DATA DIM_X DIRECT 0x819542 /end CHARACTERISTIC
/begin CHARACTERISTIC TVUHRDEV "Entprellung Zeitabweichung Uhrinformation" VALUE 0x819543 KwUb 255.0 t1sxs_uw_q1 0.00 255.0 FUNCTION_LIST BGTABST IF_DATA DIM_X DIRECT 0x819543 /end CHARACTERISTIC
/begin CHARACTERISTIC TVWDKS "Verzögerungszeit für Drosselklappen-Sollwinkel" VALUE 0x81133A KwUb 2.550 t10msxs_ub_b2p55 0.00 2.550 FUNCTION_LIST FUEDKSA IF_DATA DIM_X DIRECT 0x81133A /end CHARACTERISTIC
/begin CHARACTERISTIC TVZMSE "Zeitgrenze für Rücksetzen Überwachungszähler ZMS- Resonanz" VALUE 0x82B190 KwUw 655.3500 t10msxs_uw_b655p35 0.00 655.3500 FUNCTION_LIST BBZMS IF_DATA DIM_X DIRECT 0x82B190 /end CHARACTERISTIC
/begin CHARACTERISTIC TVZWMSA "Zeit bis zum Übergehen auf Dauerspätbegrenzung" VALUE 0x812ACE KwUb 2.550 t10msxs_ub_b2p55 0.00 2.550 FUNCTION_LIST ZWMIN IF_DATA DIM_X DIRECT 0x812ACE /end CHARACTERISTIC
/begin CHARACTERISTIC TVZWMSE "Zeit bis zum Übergehen auf Dynamikspätbegrenzung" VALUE 0x812ACF KwUb 2.550 t10msxs_ub_b2p55 0.00 2.550 FUNCTION_LIST ZWMIN IF_DATA DIM_X DIRECT 0x812ACF /end CHARACTERISTIC
/begin CHARACTERISTIC TWAFMN "Untere Schwelle des Temperaturfensters bei Feinadaption" VALUE 0x81A8AA KwUb 191.3 temp_ub_q0p75_o48 -48.00 143.3 FUNCTION_LIST BGARNW IF_DATA DIM_X DIRECT 0x81A8AA /end CHARACTERISTIC
/begin CHARACTERISTIC TWAFMX "Obere Schwelle des Temperaturfensters bei Feinadaption" VALUE 0x81A8AB KwUb 191.3 temp_ub_q0p75_o48 -48.00 143.3 FUNCTION_LIST BGARNW IF_DATA DIM_X DIRECT 0x81A8AB /end CHARACTERISTIC
/begin CHARACTERISTIC TWBDCY "Wartezeit für Erkennung Bedingung 'driving cycle'" VALUE 0x81BD6C KwUw 13107.00 t200msxs_uw_q0p2 0.00 13107.00 FUNCTION_LIST DDCY IF_DATA DIM_X DIRECT 0x81BD6C /end CHARACTERISTIC
/begin CHARACTERISTIC TWDKATS "Wartezeit nach Stoppbedingung für Filter und Integrator" VALUE 0x8186EE KwUb 12.75 t_q0p05 0.00 12.75 FUNCTION_LIST DKATSPEB IF_DATA DIM_X DIRECT 0x8186EE /end CHARACTERISTIC
/begin CHARACTERISTIC TWDKNL "Zeit nach nmot = 0 und Kl.15 AUS bis Nachlauf gestartet wird" VALUE 0x81873B KwUb 25.50 t100msxs_ub_b25p5 0.00 25.50 FUNCTION_LIST ADVE IF_DATA DIM_X DIRECT 0x81873B /end CHARACTERISTIC
/begin CHARACTERISTIC TWDKSNST_1_A "Zeitkonstante für Drosselklappensollwinkelfilterung im Start" CURVE 0x81DCA6 KlAUbSstUbWUw 655.3400 t10msxs_uw_b655p35 0.01000000 655.3500 FUNCTION_LIST WDKSOM IF_DATA DIM_X INDIRECT 0x813F2E
 /begin AXIS_DESCR STD_AXIS tmst temp_ub_q0p75_o48 6 -48.00 143.3 DEPOSIT ABSOLUT /end AXIS_DESCR
/end CHARACTERISTIC
/begin CHARACTERISTIC TWDLDPE "Wartezeit für Fehlerdiagnose LDP-Endstufe" VALUE 0x8187E4 KwUb 25.50 t100msxs_ub_b25p5 0.00 25.50 FUNCTION_LIST DLDPE IF_DATA DIM_X DIRECT 0x8187E4 /end CHARACTERISTIC
/begin CHARACTERISTIC TWDLSSA "Mindestprüfzeit für DLSSA-Extremwertbestimmung" VALUE 0x81DCCE KwUw 3276.750 t50msxs_uw_b3276p75 0.00 3276.750 FUNCTION_LIST DLSSA IF_DATA DIM_X DIRECT 0x81DCCE /end CHARACTERISTIC
/begin CHARACTERISTIC TWDMAD "Wartezeit bis Freigabe der Adaption des Verlustmoments" VALUE 0x81A0C5 KwUb 51.00 t200msxs_ub_b51 0.00 51.00 FUNCTION_LIST MDVERAD IF_DATA DIM_X DIRECT 0x81A0C5 /end CHARACTERISTIC
/begin CHARACTERISTIC TWDSLTM "tmot- Entprellzeit für Adaption/Zusatudiagnose" VALUE 0x818396 KwUb 25.40 t100msxs_ub_b25p5 0.1000 25.50 FUNCTION_LIST DSLSLRS IF_DATA DIM_X DIRECT 0x818396 /end CHARACTERISTIC
/begin CHARACTERISTIC TWDUBRNL "Wartezeit für Diagnose UBR im Nachlauf bis Ausschalten Komponenten" VALUE 0x818712 KwUb 25.40 t100msxs_ub_b25p5 0.1000 25.50 FUNCTION_LIST GGUBR IF_DATA DIM_X DIRECT 0x818712 /end CHARACTERISTIC
/begin CHARACTERISTIC TWHLSLP "Wartezeit für Hochlauf Sekundärluftpumpe" VALUE 0x818397 KwUb 25.50 t100msxs_ub_b25p5 0.00 25.50 FUNCTION_LIST DSLSLRS IF_DATA DIM_X DIRECT 0x818397 /end CHARACTERISTIC
/begin CHARACTERISTIC TWLDPE "Entprellzeit für i.O.-Prüfung LDP-Endstufe" VALUE 0x8187E5 KwUb 25.50 t100msxs_ub_b25p5 0.00 25.50 FUNCTION_LIST DLDPE IF_DATA DIM_X DIRECT 0x8187E5 /end CHARACTERISTIC
/begin CHARACTERISTIC TWMLFE "Mindestzeit für ml im Diagnosebereich" VALUE 0x818398 KwUb 25.50 t100msxs_ub_b25p5 0.00 25.50 FUNCTION_LIST DSLSLRS IF_DATA DIM_X DIRECT 0x818398 /end CHARACTERISTIC
/begin CHARACTERISTIC TWMSLMIN "Entprellzeit für Fehlermeldung B_mslmin" VALUE 0x818399 KwUb 25.50 t100msxs_ub_b25p5 0.00 25.50 FUNCTION_LIST DSLSLRS IF_DATA DIM_X DIRECT 0x818399 /end CHARACTERISTIC
/begin CHARACTERISTIC TWNTAL "Wartezeit bis Nicht-Tankleer-Signal gültig ist" VALUE 0x81C7CC KwUw 13107.00 t200msxs_uw_q0p2 0.00 13107.00 FUNCTION_LIST GGFST IF_DATA DIM_X DIRECT 0x81C7CC /end CHARACTERISTIC
/begin CHARACTERISTIC TWPLK "Entprellzeit für Rücknahme der LL-Vorgabe bei Lebendkennung" VALUE 0x818733 KwUb 25.50 t100msxs_ub_b25p5 0.00 25.50 FUNCTION_LIST GGPED IF_DATA DIM_X DIRECT 0x818733 /end CHARACTERISTIC
/begin CHARACTERISTIC TWPMBBR "Verzögerungszeit für Pedalwertbegrenzung bei betätigter Bremse" VALUE 0x811048 KwUb 2.550 t10msxs_ub_b2p55 0.00 2.550 FUNCTION_LIST GGPED IF_DATA DIM_X DIRECT 0x811048 /end CHARACTERISTIC
/begin CHARACTERISTIC TWSTT "Schwelle Abstellzeit für Wiederholstart" CURVE 0x815E38 KlAUwSstUwWUw 65535.00 t1sxs_uw_q1 0.00 65535.00 FUNCTION_LIST ESSTT IF_DATA DIM_X DIRECT 0x815E38
 /begin AXIS_DESCR STD_AXIS tmotab temp_ub_q0p75_o48 12 -48.00000 49103.25 DEPOSIT ABSOLUT /end AXIS_DESCR
/end CHARACTERISTIC
/begin CHARACTERISTIC TXFMX "Max. Zeit nach Start für Feinstleckdiagnose (0.5 mm)" VALUE 0x829DBE KwUw 65535.00 t1sxs_uw_b65535 0.00 65535.00 FUNCTION_LIST DLDP IF_DATA DIM_X DIRECT 0x829DBE /end CHARACTERISTIC
/begin CHARACTERISTIC TZ2FGRGA_0_A "Doppelte Zählerzeitkonstante für FGR-Regler" CURVE 0x81CE0C KlAUwSstUwWUw 1310.660 t20msxs_uw_q0p02 0.02000000 1310.680 FUNCTION_LIST FGRREGL IF_DATA DIM_X INDIRECT 0x813C0A /begin AXIS_DESCR STD_AXIS uevges_w fak_q0p1 8 0.00 6553.500 DEPOSIT ABSOLUT /end AXIS_DESCR /end CHARACTERISTIC
/begin CHARACTERISTIC TZ2FGRGA_1_A "Doppelte Zählerzeitkonstante für FGR-Regler" CURVE 0x81CE2E KlAUwSstUwWUw 1310.660 t20msxs_uw_q0p02 0.02000000 1310.680 FUNCTION_LIST FGRREGL IF_DATA DIM_X INDIRECT 0x813C0E /begin AXIS_DESCR STD_AXIS uevges_w fak_q0p1 8 0.00 6553.500 DEPOSIT ABSOLUT /end AXIS_DESCR /end CHARACTERISTIC
/begin CHARACTERISTIC TZKNLL1 "Zeitkonstante Rampe Regelanteil Tastverhältnis Lüfter 1" VALUE 0x81AF9F KwUb 99.61 tv_ub_b100 0.00 99.61 FUNCTION_LIST KMTR IF_DATA DIM_X DIRECT 0x81AF9F /end CHARACTERISTIC
/begin CHARACTERISTIC TZKNLL2 "Zeitkonstante Rampe Regelanteil Tastverhältnis Lüfter 2" VALUE 0x81AFA0 KwUb 99.61 tv_ub_b100 0.00 99.61 FUNCTION_LIST KMTR IF_DATA DIM_X DIRECT 0x81AFA0 /end CHARACTERISTIC
/begin CHARACTERISTIC TZMIN "Zeitfenster für Zahnerkennung nach UBatt-Einbruch" VALUE 0x81ABFE KwUb 2.550 t10msxs_ub_b2p55 0.00 2.550 FUNCTION_LIST AEKP IF_DATA DIM_X DIRECT 0x81ABFE /end CHARACTERISTIC
/begin CHARACTERISTIC TZMSAS "Zeitgrenze für ZMS-Resonanz außerhalb Start" VALUE 0x817C3C KwUw 655.3500 t10msxs_uw_b655p35 0.00 655.3500 FUNCTION_LIST BBZMS IF_DATA DIM_X DIRECT 0x817C3C /end CHARACTERISTIC
/begin CHARACTERISTIC TZMSST "Zeitgrenze für ZMS-Resonanz innerhalb Start" VALUE 0x817C3E KwUw 655.3500 t10msxs_uw_b655p35 0.00 655.3500 FUNCTION_LIST BBZMS IF_DATA DIM_X DIRECT 0x817C3E /end CHARACTERISTIC
/begin CHARACTERISTIC TZSPINI "Sperrzeit fuer Filterinitialisierung" VALUE 0x811F2B KwUb 2.550 t10msxs_ub_b2p55 0.00 2.550 FUNCTION_LIST ARMD IF_DATA DIM_X DIRECT 0x811F2B /end CHARACTERISTIC
/begin CHARACTERISTIC TZSUDYN "Dauer des Dynamikvorhalts" CURVE 0x812D70 KlAUbSstUbWUb 2.550 t10msxs_ub_b2p55 0.00 2.550 FUNCTION_LIST ZUESZ IF_DATA DIM_X DIRECT 0x812D70 /begin AXIS_DESCR STD_AXIS nmot nmot_ub_q40 6 0.00 10200. DEPOSIT ABSOLUT /end AXIS_DESCR /end CHARACTERISTIC
/begin CHARACTERISTIC TZTOL_UM "Toleranz zwischen Zeit- und Zahnzählererfassung in Timerinkrementen" VALUE 0x81421B KwUw 65535.00 dez 0.00 65535.00 FUNCTION_LIST UFNC IF_DATA DIM_X DIRECT 0x81421B /end CHARACTERISTIC
/begin CHARACTERISTIC TZZMX "Zeitfenster für Zahnerkennung" VALUE 0x81ABFF KwUb 2.550 t10msxs_ub_b2p55 0.00 2.550 FUNCTION_LIST AEKP IF_DATA DIM_X DIRECT 0x81ABFF /end CHARACTERISTIC
/begin CHARACTERISTIC T_ASRFGR "Zeit für GRA-Abwurf bei ASR-Eingriff" VALUE 0x8101A3 KwUb 2.550 t10msxs_ub_b2p55 0.00 2.550 FUNCTION_LIST GGCASR IF_DATA DIM_X DIRECT 0x8101A3 /end CHARACTERISTIC
/begin CHARACTERISTIC T_GEUEW "Überwachungszeit für Getriebeeingriff (nur ZW-Eingriff)" VALUE 0x813CE8 KwUw 655.3500 t10msxs_uw_b655p35 0.00 655.3500 FUNCTION_LIST CAN IF_DATA DIM_X DIRECT 0x813CE8 /end CHARACTERISTIC
/begin CHARACTERISTIC T_KLIMADEADCTR "" VALUE 0x810187 KwUb 255.0 dez 0.00 255.0 FUNCTION_LIST CAN IF_DATA DIM_X DIRECT 0x810187 /end CHARACTERISTIC
/begin CHARACTERISTIC T_KOM1CLDEAD "" VALUE 0x810188 KwUb 255.0 dez 0.00 255.0 FUNCTION_LIST CAN IF_DATA DIM_X DIRECT 0x810188 /end CHARACTERISTIC
/begin CHARACTERISTIC T_NOMAIR "Timeoutzeit für Airbagbotschaft" VALUE 0x810189 KwUb 5.100 t20msxs_ub_b5p1 0.00 5.100 FUNCTION_LIST CAN IF_DATA DIM_X DIRECT 0x810189 /end CHARACTERISTIC
/begin CHARACTERISTIC T_NOMAIRTA "verlängerte Timeoutzeit für Airbagbotschaft" VALUE 0x81018A KwUb 5.100 t20msxs_ub_b5p1 0.00 5.100 FUNCTION_LIST CAN IF_DATA DIM_X DIRECT 0x81018A /end CHARACTERISTIC
/begin CHARACTERISTIC T_NOMASR "Filterzeit bis Erkennung der Kommunikationsunterbrechung zu Knoten ASR" VALUE 0x8101A4 KwUb 2.550 t10msxs_ub_b2p55 0.00 2.550 FUNCTION_LIST GGCASR IF_DATA DIM_X DIRECT 0x8101A4 /end CHARACTERISTIC
/begin CHARACTERISTIC T_NOMASRTA "DCAN Timeoutzeit ASR Botschaft" VALUE 0x8101A5 KwUb 25.50 t100msxs_ub_b25p5 0.00 25.50 FUNCTION_LIST GGCASR IF_DATA DIM_X DIRECT 0x8101A5 /end CHARACTERISTIC
/begin CHARACTERISTIC T_NOMBR3 "CAN : Timeoutzeit für Botschaft Bremse 3" VALUE 0x8101A6 KwUb 2.550 t10msxs_ub_b2p55 0.00 2.550 FUNCTION_LIST GGCASR IF_DATA DIM_X DIRECT 0x8101A6 /end CHARACTERISTIC
/begin CHARACTERISTIC T_NOMBSG "Timeoutzeit BSG-Botschaft" VALUE 0x818420 KwUb 25.50 t100msxs_ub_b25p5 0.00 25.50 FUNCTION_LIST CAN IF_DATA DIM_X DIRECT 0x818420 /end CHARACTERISTIC
/begin CHARACTERISTIC T_NOMEGS "Filterzeit bis Erkennung der Kommunikationsunterbrechung zu Knoten EGS" VALUE 0x81018B KwUb 2.550 t10msxs_ub_b2p55 0.00 2.550 FUNCTION_LIST CAN IF_DATA DIM_X DIRECT 0x81018B /end CHARACTERISTIC
/begin CHARACTERISTIC T_NOMGRA "Fehlerzeit GRA-Botschaft" VALUE 0x811232 KwUb 5.100 t20msxs_ub_b5p1 0.00 5.100 FUNCTION_LIST GGCGRA IF_DATA DIM_X DIRECT 0x811232 /end CHARACTERISTIC
/begin CHARACTERISTIC T_NOMGRAD "Entprellzeit für Botschaftsausfall bei Ub <10,8V" VALUE 0x811233 KwUb 5.100 t20msxs_ub_b5p1 0.00 5.100 FUNCTION_LIST GGCGRA IF_DATA DIM_X DIRECT 0x811233 /end CHARACTERISTIC
/begin CHARACTERISTIC T_NOMKBI "DCAN Timeoutzeit Kombi Botschaft" VALUE 0x818421 KwUb 25.50 t100msxs_ub_b25p5 0.00 25.50 FUNCTION_LIST CAN IF_DATA DIM_X DIRECT 0x818421 /end CHARACTERISTIC
/begin CHARACTERISTIC T_NOMKBI1 "Timeoutzeit Botschaft Kombi1" VALUE 0x81018C KwUb 5.100 t20msxs_ub_b5p1 0.00 5.100 FUNCTION_LIST CAN IF_DATA DIM_X DIRECT 0x81018C /end CHARACTERISTIC
/begin CHARACTERISTIC T_NOMKBI23 "Timeoutzeit Botschaft Kombi2 und 3" VALUE 0x818422 KwUb 102.0 t400msxs_ub_b102 0.00 102.0 FUNCTION_LIST CAN IF_DATA DIM_X DIRECT 0x818422 /end CHARACTERISTIC
/begin CHARACTERISTIC T_NOMKLA "Timeoutzeit Botschaft Clima1" VALUE 0x818423 KwUb 25.50 t100msxs_ub_b25p5 0.00 25.50 FUNCTION_LIST CAN IF_DATA DIM_X DIRECT 0x818423 /end CHARACTERISTIC
/begin CHARACTERISTIC T_NOMNOX "Timeoutzeit Nox Botschaft" VALUE 0x81018E KwUb 2.550 t10msxs_ub_b2p55 0.00 2.550 FUNCTION_LIST CAN IF_DATA DIM_X DIRECT 0x81018E /end CHARACTERISTIC
/begin CHARACTERISTIC T_SFSEN "Zeit nach Startende für Auswertung Fahrstufe S_fs" VALUE 0x813CEA KwUw 655.3500 t10msxs_uw_b655p35 0.00 655.3500 FUNCTION_LIST CAN IF_DATA DIM_X DIRECT 0x813CEA /end CHARACTERISTIC
/begin CHARACTERISTIC UADPLMN "min. Spannungswert für Diagnose Drucksensor Ladedruck" VALUE 0x81889E KwUb 4.980 spg_ub_b5 0.00 4.980 FUNCTION_LIST GGDSAS IF_DATA DIM_X DIRECT 0x81889E /end CHARACTERISTIC
/begin CHARACTERISTIC UADPLMX "max. Spannungswert für Diagnose Drucksensor Ladedruck" VALUE 0x81889F KwUb 4.980 spg_ub_b5 0.00 4.980 FUNCTION_LIST GGDSAS IF_DATA DIM_X DIRECT 0x81889F /end CHARACTERISTIC
/begin CHARACTERISTIC UADPUMN "min. Spannungswert für Diagnose Drucksensor" VALUE 0x8188A0 KwUb 4.9805 spg_ub_q0p019 0.00 4.9805 FUNCTION_LIST GGDSAS IF_DATA DIM_X DIRECT 0x8188A0 /end CHARACTERISTIC
/begin CHARACTERISTIC UADPUMX "max. Spannungswert für Diagnose Drucksensor" VALUE 0x8188A1 KwUb 4.9805 spg_ub_q0p019 0.00 4.9805 FUNCTION_LIST GGDSAS IF_DATA DIM_X DIRECT 0x8188A1 /end CHARACTERISTIC
/begin CHARACTERISTIC UANNMAX "Motordrehzahlschwelle für Freigabe UMA-Lernen und Verstärkerabgleich" VALUE 0x81114E KwUb 2550. nmot_ub_q10 0.00 2550. FUNCTION_LIST BGDVE IF_DATA DIM_X DIRECT 0x81114E /end CHARACTERISTIC
/begin CHARACTERISTIC UANPEDMAX "Pedalschwelle für UMA-Lernen erlaubt" VALUE 0x81114F KwUb 100.0 relDK_ub_b100 0.00 100.0 FUNCTION_LIST BGDVE IF_DATA DIM_X DIRECT 0x81114F /end CHARACTERISTIC
/begin CHARACTERISTIC UANUATS "untere Ansauglufttemperaturschwelle für Lernfreigabe" VALUE 0x811150 KwUb 191.3 temp_ub_q0p75_o48 -48.00 143.3 FUNCTION_LIST BGDVE IF_DATA DIM_X DIRECT 0x811150 /end CHARACTERISTIC
/begin CHARACTERISTIC UANVFZG "Geschwindigkeitssschelle für DV-E-Prüfung/Lernroutine" VALUE 0x811151 KwUb 318.8 vfzg_ub_q1p25 0.00 318.8 FUNCTION_LIST BGDVE IF_DATA DIM_X DIRECT 0x811151 /end CHARACTERISTIC
/begin CHARACTERISTIC UAN_O_MT "obere Motortemperaturschwelle für Anschlag" VALUE 0x811152 KwUb 191.3 temp_ub_q0p75_o48 -48.00 143.3 FUNCTION_LIST BGDVE IF_DATA DIM_X DIRECT 0x811152 /end CHARACTERISTIC
/begin CHARACTERISTIC UAN_U_MT "untere Motortemperaturschwelle für Lernfreigabe" VALUE 0x811153 KwUb 191.3 temp_ub_q0p75_o48 -48.00 143.3 FUNCTION_LIST BGDVE IF_DATA DIM_X DIRECT 0x811153 /end CHARACTERISTIC
/begin CHARACTERISTIC UBDABS "Batteriespannungsschwelle für Auswertung Schlechtweginfo" VALUE 0x81845F KwUb 17.95 spg_ubatt 0.00 17.95 FUNCTION_LIST GGSWEA IF_DATA DIM_X DIRECT 0x81845F /end CHARACTERISTIC
/begin CHARACTERISTIC UBDLS "Batteriespannungsschwelle zur Freigabe der Sonden-Diagnose" VALUE 0x81866C KwUb 17.95 spg_ubatt 0.00 17.95 FUNCTION_LIST DLSH IF_DATA DIM_X DIRECT 0x81866C /end CHARACTERISTIC
/begin CHARACTERISTIC UBDMN1 "Batteriespannung min. (Netz)" VALUE 0x811029 KwUb 17.95 spg_ubatt 0.00 17.95 FUNCTION_LIST GGUB IF_DATA DIM_X DIRECT 0x811029 /end CHARACTERISTIC
/begin CHARACTERISTIC UBDMN2 "Batteriespannung min. (ADC)" VALUE 0x81102A KwUb 17.95 spg_ubatt 0.00 17.95 FUNCTION_LIST GGUB IF_DATA DIM_X DIRECT 0x81102A /end CHARACTERISTIC
/begin CHARACTERISTIC UBDMN3 "Batteriespannung, untere Schwelle für Umschaltung auf Nachlaufwertübernahme" VALUE 0x81102B KwUb 17.95 spg_ubatt 0.00 17.95 FUNCTION_LIST GGUB IF_DATA DIM_X DIRECT 0x81102B /end CHARACTERISTIC
/begin CHARACTERISTIC UBDMX "Batteriespannung max." VALUE 0x81102C KwUb 17.95 spg_ubatt 0.00 17.95 FUNCTION_LIST GGUB IF_DATA DIM_X DIRECT 0x81102C /end CHARACTERISTIC
/begin CHARACTERISTIC UBDOLDPE "obere Spannungschwelle für Freigabe LDP-Endstufendiagnose" VALUE 0x8187E6 KwUb 17.95 spg_ubatt 0.00 17.95 FUNCTION_LIST DLDPE IF_DATA DIM_X DIRECT 0x8187E6 /end CHARACTERISTIC
/begin CHARACTERISTIC UBDTRDE "Batteriespannungsabfall für Erkennung 'Starter eingerückt'" VALUE 0x818496 KwUb 17.95 spg_ubatt 0.00 17.95 FUNCTION_LIST RDE IF_DATA DIM_X DIRECT 0x818496 /end CHARACTERISTIC
/begin CHARACTERISTIC UBGGLSU "Batteriespannungsschwelle zur Freigabe B_sbbvk LSU" VALUE 0x8186CF KwUb 17.95 spg_ubatt 0.00 17.95 FUNCTION_LIST GGLSU IF_DATA DIM_X DIRECT 0x8186CF /end CHARACTERISTIC
/begin CHARACTERISTIC UBHFM "Batteriespannungsschwelle zur Umschaltung auf Ersatzlastsignal" VALUE 0x818892 KwUb 17.95 spg_ubatt 0.00 17.95 FUNCTION_LIST DHFM IF_DATA DIM_X DIRECT 0x818892 /end CHARACTERISTIC
/begin CHARACTERISTIC UBKL15 "Ub-Schwelle für redundaten KL15-Erfassung" VALUE 0x81A44E KwUb 4.998 spg_ubatt 0.00 4.998 FUNCTION_LIST GGZDGON IF_DATA DIM_X DIRECT 0x81A44E /end CHARACTERISTIC
/begin CHARACTERISTIC UBKLEMN "Minimale Batteriespannung für KLE aktiv" VALUE 0x8187F3 KwUb 25.50 fak_q0p1 0.00 25.50 FUNCTION_LIST DKMTR IF_DATA DIM_X DIRECT 0x8187F3 /end CHARACTERISTIC
/begin CHARACTERISTIC UBKLEMX "Maximale Batteriespannung für KLE aktiv" VALUE 0x8187F4 KwUb 25.50 fak_q0p1 0.00 25.50 FUNCTION_LIST DKMTR IF_DATA DIM_X DIRECT 0x8187F4 /end CHARACTERISTIC
/begin CHARACTERISTIC UBKST "Ubat-Schwelle für ZUBKSTMX" VALUE 0x811648 KwUb 17.95 spg_ubatt 0.00 17.95 FUNCTION_LIST STADAP IF_DATA DIM_X DIRECT 0x811648 /end CHARACTERISTIC
/begin CHARACTERISTIC UBKSTMX "Anzahlschwelle Ubat unter UBKST für Adaptionssperrung" VALUE 0x811649 KwUb 255.0 dez 0.00 255.0 FUNCTION_LIST STADAP IF_DATA DIM_X DIRECT 0x811649 /end CHARACTERISTIC
/begin CHARACTERISTIC UBMNPUP "Mindest-Bordspannung für pullup-Ansteuerung" VALUE 0x8197CC KwUb 25.50 spg_q0p1 0.00 25.50 FUNCTION_LIST GGTFM IF_DATA DIM_X DIRECT 0x8197CC /end CHARACTERISTIC
/begin CHARACTERISTIC UBNLMN "Minimale Batterie-Sollspannung" VALUE 0x81A44C KwUb 17.95 spg_ubatt 0.00 17.95 FUNCTION_LIST MOTAUS IF_DATA DIM_X DIRECT 0x81A44C /end CHARACTERISTIC
/begin CHARACTERISTIC UBRDMN1 "untere Grenze Bordnetzspannung über Hauptrelais, Erkennung Lastabfall" VALUE 0x818713 KwUb 25.50 spg_q0p1 0.00 25.50 FUNCTION_LIST GGUBR IF_DATA DIM_X DIRECT 0x818713 /end CHARACTERISTIC
/begin CHARACTERISTIC UBRDMN2 "untere Grenze Bordnetzspannung über Hauptrelais" VALUE 0x818714 KwUb 25.50 spg_q0p1 0.00 25.50 FUNCTION_LIST GGUBR IF_DATA DIM_X DIRECT 0x818714 /end CHARACTERISTIC
/begin CHARACTERISTIC UBRDMX "obere Grenze Bordnetzspannung über Hauptrelais" VALUE 0x818715 KwUb 28.38 spg_ub_b28p5 0.00 28.38 FUNCTION_LIST GGUBR IF_DATA DIM_X DIRECT 0x818715 /end CHARACTERISTIC
/begin CHARACTERISTIC UBRDUNL "Schwellwert für Unplausibilität der Bordnetzspannung über Hauptrelais (im Nachl)" VALUE 0x818716 KwUb 25.50 spg_q0p1 0.00 25.50 FUNCTION_LIST GGUBR IF_DATA DIM_X DIRECT 0x818716 /end CHARACTERISTIC
/begin CHARACTERISTIC UBSLMN "min. Spannung für Sekundärluft ein" VALUE 0x81B1DA KwUw 25.59961 spg_q0p00039 0.00 25.59961 FUNCTION_LIST SLS IF_DATA DIM_X DIRECT 0x81B1DA /end CHARACTERISTIC
/begin CHARACTERISTIC UBSLMX "max. Spannung für Sekundärluft ein" VALUE 0x81B1DC KwUw 25.59961 spg_q0p00039 0.00 25.59961 FUNCTION_LIST SLS IF_DATA DIM_X DIRECT 0x81B1DC /end CHARACTERISTIC
/begin CHARACTERISTIC UBSLSTMN "min.Spannung für Sekundärluft ein im Start" VALUE 0x81B1DE KwUw 25.59961 spg_q0p00039 0.00 25.59961 FUNCTION_LIST SLS IF_DATA DIM_X DIRECT 0x81B1DE /end CHARACTERISTIC
/begin CHARACTERISTIC UBSOLMN "Minimale Batterie-Sollspannung" VALUE 0x818706 KwUb 17.95 spg_ubatt 0.00 17.95 FUNCTION_LIST BGLBZ IF_DATA DIM_X DIRECT 0x818706 /end CHARACTERISTIC
/begin CHARACTERISTIC UBSOLMX "Maximale Batterie-Sollspannung" VALUE 0x818707 KwUb 17.95 spg_ubatt 0.00 17.95 FUNCTION_LIST BGLBZ IF_DATA DIM_X DIRECT 0x818707 /end CHARACTERISTIC
/begin CHARACTERISTIC UBSQBKVMN "min. Spannungsschwelle für BKV-Pumpe-Ansteuerung möglich" VALUE 0x81AFF1 KwUb 25.50 spg_q0p1 0.00 25.50 FUNCTION_LIST ABKVP IF_DATA DIM_X DIRECT 0x81AFF1 /end CHARACTERISTIC
/begin CHARACTERISTIC UBSQBKVMX "max. Spannungsschwelle für BKV-Pumpe-Ansteuerung möglich" VALUE 0x81AFF2 KwUb 25.50 spg_q0p1 0.00 25.50 FUNCTION_LIST ABKVP IF_DATA DIM_X DIRECT 0x81AFF2 /end CHARACTERISTIC
/begin CHARACTERISTIC UBSTS "Schwelle zur Erkennung UBatt-Einbruch im Start" VALUE 0x81AC00 KwUb 25.50 spg_q0p1 0.00 25.50 FUNCTION_LIST AEKP IF_DATA DIM_X DIRECT 0x81AC00 /end CHARACTERISTIC
/begin CHARACTERISTIC UBVDKPO "Batteriespannungsschwelle für Umschaltung auf verstärktes Signal von DK-Poti 1" VALUE 0x81111E KwUb 17.95 spg_ubatt 0.00 17.95 FUNCTION_LIST GGDVE IF_DATA DIM_X DIRECT 0x81111E /end CHARACTERISTIC
/begin CHARACTERISTIC UBVDKPU "Batteriespannungsschwelle für Umschaltung auf unverstärktes Signal von DK-Poti 1" VALUE 0x81111F KwUb 17.95 spg_ubatt 0.00 17.95 FUNCTION_LIST GGDVE IF_DATA DIM_X DIRECT 0x81111F /end CHARACTERISTIC
/begin CHARACTERISTIC UB_UANL "Batteriespannungsschwelle für Lernfreigabe" VALUE 0x811154 KwUb 17.95 spg_ubatt 0.00 17.95 FUNCTION_LIST BGDVE IF_DATA DIM_X DIRECT 0x811154 /end CHARACTERISTIC
/begin CHARACTERISTIC UDKP1DUS "Nennumschaltschwelle zur DK-Poti-1-Umschaltung" VALUE 0x811155 KwUb 4.9805 spg_ub_q0p019 0.00 4.9805 FUNCTION_LIST BGDVE IF_DATA DIM_X DIRECT 0x811155 /end CHARACTERISTIC
/begin CHARACTERISTIC UDKP1O "Maximale zulässige Spannung von DK-Poti 1" VALUE 0x811120 KwUb 4.980 spg_ub_b5 0.00 4.980 FUNCTION_LIST GGDVE IF_DATA DIM_X DIRECT 0x811120 /end CHARACTERISTIC
/begin CHARACTERISTIC UDKP1U "Minimale zulässige Spannung von DK-Poti 1" VALUE 0x811121 KwUb 4.980 spg_ub_b5 0.00 4.980 FUNCTION_LIST GGDVE IF_DATA DIM_X DIRECT 0x811121 /end CHARACTERISTIC
/begin CHARACTERISTIC UDKP2O "Maximale zulässige Spannung von DK-Poti 2" VALUE 0x811122 KwUb 4.980 spg_ub_b5 0.00 4.980 FUNCTION_LIST GGDVE IF_DATA DIM_X DIRECT 0x811122 /end CHARACTERISTIC
/begin CHARACTERISTIC UDKP2U "Minimale zulässige Spannung von DK-Poti 2" VALUE 0x811123 KwUb 4.980 spg_ub_b5 0.00 4.980 FUNCTION_LIST GGDVE IF_DATA DIM_X DIRECT 0x811123 /end CHARACTERISTIC
/begin CHARACTERISTIC UDKRGOFS "Spannungsschwelle für DIA/KR Grundoffset Verstärker" VALUE 0x811C48 KwUb 4.980 spg_ub_b5 0.00 4.980 FUNCTION_LIST DKRNT IF_DATA DIM_X DIRECT 0x811C48 /end CHARACTERISTIC
/begin CHARACTERISTIC UDKRTP "Integratorspannungsschwelle für Dia KS - Auswerteschaltung Testimpuls" VALUE 0x811C4A KwUb 4.980 spg_ub_b5 0.00 4.980 FUNCTION_LIST DKRTP IF_DATA DIM_X DIRECT 0x811C4A /end CHARACTERISTIC
/begin CHARACTERISTIC UDKSNO "Obere Referenzspannungsschwelle DIA KS" CURVE 0x81FA6C GklWUw 319.9813 spg_uw_b1280 0.00 319.9813 FUNCTION_LIST DKRS IF_DATA DIM_X DIRECT 0x81FA6C
 /begin AXIS_DESCR COM_AXIS nmot nmot_ub_q40 16 0.00 10200. AXIS_PTS_REF SNM16KRUB /end AXIS_DESCR
/end CHARACTERISTIC
/begin CHARACTERISTIC UDKSNU "untere Referenzspannungsschwelle DIA KS" CURVE 0x81FA8C GklWUw 319.9813 spg_uw_b1280 0.00 319.9813 FUNCTION_LIST DKRS IF_DATA DIM_X DIRECT 0x81FA8C
 /begin AXIS_DESCR COM_AXIS nmot nmot_ub_q40 16 0.00 10200. AXIS_PTS_REF SNM16KRUB /end AXIS_DESCR
/end CHARACTERISTIC
/begin CHARACTERISTIC UDSBKVMN "min. Spannungswert für Diagnose DS Bremskraftverstärker" VALUE 0x81AFF7 KwUb 4.980 spg_ub_b5 0.00 4.980 FUNCTION_LIST DDSBKV IF_DATA DIM_X DIRECT 0x81AFF7 /end CHARACTERISTIC
/begin CHARACTERISTIC UDSBKVMX "max. Spannungswert für Diagnose DS Bremskraftverstärker" VALUE 0x81AFF8 KwUb 4.980 spg_ub_b5 0.00 4.980 FUNCTION_LIST DDSBKV IF_DATA DIM_X DIRECT 0x81AFF8 /end CHARACTERISTIC
/begin CHARACTERISTIC UEVERG "Übersetzungsverhältnis abh. vom eingelegten Gang" CURVE 0x811E44 FklWUb 31.88 fak_ub_b32 0.00 31.88 FUNCTION_LIST MDWAN IF_DATA DIM_X DIRECT 0x811E44 /begin AXIS_DESCR FIX_AXIS gangi dez 8 0.00 7.000 FIX_AXIS_PAR 0 0 8 /end AXIS_DESCR /end CHARACTERISTIC
/begin CHARACTERISTIC UHEMN "Schwellwert für bestromte Heizerendstufe" VALUE 0x81101E KwUb 4.9805 spg_ub_q0p019 0.00 4.9805 FUNCTION_LIST DHLSU TKMWL IF_DATA DIM_X DIRECT 0x81101E /end CHARACTERISTIC
/begin CHARACTERISTIC UHEMX "Schwellwert für stromlose Heizerendstufe" VALUE 0x81101F KwUb 4.9805 spg_ub_q0p019 0.00 4.9805 FUNCTION_LIST DHLSU TKMWL IF_DATA DIM_X DIRECT 0x81101F /end CHARACTERISTIC
/begin CHARACTERISTIC UHRMN1 "untere Grenze HR-Spannung, Erkennung Kurzschl. n. Masse" VALUE 0x81AFF9 KwUb 4.980 spg_ub_b5 0.00 4.980 FUNCTION_LIST DHR IF_DATA DIM_X DIRECT 0x81AFF9 /end CHARACTERISTIC
/begin CHARACTERISTIC UHRMN2 "untere Grenze HR-Spannung, Erkennung Signalfehler" VALUE 0x81AFFA KwUb 4.980 spg_ub_b5 0.00 4.980 FUNCTION_LIST DHR IF_DATA DIM_X DIRECT 0x81AFFA /end CHARACTERISTIC
/begin CHARACTERISTIC UHRMNDEV "Schwelle Min. Abweichung Abstellzeit" VALUE 0x819544 KwUb 1.992 fak_ub_b2 0.00 1.992 FUNCTION_LIST BGTABST IF_DATA DIM_X DIRECT 0x819544 /end CHARACTERISTIC
/begin CHARACTERISTIC UHRMX1 "obere Grenze HR-Spannung" VALUE 0x81AFFB KwUb 4.980 spg_ub_b5 0.00 4.980 FUNCTION_LIST DHR IF_DATA DIM_X DIRECT 0x81AFFB /end CHARACTERISTIC
/begin CHARACTERISTIC UHRMX2 "obere Grenze HR-Spannung, Erkennung Kurzschl. n. ub." VALUE 0x81AFFC KwUb 4.980 spg_ub_b5 0.00 4.980 FUNCTION_LIST DHR IF_DATA DIM_X DIRECT 0x81AFFC /end CHARACTERISTIC
/begin CHARACTERISTIC UHRMXDEV "Schwelle Max. Abweichung Abstellzeit" VALUE 0x819545 KwUb 1.992 fak_ub_b2 0.00 1.992 FUNCTION_LIST BGTABST IF_DATA DIM_X DIRECT 0x819545 /end CHARACTERISTIC
/begin CHARACTERISTIC UHSN "Nennspannung für die Sondenheizung" VALUE 0x818703 KwUb 17.95 spg_ubatt 0.00 17.95 FUNCTION_LIST HLSHK IF_DATA DIM_X DIRECT 0x818703 /end CHARACTERISTIC
/begin CHARACTERISTIC UKAFRTMO "Obere Schwelle Faktor Lambdaregler (fr) zur Freigabe der UK-Adaption" CURVE 0x81E604 GklWUw 1.999969 fak_uw_b2 0.00 1.999969 FUNCTION_LIST ESUKAS IF_DATA DIM_X DIRECT 0x81E604
 /begin AXIS_DESCR COM_AXIS tmot temp_ub_q0p75_o48 9 -48.00 143.3 AXIS_PTS_REF STM09ESUB /end AXIS_DESCR
/end CHARACTERISTIC
/begin CHARACTERISTIC UKAFRTMU "Untere Schwelle Faktor Lambdaregler (fr) zur Freigabe der UK-Adaption" CURVE 0x81E616 GklWUw 1.999969 fak_uw_b2 0.00 1.999969 FUNCTION_LIST ESUKAS IF_DATA DIM_X DIRECT 0x81E616
 /begin AXIS_DESCR COM_AXIS tmot temp_ub_q0p75_o48 9 -48.00 143.3 AXIS_PTS_REF STM09ESUB /end AXIS_DESCR
/end CHARACTERISTIC
/begin CHARACTERISTIC ULDPEMN "Minimale Spannung für Diagnose LDP-Endstufe i.O." VALUE 0x8187E8 KwUb 4.9805 spg_ub_q0p019 0.00 4.9805 FUNCTION_LIST DLDPE IF_DATA DIM_X DIRECT 0x8187E8 /end CHARACTERISTIC
/begin CHARACTERISTIC ULDPEMX "Maximale Spannung für Diagnose LDP-Endstufe i.O." VALUE 0x8187E9 KwUb 4.9805 spg_ub_q0p019 0.00 4.9805 FUNCTION_LIST DLDPE IF_DATA DIM_X DIRECT 0x8187E9 /end CHARACTERISTIC
/begin CHARACTERISTIC UMDYLDR "Umschaltschwelle Dynamik LDR" VALUE 0x819D4F KwSb 2550. p_sb_q10 -1280. 1270. FUNCTION_LIST LDRPID IF_DATA DIM_X DIRECT 0x819D4F /end CHARACTERISTIC
/begin CHARACTERISTIC UNWDHFM "Umdrehungen Nockenwelle für Fehlerentprellung Diagnose HFM" VALUE 0x818893 KwUb 255.0 dez 0.00 255.0 FUNCTION_LIST DHFM IF_DATA DIM_X DIRECT 0x818893 /end CHARACTERISTIC
/begin CHARACTERISTIC UPOTHI "Tastverhältnis Heizleistung=1" VALUE 0x81AC06 KwUb 4.980 spg_ub_b5 0.00 4.980 FUNCTION_LIST GGHLA IF_DATA DIM_X DIRECT 0x81AC06 /end CHARACTERISTIC
/begin CHARACTERISTIC UPOTLO "Tastverhältnis Heizleistung=0" VALUE 0x81AC07 KwUb 4.980 spg_ub_b5 0.00 4.980 FUNCTION_LIST GGHLA IF_DATA DIM_X DIRECT 0x81AC07 /end CHARACTERISTIC
/begin CHARACTERISTIC UPVGNENN "Nennwert für DV-E Potiversorgungsspannung" VALUE 0x81C7D6 KwUw 1.000000 dez 65534.00 65535.00 FUNCTION_LIST BGDVE IF_DATA DIM_X DIRECT 0x81C7D6 /end CHARACTERISTIC
/begin CHARACTERISTIC UPW1BE "Spannung PWG-Poti 1 für Durchführung der Bewegungserkennung" VALUE 0x811049 KwUb 4.980 spg_ub_b5 0.00 4.980 FUNCTION_LIST GGPED IF_DATA DIM_X DIRECT 0x811049 /end CHARACTERISTIC
/begin CHARACTERISTIC UPW1LLMX "Maximale Spannung von Poti 1 im Leergaspunkt" VALUE 0x81104A KwUb 4.980 spg_ub_b5 0.00 4.980 FUNCTION_LIST GGPED IF_DATA DIM_X DIRECT 0x81104A /end CHARACTERISTIC
/begin CHARACTERISTIC UPWG12U "Untere Begrenzung PWG-Poti-Spannung vor Vergleich Poti 1 und 2" VALUE 0x81104B KwUb 4.980 spg_ub_b5 0.00 4.980 FUNCTION_LIST GGPED IF_DATA DIM_X DIRECT 0x81104B /end CHARACTERISTIC
/begin CHARACTERISTIC UPWG1O "Obere Schranke für PWG-Poti-1-Spannung" VALUE 0x81104C KwUb 4.980 spg_ub_b5 0.00 4.980 FUNCTION_LIST GGPED IF_DATA DIM_X DIRECT 0x81104C /end CHARACTERISTIC
/begin CHARACTERISTIC UPWG1U "Untere Schranke für PWG-Poti-1-Spannung" VALUE 0x81104D KwUb 4.980 spg_ub_b5 0.00 4.980 FUNCTION_LIST GGPED IF_DATA DIM_X DIRECT 0x81104D /end CHARACTERISTIC
/begin CHARACTERISTIC UPWG2O "Obere Schranke für PWG-Poti-2-Spannung" VALUE 0x81104E KwUb 4.980 spg_ub_b5 0.00 4.980 FUNCTION_LIST GGPED IF_DATA DIM_X DIRECT 0x81104E /end CHARACTERISTIC
/begin CHARACTERISTIC UPWG2U "Untere Schranke für PWG-Poti-2-Spannung" VALUE 0x81104F KwUb 4.980 spg_ub_b5 0.00 4.980 FUNCTION_LIST GGPED IF_DATA DIM_X DIRECT 0x81104F /end CHARACTERISTIC
/begin CHARACTERISTIC UPWGKDO "Oberer Hysterese-Schaltpunkt zur Kick-Down-Erkennung aus Potispannung" VALUE 0x81C7D2 KwUw 319.9951 spg_uw_q0p00488 0.00 319.9951 FUNCTION_LIST BBKD IF_DATA DIM_X DIRECT 0x81C7D2 /end CHARACTERISTIC
/begin CHARACTERISTIC UPWGKDU "Unterer Hysterese-Schaltpunkt zur Kick-Down-Erkennung aus Potispannung" VALUE 0x81C7D4 KwUw 319.9951 spg_uw_q0p00488 0.00 319.9951 FUNCTION_LIST BBKD IF_DATA DIM_X DIRECT 0x81C7D4 /end CHARACTERISTIC
/begin CHARACTERISTIC UPWGO "Oberer PWG-Spannungswert für Umnormierung auf Pedalwert" VALUE 0x811050 KwUb 4.980 spg_ub_b5 0.00 4.980 FUNCTION_LIST GGPED IF_DATA DIM_X DIRECT 0x811050 /end CHARACTERISTIC
/begin CHARACTERISTIC UPWGTG "PWG-Spannungsschwelle für Teilgasbereich" VALUE 0x811051 KwUb 4.980 spg_ub_b5 0.00 4.980 FUNCTION_LIST GGPED IF_DATA DIM_X DIRECT 0x811051 /end CHARACTERISTIC
/begin CHARACTERISTIC UPWGTL "Teillastschwelle der PWG-Spannung in Hochohmigkeitsprüfung" VALUE 0x811052 KwUb 4.980 spg_ub_b5 0.00 4.980 FUNCTION_LIST GGPED IF_DATA DIM_X DIRECT 0x811052 /end CHARACTERISTIC
/begin CHARACTERISTIC UPWGU "Unterer PWG-Spannungswert für Umnormierung auf Pedalwert" VALUE 0x811053 KwUb 4.980 spg_ub_b5 0.00 4.980 FUNCTION_LIST GGPED IF_DATA DIM_X DIRECT 0x811053 /end CHARACTERISTIC
/begin CHARACTERISTIC UPWGUBF "Unterer Spannungswert zur Umnormierung bei erkanntem Bewegungsfehler" VALUE 0x811054 KwUb 4.980 spg_ub_b5 0.00 4.980 FUNCTION_LIST GGPED IF_DATA DIM_X DIRECT 0x811054 /end CHARACTERISTIC
/begin CHARACTERISTIC UPWGUR "Reduzierter unterer PWG-Spannungswert für Umnormierung auf Pedalwert" VALUE 0x811055 KwUb 4.980 spg_ub_b5 0.00 4.980 FUNCTION_LIST GGPED IF_DATA DIM_X DIRECT 0x811055 /end CHARACTERISTIC
/begin CHARACTERISTIC UPWGVG "PWG-Spannungsschwelle für Vollgasbereich" VALUE 0x811056 KwUb 4.980 spg_ub_b5 0.00 4.980 FUNCTION_LIST GGPED IF_DATA DIM_X DIRECT 0x811056 /end CHARACTERISTIC
/begin CHARACTERISTIC UPWMCS "Ubatt-Schwelle für Diagnose Crash-Signal" VALUE 0x81AFDD KwUb 17.95 spg_ubatt 0.00 17.95 FUNCTION_LIST GGCS IF_DATA DIM_X DIRECT 0x81AFDD /end CHARACTERISTIC
/begin CHARACTERISTIC UPWMHI "Obere Spannungsquelle" VALUE 0x81AC08 KwUb 4.980 spg_ub_b5 0.00 4.980 FUNCTION_LIST GGHLA IF_DATA DIM_X DIRECT 0x81AC08 /end CHARACTERISTIC
/begin CHARACTERISTIC UPWMLO "Untere Spannungsquelle" VALUE 0x81AC09 KwUb 4.980 spg_ub_b5 0.00 4.980 FUNCTION_LIST GGHLA IF_DATA DIM_X DIRECT 0x81AC09 /end CHARACTERISTIC
/begin CHARACTERISTIC USHKAMNW "Sondenspannung hinter Kat für Erkennung Kat ist mit O2 gefüllt (Word)" VALUE 0x8175BC KwUw 319.9951 spg_uw_q0p00488_o1 -1.000000 318.9951 FUNCTION_LIST LRSKA IF_DATA DIM_X DIRECT 0x8175BC /end CHARACTERISTIC
/begin CHARACTERISTIC USHKAMXW "Sondenspannung hinter Kat für Abbruch Kat-Ausräumen (Word)" VALUE 0x8175BE KwUw 319.9951 spg_uw_q0p00488_o1 -1.000000 318.9951 FUNCTION_LIST LRSKA IF_DATA DIM_X DIRECT 0x8175BE /end CHARACTERISTIC
/begin CHARACTERISTIC USHKFT "Sondenspannungs-Schwelle für Erkennung ""Abgas fett"" hinter Kat" VALUE 0x81C7A8 KwUw 319.9951 spg_uw_q0p00488_o1 -1.000000 318.9951 FUNCTION_LIST DLSU IF_DATA DIM_X DIRECT 0x81C7A8 /end CHARACTERISTIC
/begin CHARACTERISTIC USHKMR "Sondenspannungs-Schwelle für Erkennung ""Abgas mager"" hinter Kat" VALUE 0x81C7AA KwUw 319.9951 spg_uw_q0p00488_o1 -1.000000 318.9951 FUNCTION_LIST DLSU IF_DATA DIM_X DIRECT 0x81C7AA /end CHARACTERISTIC
/begin CHARACTERISTIC USHKTDM "Magerschwelle der hinteren Sonde bei Katdiagnose" VALUE 0x8186DF KwUb 1.330 spg_ub_q0p0052_o0p2 -0.2000 1.130 FUNCTION_LIST DKATSP IF_DATA DIM_X DIRECT 0x8186DF /end CHARACTERISTIC
/begin CHARACTERISTIC USHKTDR "Schwelle hintere Sondenspannung für Referenzmessung" VALUE 0x8186E0 KwUb 1.330 spg_ub_q0p0052_o0p2 -0.2000 1.130 FUNCTION_LIST DKATSP IF_DATA DIM_X DIRECT 0x8186E0 /end CHARACTERISTIC
/begin CHARACTERISTIC USHKTDRX "Maximalwert der hinteren Sondenspannung für Referenzmessung" VALUE 0x8186E1 KwUb 1.330 spg_ub_q0p0052_o0p2 -0.2000 1.130 FUNCTION_LIST DKATSP IF_DATA DIM_X DIRECT 0x8186E1 /end CHARACTERISTIC
/begin CHARACTERISTIC USHKVL "Schwellwert für Sondenspannung hinter KAT im Vollast-Betrieb" VALUE 0x818677 KwUb 1.330 spg_ub_q0p0052_o0p2 -0.2000 1.130 FUNCTION_LIST DLSAHK IF_DATA DIM_X DIRECT 0x818677 /end CHARACTERISTIC
/begin CHARACTERISTIC USHLEAN "Schwelle für Magerspannung für Reset Dynamikmessung der Sonde hinter KAT" VALUE 0x81101A KwUb 1.330 spg_ub_q0p0052_o0p2 -0.2000 1.130 FUNCTION_LIST DLSAHK IF_DATA DIM_X DIRECT 0x81101A /end CHARACTERISTIC
/begin CHARACTERISTIC USHRICH "Schwelle für Fettspannung für gültige Dynamikmessung der Sonde hinter KAT" VALUE 0x81101B KwUb 1.330 spg_ub_q0p0052_o0p2 -0.2000 1.130 FUNCTION_LIST DLSAHK IF_DATA DIM_X DIRECT 0x81101B /end CHARACTERISTIC
/begin CHARACTERISTIC USHSTGMX "Wert für maximale Steigung für Startwert Filter" VALUE 0x818678 KwUb 132.6 spgg_q0p52 0.00 132.6 FUNCTION_LIST DLSAHK IF_DATA DIM_X DIRECT 0x818678 /end CHARACTERISTIC
/begin CHARACTERISTIC USHSTSOLL "Schwelle für zulässige Steigung der Sondenspannung hinter KAT" VALUE 0x818679 KwUb 132.6 spgg_q0p52 0.00 132.6 FUNCTION_LIST DLSAHK IF_DATA DIM_X DIRECT 0x818679 /end CHARACTERISTIC
/begin CHARACTERISTIC USIVMAXH "Init value für max.Sondenspg. hinter Kat nach Powerfail u. Fehlersp. löschen" VALUE 0x818A12 KwUb 1.330 spg_ub_b1p33 0.00 1.330 FUNCTION_LIST DLSSA IF_DATA DIM_X DIRECT 0x818A12 /end CHARACTERISTIC
/begin CHARACTERISTIC USIVMINH "Init value für min.Sondenspg. hinter Kat nach Powerfail u. Fehlersp. löschen" VALUE 0x818A13 KwUb 1.330 spg_ub_b1p33 0.00 1.330 FUNCTION_LIST DLSSA IF_DATA DIM_X DIRECT 0x818A13 /end CHARACTERISTIC
/begin CHARACTERISTIC USMNSHMN "min. erkannte Sondenspannung hinter Kat für Signalausgabe (min. plaus. Wert)" VALUE 0x818A14 KwUb 1.330 spg_ub_b1p33 0.00 1.330 FUNCTION_LIST DLSSA TC5MOD IF_DATA DIM_X DIRECT 0x818A14 /end CHARACTERISTIC
/begin CHARACTERISTIC USMNSHMX "min. erkannte Sondenspannung hinter Kat für Signalausgabe (max. plaus. Wert)" VALUE 0x818A15 KwUb 1.330 spg_ub_b1p33 0.00 1.330 FUNCTION_LIST DLSSA TC5MOD IF_DATA DIM_X DIRECT 0x818A15 /end CHARACTERISTIC
/begin CHARACTERISTIC USMXSHMN "max. erkannte Sondenspannung hinter Kat für Signalausgabe (min. plaus. Wert)" VALUE 0x818A16 KwUb 1.330 spg_ub_b1p33 0.00 1.330 FUNCTION_LIST DLSSA TC5MOD IF_DATA DIM_X DIRECT 0x818A16 /end CHARACTERISTIC
/begin CHARACTERISTIC USMXSHMX "max. erkannte Sondenspannung hinter Kat für Signalausgabe (max. plaus. Wert)" VALUE 0x818A17 KwUb 1.330 spg_ub_b1p33 0.00 1.330 FUNCTION_LIST DLSSA TC5MOD IF_DATA DIM_X DIRECT 0x818A17 /end CHARACTERISTIC
/begin CHARACTERISTIC USRHKFA "Sondenspannungssollwert für Regelung hinter Kat. bei Funktionsanf. B_fakat" VALUE 0x81274C KwUb 1.330 spg_ub_q0p0052_o0p2 -0.2000 1.130 FUNCTION_LIST LRSHK IF_DATA DIM_X DIRECT 0x81274C /end CHARACTERISTIC
/begin CHARACTERISTIC USRHKSHJ "Regelschwelle für Regelung hinter Kat, DLSSA-Ausgabe umgerechn. Wert" VALUE 0x818A18 KwUb 1.330 spg_ub_b1p33 0.00 1.330 FUNCTION_LIST DLSSA TC5MOD IF_DATA DIM_X DIRECT 0x818A18 /end CHARACTERISTIC
/begin CHARACTERISTIC USRJ "" VALUE 0x818A19 KwUb 1.330 spg_ub_b1p33 0.00 1.330 FUNCTION_LIST DLSSA IF_DATA DIM_X DIRECT 0x818A19 /end CHARACTERISTIC
/begin CHARACTERISTIC USSCHUB "Schwelle für Sondenspannung hinter KAT nach Schub" VALUE 0x81867A KwUb 1.330 spg_ub_q0p0052_o0p2 -0.2000 1.130 FUNCTION_LIST DLSAHK IF_DATA DIM_X DIRECT 0x81867A /end CHARACTERISTIC
/begin CHARACTERISTIC USVKKS "Lambdasondenspannungsschwelle für Rücksetzen des Zählers für Benzin im Öl" VALUE 0x81E628 KwUw 319.9951 spg_q0p00488 0.00 319.9951 FUNCTION_LIST BBBO IF_DATA DIM_X DIRECT 0x81E628 /end CHARACTERISTIC
/begin CHARACTERISTIC VALDPMN "minimale Fahrzeuggeschwindigkeit bei Aktivierung DLDP" VALUE 0x81278D KwUb 318.8 vfzg_ub_q1p25 0.00 318.8 FUNCTION_LIST DLDP IF_DATA DIM_X DIRECT 0x81278D /end CHARACTERISTIC
/begin CHARACTERISTIC VANF "Geschwindigkeitsschwelle für Anfahrhilfe" VALUE 0x811EF1 KwUb 318.8 vfzg_ub_q1p25 0.00 318.8 FUNCTION_LIST LLRMR IF_DATA DIM_X DIRECT 0x811EF1 /end CHARACTERISTIC
/begin CHARACTERISTIC VANZKBI "Kombiausgabe Anzahl Ventil" VALUE 0x81018F KwUb 255.0 DEZ 0.00 255.0 FUNCTION_LIST CAN IF_DATA DIM_X DIRECT 0x81018F /end CHARACTERISTIC
/begin CHARACTERISTIC VARAU "minimale Fahrzeuggeschwindigkeit für ARA - Funktion" VALUE 0x811F2C KwUb 317.5 fak_ub_b318p75 0.00 317.5 FUNCTION_LIST ARMD IF_DATA DIM_X DIRECT 0x811F2C /end CHARACTERISTIC
/begin CHARACTERISTIC VARDEF "Default Variante für Variantencodierung" VALUE 0x8161C6 KwUw 32767.00 dez 0.00 32767.00 FUNCTION_LIST TKMWL K71SR KDIAG OBPC_71 VAR_DST IF_DATA DIM_X DIRECT 0x8161C6 /end CHARACTERISTIC
/begin CHARACTERISTIC VDKUPPLMN "min. vfzg-Schwelle für Diagnose Kupplungsschalter" VALUE 0x81871A KwUb 318.8 vfzg_ub_q1p25 0.00 318.8 FUNCTION_LIST DKUPPL IF_DATA DIM_X DIRECT 0x81871A /end CHARACTERISTIC
/begin CHARACTERISTIC VFGREMAX "Maximale FGR-Einschaltgeschwindigkeit" VALUE 0x81C7F0 KwUw 511.9922 vfzg_uw_q0p0078125 0.00 511.9922 FUNCTION_LIST FGRABED IF_DATA DIM_X DIRECT 0x81C7F0 /end CHARACTERISTIC
/begin CHARACTERISTIC VFGREMIN "Minimale FGR-Einschaltgeschwindigkeit" VALUE 0x81C7F2 KwUw 511.9922 vfzg_uw_q0p0078125 0.00 511.9922 FUNCTION_LIST FGRABED IF_DATA DIM_X DIRECT 0x81C7F2 /end CHARACTERISTIC
/begin CHARACTERISTIC VFGRMAX "Maximal zulässige Geschwindigkeit im FGR-Betrieb" VALUE 0x81C7F4 KwUw 511.9922 vfzg_uw_q0p0078125 0.00 511.9922 FUNCTION_LIST FGRABED FGRFULO IF_DATA DIM_X DIRECT 0x81C7F4 /end CHARACTERISTIC
/begin CHARACTERISTIC VFGRMIN "Minimal zulässige Geschwindigkeit im FGR-Betrieb" VALUE 0x81C7F6 KwUw 511.9922 vfzg_uw_q0p0078125 0.00 511.9922 FUNCTION_LIST FGRABED FGRFULO IF_DATA DIM_X DIRECT 0x81C7F6 /end CHARACTERISTIC
/begin CHARACTERISTIC VFZGADMD "Fahrzeuggeschw.schwelle zum Ausblenden DMD bei aktivem Bremseingriff" VALUE 0x818425 KwUb 318.8 vfzg_ub_q1p25 0.00 318.8 FUNCTION_LIST DMDSTP IF_DATA DIM_X DIRECT 0x818425 /end CHARACTERISTIC
/begin CHARACTERISTIC VFZGEW "KMTR-Ersatzwert f. Fahrzeuggeschwindigkeit" VALUE 0x81AFA1 KwUb 318.8 vfzg_ub_q1p25 0.00 318.8 FUNCTION_LIST KMTR IF_DATA DIM_X DIRECT 0x81AFA1 /end CHARACTERISTIC
/begin CHARACTERISTIC VFZGSCH "Schwelle für Fahrzeuggeschwindigkeit" VALUE 0x82B1E4 KwUw 511.9922 vfzg_uw_q0p00781 0.00 511.9922 FUNCTION_LIST GGPBKV IF_DATA DIM_X DIRECT 0x82B1E4 /end CHARACTERISTIC
/begin CHARACTERISTIC VFZG_DAT_UC "" VAL_BLK 0x817472 KwbUw 511.9922 vfzg_uw_q0p00781 0.00 511.9922 NUMBER 16 FUNCTION_LIST URCEIN IF_DATA DIM_X DIRECT 0x817472 /end CHARACTERISTIC
/begin CHARACTERISTIC VGNL "Geschwindigkeitsschwelle für Momenteneingriff bei Ausfall der Getriebe-Botschaft" VALUE 0x818424 KwUb 318.8 vfzg_ub_q1p25 0.00 318.8 FUNCTION_LIST CAN IF_DATA DIM_X DIRECT 0x818424 /end CHARACTERISTIC
/begin CHARACTERISTIC VKO "Geschwindigkeitsschwelle für AC-Steuerung" VALUE 0x812DE8 KwUb 318.8 vfzg_ub_q1p25 0.00 318.8 FUNCTION_LIST KOS IF_DATA DIM_X DIRECT 0x812DE8 /end CHARACTERISTIC
/begin CHARACTERISTIC VKOAO "Obere Geschwindigkeitsschwelle für Kompressorabschaltung" VALUE 0x812DE9 KwUb 318.8 vfzg_ub_q1p25 0.00 318.8 FUNCTION_LIST KOS IF_DATA DIM_X DIRECT 0x812DE9 /end CHARACTERISTIC
/begin CHARACTERISTIC VKOB "Geschwindingkeitsschwelle für Ko-Steuerung in Beschleunigung" VALUE 0x812DEA KwUb 318.8 vfzg_ub_q1p25 0.00 318.8 FUNCTION_LIST KOS IF_DATA DIM_X DIRECT 0x812DEA /end CHARACTERISTIC
/begin CHARACTERISTIC VKSTEBF "Fördervolumen bei Erstbefüllung" VALUE 0x82B044 KwUw 6553.500 vol_q0p1 0.00 6553.500 FUNCTION_LIST AEKP IF_DATA DIM_X DIRECT 0x82B044 /end CHARACTERISTIC
/begin CHARACTERISTIC VKSTPVLAB "Fördervolumen EKP Vorlauf aus Abstellzeit" CURVE 0x82B046 KlAUwSstUwWUw 6553.500 vol_q0p1 0.00 6553.500 FUNCTION_LIST AEKP IF_DATA DIM_X DIRECT 0x82B046
 /begin AXIS_DESCR STD_AXIS tabst_w t1sxs_uw_q1 4 0.00 65535.00 DEPOSIT ABSOLUT /end AXIS_DESCR
/end CHARACTERISTIC
/begin CHARACTERISTIC VKSTPVLNL "Fördervolumen EKP Vorlauf aus Nachlaufzeit" VALUE 0x82B058 KwUw 6553.500 vol_q0p1 0.00 6553.500 FUNCTION_LIST AEKP IF_DATA DIM_X DIRECT 0x82B058 /end CHARACTERISTIC
/begin CHARACTERISTIC VLDPMN "Min. Geschwindigkeit für Grobleckverifikation" VALUE 0x81278E KwUb 318.8 vfzg_ub_q1p25 0.00 318.8 FUNCTION_LIST DLDP IF_DATA DIM_X DIRECT 0x81278E /end CHARACTERISTIC
/begin CHARACTERISTIC VLDPO "Obere vfz-Schwelle für 0.5 mm - Diagnose" VALUE 0x81278F KwUb 318.8 vfzg_ub_q1p25 0.00 318.8 FUNCTION_LIST DLDP IF_DATA DIM_X DIRECT 0x81278F /end CHARACTERISTIC
/begin CHARACTERISTIC VLDPU "Untere vfz-Schwelle für 0.5 mm - Diagnose" VALUE 0x812790 KwUb 318.8 vfzg_ub_q1p25 0.00 318.8 FUNCTION_LIST DLDP IF_DATA DIM_X DIRECT 0x812790 /end CHARACTERISTIC
/begin CHARACTERISTIC VLLR "Fahrzeuggeschwindigkeitsschwelle für Leerlaufregelung" VALUE 0x811CC9 KwUb 318.8 vfzg_ub_q1p25 0.00 318.8 FUNCTION_LIST LLRBB IF_DATA DIM_X DIRECT 0x811CC9 /end CHARACTERISTIC
/begin CHARACTERISTIC VLMXVZ_0_A "Maximalwert für vlast_w" CURVE 0x81CE72 KlAUwSstUwWUw 511.9922 vfzg_uw_q0p0078125 0.00 511.9922 FUNCTION_LIST FGRREGL IF_DATA DIM_X INDIRECT 0x813C12
 /begin AXIS_DESCR STD_AXIS vziel_w vfzg_uw_q0p0078125 6 0.00 511.9922 DEPOSIT ABSOLUT /end AXIS_DESCR
/end CHARACTERISTIC
/begin CHARACTERISTIC VLMXVZ_1_A "Maximalwert für vlast_w" CURVE 0x81CE8C KlAUwSstUwWUw 511.9922 vfzg_uw_q0p0078125 0.00 511.9922 FUNCTION_LIST FGRREGL IF_DATA DIM_X INDIRECT 0x813C16
 /begin AXIS_DESCR STD_AXIS vziel_w vfzg_uw_q0p0078125 6 0.00 511.9922 DEPOSIT ABSOLUT /end AXIS_DESCR
/end CHARACTERISTIC
/begin CHARACTERISTIC VLSD "Mindestgeschwindigkeit für Lastschlagdämpfung" VALUE 0x811F53 KwUb 318.8 vfzg_ub_q1p25 0.00 318.8 FUNCTION_LIST MDFAW IF_DATA DIM_X DIRECT 0x811F53 /end CHARACTERISTIC
/begin CHARACTERISTIC VMAXNB "Maximal zulässige Fahrzeuggeschwindigkeit im Normalbetrieb" VALUE 0x82950E KwUw 511.9922 vfzg_uw_q0p00781 0.00 511.9922 FUNCTION_LIST BGVMAX IF_DATA DIM_X DIRECT 0x82950E /end CHARACTERISTIC
/begin CHARACTERISTIC VMAXTM "Maximalgeschwindigkeit aus Motortemperatur" CURVE 0x829510 KlAUwSstUwWUw 511.9922 vfzg_uw_q0p00781 0.00 511.9922 FUNCTION_LIST BGVMAX IF_DATA DIM_X DIRECT 0x829510
 /begin AXIS_DESCR STD_AXIS tmotrvmx temp_ub_q0p75_o48 5 -48.00000 49103.25 DEPOSIT ABSOLUT /end AXIS_DESCR
/end CHARACTERISTIC
/begin CHARACTERISTIC VMAXTOL "Maximalgeschwindigkeit aus Öltemperatur" CURVE 0x829526 KlAUwSstUwWUw 511.9922 vfzg_uw_q0p00781 0.00 511.9922 FUNCTION_LIST BGVMAX IF_DATA DIM_X DIRECT 0x829526
 /begin AXIS_DESCR STD_AXIS tolc temp_ub_q1_o60 5 -60.00000 65475.00 DEPOSIT ABSOLUT /end AXIS_DESCR
/end CHARACTERISTIC
/begin CHARACTERISTIC VMDUB "Geschwindigkeitsschwelle min. für Batteriespannungs-Diagnose" VALUE 0x81102D KwUb 318.8 vfzg_ub_q1p25 0.00 318.8 FUNCTION_LIST GGUB IF_DATA DIM_X DIRECT 0x81102D /end CHARACTERISTIC
/begin CHARACTERISTIC VMIBGR "v-Schwelle für Freigabe Momentenbegrenzung" VALUE 0x81A446 KwUb 318.8 vfzg_ub_q1p25 0.00 318.8 FUNCTION_LIST MDBGRG IF_DATA DIM_X DIRECT 0x81A446 /end CHARACTERISTIC
/begin CHARACTERISTIC VMINAMSR "Geschwindigkeitschwelle für plausiblen MSR-Eingriff" VALUE 0x813D30 KwUw 324.9950 vfzg_uw_b325 0.00 324.9950 FUNCTION_LIST GGCASR IF_DATA DIM_X DIRECT 0x813D30 /end CHARACTERISTIC
/begin CHARACTERISTIC VMIN_UC "Minimalgeschwindigkeit für FGR-Betrieb im Befehlstest" VALUE 0x817492 KwUw 511.9922 vfzg_uw_q0p00781 0.00 511.9922 FUNCTION_LIST URCFGRC IF_DATA DIM_X DIRECT 0x817492 /end CHARACTERISTIC
/begin CHARACTERISTIC VMIN_UM "Minimalgeschwindigkeit für FGR-Betrieb in der Funktionsüberwachung" VALUE 0x81421F KwUw 511.9922 vfzg_uw_q0p00781 0.00 511.9922 FUNCTION_LIST UFFGRC IF_DATA DIM_X DIRECT 0x81421F /end CHARACTERISTIC
/begin CHARACTERISTIC VNMX "Geschwindigkeits-Schwelle für Aktivierung der erhöhten Drehzahlgrenze" VALUE 0x81215B KwUb 318.8 vfzg_ub_q1p25 0.00 318.8 FUNCTION_LIST NMAXMD IF_DATA DIM_X DIRECT 0x81215B /end CHARACTERISTIC
/begin CHARACTERISTIC VNVKO "Gangerkennungschwelle für KO-Auschalten bei Vollast" VALUE 0x817C00 KwUw 511.9922 qnv_uw_b512 0.00 511.9922 FUNCTION_LIST KOS IF_DATA DIM_X DIRECT 0x817C00 /end CHARACTERISTIC
/begin CHARACTERISTIC VNVKOB "Gangerkennungschwelle für KO-Abschaltung bei Vollast" VALUE 0x817C02 KwUw 511.9922 qnv_uw_b512 0.00 511.9922 FUNCTION_LIST KOS IF_DATA DIM_X DIRECT 0x817C02 /end CHARACTERISTIC
/begin CHARACTERISTIC VREGLMAX "Maximal zulässige Sollgeschwindigkeit für FGR" VALUE 0x81CAA0 KwUw 511.9922 vfzg_uw_q0p0078125 0.00 511.9922 FUNCTION_LIST FGRFULO IF_DATA DIM_X DIRECT 0x81CAA0 /end CHARACTERISTIC
/begin CHARACTERISTIC VREGLMIN "Minimal zulässige Sollgeschwindigkeit für FGR" VALUE 0x81CAA2 KwUw 511.9922 vfzg_uw_q0p0078125 0.00 511.9922 FUNCTION_LIST FGRFULO IF_DATA DIM_X DIRECT 0x81CAA2 /end CHARACTERISTIC
/begin CHARACTERISTIC VSAA "Geschwindigkeitsschwelle für SA-Drehzahlanhebung" VALUE 0x811C9B KwUb 318.8 vfzg_ub_q1p25 0.00 318.8 FUNCTION_LIST BBSAWE IF_DATA DIM_X DIRECT 0x811C9B /end CHARACTERISTIC
/begin CHARACTERISTIC VSL "Fahrzeuggeschwindigkeitsschwelle für Kompensation Servolenkung" VALUE 0x81A07D KwUb 318.8 vfzg_ub_q1p25 0.00 318.8 FUNCTION_LIST LLRNS IF_DATA DIM_X DIRECT 0x81A07D /end CHARACTERISTIC
/begin CHARACTERISTIC VSLDPMN "minimale Fahrzeuggeschwindigkeit DLDP für Übergang in Zustand A_Stop" VALUE 0x812791 KwUb 318.8 vfzg_ub_q1p25 0.00 318.8 FUNCTION_LIST DLDP IF_DATA DIM_X DIRECT 0x812791 /end CHARACTERISTIC
/begin CHARACTERISTIC VSLS "Schwelle Fahrzeuggeschwindigkeit für SLS ein" VALUE 0x81835E KwUb 318.8 vfzg_ub_q1p25 0.00 318.8 FUNCTION_LIST SLS IF_DATA DIM_X DIRECT 0x81835E /end CHARACTERISTIC
/begin CHARACTERISTIC VTUMTA "Schwelle Fahrzeuggeschwindigkeit für Bestimmung Umgebungstemperatur" VALUE 0x819548 KwUb 318.8 vfzg_ub_q1p25 0.00 318.8 FUNCTION_LIST BGTUMG IF_DATA DIM_X DIRECT 0x819548 /end CHARACTERISTIC
/begin CHARACTERISTIC VTUMTAT "Schwelle Fahrzeuggeschwindigkeit für TANS -> Umgebungstemperatur" VALUE 0x818665 KwUb 318.8 vfzg_ub_q1p25 0.00 318.8 FUNCTION_LIST ATM IF_DATA DIM_X DIRECT 0x818665 /end CHARACTERISTIC
/begin CHARACTERISTIC VVR_AOG "oberer Grenzwert Anpassung V-Verriegelung" VALUE 0x811C8A KwSb 255.0 vfzg_q1p0 -128.0 127.0 FUNCTION_LIST TKMWL KRACT IF_DATA DIM_X DIRECT 0x811C8A /end CHARACTERISTIC
/begin CHARACTERISTIC VVR_AUG "unterer Grenzwert Anpassung V-Verriegelung" VALUE 0x811C8B KwSb 255.0 vfzg_q1p0 -128.0 127.0 FUNCTION_LIST TKMWL KRACT IF_DATA DIM_X DIRECT 0x811C8B /end CHARACTERISTIC
/begin CHARACTERISTIC VWE "Gezwindigkeitsschwelle für Drehzahlgradient nwe Kuppl. offen" VALUE 0x811C9C KwUb 318.8 vfzg_ub_q1p25 0.00 318.8 FUNCTION_LIST BBSAWE IF_DATA DIM_X DIRECT 0x811C9C /end CHARACTERISTIC
/begin CHARACTERISTIC VWPMBBR "Mindestgeschwindigkeit für Pedalwertbegrenzung bei betätigter Bremse" VALUE 0x811057 KwUb 318.8 vfzg_ub_q1p25 0.00 318.8 FUNCTION_LIST GGPED IF_DATA DIM_X DIRECT 0x811057 /end CHARACTERISTIC
/begin CHARACTERISTIC WAD0T1 "Wichtungsfaktor Adaptionsbereich 0 zu 1" VALUE 0x81164A KwUb 15.94 fak_ub_b16 0.00 15.94 FUNCTION_LIST STADAP IF_DATA DIM_X DIRECT 0x81164A /end CHARACTERISTIC
/begin CHARACTERISTIC WAD0T2 "Wichtungsfaktor Adaptionsbereich 0 zu 2" VALUE 0x81164B KwUb 15.94 fak_ub_b16 0.00 15.94 FUNCTION_LIST STADAP IF_DATA DIM_X DIRECT 0x81164B /end CHARACTERISTIC
/begin CHARACTERISTIC WAD1T0 "Wichtungsfaktor Adaptionsbereich 1 zu 0" VALUE 0x81164C KwUb 15.94 fak_ub_b16 0.00 15.94 FUNCTION_LIST STADAP IF_DATA DIM_X DIRECT 0x81164C /end CHARACTERISTIC
/begin CHARACTERISTIC WAD1T2 "Wichtungsfaktor Adaptionsbereich 1 zu 2" VALUE 0x81164D KwUb 15.94 fak_ub_b16 0.00 15.94 FUNCTION_LIST STADAP IF_DATA DIM_X DIRECT 0x81164D /end CHARACTERISTIC
/begin CHARACTERISTIC WAD2T0 "Wichtungsfaktor Adaptionsbereich 2 zu 0" VALUE 0x81164E KwUb 15.94 fak_ub_b16 0.00 15.94 FUNCTION_LIST STADAP IF_DATA DIM_X DIRECT 0x81164E /end CHARACTERISTIC
/begin CHARACTERISTIC WAD2T1 "Wichtungsfaktor Adaptionsbereich 2 zu 1" VALUE 0x81164F KwUb 15.94 fak_ub_b16 0.00 15.94 FUNCTION_LIST STADAP IF_DATA DIM_X DIRECT 0x81164F /end CHARACTERISTIC
/begin CHARACTERISTIC WAIT_T_UM "Wartezeit für Reset-Tastverhältnis aus der Funktionsüberwachung" VALUE 0x814219 KwUw 8332.629 t_wdt_high 0.00 8332.629 FUNCTION_LIST UFURAM URDELAY IF_DATA DIM_X DIRECT 0x814219 /end CHARACTERISTIC
/begin CHARACTERISTIC WDKARN "DK-Winkel-Schwelle für Gemischadaption aktiv" CURVE 0x81930D KlAUbSstUbWUb 100.0 relDK_ub_b100 0.00 100.0 FUNCTION_LIST LRAEB IF_DATA DIM_X DIRECT 0x81930D /begin AXIS_DESCR STD_AXIS nmot nmot_ub_q40 10 0.00 10200. DEPOSIT ABSOLUT /end AXIS_DESCR /end CHARACTERISTIC
/begin CHARACTERISTIC WDKDSVLU "Drosselklappenschwelle für Drucksensorplausibilisierung" CURVE 0x8188A2 KlAUbSstUbWUb 100.0 relDK_ub_b100 0.00 100.0 FUNCTION_LIST GGDSAS IF_DATA DIM_X DIRECT 0x8188A2 /begin AXIS_DESCR STD_AXIS nmot nmot_ub_q40 6 0.00 10200. DEPOSIT ABSOLUT /end AXIS_DESCR /end CHARACTERISTIC
/begin CHARACTERISTIC WDKPMXN "Maximaler Drosselklappenwinkel für Plausibilisierung mit Füllungssignal" CURVE 0x811124 KlAUbSstUbWUb 100.0 relDK_ub_b100 0.00 100.0 FUNCTION_LIST GGDVE IF_DATA DIM_X DIRECT 0x811124 /begin AXIS_DESCR STD_AXIS nmot nmot_ub_q40 12 0.00 10200. DEPOSIT ABSOLUT /end AXIS_DESCR /end CHARACTERISTIC
/begin CHARACTERISTIC WDKREIB "Haftreibungsanteil der DK für I-Klein" VALUE 0x811205 KwUb 0.9961 fak_ub_b1 0.00 0.9961 FUNCTION_LIST ADVE IF_DATA DIM_X DIRECT 0x811205 /end CHARACTERISTIC
/begin CHARACTERISTIC WDKSNLN "Sollwinkel für Drosselklappe bei Kl15 aus" CURVE 0x81DCBA KlAUbSstUbWUb 100.0 relDK_ub_b100 0.00 100.0 FUNCTION_LIST WDKSOM IF_DATA DIM_X DIRECT 0x81DCBA /begin AXIS_DESCR STD_AXIS nmot nmot_ub_q40 8 0.00 10200. DEPOSIT ABSOLUT /end AXIS_DESCR /end CHARACTERISTIC
/begin CHARACTERISTIC WDKUGDN "KL Drosselklappenwinkel, ab der keine Drosselung mehr erfolgt" CURVE 0x815896 GklWUw 99.99847 rel_uw_b100 0.00 99.99847 FUNCTION_LIST BGMSZS IF_DATA DIM_X DIRECT 0x815896
 /begin AXIS_DESCR COM_AXIS nmot nmot_ub_q40 12 0.00 10200. AXIS_PTS_REF SNM12FEUB /end AXIS_DESCR
/end CHARACTERISTIC
/begin CHARACTERISTIC WDZWOBT "Wichtung DZWOB über evtmod" CURVE 0x81A90D KlAUbSstUbWUb 1.992 fak_ub_b2 0.00 1.992 FUNCTION_LIST ZWOB IF_DATA DIM_X DIRECT 0x81A90D
 /begin AXIS_DESCR STD_AXIS evtmod temp_ub_q0p75_o48 4 -48.00 143.3 DEPOSIT ABSOLUT /end AXIS_DESCR
/end CHARACTERISTIC
/begin CHARACTERISTIC WEAN "Winkel Einspritzabbruch" CURVE 0x81900B GklWUb 1530. zw_ub_q6 0.00 1530. FUNCTION_LIST ESVW IF_DATA DIM_X DIRECT 0x81900B
 /begin AXIS_DESCR COM_AXIS nmot nmot_ub_q40 8 0.00 10200. AXIS_PTS_REF SNM08GKUB /end AXIS_DESCR
/end CHARACTERISTIC
/begin CHARACTERISTIC WEEMRFAN "Winkel Einspritzende bei maximalem Fahrerwunsch" CURVE 0x819013 GklWUb 1530. zw_ub_q6 0.00 1530. FUNCTION_LIST ESVW IF_DATA DIM_X DIRECT 0x819013
 /begin AXIS_DESCR COM_AXIS nmot nmot_ub_q40 8 0.00 10200. AXIS_PTS_REF SNM08GKUB /end AXIS_DESCR
/end CHARACTERISTIC
/begin CHARACTERISTIC WEESTN_0_A "Winkel Einspritzende im Start" CURVE 0x8115FC KlAUbSstUbWUb 1530. zw_ub_q6 0.00 1530. FUNCTION_LIST ESVW IF_DATA DIM_X INDIRECT 0x813FE2 /begin AXIS_DESCR STD_AXIS nmot nmot_ub_q40 4 0.00 10200. DEPOSIT ABSOLUT /end AXIS_DESCR /end CHARACTERISTIC
/begin CHARACTERISTIC WEESTN_1_A "Winkel Einspritzende im Start" CURVE 0x811605 KlAUbSstUbWUb 1530. zw_ub_q6 0.00 1530. FUNCTION_LIST ESVW IF_DATA DIM_X INDIRECT 0x813FE4 /begin AXIS_DESCR STD_AXIS nmot nmot_ub_q40 4 0.00 10200. DEPOSIT ABSOLUT /end AXIS_DESCR /end CHARACTERISTIC
/begin CHARACTERISTIC WEESTSM "Winkelgrenze Einspritzende für sim. Startauslösungen f(TMOT)" CURVE 0x8187D2 KlAUbSstUbWUb 717.2 kw_q2p8125 0.00 717.2 FUNCTION_LIST ACIFI IF_DATA DIM_X DIRECT 0x8187D2
 /begin AXIS_DESCR STD_AXIS tmot temp_ub_q0p75_o48 6 -48.00 143.3 DEPOSIT ABSOLUT /end AXIS_DESCR
/end CHARACTERISTIC
/begin CHARACTERISTIC WESSOT "Winkel Einlass schliesst spät bis OT" VALUE 0x810004 KwUb 717.2 kw_q2p8125 0.00 717.2 FUNCTION_LIST PROKON IF_DATA DIM_X DIRECT 0x810004 /end CHARACTERISTIC
/begin CHARACTERISTIC WESSTO "Offsetwinkel Einspritzung für Schnellstart" VALUE 0x81120F KwUb 717.2 kw_q2p8125 0.00 717.2 FUNCTION_LIST ACIFI IF_DATA DIM_X DIRECT 0x81120F /end CHARACTERISTIC
/begin CHARACTERISTIC WFAN "Schwellwert für Fahrpedalwinkel bei Bandendetest" VALUE 0x81A23E KwUb 100.0 relPED_ub_b100 0.00 100.0 FUNCTION_LIST LLRNFA IF_DATA DIM_X DIRECT 0x81A23E /end CHARACTERISTIC
/begin CHARACTERISTIC WFRL "Kraftstoffwandfilmkennlinie" CURVE 0x815F12 FklWUw 6143.906 rel_uw_b6144 0.00 6143.906 FUNCTION_LIST ESUK IF_DATA DIM_X DIRECT 0x815F12
 /begin AXIS_DESCR FIX_AXIS rlp_w rel_uw_q0p0234 31 0.00 185.9766 FIX_AXIS_PAR 0 8 31 /end AXIS_DESCR
/end CHARACTERISTIC
/begin CHARACTERISTIC WHLSUKOR "Korrekturwert für die  LSU-Heizleistung" VALUE 0x81A493 KwUb 1.992 fak_ub_b2 0.00 1.992 FUNCTION_LIST HLSU IF_DATA DIM_X DIRECT 0x81A493 /end CHARACTERISTIC
/begin CHARACTERISTIC WIMAX "ObererSchranke interne Reglerzustände stetige Lambdaregelung" VALUE 0x8174CA KwSw 7.999878 fak_sw_b4 -4.000000 3.999878 FUNCTION_LIST LRS IF_DATA DIM_X DIRECT 0x8174CA /end CHARACTERISTIC
/begin CHARACTERISTIC WIMIN "Untere Schranke interne Reglerzustaende stetige Lambdaregelung" VALUE 0x8174CC KwSw 7.999878 fak_sw_b4 -4.000000 3.999878 FUNCTION_LIST LRS IF_DATA DIM_X DIRECT 0x8174CC /end CHARACTERISTIC
/begin CHARACTERISTIC WKRLZOF "Festwerteblock: ZW-Offset für geführte Zylinder" VAL_BLK 0x811C2E KwbUb 191.3 zw_ub_qn0p75 -191.3 0.00 NUMBER 8 FUNCTION_LIST KRRA IF_DATA DIM_X DIRECT 0x811C2E /end CHARACTERISTIC
/begin CHARACTERISTIC WKRLZOFEKS "ZW-Offset für geführte Zylinder bei KS-Fehler" VALUE 0x811C36 KwUb 191.3 zw_ub_qn0p75 -191.3 0.00 FUNCTION_LIST KRRA IF_DATA DIM_X DIRECT 0x811C36 /end CHARACTERISTIC
/begin CHARACTERISTIC WKVGDSLL "Drosselklappenschwelle für DSU/DSL Plausibilitätscheck nach Start" VALUE 0x8188AF KwUb 100.0 relDK_ub_b100 0.00 100.0 FUNCTION_LIST GGDSAS IF_DATA DIM_X DIRECT 0x8188AF /end CHARACTERISTIC
/begin CHARACTERISTIC WMABGKH "Faktor für Wärmemengenkorrektur bei Katheizen für Taupunktende" VALUE 0x818666 KwUb 1.000 fak_ub_b2 0.00 1.000 FUNCTION_LIST ATM IF_DATA DIM_X DIRECT 0x818666 /end CHARACTERISTIC
/begin CHARACTERISTIC WMKATKH "Faktor für Wärmemengenkorrektur bei Katheizen für Taupunktende hinter Kat" VALUE 0x818667 KwUb 1.000 fak_ub_b2 0.00 1.000 FUNCTION_LIST ATM IF_DATA DIM_X DIRECT 0x818667 /end CHARACTERISTIC
/begin CHARACTERISTIC WNWAFMX "Begrenzung Adaption Spätanschlag nach 'früh'" VALUE 0x810FAE KwSb 128.0 kw_q1 -128.0 0.00 FUNCTION_LIST GGNW IF_DATA DIM_X DIRECT 0x810FAE /end CHARACTERISTIC
/begin CHARACTERISTIC WNWAMAX "maximaler Auslaßnockenwellensollwinkel" VALUE 0x8182E4 KwUb 127.5 kw_ub_q0p5 0.00 127.5 FUNCTION_LIST SWADP IF_DATA DIM_X DIRECT 0x8182E4 /end CHARACTERISTIC
/begin CHARACTERISTIC WNWASMX "Obere Begrenzung Adaption NW-Spätanschlag (Richtung spät)" VALUE 0x810FAF KwSb 127.0 kw_q1 0.00 127.0 FUNCTION_LIST GGNW IF_DATA DIM_X DIRECT 0x810FAF /end CHARACTERISTIC
/begin CHARACTERISTIC WNWBKVE "Winkel NW-Position  mit min. Überschneidung Einlaßnockenwelle bei BKV leer" VALUE 0x82A584 KwSw 511.9922 kw_sw_q0p0078 -256.0000 255.9922 FUNCTION_LIST NWSOLLE IF_DATA DIM_X DIRECT 0x82A584 /end CHARACTERISTIC
/begin CHARACTERISTIC WNWDSHKE "Deltasollwinkel Nockenwelle Korrektur Katheizen über Höhe Einlaß" CURVE 0x82A586 KlAUwSstUwWSw 511.9922 kw_sw_q0p0078 -256.0000 255.9922 FUNCTION_LIST NWSOLLE IF_DATA DIM_X DIRECT 0x82A586 /begin AXIS_DESCR STD_AXIS fho_w fak_uw_b4 4 0.00 3.999939 DEPOSIT ABSOLUT /end AXIS_DESCR /end CHARACTERISTIC
/begin CHARACTERISTIC WNWEMAX "maximaler Nockenwellensollwinkel Einlaß" VALUE 0x8182E5 KwUb 127.5 kw_ub_q0p5 0.00 127.5 FUNCTION_LIST SWADP DNWSEIN IF_DATA DIM_X DIRECT 0x8182E5 /end CHARACTERISTIC
/begin CHARACTERISTIC WNWREO "Winkel Einlassventil öffnet in Referenzposition bezogen auf Ladungswechsel(LWOT)" VALUE 0x82A598 KwSw 511.9922 kw_sw_q0p0078 -256.0000 255.9922 FUNCTION_LIST NWSOLLE BGARNW GGNW NWEVO NWWUE IF_DATA DIM_X DIRECT 0x82A598 /end CHARACTERISTIC
/begin CHARACTERISTIC WNWRPS "Sollwinkel der Phasengeberflanken in Referenzposition, Nockenwelle 1" VAL_BLK 0x813FD2 KwbUw 1023.984 kw_q0p0156 0.00 1023.984 NUMBER 4 FUNCTION_LIST GGNW DNWKW IF_DATA DIM_X DIRECT 0x813FD2 /end CHARACTERISTIC
/begin CHARACTERISTIC WNWSAMXE "Maxwert zur Berechnung der Sollwertänderungsbegrenzung Einlass Nockenwelle" VALUE 0x82A59A KwUw 255.9961 kw_q0p0039 0.00 255.9961 FUNCTION_LIST NWSOLLE IF_DATA DIM_X DIRECT 0x82A59A /end CHARACTERISTIC
/begin CHARACTERISTIC WNWSEAPP "Applikationswert für den Einlaß-Nockenwellensollwinkel" VALUE 0x82A59C KwSw 511.9922 kw_sw_q0p0078 -256.0000 255.9922 FUNCTION_LIST NWSOLLE IF_DATA DIM_X DIRECT 0x82A59C /end CHARACTERISTIC
/begin CHARACTERISTIC WNWSMNA "Minimal zulässiger Sollwert für Nockenwellenverstellung Auslass schliesst (LWOT)" VALUE 0x829E22 KwSw 511.9922 kw_sw_q0p0078 -256.0000 255.9922 FUNCTION_LIST NWWUE IF_DATA DIM_X DIRECT 0x829E22 /end CHARACTERISTIC
/begin CHARACTERISTIC WNWSMNE "Minimal zulässiger Sollwert für Nockenwellenverstellung Einlass öffnet (LWOT)" VALUE 0x82A59E KwSw 511.9922 kw_sw_q0p0078 -256.0000 255.9922 FUNCTION_LIST NWSOLLE IF_DATA DIM_X DIRECT 0x82A59E /end CHARACTERISTIC
/begin CHARACTERISTIC WNWSMXA "Maximal zulässiger Sollwert für Nockenwellenverstellung Auslass schliesst (LWOT)" VALUE 0x829E24 KwSw 511.9922 kw_sw_q0p0078 -256.0000 255.9922 FUNCTION_LIST NWWUE IF_DATA DIM_X DIRECT 0x829E24 /end CHARACTERISTIC
/begin CHARACTERISTIC WNWSMXE "Maximal zulässiger Sollwert für Nockenwellenverstellung Einlass öffnet (LWOT)" VALUE 0x82A5A0 KwSw 511.9922 kw_sw_q0p0078 -256.0000 255.9922 FUNCTION_LIST NWSOLLE IF_DATA DIM_X DIRECT 0x82A5A0 /end CHARACTERISTIC
/begin CHARACTERISTIC WNWSTE "Sollwinkel für Einlaßnockenwellenposition während Start" CURVE 0x82A5A2 KlAUbSstSwWSw 511.9922 kw_sw_q0p0078 -256.0000 255.9922 FUNCTION_LIST NWSOLLE IF_DATA DIM_X DIRECT 0x82A5A2
 /begin AXIS_DESCR STD_AXIS tmot temp_ub_q0p75_o48 4 -24624.00 24527.25 DEPOSIT ABSOLUT /end AXIS_DESCR
/end CHARACTERISTIC
/begin CHARACTERISTIC WNWSWOFE "Sollwinkel für Einlaßnockenwellenposition bei S_KL15 = aus" CURVE 0x82A5B4 KlAUbSstSwWSw 511.9922 kw_sw_q0p0078 -256.0000 255.9922 FUNCTION_LIST NWSOLLE IF_DATA DIM_X DIRECT 0x82A5B4
 /begin AXIS_DESCR STD_AXIS tumg temp_ub_q0p75_o48 4 -24624.00 24527.25 DEPOSIT ABSOLUT /end AXIS_DESCR
/end CHARACTERISTIC
/begin CHARACTERISTIC WPEDKO "Pedalwinkelschwelle für KO-Ausschaltung" CURVE 0x812DEB GklWUb 99.61 rel_ub_b100 0.00 99.61 FUNCTION_LIST KOS IF_DATA DIM_X DIRECT 0x812DEB
 /begin AXIS_DESCR COM_AXIS nmot nmot_ub_q40 8 0.00 10200. AXIS_PTS_REF SNM08KOUB /end AXIS_DESCR
/end CHARACTERISTIC
/begin CHARACTERISTIC WPEDU "Untere Schwelle Pedalwert für Antiruckelfunktion" VALUE 0x8167B6 KwUw 100.0000 relPED_uw_b100 0.00 100.0000 FUNCTION_LIST ARMD IF_DATA DIM_X DIRECT 0x8167B6 /end CHARACTERISTIC
/begin CHARACTERISTIC WPFGRBMR "Rückgerechneter Pedalwert beim Beschleunigen mit FGR" CURVE 0x81D092 KlAUwSstUwWUw 99.99847 rel_uw_b100 0.00 99.99847 FUNCTION_LIST BGWPFGR IF_DATA DIM_X DIRECT 0x81D092
 /begin AXIS_DESCR STD_AXIS mrfgr_w rel_uw_b200 16 0.00 199.9969 DEPOSIT ABSOLUT /end AXIS_DESCR
/end CHARACTERISTIC
/begin CHARACTERISTIC WPHN "Phasengang" CURVE 0x81A905 GklWSb 191.3 zw_sb_q0p75 -96.00 95.25 FUNCTION_LIST ZUE IF_DATA DIM_X DIRECT 0x81A905
 /begin AXIS_DESCR COM_AXIS nmot nmot_ub_q40 8 0.00 10200. AXIS_PTS_REF SNM08__UB /end AXIS_DESCR
/end CHARACTERISTIC
/begin CHARACTERISTIC WPMXNOT "Maximal zulässiger Fahrpedalwert im PWG-Notfahren" VALUE 0x811058 KwUb 100.0 relPED_ub_b100 0.00 100.0 FUNCTION_LIST GGPED IF_DATA DIM_X DIRECT 0x811058 /end CHARACTERISTIC
/begin CHARACTERISTIC WPRMBVH "Pedalwertgrenze zur Rücknahme der Mißbrauchsverhinderung" VALUE 0x818734 KwUb 100.0 relPED_ub_b100 0.00 100.0 FUNCTION_LIST GGPED IF_DATA DIM_X DIRECT 0x818734 /end CHARACTERISTIC
/begin CHARACTERISTIC WPRMX "maximaler Prädiktionswinkel" VALUE 0x811504 KwUb 1530. kw_q6 0.00 1530. FUNCTION_LIST BGRLP IF_DATA DIM_X DIRECT 0x811504 /end CHARACTERISTIC
/begin CHARACTERISTIC WZLDPD "Max. Anzahl Wiederholversuche bei 1mm-Dichtprüfung" VALUE 0x812792 KwUb 255.0 dez 0.00 255.0 FUNCTION_LIST DLDP IF_DATA DIM_X DIRECT 0x812792 /end CHARACTERISTIC
/begin CHARACTERISTIC WZLDPGS "Max. Anzahl Wiederholversuche nach Unterbrechung insgesamt" VALUE 0x812793 KwUb 255.0 dez 0.00 255.0 FUNCTION_LIST DLDP IF_DATA DIM_X DIRECT 0x812793 /end CHARACTERISTIC
/begin CHARACTERISTIC WZLDPMX "Max. Anzahl Wiederholversuche nach Unterbrechung bei erkanntem Leck" VALUE 0x812794 KwUb 255.0 dez 0.00 255.0 FUNCTION_LIST DLDP IF_DATA DIM_X DIRECT 0x812794 /end CHARACTERISTIC
/begin CHARACTERISTIC WZLDPRO "Max. Anzahl Wiederholversuche Reed-Switch Close to Open Check" VALUE 0x812795 KwUb 255.0 dez 0.00 255.0 FUNCTION_LIST DLDP IF_DATA DIM_X DIRECT 0x812795 /end CHARACTERISTIC
/begin CHARACTERISTIC XIMAX "ObererSchranke interne Reglerzustände stetige Lambdaregelung" VALUE 0x8174CE KwSw 1.999969 fak_sw_b1 -1.000000 0.9999695 FUNCTION_LIST LRS IF_DATA DIM_X DIRECT 0x8174CE /end CHARACTERISTIC
/begin CHARACTERISTIC XIMIN "Untere [Bhranke interne Reglerzustaende stetige Lambdaregelung" VALUE 0x8174D0 KwSw 1.999969 fak_sw_b1 -1.000000 0.9999695 FUNCTION_LIST LRS IF_DATA DIM_X DIRECT 0x8174D0 /end CHARACTERISTIC
/begin CHARACTERISTIC Y2MAX "Obere Schranke Integralanteil LRS" VALUE 0x8174D2 KwSw 1.999969 fak_sw_b1 -1.000000 0.9999695 FUNCTION_LIST LRS IF_DATA DIM_X DIRECT 0x8174D2 /end CHARACTERISTIC
/begin CHARACTERISTIC ZASMASK "Zylinderabschaltmaske für CIFI aus ZAS" VALUE 0x810224 KwUb 255.0 dez 0.00 255.0 FUNCTION_LIST DMDFON IF_DATA DIM_X DIRECT 0x810224 /end CHARACTERISTIC
/begin CHARACTERISTIC ZBAKM "Abregelfaktor K-Speicher (tmot) BA" CURVE 0x81951C GklWUb 0.9961 fak_q0p0039 0.00 0.9961 FUNCTION_LIST ESUK IF_DATA DIM_X DIRECT 0x81951C
 /begin AXIS_DESCR COM_AXIS tmot temp_ub_q0p75_o48 9 -48.00 143.3 AXIS_PTS_REF STM09ESUB /end AXIS_DESCR
/end CHARACTERISTIC
/begin CHARACTERISTIC ZBALM "Abregelfaktor L-Speicher (tmot) BA" CURVE 0x819525 GklWUb 0.1245 fak_ub_b0p125 0.00 0.1245 FUNCTION_LIST ESUK IF_DATA DIM_X DIRECT 0x819525
 /begin AXIS_DESCR COM_AXIS tmot temp_ub_q0p75_o48 9 -48.00 143.3 AXIS_PTS_REF STM09ESUB /end AXIS_DESCR
/end CHARACTERISTIC
/begin CHARACTERISTIC ZBRT "Zeitkonstante für Brennraumtempmodell" VALUE 0x81D6F4 KwUw 6553.4999985 zk100msxs_uw_b6553 0.10000152590 6553.6000000 FUNCTION_LIST BGTEMPK IF_DATA DIM_X DIRECT 0x81D6F4 /end CHARACTERISTIC
/begin CHARACTERISTIC ZBTEML "Integrationsgeschwindigkeit Beladungsfaktor" CURVE 0x81A6A9 GklWUb 6.101 perio_ub_b6p125 0.00 6.101 FUNCTION_LIST TEB IF_DATA DIM_X DIRECT 0x81A6A9 /begin AXIS_DESCR COM_AXIS ml m_ub_b1020 6 0.00 1020. AXIS_PTS_REF SML06TEUB /end AXIS_DESCR /end CHARACTERISTIC
/begin CHARACTERISTIC ZBURNABR "Verbrennungsanzahl für Entscheidung Adaptionsabbruch" VALUE 0x811650 KwUb 255.0 dez 0.00 255.0 FUNCTION_LIST STADAP IF_DATA DIM_X DIRECT 0x811650 /end CHARACTERISTIC
/begin CHARACTERISTIC ZBURNDEC "Zu überschreitende Verbrennungsanzahl für ""Abmagern""" VALUE 0x811651 KwUb 255.0 dez 0.00 255.0 FUNCTION_LIST STADAP IF_DATA DIM_X DIRECT 0x811651 /end CHARACTERISTIC
/begin CHARACTERISTIC ZBURNLIM "Schwelle erkannte Verbrennungen für Wiederholstart" VALUE 0x811BC6 KwUb 255.0 dez 0.00 255.0 FUNCTION_LIST ESSTT IF_DATA DIM_X DIRECT 0x811BC6 /end CHARACTERISTIC
/begin CHARACTERISTIC ZBURNSOL "Erforderliche Verbrennungsanzahl für ""keine Anreicherung""" VALUE 0x811652 KwUb 255.0 dez 0.00 255.0 FUNCTION_LIST STADAP IF_DATA DIM_X DIRECT 0x811652 /end CHARACTERISTIC
/begin CHARACTERISTIC ZBWF "Zählerstand für Fehlereintrag Bewegungserkennung" VALUE 0x811059 KwUb 255.0 dez 0.00 255.0 FUNCTION_LIST GGPED IF_DATA DIM_X DIRECT 0x811059 /end CHARACTERISTIC
/begin CHARACTERISTIC ZCANAIR "Zähler für Codierfehlererkennung der Airbagbotschaft" VALUE 0x810190 KwUb 5.100 t20msxs_ub_b5p1 0.00 5.100 FUNCTION_LIST CAN IF_DATA DIM_X DIRECT 0x810190 /end CHARACTERISTIC
/begin CHARACTERISTIC ZDBTMN "Zeitkonstante Dynamikanteil Brennraumtemperaturmodell für negative Gradienten" CURVE 0x81D6F6 KlAUwSstUwWUw 6553.4999985 zk100msxs_uw_b6553 0.10000152590 6553.6000000 FUNCTION_LIST BGTEMPK IF_DATA DIM_X DIRECT 0x81D6F6
 /begin AXIS_DESCR STD_AXIS nmot_w nmot_uw_q0p25 8 0.00 16383.75 DEPOSIT ABSOLUT /end AXIS_DESCR
/end CHARACTERISTIC
/begin CHARACTERISTIC ZDBTMP "Zeitkonstante Dynamikanteil Brennraumtemperaturmodell für positive Gradienten" CURVE 0x81D718 KlAUwSstUwWUw 6553.4999985 zk100msxs_uw_b6553 0.10000152590 6553.6000000 FUNCTION_LIST BGTEMPK IF_DATA DIM_X DIRECT 0x81D718
 /begin AXIS_DESCR STD_AXIS nmot_w nmot_uw_q0p25 8 0.00 16383.75 DEPOSIT ABSOLUT /end AXIS_DESCR
/end CHARACTERISTIC
/begin CHARACTERISTIC ZDELBMSRCH "Zusätzlicher Zahnoffset beim Warten auf BM im Schnellstart" VALUE 0x810FC8 KwUb 6.000 dez 0.00 6.000 FUNCTION_LIST GGDPG IF_DATA DIM_X DIRECT 0x810FC8 /end CHARACTERISTIC
/begin CHARACTERISTIC ZDFFDTE "Zeitkonstante für Hochpassfilter des Genaratorsignals" VALUE 0x829D30 KwUw 6553.4999985 zk100msxs_uw_b6553 0.10000152590 6553.6000000 FUNCTION_LIST DTEV IF_DATA DIM_X DIRECT 0x829D30 /end CHARACTERISTIC
/begin CHARACTERISTIC ZDGZA1 "Zündungszahl Abregelung Bereich 1" VALUE 0x8114EC KwUb 255.0 dez 0.00 255.0 FUNCTION_LIST ESNSWL IF_DATA DIM_X DIRECT 0x8114EC /end CHARACTERISTIC
/begin CHARACTERISTIC ZDGZA3 "Zündungszahl Abregelung Bereich 3" VALUE 0x8114EE KwUb 255.0 dez 0.00 255.0 FUNCTION_LIST ESNSWL IF_DATA DIM_X DIRECT 0x8114EE /end CHARACTERISTIC
/begin CHARACTERISTIC ZDLBTS "Zeitkonstante Delta Lambda Bauteileschutz" VALUE 0x81E5DA KwUw 6553.4999985 zk100msxs_uw_b6553 0.10000152590 6553.6000000 FUNCTION_LIST LAMBTS IF_DATA DIM_X DIRECT 0x81E5DA /end CHARACTERISTIC
/begin CHARACTERISTIC ZDRLKRA "Zeitkonstante für Tiefpass Lastgradient in KR" VALUE 0x816112 KwUw 2.5499998474 zk10msxs_uw_b655 0.010000152590 2.5600000000 FUNCTION_LIST KRDY IF_DATA DIM_X DIRECT 0x816112 /end CHARACTERISTIC
/begin CHARACTERISTIC ZDSLAMX "Maximale Anzahl Wiederholungen aktive Zusatzdiagnose (Phasen 4+5)" VALUE 0x81839A KwUb 255.0 dez 0.00 255.0 FUNCTION_LIST DSLSLRS IF_DATA DIM_X DIRECT 0x81839A /end CHARACTERISTIC
/begin CHARACTERISTIC ZDSU "Zeitkonstante für Filterung von pu und fho in GGDSU" VALUE 0x8188B0 KwUb 25.4996 zk100msxs_ub_b25p5 0.100392 25.6000 FUNCTION_LIST GGDSAS IF_DATA DIM_X DIRECT 0x8188B0 /end CHARACTERISTIC
/begin CHARACTERISTIC ZDYNFA "Zählerwert für Dynamikmessung LSU bei Kurztest" VALUE 0x8186FF KwUb 255.0 dez 0.00 255.0 FUNCTION_LIST DLSU IF_DATA DIM_X DIRECT 0x8186FF /end CHARACTERISTIC
/begin CHARACTERISTIC ZDYNLSU "Zählerwert für Dynamikmessung LSU" VALUE 0x818700 KwUb 255.0 dez 0.00 255.0 FUNCTION_LIST DLSU IF_DATA DIM_X DIRECT 0x818700 /end CHARACTERISTIC
/begin CHARACTERISTIC ZEHK "Fehlerzähler für Heizerkopplung auf das Lambdasignal" VALUE 0x818701 KwUb 255.0 dez 0.00 255.0 FUNCTION_LIST DLSU IF_DATA DIM_X DIRECT 0x818701 /end CHARACTERISTIC
/begin CHARACTERISTIC ZERBR "Fehlerzähler für Bremsschalter-Unplausibilitäten" VALUE 0x81873E KwUb 255.0 dez 0.00 255.0 FUNCTION_LIST GGEGAS IF_DATA DIM_X DIRECT 0x81873E /end CHARACTERISTIC
/begin CHARACTERISTIC ZETATE "Rampensteilheit für Veränderung Motorwirkungsgrad durch Tankentlüftung" VALUE 0x829CC2 KwUw 1279.590 rgrad_uw_b1280 0.3906250 1279.980 FUNCTION_LIST TEB IF_DATA DIM_X DIRECT 0x829CC2 /end CHARACTERISTIC
/begin CHARACTERISTIC ZFLAGS_D_UC "" VAL_BLK 0x8124C4 KwbUb 255.0 dez 0.00 255.0 NUMBER 16 FUNCTION_LIST URCEIN IF_DATA DIM_X DIRECT 0x8124C4 /end CHARACTERISTIC
/begin CHARACTERISTIC ZFLASKH "Zeitkonstante für Übergang auf Lambda-Abgas-Vorgabe" VALUE 0x819894 KwUb 25.4996 zk100msxs_ub_b25p5 0.100392 25.6000 FUNCTION_LIST LAKH IF_DATA DIM_X DIRECT 0x819894 /end CHARACTERISTIC
/begin CHARACTERISTIC ZFLLRPL "Zeitkonstante: Aufregeln des P-Anteils auf dem Luftpfad" VALUE 0x811DAB KwUb 5.08000 zk20msxs_ub_b5p1 0.0200000 5.10000 FUNCTION_LIST LLRRM IF_DATA DIM_X DIRECT 0x811DAB /end CHARACTERISTIC
/begin CHARACTERISTIC ZFLMSSL "Zeitkonstante Gemischanteil Sekundärluft" VALUE 0x81835F KwUb 25.4996 zk100msxs_ub_b25p5 0.100392 25.6000 FUNCTION_LIST SLS IF_DATA DIM_X DIRECT 0x81835F /end CHARACTERISTIC
/begin CHARACTERISTIC ZFMDVERL "Zeitkonstante für Filterung Verlustmoment" VALUE 0x81214A KwUb 2.53000 zk20msxs_ub_b5p1 0.0200000 2.55000 FUNCTION_LIST MDVER IF_DATA DIM_X DIRECT 0x81214A /end CHARACTERISTIC
/begin CHARACTERISTIC ZFRMST "Zeitkonstante für frm-Filter (short test)" VALUE 0x819557 KwUb 50.8000 zk200msxs_ub_b51p2 0.200000 51.0000 FUNCTION_LIST DKVS IF_DATA DIM_X DIRECT 0x819557 /end CHARACTERISTIC
/begin CHARACTERISTIC ZFRMXAF "Filterzeitkonstante für frmxa_w Signal" VALUE 0x829D34 KwUw 6553.4999985 zk100msxs_uw_b6553 0.10000152590 6553.6000000 FUNCTION_LIST DTEV IF_DATA DIM_X DIRECT 0x829D34 /end CHARACTERISTIC
/begin CHARACTERISTIC ZFTANS "Zeitkonstante Tiefpaßfilter Ansauglufttemperatur" VALUE 0x81E630 KwUw 6553.4999985 zk100msxs_uw_b6553 0.10000152590 6553.6000000 FUNCTION_LIST GGTFA IF_DATA DIM_X DIRECT 0x81E630 /end CHARACTERISTIC
/begin CHARACTERISTIC ZGRDPSSF "Zeitkonstante für Filter pssol-Gradient" VALUE 0x811324 KwUb 2.54000 zk10msxs_ub_b2p55 0.0100000 2.55000 FUNCTION_LIST BGMSZS IF_DATA DIM_X DIRECT 0x811324 /end CHARACTERISTIC
/begin CHARACTERISTIC ZKBKVAB "Zeitkonstante Absteuerung Momentenreserve Katheizen für BKV" VALUE 0x81987D KwUb 25.4996 zk100msxs_ub_b25p5 0.100392 25.6000 FUNCTION_LIST KHMD IF_DATA DIM_X DIRECT 0x81987D /end CHARACTERISTIC
/begin CHARACTERISTIC ZKDXLDPE "Einschaltzeit(konstante) für Max-Fehler-Prüfung (KS_UB) LDP-Endst.-Diagnose" VALUE 0x8187EA KwUb 25.50 t100msxs_ub_b25p5 0.00 25.50 FUNCTION_LIST DLDPE IF_DATA DIM_X DIRECT 0x8187EA /end CHARACTERISTIC
/begin CHARACTERISTIC ZKETR "Zeitkonstante I-Regler Thermostatregelung" VALUE 0x81AFA2 KwUb 254.996 zk1sxs_ub_b255 1.00392 256.000 FUNCTION_LIST KMTR IF_DATA DIM_X DIRECT 0x81AFA2 /end CHARACTERISTIC
/begin CHARACTERISTIC ZKFRAOA "Zeitkonstante für frao-Integrator, f(Anzahl Starts mit Ölverdünnung)" CURVE 0x81E046 KlAUwSstUwWUw 4.999924 zk200msxs_uw_b5 0.00 4.999924 FUNCTION_LIST LRA IF_DATA DIM_X DIRECT 0x81E046 /begin AXIS_DESCR STD_AXIS abo dez 3 0.00 65535.00 DEPOSIT ABSOLUT /end AXIS_DESCR /end CHARACTERISTIC
/begin CHARACTERISTIC ZKFRAUA "Zeitkonstante für frau-Integrator, f(Anzahl Stats mit Ölverdünnung)" CURVE 0x81E054 KlAUwSstUwWUw 4.999924 zk200msxs_uw_b5 0.00 4.999924 FUNCTION_LIST LRA IF_DATA DIM_X DIRECT 0x81E054 /begin AXIS_DESCR STD_AXIS abo dez 3 0.00 65535.00 DEPOSIT ABSOLUT /end AXIS_DESCR /end CHARACTERISTIC
/begin CHARACTERISTIC ZKFRMSLS "Zeitkonstante für Filterung des frm in der Diagnose SLS" VALUE 0x81839B KwUb 25.4996 zk100msxs_ub_b25p5 0.100392 25.6000 FUNCTION_LIST DSLSLRS IF_DATA DIM_X DIRECT 0x81839B /end CHARACTERISTIC
/begin CHARACTERISTIC ZKFTEAD "Zeitkonstante gefilteter Faktor Beladung Spülstrom bei Tankentlüftung" VALUE 0x829CC4 KwUw 6553.4999985 zk100msxs_uw_b6553 0.10000152590 6553.6000000 FUNCTION_LIST TEB IF_DATA DIM_X DIRECT 0x829CC4 /end CHARACTERISTIC
/begin CHARACTERISTIC ZKFUB "Filterzeitkonstante für Batteriespannung" VALUE 0x818708 KwUb 50.8000 zk200msxs_ub_b51p2 0.200000 51.0000 FUNCTION_LIST BGLBZ IF_DATA DIM_X DIRECT 0x818708 /end CHARACTERISTIC
/begin CHARACTERISTIC ZKGAFRANM "Zeitkonstante für Mittelwertsbildung von dgafra" CURVE 0x81D750 KlAUwSstUwWUw 65534.000000 zk1sxs_uw_b65535 1.0000000000 65535.000000 FUNCTION_LIST DEGFE IF_DATA DIM_X DIRECT 0x81D750
 /begin AXIS_DESCR STD_AXIS pspvds_w fak_uw_b2 8 0.00 1.999969 DEPOSIT ABSOLUT /end AXIS_DESCR
/end CHARACTERISTIC
/begin CHARACTERISTIC ZKLAMFAW "Zeitkonstante Filterung Anfettung durch Fahrerwunsch" VALUE 0x81E424 KwUw 3276.7499992 zk50msxs_uw_b3276p8 0.050000762951 3276.8000000 FUNCTION_LIST LAMFAW IF_DATA DIM_X DIRECT 0x81E424 /end CHARACTERISTIC
/begin CHARACTERISTIC ZKLAMKH "Zeitkonstante Lambda-Motor-Soll bei Katheizen" VALUE 0x816070 KwUw 655.34999985 zk10msxs_uw_b655 0.010000152590 655.36000000 FUNCTION_LIST BBKHZ IF_DATA DIM_X DIRECT 0x816070 /end CHARACTERISTIC
/begin CHARACTERISTIC ZKLLRD "Zeitkonstante für die Abregelung des D-Anteils" VALUE 0x811DAC KwUb 5.08000 zk20msxs_ub_b5p1 0.0200000 5.10000 FUNCTION_LIST LLRRM IF_DATA DIM_X DIRECT 0x811DAC /end CHARACTERISTIC
/begin CHARACTERISTIC ZKMDGEN "Zeitkonstante Generator-Lastabregelung" VALUE 0x81A221 KwUb 5.09992 zk20msxs_ub_b5p12 0.0200784 5.12000 FUNCTION_LIST MDVERB IF_DATA DIM_X DIRECT 0x81A221 /end CHARACTERISTIC
/begin CHARACTERISTIC ZKMDKH "Filterzeitkonstante bei Wechsel von Teillast nach LL und umgekehrt" VALUE 0x81987E KwUb 25.4996 zk100msxs_ub_b25p5 0.100392 25.6000 FUNCTION_LIST KHMD IF_DATA DIM_X DIRECT 0x81987E /end CHARACTERISTIC
/begin CHARACTERISTIC ZKMDSLP "Zeitkonstante zur Abregelung des Einschaltmomentes der Sek-Luftpumpe" VALUE 0x81A225 KwUb 5.09992 zk20msxs_ub_b5p12 0.0200784 5.12000 FUNCTION_LIST MDVERB IF_DATA DIM_X DIRECT 0x81A225 /end CHARACTERISTIC
/begin CHARACTERISTIC ZKMDWF "Zeitkonstante für Filterung Wandlermoment zur Bildung D-Anteil" VALUE 0x811E4D KwUb 5.08000 zk20msxs_ub_b5p1 0.0200000 5.10000 FUNCTION_LIST MDWAN IF_DATA DIM_X DIRECT 0x811E4D /end CHARACTERISTIC
/begin CHARACTERISTIC ZKNLST "Filterzeitkonstante Nachlaufzeitberechnung" VALUE 0x81AFA3 KwUb 254.996 zk1sxs_ub_b255 1.00392 256.000 FUNCTION_LIST KMTR IF_DATA DIM_X DIRECT 0x81AFA3 /end CHARACTERISTIC
/begin CHARACTERISTIC ZKPVDKT "Zeitkonstante für langsame Massenstromadaption" CURVE 0x81D5DE KlAUwSstUwWUw 65534.000000 zk1sxs_uw_b65535 1.0000000000 65535.000000 FUNCTION_LIST BGMSZS IF_DATA DIM_X DIRECT 0x81D5DE
 /begin AXIS_DESCR STD_AXIS pspvds_w fak_uw_b2 8 0.00 1.999969 DEPOSIT ABSOLUT /end AXIS_DESCR
/end CHARACTERISTIC
/begin CHARACTERISTIC ZKQMAXL1 "Zeitkonstante für Rampenabsteuerung Lüfter 1 im Nachlauf" VALUE 0x81AFA4 KwUb 254.996 zk1sxs_ub_b255 1.00392 256.000 FUNCTION_LIST KMTR IF_DATA DIM_X DIRECT 0x81AFA4 /end CHARACTERISTIC
/begin CHARACTERISTIC ZKQMAXL2 "Zeitkonstante für Rampenabsteuerung Lüfter 2 im Nachlauf" VALUE 0x81AFA5 KwUb 254.996 zk1sxs_ub_b255 1.00392 256.000 FUNCTION_LIST KMTR IF_DATA DIM_X DIRECT 0x81AFA5 /end CHARACTERISTIC
/begin CHARACTERISTIC ZKRKATA "Integrationsgeschwindigkeit Integrator rkat, f(abo)" CURVE 0x81E062 KlAUwSstUwWUw 959.9854 zk200msxs_uw_b960 0.00 959.9854 FUNCTION_LIST LRA IF_DATA DIM_X DIRECT 0x81E062 /begin AXIS_DESCR STD_AXIS abo dez 3 0.00 65535.00 DEPOSIT ABSOLUT /end AXIS_DESCR /end CHARACTERISTIC
/begin CHARACTERISTIC ZKRKAZA "Integrationsgeschwindigkeit Integrator rkaz, f(abo)" CURVE 0x81E070 KlAUwSstUwWUw 959.9854 zk200msxs_uw_b960 0.00 959.9854 FUNCTION_LIST LRA IF_DATA DIM_X DIRECT 0x81E070 /begin AXIS_DESCR STD_AXIS abo dez 3 0.00 65535.00 DEPOSIT ABSOLUT /end AXIS_DESCR /end CHARACTERISTIC
/begin CHARACTERISTIC ZKSLPOFF "Zeitkonstante Runterlauf Sekundärluftgebläse" VALUE 0x818360 KwUb 25.4996 zk100msxs_ub_b25p5 0.100392 25.6000 FUNCTION_LIST SLS IF_DATA DIM_X DIRECT 0x818360 /end CHARACTERISTIC
/begin CHARACTERISTIC ZKSLPON "Zeitkonstante Hochlauf Sekundärluftgebläse" VALUE 0x818361 KwUb 25.4996 zk100msxs_ub_b25p5 0.100392 25.6000 FUNCTION_LIST SLS IF_DATA DIM_X DIRECT 0x818361 /end CHARACTERISTIC
/begin CHARACTERISTIC ZKSLSOFML "Zeitkonstante Ausräumen der Sekundärluft nach Ventil schließen" CURVE 0x81B1E0 KlAUwSstUwWUw 6553.4999985 zk100msxs_uw_b6553 0.10000152590 6553.6000000 FUNCTION_LIST SLS IF_DATA DIM_X DIRECT 0x81B1E0 /begin AXIS_DESCR STD_AXIS ml_w m_uw_b6553p5 4 0.00 6553.500 DEPOSIT ABSOLUT /end AXIS_DESCR /end CHARACTERISTIC
/begin CHARACTERISTIC ZKSLSONML "Zeitkonstante Einbringen der Sekundärluft nach Ventil öffnen" CURVE 0x81B1F2 KlAUwSstUwWUw 6553.4999985 zk100msxs_uw_b6553 0.10000152590 6553.6000000 FUNCTION_LIST SLS IF_DATA DIM_X DIRECT 0x81B1F2 /begin AXIS_DESCR STD_AXIS ml_w m_uw_b6553p5 4 0.00 6553.500 DEPOSIT ABSOLUT /end AXIS_DESCR /end CHARACTERISTIC
/begin CHARACTERISTIC ZKTABTU "Zeitkonstante für Motorabkühlung" CURVE 0x81E4B4 KlAUbSstUbWUw 65535.00 t1sxs_uw_b65535 0.00 65535.00 FUNCTION_LIST BGTABST IF_DATA DIM_X DIRECT 0x81E4B4
 /begin AXIS_DESCR STD_AXIS tumg temp_ub_q0p75_o48 4 -48.00 143.3 DEPOSIT ABSOLUT /end AXIS_DESCR
/end CHARACTERISTIC
/begin CHARACTERISTIC ZKTDML "Tiefpaß-Filterzeitkonstante für Luftmasse" VALUE 0x81C71C KwUw 3276.7499992 zk50msxs_uw_b12p8 0.050000762951 3276.8000000 FUNCTION_LIST DKATSPEB IF_DATA DIM_X DIRECT 0x81C71C /end CHARACTERISTIC
/begin CHARACTERISTIC ZKTDTK "Tiefpaß-Filterzeitkonstante für Temperatur-Filterung" VALUE 0x8186EF KwUb 50.7992 zk200msxs_ub_b51p2 0.200787 51.0000 FUNCTION_LIST DKATSPEB IF_DATA DIM_X DIRECT 0x8186EF /end CHARACTERISTIC
/begin CHARACTERISTIC ZKTMSN "Filterzeitkonstante Soll-Motortemperatur bei neg. Gradient" VALUE 0x81AFA6 KwUb 254.996 zk1sxs_ub_b255 1.00392 256.000 FUNCTION_LIST KMTR IF_DATA DIM_X DIRECT 0x81AFA6 /end CHARACTERISTIC
/begin CHARACTERISTIC ZKTMSP "Filterzeitkonstante Soll-Motortemperatur bei pos. Gradient" VALUE 0x81AFA7 KwUb 254.996 zk1sxs_ub_b255 1.00392 256.000 FUNCTION_LIST KMTR IF_DATA DIM_X DIRECT 0x81AFA7 /end CHARACTERISTIC
/begin CHARACTERISTIC ZKUBDLR "DLR, Zeitkonstante für Filterung von Ubatt" VALUE 0x81873C KwUb 0.4980 fak_ub_b0p5 0.00 0.4980 FUNCTION_LIST ADVE IF_DATA DIM_X DIRECT 0x81873C /end CHARACTERISTIC
/begin CHARACTERISTIC ZKUEVERG "Filterzeitkonstante: Turbinendrehzahl bei Gangwechsel" VALUE 0x811E4E KwUb 5.08000 zk20msxs_ub_b5p1 0.0200000 5.10000 FUNCTION_LIST MDWAN IF_DATA DIM_X DIRECT 0x811E4E /end CHARACTERISTIC
/begin CHARACTERISTIC ZKWDKSPT1 "Zeitkonstante für Prädiktion DK-Winkel aus Sollwert" VALUE 0x811206 KwUb 0.6973 fak_q0p00273 0.00 0.6973 FUNCTION_LIST ADVE IF_DATA DIM_X DIRECT 0x811206 /end CHARACTERISTIC
/begin CHARACTERISTIC ZKWLAFWL "Zeitkonstante Wichtung Offset Lambda-Motor-Soll" VALUE 0x819309 KwUb 25.4996 zk100msxs_ub_b25p5 0.100392 25.6000 FUNCTION_LIST LAMFAW IF_DATA DIM_X DIRECT 0x819309 /end CHARACTERISTIC
/begin CHARACTERISTIC ZLASHKAB "Zeitkonstante für Abregelung der dyn. Sollwertanhebung (dlasohkab) rin der LRHK" VALUE 0x817582 KwUw 655.34999985 zk10msxs_uw_b655 0.010000152590 655.36000000 FUNCTION_LIST LRSHK IF_DATA DIM_X DIRECT 0x817582 /end CHARACTERISTIC
/begin CHARACTERISTIC ZLASOHML "Zeitkonstante für PT1-Filter des Pseudo-Lambda hinter Kat" CURVE 0x817584 KlAUwSstUwWUw 655.34999985 zk10msxs_uw_b655 0.010000152590 655.36000000 FUNCTION_LIST LRSHK IF_DATA DIM_X DIRECT 0x817584 /begin AXIS_DESCR STD_AXIS ml_w m_uw_b6553p5 8 0.00 6553.500 DEPOSIT ABSOLUT /end AXIS_DESCR /end CHARACTERISTIC
/begin CHARACTERISTIC ZLBTS "Zeitkonstante Lambda Bauteileschutz" VALUE 0x81E5DC KwUw 6553.4999985 zk100msxs_uw_b6553 0.10000152590 6553.6000000 FUNCTION_LIST LAMBTS IF_DATA DIM_X DIRECT 0x81E5DC /end CHARACTERISTIC
/begin CHARACTERISTIC ZLBTSNEG "Zeitkonstante Lambda Bauteileschutz (abgesteuert)" VALUE 0x81E5DE KwUw 6553.4999985 zk100msxs_uw_b6553 0.10000152590 6553.6000000 FUNCTION_LIST LAMBTS IF_DATA DIM_X DIRECT 0x81E5DE /end CHARACTERISTIC
/begin CHARACTERISTIC ZLIBG "Filterzeitkonstante für die Nachführung der Integratorgrenzen" VALUE 0x811DAD KwUb 5.08000 zk20msxs_ub_b5p1 0.0200000 5.10000 FUNCTION_LIST LLRRM IF_DATA DIM_X DIRECT 0x811DAD /end CHARACTERISTIC
/begin CHARACTERISTIC ZMDDLWS "Zeitkonstant für Lenkhilfelastmoment" VALUE 0x81A226 KwUb 5.09992 zk20msxs_ub_b5p12 0.0200784 5.12000 FUNCTION_LIST MDVERB IF_DATA DIM_X DIRECT 0x81A226 /end CHARACTERISTIC
/begin CHARACTERISTIC ZMDNSM "Zeitkonstante zur Abrgelung des Nachstart-Momentenoffset" CURVE 0x8294D2 KlAUbSstUbWUw 3276.7499992 zk50msxs_uw_b3276p8 0.050000762951 3276.8000000 FUNCTION_LIST MDVER IF_DATA DIM_X DIRECT 0x8294D2
 /begin AXIS_DESCR STD_AXIS tmot temp_ub_q0p75_o48 8 -48.00 143.3 DEPOSIT ABSOLUT /end AXIS_DESCR
/end CHARACTERISTIC
/begin CHARACTERISTIC ZMLETAN "Zeitkonstante für Filterung zur Berechnung des Leerlaufenergiebedarf für DTEV" VALUE 0x829D38 KwUw 9.9054946573 zk100msxs_uw_b6553 0.10000152590 10.005496183 FUNCTION_LIST DTEV IF_DATA DIM_X DIRECT 0x829D38 /end CHARACTERISTIC
/begin CHARACTERISTIC ZMLRO "Zeitkonstante mlroh-Tiefpaß bei Diagnose HFM/HLM" VALUE 0x811319 KwUb 2.54000 zk10msxs_ub_b2p55 0.0100000 2.55000 FUNCTION_LIST DHFM IF_DATA DIM_X DIRECT 0x811319 /end CHARACTERISTIC
/begin CHARACTERISTIC ZMLTE "Zeitkonstante für ml-Filter in beladungsabh. Tankentlüftung" VALUE 0x829CC6 KwUw 6553.4999985 zk100msxs_uw_b655 0.10000152590 6553.6000000 FUNCTION_LIST TEB IF_DATA DIM_X DIRECT 0x829CC6 /end CHARACTERISTIC
/begin CHARACTERISTIC ZMRFABN "berechnet aktuelle Zeitkonstante des Tiefpaß (Dauerhochlast) mrfabnf_w" CURVE 0x81E35C KlAUwSstSwWUw 6553.4999985 zk100msxs_uw_b6553 0.10000152590 6553.6000000 FUNCTION_LIST BBTEGA IF_DATA DIM_X DIRECT 0x81E35C
 /begin AXIS_DESCR STD_AXIS dmrfabn_w rel_sw_b100 5 -100.0000 99.99695 DEPOSIT ABSOLUT /end AXIS_DESCR
/end CHARACTERISTIC
/begin CHARACTERISTIC ZMSSGIN "Filterzeitkonstante für Berechnung der relativen Änderung von mssgin_w" VALUE 0x81A6AF KwUb 25.4996 zk100msxs_ub_b25p5 0.100392 25.6000 FUNCTION_LIST TEB IF_DATA DIM_X DIRECT 0x81A6AF /end CHARACTERISTIC
/begin CHARACTERISTIC ZNFNGLL "Filterzeitkonstante für Drehzahlgradient auf Luftpfad (LLR)" VALUE 0x811DAE KwUb 5.08000 zk20msxs_ub_b5p1 0.0200000 5.10000 FUNCTION_LIST LLRRM IF_DATA DIM_X DIRECT 0x811DAE /end CHARACTERISTIC
/begin CHARACTERISTIC ZNGFIL "Zeitkonstante für Drehzahlgradient-Filter" VALUE 0x813FC8 KwUw 655.34999985 zk10msxs_uw_b655 0.010000152590 655.36000000 FUNCTION_LIST BGNG IF_DATA DIM_X DIRECT 0x813FC8 /end CHARACTERISTIC
/begin CHARACTERISTIC ZNGKRA "Zeitkonstante für Tiefpaß Drehzahlgradient" VALUE 0x816114 KwUw 2.5499998474 zk10msxs_uw_b655 0.010000152590 2.5600000000 FUNCTION_LIST KRDY IF_DATA DIM_X DIRECT 0x816114 /end CHARACTERISTIC
/begin CHARACTERISTIC ZNSUB "Zeitkonstante für Mindestsolldrehzahl bei Unterspannung" VALUE 0x81A07E KwUb 50.8000 zk200msxs_ub_b51p2 0.200000 51.0000 FUNCTION_LIST LLRNS IF_DATA DIM_X DIRECT 0x81A07E /end CHARACTERISTIC
/begin CHARACTERISTIC ZNWSP "Zeitkonstante für Adaption-Spätanschlagposition" VALUE 0x810FB0 KwUb 99.61 rel_ub_b99p6 0.00 99.61 FUNCTION_LIST GGNW IF_DATA DIM_X DIRECT 0x810FB0 /end CHARACTERISTIC
/begin CHARACTERISTIC ZPHFLBM1 "Nockenwellenflanken Nr. vor Bezugsmarke 1" VALUE 0x810FB1 KwSb 255.0 dez -128.0 127.0 FUNCTION_LIST GGNW IF_DATA DIM_X DIRECT 0x810FB1 /end CHARACTERISTIC
/begin CHARACTERISTIC ZPPWMX "Reset-Schwelle für Fehleraktualisierung aus Periodencheck" VALUE 0x81AC0A KwUb 255.0 dez 0.00 255.0 FUNCTION_LIST GGHLA IF_DATA DIM_X DIRECT 0x81AC0A /end CHARACTERISTIC
/begin CHARACTERISTIC ZPWMCS "Anzahl Crash-Impulse bis Crash erkannt" VALUE 0x81AFDE KwUb 255.0 DEZ 0.00 255.0 FUNCTION_LIST GGCS IF_DATA DIM_X DIRECT 0x81AFDE /end CHARACTERISTIC
/begin CHARACTERISTIC ZPWMCSMAX "Entprellzähler für Diagnose Crash-Signal" VALUE 0x81AFDF KwUb 255.0 DEZ 0.00 255.0 FUNCTION_LIST GGCS IF_DATA DIM_X DIRECT 0x81AFDF /end CHARACTERISTIC
/begin CHARACTERISTIC ZPWMDMN "Plaus.-Schwelle-Min für Dekodierung" VALUE 0x81AC0B KwUb 255.0 dez 0.00 255.0 FUNCTION_LIST GGHLA IF_DATA DIM_X DIRECT 0x81AC0B /end CHARACTERISTIC
/begin CHARACTERISTIC ZPWMDMX "Plaus.-Schwelle-Max für Dekodierung" VALUE 0x81AC0C KwUb 255.0 dez 0.00 255.0 FUNCTION_LIST GGHLA IF_DATA DIM_X DIRECT 0x81AC0C /end CHARACTERISTIC
/begin CHARACTERISTIC ZPWMPMN "Plaus.-Schwelle-Min für Periodenmessung" VALUE 0x81AC0D KwUb 255.0 dez 0.00 255.0 FUNCTION_LIST GGHLA IF_DATA DIM_X DIRECT 0x81AC0D /end CHARACTERISTIC
/begin CHARACTERISTIC ZPWMPMX "Plaus.-Schwelle-Max für Periodenmessung" VALUE 0x81AC0E KwUb 255.0 dez 0.00 255.0 FUNCTION_LIST GGHLA IF_DATA DIM_X DIRECT 0x81AC0E /end CHARACTERISTIC
/begin CHARACTERISTIC ZRFKMSDK "Zeitkonstante Reset Massenstromabgleich fkmsdk" VALUE 0x811325 KwUb 2.54000 zk10msxs_ub_b2p55 0.0100000 2.55000 FUNCTION_LIST BGMSZS IF_DATA DIM_X DIRECT 0x811325 /end CHARACTERISTIC
/begin CHARACTERISTIC ZRLBAB "Zeitkonstante RL-Tiefpaß bei Bergaberkennung" VALUE 0x829DC0 KwUw 6553.4999985 zk100msxs_uw_b6553 0.10000152590 6553.6000000 FUNCTION_LIST DLDP IF_DATA DIM_X DIRECT 0x829DC0 /end CHARACTERISTIC
/begin CHARACTERISTIC ZRLFRAT "Filterzeitkonstante für die Berechnung der Zeitkonstante der FRAT-Adaption" VALUE 0x819067 KwUb 3.72308 zk200msxs_ub_b51p2 0.200000 3.92308 FUNCTION_LIST LRA IF_DATA DIM_X DIRECT 0x819067 /end CHARACTERISTIC
/begin CHARACTERISTIC ZRLTEDTE "Zeitkonstante für Filterung der berechneten Füllung TEV" VALUE 0x829D3C KwUw 6553.4999985 zk100msxs_uw_b6553 0.10000152590 6553.6000000 FUNCTION_LIST DTEV IF_DATA DIM_X DIRECT 0x829D3C /end CHARACTERISTIC
/begin CHARACTERISTIC ZSYNABR "Zündungsanzahl für Entscheidung Adaptionsabbruch" VALUE 0x811653 KwUb 255.0 dez 0.00 255.0 FUNCTION_LIST STADAP IF_DATA DIM_X DIRECT 0x811653 /end CHARACTERISTIC
/begin CHARACTERISTIC ZSYNAUSW "Anzahl Zündungen (Synchros) bis Auswerten" VALUE 0x811654 KwUb 255.0 dez 0.00 255.0 FUNCTION_LIST STADAP IF_DATA DIM_X DIRECT 0x811654 /end CHARACTERISTIC
/begin CHARACTERISTIC ZSYNDEL "Anzahl ausgeblendete Verbrennungen für Verbrennungserkennung" VALUE 0x811655 KwUb 255.0 dez 0.00 255.0 FUNCTION_LIST STADAP IF_DATA DIM_X DIRECT 0x811655 /end CHARACTERISTIC
/begin CHARACTERISTIC ZTDAGR "Zeitkonstante Temperaturdynamik bei AGR Auf- Abschaltung" VALUE 0x81D73A KwUw 6553.4999985 zk100msxs_uw_b6553 0.10000152590 6553.6000000 FUNCTION_LIST BGTEMPK IF_DATA DIM_X DIRECT 0x81D73A /end CHARACTERISTIC
/begin CHARACTERISTIC ZTMMBR "Zeitkonstante Motortemperatur für Brennraumtempmodell" VALUE 0x81D73C KwUw 6553.4999985 zk100msxs_uw_b6553 0.10000152590 6553.6000000 FUNCTION_LIST BGTEMPK IF_DATA DIM_X DIRECT 0x81D73C /end CHARACTERISTIC
/begin CHARACTERISTIC ZTOELKBI "Zeitkonstante für nmot-Filter" VALUE 0x813CEC KwUw 655.3500 t10msxs_uw_b655p35 0.00 655.3500 FUNCTION_LIST CAN IF_DATA DIM_X DIRECT 0x813CEC /end CHARACTERISTIC
/begin CHARACTERISTIC ZTPREL "Anzahl Zähne während der Starterkennung" VALUE 0x810FC9 KwUb 255.0 dez 0.00 255.0 FUNCTION_LIST GGDPG IF_DATA DIM_X DIRECT 0x810FC9 /end CHARACTERISTIC
/begin CHARACTERISTIC ZTSPEV "Zeitkonstante zur Bildung der Spulentemperatur eines Einspritzventils" VALUE 0x81DFA2 KwUw 6553.4999985 zk100msxs_uw_b6553 0.10000152590 6553.6000000 FUNCTION_LIST RKTI IF_DATA DIM_X DIRECT 0x81DFA2 /end CHARACTERISTIC
/begin CHARACTERISTIC ZUKNST "Abregelzeitkonstante ÜK-Faktor im Nachstart" VALUE 0x815F52 KwUw 6553.4999985 zk100msxs_uw_b6553 0.10000152590 6553.6000000 FUNCTION_LIST ESUK IF_DATA DIM_X DIRECT 0x815F52 /end CHARACTERISTIC
/begin CHARACTERISTIC ZVAKM "Abregelfaktor K-Speicher (tmot) VA" CURVE 0x81952E GklWUb 0.9961 fak_q0p0039 0.00 0.9961 FUNCTION_LIST ESUK IF_DATA DIM_X DIRECT 0x81952E
 /begin AXIS_DESCR COM_AXIS tmot temp_ub_q0p75_o48 9 -48.00 143.3 AXIS_PTS_REF STM09ESUB /end AXIS_DESCR
/end CHARACTERISTIC
/begin CHARACTERISTIC ZVALM "Abregelfaktor L-Speicher (tmot) VA" CURVE 0x819537 GklWUb 0.1245 fak_ub_b0p125 0.00 0.1245 FUNCTION_LIST ESUK IF_DATA DIM_X DIRECT 0x819537
 /begin AXIS_DESCR COM_AXIS tmot temp_ub_q0p75_o48 9 -48.00 143.3 AXIS_PTS_REF STM09ESUB /end AXIS_DESCR
/end CHARACTERISTIC
/begin CHARACTERISTIC ZVSKS "Zeitkonstante Tiefpaßfilter für Kraftstoffverbrauch" VALUE 0x81AFA8 KwUb 254.996 zk1sxs_ub_b255 1.00392 256.000 FUNCTION_LIST KMTR IF_DATA DIM_X DIRECT 0x81AFA8 /end CHARACTERISTIC
/begin CHARACTERISTIC ZVTPRGSU "Zeitkonstante Tiefpaßfilterung bei Saugrohrklappendynamik" VALUE 0x81131A KwUb 12.7498039 zk50msxs_ub_b12p8 0.0501960784 12.8000000 FUNCTION_LIST BGSRM IF_DATA DIM_X DIRECT 0x81131A /end CHARACTERISTIC
/begin CHARACTERISTIC ZWAPPL "Applikationsschnittstelle Zündwinkelverstellung" VALUE 0x8127A9 KwSb 191.3 zw_sb_q0p75 -96.00 95.25 FUNCTION_LIST ZUE IF_DATA DIM_X DIRECT 0x8127A9 /end CHARACTERISTIC
/begin CHARACTERISTIC ZWC_T_UM "Fehlertoleranzzeit der Zündwinkelüberwachung in der Funktionsüberw." VALUE 0x814011 KwUb 255.0 dez 0.00 255.0 FUNCTION_LIST UFZWC IF_DATA DIM_X DIRECT 0x814011 /end CHARACTERISTIC
/begin CHARACTERISTIC ZWFUBAMN "Endwinkel der Mehrfachfunkenzündung, falls konfiguriert" VALUE 0x81005A KwUb 90.00 zw_TR2OT_teeth_sy -30.00 60.00 FUNCTION_LIST AZUE IF_DATA DIM_X DIRECT 0x81005A /end CHARACTERISTIC
/begin CHARACTERISTIC ZWOUT_DAT_UC "" VAL_BLK 0x8124D4 KwbUb 191.3 zw_sb_q0p75 0.00 191.3 NUMBER 16 FUNCTION_LIST URCEIN IF_DATA DIM_X DIRECT 0x8124D4 /end CHARACTERISTIC
/begin CHARACTERISTIC ZWSPTIP "Zeit für Freischalten des TIPIN-Offsets auf den spätesten Zündwinkel" VALUE 0x817B88 KwUw 655.3500 t10msxs_uw_b655p35 0.00 655.3500 FUNCTION_LIST ZWMIN IF_DATA DIM_X DIRECT 0x817B88 /end CHARACTERISTIC
/begin CHARACTERISTIC ZYLANZ_UM "Zylinderzahl für die Zündwinkelüberwachung in der Funktionsüberw." VALUE 0x814012 KwUb 255.0 dez 0.00 255.0 FUNCTION_LIST UFZWC IF_DATA DIM_X DIRECT 0x814012 /end CHARACTERISTIC
/begin CHARACTERISTIC ZYLEAUS "auszublendender Zylinder" VALUE 0x810FC1 KwUb 255.0 dez 0.00 255.0 FUNCTION_LIST NLPH IF_DATA DIM_X DIRECT 0x810FC1 /end CHARACTERISTIC
/begin CHARACTERISTIC ZYLKOR "Wert zur Zylinderkorrektur (tsroh zu zzyldmd)" VALUE 0x810055 KwUb 3.000 dez 0.00 3.000 FUNCTION_LIST DMDTSB IF_DATA DIM_X DIRECT 0x810055 /end CHARACTERISTIC
/begin CHARACTERISTIC ZYRKR "Zylinderzuordnung für maximale Referenzpegelbegrenzung Klopfregelung" VALUE 0x819A9A KwUb 255.0 dez 0.00 255.0 FUNCTION_LIST KRKE IF_DATA DIM_X DIRECT 0x819A9A /end CHARACTERISTIC
/begin CHARACTERISTIC ZZWEETM "Umschaltschwelle Vorlagerungswinkel" CURVE 0x81DFF4 KlAUwSstUwWUw 65535.00 dez 0.00 65535.00 FUNCTION_LIST ESVW IF_DATA DIM_X DIRECT 0x81DFF4
 /begin AXIS_DESCR STD_AXIS tmst temp_ub_q0p75_o48 8 -48.00000 49103.25 DEPOSIT ABSOLUT /end AXIS_DESCR
/end CHARACTERISTIC
/begin COMPU_METHOD DEZ "1 : 1 Umrechnug (dez/hex)" RAT_FUNC "%6.2" "" COEFFS 0 1 0 0 0 1 /end COMPU_METHOD
/begin COMPU_METHOD dez "1 : 1 Umrechnug (dez/hex)" RAT_FUNC "%6.2" "" COEFFS 0 1 0 0 0 1 /end COMPU_METHOD
/begin COMPU_METHOD fak_q0p00273 "" RAT_FUNC "%6.4" "-" COEFFS 0 256 0 0 0 0.7 /end COMPU_METHOD
/begin COMPU_METHOD fak_q0p0039 "" RAT_FUNC "%6.4" "-" COEFFS 0 256 0 0 0 1 /end COMPU_METHOD
/begin COMPU_METHOD fak_q0p1 "" RAT_FUNC "%6.3" "" COEFFS 0 1 0 0 0 0.1 /end COMPU_METHOD
/begin COMPU_METHOD fak_sw_b1 "" RAT_FUNC "%7.6" "-" COEFFS 0 65536 0 0 0 2 /end COMPU_METHOD
/begin COMPU_METHOD fak_sw_b4 "" RAT_FUNC "%6.5" "-" COEFFS 0 65536 0 0 0 8 /end COMPU_METHOD
/begin COMPU_METHOD fak_ub_b0p125 "" RAT_FUNC "%6.5" "-" COEFFS 0 256 0 0 0 0.125 /end COMPU_METHOD
/begin COMPU_METHOD fak_ub_b0p5 "" RAT_FUNC "%6.4" "-" COEFFS 0 256 0 0 0 0.5 /end COMPU_METHOD
/begin COMPU_METHOD fak_ub_b1 "" RAT_FUNC "%6.4" "-" COEFFS 0 256 0 0 0 1 /end COMPU_METHOD
/begin COMPU_METHOD fak_ub_b16 "" RAT_FUNC "%6.4" "-" COEFFS 0 256 0 0 0 16 /end COMPU_METHOD
/begin COMPU_METHOD fak_ub_b2 "" RAT_FUNC "%6.4" "-" COEFFS 0 256 0 0 0 2 /end COMPU_METHOD
/begin COMPU_METHOD fak_ub_b318p75 "" RAT_FUNC "%6.2" "-" COEFFS 0 256 0 0 0 318.75 /end COMPU_METHOD
/begin COMPU_METHOD fak_ub_b32 "" RAT_FUNC "%6.3" "-" COEFFS 0 256 0 0 0 32 /end COMPU_METHOD
/begin COMPU_METHOD fak_uw_b2 "" RAT_FUNC "%7.6" "-" COEFFS 0 65536 0 0 0 2 /end COMPU_METHOD
/begin COMPU_METHOD fak_uw_b4 "" RAT_FUNC "%7.6" "-" COEFFS 0 65536 0 0 0 4 /end COMPU_METHOD
/begin COMPU_METHOD kw_q0p0039 "" RAT_FUNC "%6.4" "°KW" COEFFS 0 256 0 0 0 1 /end COMPU_METHOD
/begin COMPU_METHOD kw_q0p0156 "" RAT_FUNC "%6.4" "°KW" COEFFS 0 64 0 0 0 1 /end COMPU_METHOD
/begin COMPU_METHOD kw_q1 "" RAT_FUNC "%6.2" "°KW" COEFFS 0 1 0 0 0 1 /end COMPU_METHOD
/begin COMPU_METHOD kw_q2p8125 "" RAT_FUNC "%6.2" "°KW" COEFFS 0 1 0 0 0 2.8125 /end COMPU_METHOD
/begin COMPU_METHOD kw_q6 "" RAT_FUNC "%6.2" "°KW" COEFFS 0 1 0 0 0 6 /end COMPU_METHOD
/begin COMPU_METHOD kw_sw_q0p0078 "" RAT_FUNC "%6.4" "°KW" COEFFS 0 128 0 0 0 1 /end COMPU_METHOD
/begin COMPU_METHOD kw_ub_q0p5 "" RAT_FUNC "%6.3" "°KW" COEFFS 0 256 0 0 0 128 /end COMPU_METHOD
/begin COMPU_METHOD m_ub_b1020 "" RAT_FUNC "%6.2" "kg/h" COEFFS 0 1 0 0 0 4 /end COMPU_METHOD
/begin COMPU_METHOD m_uw_b6553p5 "" RAT_FUNC "%6.3" "kg/h" COEFFS 0 1 0 0 0 0.1 /end COMPU_METHOD
/begin COMPU_METHOD nmot_ub_q10 "" RAT_FUNC "%6.1" "U/min" COEFFS 0 1 0 0 0 10 /end COMPU_METHOD
/begin COMPU_METHOD nmot_ub_q40 "" RAT_FUNC "%6.1" "Upm" COEFFS 0 1 0 0 0 40 /end COMPU_METHOD
/begin COMPU_METHOD nmot_uw_q0p25 "" RAT_FUNC "%6.3" "U/min" COEFFS 0 1 0 0 0 0.25 /end COMPU_METHOD
/begin COMPU_METHOD perio_ub_b6p125 "" RAT_FUNC "%6.4" "1/s" COEFFS 0 256 0 0 0 6.125 /end COMPU_METHOD
/begin COMPU_METHOD p_q0p2 "" RAT_FUNC "%6.3" "bar" COEFFS 0 5 0 0 0 1 /end COMPU_METHOD
/begin COMPU_METHOD p_sb_q10 "" RAT_FUNC "%6.1" "hPa" COEFFS 0 1 0 0 0 10 /end COMPU_METHOD
/begin COMPU_METHOD qnv_uw_b512 "" RAT_FUNC "%6.4" "(U/min)/(km/h)" COEFFS 0 65536 0 0 0 512 /end COMPU_METHOD
/begin COMPU_METHOD relDK_ub_b100 "" RAT_FUNC "%6.3" "% DK" COEFFS 0 255 0 0 0 100 /end COMPU_METHOD
/begin COMPU_METHOD relPED_ub_b100 "" RAT_FUNC "%6.3" "% PED" COEFFS 0 255 0 0 0 100 /end COMPU_METHOD
/begin COMPU_METHOD relPED_uw_b100 "" RAT_FUNC "%6.4" "% PED" COEFFS 0 65535 0 0 0 100 /end COMPU_METHOD
/begin COMPU_METHOD rel_sw_b100 "" RAT_FUNC "%6.4" "%" COEFFS 0 32768 0 0 0 100 /end COMPU_METHOD
/begin COMPU_METHOD rel_ub_b100 "" RAT_FUNC "%6.3" "%" COEFFS 0 256 0 0 0 100 /end COMPU_METHOD
/begin COMPU_METHOD rel_ub_b127p5 "" RAT_FUNC "%6.3" "%" COEFFS 0 2 0 0 0 1 /end COMPU_METHOD
/begin COMPU_METHOD rel_ub_b99p6 "" RAT_FUNC "%6.3" "%" COEFFS 0 256 0 0 0 100 /end COMPU_METHOD
/begin COMPU_METHOD rel_uw_b100 "" RAT_FUNC "%6.4" "%" COEFFS 0 65536 0 0 0 100 /end COMPU_METHOD
/begin COMPU_METHOD rel_uw_b200 "" RAT_FUNC "%6.4" "%" COEFFS 0 65536 0 0 0 200 /end COMPU_METHOD
/begin COMPU_METHOD rel_uw_b6144 "" RAT_FUNC "%6.3" "%" COEFFS 0 65536 0 0 0 6144 /end COMPU_METHOD
/begin COMPU_METHOD rel_uw_q0p0234 "" RAT_FUNC "%6.4" "%" COEFFS 0 32 0 0 0 0.75 /end COMPU_METHOD
/begin COMPU_METHOD rgrad_uw_b1280 "" RAT_FUNC "%6.4" "%/s" COEFFS 0 65536 0 0 0 1280 /end COMPU_METHOD
/begin COMPU_METHOD spgg_q0p52 "" RAT_FUNC "%6.3" "mV/ms" COEFFS 0 1 0 0 0 0.52 /end COMPU_METHOD
/begin COMPU_METHOD spg_q0p00039 "" RAT_FUNC "%6.5" "V" COEFFS 0 1 0 0 0 0.000390625 /end COMPU_METHOD
/begin COMPU_METHOD spg_q0p00488 "" RAT_FUNC "%6.4" "V" COEFFS 0 1024 0 0 0 5 /end COMPU_METHOD
/begin COMPU_METHOD spg_q0p1 "" RAT_FUNC "%6.3" "V" COEFFS 0 1 0 0 0 0.1 /end COMPU_METHOD
/begin COMPU_METHOD spg_ubatt "" RAT_FUNC "%6.4" "V" COEFFS 0 1 0 0 0 0.0704 /end COMPU_METHOD
/begin COMPU_METHOD spg_ub_b1p33 "" RAT_FUNC "%6.4" "V" COEFFS 0 255 0 0 0 1.33 /end COMPU_METHOD
/begin COMPU_METHOD spg_ub_b28p5 "" RAT_FUNC "%6.3" "V" COEFFS 0 1 0 0 0 0.1113 /end COMPU_METHOD
/begin COMPU_METHOD spg_ub_b5 "" RAT_FUNC "%6.4" "V" COEFFS 0 256 0 0 0 5 /end COMPU_METHOD
/begin COMPU_METHOD spg_ub_q0p0052_o0p2 "" RAT_FUNC "%6.3" "V" COEFFS 0 255 51 0 0 1.33 /end COMPU_METHOD
/begin COMPU_METHOD spg_ub_q0p019 "" RAT_FUNC "%6.4" "V" COEFFS 0 256 0 0 0 5 /end COMPU_METHOD
/begin COMPU_METHOD spg_uw_b1280 "" RAT_FUNC "%6.4" "V" COEFFS 0 1000 0 0 0 19.5313 /end COMPU_METHOD
/begin COMPU_METHOD spg_uw_q0p00488 "" RAT_FUNC "%6.4" "V" COEFFS 0 1024 0 0 0 5 /end COMPU_METHOD
/begin COMPU_METHOD spg_uw_q0p00488_o1 "" RAT_FUNC "%6.3" "V" COEFFS 0 1024 1024 0 0 5 /end COMPU_METHOD
/begin COMPU_METHOD t100msxs_ub_b25p5 "" RAT_FUNC "%6.3" "s" COEFFS 0 1 0 0 0 0.1 /end COMPU_METHOD
/begin COMPU_METHOD t100msxs_uw_b6553p5 "" RAT_FUNC "%6.3" "s" COEFFS 0 1 0 0 0 0.1 /end COMPU_METHOD
/begin COMPU_METHOD t100msxs_uw_b6553p6 "" RAT_FUNC "%6.3" "s" COEFFS 0 10 0 0 0 1 /end COMPU_METHOD
/begin COMPU_METHOD t100msxs_uw_q100 "" RAT_FUNC "%6.3" "s" COEFFS 0 1 0 0 0 0.1 /end COMPU_METHOD
/begin COMPU_METHOD t10msxs_ub_b2p55 "" RAT_FUNC "%6.4" "s" COEFFS 0 1 0 0 0 0.01 /end COMPU_METHOD
/begin COMPU_METHOD t10msxs_uw_b655p35 "" RAT_FUNC "%6.4" "s" COEFFS 0 1 0 0 0 0.01 /end COMPU_METHOD
/begin COMPU_METHOD t1msxms_q1 "" RAT_FUNC "%6.2" "ms" COEFFS 0 1 0 0 0 1 /end COMPU_METHOD
/begin COMPU_METHOD t1sxs_ub_b255 "" RAT_FUNC "%6.2" "s" COEFFS 0 1 0 0 0 1 /end COMPU_METHOD
/begin COMPU_METHOD t1sxs_uw_b65535 "" RAT_FUNC "%6.2" "s" COEFFS 0 1 0 0 0 1 /end COMPU_METHOD
/begin COMPU_METHOD t1sxs_uw_q1 "" RAT_FUNC "%6.2" "s" COEFFS 0 1 0 0 0 1 /end COMPU_METHOD
/begin COMPU_METHOD t200msxs_ub_b51 "" RAT_FUNC "%6.3" "s" COEFFS 0 1 0 0 0 0.2 /end COMPU_METHOD
/begin COMPU_METHOD t200msxs_uw_q0p2 "" RAT_FUNC "%6.3" "s" COEFFS 0 1 0 0 0 0.2 /end COMPU_METHOD
/begin COMPU_METHOD t20msxs_ub_b5p1 "" RAT_FUNC "%6.4" "s" COEFFS 0 1 0 0 0 0.02 /end COMPU_METHOD
/begin COMPU_METHOD t20msxs_ub_q0p02 "" RAT_FUNC "%6.4" "s" COEFFS 0 50 0 0 0 1 /end COMPU_METHOD
/begin COMPU_METHOD t20msxs_ub_q0p32 "" RAT_FUNC "%6.3" "s" COEFFS 0 256 0 0 0 81.92 /end COMPU_METHOD
/begin COMPU_METHOD t20msxs_uw_b1310 "" RAT_FUNC "%6.4" "s" COEFFS 0 1 0 0 0 0.02 /end COMPU_METHOD
/begin COMPU_METHOD t20msxs_uw_q0p02 "" RAT_FUNC "%6.4" "s" COEFFS 0 1 0 0 0 0.02 /end COMPU_METHOD
/begin COMPU_METHOD t400msxs_ub_b102 "" RAT_FUNC "%6.3" "s" COEFFS 0 1 0 0 0 0.4 /end COMPU_METHOD
/begin COMPU_METHOD t500usxms_ub_q0p5 "" RAT_FUNC "%6.3" "ms" COEFFS 0 1 0 0 0 0.5 /end COMPU_METHOD
/begin COMPU_METHOD t50msxs_q0p05 "" RAT_FUNC "%6.4" "s" COEFFS 0 1 0 0 0 0.05 /end COMPU_METHOD
/begin COMPU_METHOD t50msxs_ub_b12p75 "" RAT_FUNC "%6.4" "s" COEFFS 0 1 0 0 0 0.05 /end COMPU_METHOD
/begin COMPU_METHOD t50msxs_uw_b3276p75 "" RAT_FUNC "%6.4" "s" COEFFS 0 1 0 0 0 0.05 /end COMPU_METHOD
/begin COMPU_METHOD temp_q0p0234_o273 "" RAT_FUNC "%6.1" "Grad C" COEFFS 0 1 273.15 0 0 0.0234375 /end COMPU_METHOD
/begin COMPU_METHOD temp_ub_q0p75_o48 "" RAT_FUNC "%6.2" "Grad C" COEFFS 0 1 48 0 0 0.75 /end COMPU_METHOD
/begin COMPU_METHOD temp_ub_q1_o60 "" RAT_FUNC "%6.2" "Grad C" COEFFS 0 1 60 0 0 1 /end COMPU_METHOD
/begin COMPU_METHOD temp_ub_q5 "" RAT_FUNC "%6.2" "Grad C" COEFFS 0 1 0 0 0 5 /end COMPU_METHOD
/begin COMPU_METHOD temp_ub_q5_o50 "" RAT_FUNC "%6.2" "Grad C" COEFFS 0 1 50 0 0 5 /end COMPU_METHOD
/begin COMPU_METHOD tfst_ub_b126 "" RAT_FUNC "%6.2" "l" COEFFS 0 1 0 0 0 1 /end COMPU_METHOD
/begin COMPU_METHOD tinjection5_sy "" RAT_FUNC "%6.4" "ms" COEFFS 0 75 0 0 0 1 /end COMPU_METHOD
/begin COMPU_METHOD tinjection_sy "" RAT_FUNC "%6.4" "ms" COEFFS 0 375 0 0 0 1 /end COMPU_METHOD
/begin COMPU_METHOD tsquant "Umrechnung Segmentzeit in DMD" RAT_FUNC "%6.2" "us" COEFFS 0 1.21951 0 0 0 1 /end COMPU_METHOD
/begin COMPU_METHOD tsquantl "" RAT_FUNC "%6.1" "us" COEFFS 0 0.0762195 0 0 0 1 /end COMPU_METHOD
/begin COMPU_METHOD tv_ub_b100 "" RAT_FUNC "%6.3" "%" COEFFS 0 256 0 0 0 100 /end COMPU_METHOD
/begin COMPU_METHOD txms_ub_q0p1 "" RAT_FUNC "%6.3" "ms" COEFFS 0 10 0 0 0 1 /end COMPU_METHOD
/begin COMPU_METHOD txms_uw_q0p1 "" RAT_FUNC "%6.3" "ms" COEFFS 0 10 0 0 0 1 /end COMPU_METHOD
/begin COMPU_METHOD tz100msxs_uw_b3276p8 "" RAT_FUNC "%6.1" "s" COEFFS 0 0 3276.8 0 1 0 /end COMPU_METHOD
/begin COMPU_METHOD t_q0p01 "" RAT_FUNC "%6.4" "s" COEFFS 0 100 0 0 0 1 /end COMPU_METHOD
/begin COMPU_METHOD t_q0p02 "" RAT_FUNC "%6.4" "s" COEFFS 0 100 0 0 0 2 /end COMPU_METHOD
/begin COMPU_METHOD t_q0p05 "" RAT_FUNC "%6.4" "s" COEFFS 0 100 0 0 0 5 /end COMPU_METHOD
/begin COMPU_METHOD t_q0p1 "" RAT_FUNC "%6.3" "s" COEFFS 0 10 0 0 0 1 /end COMPU_METHOD
/begin COMPU_METHOD t_q16us "" RAT_FUNC "%6.1" "us" COEFFS 0 1 0 0 0 16 /end COMPU_METHOD
/begin COMPU_METHOD t_q4_s "" RAT_FUNC "%6.2" "s" COEFFS 0 1 0 0 0 4 /end COMPU_METHOD
/begin COMPU_METHOD t_wdt_high "" RAT_FUNC "%6.2" "ms" COEFFS 0 0.732422 0 0 0 1 /end COMPU_METHOD
/begin COMPU_METHOD vfzgkb_uw_b655 "" RAT_FUNC "%6.4" "km/h" COEFFS 0 65536 0 0 0 655 /end COMPU_METHOD
/begin COMPU_METHOD vfzg_q1p0 "" RAT_FUNC "%6.2" "km/h" COEFFS 0 1 0 0 0 1 /end COMPU_METHOD
/begin COMPU_METHOD vfzg_sw_q0p00781 "" RAT_FUNC "%6.4" "km/h" COEFFS 0 1 0 0 0 0.0078125 /end COMPU_METHOD
/begin COMPU_METHOD vfzg_ub_q1p25 "" RAT_FUNC "%6.2" "km/h" COEFFS 0 1 0 0 0 1.25 /end COMPU_METHOD
/begin COMPU_METHOD vfzg_uw_b325 "" RAT_FUNC "%6.4" "km/h" COEFFS 0 65536 0 0 0 325 /end COMPU_METHOD
/begin COMPU_METHOD vfzg_uw_q0p00781 "" RAT_FUNC "%6.4" "km/h" COEFFS 0 1 0 0 0 0.0078125 /end COMPU_METHOD
/begin COMPU_METHOD vfzg_uw_q0p0078125 "" RAT_FUNC "%6.4" "km/h" COEFFS 0 1 0 0 0 0.0078125 /end COMPU_METHOD
/begin COMPU_METHOD vol_q0p1 "" RAT_FUNC "%6.3" "mL" COEFFS 0 1 0 0 0 0.1 /end COMPU_METHOD
/begin COMPU_METHOD vrad_uw_b655 "" RAT_FUNC "%6.4" "km/h" COEFFS 0 65536 0 0 0 655 /end COMPU_METHOD
/begin COMPU_METHOD vs_uw_b25p6 "" RAT_FUNC "%6.5" "m^3/h" COEFFS 0 65536 0 0 0 25.6 /end COMPU_METHOD
/begin COMPU_METHOD wkw_ub_q0p25 "" RAT_FUNC "%6.3" "° KW" COEFFS 0 100 0 0 0 25 /end COMPU_METHOD
/begin COMPU_METHOD zk100msxs_ub_b25p5 "" RAT_FUNC "%6.3" "s" COEFFS 0 0 256 0 10 0 /end COMPU_METHOD
/begin COMPU_METHOD zk100msxs_uw_b655 "" RAT_FUNC "%6.1" "s" COEFFS 0 0 65536 0 10 0 /end COMPU_METHOD
/begin COMPU_METHOD zk100msxs_uw_b6553 "" RAT_FUNC "%12.4" "s" COEFFS 0 0 65536 0 10 0 /end COMPU_METHOD
/begin COMPU_METHOD zk10msxs_ub_b2p55 "" RAT_FUNC "%6.4" "s" COEFFS 0 0 255 0 100 0 /end COMPU_METHOD
/begin COMPU_METHOD zk10msxs_uw_b2p55T "" TAB_INTP "%6.3" "s" COMPU_TAB_REF zk10msxs_uw_b2p55T /end COMPU_METHOD
/begin COMPU_TAB zk10msxs_uw_b2p55T "" TAB_INTP 35 128 2.55 145 2.25 163 2 186 1.75 217 1.5 251 1.3 283 1.15 326 1 362 0.9 407 0.8 465 0.7 541 0.6 649 0.5 720 0.45 809 0.4 923 0.35 1074 0.3 1285 0.25 1524 0.21 1872 0.17 2259 0.14 2426 0.13 2620 0.12 2847 0.11 3118 0.1 3446 0.09 3850 0.08 4362 0.07 5030 0.06 5939 0.05 7248 0.04 9288 0.03 12893 0.02 20713 0.01 32767 0 /end COMPU_TAB
/begin COMPU_METHOD zk10msxs_uw_b655 "" RAT_FUNC "%12.5" "s" COEFFS 0 0 65536 0 100 0 /end COMPU_METHOD
/begin COMPU_METHOD zk1sxs_ub_b255 "" RAT_FUNC "%6.2" "s" COEFFS 0 0 256 0 1 0 /end COMPU_METHOD
/begin COMPU_METHOD zk1sxs_uw_b65535 "" RAT_FUNC "%6.0" "s" COEFFS 0 0 65535 0 1 0 /end COMPU_METHOD
/begin COMPU_METHOD zk200msxs_ub_b51p2 "" RAT_FUNC "%6.3" "s" COEFFS 0 0 255 0 5 0 /end COMPU_METHOD
/begin COMPU_METHOD zk200msxs_uw_b13107 "" RAT_FUNC "%12.3" "s" COEFFS 0 0 13107.2 0 1 0 /end COMPU_METHOD
/begin COMPU_METHOD zk200msxs_uw_b5 "" RAT_FUNC "%7.6" "1/s" COEFFS 0 65536 0 0 0 5 /end COMPU_METHOD
/begin COMPU_METHOD zk200msxs_uw_b960 "" RAT_FUNC "%6.4" "%/s" COEFFS 0 65536 0 0 0 960 /end COMPU_METHOD
/begin COMPU_METHOD zk20msxs_ub_b5p1 "" RAT_FUNC "%6.4" "s" COEFFS 0 0 5.1 0 1 0 /end COMPU_METHOD
/begin COMPU_METHOD zk20msxs_ub_b5p12 "" RAT_FUNC "%6.4" "s" COEFFS 0 0 256 0 50 0 /end COMPU_METHOD
/begin COMPU_METHOD zk20msxs_uw_b1310 "" RAT_FUNC "%12.4" "s" COEFFS 0 0 65536 0 50 0 /end COMPU_METHOD
/begin COMPU_METHOD zk50msxs_ub_b12p8 "" RAT_FUNC "%10.5" "s" COEFFS 0 0 128 0 10 0 /end COMPU_METHOD
/begin COMPU_METHOD zk50msxs_uw_b12p8 "" RAT_FUNC "%12.4" "s" COEFFS 0 0 32768 0 10 0 /end COMPU_METHOD
/begin COMPU_METHOD zk50msxs_uw_b3276p8 "" RAT_FUNC "%12.4" "s" COEFFS 0 0 65536 0 20 0 /end COMPU_METHOD
/begin COMPU_METHOD zue_dmdstp "" RAT_FUNC "%6.2" "Zuendungen" COEFFS 0 1 0 0 0 1 /end COMPU_METHOD
/begin COMPU_METHOD zw_azue_sy "" RAT_FUNC "%6.3" "Grad KW" COEFFS 0 1.33333 0 0 0 1 /end COMPU_METHOD
/begin COMPU_METHOD zw_sb_q0p75 "" RAT_FUNC "%6.3" "grad KW" COEFFS 0 255 0 0 0 191.25 /end COMPU_METHOD
/begin COMPU_METHOD zw_TR2OT_sy "" RAT_FUNC "%6.2" "Grad KW" COEFFS 0 -1.33333 96 0 0 1 /end COMPU_METHOD
/begin COMPU_METHOD zw_TR2OT_teeth_sy "" RAT_FUNC "%6.3" "Grad KW" COEFFS 0 -0.166667 12 0 0 1 /end COMPU_METHOD
/begin COMPU_METHOD zw_ub_q6 "" RAT_FUNC "%6.2" "Grad KW" COEFFS 0 255 0 0 0 1530 /end COMPU_METHOD
/begin COMPU_METHOD zw_ub_qn0p75 "" RAT_FUNC "%6.4" "grad KW" COEFFS 0 1 0 0 0 -0.75 /end COMPU_METHOD
/begin RECORD_LAYOUT FklWUb FNC_VALUES 1 UBYTE COLUMN_DIR DIRECT /end RECORD_LAYOUT
/begin RECORD_LAYOUT FklWUw FNC_VALUES 1 UWORD COLUMN_DIR DIRECT /end RECORD_LAYOUT
/begin RECORD_LAYOUT GklWSb FNC_VALUES 1 SBYTE COLUMN_DIR DIRECT /end RECORD_LAYOUT
/begin RECORD_LAYOUT GklWUb FNC_VALUES 1 UBYTE COLUMN_DIR DIRECT /end RECORD_LAYOUT
/begin RECORD_LAYOUT GklWUw FNC_VALUES 1 UWORD COLUMN_DIR DIRECT /end RECORD_LAYOUT
/begin RECORD_LAYOUT KlAUbSstSwWSw NO_AXIS_PTS_X 1 SWORD AXIS_PTS_X 2 SWORD INDEX_INCR DIRECT FNC_VALUES 3 SWORD COLUMN_DIR DIRECT /end RECORD_LAYOUT
/begin RECORD_LAYOUT KlAUbSstUbWUb NO_AXIS_PTS_X 1 UBYTE AXIS_PTS_X 2 UBYTE INDEX_INCR DIRECT FNC_VALUES 3 UBYTE COLUMN_DIR DIRECT /end RECORD_LAYOUT
/begin RECORD_LAYOUT KlAUbSstUbWUw NO_AXIS_PTS_X 1 UBYTE AXIS_PTS_X 2 UBYTE INDEX_INCR DIRECT FNC_VALUES 3 UWORD COLUMN_DIR DIRECT /end RECORD_LAYOUT
/begin RECORD_LAYOUT KlAUbSstUwWUw NO_AXIS_PTS_X 1 UWORD AXIS_PTS_X 2 UWORD INDEX_INCR DIRECT FNC_VALUES 3 UWORD COLUMN_DIR DIRECT /end RECORD_LAYOUT
/begin RECORD_LAYOUT KlAUwSstSwWUw NO_AXIS_PTS_X 1 UWORD AXIS_PTS_X 2 SWORD INDEX_INCR DIRECT FNC_VALUES 3 UWORD COLUMN_DIR DIRECT /end RECORD_LAYOUT
/begin RECORD_LAYOUT KlAUwSstUwWSw NO_AXIS_PTS_X 1 UWORD AXIS_PTS_X 2 UWORD INDEX_INCR DIRECT FNC_VALUES 3 SWORD COLUMN_DIR DIRECT /end RECORD_LAYOUT
/begin RECORD_LAYOUT KlAUwSstUwWUw NO_AXIS_PTS_X 1 UWORD AXIS_PTS_X 2 UWORD INDEX_INCR DIRECT FNC_VALUES 3 UWORD COLUMN_DIR DIRECT /end RECORD_LAYOUT
/begin RECORD_LAYOUT KwbUb FNC_VALUES 1 UBYTE COLUMN_DIR DIRECT /end RECORD_LAYOUT
/begin RECORD_LAYOUT KwbUw FNC_VALUES 1 UWORD COLUMN_DIR DIRECT /end RECORD_LAYOUT
/begin RECORD_LAYOUT KwSb FNC_VALUES 1 SBYTE COLUMN_DIR DIRECT /end RECORD_LAYOUT
/begin RECORD_LAYOUT KwSw FNC_VALUES 1 SWORD COLUMN_DIR DIRECT /end RECORD_LAYOUT
/begin RECORD_LAYOUT KwUb FNC_VALUES 1 UBYTE COLUMN_DIR DIRECT /end RECORD_LAYOUT
/begin RECORD_LAYOUT KwUl FNC_VALUES 1 ULONG COLUMN_DIR DIRECT /end RECORD_LAYOUT
/begin RECORD_LAYOUT KwUw FNC_VALUES 1 UWORD COLUMN_DIR DIRECT /end RECORD_LAYOUT
/begin RECORD_LAYOUT SstAUbSstUb NO_AXIS_PTS_X 1 UBYTE AXIS_PTS_X 2 UBYTE INDEX_INCR DIRECT /end RECORD_LAYOUT
/begin RECORD_LAYOUT SstAUwSstUw NO_AXIS_PTS_X 1 UWORD AXIS_PTS_X 2 UWORD INDEX_INCR DIRECT /end RECORD_LAYOUT
/end MODULE
/end PROJECT
