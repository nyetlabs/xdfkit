ASAP2_VERSION 1 3
/begin PROJECT X505P_24HG_1 "X505P"
/begin HEADER "" VERSION "X505P_24HG_1" PROJECT_NO X505P_24HG_1 /end HEADER
/begin MODULE DIM ""
/begin MOD_COMMON "" BYTE_ORDER MSB_LAST ALIGNMENT_BYTE 1 ALIGNMENT_WORD 2 ALIGNMENT_LONG 2 /end MOD_COMMON
/begin CHARACTERISTIC AFNTOL "Toleranz zur Verkleinerung des Aussetzerfenster bzgl. Drehzahl" VALUE 0x810897 KwUb 10200. nmot_ub_q40 0.00 10200. FORMAT "%5.0" READ_ONLY /end CHARACTERISTIC
/begin CHARACTERISTIC AHEAGW "Aussetzerhäufigkeit zum Erreichen der gesetzlichen Abgaslimits" VALUE 0x81377E KwUw 65535.00 dez 0.00 65535.00 FORMAT "%8.2" /end CHARACTERISTIC
/begin CHARACTERISTIC AHEAGWS "Aussetzerhäufigkeit zum Erreichen der gesetzlichen Abgaslimits" VALUE 0x813780 KwUw 65535.00 dez 0.00 65535.00 FORMAT "%8.2" /end CHARACTERISTIC
/begin CHARACTERISTIC AHEARV "Aussetzerhäufigkeit zum Erreichen der Ausblendung weiterer Funktionen" VALUE 0x813782 KwUw 65535.00 dez 0.00 65535.00 FORMAT "%8.2" /end CHARACTERISTIC
/begin CHARACTERISTIC AHEKA "Aussetzerhäufigkeit zum Erreichen einer Kraftstoffabschaltung" VALUE 0x813784 KwUw 65535.00 dez 0.00 65535.00 FORMAT "%8.2" /end CHARACTERISTIC
/begin CHARACTERISTIC AHEKS1B1 "Aussetzerhäufigkeit zum Erreichen einer Katschädigung im 1. Intervall Bank 1" VALUE 0x813786 KwUw 65535.00 dez 0.00 65535.00 FORMAT "%8.2" /end CHARACTERISTIC
/begin CHARACTERISTIC AHEKS1B2 "Aussetzerhäufigkeit zum Erreichen einer Katschädigung im 1. Intervall Bank 2" VALUE 0x813788 KwUw 65535.00 dez 0.00 65535.00 FORMAT "%8.2" /end CHARACTERISTIC
/begin CHARACTERISTIC AHEKSB1 "Aussetzerhäufigkeit zum Erreichen einer Katalysatorschädigung Bank 1" VALUE 0x81378A KwUw 65535.00 dez 0.00 65535.00 FORMAT "%8.2" /end CHARACTERISTIC
/begin CHARACTERISTIC AHEKSB2 "Aussetzerhäufigkeit zum Erreichen einer Katalysatorschädigung Bank 2" VALUE 0x81378C KwUw 65535.00 dez 0.00 65535.00 FORMAT "%8.2" /end CHARACTERISTIC
/begin CHARACTERISTIC AINTKAN "Anzahl Intervalle mit Katschädigung für Ti-Abschaltung" CURVE 0x818447 GklWUb 255.0 dez 0.00 255.0 FORMAT "%5.1"
 /begin AXIS_DESCR COM_AXIS nmot nmot_ub_q40 8 0.00 10200. AXIS_PTS_REF SNM08DMUB /end AXIS_DESCR
/end CHARACTERISTIC
/begin CHARACTERISTIC ANALUN_0_A "Anzahl Verbrennungen für Ausblendungen nach erkanntem Auss., drehzahlabhängig" CURVE 0x81058C GklWUb 255.0 dez 0.00 255.0 FORMAT "%5.1"
 /begin AXIS_DESCR COM_AXIS nmot nmot_ub_q40 8 0.00 10200. AXIS_PTS_REF SNM08DMUB /end AXIS_DESCR
/end CHARACTERISTIC
/begin CHARACTERISTIC ANALUN_1_A "Anzahl Verbrennungen für Ausblendungen nach erkanntem Auss., drehzahlabhängig" CURVE 0x810594 GklWUb 255.0 dez 0.00 255.0 FORMAT "%5.1"
 /begin AXIS_DESCR COM_AXIS nmot nmot_ub_q40 8 0.00 10200. AXIS_PTS_REF SNM08DMUB /end AXIS_DESCR
/end CHARACTERISTIC
/begin CHARACTERISTIC ANALUST "Anzahl Verbrennungen für Ausblendungen nach erkanntem Auss., nach Start" VALUE 0x81059C KwUb 255.0 dez 0.00 255.0 FORMAT "%5.1" /end CHARACTERISTIC
/begin CHARACTERISTIC ANZRMSL "Anzahl der MSL-Messungen für Auswertung des gleitenden Mittelwertes" VALUE 0x81AF46 KwUw 65535.00 dez 0.00 65535.00 FORMAT "%8.2" /end CHARACTERISTIC
/begin CHARACTERISTIC APDTEFRE "Anzahl Vergleiche Gradient fr für Erkennen fr-eingeschwungen in DTEV" VALUE 0x81A432 KwUb 50.00 dez 0.00 50.00 FORMAT "%5.2" /end CHARACTERISTIC
/begin CHARACTERISTIC APDTEVX "max. Anzahl Prüfungen bei erkanntem Fehler" VALUE 0x81A433 KwUb 10.00 dez 0.00 10.00 FORMAT "%5.2" /end CHARACTERISTIC
/begin CHARACTERISTIC ATVFETTO "obere Grenze für atvfett, CARB-Tester, DLSSA" VALUE 0x81015B KwUb 1.330 spg_ub_b1p33 0.00 1.330 FORMAT "%5.3" /end CHARACTERISTIC
/begin CHARACTERISTIC ATVFETTU "untere Grenze für atvfett, CARB-Tester, DLSSA" VALUE 0x81015C KwUb 1.330 spg_ub_b1p33 0.00 1.330 FORMAT "%5.3" /end CHARACTERISTIC
/begin CHARACTERISTIC ATVMAGO "obere Grenze für atvmager, CARB-Tester, DLSSA" VALUE 0x81015D KwUb 1.330 spg_ub_b1p33 0.00 1.330 FORMAT "%5.3" /end CHARACTERISTIC
/begin CHARACTERISTIC ATVMAGU "untere Grenze für atvmager, CARB-Tester, DLSSA" VALUE 0x81015E KwUb 1.330 spg_ub_b1p33 0.00 1.330 FORMAT "%5.3" /end CHARACTERISTIC
/begin CHARACTERISTIC AVDTEVX "max. Anzahl Prüfversuche DTEV" VALUE 0x81A434 KwUb 20.00 dez 0.00 20.00 FORMAT "%5.2" /end CHARACTERISTIC
/begin CHARACTERISTIC AVRALU "Anzahl NW-Umdr./Verbrenng. f. Reaktivierung Aussetzererkennung nach Ausblendung" VALUE 0x8104FB KwUb 63.50 nw_dmdstp_sy 0.2500 63.75 FORMAT "%5.2" /end CHARACTERISTIC
/begin CHARACTERISTIC AZSTLU "Verlängerung der Ausblendanforderung bei Motorstart in Anzahl Zündungen" VALUE 0x8104FC KwUb 254.0 zue_dmdstp 1.000 255.0 FORMAT "%5.1" /end CHARACTERISTIC
/begin CHARACTERISTIC AZSTPON "Umschaltung von Ausblendanforderung nach Motorstart in Anzahl Zündungen" VALUE 0x8104FD KwUb 254.0 zue_dmdstp 1.000 255.0 FORMAT "%5.1" /end CHARACTERISTIC
/begin CHARACTERISTIC AZYTIAB "Maximale Anzahl von Zylindern mit Ti-Abschaltung aufgrund von Aussetzern" VALUE 0x810898 KwUb 255.0 dez 0.00 255.0 FORMAT "%5.1" /end CHARACTERISTIC
/begin CHARACTERISTIC CWDALA "Codewort DMDMIL Dauerlaufzähler" VALUE 0x810899 KwUb 255.0 dez 0.00 255.0 FORMAT "%5.1" /end CHARACTERISTIC
/begin CHARACTERISTIC CWDLDPTE "Codewort für DLDP in System Vorhanden" VALUE 0x81A435 KwUb 255.0 dez 0.00 255.0 FORMAT "%5.1" /end CHARACTERISTIC
/begin CHARACTERISTIC CWDMDE "Codewort für EOBD-Appl. DMDMIL" VALUE 0x81844F KwUb 255.0 dez 0.00 255.0 FORMAT "%5.1" /end CHARACTERISTIC
/begin CHARACTERISTIC CWDNMAX "Codeword: Abschaltung Diagnose Überdrehzahl" VALUE 0x810BA4 KwUb 255.0 dez 0.00 255.0 FORMAT "%5.1" /end CHARACTERISTIC
/begin CHARACTERISTIC CWDSLSA "Codewort in der Diagnose Sekundärluftsystem" VALUE 0x818364 KwUb 255.0 dez 0.00 255.0 FORMAT "%5.1" /end CHARACTERISTIC
/begin CHARACTERISTIC CWDSLSAD "Codewort in der Diagnose der Sekundärluftsteuerung für aktiv Diagnose" VALUE 0x818365 KwUb 255.0 dez 0.00 255.0 FORMAT "%5.1" /end CHARACTERISTIC
/begin CHARACTERISTIC CWDSLSY "Codewort in der Diagnose Sekundärluftsystem" VALUE 0x818366 KwUb 255.0 dez 0.00 255.0 FORMAT "%5.1" /end CHARACTERISTIC
/begin CHARACTERISTIC CWDTEAPP "Applikationscodeword für DTEV immer aktiv und Umschaltung von HFM auf P-System" VALUE 0x81A436 KwUb 255.0 dez 0.00 255.0 FORMAT "%5.1" /end CHARACTERISTIC
/begin CHARACTERISTIC CWDTEV "Codword DTEV" VALUE 0x81A437 KwUb 255.0 dez 0.00 255.0 FORMAT "%5.1" /end CHARACTERISTIC
/begin CHARACTERISTIC CWDTHM "Codewort DTHM-Funktion" VALUE 0x8196E5 KwUb 255.0 dez 0.00 255.0 FORMAT "%5.1" /end CHARACTERISTIC
/begin CHARACTERISTIC CWNOMIL "Codewort MIL-Ansteuerung nicht aktiv" VALUE 0x818459 KwUb 255.0 dez 0.00 255.0 FORMAT "%5.1" /end CHARACTERISTIC
/begin CHARACTERISTIC CWSTDMD "Codewort zur Auswahl Startfreigabe: 1 -> B_st, 0 -> nmot" VALUE 0x8104FE KwUb 255.0 dez 0.00 255.0 FORMAT "%5.1" /end CHARACTERISTIC
/begin CHARACTERISTIC CWSTPCNF "Codewort Ausblendkriterien 1 -> Kriterium aktiv" VALUE 0x8104FF KwUb 255.0 dez 0.00 255.0 FORMAT "%5.1" /end CHARACTERISTIC
/begin CHARACTERISTIC CWUTEKU "Umschaltung Tankentlüftung Kurztrip Test (B_fates)" VALUE 0x81A438 KwUb 255.0 dez 0.00 255.0 FORMAT "%5.1" /end CHARACTERISTIC
/begin CHARACTERISTIC CW_SWE_0__A "" VALUE 0x81BB74 KwUw 65535.00 dez 0.00 65535.00 FORMAT "%8.2" /end CHARACTERISTIC
/begin CHARACTERISTIC CW_SWE_1__A "" VALUE 0x81BB76 KwUw 65535.00 dez 0.00 65535.00 FORMAT "%8.2" /end CHARACTERISTIC
/begin CHARACTERISTIC DASE_CMD "Codewort DMD-Ausblendbedingungen abschalten - nur für Testzwecke !!!" VALUE 0x810500 KwUb 7.000 dez 0.00 7.000 FORMAT "%5.3" /end CHARACTERISTIC
/begin CHARACTERISTIC DFRMDSLS "Deltawert zu frmx für Freigabe der Diagnose der SLS" VALUE 0x81AF48 KwUw 1.999969 fak_uw_b2 0.00 1.999969 FORMAT "%8.6" /end CHARACTERISTIC
/begin CHARACTERISTIC DFRMDTEE "Delta-frm-Schwelle für Erkennung der eingeschwungenen Gemischkorrektur" VALUE 0x827F7E KwUw 0.03125000 fak_uw_b2 0.00 0.03125000 FORMAT "%10.8" /end CHARACTERISTIC
/begin CHARACTERISTIC DFRMDTEF "Regelhubschwelle für Fettkorrektur des fr für Prüfung i.O." VALUE 0x827F80 KwSw 0.2000122 fak_sw_b1 -0.2000122 0.00 FORMAT "%9.7" /end CHARACTERISTIC
/begin CHARACTERISTIC DFRMDTEM "Regelhubschwelle für Magerkorrektur des fr für Prüfung i.O." VALUE 0x827F82 KwSw 0.2000122 fak_sw_b1 0.00 0.2000122 FORMAT "%9.7" /end CHARACTERISTIC
/begin CHARACTERISTIC DFRMOFNML "frm-Offset-Schwelle (negativ) in Abhängigkeit vom Luftmassenfluß" CURVE 0x81AF4A KlAUwSstUwWSw 1.999969 fak_sw_b1 -1.000000 0.9999695 FORMAT "%8.6"
 /begin AXIS_DESCR STD_AXIS ml_w m_uw_b6553p5 6 0.00 6553.500 FORMAT "%8.3" DEPOSIT ABSOLUTE /end AXIS_DESCR
/end CHARACTERISTIC
/begin CHARACTERISTIC DFRMOFNXKT "frm-Offset-Schwelle (negativ): Kontrolle Vorsteuerproblem (Kurztest)" VALUE 0x81AF64 KwSw 1.999969 fak_sw_b1 -1.000000 0.9999695 FORMAT "%8.6" /end CHARACTERISTIC
/begin CHARACTERISTIC DFRMOFPML "frm-Offset-Schwelle (positiv) in Abhängigkeit vom Luftmassenfluß" CURVE 0x81AF66 KlAUwSstUwWSw 1.999969 fak_sw_b1 -1.000000 0.9999695 FORMAT "%8.6"
 /begin AXIS_DESCR STD_AXIS ml_w m_uw_b6553p5 6 0.00 6553.500 FORMAT "%8.3" DEPOSIT ABSOLUTE /end AXIS_DESCR
/end CHARACTERISTIC
/begin CHARACTERISTIC DFRMOFPXKT "frm-Offset-Schwelle (positiv): Kontrolle Vorsteuerproblem (Kurztest)" VALUE 0x81AF80 KwSw 1.999969 fak_sw_b1 -1.000000 0.9999695 FORMAT "%8.6" /end CHARACTERISTIC
/begin CHARACTERISTIC DFRMSLS "Schwelle für Einschwingkriterium des frm bei der Aktiv-Diagnose" VALUE 0x81AF82 KwUw 1.999969 fak_uw_b2 0.00 1.999969 FORMAT "%8.6" /end CHARACTERISTIC
/begin CHARACTERISTIC DMLDTEFN "Schwelle Luftmassenstrom unplausibel für Erkennung Fehler in DTEV" VALUE 0x827F84 KwSw 2.000000 m_q0p0031 -2.000000 0.00 FORMAT "%8.6" /end CHARACTERISTIC
/begin CHARACTERISTIC DMLDTEFX "Luftmassenschwelle für Erkennung TEV defekt nicht mehr nötig" VALUE 0x827F86 KwSw 3.025000 m_q0p0031 0.00 3.025000 FORMAT "%8.6" /end CHARACTERISTIC
/begin CHARACTERISTIC DMLDTEMN "Untere Schwelle für Erkennung Luftmassenstrom unplausibel für Auswertung in DTEV" VALUE 0x827F88 KwSw 2.000000 m_q0p0031 -2.000000 0.00 FORMAT "%8.6" /end CHARACTERISTIC
/begin CHARACTERISTIC DMLDTEMX "Obere Schwelle für Erkennung Luftmassenstrom unplausibel für Auswertung in DTEV" VALUE 0x827F8A KwSw 2.000000 m_q0p0031 0.00 2.000000 FORMAT "%8.6" /end CHARACTERISTIC
/begin CHARACTERISTIC DMSDRLTM "Delta-rl-Schwelle in Abhängigkeit von tmot für Sperre Bedingung B_dslmes" CURVE 0x81AF84 KlAUbSstUbWUw 1535.977 rel_uw_q0p0234 0.00 1535.977 FORMAT "%8.3"
 /begin AXIS_DESCR STD_AXIS tmot temp_ub_q0p75_o48 4 -48.00 143.3 FORMAT "%5.1" DEPOSIT ABSOLUTE /end AXIS_DESCR
/end CHARACTERISTIC
/begin CHARACTERISTIC DMSNTEMN "Minmale normierte Massenstromänderung TEV" VALUE 0x827F8C KwSw 3281.700 m_q0p1 -5.000000 3276.700 FORMAT "%8.3" /end CHARACTERISTIC
/begin CHARACTERISTIC DMSNTEMX "Maximale normierte Massenstromänderung TEV" VALUE 0x827F8E KwSw 3274.700 m_q0p1 2.000000 3276.700 FORMAT "%8.3" /end CHARACTERISTIC
/begin CHARACTERISTIC DMVTEVDO "Schwelle Verlustadaption zur Unterscheidung min, max Fehler in DTEV" VALUE 0x827F90 KwSw 199.9969 rel_sw_b100 -100.0000 99.99695 FORMAT "%8.4" /end CHARACTERISTIC
/begin CHARACTERISTIC DMXRFL "Begrenzung bei max. Filter-Laufunruhe-Referenzwert-Änderung" VALUE 0x810260 KwSb 85.89 luquant 0.00 85.89 FORMAT "%5.2" /end CHARACTERISTIC
/begin CHARACTERISTIC DMXRLU "Begrenzung bei max. Laufunruhe-Referenzwert-Änderung" VALUE 0x81059D KwSb 85.89 luquant 0.00 85.89 FORMAT "%5.2" /end CHARACTERISTIC
/begin CHARACTERISTIC DNDTEO "obere Nsoll-Nist-Schwelle für Abbruch Diagnose TEV" VALUE 0x81A439 KwSb 200.0 nmot_ub_q10 0.00 200.0 FORMAT "%5.1" /end CHARACTERISTIC
/begin CHARACTERISTIC DNDTEU "lower Nsoll-Nist-Schwelle für Abbruch Diagnose TEV" VALUE 0x81A43A KwSb 200.0 nmot_ub_q10 -200.0 0.00 FORMAT "%5.1" /end CHARACTERISTIC
/begin CHARACTERISTIC DNNSOL "Drehzahlschwelle für Solldrehzahländerung während DTEV" VALUE 0x81A43B KwUb 200.0 nmot_ub_q10 0.00 200.0 FORMAT "%5.1" /end CHARACTERISTIC
/begin CHARACTERISTIC DRLSOLA_0_A "Misfire Detection: Schwelle Lastdynamik für Ausblendung" CURVE 0x81371E GklWUw 767.9766 relNWU_q0p0234 0.00 767.9766 FORMAT "%8.4"
 /begin AXIS_DESCR COM_AXIS rl rel_ub_q0p75 8 0.00 191.3 AXIS_PTS_REF SRL08DMUB /end AXIS_DESCR
/end CHARACTERISTIC
/begin CHARACTERISTIC DRLSOLA_1_A "Misfire Detection: Schwelle Lastdynamik für Ausblendung" CURVE 0x81372E GklWUw 767.9766 relNWU_q0p0234 0.00 767.9766 FORMAT "%8.4"
 /begin AXIS_DESCR COM_AXIS rl rel_ub_q0p75 8 0.00 191.3 AXIS_PTS_REF SRL08DMUB /end AXIS_DESCR
/end CHARACTERISTIC
/begin CHARACTERISTIC DRLSOLST_0_A "Misfire Detection: Schwelle Lastdynamik für Ausblendung nach Start" VALUE 0x81375E KwUw 767.9766 relNWU_q0p0234 0.00 767.9766 FORMAT "%8.4" /end CHARACTERISTIC
/begin CHARACTERISTIC DRLSOLST_1_A "Misfire Detection: Schwelle Lastdynamik für Ausblendung nach Start" VALUE 0x813760 KwUw 767.9766 relNWU_q0p0234 0.00 767.9766 FORMAT "%8.4" /end CHARACTERISTIC
/begin CHARACTERISTIC DSLVFZMN "vfzg-Schwelle: Aktivieren Phase 4 durch B_ll-Bedingung" VALUE 0x818367 KwUb 318.8 vfzg_ub_q1p25 0.00 318.8 FORMAT "%5.1" /end CHARACTERISTIC
/begin CHARACTERISTIC DTMDSLA "Temperaturdifferenz zwischen Abstellen und Neustart für Zusatzdiagnose" VALUE 0x818368 KwUb 191.3 temp_ub_b191p25 0.00 191.3 FORMAT "%5.1" /end CHARACTERISTIC
/begin CHARACTERISTIC DTMWUC "Delta Motortemperaturschwelle für Erfüllung 'warm up cycle'" VALUE 0x810B34 KwUb 191.3 temp_ub_b191p25 0.00 191.3 FORMAT "%5.1" /end CHARACTERISTIC
/begin CHARACTERISTIC DTPSWE "Toleranz Periodendauer Schlechtwegsignal" VALUE 0x818451 KwUb 255.0 t100msxms_ub_b255 0.00 255.0 FORMAT "%5.1" /end CHARACTERISTIC
/begin CHARACTERISTIC DUF_T "Zeit fürs Setzen der Zyklusflags der Funktionsüberwachungs-Diagnose" VALUE 0x811FD4 KwUb 25.50 t100msxs_ub_b25p5 0.00 25.50 FORMAT "%5.2" /end CHARACTERISTIC
/begin CHARACTERISTIC DWNWSMNE "Schwelle für Nockenwellenwinkel für Setzen des MIN-Errors (Einlaß)" VALUE 0x8287A4 KwUw 127.9980 kw_q0p0019 0.00 127.9980 FORMAT "%8.4" /end CHARACTERISTIC
/begin CHARACTERISTIC DWNWSMXE "Schwelle für Nockenwellenwinkel für Setzen des MAX-Errors (Einlaß)" VALUE 0x8287A6 KwUw 127.9980 kw_q0p0019 0.00 127.9980 FORMAT "%8.4" /end CHARACTERISTIC
/begin CHARACTERISTIC DZUPHL "Zähldauer des Entprellzählers Heilung" VALUE 0x810DB5 KwUb 255.0 dez 0.00 255.0 FORMAT "%5.1" /end CHARACTERISTIC
/begin CHARACTERISTIC DZUPKSMS "Zähldauer des Entprellzählers KS nach Masse" VALUE 0x810DB6 KwUb 255.0 dez 0.00 255.0 FORMAT "%5.1" /end CHARACTERISTIC
/begin CHARACTERISTIC DZUPKSUB "Zähldauer des Entprellzählers KS nach Ub" VALUE 0x810DB7 KwUb 255.0 dez 0.00 255.0 FORMAT "%5.1" /end CHARACTERISTIC
/begin CHARACTERISTIC DZUPSIG "Zähldauer des Entprellzählers Leitungsabfall" VALUE 0x810DB8 KwUb 255.0 dez 0.00 255.0 FORMAT "%5.1" /end CHARACTERISTIC
/begin CHARACTERISTIC ETAZWTEN "minimale Zündwinkelwirkungsgrad Schwelle für DTEV" VALUE 0x81A43C KwUb 60.00 rel_ub_b127p5 0.00 60.00 FORMAT "%5.2" /end CHARACTERISTIC
/begin CHARACTERISTIC FAINTEN "Anzahl Intervalle zur Freigabe Ti - Abschaltung" VALUE 0x818450 KwUb 255.0 dez 0.00 255.0 FORMAT "%5.1" /end CHARACTERISTIC
/begin CHARACTERISTIC FASKIV1 "Faktor für Verlängerung 1. KAT-Intervall, Aussetzererkennung" VALUE 0x81089A KwUb 4.000 dez 1.000 5.000 FORMAT "%5.3" /end CHARACTERISTIC
/begin CHARACTERISTIC FBWRMSL "Bewertungsfaktor für gleitende Mittelwertsbildung von rmsl" VALUE 0x818369 KwUb 0.9961 fak_ub_b1 0.00 0.9961 /end CHARACTERISTIC
/begin AXIS_PTS FHO04ESUB "SST-Verteilung für Höhenfaktor" 0x81005A fho SstAUbSstUb 3.984 fak_ub_b4 4 0.00 3.984 FORMAT "%5.3" DEPOSIT ABSOLUTE /end AXIS_PTS
/begin CHARACTERISTIC FHODSL "minimaler Höhenfaktor für DSLS" VALUE 0x81AF92 KwUw 3.999939 fak_uw_b4 0.00 3.999939 FORMAT "%8.6" /end CHARACTERISTIC
/begin CHARACTERISTIC FHODTEA "untere Höhenschwelle für DTEV aktiv" VALUE 0x827F92 KwUw 1.900024 fak_uw_b4 0.09997559 2.000000 FORMAT "%8.6" /end CHARACTERISTIC
/begin CHARACTERISTIC FIAMALU "Anhebungsfaktor für Filter Mehrfachaussetzererkennung" VALUE 0x81059E KwUb 3.984 fak_ub_b4 0.00 3.984 FORMAT "%5.3" /end CHARACTERISTIC
/begin CHARACTERISTIC FIMALU_0_A "Filterfaktor Mehrfachaussetzererkennung" VALUE 0x810895 KwUb 0.9961 fak_ub_b1 0.00 0.9961 /end CHARACTERISTIC
/begin CHARACTERISTIC FIMALU_1_A "Filterfaktor Mehrfachaussetzererkennung" VALUE 0x810896 KwUb 0.9961 fak_ub_b1 0.00 0.9961 /end CHARACTERISTIC
/begin CHARACTERISTIC FKADPMN "miminaler Kraftstoffanteil über TEV für passive i.O. Prüfung." VALUE 0x81A43D KwSb 0.6953 fak_sb_b1 0.1016 0.7969 /end CHARACTERISTIC
/begin CHARACTERISTIC FLUTN "Filterfaktor Laufunruhe-Filter" CURVE 0x810261 GklWUb 0.9961 fak_ub_b1 0.00 0.9961
 /begin AXIS_DESCR COM_AXIS nmot nmot_ub_q40 8 0.00 10200. AXIS_PTS_REF SNM08DMUB /end AXIS_DESCR
/end CHARACTERISTIC
/begin CHARACTERISTIC FLUV1 "Schalter der Modifikation 1 der Laufunruhe-Berechnung" VALUE 0x81059F KwUb 255.0 dez 0.00 255.0 FORMAT "%5.1" /end CHARACTERISTIC
/begin CHARACTERISTIC FLUV2 "Schalter der Modifikation 2 der Laufunruhe-Berechnung" VALUE 0x8105A0 KwUb 255.0 dez 0.00 255.0 FORMAT "%5.1" /end CHARACTERISTIC
/begin CHARACTERISTIC FMSLAMN "minimaler Adaptionsfaktor Sekundärluftmasse" VALUE 0x81836A KwUb 1.992 fak_ub_b2 0.00 1.992 FORMAT "%5.3" /end CHARACTERISTIC
/begin CHARACTERISTIC FMSLAMX "maximaler Adaptionsfaktor Sekundärluftmasse" VALUE 0x81836B KwUb 1.992 fak_ub_b2 0.00 1.992 FORMAT "%5.3" /end CHARACTERISTIC
/begin CHARACTERISTIC FNSHO "Wichtung Nachstartanhebung" CURVE 0x818A96 KlAUbSstUbWUb 1.992 fak_ub_b2 0.00 1.992 FORMAT "%5.3"
 /begin AXIS_DESCR STD_AXIS fho fak_ub_b4 4 0.00 3.984 FORMAT "%5.3" DEPOSIT ABSOLUTE /end AXIS_DESCR
/end CHARACTERISTIC
/begin CHARACTERISTIC FNSSM_0_A "Nachstartanhebung" CURVE 0x818A9F GklWUb 3.984 fak_ub_b4 0.00 3.984 FORMAT "%5.3"
 /begin AXIS_DESCR COM_AXIS tmst temp_ub_q0p75_o48 12 -48.00 143.3 AXIS_PTS_REF STS12ESUB /end AXIS_DESCR
/end CHARACTERISTIC
/begin CHARACTERISTIC FNSSM_1_A "Nachstartanhebung" CURVE 0x818AAB GklWUb 3.984 fak_ub_b4 0.00 3.984 FORMAT "%5.3"
 /begin AXIS_DESCR COM_AXIS tmst temp_ub_q0p75_o48 12 -48.00 143.3 AXIS_PTS_REF STS12ESUB /end AXIS_DESCR
/end CHARACTERISTIC
/begin CHARACTERISTIC FNSSM_2_A "Nachstartanhebung" CURVE 0x818AB7 GklWUb 3.984 fak_ub_b4 0.00 3.984 FORMAT "%5.3"
 /begin AXIS_DESCR COM_AXIS tmst temp_ub_q0p75_o48 12 -48.00 143.3 AXIS_PTS_REF STS12ESUB /end AXIS_DESCR
/end CHARACTERISTIC
/begin CHARACTERISTIC FNSSM_3_A "Nachstartanhebung" CURVE 0x818AC3 GklWUb 3.984 fak_ub_b4 0.00 3.984 FORMAT "%5.3"
 /begin AXIS_DESCR COM_AXIS tmst temp_ub_q0p75_o48 12 -48.00 143.3 AXIS_PTS_REF STS12ESUB /end AXIS_DESCR
/end CHARACTERISTIC
/begin CHARACTERISTIC FRKAP_0_A "Faktor relative Kraftstoffmasse für Applikation" VALUE 0x81D6CC KwUb 1.992 fak_ub_b2 0.00 1.992 FORMAT "%5.3" /end CHARACTERISTIC
/begin CHARACTERISTIC FRKAP_1_A "Faktor relative Kraftstoffmasse für Applikation" VALUE 0x81D6CD KwUb 1.992 fak_ub_b2 0.00 1.992 FORMAT "%5.3" /end CHARACTERISTIC
/begin CHARACTERISTIC FRMDPMO "obere frm Schwelle für passive Einschaltbedingungen Diagnose TEV" VALUE 0x827F94 KwUw 0.1499939 fak_uw_b2 1.000000 1.149994 FORMAT "%8.6" /end CHARACTERISTIC
/begin CHARACTERISTIC FRMDPMU "untere frm Schwelle für passive Einschaltbedingungen Diagnose TEV" VALUE 0x827F96 KwUw 0.1499939 fak_uw_b2 0.8500061 1.000000 FORMAT "%8.6" /end CHARACTERISTIC
/begin CHARACTERISTIC FRMDTEVO "obere frm Schwelle für passive i.O. Prüfung Diagnose TEV" VALUE 0x827F98 KwUw 0.1499939 fak_uw_b2 1.000000 1.149994 FORMAT "%8.6" /end CHARACTERISTIC
/begin CHARACTERISTIC FRMDTEVU "untere frm Schwelle für passive i.O. Prüfung Diagnose TEV" VALUE 0x827F9A KwUw 0.1499939 fak_uw_b2 0.8500061 1.000000 FORMAT "%8.6" /end CHARACTERISTIC
/begin CHARACTERISTIC FTEADDPO "obere Beladungsschwelle für passive i.O. Prüfung" VALUE 0x827F9C KwSw 30.00000 fak_sw_b64 20.00000 50.00000 FORMAT "%8.5" /end CHARACTERISTIC
/begin CHARACTERISTIC FTEADDPU "untere Beladungsschwelle für passive i.O. Prüfung" VALUE 0x827F9E KwSw 8.000000 fak_sw_b64 2.000000 10.00000 FORMAT "%8.5" /end CHARACTERISTIC
/begin CHARACTERISTIC FTEADSZ "Schwelle Beladung für TEV sofort schließen aus DTEV" VALUE 0x827FA0 KwSw 15.00000 fak_sw_b64 0.00 15.00000 FORMAT "%8.5" /end CHARACTERISTIC
/begin CHARACTERISTIC FWSTAB1 "Wichtung Nachstart Abregelung Bereich 1" CURVE 0x818ACF GklWUb 1.992 fak_ub_b2 0.00 1.992 FORMAT "%5.3"
 /begin AXIS_DESCR COM_AXIS kstaa fak_ub_b2 6 0.00 1.992 AXIS_PTS_REF SKS06ESUB /end AXIS_DESCR
/end CHARACTERISTIC
/begin CHARACTERISTIC FWSTAB2 "Wichtung Nachstart Abregelung Bereich 2" CURVE 0x818AD5 GklWUb 1.992 fak_ub_b2 0.00 1.992 FORMAT "%5.3"
 /begin AXIS_DESCR COM_AXIS kstaa fak_ub_b2 6 0.00 1.992 AXIS_PTS_REF SKS06ESUB /end AXIS_DESCR
/end CHARACTERISTIC
/begin CHARACTERISTIC FWSTAB3 "Wichtung Nachstart Abregelung Bereich 3" CURVE 0x818ADB GklWUb 1.992 fak_ub_b2 0.00 1.992 FORMAT "%5.3"
 /begin AXIS_DESCR COM_AXIS kstaa fak_ub_b2 6 0.00 1.992 AXIS_PTS_REF SKS06ESUB /end AXIS_DESCR
/end CHARACTERISTIC
/begin CHARACTERISTIC FWSTAS1 "Wichtung Nachstart Umschaltschwelle 1" CURVE 0x818AE1 GklWUb 1.992 fak_ub_b2 0.00 1.992 FORMAT "%5.3"
 /begin AXIS_DESCR COM_AXIS kstaa fak_ub_b2 6 0.00 1.992 AXIS_PTS_REF SKS06ESUB /end AXIS_DESCR
/end CHARACTERISTIC
/begin CHARACTERISTIC FWSTAS2 "Wichtung Nachstart Umschaltschwelle 2" CURVE 0x818AE7 GklWUb 1.992 fak_ub_b2 0.00 1.992 FORMAT "%5.3"
 /begin AXIS_DESCR COM_AXIS kstaa fak_ub_b2 6 0.00 1.992 AXIS_PTS_REF SKS06ESUB /end AXIS_DESCR
/end CHARACTERISTIC
/begin CHARACTERISTIC FZANSSA1_0_A "Faktor für zündsynchrone Abregelung des Nachstartfaktors bei Heißstart Bereich 1" CURVE 0x818AED GklWUb 0.249023438 fak_ub_b0p25 0.00 0.249023438 FORMAT "%11.9"
 /begin AXIS_DESCR COM_AXIS tans temp_ub_q0p75_o48 6 -48.00 143.3 AXIS_PTS_REF STA06ESUB /end AXIS_DESCR
/end CHARACTERISTIC
/begin CHARACTERISTIC FZANSSA1_1_A "Faktor für zündsynchrone Abregelung des Nachstartfaktors bei Heißstart Bereich 1" CURVE 0x818AF3 GklWUb 0.249023438 fak_ub_b0p25 0.00 0.249023438 FORMAT "%11.9"
 /begin AXIS_DESCR COM_AXIS tans temp_ub_q0p75_o48 6 -48.00 143.3 AXIS_PTS_REF STA06ESUB /end AXIS_DESCR
/end CHARACTERISTIC
/begin CHARACTERISTIC FZANSSA2_0_A "Faktor für zündsynchrone Abregelung des Nachstartfaktors bei Heißstart Bereich 2" CURVE 0x818AF9 GklWUb 0.249023438 fak_ub_b0p25 0.00 0.249023438 FORMAT "%11.9"
 /begin AXIS_DESCR COM_AXIS tans temp_ub_q0p75_o48 6 -48.00 143.3 AXIS_PTS_REF STA06ESUB /end AXIS_DESCR
/end CHARACTERISTIC
/begin CHARACTERISTIC FZANSSA2_1_A "Faktor für zündsynchrone Abregelung des Nachstartfaktors bei Heißstart Bereich 2" CURVE 0x818AFF GklWUb 0.249023438 fak_ub_b0p25 0.00 0.249023438 FORMAT "%11.9"
 /begin AXIS_DESCR COM_AXIS tans temp_ub_q0p75_o48 6 -48.00 143.3 AXIS_PTS_REF STA06ESUB /end AXIS_DESCR
/end CHARACTERISTIC
/begin CHARACTERISTIC FZANSSM1_0_A "Faktor für zündsynchrone Abregelung des Nachstartfaktors oberhalb Schwelle" CURVE 0x818B05 GklWUb 0.249023438 fak_ub_b0p25 0.00 0.249023438 FORMAT "%11.9"
 /begin AXIS_DESCR COM_AXIS tmst temp_ub_q0p75_o48 12 -48.00 143.3 AXIS_PTS_REF STS12ESUB /end AXIS_DESCR
/end CHARACTERISTIC
/begin CHARACTERISTIC FZANSSM1_1_A "Faktor für zündsynchrone Abregelung des Nachstartfaktors oberhalb Schwelle" CURVE 0x818B11 GklWUb 0.249023438 fak_ub_b0p25 0.00 0.249023438 FORMAT "%11.9"
 /begin AXIS_DESCR COM_AXIS tmst temp_ub_q0p75_o48 12 -48.00 143.3 AXIS_PTS_REF STS12ESUB /end AXIS_DESCR
/end CHARACTERISTIC
/begin CHARACTERISTIC FZANSSM2_0_A "Faktor für zündsynchrone Abregelung des Nachstartfaktors unterhalb Schwelle" CURVE 0x818B1D GklWUb 0.249023438 fak_ub_b0p25 0.00 0.249023438 FORMAT "%11.9"
 /begin AXIS_DESCR COM_AXIS tmst temp_ub_q0p75_o48 12 -48.00 143.3 AXIS_PTS_REF STS12ESUB /end AXIS_DESCR
/end CHARACTERISTIC
/begin CHARACTERISTIC FZANSSM2_1_A "Faktor für zündsynchrone Abregelung des Nachstartfaktors unterhalb Schwelle" CURVE 0x818B29 GklWUb 0.249023438 fak_ub_b0p25 0.00 0.249023438 FORMAT "%11.9"
 /begin AXIS_DESCR COM_AXIS tmst temp_ub_q0p75_o48 12 -48.00 143.3 AXIS_PTS_REF STS12ESUB /end AXIS_DESCR
/end CHARACTERISTIC
/begin CHARACTERISTIC FZANSSM3_0_A "Faktor für zündsynchrone Abregelung des Nachstartfaktors im Bereich 3" CURVE 0x818B35 GklWUb 0.249023438 fak_ub_b0p25 0.00 0.249023438 FORMAT "%11.9"
 /begin AXIS_DESCR COM_AXIS tmst temp_ub_q0p75_o48 12 -48.00 143.3 AXIS_PTS_REF STS12ESUB /end AXIS_DESCR
/end CHARACTERISTIC
/begin CHARACTERISTIC FZANSSM3_1_A "Faktor für zündsynchrone Abregelung des Nachstartfaktors im Bereich 3" CURVE 0x818B41 GklWUb 0.249023438 fak_ub_b0p25 0.00 0.249023438 FORMAT "%11.9"
 /begin AXIS_DESCR COM_AXIS tmst temp_ub_q0p75_o48 12 -48.00 143.3 AXIS_PTS_REF STS12ESUB /end AXIS_DESCR
/end CHARACTERISTIC
/begin CHARACTERISTIC IDTHMO "obere Schwelle der integrierten Luftmasse für Fehlererkennung Thermostatdiagnose" VALUE 0x8196E6 KwUb 23.21 m_ub_b23p3 0.00 23.21 FORMAT "%5.2" /end CHARACTERISTIC
/begin CHARACTERISTIC IDTHMU "untere Schwelle der integrierten Luftmasse für Freigabe Thermostatdiagnose" VALUE 0x8196E7 KwUb 23.21 m_ub_b23p3 0.00 23.21 FORMAT "%5.2" /end CHARACTERISTIC
/begin CHARACTERISTIC IMLATDSL "min. Luftmassenfluß für Adaption/Zusatzdiagnose" VALUE 0x81AF94 KwUw 23.30133 m_uw_b23p3 0.00 23.30133 FORMAT "%8.5" /end CHARACTERISTIC
/begin CHARACTERISTIC IMLATDSLK "min. Luftmassenfluß für Kurztest" VALUE 0x81AF96 KwUw 23.30133 m_uw_b23p3 0.00 23.30133 FORMAT "%8.5" /end CHARACTERISTIC
/begin CHARACTERISTIC IMLDSL "minimale durchgeströmte Luftmasse" VALUE 0x81836C KwUb 0.9961 fak_ub_b1 0.00 0.9961 /end CHARACTERISTIC
/begin CHARACTERISTIC IMSDTEVA "Schwelle für Intergal des Massenstroms TEV nach längerem TE-Stop" VALUE 0x81A43E KwUb 11.32 m_ub_q0p0444 0.00 11.32 FORMAT "%5.2" /end CHARACTERISTIC
/begin CHARACTERISTIC ITWDTHMMN "Min.-Schwelle der mittleren integr. Luftmasse für Thermostatdiagnose" VALUE 0x81DF42 KwUw 9.169864 m_q0p00014 0.00 9.169864 FORMAT "%8.6" /end CHARACTERISTIC
/begin CHARACTERISTIC ITWDTHMMX "Max.-Schwelle der mittleren integr. Luftmasse für Thermostatdiagnose" VALUE 0x81DF44 KwUw 9.169864 m_q0p00014 0.00 9.169864 FORMAT "%8.6" /end CHARACTERISTIC
/begin CHARACTERISTIC KAMFZ "Segment- bzw. Messfensterbeginn bei Segmentzeiterfassung Aussetzererkennung" VALUE 0x8181C5 KwSb 1530. kw_tooth_sy -768.0 762.0 FORMAT "%5.1" /end CHARACTERISTIC
/begin CHARACTERISTIC KFAMAL_0_A "Kennfeld Absenkungsfaktor für Lur-Wert bei erkannten Mehrfachaussetzern" MAP 0x8105A1 GkfWUb 0.9961 fak_ub_b1 0.00 0.9961
 /begin AXIS_DESCR COM_AXIS rl rel_ub_q0p75 8 0.00 191.3 AXIS_PTS_REF SRL08DMUB /end AXIS_DESCR
 /begin AXIS_DESCR COM_AXIS nmot nmot_ub_q40 8 0.00 10200. AXIS_PTS_REF SNM08DMUB /end AXIS_DESCR
/end CHARACTERISTIC
/begin CHARACTERISTIC KFAMAL_1_A "Kennfeld Absenkungsfaktor für Lur-Wert bei erkannten Mehrfachaussetzern" MAP 0x8105E1 GkfWUb 0.9961 fak_ub_b1 0.00 0.9961
 /begin AXIS_DESCR COM_AXIS rl rel_ub_q0p75 8 0.00 191.3 AXIS_PTS_REF SRL08DMUB /end AXIS_DESCR
 /begin AXIS_DESCR COM_AXIS nmot nmot_ub_q40 8 0.00 10200. AXIS_PTS_REF SNM08DMUB /end AXIS_DESCR
/end CHARACTERISTIC
/begin CHARACTERISTIC KFAMAL1 "Kennfeld Absenkungsfaktor für Lur-Wert bei erkannten Mehrfachaussetzern" MAP 0x810621 GkfWUb 0.9961 fak_ub_b1 0.00 0.9961
 /begin AXIS_DESCR COM_AXIS rl rel_ub_q0p75 8 0.00 191.3 AXIS_PTS_REF SRL08DMUB /end AXIS_DESCR
 /begin AXIS_DESCR COM_AXIS nmot nmot_ub_q40 8 0.00 10200. AXIS_PTS_REF SNM08DMUB /end AXIS_DESCR
/end CHARACTERISTIC
/begin CHARACTERISTIC KFDETATE "Zündwinkelwirkungsgrad Korrektur for DTEV" MAP 0x81A43F KfAxUbAyUbSstxUbSstyUbWUb 127.5 rel_ub_b127p5 0.00 127.5 FORMAT "%5.1"
 /begin AXIS_DESCR STD_AXIS etazwist rel_ub_b127p5 4 0.00 127.5 FORMAT "%5.1" DEPOSIT ABSOLUTE /end AXIS_DESCR
 /begin AXIS_DESCR STD_AXIS dmletanu m_q0p1 6 0.00 25.50 FORMAT "%5.2" DEPOSIT ABSOLUTE /end AXIS_DESCR
/end CHARACTERISTIC
/begin CHARACTERISTIC KFFWL_0_A "Kennfeld Warmlauffaktor" MAP 0x818B4D GkfWUb 1.992 fak_ub_b2 0.00 1.992 FORMAT "%5.3"
 /begin AXIS_DESCR COM_AXIS tmot temp_ub_q0p75_o48 12 -48.00 143.3 AXIS_PTS_REF STM12ESUB /end AXIS_DESCR
 /begin AXIS_DESCR COM_AXIS tmst temp_ub_q0p75_o48 12 -48.00 143.3 AXIS_PTS_REF STS12ESUB /end AXIS_DESCR
/end CHARACTERISTIC
/begin CHARACTERISTIC KFFWL_1_A "Kennfeld Warmlauffaktor" MAP 0x818BDD GkfWUb 1.992 fak_ub_b2 0.00 1.992 FORMAT "%5.3"
 /begin AXIS_DESCR COM_AXIS tmot temp_ub_q0p75_o48 12 -48.00 143.3 AXIS_PTS_REF STM12ESUB /end AXIS_DESCR
 /begin AXIS_DESCR COM_AXIS tmst temp_ub_q0p75_o48 12 -48.00 143.3 AXIS_PTS_REF STS12ESUB /end AXIS_DESCR
/end CHARACTERISTIC
/begin CHARACTERISTIC KFFWL_2_A "Kennfeld Warmlauffaktor" MAP 0x818C6D GkfWUb 1.992 fak_ub_b2 0.00 1.992 FORMAT "%5.3"
 /begin AXIS_DESCR COM_AXIS tmot temp_ub_q0p75_o48 12 -48.00 143.3 AXIS_PTS_REF STM12ESUB /end AXIS_DESCR
 /begin AXIS_DESCR COM_AXIS tmst temp_ub_q0p75_o48 12 -48.00 143.3 AXIS_PTS_REF STS12ESUB /end AXIS_DESCR
/end CHARACTERISTIC
/begin CHARACTERISTIC KFFWL_3_A "Kennfeld Warmlauffaktor" MAP 0x818CFD GkfWUb 1.992 fak_ub_b2 0.00 1.992 FORMAT "%5.3"
 /begin AXIS_DESCR COM_AXIS tmot temp_ub_q0p75_o48 12 -48.00 143.3 AXIS_PTS_REF STM12ESUB /end AXIS_DESCR
 /begin AXIS_DESCR COM_AXIS tmst temp_ub_q0p75_o48 12 -48.00 143.3 AXIS_PTS_REF STS12ESUB /end AXIS_DESCR
/end CHARACTERISTIC
/begin CHARACTERISTIC KFFWLRL_0_A "Kennfeld Warmlauffaktor lastabhängiger Anteil" MAP 0x810ECC GkfWUb 1.992 fak_ub_b2 0.00 1.992 FORMAT "%5.3"
 /begin AXIS_DESCR COM_AXIS tmst temp_ub_q0p75_o48 8 -48.00 143.3 AXIS_PTS_REF STS08ESUB /end AXIS_DESCR
 /begin AXIS_DESCR COM_AXIS rlp rel_ub_q0p75 6 0.00 191.3 AXIS_PTS_REF SRP06ESUB /end AXIS_DESCR
/end CHARACTERISTIC
/begin CHARACTERISTIC KFFWLRL_1_A "Kennfeld Warmlauffaktor lastabhängiger Anteil" MAP 0x810EFC GkfWUb 1.992 fak_ub_b2 0.00 1.992 FORMAT "%5.3"
 /begin AXIS_DESCR COM_AXIS tmst temp_ub_q0p75_o48 8 -48.00 143.3 AXIS_PTS_REF STS08ESUB /end AXIS_DESCR
 /begin AXIS_DESCR COM_AXIS rlp rel_ub_q0p75 6 0.00 191.3 AXIS_PTS_REF SRP06ESUB /end AXIS_DESCR
/end CHARACTERISTIC
/begin CHARACTERISTIC KFFWLW_0_A "Kennfeld Wichtung Warmlauffaktor" MAP 0x818D8D GkfWUb 1.992 fak_ub_b2 0.00 1.992 FORMAT "%5.3"
 /begin AXIS_DESCR COM_AXIS nmot nmot_ub_q40 6 0.00 10200. AXIS_PTS_REF SNM06ESUB /end AXIS_DESCR
 /begin AXIS_DESCR COM_AXIS rlp rel_ub_q0p75 6 0.00 191.3 AXIS_PTS_REF SRP06ESUB /end AXIS_DESCR
/end CHARACTERISTIC
/begin CHARACTERISTIC KFFWLW_1_A "Kennfeld Wichtung Warmlauffaktor" MAP 0x818DB1 GkfWUb 1.992 fak_ub_b2 0.00 1.992 FORMAT "%5.3"
 /begin AXIS_DESCR COM_AXIS nmot nmot_ub_q40 6 0.00 10200. AXIS_PTS_REF SNM06ESUB /end AXIS_DESCR
 /begin AXIS_DESCR COM_AXIS rlp rel_ub_q0p75 6 0.00 191.3 AXIS_PTS_REF SRP06ESUB /end AXIS_DESCR
/end CHARACTERISTIC
/begin CHARACTERISTIC KFFWLW_2_A "Kennfeld Wichtung Warmlauffaktor" MAP 0x818DD5 GkfWUb 1.992 fak_ub_b2 0.00 1.992 FORMAT "%5.3"
 /begin AXIS_DESCR COM_AXIS nmot nmot_ub_q40 6 0.00 10200. AXIS_PTS_REF SNM06ESUB /end AXIS_DESCR
 /begin AXIS_DESCR COM_AXIS rlp rel_ub_q0p75 6 0.00 191.3 AXIS_PTS_REF SRP06ESUB /end AXIS_DESCR
/end CHARACTERISTIC
/begin CHARACTERISTIC KFFWLW_3_A "Kennfeld Wichtung Warmlauffaktor" MAP 0x818DF9 GkfWUb 1.992 fak_ub_b2 0.00 1.992 FORMAT "%5.3"
 /begin AXIS_DESCR COM_AXIS nmot nmot_ub_q40 6 0.00 10200. AXIS_PTS_REF SNM06ESUB /end AXIS_DESCR
 /begin AXIS_DESCR COM_AXIS rlp rel_ub_q0p75 6 0.00 191.3 AXIS_PTS_REF SRP06ESUB /end AXIS_DESCR
/end CHARACTERISTIC
/begin CHARACTERISTIC KFKSWF "Kennfeld für Kat.-Schutz-Wichtungsfaktoren" MAP 0x81089B KfAxUbAyUbSstxUbSstyUbWUb 255.0 dez 0.00 255.0 FORMAT "%5.1"
 /begin AXIS_DESCR STD_AXIS nmot nmot_ub_q40 6 0.00 10200. FORMAT "%5.0" DEPOSIT ABSOLUTE /end AXIS_DESCR
 /begin AXIS_DESCR STD_AXIS rl rel_ub_q0p75 6 0.00 191.3 FORMAT "%5.1" DEPOSIT ABSOLUTE /end AXIS_DESCR
/end CHARACTERISTIC
/begin CHARACTERISTIC KFLF "Lambdakennfeld bei Teillast" MAP 0x8189B8 KfAxUbAyUbSstxUbSstyUbWUb 1.992 fak_ub_b2 0.00 1.992 FORMAT "%5.3"
 /begin AXIS_DESCR STD_AXIS nmot nmot_ub_q40 12 0.00 10200. FORMAT "%5.0" DEPOSIT ABSOLUTE /end AXIS_DESCR
 /begin AXIS_DESCR STD_AXIS rl rel_ub_q0p75 16 0.00 191.3 FORMAT "%5.1" DEPOSIT ABSOLUTE /end AXIS_DESCR
/end CHARACTERISTIC
/begin CHARACTERISTIC KFLUAR_0_A "Kennfeld für Laufunruhe-Abstandsmass-Referenzwert" MAP 0x810269 GkfWUb 172.5 luquant 0.00 172.5 FORMAT "%5.1"
 /begin AXIS_DESCR COM_AXIS rl rel_ub_q0p75 8 0.00 191.3 AXIS_PTS_REF SRL08DMUB /end AXIS_DESCR
 /begin AXIS_DESCR COM_AXIS nmot nmot_ub_q40 8 0.00 10200. AXIS_PTS_REF SNM08DMUB /end AXIS_DESCR
/end CHARACTERISTIC
/begin CHARACTERISTIC KFLUAR_1_A "Kennfeld für Laufunruhe-Abstandsmass-Referenzwert" MAP 0x8102A9 GkfWUb 172.5 luquant 0.00 172.5 FORMAT "%5.1"
 /begin AXIS_DESCR COM_AXIS rl rel_ub_q0p75 8 0.00 191.3 AXIS_PTS_REF SRL08DMUB /end AXIS_DESCR
 /begin AXIS_DESCR COM_AXIS nmot nmot_ub_q40 8 0.00 10200. AXIS_PTS_REF SNM08DMUB /end AXIS_DESCR
/end CHARACTERISTIC
/begin CHARACTERISTIC KFLUAR1 "Kennfeld für Laufunruhe-Abstandsmass-Referenzwert" MAP 0x8102E9 GkfWUb 172.5 luquant 0.00 172.5 FORMAT "%5.1"
 /begin AXIS_DESCR COM_AXIS rl rel_ub_q0p75 8 0.00 191.3 AXIS_PTS_REF SRL08DMUB /end AXIS_DESCR
 /begin AXIS_DESCR COM_AXIS nmot nmot_ub_q40 8 0.00 10200. AXIS_PTS_REF SNM08DMUB /end AXIS_DESCR
/end CHARACTERISTIC
/begin CHARACTERISTIC KFLUAR2 "Kennfeld für Laufunruhe-Abstandsmass-Referenzwert" MAP 0x810329 GkfWUb 172.5 luquant 0.00 172.5 FORMAT "%5.1"
 /begin AXIS_DESCR COM_AXIS rl rel_ub_q0p75 8 0.00 191.3 AXIS_PTS_REF SRL08DMUB /end AXIS_DESCR
 /begin AXIS_DESCR COM_AXIS nmot nmot_ub_q40 8 0.00 10200. AXIS_PTS_REF SNM08DMUB /end AXIS_DESCR
/end CHARACTERISTIC
/begin CHARACTERISTIC KFLUARZ "Kennfeld für Laufunruhe-Abstandsmass-Referenzwert bei ZAS" MAP 0x810369 GkfWUb 172.5 luquant 0.00 172.5 FORMAT "%5.1"
 /begin AXIS_DESCR COM_AXIS rl rel_ub_q0p75 8 0.00 191.3 AXIS_PTS_REF SRL08DMUB /end AXIS_DESCR
 /begin AXIS_DESCR COM_AXIS nmot nmot_ub_q40 8 0.00 10200. AXIS_PTS_REF SNM08DMUB /end AXIS_DESCR
/end CHARACTERISTIC
/begin CHARACTERISTIC KFLURB_0_A "Kennfeld für Laufunruhe-Referenz-Basiswert" MAP 0x810661 GkfWSb 172.5 luquant -86.57 85.89 FORMAT "%5.2"
 /begin AXIS_DESCR COM_AXIS rl rel_ub_q0p75 8 0.00 191.3 AXIS_PTS_REF SRL08DMUB /end AXIS_DESCR
 /begin AXIS_DESCR COM_AXIS nmot nmot_ub_q40 8 0.00 10200. AXIS_PTS_REF SNM08DMUB /end AXIS_DESCR
/end CHARACTERISTIC
/begin CHARACTERISTIC KFLURB_1_A "Kennfeld für Laufunruhe-Referenz-Basiswert" MAP 0x8106A1 GkfWSb 172.5 luquant -86.57 85.89 FORMAT "%5.2"
 /begin AXIS_DESCR COM_AXIS rl rel_ub_q0p75 8 0.00 191.3 AXIS_PTS_REF SRL08DMUB /end AXIS_DESCR
 /begin AXIS_DESCR COM_AXIS nmot nmot_ub_q40 8 0.00 10200. AXIS_PTS_REF SNM08DMUB /end AXIS_DESCR
/end CHARACTERISTIC
/begin CHARACTERISTIC KFLURB1 "Kennfeld für Laufunruhe-Referenz-Basiswert" MAP 0x8106E1 GkfWSb 172.5 luquant -86.57 85.89 FORMAT "%5.2"
 /begin AXIS_DESCR COM_AXIS rl rel_ub_q0p75 8 0.00 191.3 AXIS_PTS_REF SRL08DMUB /end AXIS_DESCR
 /begin AXIS_DESCR COM_AXIS nmot nmot_ub_q40 8 0.00 10200. AXIS_PTS_REF SNM08DMUB /end AXIS_DESCR
/end CHARACTERISTIC
/begin CHARACTERISTIC KFLURB2 "Kennfeld für Laufunruhe-Referenz-Basiswert" MAP 0x810721 GkfWSb 172.5 luquant -86.57 85.89 FORMAT "%5.2"
 /begin AXIS_DESCR COM_AXIS rl rel_ub_q0p75 8 0.00 191.3 AXIS_PTS_REF SRL08DMUB /end AXIS_DESCR
 /begin AXIS_DESCR COM_AXIS nmot nmot_ub_q40 8 0.00 10200. AXIS_PTS_REF SNM08DMUB /end AXIS_DESCR
/end CHARACTERISTIC
/begin CHARACTERISTIC KFLURBZ "Kennfeld für Laufunruhe-Referenz-Basiswert bei ZAS" MAP 0x810761 GkfWSb 172.5 luquant -86.57 85.89 FORMAT "%5.2"
 /begin AXIS_DESCR COM_AXIS rl rel_ub_q0p75 8 0.00 191.3 AXIS_PTS_REF SRL08DMUB /end AXIS_DESCR
 /begin AXIS_DESCR COM_AXIS nmot nmot_ub_q40 8 0.00 10200. AXIS_PTS_REF SNM08DMUB /end AXIS_DESCR
/end CHARACTERISTIC
/begin CHARACTERISTIC KFLURM_0_A "Kennfeld für Laufunruhe-Referenzwert zur Mehrfachaussetzererkennung ->Lum-Vergl." MAP 0x8107A1 GkfWSb 172.5 luquant -86.57 85.89 FORMAT "%5.2"
 /begin AXIS_DESCR COM_AXIS rl rel_ub_q0p75 8 0.00 191.3 AXIS_PTS_REF SRL08DMUB /end AXIS_DESCR
 /begin AXIS_DESCR COM_AXIS nmot nmot_ub_q40 8 0.00 10200. AXIS_PTS_REF SNM08DMUB /end AXIS_DESCR
/end CHARACTERISTIC
/begin CHARACTERISTIC KFLURM_1_A "Kennfeld für Laufunruhe-Referenzwert zur Mehrfachaussetzererkennung ->Lum-Vergl." MAP 0x8107E1 GkfWSb 172.5 luquant -86.57 85.89 FORMAT "%5.2"
 /begin AXIS_DESCR COM_AXIS rl rel_ub_q0p75 8 0.00 191.3 AXIS_PTS_REF SRL08DMUB /end AXIS_DESCR
 /begin AXIS_DESCR COM_AXIS nmot nmot_ub_q40 8 0.00 10200. AXIS_PTS_REF SNM08DMUB /end AXIS_DESCR
/end CHARACTERISTIC
/begin CHARACTERISTIC KFLURM1 "Kennfeld für Laufunruhe-Referenzwert zur Mehrfachaussetzererkennung ->Lum-Vergl." MAP 0x810821 GkfWSb 172.5 luquant -86.57 85.89 FORMAT "%5.2"
 /begin AXIS_DESCR COM_AXIS rl rel_ub_q0p75 8 0.00 191.3 AXIS_PTS_REF SRL08DMUB /end AXIS_DESCR
 /begin AXIS_DESCR COM_AXIS nmot nmot_ub_q40 8 0.00 10200. AXIS_PTS_REF SNM08DMUB /end AXIS_DESCR
/end CHARACTERISTIC
/begin CHARACTERISTIC KFNSA_0_A "Nachstartanhebung" MAP 0x818E1D KfAxUbAyUbSstxUbSstyUbWUb 1.992 fak_ub_b2 0.00 1.992 FORMAT "%5.3"
 /begin AXIS_DESCR STD_AXIS tans temp_ub_q0p75_o48 6 -48.00 143.3 FORMAT "%5.1" DEPOSIT ABSOLUTE /end AXIS_DESCR
 /begin AXIS_DESCR STD_AXIS tmot temp_ub_q0p75_o48 3 -48.00 143.3 FORMAT "%5.1" DEPOSIT ABSOLUTE /end AXIS_DESCR
/end CHARACTERISTIC
/begin CHARACTERISTIC KFNSA_1_A "Nachstartanhebung" MAP 0x818E3A KfAxUbAyUbSstxUbSstyUbWUb 1.992 fak_ub_b2 0.00 1.992 FORMAT "%5.3"
 /begin AXIS_DESCR STD_AXIS tans temp_ub_q0p75_o48 6 -48.00 143.3 FORMAT "%5.1" DEPOSIT ABSOLUTE /end AXIS_DESCR
 /begin AXIS_DESCR STD_AXIS tmot temp_ub_q0p75_o48 3 -48.00 143.3 FORMAT "%5.1" DEPOSIT ABSOLUTE /end AXIS_DESCR
/end CHARACTERISTIC
/begin CHARACTERISTIC KFNSWRL_0_A "Wichtung Nachstartanhebung" MAP 0x810F2C GkfWUb 1.992 fak_ub_b2 0.00 1.992 FORMAT "%5.3"
 /begin AXIS_DESCR COM_AXIS tmst temp_ub_q0p75_o48 8 -48.00 143.3 AXIS_PTS_REF STS08ESUB /end AXIS_DESCR
 /begin AXIS_DESCR COM_AXIS rlp rel_ub_q0p75 6 0.00 191.3 AXIS_PTS_REF SRP06ESUB /end AXIS_DESCR
/end CHARACTERISTIC
/begin CHARACTERISTIC KFNSWRL_1_A "Wichtung Nachstartanhebung" MAP 0x810F5C GkfWUb 1.992 fak_ub_b2 0.00 1.992 FORMAT "%5.3"
 /begin AXIS_DESCR COM_AXIS tmst temp_ub_q0p75_o48 8 -48.00 143.3 AXIS_PTS_REF STS08ESUB /end AXIS_DESCR
 /begin AXIS_DESCR COM_AXIS rlp rel_ub_q0p75 6 0.00 191.3 AXIS_PTS_REF SRP06ESUB /end AXIS_DESCR
/end CHARACTERISTIC
/begin CHARACTERISTIC KFTVFRR "Kennfeld: Lambda-Regler nach dieser Zeit auf Referenzwert zurücksetzen" MAP 0x81A463 KfAxUbAyUbSstxUbSstyUbWUb 25.50 t100msxs_ub_b25p5 0.00 25.50 FORMAT "%5.2"
 /begin AXIS_DESCR STD_AXIS tadteazs rel_ub_b99p6 4 0.00 99.61 FORMAT "%5.2" DEPOSIT ABSOLUTE /end AXIS_DESCR
 /begin AXIS_DESCR STD_AXIS ml m_ub_b1020 3 0.00 1020. FORMAT "%5.0" DEPOSIT ABSOLUTE /end AXIS_DESCR
/end CHARACTERISTIC
/begin CHARACTERISTIC KFTWDTHM "Kennfeld Wartezeitvorgabe für Motorerwärmung bis Thermostatdiagnose" MAP 0x81DF46 KfAxUbAyUbSstxUwSstyUwWUw 655.3500 t10msxs_uw_b655p35 0.00 655.3500 FORMAT "%8.4"
 /begin AXIS_DESCR STD_AXIS tmst temp_ub_q0p75_o48 5 -48.00000 49103.25 FORMAT "%8.2" DEPOSIT ABSOLUTE /end AXIS_DESCR
 /begin AXIS_DESCR STD_AXIS tamb temp_ub_q0p75_o48 5 -48.00000 49103.25 FORMAT "%8.2" DEPOSIT ABSOLUTE /end AXIS_DESCR
/end CHARACTERISTIC
/begin CHARACTERISTIC KFWLHO "Kennfeld für Höhenabhängigkeit des Warmlauffaktors" MAP 0x810F8C GkfWUb 1.992 fak_ub_b2 0.00 1.992 FORMAT "%5.3" /begin AXIS_DESCR COM_AXIS fho fak_ub_b4 4 0.00 3.984 AXIS_PTS_REF FHO04ESUB /end AXIS_DESCR
 /begin AXIS_DESCR COM_AXIS rlp rel_ub_q0p75 6 0.00 191.3 AXIS_PTS_REF SRP06ESUB /end AXIS_DESCR
/end CHARACTERISTIC
/begin CHARACTERISTIC KFWSTAARL "Wichtung Nachstart mit Startadaption und Relativer Luftmasse" MAP 0x818E57 GkfWUb 3.984 fak_ub_b4 0.00 3.984 FORMAT "%5.3"
 /begin AXIS_DESCR COM_AXIS kstaa fak_ub_b2 6 0.00 1.992 AXIS_PTS_REF SKS06ESUB /end AXIS_DESCR
 /begin AXIS_DESCR COM_AXIS rlp rel_ub_q0p75 6 0.00 191.3 AXIS_PTS_REF SRP06ESUB /end AXIS_DESCR
/end CHARACTERISTIC
/begin CHARACTERISTIC KFWWLML "Kennfeld Wichtung Warmlauffaktor" MAP 0x810FA4 GkfWUb 1.992 fak_ub_b2 0.00 1.992 FORMAT "%5.3"
 /begin AXIS_DESCR COM_AXIS imlatm_w m_uw_b23p3 6 0.00 23.30133 AXIS_PTS_REF SIM06ESUW /end AXIS_DESCR
 /begin AXIS_DESCR COM_AXIS tmst temp_ub_q0p75_o48 8 -48.00 143.3 AXIS_PTS_REF STS08ESUB /end AXIS_DESCR
/end CHARACTERISTIC
/begin CHARACTERISTIC KFWWNS "Wiederholstartzeitfaktor" MAP 0x81D6CE KfAxUbAyUbSstxUbSstyUwWUb 1.992 fak_ub_b2 0.00 1.992 FORMAT "%5.3"
 /begin AXIS_DESCR STD_AXIS tmst temp_ub_q0p75_o48 8 -48.00 143.3 FORMAT "%5.1" DEPOSIT ABSOLUTE /end AXIS_DESCR
 /begin AXIS_DESCR STD_AXIS tabst_w t1sxs_uw_q1 8 0.00 65535.00 FORMAT "%8.2" DEPOSIT ABSOLUTE /end AXIS_DESCR
/end CHARACTERISTIC
/begin CHARACTERISTIC KIDMSNTE "Integrationsgeschwindigkeit für die Berechnung der Massenstromänderung TEV" VALUE 0x827FA2 KwUw 127.9980 m_q0p00195 0.00 127.9980 FORMAT "%8.4" /end CHARACTERISTIC
/begin CHARACTERISTIC KIRMSMS "Integrationsgeschwindigkeit Abgleich Massenstrom TEV mit berechnetem Massenstrom" CURVE 0x8176FE KlAUbSstUbWUw 2498.970 fak_q0p03815 0.9918213 2499.962 FORMAT "%8.3"
 /begin AXIS_DESCR STD_AXIS mstedte m_ub_b25p6 4 0.00 25.50 FORMAT "%5.2" DEPOSIT ABSOLUTE /end AXIS_DESCR
/end CHARACTERISTIC
/begin CHARACTERISTIC KLMLDSLAMX "max. Luftmasse für Bedingung Adaption/Zusatzdiagnose (16 Bit)" CURVE 0x81AF98 KlAUwSstUwWUw 6553.500 m_q0p1 0.00 6553.500 FORMAT "%8.3"
 /begin AXIS_DESCR STD_AXIS fho_w fak_uw_b4 5 0.00 3.999939 FORMAT "%8.6" DEPOSIT ABSOLUTE /end AXIS_DESCR
/end CHARACTERISTIC
/begin CHARACTERISTIC KLMLDSLKMX "max. Luftmasse für Bedingung Kurztest-Diagnose (16 Bit)" CURVE 0x81AFAE KlAUwSstUwWUw 6553.500 m_q0p1 0.00 6553.500 FORMAT "%8.3"
 /begin AXIS_DESCR STD_AXIS fho_w fak_uw_b4 5 0.00 3.999939 FORMAT "%8.6" DEPOSIT ABSOLUTE /end AXIS_DESCR
/end CHARACTERISTIC
/begin CHARACTERISTIC KLMLDSLMX "max. Luftmasse für Bedingung Diagnose (16 Bit)" CURVE 0x81AFC4 KlAUwSstUwWUw 6553.500 m_q0p1 0.00 6553.500 FORMAT "%8.3"
 /begin AXIS_DESCR STD_AXIS fho_w fak_uw_b4 5 0.00 3.999939 FORMAT "%8.6" DEPOSIT ABSOLUTE /end AXIS_DESCR
/end CHARACTERISTIC
/begin CHARACTERISTIC KLMLDSLOMX "max. Luftmasse für Bedingung frm-Offset-Messung (16 Bit)" CURVE 0x81AFDA KlAUwSstUwWUw 6553.500 m_q0p1 0.00 6553.500 FORMAT "%8.3"
 /begin AXIS_DESCR STD_AXIS fho_w fak_uw_b4 5 0.00 3.999939 FORMAT "%8.6" DEPOSIT ABSOLUTE /end AXIS_DESCR
/end CHARACTERISTIC
/begin CHARACTERISTIC KLRLSALULL "Lastschwelle zur Schuberkennung für Ausblendung der Aussetzererkennung im LL" CURVE 0x810501 GklWUb 191.3 rel_ub_q0p75 0.00 191.3 FORMAT "%5.1"
 /begin AXIS_DESCR COM_AXIS nmot nmot_ub_q40 8 0.00 10200. AXIS_PTS_REF SNM08DMUB /end AXIS_DESCR
/end CHARACTERISTIC
/begin CHARACTERISTIC KLTALUST "Zeitdauer Ausblendung der Aussetzererkennung nach Motorstart" CURVE 0x81BB66 KlAUbSstUbWUw 655.3500 t10msxs_uw_b655p35 0.00 655.3500 FORMAT "%8.4"
 /begin AXIS_DESCR STD_AXIS tmst temp_ub_q0p75_o48 4 -48.00 143.3 FORMAT "%5.1" DEPOSIT ABSOLUTE /end AXIS_DESCR
/end CHARACTERISTIC
/begin CHARACTERISTIC KLZANSFHO "Kennlinie für Höhenkorrektur der Zeitkonstante zur Nachstartabregelung" CURVE 0x818E7B KlAUbSstUbWUb 3.984 fak_ub_b4 0.00 3.984 FORMAT "%5.3"
 /begin AXIS_DESCR STD_AXIS fho fak_ub_b4 8 0.00 3.984 FORMAT "%5.3" DEPOSIT ABSOLUTE /end AXIS_DESCR
/end CHARACTERISTIC
/begin CHARACTERISTIC KMDTHMMN "Minimale Fahrtstrecke für Thermostatdiagnose" VALUE 0x8196E8 KwUb 25.50 km_ub_q0p10 0.00 25.50 FORMAT "%5.2" /end CHARACTERISTIC
/begin CHARACTERISTIC KMDTHMMX "Max. Fahrtstrecke für Thermostatdiagnose" VALUE 0x8196E9 KwUb 25.50 km_ub_q0p10 0.00 25.50 FORMAT "%5.2" /end CHARACTERISTIC
/begin CHARACTERISTIC LURBRL8_0_A "Laufunruhe-Referenzwert bei Fahrzeug steht" CURVE 0x81BB78 KlAUbSstUbWSb 172.5 luquant -86.57 85.89 FORMAT "%5.2"
 /begin AXIS_DESCR STD_AXIS rl rel_ub_q0p75 8 0.00 191.3 FORMAT "%5.1" DEPOSIT ABSOLUTE /end AXIS_DESCR
/end CHARACTERISTIC
/begin CHARACTERISTIC LURBRL8_1_A "Laufunruhe-Referenzwert bei Fahrzeug steht" CURVE 0x81BB8A KlAUbSstUbWSb 172.5 luquant -86.57 85.89 FORMAT "%5.2"
 /begin AXIS_DESCR STD_AXIS rl rel_ub_q0p75 8 0.00 191.3 FORMAT "%5.1" DEPOSIT ABSOLUTE /end AXIS_DESCR
/end CHARACTERISTIC
/begin CHARACTERISTIC LURKH_0_A "dmrkh-abh. Laufunruhe-Referenzkorrekturwert, bei Katheizen" CURVE 0x818428 KlAUbSstUbWUb 1.992 fak_ub_b2 0.00 1.992 FORMAT "%5.3"
 /begin AXIS_DESCR STD_AXIS dmrkh rel_ub_b99p6 4 0.00 99.61 FORMAT "%5.2" DEPOSIT ABSOLUTE /end AXIS_DESCR
/end CHARACTERISTIC
/begin CHARACTERISTIC LURKH_1_A "dmrkh-abh. Laufunruhe-Referenzkorrekturwert, bei Katheizen" CURVE 0x818431 KlAUbSstUbWUb 1.992 fak_ub_b2 0.00 1.992 FORMAT "%5.3"
 /begin AXIS_DESCR STD_AXIS dmrkh rel_ub_b99p6 4 0.00 99.61 FORMAT "%5.2" DEPOSIT ABSOLUTE /end AXIS_DESCR
/end CHARACTERISTIC
/begin CHARACTERISTIC LURKTM "Tmot-abhängiger Laufunruhe-Referenz-Korrekturwert" CURVE 0x810861 GklWSb 172.5 luquant -86.57 85.89 FORMAT "%5.2"
 /begin AXIS_DESCR COM_AXIS tmot temp_ub_q0p75_o48 8 -48.00 143.3 AXIS_PTS_REF STM08DMUB /end AXIS_DESCR
/end CHARACTERISTIC
/begin CHARACTERISTIC LURMIN1_0_A "Drehzahlabh. Laufunruhe-Referenz-Minimalwert 1" CURVE 0x810869 GklWSb 172.5 luquant -86.57 85.89 FORMAT "%5.2"
 /begin AXIS_DESCR COM_AXIS nmot nmot_ub_q40 8 0.00 10200. AXIS_PTS_REF SNM08DMUB /end AXIS_DESCR
/end CHARACTERISTIC
/begin CHARACTERISTIC LURMIN1_1_A "Drehzahlabh. Laufunruhe-Referenz-Minimalwert 1" CURVE 0x810871 GklWSb 172.5 luquant -86.57 85.89 FORMAT "%5.2"
 /begin AXIS_DESCR COM_AXIS nmot nmot_ub_q40 8 0.00 10200. AXIS_PTS_REF SNM08DMUB /end AXIS_DESCR
/end CHARACTERISTIC
/begin CHARACTERISTIC LURMIN2_0_A "Drehzahlabh. Laufunruhe-Referenz-Minimalwert 2" CURVE 0x810879 GklWSb 172.5 luquant -86.57 85.89 FORMAT "%5.2"
 /begin AXIS_DESCR COM_AXIS nmot nmot_ub_q40 8 0.00 10200. AXIS_PTS_REF SNM08DMUB /end AXIS_DESCR
/end CHARACTERISTIC
/begin CHARACTERISTIC LURMIN2_1_A "Drehzahlabh. Laufunruhe-Referenz-Minimalwert 2" CURVE 0x810881 GklWSb 172.5 luquant -86.57 85.89 FORMAT "%5.2"
 /begin AXIS_DESCR COM_AXIS nmot nmot_ub_q40 8 0.00 10200. AXIS_PTS_REF SNM08DMUB /end AXIS_DESCR
/end CHARACTERISTIC
/begin CHARACTERISTIC LURMIN3 "Drehzahlabh. Laufunruhe-Referenz-Minimalwert 3" CURVE 0x810889 GklWSb 172.5 luquant -86.57 85.89 FORMAT "%5.2"
 /begin AXIS_DESCR COM_AXIS nmot nmot_ub_q40 8 0.00 10200. AXIS_PTS_REF SNM08DMUB /end AXIS_DESCR
/end CHARACTERISTIC
/begin CHARACTERISTIC LURMINKH "Laufunruhe Referenz-Minimalwert bei Katheizen" VALUE 0x810891 KwSb 85.89 luquant 0.00 85.89 FORMAT "%5.2" /end CHARACTERISTIC
/begin CHARACTERISTIC LURST "Laufunruhe-Referenzwertkorrektur nach Start" CURVE 0x81843A KlAUbSstUbWUb 1.992 fak_ub_b2 0.00 1.992 FORMAT "%5.3"
 /begin AXIS_DESCR STD_AXIS tnstmd t40msxs_ub_q0p04 6 0.00 10.20 FORMAT "%5.2" DEPOSIT ABSOLUTE /end AXIS_DESCR
/end CHARACTERISTIC
/begin CHARACTERISTIC MILANTI "MIL ist bei ti-Abschaltung an, auch im 1.dcy" VALUE 0x8108CD KwUb 1.000 dez 0.00 1.000 FORMAT "%5.3" /end CHARACTERISTIC
/begin CHARACTERISTIC MLDTEFPF "Schwelle Motorluftmasse für Freigabe Überprüfung Diagnose DTEV passiv möglich" VALUE 0x827FA4 KwUw 80.00000 m_q0p1 0.00 80.00000 FORMAT "%8.5" /end CHARACTERISTIC
/begin CHARACTERISTIC MLDTEPF "Schwelle Motorluftmasse für Freigabe Diagnose DTEV passiv möglich" VALUE 0x827FA6 KwUw 80.00000 m_q0p1 0.00 80.00000 FORMAT "%8.5" /end CHARACTERISTIC
/begin CHARACTERISTIC MLWDSLAMN "min. Luftmasse für Bedingung Adaption/Zusatzdiagnose (16 Bit)" VALUE 0x81AFF0 KwUw 6553.500 m_uw_b6553p5 0.00 6553.500 FORMAT "%8.3" /end CHARACTERISTIC
/begin CHARACTERISTIC MLWDSLKMN "min. Luftmasse für Bedingung Kurztest-Diagnose (16 Bit)" VALUE 0x81AFF2 KwUw 6553.500 m_uw_b6553p5 0.00 6553.500 FORMAT "%8.3" /end CHARACTERISTIC
/begin CHARACTERISTIC MLWDSLMN "min. Luftmasse für Bedingung Diagnose (16 Bit)" VALUE 0x81AFF4 KwUw 6553.500 m_uw_b6553p5 0.00 6553.500 FORMAT "%8.3" /end CHARACTERISTIC
/begin CHARACTERISTIC MLWDSLOMN "min. Luftmasse für Bedingung frm-Offset-Messung (16 Bit)" VALUE 0x81AFF6 KwUw 6553.500 m_uw_b6553p5 0.00 6553.500 FORMAT "%8.3" /end CHARACTERISTIC
/begin CHARACTERISTIC MSLBAS "Ini.- Sekundärluftmasse" VALUE 0x81836D KwUb 102.0 m_q0p4 0.00 102.0 FORMAT "%5.1" /end CHARACTERISTIC
/begin CHARACTERISTIC MSLVMX "Diagnoseschwelle für Ventildichtheitsprüfung" VALUE 0x81AFF8 KwUw 102.3984 m_q0p0015625 0.00 102.3984 FORMAT "%8.4" /end CHARACTERISTIC
/begin CHARACTERISTIC MSLVMXK "Diagnoseschwelle für Ventildichtheitsprüfung bei Kurztest" VALUE 0x81AFFA KwUw 102.3984 m_q0p0015625 0.00 102.3984 FORMAT "%8.4" /end CHARACTERISTIC
/begin CHARACTERISTIC MSLVMXX "Diagnoseschwelle für absoluten Fehler Ventildichtheit" VALUE 0x81AFFC KwUw 102.3984 m_q0p0015625 0.00 102.3984 FORMAT "%8.4" /end CHARACTERISTIC
/begin CHARACTERISTIC MSLVMXXK "Diagnoseschwelle für absoluten Fehler Ventildichtheit bei Kurztest" VALUE 0x81AFFE KwUw 102.3984 m_q0p0015625 0.00 102.3984 FORMAT "%8.4" /end CHARACTERISTIC
/begin CHARACTERISTIC NDTHMU "untere Drehzahlschwelle für Freigabe Thermostatdiagnose" VALUE 0x8196EA KwUb 10200. nmot_ub_q40 0.00 10200. FORMAT "%5.0" /end CHARACTERISTIC
/begin CHARACTERISTIC NDV "Fehlererkennung Tachosignal / Drehzahlschwelle minimal" VALUE 0x8186E9 KwUb 10200. nmot_ub_q40 0.00 10200. FORMAT "%5.0" /end CHARACTERISTIC
/begin CHARACTERISTIC NDVO "Fehlererkennung Fz-Geschwindigkeitssignal, obere Drehzahlgrenze" VALUE 0x8186EA KwUb 10200. nmot_ub_q40 0.00 10200. FORMAT "%5.0" /end CHARACTERISTIC
/begin CHARACTERISTIC NFLUV "Drehzahlschwelle der Modifikation der Laufunruhe-Berechnung" VALUE 0x810892 KwUb 10200. nmot_ub_q40 0.00 10200. FORMAT "%5.0" /end CHARACTERISTIC
/begin CHARACTERISTIC NGALU_0_A "Misfire Detection : Schwelle Drehzahländerung für Ausblendung" CURVE 0x81373E GklWUw 12799.77 nmotg_sw_q0p39 0.00 12799.77 FORMAT "%8.2"
 /begin AXIS_DESCR COM_AXIS nmot nmot_ub_q40 8 0.00 10200. AXIS_PTS_REF SNM08DMUB /end AXIS_DESCR
/end CHARACTERISTIC
/begin CHARACTERISTIC NGALU_1_A "Misfire Detection : Schwelle Drehzahländerung für Ausblendung" CURVE 0x81374E GklWUw 12799.77 nmotg_sw_q0p39 0.00 12799.77 FORMAT "%8.2"
 /begin AXIS_DESCR COM_AXIS nmot nmot_ub_q40 8 0.00 10200. AXIS_PTS_REF SNM08DMUB /end AXIS_DESCR
/end CHARACTERISTIC
/begin CHARACTERISTIC NGALUST_0_A "Misfire Detection : Schwelle Drehzahländerung für Ausblendung nach Start" VALUE 0x813762 KwUw 12799.77 nmotg_sw_q0p39 0.00 12799.77 FORMAT "%8.2" /end CHARACTERISTIC
/begin CHARACTERISTIC NGALUST_1_A "Misfire Detection : Schwelle Drehzahländerung für Ausblendung nach Start" VALUE 0x813764 KwUw 12799.77 nmotg_sw_q0p39 0.00 12799.77 FORMAT "%8.2" /end CHARACTERISTIC
/begin CHARACTERISTIC NMAXF "Fehlererkennung nmax - Überschreitung" VALUE 0x81397C KwUw 16383.75 nmot_uw_q0p25 0.00 16383.75 FORMAT "%8.2" /end CHARACTERISTIC
/begin CHARACTERISTIC NMIALU "Min. Drehzahl für Ausblendung der Aussetzererkennung" VALUE 0x810509 KwUb 10200. nmot_ub_q40 0.00 10200. FORMAT "%5.0" /end CHARACTERISTIC
/begin CHARACTERISTIC NMN_DUF "Drehzahl-Schwelle fürs Setzen der Zyklusflags der Funktionsüberwachungs-Diagnose" VALUE 0x811FD5 KwUb 10200. nmot_ub_q40 0.00 10200. FORMAT "%5.0" /end CHARACTERISTIC
/begin CHARACTERISTIC NMXALU "Max. Drehzahl für Ausblendung der Aussetzererkennung" VALUE 0x81050A KwUb 10200. nmot_ub_q40 0.00 10200. FORMAT "%5.0" /end CHARACTERISTIC
/begin CHARACTERISTIC NSTDMD_0_A "Max. Drehzahl für Ausblendung der Aussetzererkennung nach Start" VALUE 0x813766 KwUw 16383.75 nmot_uw_q0p25 0.00 16383.75 FORMAT "%8.2" /end CHARACTERISTIC
/begin CHARACTERISTIC NSTDMD_1_A "Max. Drehzahl für Ausblendung der Aussetzererkennung nach Start" VALUE 0x813768 KwUw 16383.75 nmot_uw_q0p25 0.00 16383.75 FORMAT "%8.2" /end CHARACTERISTIC
/begin CHARACTERISTIC NWFDECE "Dekrementierung des Fehlerentprellzählers Nockenwellensteller Einlaß" VALUE 0x81A5F9 KwUb 255.0 dez 0.00 255.0 FORMAT "%5.1" /end CHARACTERISTIC
/begin CHARACTERISTIC NWFINCE "Inkrementierung des Fehlerentprellzählers Nockenwellensteller Einlaß" VALUE 0x81A5FA KwUb 255.0 dez 0.00 255.0 FORMAT "%5.1" /end CHARACTERISTIC
/begin CHARACTERISTIC NWFMXE "Maximalwert des Fehlerentprellzählers Nockenwellensteller Einlaß für Fehlereintr" VALUE 0x81A5FB KwUb 255.0 dez 0.00 255.0 FORMAT "%5.1" /end CHARACTERISTIC
/begin CHARACTERISTIC PHNOKA "Anfangswert für Zähler Phasensignal nicht ok" VALUE 0x810B46 KwUb 255.0 dez 0.00 255.0 FORMAT "%5.1" /end CHARACTERISTIC
/begin CHARACTERISTIC P_ZYL "Abstand zur Bestimmung des arithmet Mittelwertes - DMDLU" VALUE 0x810893 KwUb 7.000 dez 0.00 7.000 FORMAT "%5.3" /end CHARACTERISTIC
/begin CHARACTERISTIC RKADTEVO "obere rka Schwelle für passive Einschaltbedingungen Diagnose TEV" VALUE 0x827FA8 KwSw 9.984375 rel_sw_b1536 0.00 9.984375 FORMAT "%8.6" /end CHARACTERISTIC
/begin CHARACTERISTIC RKADTEVU "untere rka Schwelle für passive Einschaltbedingungen Diagnose TEV" VALUE 0x827FAA KwSw 9.984375 rel_sw_b1536 -9.984375 0.00 FORMAT "%8.6" /end CHARACTERISTIC
/begin CHARACTERISTIC RLSALUNG_0_A "Lastschwelle zur Schuberkennung für Ausblendung der Aussetzererkennung" MAP 0x81050B GkfWUb 191.3 rel_ub_q0p75 0.00 191.3 FORMAT "%5.1" /begin AXIS_DESCR COM_AXIS gangi dez 8 0.00 255.0 AXIS_PTS_REF SGA08MDUB /end AXIS_DESCR
 /begin AXIS_DESCR COM_AXIS nmot nmot_ub_q40 8 0.00 10200. AXIS_PTS_REF SNM08DMUB /end AXIS_DESCR
/end CHARACTERISTIC
/begin CHARACTERISTIC RLSALUNG_1_A "Lastschwelle zur Schuberkennung für Ausblendung der Aussetzererkennung" MAP 0x81054B GkfWUb 191.3 rel_ub_q0p75 0.00 191.3 FORMAT "%5.1" /begin AXIS_DESCR COM_AXIS gangi dez 8 0.00 255.0 AXIS_PTS_REF SGA08MDUB /end AXIS_DESCR
 /begin AXIS_DESCR COM_AXIS nmot nmot_ub_q40 8 0.00 10200. AXIS_PTS_REF SNM08DMUB /end AXIS_DESCR
/end CHARACTERISTIC
/begin CHARACTERISTIC RMSLMN "Diagnoseschwelle: verringerte Sekundärluftmasse (Fehlerhaft)" VALUE 0x81836E KwUb 1.992 fak_ub_b2 0.00 1.992 FORMAT "%5.3" /end CHARACTERISTIC
/begin CHARACTERISTIC RMSLMNK "Diagnoseschwelle Bandendetest: verringerte Sekundärluftmasse" VALUE 0x81836F KwUb 1.992 fak_ub_b2 0.00 1.992 FORMAT "%5.3" /end CHARACTERISTIC
/begin CHARACTERISTIC RMSLMNST "Diagnoseschwelle: verringerte Sekundärluftmasse für gefilterten rmslf" VALUE 0x818370 KwUb 1.992 fak_ub_b2 0.00 1.992 FORMAT "%5.3" /end CHARACTERISTIC
/begin CHARACTERISTIC RMSLMXST "Diagnoseschwelle: verringerte Sekundärluftmasse," VALUE 0x818371 KwUb 1.992 fak_ub_b2 0.00 1.992 FORMAT "%5.3" /end CHARACTERISTIC
/begin CHARACTERISTIC RMSLPMN "Diagnoseschwelle: Fehler Sekundärluftpumpe, nur Pulse Air" VALUE 0x818372 KwUb 1.992 fak_ub_b2 0.00 1.992 FORMAT "%5.3" /end CHARACTERISTIC
/begin CHARACTERISTIC RMSLTMN "Schwelle: sehr geringe Sekundärluftmasse, ohne Offset" VALUE 0x818373 KwUb 1.992 fak_ub_b2 0.00 1.992 FORMAT "%5.3" /end CHARACTERISTIC
/begin CHARACTERISTIC RMSTEVIO "Schwelle relativer Massenstrom für i.O. Erkennung" VALUE 0x827FAC KwUw 199.9969 rel_uw_b200 0.00 199.9969 FORMAT "%8.4" /end CHARACTERISTIC
/begin CHARACTERISTIC RMSTEVMN "Minimalwert relativer Massenstrom TEV" VALUE 0x827FAE KwSw 399.9939 rel_sw_b200 -200.0000 199.9939 FORMAT "%8.4" /end CHARACTERISTIC
/begin CHARACTERISTIC RMSTEVMX "Maximalwert relativer Massenstrom TEV" VALUE 0x827FB0 KwSw 399.9939 rel_sw_b200 -200.0000 199.9939 FORMAT "%8.4" /end CHARACTERISTIC
/begin CHARACTERISTIC SALUNKH_0_A "dmrkh-abh. Nullastfaktoren bei Katheizen" CURVE 0x81024E KlAUbSstUbWUb 1.992 fak_ub_b2 0.00 1.992 FORMAT "%5.3"
 /begin AXIS_DESCR STD_AXIS dmrkh rel_ub_b99p6 4 0.00 99.61 FORMAT "%5.2" DEPOSIT ABSOLUTE /end AXIS_DESCR
/end CHARACTERISTIC
/begin CHARACTERISTIC SALUNKH_1_A "dmrkh-abh. Nullastfaktoren bei Katheizen" CURVE 0x810257 KlAUbSstUbWUb 1.992 fak_ub_b2 0.00 1.992 FORMAT "%5.3"
 /begin AXIS_DESCR STD_AXIS dmrkh rel_ub_b99p6 4 0.00 99.61 FORMAT "%5.2" DEPOSIT ABSOLUTE /end AXIS_DESCR
/end CHARACTERISTIC
/begin AXIS_PTS SGA08MDUB "Stützstellenverteilung Ist Gang 8 Sst." 0x81005F gangi SstAUbSstUb 255.0 dez 8 0.00 255.0 FORMAT "%5.1" DEPOSIT ABSOLUTE /end AXIS_PTS
/begin AXIS_PTS SIM06ESUW "SST-Verteilung für integrierten Luftmassenstrom ab Startende" 0x81AE74 imlatm_w SstAUwSstUw 23.30133 m_uw_b23p3 6 0.00 23.30133 FORMAT "%8.5" DEPOSIT ABSOLUTE /end AXIS_PTS
/begin AXIS_PTS SKS06ESUB "SST-Verteilung für den Startadaptionsfaktor kstaa" 0x810068 kstaa SstAUbSstUb 1.992 fak_ub_b2 6 0.00 1.992 FORMAT "%5.3" DEPOSIT ABSOLUTE /end AXIS_PTS
/begin AXIS_PTS SNM06ESUB "SST-Verteilung für Drehzahl" 0x8181F4 nmot SstAUbSstUb 10200. nmot_ub_q40 6 0.00 10200. FORMAT "%5.0" DEPOSIT ABSOLUTE /end AXIS_PTS
/begin AXIS_PTS SNM08DMUB "SST-Verteilung in DMD, 8 Drehzahl-SST" 0x81007B nmot SstAUbSstUb 10200. nmot_ub_q40 8 0.00 10200. FORMAT "%5.0" DEPOSIT ABSOLUTE /end AXIS_PTS
/begin AXIS_PTS SRL08DMUB "SST-Verteilung in DMD, 8 Last-SST" 0x8100E2 rl SstAUbSstUb 191.3 rel_ub_q0p75 8 0.00 191.3 FORMAT "%5.1" DEPOSIT ABSOLUTE /end AXIS_PTS
/begin AXIS_PTS SRP06ESUB "SST-Verteilung für rel. Luftfüllung präd. für Einspritzung" 0x8100F6 rlp SstAUbSstUb 191.3 rel_ub_q0p75 6 0.00 191.3 FORMAT "%5.1" DEPOSIT ABSOLUTE /end AXIS_PTS
/begin AXIS_PTS STA06ESUB "SST-Verteilung für die Ansauglufttemperatur" 0x818293 tans SstAUbSstUb 191.3 temp_ub_q0p75_o48 6 -48.00 143.3 FORMAT "%5.1" DEPOSIT ABSOLUTE /end AXIS_PTS
/begin AXIS_PTS STM08DMUB "8 Motortemperaturstützstellen für DMD" 0x81011D tmot SstAUbSstUb 191.3 temp_ub_q0p75_o48 8 -48.00 143.3 FORMAT "%5.1" DEPOSIT ABSOLUTE /end AXIS_PTS
/begin AXIS_PTS STM12ESUB "SST-Verteilung für die Motortemperatur tmot" 0x810126 tmot SstAUbSstUb 191.3 temp_ub_q0p75_o48 12 -48.00 143.3 FORMAT "%5.1" DEPOSIT ABSOLUTE /end AXIS_PTS
/begin AXIS_PTS STS08ESUB "SST-Verteilung für Motorstarttemperatur" 0x810133 tmst SstAUbSstUb 191.3 temp_ub_q0p75_o48 8 -48.00 143.3 FORMAT "%5.1" DEPOSIT ABSOLUTE /end AXIS_PTS
/begin AXIS_PTS STS12ESUB "SST-Verteilung für Motorstarttemperatur" 0x810145 tmst SstAUbSstUb 191.3 temp_ub_q0p75_o48 12 -48.00 143.3 FORMAT "%5.1" DEPOSIT ABSOLUTE /end AXIS_PTS
/begin CHARACTERISTIC SZANSSM1_0_A "Absteuerungsfaktorumschaltschwelle 1 für Nachstartfaktor" CURVE 0x818E8C GklWUb 0.9961 fak_ub_b1 0.00 0.9961
 /begin AXIS_DESCR COM_AXIS tmst temp_ub_q0p75_o48 12 -48.00 143.3 AXIS_PTS_REF STS12ESUB /end AXIS_DESCR
/end CHARACTERISTIC
/begin CHARACTERISTIC SZANSSM1_1_A "Absteuerungsfaktorumschaltschwelle 1 für Nachstartfaktor" CURVE 0x818E98 GklWUb 0.9961 fak_ub_b1 0.00 0.9961
 /begin AXIS_DESCR COM_AXIS tmst temp_ub_q0p75_o48 12 -48.00 143.3 AXIS_PTS_REF STS12ESUB /end AXIS_DESCR
/end CHARACTERISTIC
/begin CHARACTERISTIC SZANSSM2_0_A "Absteuerungsfaktorumschaltschwelle 2 für Nachstartfaktor" CURVE 0x818EA4 GklWUb 0.9961 fak_ub_b1 0.00 0.9961
 /begin AXIS_DESCR COM_AXIS tmst temp_ub_q0p75_o48 12 -48.00 143.3 AXIS_PTS_REF STS12ESUB /end AXIS_DESCR
/end CHARACTERISTIC
/begin CHARACTERISTIC SZANSSM2_1_A "Absteuerungsfaktorumschaltschwelle 2 für Nachstartfaktor" CURVE 0x818EB0 GklWUb 0.9961 fak_ub_b1 0.00 0.9961
 /begin AXIS_DESCR COM_AXIS tmst temp_ub_q0p75_o48 12 -48.00 143.3 AXIS_PTS_REF STS12ESUB /end AXIS_DESCR
/end CHARACTERISTIC
/begin CHARACTERISTIC TADTEAMX "Kennlinie Max. tastverhältnis abhängig vom Integral Massenstrom TE nach TE Stop" CURVE 0x81A478 KlAUbSstUbWUb 99.61 rel_ub_b99p6 0.00 99.61 FORMAT "%5.2"
 /begin AXIS_DESCR STD_AXIS tdtesta t100msxs_ub_b25p5 14 0.00 25.50 FORMAT "%5.2" DEPOSIT ABSOLUTE /end AXIS_DESCR
/end CHARACTERISTIC
/begin CHARACTERISTIC TADTEMX "Tastverhältnisschwelle für aktive Prüfung" VALUE 0x81A495 KwUb 89.84 rel_ub_b99p6 9.766 99.61 FORMAT "%5.2" /end CHARACTERISTIC
/begin CHARACTERISTIC TAMIALU "Minimale Ansauglufttemperatur für Ausblendung der Aussetzererkennung" VALUE 0x81058B KwUb 191.3 temp_ub_q0p75_o48 -48.00 143.3 FORMAT "%5.1" /end CHARACTERISTIC
/begin CHARACTERISTIC TANDSLMN "min. Ansauglufttemperatur für SL- Diagnose" VALUE 0x818374 KwUb 191.3 temp_ub_q0p75_o48 -48.00 143.3 FORMAT "%5.1" /end CHARACTERISTIC
/begin CHARACTERISTIC TANDSLMX "max. Ansauglufttemperatur für SL- Diagnose" VALUE 0x818375 KwUb 191.3 temp_ub_q0p75_o48 -48.00 143.3 FORMAT "%5.1" /end CHARACTERISTIC
/begin CHARACTERISTIC TC6CSL "Mode 6: Component ID für Prüfung Sekundärluftsystem" VALUE 0x818376 KwUb 127.0 dez 0.00 127.0 FORMAT "%5.1" /end CHARACTERISTIC
/begin CHARACTERISTIC TC6CSLF "Mode 6: Component ID für Prüfung gefilterter Sekundärluftmittelwert" VALUE 0x818377 KwUb 127.0 dez 0.00 127.0 FORMAT "%5.1" /end CHARACTERISTIC
/begin CHARACTERISTIC TC6CSLK "Mode 6: Component ID für Prüfung Sekundärluftsystem; Kurztest" VALUE 0x818378 KwUb 127.0 dez 0.00 127.0 FORMAT "%5.1" /end CHARACTERISTIC
/begin CHARACTERISTIC TC6CSLN "Mode 6: Component ID für Prüfung minimale Sekundärluft in Phase 1" VALUE 0x818379 KwUb 127.0 dez 0.00 127.0 FORMAT "%5.1" /end CHARACTERISTIC
/begin CHARACTERISTIC TC6CSLV "Mode 6: Component ID für Prüfung Dichtheit SL-Ventil" VALUE 0x81837A KwUb 127.0 dez 0.00 127.0 FORMAT "%5.1" /end CHARACTERISTIC
/begin CHARACTERISTIC TC6CTHM "Mode 6: Component ID für Prüfung Kühlwasserthermostat" VALUE 0x8196EB KwUb 126.0 dez 1.000 127.0 FORMAT "%5.1" /end CHARACTERISTIC
/begin CHARACTERISTIC TC6TECI "Mode 6 Codewort für i.O. Prüfung des TEVs aus DLDP" VALUE 0x81A496 KwUb 127.0 dez 0.00 127.0 FORMAT "%5.1" /end CHARACTERISTIC
/begin CHARACTERISTIC TC6TECL "Mode 6 Codewort für i.O. Prüfung des TEVs aus Luft-Prüfung" VALUE 0x81A497 KwUb 127.0 dez 0.00 127.0 FORMAT "%5.1" /end CHARACTERISTIC
/begin CHARACTERISTIC TC6TECNL "Mode 6 Codewort für NICHT i.O. Prüfung des TEVs aus Luft-Prüfung" VALUE 0x81A498 KwUb 127.0 dez 0.00 127.0 FORMAT "%5.1" /end CHARACTERISTIC
/begin CHARACTERISTIC TC6TECP "Mode 6 Codewort für passive i.O. Prüfung des TEVs" VALUE 0x81A499 KwUb 127.0 dez 0.00 127.0 FORMAT "%5.1" /end CHARACTERISTIC
/begin CHARACTERISTIC TC6TECRF "Mode 6 Codewort für i.O. Prüfung des TEVs aus FR-Abweichung Richtung fett" VALUE 0x81A49A KwUb 127.0 dez 0.00 127.0 FORMAT "%5.1" /end CHARACTERISTIC
/begin CHARACTERISTIC TC6TECRM "Mode 6 Codewort für i.O. Prüfung des TEVs aus FR-Abweichung Richtung mager" VALUE 0x81A49B KwUb 127.0 dez 0.00 127.0 FORMAT "%5.1" /end CHARACTERISTIC
/begin CHARACTERISTIC TC6TECT "Mode 6 Codewort für i.O. Prüfung des TEVs aus DLDP" VALUE 0x81A49C KwUb 127.0 dez 0.00 127.0 FORMAT "%5.1" /end CHARACTERISTIC
/begin CHARACTERISTIC TDASTAT "Zeitverzögerung bei Rücksetzen von B_astat" VALUE 0x81837B KwUb 25.50 t100msxs_ub_b25p5 0.00 25.50 FORMAT "%5.2" /end CHARACTERISTIC
/begin CHARACTERISTIC TDDNWSMNE "Entprellzeit für Setzen des min.-Fehlers der Einlaßnockenwelle" VALUE 0x81A5FC KwUb 25.50 t100msxs_ub_b25p5 0.00 25.50 FORMAT "%5.2" /end CHARACTERISTIC
/begin CHARACTERISTIC TDDNWSMXE "Entprellzeit für Setzen des max.-Fehlers bei Einlaß Nockenwelle" VALUE 0x81A5FD KwUb 25.50 t100msxs_ub_b25p5 0.00 25.50 FORMAT "%5.2" /end CHARACTERISTIC
/begin CHARACTERISTIC TDDSLSFG "Zeitverzögerung für Freigabe der Zusatzdiagnose SLS (Bank1)" VALUE 0x81837C KwUb 25.50 t100msxs_ub_b25p5 0.00 25.50 FORMAT "%5.2" /end CHARACTERISTIC
/begin CHARACTERISTIC TDFGSLA "Zeitverzögerung für die Freigabe der Anforderung der Aktivdiagnose" VALUE 0x81837D KwUb 25.40 t100msxs_ub_b25p5 0.1000 25.50 FORMAT "%5.2" /end CHARACTERISTIC
/begin CHARACTERISTIC TDFGSZSLS "Zeitverzögerung für die Freigabe der Setzbedingung des Zyklusflags" VALUE 0x81837E KwUb 25.50 t100msxs_ub_b25p5 0.00 25.50 FORMAT "%5.2" /end CHARACTERISTIC
/begin CHARACTERISTIC TDMFB "Zeit Diagnose für Erkennung Fehler in MIL-Fremdbestimmung" VALUE 0x818461 KwUb 255.0 t1sxs_ub_b255 0.00 255.0 FORMAT "%5.1" /end CHARACTERISTIC
/begin CHARACTERISTIC TDMSLMN1 "Mindestmeßzeit Sekundärluftmasse, Phase 1" VALUE 0x81837F KwUb 25.50 t100msxs_ub_b25p5 0.00 25.50 FORMAT "%5.2" /end CHARACTERISTIC
/begin CHARACTERISTIC TDMSLMN4 "Mindestmeßzeit Sekundärluftmasse, Phase 4" VALUE 0x818380 KwUb 25.50 t100msxs_ub_b25p5 0.00 25.50 FORMAT "%5.2" /end CHARACTERISTIC
/begin CHARACTERISTIC TDMSLMNK "Mindestmeßzeit Sekundärluftmasse, Phase 1 bei Kurztest" VALUE 0x818381 KwUb 25.50 t100msxs_ub_b25p5 0.00 25.50 FORMAT "%5.2" /end CHARACTERISTIC
/begin CHARACTERISTIC TDMSLOF3 "Meßzeit Offset Sekundärluftmasse, Phase 3" VALUE 0x818382 KwUb 25.50 t100msxs_ub_b25p5 0.00 25.50 FORMAT "%5.2" /end CHARACTERISTIC
/begin CHARACTERISTIC TDMSLOF5 "Meßzeit Offset sekundärluftmasse, Phase 5" VALUE 0x818383 KwUb 25.50 t100msxs_ub_b25p5 0.00 25.50 FORMAT "%5.2" /end CHARACTERISTIC
/begin CHARACTERISTIC TDMSLOFK "Meßzeit Offset Sekundärluftmasse, Phase 3 bei Kurztest" VALUE 0x818384 KwUb 25.50 t100msxs_ub_b25p5 0.00 25.50 FORMAT "%5.2" /end CHARACTERISTIC
/begin CHARACTERISTIC TDMSLV "Messzeit für Ventildichtheitsprüfung" VALUE 0x818385 KwUb 25.50 t100msxs_ub_b25p5 0.00 25.50 FORMAT "%5.2" /end CHARACTERISTIC
/begin CHARACTERISTIC TDMSLVK "Meßzeit für Ventildichtheitsprüfung bei Kurztest" VALUE 0x818386 KwUb 25.50 t100msxs_ub_b25p5 0.00 25.50 FORMAT "%5.2" /end CHARACTERISTIC
/begin CHARACTERISTIC TDNWSP "Zeitverzögerung für Prüfung Nockenwellenverschiebung" VALUE 0x818474 KwUb 51.00 t200msxs_ub_b51 0.00 51.00 FORMAT "%5.2" /end CHARACTERISTIC
/begin CHARACTERISTIC TDNX "Entprellzeit Fehlertyp max.: Überdrehzahl" VALUE 0x810BA5 KwUb 2.550 t10msxs_ub_b2p55 0.00 2.550 FORMAT "%5.3" /end CHARACTERISTIC
/begin CHARACTERISTIC TDPH2SLOF "Zeit Einschaltverzögerung von Phase 2 nach Phase 3" VALUE 0x818387 KwUb 25.50 t100msxs_ub_b25p5 0.00 25.50 FORMAT "%5.2" /end CHARACTERISTIC
/begin CHARACTERISTIC TDPHSLOF "Zeit Einschaltverzögerung Bit B_slsoff in Phase 2, 3 und 5 nach" VALUE 0x818388 KwUb 25.50 t100msxs_ub_b25p5 0.00 25.50 FORMAT "%5.2" /end CHARACTERISTIC
/begin CHARACTERISTIC TDSLMDRL "Einschaltverzögerung Delta-rl-Sperre bei Bildung B_dslmes" VALUE 0x818389 KwUb 25.50 t100msxs_ub_b25p5 0.00 25.50 FORMAT "%5.2" /end CHARACTERISTIC
/begin CHARACTERISTIC TDSLMVBA "Einschaltverzögerung BA-/VA-Sperre bei Bildung B_dslmes" VALUE 0x81838A KwUb 25.50 t100msxs_ub_b25p5 0.00 25.50 FORMAT "%5.2" /end CHARACTERISTIC
/begin CHARACTERISTIC TDTEFA "Zeit für Sperre DTEV ab Start bei Testeranforderung" VALUE 0x827FB2 KwUw 180.0000 t100msxs_uw_b6553p6 20.00000 200.0000 FORMAT "%8.4" /end CHARACTERISTIC
/begin CHARACTERISTIC TDTESZO "Zeit ab Startende für schnelle Spülratenabsteuerung DTEV bei B_ll = TRUE inaktiv" VALUE 0x827FB4 KwUw 6553.500 t100msxs_uw_b6553p6 0.00 6553.500 FORMAT "%8.3" /end CHARACTERISTIC
/begin CHARACTERISTIC TDTESZU "Zeit ab Startende für Aktivierung Spülratenabsteuerung DTEV bei B_ll = TRUE" VALUE 0x827FB6 KwUw 6553.500 t100msxs_uw_b6553p6 0.00 6553.500 FORMAT "%8.3" /end CHARACTERISTIC
/begin CHARACTERISTIC TDTEZAM "Zeit ab Start für aktive DTEV möglich" VALUE 0x827FB8 KwUw 6553.500 t100msxs_uw_b6553p6 0.00 6553.500 FORMAT "%8.3" /end CHARACTERISTIC
/begin CHARACTERISTIC TDTHMO "obere Temp.-Schwelle (tans/tum) für Thermostatdiagnose" VALUE 0x8196EC KwUb 191.3 temp_ub_q0p75_o48 -48.00 143.3 FORMAT "%5.1" /end CHARACTERISTIC
/begin CHARACTERISTIC TDTHMU "untere Temp.-Schwelle (tans/tum) für Thermostatdiagnose" VALUE 0x8196ED KwUb 191.3 temp_ub_q0p75_o48 -48.00 143.3 FORMAT "%5.1" /end CHARACTERISTIC
/begin CHARACTERISTIC TDV "Fehlererkennung Tachosignal / Zeitdauer für Abfrage" VALUE 0x8186EB KwUb 12.75 t50msxs_ub_b12p75 0.00 12.75 FORMAT "%5.2" /end CHARACTERISTIC
/begin CHARACTERISTIC TFIMSLI "Zeitkonstante für msli- und msln-Filter" VALUE 0x81838B KwUb 12.6996 zk100msxs_ub_b25p5 0.100392 12.8000 FORMAT "%7.4" /end CHARACTERISTIC
/begin CHARACTERISTIC TFIMSLIK "Zeitkonstante für msli- und msln-Filter bei Kurztest" VALUE 0x81838C KwUb 12.6996 zk100msxs_ub_b25p5 0.100392 12.8000 FORMAT "%7.4" /end CHARACTERISTIC
/begin CHARACTERISTIC TFIMSLO "Zeitkonstante für mslo- Filter" VALUE 0x81838D KwUb 12.6996 zk100msxs_ub_b25p5 0.100392 12.8000 FORMAT "%7.4" /end CHARACTERISTIC
/begin CHARACTERISTIC TFIMSLOK "Zeitkonstante für mslo- Filter bei Kurztest" VALUE 0x81838E KwUb 12.6996 zk100msxs_ub_b25p5 0.100392 12.8000 FORMAT "%7.4" /end CHARACTERISTIC
/begin CHARACTERISTIC TFIMSLV "Zeitkonstante für mslv- Filter" VALUE 0x81838F KwUb 12.6996 zk100msxs_ub_b25p5 0.100392 12.8000 FORMAT "%7.4" /end CHARACTERISTIC
/begin CHARACTERISTIC TFIMSLVK "Zeitkonstante für mslv- Filter bei Kurztest" VALUE 0x818390 KwUb 12.6996 zk100msxs_ub_b25p5 0.100392 12.8000 FORMAT "%7.4" /end CHARACTERISTIC
/begin CHARACTERISTIC TFRMDTEE "Erkennungszeit für eingeschwungene frm" VALUE 0x81A49D KwUb 3.000 t100msxs_ub_b25p5 0.00 3.000 FORMAT "%5.3" /end CHARACTERISTIC
/begin CHARACTERISTIC THMDMIN "Mindest-Motortemperaturschwelle für Abfrage bei Thermostatdiagnose" VALUE 0x8196EE KwUb 191.3 temp_ub_q0p75_o48 -48.00 143.3 FORMAT "%5.1" /end CHARACTERISTIC
/begin CHARACTERISTIC TKATDSL "maximale Katalysatortemperatur für Freigabe SLS-Diagnose" VALUE 0x818391 KwUb 1275. temp_ub_q5_o50 -50.00 1225. FORMAT "%5.0" /end CHARACTERISTIC
/begin CHARACTERISTIC TLAED "Wartezeit bis Fehlerlampe aus nach Start" VALUE 0x81845A KwUb 51.00 t200msxs_ub_b51 0.00 51.00 FORMAT "%5.2" /end CHARACTERISTIC
/begin CHARACTERISTIC TMASKIV1 "Temperaturschwelle für Verlägerung 1. KAT-Intervall, Aussetzererkennung" VALUE 0x8108CE KwUb 191.3 temp_ub_q0p75_o48 -48.00 143.3 FORMAT "%5.1" /end CHARACTERISTIC
/begin CHARACTERISTIC TMDSLAMN "min. Motortemperatur für Zusatzdiagnose" VALUE 0x818392 KwUb 191.3 temp_ub_q0p75_o48 -48.00 143.3 FORMAT "%5.1" /end CHARACTERISTIC
/begin CHARACTERISTIC TMDSLMN "min. Motortemperatur für DSLS" VALUE 0x818393 KwUb 191.3 temp_ub_q0p75_o48 -48.00 143.3 FORMAT "%5.1" /end CHARACTERISTIC
/begin CHARACTERISTIC TMDSLMX "max. Motortemperatur für DSLS" VALUE 0x818394 KwUb 191.3 temp_ub_q0p75_o48 -48.00 143.3 FORMAT "%5.1" /end CHARACTERISTIC
/begin CHARACTERISTIC TMDTEU "Untere Motortemperaturschwelle für Tankentlüftungsdiagnose" VALUE 0x81A49E KwUb 63.75 temp_ub_q0p75_o48 27.00 90.75 FORMAT "%5.2" /end CHARACTERISTIC
/begin CHARACTERISTIC TMDV "Motortemperaturschwelle für Freigabe Fz-Geschwindigkeits-Diagnose" VALUE 0x8186EC KwUb 191.3 temp_ub_q0p75_o48 -48.00 143.3 FORMAT "%5.1" /end CHARACTERISTIC
/begin CHARACTERISTIC TMEWDTEU "Untere Temperaturschwelle für TE-Diagnose bezogen auf modellierte Motortemp." VALUE 0x81A49F KwUb 191.3 temp_ub_q0p75_o48 -48.00 143.3 FORMAT "%5.1" /end CHARACTERISTIC
/begin CHARACTERISTIC TMNST "Untere Temperaturschwelle bei Start des Motors" VALUE 0x81A4A0 KwUb 191.3 temp_ub_q0p75_o48 -48.00 143.3 FORMAT "%5.1" /end CHARACTERISTIC
/begin CHARACTERISTIC TMSDTHMO "obere Motorstart-Temp.-Schwelle für Thermostatdiagnose" VALUE 0x8196EF KwUb 191.3 temp_ub_q0p75_o48 -48.00 143.3 FORMAT "%5.1" /end CHARACTERISTIC
/begin CHARACTERISTIC TMSDTHMU "untere Motorstart-Temp.-Schwelle für Thermostatdiagnose" VALUE 0x8196F0 KwUb 191.3 temp_ub_q0p75_o48 -48.00 143.3 FORMAT "%5.1" /end CHARACTERISTIC
/begin CHARACTERISTIC TMSLADAP "Sperrzeit für Wiederholung Adaption" VALUE 0x81B000 KwUw 6553.500 t100msxs_uw_b6553p5 0.00 6553.500 FORMAT "%8.3" /end CHARACTERISTIC
/begin CHARACTERISTIC TMSLIFT "Wartezeit für für mslift-Filter (Aufbau Drehmomentenreserve)" VALUE 0x81B002 KwUw 6553.500 t100msxs_uw_b6553p5 0.00 6553.500 FORMAT "%8.3" /end CHARACTERISTIC
/begin CHARACTERISTIC TMSLIFT1 "Wartezeit für mslift-Filter (Aufbau Drehmomentenreserve) in Phase 1" VALUE 0x81B004 KwUw 6553.500 t100msxs_uw_b6553p5 0.00 6553.500 FORMAT "%8.3" /end CHARACTERISTIC
/begin CHARACTERISTIC TMSLIFTK "Wartezeit für mslift-Filter (Aufbau Drehmomentenreserve) in Phase 1 während Kurz" VALUE 0x81B006 KwUw 6553.500 t100msxs_uw_b6553p5 0.00 6553.500 FORMAT "%8.3" /end CHARACTERISTIC
/begin CHARACTERISTIC TMUDTEU "Untere Umgebungstmperaturschwelle für Tankentlüftungsdiagnose" VALUE 0x81A4A1 KwUb 191.3 temp_ub_q0p75_o48 -48.00 143.3 FORMAT "%5.1" /end CHARACTERISTIC
/begin CHARACTERISTIC TMWUC "Motortemperaturschwelle für Erfüllung 'warm up cycle'" VALUE 0x810B35 KwUb 191.3 temp_ub_q0p75_o48 -48.00 143.3 FORMAT "%5.1" /end CHARACTERISTIC
/begin CHARACTERISTIC TMWUCST "max. Motortemperatur im Start für Erfüllung 'warm up cycle'" VALUE 0x810B36 KwUb 191.3 temp_ub_q0p75_o48 -48.00 143.3 FORMAT "%5.1" /end CHARACTERISTIC
/begin CHARACTERISTIC TNALU "Testphasenlänge nach erkanntem Aussetzer" VALUE 0x810894 KwUb 255.0 dez 0.00 255.0 FORMAT "%5.1" /end CHARACTERISTIC
/begin CHARACTERISTIC TNOMF2 "zulässige Zeit außerhalb Meßfenster, Phase 2" VALUE 0x818395 KwUb 25.50 t100msxs_ub_b25p5 0.00 25.50 FORMAT "%5.2" /end CHARACTERISTIC
/begin CHARACTERISTIC TNOMF3 "zulässige Zeit außerhalb Meßfenster, Phase 3" VALUE 0x818396 KwUb 25.50 t100msxs_ub_b25p5 0.00 25.50 FORMAT "%5.2" /end CHARACTERISTIC
/begin CHARACTERISTIC TNOMF5 "zulässige Zeit außerhalb Meßfenster, Phase 5" VALUE 0x818397 KwUb 25.50 t100msxs_ub_b25p5 0.00 25.50 FORMAT "%5.2" /end CHARACTERISTIC
/begin CHARACTERISTIC TNSTDSL "Schwelle Zeit nach Start für aktivieren Phase 4" VALUE 0x81B008 KwUw 6553.500 t100msxs_uw_b6553p5 0.00 6553.500 FORMAT "%8.3" /end CHARACTERISTIC
/begin CHARACTERISTIC TPERDTE "Zeit für Wiederholung DTEV bei Dauerleerlauf" VALUE 0x81A4A2 KwUb 25.50 t100msxs_ub_b25p5 0.00 25.50 FORMAT "%5.2" /end CHARACTERISTIC
/begin CHARACTERISTIC TPSVKMN "minimale Periodendauer der Lambdasonde vor Kat, DLSSA" VALUE 0x81015F KwUb 1.330 spg_ub_b1p33 0.00 1.330 FORMAT "%5.3" /end CHARACTERISTIC
/begin CHARACTERISTIC TPSVKMX "maximale Periodendauer der Lambdasonde vor Kat, DLSSA" VALUE 0x810160 KwUb 1.330 spg_ub_b1p33 0.00 1.330 FORMAT "%5.3" /end CHARACTERISTIC
/begin CHARACTERISTIC TSBVDSLTMS "Verzögerung Messbeginn DSLSLRS nach Sondenbetriebsbereitschaft" CURVE 0x81B00A KlAUbSstUbWUw 6553.500 t100msxs_uw_b6553p5 0.00 6553.500 FORMAT "%8.3"
 /begin AXIS_DESCR STD_AXIS tmst temp_ub_q0p75_o48 6 -48.00 143.3 FORMAT "%5.1" DEPOSIT ABSOLUTE /end AXIS_DESCR
/end CHARACTERISTIC
/begin CHARACTERISTIC TSTM "Zeit bis B_nmot weitergeleitet wird" VALUE 0x81A4A3 KwUb 25.50 t_q0p1 0.00 25.50 FORMAT "%5.2" /end CHARACTERISTIC
/begin CHARACTERISTIC TTEVAZ "Verweilzeit für TEV Aufsteuern bei nicht eingeschwungen frm" VALUE 0x81A4A4 KwUb 10.00 t100msxs_ub_b25p5 0.00 10.00 FORMAT "%5.2" /end CHARACTERISTIC
/begin CHARACTERISTIC TUSPNMN "min. Zeit der Sondenspannung zwischen pos. und neg. Flanke" VALUE 0x810161 KwUb 1.330 spg_ub_b1p33 0.00 1.330 FORMAT "%5.3" /end CHARACTERISTIC
/begin CHARACTERISTIC TUSPNMX "max. Zeit der Sondenspannung zwischen pos. und neg. Flanke" VALUE 0x810162 KwUb 1.330 spg_ub_b1p33 0.00 1.330 FORMAT "%5.3" /end CHARACTERISTIC
/begin CHARACTERISTIC TVDTEABG "Verzögerungszeit zwischen Motor und Lambdasonde" VALUE 0x81A4A5 KwUb 2.000 t100msxs_ub_b25p5 0.00 2.000 FORMAT "%5.3" /end CHARACTERISTIC
/begin CHARACTERISTIC TVDTEB "Verzögerungszeit ab TEV offen für Aussage TEV i.O./defekt in Diagnose DTEV" VALUE 0x81A4A6 KwUb 10.00 t100msxs_ub_b25p5 0.00 10.00 FORMAT "%5.2" /end CHARACTERISTIC
/begin CHARACTERISTIC TVDTEE "Zeitdauer ab TEV offen für Prüfung DTEV" VALUE 0x81A4A7 KwUb 12.00 t100msxs_ub_b25p5 3.000 15.00 FORMAT "%5.2" /end CHARACTERISTIC
/begin CHARACTERISTIC TVDTELLA "Mindestzzeit für Aktivierungsbedingungen für Aufsteuerprüfung DTEV erfüllt" VALUE 0x81A4A8 KwUb 9.500 t100msxs_ub_b25p5 0.5000 10.00 FORMAT "%5.2" /end CHARACTERISTIC
/begin CHARACTERISTIC TVDTEVP "Entprellung für Setzen Flip-Flop Passiv-Prüfung DTEV i.O." VALUE 0x81A4A9 KwUb 19.00 t100msxs_ub_b25p5 1.000 20.00 FORMAT "%5.2" /end CHARACTERISTIC
/begin CHARACTERISTIC TVDTEVPM "Entprellung für Setzen Flip-Flop ""Diagnose passiv möglich""" VALUE 0x81A4AA KwUb 19.00 t100msxs_ub_b25p5 1.000 20.00 FORMAT "%5.2" /end CHARACTERISTIC
/begin CHARACTERISTIC TVDTEVZ "Verzögerungszeit für Schließen TEV für Aufsteuerprüfung DTEV" VALUE 0x81A4AB KwUb 10.00 t100msxs_ub_b25p5 0.00 10.00 FORMAT "%5.2" /end CHARACTERISTIC
/begin CHARACTERISTIC TVESWER "Verzögerungszeit für Erkennung fehlerfreies Schlechtwegsignal" VALUE 0x818452 KwUb 25.50 t100msxs_ub_b25p5 0.00 25.50 FORMAT "%5.2" /end CHARACTERISTIC
/begin CHARACTERISTIC TVESWES "Verzögerungszeit für Erkennung fehlerhaften Schlechtwegsignal" VALUE 0x818453 KwUb 25.50 t100msxs_ub_b25p5 0.00 25.50 FORMAT "%5.2" /end CHARACTERISTIC
/begin CHARACTERISTIC TVPWMFR "Verzögerungszeit für Erkennung fehlerfreiem PWM-Signal" VALUE 0x818454 KwUb 25.50 t100msxs_ub_b25p5 0.00 25.50 FORMAT "%5.2" /end CHARACTERISTIC
/begin CHARACTERISTIC TVPWMFS "Verzögerungszeit für Erkennung fehlerhaftes PWM-Signal" VALUE 0x818455 KwUb 25.50 t100msxs_ub_b25p5 0.00 25.50 FORMAT "%5.2" /end CHARACTERISTIC
/begin CHARACTERISTIC TVTANKL "Verzögerungszeit für Information Tank-Leer-Zustand beendet" VALUE 0x810B3B KwUb 255.0 t1sxs_ub_b255 0.00 255.0 FORMAT "%5.1" /end CHARACTERISTIC
/begin CHARACTERISTIC TWDSLTM "tmot- Entprellzeit für Adaption/Zusatudiagnose" VALUE 0x818398 KwUb 25.40 t100msxs_ub_b25p5 0.1000 25.50 FORMAT "%5.2" /end CHARACTERISTIC
/begin CHARACTERISTIC TWHLSLP "Wartezeit für Hochlauf Sekundärluftpumpe" VALUE 0x818399 KwUb 25.50 t100msxs_ub_b25p5 0.00 25.50 FORMAT "%5.2" /end CHARACTERISTIC
/begin CHARACTERISTIC TWMLFE "Mindestzeit für Luftmasse im Diagnosebereich" VALUE 0x81839A KwUb 25.50 t100msxs_ub_b25p5 0.00 25.50 FORMAT "%5.2" /end CHARACTERISTIC
/begin CHARACTERISTIC TWMSLMIN "Entprellzeit für Fehlermeldung B_mslmin" VALUE 0x81839B KwUb 25.50 t100msxs_ub_b25p5 0.00 25.50 FORMAT "%5.2" /end CHARACTERISTIC
/begin CHARACTERISTIC USMNSAMN "min. erkannte Sondenspannung für Signalausgabe (min. plaus. Wert)" VALUE 0x810163 KwUb 1.330 spg_ub_b1p33 0.00 1.330 FORMAT "%5.3" /end CHARACTERISTIC
/begin CHARACTERISTIC USMNSAMX "min. erkannte Sondenspannung für Signalausgabe (max. plaus. Wert)" VALUE 0x810164 KwUb 1.330 spg_ub_b1p33 0.00 1.330 FORMAT "%5.3" /end CHARACTERISTIC
/begin CHARACTERISTIC USMXSAMN "max. erkannte Sondenspannung für Signalausgabe (min. plaus. Wert)" VALUE 0x810165 KwUb 1.330 spg_ub_b1p33 0.00 1.330 FORMAT "%5.3" /end CHARACTERISTIC
/begin CHARACTERISTIC USMXSAMX "max. erkannte Sondenspannung für Signalausgabe (max. plaus. Wert)" VALUE 0x810166 KwUb 1.330 spg_ub_b1p33 0.00 1.330 FORMAT "%5.3" /end CHARACTERISTIC
/begin CHARACTERISTIC VDMN "Geschwindigkeitsschwelle; Fehlererkennung Geschwindigkeitssignal" VALUE 0x81C570 KwUw 511.9922 vfzg_uw_b512 0.00 511.9922 FORMAT "%8.4" /end CHARACTERISTIC
/begin CHARACTERISTIC VFZGADMD "Fahrzeuggeschw.schwelle zum Ausblenden DMD bei aktivem Bremseingriff" VALUE 0x818427 KwUb 318.8 vfzg_ub_q1p25 0.00 318.8 FORMAT "%5.1" /end CHARACTERISTIC
/begin CHARACTERISTIC WNWSPMN "Grenzwinkel Spätverschiebung für Zuordnung Nockenwelle zu Kurbelwelle" VALUE 0x81C21C KwSw 1023.984 kw_q0p0156 -512.0000 511.9844 FORMAT "%8.4" /end CHARACTERISTIC
/begin CHARACTERISTIC WNWSPMX "Grenzwinkel Frühverschiebung für Zuordnung Nockenwelle zu Kurbelwelle" VALUE 0x81C21E KwSw 1023.984 kw_q0p0156 -512.0000 511.9844 FORMAT "%8.4" /end CHARACTERISTIC
/begin CHARACTERISTIC ZDGZA1 "Zündungszahl Abregelung Bereich 1" VALUE 0x810FD4 KwUb 255.0 dez 0.00 255.0 FORMAT "%5.1" /end CHARACTERISTIC
/begin CHARACTERISTIC ZDGZA2 "Zündungszahl Abregelung Bereich 2" VALUE 0x810FD5 KwUb 255.0 dez 0.00 255.0 FORMAT "%5.1" /end CHARACTERISTIC
/begin CHARACTERISTIC ZDGZA3 "Zündungszahl Abregelung Bereich 3" VALUE 0x810FD6 KwUb 255.0 dez 0.00 255.0 FORMAT "%5.1" /end CHARACTERISTIC
/begin CHARACTERISTIC ZDSLAMX "Maximale Anzahl Wiederholungen aktive Zusatzdiagnose (Phasen 4+5)" VALUE 0x81839C KwUb 255.0 dez 0.00 255.0 FORMAT "%5.1" /end CHARACTERISTIC
/begin CHARACTERISTIC ZFNMOT "Filterzeitkonstante nmot für die Diagnose Tankentlüftungsventil" VALUE 0x827FBA KwUw 6553.4999985 zk100msxs_uw_b6553 0.10000152590 6553.6000000 FORMAT "%12.7" /end CHARACTERISTIC
/begin CHARACTERISTIC ZFRMFIL "Filterzeitkonstante Lambdareglergrößen" VALUE 0x827FBC KwUw 5.9069645603 zk100msxs_uw_b6553 0.10000152590 6.0069660862 FORMAT "%12.10" /end CHARACTERISTIC
/begin CHARACTERISTIC ZFRMXAF "Filterzeitkonstante für frmxa_w Signal" VALUE 0x827FBE KwUw 6553.4999985 zk100msxs_uw_b6553 0.10000152590 6553.6000000 FORMAT "%12.7" /end CHARACTERISTIC
/begin CHARACTERISTIC ZKFRMSLS "Zeitkonstante für Filterung des frm in der Diagnose SLS" VALUE 0x81839D KwUb 25.4996 zk100msxs_ub_b25p5 0.100392 25.6000 FORMAT "%7.4" /end CHARACTERISTIC
/begin CHARACTERISTIC ZKRMSTEV "Zeitkonstante Tiefpaßfilterung für Mode 6 DTEV" VALUE 0x827FC0 KwUw 60.024769116 zk100msxs_uw_b6553 0.10000152590 60.124770642 FORMAT "%12.9" /end CHARACTERISTIC
/begin CHARACTERISTIC ZMLETAN "Zeitkonstante für Filterung zur Berechnung des Leerlaufenergiebedarf für DTEV" VALUE 0x827FC2 KwUw 9.9054946573 zk100msxs_uw_b6553 0.10000152590 10.005496183 FORMAT "%12.9" /end CHARACTERISTIC
/begin CHARACTERISTIC ZMSTEDTE "Zeitkonstante für Filterung des berechneten Massenstrom TEV" VALUE 0x827FC4 KwUw 14.931191135 zk100msxs_uw_b6553 0.10000152590 15.031192661 FORMAT "%12.9" /end CHARACTERISTIC
/begin CHARACTERISTIC ZRLTEDTE "Zeitkonstante für Filterung der berechneten Füllung TEV" VALUE 0x827FC6 KwUw 6553.4999985 zk100msxs_uw_b6553 0.10000152590 6553.6000000 FORMAT "%12.7" /end CHARACTERISTIC
/begin CHARACTERISTIC ZYLKOR "Wert zur Zylinderkorrektur (tsroh zu zzyldmd)" VALUE 0x810055 KwUb 3.000 dez 0.00 3.000 FORMAT "%5.3" /end CHARACTERISTIC
/begin MEASUREMENT abr1_count "Nachstart Abregelzähler 1" UBYTE dez 1 100 0 255 FORMAT "%5.1" ECU_ADDRESS 0x3809D7 /end MEASUREMENT
/begin MEASUREMENT afnmn "Bereichsfenster Aussetzer, minimale Drehzahl" UBYTE nmot_ub_q40 1 100 0 10200 FORMAT "%5.0" ECU_ADDRESS 0x383305 /end MEASUREMENT
/begin MEASUREMENT afnmx "Bereichsfenster Aussetzer, maximale Drehzahl" UBYTE nmot_ub_q40 1 100 0 10200 FORMAT "%5.0" ECU_ADDRESS 0x383306 /end MEASUREMENT
/begin MEASUREMENT afrlmn "Bereichsfenster Aussetzer, minimale Last" UBYTE rel_ub_q0p75 1 100 0 191.25 FORMAT "%5.1" ECU_ADDRESS 0x383307 /end MEASUREMENT
/begin MEASUREMENT afrlmx "Bereichsfenster Aussetzer, maximale Last" UBYTE rel_ub_q0p75 1 100 0 191.25 FORMAT "%5.1" ECU_ADDRESS 0x383308 /end MEASUREMENT
/begin MEASUREMENT aftnmn "Bereichsfenster Aussetzer, minimale Drehzahl, temporär" UBYTE nmot_ub_q40 1 100 0 10200 FORMAT "%5.0" ECU_ADDRESS 0x3808E7 /end MEASUREMENT
/begin MEASUREMENT aftnmx "Bereichsfenster Aussetzer, maximale Drehzahl, temporär" UBYTE nmot_ub_q40 1 100 0 10200 FORMAT "%5.0" ECU_ADDRESS 0x3808E8 /end MEASUREMENT
/begin MEASUREMENT aftrlmn "Bereichsfenster Aussetzer, minimale Last, temporär" UBYTE rel_ub_q0p75 1 100 0 191.25 FORMAT "%5.1" ECU_ADDRESS 0x3808E9 /end MEASUREMENT
/begin MEASUREMENT aftrlmx "Bereichsfenster Aussetzer, maximale Last, temporär" UBYTE rel_ub_q0p75 1 100 0 191.25 FORMAT "%5.1" ECU_ADDRESS 0x3808EA /end MEASUREMENT
/begin MEASUREMENT ahearv_w "Aussetzerhäufigkeit zum Erreichen der Ausblendung anderer Funktionen (aus AHEARV" UWORD dez 1 100 0 65535 FORMAT "%8.2" ECU_ADDRESS 0x381814 /end MEASUREMENT
/begin MEASUREMENT aint "Anzahl Intervalle mit Katschädigung" UBYTE dez 1 100 0 255 FORMAT "%5.1" ARRAY_SIZE 4 ECU_ADDRESS 0x3808EB /end MEASUREMENT
/begin MEASUREMENT aintkamin "Anzahl Intervalle mit Katschädigung für Ti-Abschaltung, Minimalwert" UBYTE dez 1 100 0 255 FORMAT "%5.1" ECU_ADDRESS 0x38481D /end MEASUREMENT
/begin MEASUREMENT anzainten "Anzahl Intervalle nach Start für Freigabe Ti-Abschaltung (200 KWU)" UBYTE dez 1 100 0 255 FORMAT "%5.1" ECU_ADDRESS 0x38481E /end MEASUREMENT
/begin MEASUREMENT anzmsls_w "Anzahl der dürchgeführten Sekundärluftmessungen" UWORD dez 1 100 0 65535 FORMAT "%8.2" ECU_ADDRESS 0x38402C /end MEASUREMENT
/begin MEASUREMENT apdtev "Anzahl der erfolgreichen DTEV Prüfungen" UBYTE dez 1 100 0 255 FORMAT "%5.1" ECU_ADDRESS 0x3848FE /end MEASUREMENT
/begin MEASUREMENT atvfett "atv-Verschiebung nach FETT, DLSSA" UBYTE dez 1 100 0 255 FORMAT "%5.1" ARRAY_SIZE 2 ECU_ADDRESS 0x384808 /end MEASUREMENT
/begin MEASUREMENT atvmager "atv-Verschiebung nach MAGER, DLSSA" UBYTE dez 1 100 0 255 FORMAT "%5.1" ARRAY_SIZE 2 ECU_ADDRESS 0x38480A /end MEASUREMENT
/begin MEASUREMENT avdtev "Anzahl der nicht erfolgreichen DTEV Prüfversuche" UBYTE dez 1 100 0 255 FORMAT "%5.1" ECU_ADDRESS 0x3848FF /end MEASUREMENT
/begin MEASUREMENT azpdtefre "Anzahl Prüfungen Faktor Lambdaregelung auf eingeschwungen" UBYTE dez 1 100 0 255 FORMAT "%5.1" ECU_ADDRESS 0x384900 /end MEASUREMENT
/begin MEASUREMENT azycnt "Anzahl der wg. katschädigender Aussetzer abgeschalteten Zylinder" UBYTE dez 1 100 0 255 FORMAT "%5.1" ECU_ADDRESS 0x3808EF /end MEASUREMENT
/begin MEASUREMENT bbdmdmil "" UBYTE dez 1 100 0 255 FORMAT "%5.1" ECU_ADDRESS 0x383309 /end MEASUREMENT
/begin MEASUREMENT bbsp1 "Byte für Bedingung B_sp1 als Triggerevent in DCLA" UBYTE dez 1 100 0 255 FORMAT "%5.1" ECU_ADDRESS 0x3808F0 /end MEASUREMENT
/begin MEASUREMENT bbsp2 "Byte für Bedingung B_sp2 als Triggerevent in DCLA" UBYTE dez 1 100 0 255 FORMAT "%5.1" ECU_ADDRESS 0x3808F1 /end MEASUREMENT
/begin MEASUREMENT bbwuc "Byte für Bedingung B_wuc als Triggerevent in DCLA" UBYTE dez 1 100 0 255 FORMAT "%5.1" ECU_ADDRESS 0x3808FC /end MEASUREMENT
/begin MEASUREMENT bfnmn "Bereichsfenster Motorbetrieb, minimale Drehzahl" UBYTE nmot_ub_q40 1 100 0 10200 FORMAT "%5.0" ECU_ADDRESS 0x3808F2 /end MEASUREMENT
/begin MEASUREMENT bfnmx "Bereichsfenster Motorbetrieb, maximale Drehzahl" UBYTE nmot_ub_q40 1 100 0 10200 FORMAT "%5.0" ECU_ADDRESS 0x3808F3 /end MEASUREMENT
/begin MEASUREMENT bfrlmn "Bereichsfenster Motorbetrieb, minimale Last" UBYTE rel_ub_q0p75 1 100 0 191.25 FORMAT "%5.1" ECU_ADDRESS 0x3808F4 /end MEASUREMENT
/begin MEASUREMENT bfrlmx "Bereichsfenster Motorbetrieb, maximale Last" UBYTE rel_ub_q0p75 1 100 0 191.25 FORMAT "%5.1" ECU_ADDRESS 0x3808F5 /end MEASUREMENT
/begin MEASUREMENT B_afklt "Bereichsfenster Aussetzer, Bedingung kalt, TMOT<TMWUC" UBYTE B_TRUE 1 100 0 1 BIT_MASK 0x2 FORMAT "%13.11" ECU_ADDRESS 0x383309 /end MEASUREMENT
/begin MEASUREMENT B_aftklt "Bereichsfenster Aussetzer, temporär, Bedingung kalt, TMOT<TMWUC" UBYTE B_TRUE 1 100 0 1 BIT_MASK 0x8 FORMAT "%13.11" ECU_ADDRESS 0x383309 /end MEASUREMENT
/begin MEASUREMENT B_aftwrm "Bereichsfenster Aussetzer, temporär, Bedingung warm, TMOT>TMWUC" UBYTE B_TRUE 1 100 0 1 BIT_MASK 0x4 FORMAT "%13.11" ECU_ADDRESS 0x383309 /end MEASUREMENT
/begin MEASUREMENT B_afwrm "Bereichsfenster Aussetzer, Bedingung warm, TMOT>TMWUC" UBYTE B_TRUE 1 100 0 1 BIT_MASK 0x1 FORMAT "%13.11" ECU_ADDRESS 0x383309 /end MEASUREMENT
/begin MEASUREMENT B_analu_m "Monitor, Ausblendung nach dem ersten erkannten Aussetzer" UBYTE B_TRUE 1 100 0 1 BIT_MASK 0x4 FORMAT "%13.11" ECU_ADDRESS 0xE3DB /end MEASUREMENT
/begin MEASUREMENT B_anzsls "Bedingung Anzahl der ausgewerteten SL-Messungen größer als Schwellwert" UBYTE B_TRUE 1 100 0 1 BIT_MASK 0x4 FORMAT "%13.11" ECU_ADDRESS 0x3808A1 /end MEASUREMENT
/begin MEASUREMENT B_asent "Bedingung : Fehler E_ase bereits vor Tank-Leer vorhanden" UWORD B_TRUE 1 100 0 1 BIT_MASK 0x1 FORMAT "%13.11" ECU_ADDRESS 0x383C3C /end MEASUREMENT
/begin MEASUREMENT B_asetl "Bedingung abgasrelevante Aussetzer wegen leerem Tank" UWORD B_TRUE 1 100 0 1 BIT_MASK 0x1 FORMAT "%13.11" ECU_ADDRESS 0x383C3E /end MEASUREMENT
/begin MEASUREMENT B_asknt "Bedingung : Fehler E_ask bereits vor Tank-Leer" UWORD B_TRUE 1 100 0 1 BIT_MASK 0x2 FORMAT "%13.11" ECU_ADDRESS 0x383C3C /end MEASUREMENT
/begin MEASUREMENT B_asktl "Bedingung katschädigende Aussetzer wegen leerem Tank" UWORD B_TRUE 1 100 0 1 BIT_MASK 0x2 FORMAT "%13.11" ECU_ADDRESS 0x383C3E /end MEASUREMENT
/begin MEASUREMENT B_astat "Bedingung Anforderung Statistikteil für Diagnose Sekundärluft" UBYTE B_TRUE 1 100 0 1 BIT_MASK 0x8 FORMAT "%13.11" ECU_ADDRESS 0x3808A1 /end MEASUREMENT
/begin MEASUREMENT B_atev "Bedingung Endstufendiagnose TEV auf" UWORD B_TRUE 1 100 0 1 BIT_MASK 0x8 FORMAT "%13.11" ECU_ADDRESS 0xFD4E /end MEASUREMENT
/begin MEASUREMENT B_bbdthm "Bedingung Betriebsbereich Diagn. Thermostat erfüllt" UWORD B_TRUE 1 100 0 1 BIT_MASK 0x80 FORMAT "%13.11" ECU_ADDRESS 0xFD6A /end MEASUREMENT
/begin MEASUREMENT B_bfklt "Bereichsfenster Motorbetrieb, Bedingung kalt, TMOT<TMWUC" UBYTE B_TRUE 1 100 0 1 BIT_MASK 0x20 FORMAT "%13.11" ECU_ADDRESS 0x383309 /end MEASUREMENT
/begin MEASUREMENT B_bfwrm "Bereichsfenster Motorbetrieb, Bedingung warm, TMOT>TMWUC" UBYTE B_TRUE 1 100 0 1 BIT_MASK 0x10 FORMAT "%13.11" ECU_ADDRESS 0x383309 /end MEASUREMENT
/begin MEASUREMENT B_blkeb "MIL-Ansteuerung blinkend eigenbestimmt" UBYTE B_TRUE 1 100 0 1 BIT_MASK 0x4 FORMAT "%13.11" ECU_ADDRESS 0x384821 /end MEASUREMENT
/begin MEASUREMENT B_blkfb "MIL-Ansteuerung blinkend fremdbestimmt durch externes SG" UWORD B_TRUE 1 100 0 1 BIT_MASK 0x2 FORMAT "%13.11" ECU_ADDRESS 0xFD0E /end MEASUREMENT
/begin MEASUREMENT B_blkmd "MIL-Ansteuerung blinkend durch Aussetzererkennung" UWORD B_TRUE 1 100 0 1 BIT_MASK 0x8000 FORMAT "%13.11" ECU_ADDRESS 0xFD24 /end MEASUREMENT
/begin MEASUREMENT B_cwdslt "Bedingung: Freigabe Ventildichtheitsprüfung" UBYTE B_TRUE 1 100 0 1 BIT_MASK 0x1 FORMAT "%13.11" ECU_ADDRESS 0x38089B /end MEASUREMENT
/begin MEASUREMENT B_cwdsltfa "Bedingung: Freigabe Ventildichtheitsprüfung bei Kurztest" UBYTE B_TRUE 1 100 0 1 BIT_MASK 0x10 FORMAT "%13.11" ECU_ADDRESS 0x3808A2 /end MEASUREMENT
/begin MEASUREMENT B_cwdslty "Bedingung rdy-Flag ohne Z_slp bei aktiver Prüfung" UBYTE B_TRUE 1 100 0 1 BIT_MASK 0x1 FORMAT "%13.11" ECU_ADDRESS 0x380899 /end MEASUREMENT
/begin MEASUREMENT B_cwdthm "Bedingung: Diagnose Thermostat Motor-Kühlmittel eingeschaltet" UWORD B_TRUE 1 100 0 1 BIT_MASK 0x100 FORMAT "%13.11" ECU_ADDRESS 0xFD6A /end MEASUREMENT
/begin MEASUREMENT B_cwsla "Bedingung: Freigabe der Adaptionsphase/Zusatzdiagnose" UBYTE B_TRUE 1 100 0 1 BIT_MASK 0x1 FORMAT "%13.11" ECU_ADDRESS 0x38089D /end MEASUREMENT
/begin MEASUREMENT B_denws "Aktive Diagnose: Nockenwellensteuerung (Einlaßseite, Bank1)" UBYTE B_TRUE 1 100 0 1 BIT_MASK 0x1 FORMAT "%13.11" ECU_ADDRESS 0x38492B /end MEASUREMENT
/begin MEASUREMENT B_dfrmoe "Bedingung Messung und Bewertung frm-Offset läuft (dfrmoff_w, B_dfrmoff)" UBYTE B_TRUE 1 100 0 1 BIT_MASK 0x1 FORMAT "%13.11" ECU_ADDRESS 0x3808A1 /end MEASUREMENT
/begin MEASUREMENT B_dfrmoff "frm-Offset-Schwelle überschritten: zeigt Vorsteuerproblem" UBYTE B_TRUE 1 100 0 1 BIT_MASK 0x80 FORMAT "%13.11" ECU_ADDRESS 0x38089F /end MEASUREMENT
/begin MEASUREMENT B_dfrmoff2 "frm-Offset-Schwelle überschritten: zeigt Vorsteuerproblem Bank 2" UBYTE B_TRUE 1 100 0 1 BIT_MASK 0x1 FORMAT "%13.11" ECU_ADDRESS 0x3808A0 /end MEASUREMENT
/begin MEASUREMENT B_dsl "Bedingung Diagnoseanforderung" UBYTE B_TRUE 1 100 0 1 BIT_MASK 0x20 FORMAT "%13.11" ECU_ADDRESS 0x38089C /end MEASUREMENT
/begin MEASUREMENT B_dsl1 "Diagnose Phase 1: Bestimmung Sekundärluftmasse" UBYTE B_TRUE 1 100 0 1 BIT_MASK 0x2 FORMAT "%13.11" ECU_ADDRESS 0x380899 /end MEASUREMENT
/begin MEASUREMENT B_dsl1ab "Diagnose Phase 1: Abbruch Phase 1" UBYTE B_TRUE 1 100 0 1 BIT_MASK 0x20 FORMAT "%13.11" ECU_ADDRESS 0x38089D /end MEASUREMENT
/begin MEASUREMENT B_dsl1e "Diagnose Phase 1, Meßfreigabe Sekundärluftmasse" UBYTE B_TRUE 1 100 0 1 BIT_MASK 0x40 FORMAT "%13.11" ECU_ADDRESS 0x38089D /end MEASUREMENT
/begin MEASUREMENT B_dsl2 "Diagnose Phase 2: Ventildichtheit" UBYTE B_TRUE 1 100 0 1 BIT_MASK 0x80 FORMAT "%13.11" ECU_ADDRESS 0x38089D /end MEASUREMENT
/begin MEASUREMENT B_dsl2ab "Diagnose Phase 2: Abbruch Phase 2" UBYTE B_TRUE 1 100 0 1 BIT_MASK 0x1 FORMAT "%13.11" ECU_ADDRESS 0x38089E /end MEASUREMENT
/begin MEASUREMENT B_dsl2e "Diagnose Phase 2: Freigabe Messung" UBYTE B_TRUE 1 100 0 1 BIT_MASK 0x2 FORMAT "%13.11" ECU_ADDRESS 0x38089E /end MEASUREMENT
/begin MEASUREMENT B_dsl3 "Diagnose Phase3: Offset Sekundärluftmasse" UBYTE B_TRUE 1 100 0 1 BIT_MASK 0x4 FORMAT "%13.11" ECU_ADDRESS 0x38089E /end MEASUREMENT
/begin MEASUREMENT B_dsl3ab "Diagnose Phase 3: Abbruch" UBYTE B_TRUE 1 100 0 1 BIT_MASK 0x8 FORMAT "%13.11" ECU_ADDRESS 0x38089E /end MEASUREMENT
/begin MEASUREMENT B_dsl3e "Diagnose Phase 3: Freigabe Messung" UBYTE B_TRUE 1 100 0 1 BIT_MASK 0x10 FORMAT "%13.11" ECU_ADDRESS 0x38089E /end MEASUREMENT
/begin MEASUREMENT B_dsl4 "Bedingung Phase 4: Sekundärluftmasse aus Adaption/Zusatzdiagnose" UBYTE B_TRUE 1 100 0 1 BIT_MASK 0x4 FORMAT "%13.11" ECU_ADDRESS 0x380899 /end MEASUREMENT
/begin MEASUREMENT B_dsl45 "Diagnose Phase 4 oder Phase 5 aktiv" UBYTE B_TRUE 1 100 0 1 BIT_MASK 0x4 FORMAT "%13.11" ECU_ADDRESS 0x3808A0 /end MEASUREMENT
/begin MEASUREMENT B_dsl4ab "Bedingung: Abbruch Phase 4" UBYTE B_TRUE 1 100 0 1 BIT_MASK 0x80 FORMAT "%13.11" ECU_ADDRESS 0x38089E /end MEASUREMENT
/begin MEASUREMENT B_dsl4e "Bedingung: Phase 4 Freigabe Messung" UBYTE B_TRUE 1 100 0 1 BIT_MASK 0x1 FORMAT "%13.11" ECU_ADDRESS 0x38089F /end MEASUREMENT
/begin MEASUREMENT B_dsl5 "Diagnose Phase 5: Offset Sekundärluftmasse" UBYTE B_TRUE 1 100 0 1 BIT_MASK 0x2 FORMAT "%13.11" ECU_ADDRESS 0x38089F /end MEASUREMENT
/begin MEASUREMENT B_dsl5ab "Diagnose Phase 5: Abbruch" UBYTE B_TRUE 1 100 0 1 BIT_MASK 0x4 FORMAT "%13.11" ECU_ADDRESS 0x38089F /end MEASUREMENT
/begin MEASUREMENT B_dsl5dly "Verzögerung nach Diagnose Phase 5" UBYTE B_TRUE 1 100 0 1 BIT_MASK 0x2 FORMAT "%13.11" ECU_ADDRESS 0x3808A0 /end MEASUREMENT
/begin MEASUREMENT B_dsl5e "Diagnose Phase 5: Freigabe Messung" UBYTE B_TRUE 1 100 0 1 BIT_MASK 0x8 FORMAT "%13.11" ECU_ADDRESS 0x38089F /end MEASUREMENT
/begin MEASUREMENT B_dsla "Adaptionsphase: Bestimmung Sekundärluftmasse" UWORD B_TRUE 1 100 0 1 BIT_MASK 0x8000 FORMAT "%13.11" ECU_ADDRESS 0xFD0E /end MEASUREMENT
/begin MEASUREMENT B_dslerr "Zusammenfassung Abbruchmerkmale Sekundärluftdiagnose" UBYTE B_TRUE 1 100 0 1 BIT_MASK 0x8 FORMAT "%13.11" ECU_ADDRESS 0x38089B /end MEASUREMENT
/begin MEASUREMENT B_dslfa "Bedingung: Anforderung SL-System für Kurztest" UBYTE B_TRUE 1 100 0 1 BIT_MASK 0x4 FORMAT "%13.11" ECU_ADDRESS 0x38089A /end MEASUREMENT
/begin MEASUREMENT B_dslfrg "Bedingung frm eingeschwungenen für Freigabe Zusatzdiagnose SLS" UBYTE B_TRUE 1 100 0 1 BIT_MASK 0x2 FORMAT "%13.11" ECU_ADDRESS 0x3808A1 /end MEASUREMENT
/begin MEASUREMENT B_dslfrg12 "Bedingung frm und frm2 eingeschwungenen für Freigabe Zusatzdiagnose SLS" UBYTE B_TRUE 1 100 0 1 BIT_MASK 0x20 FORMAT "%13.11" ECU_ADDRESS 0x38089A /end MEASUREMENT
/begin MEASUREMENT B_dslm "Diagnose Sekundärluftmasse" UBYTE B_TRUE 1 100 0 1 BIT_MASK 0x10 FORMAT "%13.11" ECU_ADDRESS 0x38089B /end MEASUREMENT
/begin MEASUREMENT B_dslmab "Diagnose Sekundärluftmasse, Meßabbruch" UBYTE B_TRUE 1 100 0 1 BIT_MASK 0x20 FORMAT "%13.11" ECU_ADDRESS 0x38089B /end MEASUREMENT
/begin MEASUREMENT B_dslme "Diagnose Sekundärluftmasse, Meßfreigabe" UBYTE B_TRUE 1 100 0 1 BIT_MASK 0x40 FORMAT "%13.11" ECU_ADDRESS 0x38089B /end MEASUREMENT
/begin MEASUREMENT B_dslmes "Bedingung: Freigabe Meßfenster" UBYTE B_TRUE 1 100 0 1 BIT_MASK 0x80 FORMAT "%13.11" ECU_ADDRESS 0x38089B /end MEASUREMENT
/begin MEASUREMENT B_dslo "Diagnose Sekundärluftmassenoffset" UBYTE B_TRUE 1 100 0 1 BIT_MASK 0x1 FORMAT "%13.11" ECU_ADDRESS 0x38089C /end MEASUREMENT
/begin MEASUREMENT B_dsloab "Diagnose Sekundärluftoffset, Meßabbruch" UBYTE B_TRUE 1 100 0 1 BIT_MASK 0x2 FORMAT "%13.11" ECU_ADDRESS 0x38089C /end MEASUREMENT
/begin MEASUREMENT B_dsloe "Diagnose Sekundärluftoffset, Meßfreigabe" UBYTE B_TRUE 1 100 0 1 BIT_MASK 0x4 FORMAT "%13.11" ECU_ADDRESS 0x38089C /end MEASUREMENT
/begin MEASUREMENT B_dslp4 "Bedingung  Phase 4 mindestens einmal eingeleitet" UBYTE B_TRUE 1 100 0 1 BIT_MASK 0x8 FORMAT "%13.11" ECU_ADDRESS 0x38089C /end MEASUREMENT
/begin MEASUREMENT B_dsls "Aktive Diagnose: Sekundärluft-System" UWORD B_TRUE 1 100 0 1 BIT_MASK 0x1 FORMAT "%13.11" ECU_ADDRESS 0xFD10 /end MEASUREMENT
/begin MEASUREMENT B_dslsp4 "Bedingung: Anforderung SL-System für Sekundärluftadaption/Zusatzdiagnose" UBYTE B_TRUE 1 100 0 1 BIT_MASK 0x1 FORMAT "%13.11" ECU_ADDRESS 0x38089A /end MEASUREMENT
/begin MEASUREMENT B_dsltab "Diagnose Ventilichtheit, Meßabbruch" UBYTE B_TRUE 1 100 0 1 BIT_MASK 0x80 FORMAT "%13.11" ECU_ADDRESS 0x38089C /end MEASUREMENT
/begin MEASUREMENT B_dslte "Diagnose Ventildichtheit, Meßfreigabe" UBYTE B_TRUE 1 100 0 1 BIT_MASK 0x2 FORMAT "%13.11" ECU_ADDRESS 0x38089D /end MEASUREMENT
/begin MEASUREMENT B_dspe "Bedingung Diagnose Sekundärluft ein" UBYTE B_TRUE 1 100 0 1 BIT_MASK 0x8 FORMAT "%13.11" ECU_ADDRESS 0x380899 /end MEASUREMENT
/begin MEASUREMENT B_dsper "Bedingung Rücksetzen ESP ein" UBYTE B_TRUE 1 100 0 1 BIT_MASK 0x4 FORMAT "%13.11" ECU_ADDRESS 0x38089D /end MEASUREMENT
/begin MEASUREMENT B_dspes "Bedingung Setzen ESP ein" UBYTE B_TRUE 1 100 0 1 BIT_MASK 0x8 FORMAT "%13.11" ECU_ADDRESS 0x38089D /end MEASUREMENT
/begin MEASUREMENT B_dteaa "Bedingung Aufsteuerprüfung für TEV Diagnose aktiv" UWORD B_TRUE 1 100 0 1 BIT_MASK 0x4000 FORMAT "%13.11" ECU_ADDRESS 0xFD9C /end MEASUREMENT
/begin MEASUREMENT B_dteaab "Bedingung DTEV-Abbruch wegen Verlassen Aktivierungsbedingungen" UWORD B_TRUE 1 100 0 1 BIT_MASK 0x8000 FORMAT "%13.11" ECU_ADDRESS 0xFD9C /end MEASUREMENT
/begin MEASUREMENT B_dteaam "Bedingung Aufsteuerprüfung für TEV Diagnose aktiv möglich" UWORD B_TRUE 1 100 0 1 BIT_MASK 0x1 FORMAT "%13.11" ECU_ADDRESS 0xFD9E /end MEASUREMENT
/begin MEASUREMENT B_dteabu "Bedingung Abbruch TE Diagnose ohne Prüfergebnis" UWORD B_TRUE 1 100 0 1 BIT_MASK 0x2 FORMAT "%13.11" ECU_ADDRESS 0xFD9E /end MEASUREMENT
/begin MEASUREMENT B_dteanfl "abgelaufene Zeit ab die, das Tastverhälnis aus DTEV größer Schwelle" UWORD B_TRUE 1 100 0 1 BIT_MASK 0x4 FORMAT "%13.11" ECU_ADDRESS 0xFD9E /end MEASUREMENT
/begin MEASUREMENT B_dteend "Bedingung Diagnose TEV erfolgreich zu Ende" UWORD B_TRUE 1 100 0 1 BIT_MASK 0x8 FORMAT "%13.11" ECU_ADDRESS 0xFD9E /end MEASUREMENT
/begin MEASUREMENT B_dteendl "Bedingung Diagnose TEV über Luftprüfung erfolgreich zu Ende" UWORD B_TRUE 1 100 0 1 BIT_MASK 0x10 FORMAT "%13.11" ECU_ADDRESS 0xFD9E /end MEASUREMENT
/begin MEASUREMENT B_dteenf "Bedingung Diagnose TEV wegen System-Error nicht freigegeben" UWORD B_TRUE 1 100 0 1 BIT_MASK 0x20 FORMAT "%13.11" ECU_ADDRESS 0xFD9E /end MEASUREMENT
/begin MEASUREMENT B_dtefre "Bedingung fr für Diagnose TEV eingeschwungen." UWORD B_TRUE 1 100 0 1 BIT_MASK 0x40 FORMAT "%13.11" ECU_ADDRESS 0xFD9E /end MEASUREMENT
/begin MEASUREMENT B_dtefrr "Bedingung Lambdareglerreset bei Tankentlüftungsdiagnose" UWORD B_TRUE 1 100 0 1 BIT_MASK 0x80 FORMAT "%13.11" ECU_ADDRESS 0xFD9E /end MEASUREMENT
/begin MEASUREMENT B_dtelab "Bedingung DTEV-Abbruch wegen Störung Leerlaufluftprüfung" UWORD B_TRUE 1 100 0 1 BIT_MASK 0x100 FORMAT "%13.11" ECU_ADDRESS 0xFD9E /end MEASUREMENT
/begin MEASUREMENT B_dtelbm "Bedingung Bewertung des Lambda Reglers bei Diagnose TEV möglich" UWORD B_TRUE 1 100 0 1 BIT_MASK 0x200 FORMAT "%13.11" ECU_ADDRESS 0xFD9E /end MEASUREMENT
/begin MEASUREMENT B_dtelbr "Bedingung Reset Flip-Flop Passiv-Prüfung DTEV möglich" UWORD B_TRUE 1 100 0 1 BIT_MASK 0x400 FORMAT "%13.11" ECU_ADDRESS 0xFD9E /end MEASUREMENT
/begin MEASUREMENT B_dtelnm "LL-Prüfung Diagnose TEV nicht möglich" UWORD B_TRUE 1 100 0 1 BIT_MASK 0x800 FORMAT "%13.11" ECU_ADDRESS 0xFD9E /end MEASUREMENT
/begin MEASUREMENT B_dtelnmb "Bestätigt : LL-Prüfung Diagnose TEV nicht möglich" UWORD B_TRUE 1 100 0 1 BIT_MASK 0x1000 FORMAT "%13.11" ECU_ADDRESS 0xFD9E /end MEASUREMENT
/begin MEASUREMENT B_dtelnmv "Vorbehalt: LL-Prüfung Diagnose TEV nicht möglich" UWORD B_TRUE 1 100 0 1 BIT_MASK 0x2000 FORMAT "%13.11" ECU_ADDRESS 0xFD9E /end MEASUREMENT
/begin MEASUREMENT B_dtenam "Bedingung TEV Diagnose nur über Aufsteuerprüfung möglich" UWORD B_TRUE 1 100 0 1 BIT_MASK 0x4000 FORMAT "%13.11" ECU_ADDRESS 0xFD9E /end MEASUREMENT
/begin MEASUREMENT B_dtephm "Bedingung physikalische Freigabe DTEV" UWORD B_TRUE 1 100 0 1 BIT_MASK 0x8000 FORMAT "%13.11" ECU_ADDRESS 0xFD9E /end MEASUREMENT
/begin MEASUREMENT B_dtepm "Bedingung passive TEV Diagnose möglich" UWORD B_TRUE 1 100 0 1 BIT_MASK 0x1 FORMAT "%13.11" ECU_ADDRESS 0xFDA0 /end MEASUREMENT
/begin MEASUREMENT B_dterab "Bedingung DTEV-Abbruch wegen Abweichung Lambdaregler zur groß" UWORD B_TRUE 1 100 0 1 BIT_MASK 0x2 FORMAT "%13.11" ECU_ADDRESS 0xFDA0 /end MEASUREMENT
/begin MEASUREMENT B_dterap "Bedingung DTEV Reset durch Applikation" UWORD B_TRUE 1 100 0 1 BIT_MASK 0x4 FORMAT "%13.11" ECU_ADDRESS 0xFDA0 /end MEASUREMENT
/begin MEASUREMENT B_dteres "Bedingung TEV Diagnose Reset" UWORD B_TRUE 1 100 0 1 BIT_MASK 0x8 FORMAT "%13.11" ECU_ADDRESS 0xFDA0 /end MEASUREMENT
/begin MEASUREMENT B_dternm "Bedingung kein fr-Hub für Diagnose TEV vorhanden" UWORD B_TRUE 1 100 0 1 BIT_MASK 0x10 FORMAT "%13.11" ECU_ADDRESS 0xFDA0 /end MEASUREMENT
/begin MEASUREMENT B_dtes "Aktive Diagnose: Tankentlüftungssystem" UWORD B_TRUE 1 100 0 1 BIT_MASK 0x20 FORMAT "%13.11" ECU_ADDRESS 0xFDA0 /end MEASUREMENT
/begin MEASUREMENT B_dtest "Start für TEV-Ansteuerung" UWORD B_TRUE 1 100 0 1 BIT_MASK 0x40 FORMAT "%13.11" ECU_ADDRESS 0xFDA0 /end MEASUREMENT
/begin MEASUREMENT B_dtezam "Bedingung Diagnose TEV für Zusteuer-/Aufsteuerprüfung ist möglich" UWORD B_TRUE 1 100 0 1 BIT_MASK 0x80 FORMAT "%13.11" ECU_ADDRESS 0xFDA0 /end MEASUREMENT
/begin MEASUREMENT B_ehfs "Bedingung Ersatzwert Hauptfüllungssensor" UWORD B_TRUE 1 100 0 1 BIT_MASK 0x400 FORMAT "%13.11" ECU_ADDRESS 0xFD52 /end MEASUREMENT
/begin MEASUREMENT B_enws "Bedingung Fehler Nockenwellenansteuerung liegt vor" UBYTE B_TRUE 1 100 0 1 BIT_MASK 0x1 FORMAT "%13.11" ECU_ADDRESS 0x38491D /end MEASUREMENT
/begin MEASUREMENT B_enwse "Bedingung Error Nockenwelle (Einlaßseitig)" UBYTE B_TRUE 1 100 0 1 BIT_MASK 0x2 FORMAT "%13.11" ECU_ADDRESS 0x38491D /end MEASUREMENT
/begin MEASUREMENT B_enwsea "Bedingung Endstufe-NW (Einlaß, Bank1) angesteuert" UBYTE B_TRUE 1 100 0 1 BIT_MASK 0x1 FORMAT "%13.11" ECU_ADDRESS 0x38492D /end MEASUREMENT
/begin MEASUREMENT B_enwsena "Bedingung Endstufe-NW (Einlaß, Bank1) nicht angesteuert" UBYTE B_TRUE 1 100 0 1 BIT_MASK 0x2 FORMAT "%13.11" ECU_ADDRESS 0x38492D /end MEASUREMENT
/begin MEASUREMENT B_enwsve "Bedingung Fehlerverdacht Nockenwellensteller Einlass" UBYTE B_TRUE 1 100 0 1 BIT_MASK 0x4 FORMAT "%13.11" ECU_ADDRESS 0x38492B /end MEASUREMENT
/begin MEASUREMENT B_errmsl "Bedingung rmsl kleiner als vorgegebener Schwellwert" UBYTE B_TRUE 1 100 0 1 BIT_MASK 0x10 FORMAT "%13.11" ECU_ADDRESS 0x3808A1 /end MEASUREMENT
/begin MEASUREMENT B_errofs "Bedingung: zulässige Sekundärluftmassen-Offset überschritten" UBYTE B_TRUE 1 100 0 1 BIT_MASK 0x10 FORMAT "%13.11" ECU_ADDRESS 0x38089D /end MEASUREMENT
/begin MEASUREMENT B_esls "Bedingung Falschluft durch Fehler im Sekundärluftsystem" UWORD B_TRUE 1 100 0 1 BIT_MASK 0x2 FORMAT "%13.11" ECU_ADDRESS 0xFD10 /end MEASUREMENT
/begin MEASUREMENT B_eslsp "lokales Errorflag: Sekundärluft-System" UBYTE B_TRUE 1 100 0 1 BIT_MASK 0x10 FORMAT "%13.11" ECU_ADDRESS 0x3808A0 /end MEASUREMENT
/begin MEASUREMENT B_eslvp "lokale Errorflag: Sekundärluftventil" UBYTE B_TRUE 1 100 0 1 BIT_MASK 0x20 FORMAT "%13.11" ECU_ADDRESS 0x38089E /end MEASUREMENT
/begin MEASUREMENT B_ethmr "Bedingung Thermostatfehler im RS-Flip-Flop gespeichert" UBYTE B_TRUE 1 100 0 1 BIT_MASK 0x1 FORMAT "%13.11" ECU_ADDRESS 0x380A11 /end MEASUREMENT
/begin MEASUREMENT B_faslarq "Bedingung: lokale Anforderung Testdurchlauf Sekundärluft starten" UBYTE B_TRUE 1 100 0 1 BIT_MASK 0x40 FORMAT "%13.11" ECU_ADDRESS 0x38089F /end MEASUREMENT
/begin MEASUREMENT B_faslaset "Auswertung der Fehlerschwellen für Kurztest" UBYTE B_TRUE 1 100 0 1 BIT_MASK 0x8 FORMAT "%13.11" ECU_ADDRESS 0x3808A2 /end MEASUREMENT
/begin MEASUREMENT B_fedkb "Bedingung Füllungserfassung drosselklappenbasiert" UWORD B_TRUE 1 100 0 1 BIT_MASK 0x800 FORMAT "%13.11" ECU_ADDRESS 0xFD52 /end MEASUREMENT
/begin MEASUREMENT B_fgadllfr "Bedingung zur Freigabe der aktiv Diagnose im LL bei eingeschwungenen fr" UBYTE B_TRUE 1 100 0 1 BIT_MASK 0x10 FORMAT "%13.11" ECU_ADDRESS 0x38089A /end MEASUREMENT
/begin MEASUREMENT B_fgszsla "Bedingung Freigabe der Anforderung Aktivdiagnose" UBYTE B_TRUE 1 100 0 1 BIT_MASK 0x2 FORMAT "%13.11" ECU_ADDRESS 0x3808A2 /end MEASUREMENT
/begin MEASUREMENT B_fgszsls "Bedingung Freigabe der Setzbedingung des Zyklusflags Z_sls" UBYTE B_TRUE 1 100 0 1 BIT_MASK 0x1 FORMAT "%13.11" ECU_ADDRESS 0x3808A2 /end MEASUREMENT
/begin MEASUREMENT B_first "Hilfsvariable Detektion 720° Marke Kurbelwelle" UWORD B_TRUE 1 100 0 1 BIT_MASK 0x2000 FORMAT "%13.11" ECU_ADDRESS 0x38195E /end MEASUREMENT
/begin MEASUREMENT B_fnsoff "Bedingung Berechnung Nachstart abschalten" UBYTE B_TRUE 1 100 0 1 BIT_MASK 0x1 FORMAT "%13.11" ECU_ADDRESS 0x3809D8 /end MEASUREMENT
/begin MEASUREMENT B_fofstp "Bedingung fuel-off Adaption gestoppt" UWORD B_TRUE 1 100 0 1 BIT_MASK 0x40 FORMAT "%13.11" ECU_ADDRESS 0xFDB8 /end MEASUREMENT
/begin MEASUREMENT B_fofstpt "Bedingung fuel-off Adaption gestoppt vom 2. SG" UWORD B_TRUE 1 100 0 1 BIT_MASK 0x2 FORMAT "%13.11" ECU_ADDRESS 0xFD24 /end MEASUREMENT
/begin MEASUREMENT B_fonstp "Bedingung fuel-on Adaption gestoppt" UWORD B_TRUE 1 100 0 1 BIT_MASK 0x80 FORMAT "%13.11" ECU_ADDRESS 0xFDB8 /end MEASUREMENT
/begin MEASUREMENT B_fonstpt "Bedingung fuel-on Adaption gestoppt vom 2. SG" UWORD B_TRUE 1 100 0 1 BIT_MASK 0x4 FORMAT "%13.11" ECU_ADDRESS 0xFD24 /end MEASUREMENT
/begin MEASUREMENT B_fraont "Bedingung : Fehler E-frao bereits vor Tank-Leer" UWORD B_TRUE 1 100 0 1 BIT_MASK 0x40 FORMAT "%13.11" ECU_ADDRESS 0x383C3C /end MEASUREMENT
/begin MEASUREMENT B_fraotl "Bedingung Fehler LR-Adaption oberer Bereich wegen leerem Tank" UWORD B_TRUE 1 100 0 1 BIT_MASK 0x40 FORMAT "%13.11" ECU_ADDRESS 0x383C3E /end MEASUREMENT
/begin MEASUREMENT B_fraunt "Bedingung : Fehler E_frau bereits vor Tank-Leer" UWORD B_TRUE 1 100 0 1 BIT_MASK 0x10 FORMAT "%13.11" ECU_ADDRESS 0x383C3C /end MEASUREMENT
/begin MEASUREMENT B_frautl "Bed. Fehler LR-Adaption unterer mult. Bereich wegen leerem Tank" UWORD B_TRUE 1 100 0 1 BIT_MASK 0x10 FORMAT "%13.11" ECU_ADDRESS 0x383C3E /end MEASUREMENT
/begin MEASUREMENT B_ftedab "Bedingung Spülrate für Diagnose zusteuern" UWORD B_TRUE 1 100 0 1 BIT_MASK 0x100 FORMAT "%13.11" ECU_ADDRESS 0xFDA0 /end MEASUREMENT
/begin MEASUREMENT B_kmmil "MIL-Ansteuerung mit Relevanz zu Kilometererfassung" UBYTE B_TRUE 1 100 0 1 BIT_MASK 0x1 FORMAT "%13.11" ECU_ADDRESS 0x384005 /end MEASUREMENT
/begin MEASUREMENT B_luaerk_m "Monitor, Aussetzer erkannt in DMDLUA" UBYTE B_TRUE 1 100 0 1 BIT_MASK 0x2 FORMAT "%13.11" ECU_ADDRESS 0xE3DB /end MEASUREMENT
/begin MEASUREMENT B_luena "Bedingung LU-Berechnung erlaubt (ohne Verzugszeit)" UWORD B_TRUE 1 100 0 1 BIT_MASK 0x2 FORMAT "%13.11" ECU_ADDRESS 0xFDB6 /end MEASUREMENT
/begin MEASUREMENT B_luerk_m "Monitor, Aussetzer erkannt in DMDLU" UBYTE B_TRUE 1 100 0 1 BIT_MASK 0x4 FORMAT "%13.11" ECU_ADDRESS 0xE43C /end MEASUREMENT
/begin MEASUREMENT B_lustop "Laufunruhe-Berechnung gesperrt" UWORD B_TRUE 1 100 0 1 BIT_MASK 0x2000 FORMAT "%13.11" ECU_ADDRESS 0xFDB8 /end MEASUREMENT
/begin MEASUREMENT B_lustopt "Laufunruhe-Berechnung gesperrt vom 2. SG" UWORD B_TRUE 1 100 0 1 BIT_MASK 0x8 FORMAT "%13.11" ECU_ADDRESS 0xFD24 /end MEASUREMENT
/begin MEASUREMENT B_lustopu "Laufunruhe-Berechnung gesperrt, unverzögert" UWORD B_TRUE 1 100 0 1 BIT_MASK 0x4 FORMAT "%13.11" ECU_ADDRESS 0xFDB6 /end MEASUREMENT
/begin MEASUREMENT B_lustop_m "Laufunruhe-Berechnung gesperrt, Monitor-Größe" UBYTE B_TRUE 1 100 0 1 BIT_MASK 0x8 FORMAT "%13.11" ECU_ADDRESS 0xE43C /end MEASUREMENT
/begin MEASUREMENT B_mdarv "kritische Aussetzerrate vorhanden" UWORD B_TRUE 1 100 0 1 BIT_MASK 0x1 FORMAT "%13.11" ECU_ADDRESS 0xFD26 /end MEASUREMENT
/begin MEASUREMENT B_mdarvb1 "kritische Aussetzerrate Bank1 vorhanden" UWORD B_TRUE 1 100 0 1 BIT_MASK 0x2 FORMAT "%13.11" ECU_ADDRESS 0xFD26 /end MEASUREMENT
/begin MEASUREMENT B_mdarvb2 "kritische Aussetzerrate Bank2 vorhanden" UWORD B_TRUE 1 100 0 1 BIT_MASK 0x4 FORMAT "%13.11" ECU_ADDRESS 0xFD26 /end MEASUREMENT
/begin MEASUREMENT B_mddrla "Bedingung Misfire Detection Lastgradient für Aussetzererkennung" UWORD B_TRUE 1 100 0 1 BIT_MASK 0x20 FORMAT "%13.11" ECU_ADDRESS 0xFDBA /end MEASUREMENT
/begin MEASUREMENT B_mdkat "Katschädigende Aussetzerrate überschritten (zur Ausblendung anderer Funktionen)" UWORD B_TRUE 1 100 0 1 BIT_MASK 0x8 FORMAT "%13.11" ECU_ADDRESS 0xFD26 /end MEASUREMENT
/begin MEASUREMENT B_mdkatb1 "Katschädigende Aussetzerrate Bank1 (zur Ausblendung anderer Funktionen)" UWORD B_TRUE 1 100 0 1 BIT_MASK 0x10 FORMAT "%13.11" ECU_ADDRESS 0xFD26 /end MEASUREMENT
/begin MEASUREMENT B_mdkatb2 "Katschädigende Aussetzerrate Bank2 (zur Ausblendung anderer Funktionen)" UWORD B_TRUE 1 100 0 1 BIT_MASK 0x20 FORMAT "%13.11" ECU_ADDRESS 0xFD26 /end MEASUREMENT
/begin MEASUREMENT B_mdng "Bedingung Misfire Detection Drehzahlgradient für Aussetzererkennung" UWORD B_TRUE 1 100 0 1 BIT_MASK 0x2 FORMAT "%13.11" ECU_ADDRESS 0xFDBA /end MEASUREMENT
/begin MEASUREMENT B_mdnmot "Bedingung Misfire Detection obere und untere Drehzahlgrenze" UWORD B_TRUE 1 100 0 1 BIT_MASK 0x4 FORMAT "%13.11" ECU_ADDRESS 0xFDBA /end MEASUREMENT
/begin MEASUREMENT B_mdrl "Bedingung Misfire Detection untere Lastgrenze" UWORD B_TRUE 1 100 0 1 BIT_MASK 0x8 FORMAT "%13.11" ECU_ADDRESS 0xFDBA /end MEASUREMENT
/begin MEASUREMENT B_mdstim_m "Monitor, Zündungsaussetzer eingestellt, Stimuli-Signal vom Aussetzergenerator" UBYTE B_TRUE 1 100 0 1 BIT_MASK 0x2 FORMAT "%13.11" ECU_ADDRESS 0xE43C /end MEASUREMENT
/begin MEASUREMENT B_mdstopt "Misfire Detection gesperrt vom 2. SG" UWORD B_TRUE 1 100 0 1 BIT_MASK 0x10 FORMAT "%13.11" ECU_ADDRESS 0xFD24 /end MEASUREMENT
/begin MEASUREMENT B_mdstop_m "Monitor, Misfire Detection gesperrt" UBYTE B_TRUE 1 100 0 1 BIT_MASK 0x80 FORMAT "%13.11" ECU_ADDRESS 0xE43C /end MEASUREMENT
/begin MEASUREMENT B_mdtnst "Bedingung Misfire Detection Zeit nach Startende" UWORD B_TRUE 1 100 0 1 BIT_MASK 0x10 FORMAT "%13.11" ECU_ADDRESS 0xFDBA /end MEASUREMENT
/begin MEASUREMENT B_mdzyl1_m "Monitor, Zylinder-1-Kennung" UBYTE B_TRUE 1 100 0 1 BIT_MASK 0x10 FORMAT "%13.11" ECU_ADDRESS 0xE43C /end MEASUREMENT
/begin MEASUREMENT B_meaoper "ml-/nmot-/rl-Bedingung: Freigabe Meßfenster in Block MEASURE" UBYTE B_TRUE 1 100 0 1 BIT_MASK 0x80 FORMAT "%13.11" ECU_ADDRESS 0x3808A0 /end MEASUREMENT
/begin MEASUREMENT B_mesausw "Bedingung Messung msl kann für Diagnose Sekundärluft ausgewertet werden" UBYTE B_TRUE 1 100 0 1 BIT_MASK 0x40 FORMAT "%13.11" ECU_ADDRESS 0x3808A1 /end MEASUREMENT
/begin MEASUREMENT B_mess "Bedingung mindestens eine verwertbare Messung durchgeführt" UBYTE B_TRUE 1 100 0 1 BIT_MASK 0x20 FORMAT "%13.11" ECU_ADDRESS 0x3808A1 /end MEASUREMENT
/begin MEASUREMENT B_mil "MIL-Ansteuerung" UWORD B_TRUE 1 100 0 1 BIT_MASK 0x8000 FORMAT "%13.11" ECU_ADDRESS 0xFD26 /end MEASUREMENT
/begin MEASUREMENT B_milabg "Mil leuchtet Abgasrelevant" UBYTE B_TRUE 1 100 0 1 BIT_MASK 0x2 FORMAT "%13.11" ECU_ADDRESS 0x383304 /end MEASUREMENT
/begin MEASUREMENT B_milact "MIL-Ansteuerung aktiv" UBYTE B_TRUE 1 100 0 1 BIT_MASK 0x80 FORMAT "%13.11" ECU_ADDRESS 0x384821 /end MEASUREMENT
/begin MEASUREMENT B_milblk "MIL-Ansteuerung blinkend" UBYTE B_TRUE 1 100 0 1 BIT_MASK 0x8 FORMAT "%13.11" ECU_ADDRESS 0x384821 /end MEASUREMENT
/begin MEASUREMENT B_mileb "MIL-Ansteuerung eigenbestimmt" UBYTE B_TRUE 1 100 0 1 BIT_MASK 0x2 FORMAT "%13.11" ECU_ADDRESS 0x384821 /end MEASUREMENT
/begin MEASUREMENT B_milkat "Mil blinkt wegen Kat schädigende Aussetzer" UBYTE B_TRUE 1 100 0 1 BIT_MASK 0x1 FORMAT "%13.11" ECU_ADDRESS 0x383304 /end MEASUREMENT
/begin MEASUREMENT B_milmd "MIL-Ansteuerung an durch Aussetzererkennung, bei ti-Abschaltung" UWORD B_TRUE 1 100 0 1 BIT_MASK 0x40 FORMAT "%13.11" ECU_ADDRESS 0xFD26 /end MEASUREMENT
/begin MEASUREMENT B_milst "MIL-Ansteuerung Prueffunktion bei Start" UBYTE B_TRUE 1 100 0 1 BIT_MASK 0x1 FORMAT "%13.11" ECU_ADDRESS 0x384821 /end MEASUREMENT
/begin MEASUREMENT B_milstat "MIL - Status für Scan Tool Mode $01 PID $01" UBYTE B_TRUE 1 100 0 1 BIT_MASK 0x40 FORMAT "%13.11" ECU_ADDRESS 0x384821 /end MEASUREMENT
/begin MEASUREMENT B_milstp "Auswertung Aussetzererkennung (%DMDMIL) gesperrt" UWORD B_TRUE 1 100 0 1 BIT_MASK 0x20 FORMAT "%13.11" ECU_ADDRESS 0xFD24 /end MEASUREMENT
/begin MEASUREMENT B_mnslspr "Fehlerart lokal: Sekundärluftmasse zu gering" UBYTE B_TRUE 1 100 0 1 BIT_MASK 0x8 FORMAT "%13.11" ECU_ADDRESS 0x3808A0 /end MEASUREMENT
/begin MEASUREMENT B_mslmin "Bedingung sehr geringe Sekundärluftmasse aus Meßphase" UBYTE B_TRUE 1 100 0 1 BIT_MASK 0x2 FORMAT "%13.11" ECU_ADDRESS 0x38089B /end MEASUREMENT
/begin MEASUREMENT B_mslmn "Bedingung zu wenig Sekundärluftmasse" UBYTE B_TRUE 1 100 0 1 BIT_MASK 0x10 FORMAT "%13.11" ECU_ADDRESS 0x380899 /end MEASUREMENT
/begin MEASUREMENT B_mslpmn "Fehlerbedingung: keine Sekundärluftpumpe, nur Pulse Air" UBYTE B_TRUE 1 100 0 1 BIT_MASK 0x2 FORMAT "%13.11" ECU_ADDRESS 0x38089A /end MEASUREMENT
/begin MEASUREMENT B_mxslvpr "Fehlerart lokal: Sekundärluftmasse bei Ventildichtheitsprüfung zu groß" UBYTE B_TRUE 1 100 0 1 BIT_MASK 0x40 FORMAT "%13.11" ECU_ADDRESS 0x3808A0 /end MEASUREMENT
/begin MEASUREMENT B_nlphdly "Bed. Verzögerung für Stimulibit bei Notlauf Phasengeber (für Trommeleintrag)" UWORD B_TRUE 1 100 0 1 BIT_MASK 0x40 FORMAT "%13.11" ECU_ADDRESS 0xFD06 /end MEASUREMENT
/begin MEASUREMENT B_nomil "MIL-Ansteuerung verriegelt" UBYTE B_TRUE 1 100 0 1 BIT_MASK 0x10 FORMAT "%13.11" ECU_ADDRESS 0x384821 /end MEASUREMENT
/begin MEASUREMENT B_nophnldg "Bedingung kein Phasengebersignal für Notlauf Drehzahlgeber verwendbar" UWORD B_TRUE 1 100 0 1 BIT_MASK 0x4 FORMAT "%13.11" ECU_ADDRESS 0xFD2A /end MEASUREMENT
/begin MEASUREMENT B_nowuc "Bedingung 'kein warm up cycle' erkannt" UWORD B_TRUE 1 100 0 1 BIT_MASK 0x4000 FORMAT "%13.11" ECU_ADDRESS 0xFD26 /end MEASUREMENT
/begin MEASUREMENT B_ntal "Bedingung : Zustand Tank-Leer verlassen" UWORD B_TRUE 1 100 0 1 BIT_MASK 0x2 FORMAT "%13.11" ECU_ADDRESS 0xFD28 /end MEASUREMENT
/begin MEASUREMENT B_nwkv "Bedingung NW korrekt verbaut" UBYTE B_TRUE 1 100 0 1 BIT_MASK 0x1 FORMAT "%13.11" ECU_ADDRESS 0x383316 /end MEASUREMENT
/begin MEASUREMENT B_nwmnoke "Min-Fehlerprüfung  mindestens einmal ohne Fehler Einlassnockenwelle" UBYTE B_TRUE 1 100 0 1 BIT_MASK 0x4 FORMAT "%13.11" ECU_ADDRESS 0x38492C /end MEASUREMENT
/begin MEASUREMENT B_nwmxoke "Max-Fehlerprüfung  mindestens einmal ohne Fehler Einlassnockenwelle" UBYTE B_TRUE 1 100 0 1 BIT_MASK 0x2 FORMAT "%13.11" ECU_ADDRESS 0x38492C /end MEASUREMENT
/begin MEASUREMENT B_phexor "Zwei unterste Bits von phpw sind ungleich" UBYTE B_TRUE 1 100 0 1 BIT_MASK 0x1 FORMAT "%13.11" ECU_ADDRESS 0x38091E /end MEASUREMENT
/begin MEASUREMENT B_phregok "Kein Fehlmuster im Phasenregister 1" UBYTE B_TRUE 1 100 0 1 BIT_MASK 0x2 FORMAT "%13.11" ECU_ADDRESS 0x38091E /end MEASUREMENT
/begin MEASUREMENT B_phsok "Bedingung Phasensignal ok" UWORD B_TRUE 1 100 0 1 BIT_MASK 0x8 FORMAT "%13.11" ECU_ADDRESS 0xFD2A /end MEASUREMENT
/begin MEASUREMENT B_rkatnt "Bedingung : Fehler E_rkat bereits vor Tank-Leer" UWORD B_TRUE 1 100 0 1 BIT_MASK 0x4 FORMAT "%13.11" ECU_ADDRESS 0x383C3C /end MEASUREMENT
/begin MEASUREMENT B_rkattl "Bedingung Fehler DKVS wegen leerem Tank" UWORD B_TRUE 1 100 0 1 BIT_MASK 0x4 FORMAT "%13.11" ECU_ADDRESS 0x383C3E /end MEASUREMENT
/begin MEASUREMENT B_rkaznt "Bedingung : Fehler E_rkaz bereits vor Tank-Leer vorhanden" UWORD B_TRUE 1 100 0 1 BIT_MASK 0x100 FORMAT "%13.11" ECU_ADDRESS 0x383C3C /end MEASUREMENT
/begin MEASUREMENT B_rkaztl "Bedingung Fehler DKVS (additiv) wegen leerem Tank" UWORD B_TRUE 1 100 0 1 BIT_MASK 0x100 FORMAT "%13.11" ECU_ADDRESS 0x383C3E /end MEASUREMENT
/begin MEASUREMENT B_rmsl "Bedingung Berechnung der relativen Sekundärluftmasse," UBYTE B_TRUE 1 100 0 1 BIT_MASK 0x80 FORMAT "%13.11" ECU_ADDRESS 0x3808A1 /end MEASUREMENT
/begin MEASUREMENT B_rmsval "Bedingung relativer Massenstrom TEV fültig" UBYTE B_TRUE 1 100 0 1 BIT_MASK 0x1 FORMAT "%13.11" ECU_ADDRESS 0x38344C /end MEASUREMENT
/begin MEASUREMENT B_second "" UWORD B_TRUE 1 100 0 1 BIT_MASK 0x4000 FORMAT "%13.11" ECU_ADDRESS 0x38195E /end MEASUREMENT
/begin MEASUREMENT B_sla "Anforderung Sekundärluftadaptionsphase" UBYTE B_TRUE 1 100 0 1 BIT_MASK 0x8 FORMAT "%13.11" ECU_ADDRESS 0x38089A /end MEASUREMENT
/begin MEASUREMENT B_slar "Anforderung Sekundärluftadaptionsphase zurücksetzen" UBYTE B_TRUE 1 100 0 1 BIT_MASK 0x20 FORMAT "%13.11" ECU_ADDRESS 0x38089F /end MEASUREMENT
/begin MEASUREMENT B_slarq "Gespeicherte Anforderung Sekundärluftadaptionsphase" UBYTE B_TRUE 1 100 0 1 BIT_MASK 0x40 FORMAT "%13.11" ECU_ADDRESS 0x38089C /end MEASUREMENT
/begin MEASUREMENT B_slas "Anforderung Sekundärluftadaptionsphase setzen" UBYTE B_TRUE 1 100 0 1 BIT_MASK 0x10 FORMAT "%13.11" ECU_ADDRESS 0x38089F /end MEASUREMENT
/begin MEASUREMENT B_slsofw "Lokale Bit: B_slsoff um TDPHSLOF verzögert" UBYTE B_TRUE 1 100 0 1 BIT_MASK 0x40 FORMAT "%13.11" ECU_ADDRESS 0x38089E /end MEASUREMENT
/begin MEASUREMENT B_sp1 "FLC-Trigger der Aussetzererkennung" UBYTE B_TRUE 1 100 0 1 BIT_MASK 0x1 FORMAT "%13.11" ECU_ADDRESS 0x3808F0 /end MEASUREMENT
/begin MEASUREMENT B_sp1_old "" UWORD B_TRUE 1 100 0 1 BIT_MASK 0x8000 FORMAT "%13.11" ECU_ADDRESS 0x38195E /end MEASUREMENT
/begin MEASUREMENT B_sp2 "HLC-Trigger der Aussetzererkennung" UBYTE B_TRUE 1 100 0 1 BIT_MASK 0x1 FORMAT "%13.11" ECU_ADDRESS 0x3808F1 /end MEASUREMENT
/begin MEASUREMENT B_swe "Bedingung Schlechtwegstrecke erkannt" UWORD B_TRUE 1 100 0 1 BIT_MASK 0x40 FORMAT "%13.11" ECU_ADDRESS 0xFD24 /end MEASUREMENT
/begin MEASUREMENT B_switchpg "Bedingung für Umschaltung des Phasengebers auf PG2 für Notlauf Drehzahlgeber" UWORD B_TRUE 1 100 0 1 BIT_MASK 0x10 FORMAT "%13.11" ECU_ADDRESS 0xFD2A /end MEASUREMENT
/begin MEASUREMENT B_szsls "Bedingung Diagnose Sekundärluftsystem durchgeführt, Summe" UBYTE B_TRUE 1 100 0 1 BIT_MASK 0x10 FORMAT "%13.11" ECU_ADDRESS 0x38089C /end MEASUREMENT
/begin MEASUREMENT B_tal01 "Übergang in den Zustand <Tank leer>" UWORD B_TRUE 1 100 0 1 BIT_MASK 0x1000 FORMAT "%13.11" ECU_ADDRESS 0x38195E /end MEASUREMENT
/begin MEASUREMENT B_tal_old "" UWORD B_TRUE 1 100 0 1 BIT_MASK 0x800 FORMAT "%13.11" ECU_ADDRESS 0x38195E /end MEASUREMENT
/begin MEASUREMENT B_temp1 "" UBYTE B_TRUE 1 100 0 1 BIT_MASK 0x4 FORMAT "%13.11" ECU_ADDRESS 0x380A11 /end MEASUREMENT
/begin MEASUREMENT B_temp2 "" UBYTE B_TRUE 1 100 0 1 BIT_MASK 0x8 FORMAT "%13.11" ECU_ADDRESS 0x380A11 /end MEASUREMENT
/begin MEASUREMENT B_teviol "Bedingung TEV aus der Reaktion der Leerlaufregelung als i.O. erkannt" UWORD B_TRUE 1 100 0 1 BIT_MASK 0x200 FORMAT "%13.11" ECU_ADDRESS 0xFDA0 /end MEASUREMENT
/begin MEASUREMENT B_teviolm "Bedingung i.O-Aussage TEV über Leerlaufluftprüfung möglich" UWORD B_TRUE 1 100 0 1 BIT_MASK 0x400 FORMAT "%13.11" ECU_ADDRESS 0xFDA0 /end MEASUREMENT
/begin MEASUREMENT B_teviop "Bedingung TEV in passiver Prüfung als i.O. erkannt." UWORD B_TRUE 1 100 0 1 BIT_MASK 0x800 FORMAT "%13.11" ECU_ADDRESS 0xFDA0 /end MEASUREMENT
/begin MEASUREMENT B_tevior "Bedingung TEV aus fr-Abweichung als i.O. erkannt." UWORD B_TRUE 1 100 0 1 BIT_MASK 0x1000 FORMAT "%13.11" ECU_ADDRESS 0xFDA0 /end MEASUREMENT
/begin MEASUREMENT B_tevnio "Bedingung TEV in aktiver Prüfung als defekt erkannt" UWORD B_TRUE 1 100 0 1 BIT_MASK 0x2000 FORMAT "%13.11" ECU_ADDRESS 0xFDA0 /end MEASUREMENT
/begin MEASUREMENT B_tevniom "Bedingung i.O-Aussage TEV über Leerlaufprüfung nicht möglich" UWORD B_TRUE 1 100 0 1 BIT_MASK 0x4000 FORMAT "%13.11" ECU_ADDRESS 0xFDA0 /end MEASUREMENT
/begin MEASUREMENT B_tiab0 "ti-Abschaltung bei kat.schädigenden Aussetzerraten, Zyl/Zündung 0" UBYTE B_TRUE 1 100 0 1 BIT_MASK 0x1 FORMAT "%13.11" ECU_ADDRESS 0x3808F7 /end MEASUREMENT
/begin MEASUREMENT B_tiab1 "ti-Abschaltung bei kat.schädigenden Aussetzerraten, Zyl/Zündung 1" UBYTE B_TRUE 1 100 0 1 BIT_MASK 0x2 FORMAT "%13.11" ECU_ADDRESS 0x3808F7 /end MEASUREMENT
/begin MEASUREMENT B_tiab2 "ti-Abschaltung bei kat.schädigenden Aussetzerraten, Zyl/Zündung 2" UBYTE B_TRUE 1 100 0 1 BIT_MASK 0x4 FORMAT "%13.11" ECU_ADDRESS 0x3808F7 /end MEASUREMENT
/begin MEASUREMENT B_tiab3 "ti-Abschaltung bei kat.schädigenden Aussetzerraten, Zyl/Zündung 3" UBYTE B_TRUE 1 100 0 1 BIT_MASK 0x8 FORMAT "%13.11" ECU_ADDRESS 0x3808F7 /end MEASUREMENT
/begin MEASUREMENT B_tnalu_m "Monitor, Testphase nach erkanntem Aussetzer" UBYTE B_TRUE 1 100 0 1 BIT_MASK 0x8 FORMAT "%13.11" ECU_ADDRESS 0xE3DB /end MEASUREMENT
/begin MEASUREMENT B_trfasla "Trigger (stegende Flanke) von B_FASLA" UBYTE B_TRUE 1 100 0 1 BIT_MASK 0x4 FORMAT "%13.11" ECU_ADDRESS 0x3808A2 /end MEASUREMENT
/begin MEASUREMENT B_tsroov "Bedingung Segmentzeit-Wordoverflow" UWORD B_TRUE 1 100 0 1 BIT_MASK 0x80 FORMAT "%13.11" ECU_ADDRESS 0xFD06 /end MEASUREMENT
/begin MEASUREMENT B_twdthm "Bedingung Wartezeit für Erwärmung vor Thermostatdiagnose abgelaufen" UWORD B_TRUE 1 100 0 1 BIT_MASK 0x200 FORMAT "%13.11" ECU_ADDRESS 0xFD6A /end MEASUREMENT
/begin MEASUREMENT B_vereph "Verdacht auf Fehler im Phasensignal von PG1" UBYTE B_TRUE 1 100 0 1 BIT_MASK 0x1 FORMAT "%13.11" ECU_ADDRESS 0x383317 /end MEASUREMENT
/begin MEASUREMENT B_wuc "Bedingung 'warm up cycle' erkannt" UBYTE B_TRUE 1 100 0 1 BIT_MASK 0x1 FORMAT "%13.11" ECU_ADDRESS 0x3808FC /end MEASUREMENT
/begin MEASUREMENT B_zslsp "lokales Zyklusflag: Sekundärluft-System" UBYTE B_TRUE 1 100 0 1 BIT_MASK 0x20 FORMAT "%13.11" ECU_ADDRESS 0x3808A0 /end MEASUREMENT
/begin MEASUREMENT B_zslvp "lokales Zyklusflag: Sekundärluftventil" UBYTE B_TRUE 1 100 0 1 BIT_MASK 0x4 FORMAT "%13.11" ECU_ADDRESS 0x38089B /end MEASUREMENT
/begin MEASUREMENT B_ztev "Bedingung Endstufendiagnose TEV zu" UWORD B_TRUE 1 100 0 1 BIT_MASK 0x10 FORMAT "%13.11" ECU_ADDRESS 0xFD4E /end MEASUREMENT
/begin MEASUREMENT B_zthmr "Bedingung Thermostat-Prüfung  gültig" UBYTE B_TRUE 1 100 0 1 BIT_MASK 0x2 FORMAT "%13.11" ECU_ADDRESS 0x380A11 /end MEASUREMENT
/begin MEASUREMENT detazwte "Korrekturfaktor des Zündwinkelwirkungsgrads für DTEV" UBYTE rel_ub_b127p5 1 100 0 127.5 FORMAT "%5.1" ECU_ADDRESS 0x384901 /end MEASUREMENT
/begin MEASUREMENT dfrmoff_w "frm-Offset: zur Kontrolle von Problemen der Vorsteuerung" SWORD fak_sw_b1 1 100 -1 0.999969 FORMAT "%8.6" ECU_ADDRESS 0x3849EA /end MEASUREMENT
/begin MEASUREMENT dmdafmb "Anzahl Fahrzeiten mit blinkender MIL" UBYTE dez 1 100 0 255 FORMAT "%5.1" ECU_ADDRESS 0x384003 /end MEASUREMENT
/begin MEASUREMENT dmdlfmb "längste Fahrzeit mit blinkender MIL" UBYTE t1sxs_ub_b255 1 100 0 255 FORMAT "%5.1" ECU_ADDRESS 0x384004 /end MEASUREMENT
/begin MEASUREMENT dmdmilst "Aussetzer mit MIL Status" UBYTE dez 1 100 0 255 FORMAT "%5.1" ECU_ADDRESS 0x383304 /end MEASUREMENT
/begin MEASUREMENT dmdsfmb_w "Summe der Fahrzeiten mit blinkender MIL" UWORD t1sxs_uw_b65535 1 100 0 65535 FORMAT "%8.2" ECU_ADDRESS 0x38402E /end MEASUREMENT
/begin MEASUREMENT dmletanf_w "gefilterter Wert für Abweichung Leerlaufenergiebedarf während DTEV" SWORD m_q0p0031 1 100 -102.4 102.397 FORMAT "%8.4" ECU_ADDRESS 0x385332 /end MEASUREMENT
/begin MEASUREMENT dmletanu "Abweichung Produkt Luftmasse * Zündwinkelwirkungsgrad bei Prüfung DTEV unsigned" UBYTE m_q0p1 1 100 0 25.5 FORMAT "%5.2" ECU_ADDRESS 0x384902 /end MEASUREMENT
/begin MEASUREMENT dmletan_w "Abweichung Produkt Luftmasse * Zündwinkelwirkungsgrad bei Prüfung DTEV 16 Bits" SWORD m_q0p0031 1 100 -102.4 102.397 FORMAT "%8.4" ECU_ADDRESS 0x385334 /end MEASUREMENT
/begin MEASUREMENT dmsldrl_w "Delta relative Luftfüllung (Word)" UWORD rel_uw_q0p0234 1 100 0 1535.98 FORMAT "%8.3" ECU_ADDRESS 0x3849EC /end MEASUREMENT
/begin MEASUREMENT dmsnte_w "normierte Massenstromänderung über TEV" SWORD m_q0p1 1 100 -3276.8 3276.7 FORMAT "%8.3" ECU_ADDRESS 0x385336 /end MEASUREMENT
/begin MEASUREMENT dnwkwNvBits "" UBYTE dez 1 100 0 255 FORMAT "%5.1" ECU_ADDRESS 0x383316 /end MEASUREMENT
/begin MEASUREMENT dnwszfausbits0 "" UBYTE dez 1 100 0 255 FORMAT "%5.1" ECU_ADDRESS 0x38491D /end MEASUREMENT
/begin MEASUREMENT dphBits "" UBYTE dez 1 100 0 255 FORMAT "%5.1" ECU_ADDRESS 0x38091E /end MEASUREMENT
/begin MEASUREMENT DSLSLRSausbits "" UBYTE dez 1 100 0 255 FORMAT "%5.1" ECU_ADDRESS 0x380899 /end MEASUREMENT
/begin MEASUREMENT DSLSLRSausbits2 "" UBYTE dez 1 100 0 255 FORMAT "%5.1" ECU_ADDRESS 0x38089A /end MEASUREMENT
/begin MEASUREMENT DSLSLRSlokBits1 "" UBYTE dez 1 100 0 255 FORMAT "%5.1" ECU_ADDRESS 0x38089B /end MEASUREMENT
/begin MEASUREMENT DSLSLRSlokBits1a "" UBYTE dez 1 100 0 255 FORMAT "%5.1" ECU_ADDRESS 0x38089C /end MEASUREMENT
/begin MEASUREMENT DSLSLRSlokBits2 "" UBYTE dez 1 100 0 255 FORMAT "%5.1" ECU_ADDRESS 0x38089D /end MEASUREMENT
/begin MEASUREMENT DSLSLRSlokBits2a "" UBYTE dez 1 100 0 255 FORMAT "%5.1" ECU_ADDRESS 0x38089E /end MEASUREMENT
/begin MEASUREMENT DSLSLRSlokBits3 "" UBYTE dez 1 100 0 255 FORMAT "%5.1" ECU_ADDRESS 0x38089F /end MEASUREMENT
/begin MEASUREMENT DSLSLRSlokBits3a "" UBYTE dez 1 100 0 255 FORMAT "%5.1" ECU_ADDRESS 0x3808A0 /end MEASUREMENT
/begin MEASUREMENT DSLSLRSlokBits5 "" UBYTE dez 1 100 0 255 FORMAT "%5.1" ECU_ADDRESS 0x3808A1 /end MEASUREMENT
/begin MEASUREMENT DSLSLRSlokBits5a "" UBYTE dez 1 100 0 255 FORMAT "%5.1" ECU_ADDRESS 0x3808A2 /end MEASUREMENT
/begin MEASUREMENT DTEVNonVolbits "" UBYTE dez 1 100 0 255 FORMAT "%5.1" ECU_ADDRESS 0x38344C /end MEASUREMENT
/begin MEASUREMENT DTHMlokBits "" UBYTE dez 1 100 0 255 FORMAT "%5.1" ECU_ADDRESS 0x380A11 /end MEASUREMENT
/begin MEASUREMENT duf_c "Zeitzähler fürs Setzen der Zyklusflags der Funktionsüberwachungs-Diagnose" UBYTE t100msxs_ub_b25p5 1 100 0 25.5 FORMAT "%5.2" ECU_ADDRESS 0x380B1C /end MEASUREMENT
/begin MEASUREMENT dwnwsp_w "Abweichung des Adaptionswinkels vom fahrzeugspez. Sollwinkel der Nockenwelle" SWORD kw_q0p0156 1 100 -512 511.984 FORMAT "%8.4" ECU_ADDRESS 0x384A0E /end MEASUREMENT
/begin MEASUREMENT dzuhlzl "Entprellzähler Heilung" UBYTE dez 1 100 0 255 FORMAT "%5.1" ARRAY_SIZE 8 ECU_ADDRESS 0x380999 /end MEASUREMENT
/begin MEASUREMENT dzuksmszl "Entprellzähler Kurzschluß nach Masse" UBYTE dez 1 100 0 255 FORMAT "%5.1" ARRAY_SIZE 8 ECU_ADDRESS 0x3809A1 /end MEASUREMENT
/begin MEASUREMENT dzuksubzl "Entprellzähler Kurzschluß nach Ubatt" UBYTE dez 1 100 0 255 FORMAT "%5.1" ARRAY_SIZE 8 ECU_ADDRESS 0x3809A9 /end MEASUREMENT
/begin MEASUREMENT dzusigzl "Entprellzähler Leitungsabfall" UBYTE dez 1 100 0 255 FORMAT "%5.1" ARRAY_SIZE 8 ECU_ADDRESS 0x3809B1 /end MEASUREMENT
/begin MEASUREMENT egaspfad "EGAS-Pfad als Umweltbedingung für Funktionsüberwachungs-Diagnoseeintrag" UBYTE dez 1 100 0 255 FORMAT "%5.1" ECU_ADDRESS 0x380B1D /end MEASUREMENT
/begin MEASUREMENT esnswlbits "" UBYTE default 1 100 0 255 FORMAT "%5.1" ECU_ADDRESS 0x3809D8 /end MEASUREMENT
/begin MEASUREMENT etazwif "Ist-Zündwinkelwirkungsgrad: für DTEV gefilterter Wert" UBYTE rel_ub_b127p5 1 100 0 127.5 FORMAT "%5.1" ECU_ADDRESS 0x384903 /end MEASUREMENT
/begin MEASUREMENT etazwkte "korrigierter Zündwinkelwirkungsgrad für DTEV" UBYTE rel_ub_b127p5 1 100 0 127.5 FORMAT "%5.1" ECU_ADDRESS 0x384904 /end MEASUREMENT
/begin MEASUREMENT evsup0 "" UBYTE dez 1 100 0 255 FORMAT "%5.1" ECU_ADDRESS 0x380896 /end MEASUREMENT
/begin MEASUREMENT E_ase_fsp "" UWORD B_TRUE 1 100 0 1 BIT_MASK 0x2 FORMAT "%13.11" ECU_ADDRESS 0x381960 /end MEASUREMENT
/begin MEASUREMENT E_ase_old "" UWORD B_TRUE 1 100 0 1 BIT_MASK 0x2 FORMAT "%13.11" ECU_ADDRESS 0x38195E /end MEASUREMENT
/begin MEASUREMENT E_ask_fsp "" UWORD B_TRUE 1 100 0 1 BIT_MASK 0x1 FORMAT "%13.11" ECU_ADDRESS 0x381960 /end MEASUREMENT
/begin MEASUREMENT E_ask_old "" UWORD B_TRUE 1 100 0 1 BIT_MASK 0x1 FORMAT "%13.11" ECU_ADDRESS 0x38195E /end MEASUREMENT
/begin MEASUREMENT E_frao_fsp "" UWORD B_TRUE 1 100 0 1 BIT_MASK 0x40 FORMAT "%13.11" ECU_ADDRESS 0x381960 /end MEASUREMENT
/begin MEASUREMENT E_frao_old "" UWORD B_TRUE 1 100 0 1 BIT_MASK 0x40 FORMAT "%13.11" ECU_ADDRESS 0x38195E /end MEASUREMENT
/begin MEASUREMENT E_frau_fsp "" UWORD B_TRUE 1 100 0 1 BIT_MASK 0x10 FORMAT "%13.11" ECU_ADDRESS 0x381960 /end MEASUREMENT
/begin MEASUREMENT E_frau_old "" UWORD B_TRUE 1 100 0 1 BIT_MASK 0x10 FORMAT "%13.11" ECU_ADDRESS 0x38195E /end MEASUREMENT
/begin MEASUREMENT E_rkat_fsp "" UWORD B_TRUE 1 100 0 1 BIT_MASK 0x4 FORMAT "%13.11" ECU_ADDRESS 0x381960 /end MEASUREMENT
/begin MEASUREMENT E_rkat_old "" UWORD B_TRUE 1 100 0 1 BIT_MASK 0x4 FORMAT "%13.11" ECU_ADDRESS 0x38195E /end MEASUREMENT
/begin MEASUREMENT E_rkaz_fsp "" UWORD B_TRUE 1 100 0 1 BIT_MASK 0x100 FORMAT "%13.11" ECU_ADDRESS 0x381960 /end MEASUREMENT
/begin MEASUREMENT E_rkaz_old "" UWORD B_TRUE 1 100 0 1 BIT_MASK 0x100 FORMAT "%13.11" ECU_ADDRESS 0x38195E /end MEASUREMENT
/begin MEASUREMENT E_tankl_old "" UWORD B_TRUE 1 100 0 1 BIT_MASK 0x400 FORMAT "%13.11" ECU_ADDRESS 0x38195E /end MEASUREMENT
/begin MEASUREMENT famal "Faktor zur Absenkung des LUR-Wertes bei Mehrfachaussetzern, aus KFFAMALU" UBYTE fak_ub_b1 1 100 0 0.996094 ECU_ADDRESS 0xE3F7 /end MEASUREMENT
/begin MEASUREMENT fflutn "Filterfaktor über n für Filterung der Laufunruhe" UBYTE fak_ub_b1 1 100 0 0.996094 ECU_ADDRESS 0xE40E /end MEASUREMENT
/begin MEASUREMENT ffzdfp "Fehlerpfadidentifikationsnummer (dfp) zum Freeze-Frame Zero" UBYTE dez 1 100 0 255 FORMAT "%5.1" ECU_ADDRESS 0x3808FB /end MEASUREMENT
/begin MEASUREMENT fgru "Faktor Grundvorsteuerung" UBYTE fak_ub_b2 1 100 0 1.99219 FORMAT "%5.3" ECU_ADDRESS 0x38487F /end MEASUREMENT
/begin MEASUREMENT fivzabg "Intervallzähler abgasrelevante Aussetzer" UBYTE dez 1 100 0 255 FORMAT "%5.1" ECU_ADDRESS 0x3808F6 /end MEASUREMENT
/begin MEASUREMENT fktns_w "Nachstartanhebung" UWORD fak_uw_b16 1 100 0 15.9998 FORMAT "%8.5" ECU_ADDRESS 0x382078 /end MEASUREMENT
/begin MEASUREMENT flgkat_w "Statusflag kat.schädigende Aussetzerraten oder ti-Abschaltung" UWORD dez 1 100 0 65535 FORMAT "%8.2" ECU_ADDRESS 0x381816 /end MEASUREMENT
/begin MEASUREMENT flgtiab "Statusflag ti-Abschaltung bei kat.schädigenden Aussetzerraten" UBYTE dez 1 100 0 255 FORMAT "%5.1" ECU_ADDRESS 0x3808F7 /end MEASUREMENT
/begin MEASUREMENT flurkh "Faktor zur Absenkung des LUR-Wertes bei Katheizen, aus KL LURKH" UBYTE fak_ub_b2 1 100 0 1.99219 FORMAT "%5.3" ECU_ADDRESS 0x3808E6 /end MEASUREMENT
/begin MEASUREMENT fluts "Filter der Laufunruhe-Testgröße" SWORD luquant_w 1 100 -86.567 86.5644 FORMAT "%8.5" ECU_ADDRESS 0xE470 /end MEASUREMENT
/begin MEASUREMENT fluts1 "Filter der Laufunruhe-Testgröße von Zylinder 1 bzw. Zündung 1, signed" SWORD luquant_w 1 100 -86.567 86.5644 FORMAT "%8.5" ECU_ADDRESS 0xE472 /end MEASUREMENT
/begin MEASUREMENT fluts2 "Filter der Laufunruhe-Testgröße von Zylinder 2 bzw. Zündung 2, signed" SWORD luquant_w 1 100 -86.567 86.5644 FORMAT "%8.5" ECU_ADDRESS 0xE474 /end MEASUREMENT
/begin MEASUREMENT fluts3 "Filter der Laufunruhe-Testgröße von Zylinder 3 bzw. Zündung 3, signed" SWORD luquant_w 1 100 -86.567 86.5644 FORMAT "%8.5" ECU_ADDRESS 0xE476 /end MEASUREMENT
/begin MEASUREMENT fluts4 "Filter der Laufunruhe-Testgröße von Zylinder 4 bzw. Zündung 4, signed" SWORD luquant_w 1 100 -86.567 86.5644 FORMAT "%8.5" ECU_ADDRESS 0xE478 /end MEASUREMENT
/begin MEASUREMENT fluts5 "Filter der Laufunruhe-Testgröße von Zylinder 5 bzw. Zündung 5, signed" SWORD luquant_w 1 100 -86.567 86.5644 FORMAT "%8.5" ECU_ADDRESS 0xE47A /end MEASUREMENT
/begin MEASUREMENT fluts6 "Filter der Laufunruhe-Testgröße von Zylinder 6 bzw. Zündung 6, signed" SWORD luquant_w 1 100 -86.567 86.5644 FORMAT "%8.5" ECU_ADDRESS 0xE47C /end MEASUREMENT
/begin MEASUREMENT fluts7 "Filter der Laufunruhe-Testgröße von Zylinder 7 bzw. Zündung 7, signed" SWORD luquant_w 1 100 -86.567 86.5644 FORMAT "%8.5" ECU_ADDRESS 0xE47E /end MEASUREMENT
/begin MEASUREMENT fluts8 "Filter der Laufunruhe-Testgröße von Zylinder 8 bzw. Zündung 8, signed" SWORD luquant_w 1 100 -86.567 86.5644 FORMAT "%8.5" ECU_ADDRESS 0xE480 /end MEASUREMENT
/begin MEASUREMENT fluts_m "Monitor, gefilterte Laufunruhetestgröße, signed, verzögerte Ausgabe" SWORD luquant_w 1 100 -86.567 86.5644 FORMAT "%8.5" ECU_ADDRESS 0xE444 /end MEASUREMENT
/begin MEASUREMENT fmsla "Korrekturfaktor Sekundärluftmasse adaptiv" UBYTE fak_ub_b2 1 100 0 1.99219 FORMAT "%5.3" ECU_ADDRESS 0x384815 /end MEASUREMENT
/begin MEASUREMENT fmslav "Adaptionsfaktor Sekundärluftmasse" UBYTE fak_ub_b2 1 100 0 1.99219 FORMAT "%5.3" ECU_ADDRESS 0x38324F /end MEASUREMENT
/begin MEASUREMENT fnswlst_w "Faktor Nachstart und Warmlauf für Max-Auswahl im Start" UWORD fak_uw_b16 1 100 0 15.9998 FORMAT "%8.5" ECU_ADDRESS 0x38207A /end MEASUREMENT
/begin MEASUREMENT fnswl_w "Faktor Nachstart und Warmlauf" UWORD fak_uw_b16 1 100 0 15.9998 FORMAT "%8.5" ECU_ADDRESS 0x38207C /end MEASUREMENT
/begin MEASUREMENT fns_w "Faktor Nachstart" UWORD fak_uw_b16 1 100 0 15.9998 FORMAT "%8.5" ECU_ADDRESS 0x38207E /end MEASUREMENT
/begin MEASUREMENT frdter_w "Faktor Regelung Referenz für TE-Diagnose" UWORD fak_uw_b2 1 100 0 1.99997 FORMAT "%8.6" ECU_ADDRESS 0x385338 /end MEASUREMENT
/begin MEASUREMENT frmfdif_w "Diffrenzwert zwischen Probewert und Momentanwert" SWORD fak_sw_b1 1 100 -1 0.999969 FORMAT "%8.6" ECU_ADDRESS 0x38533A /end MEASUREMENT
/begin MEASUREMENT frmfref_w "gefilterter Referenzwert fr für DTEV Ausfsteuerprüfung" UWORD fak_uw_b2 1 100 0 1.99997 FORMAT "%8.6" ECU_ADDRESS 0x38533C /end MEASUREMENT
/begin MEASUREMENT frmfrz_w "Eingefrorener frm_w bei Zusatzdiagnose für SLS (Bank1)" UWORD fak_uw_b2 1 100 0 1.99997 FORMAT "%8.6" ECU_ADDRESS 0x3849EE /end MEASUREMENT
/begin MEASUREMENT frmitf_w "gefilterter Mittelwert fr für DTEV" UWORD fak_uw_b2 1 100 0 1.99997 FORMAT "%8.6" ECU_ADDRESS 0x38533E /end MEASUREMENT
/begin MEASUREMENT frmxaf_w "fr-Max-Ausschlag: Bei Stereo LR der fr, der am weitesten von 1.0 weg (gefiltert)" UWORD fak_uw_b2 1 100 0 1.99997 FORMAT "%8.6" ECU_ADDRESS 0x385340 /end MEASUREMENT
/begin MEASUREMENT fsalunkh "Faktor Korrektur Nullastausblendung bei Katheizen" UBYTE fak_ub_b2 1 100 0 1.99219 FORMAT "%5.3" ECU_ADDRESS 0x3808E5 /end MEASUREMENT
/begin MEASUREMENT fthozs_w "Faktor Korrektur Höhe und Temperatur" UWORD fak_uw_b2 1 100 0 1.99997 FORMAT "%8.6" ECU_ADDRESS 0x385342 /end MEASUREMENT
/begin MEASUREMENT fwl "Faktor Warmlauf" UBYTE fak_ub_b2 1 100 0 1.99219 FORMAT "%5.3" ECU_ADDRESS 0x3809D9 /end MEASUREMENT
/begin MEASUREMENT fwlrl "Faktor Warmlauf lastabhängiger Anteil" UBYTE fak_ub_b2 1 100 0 1.99219 FORMAT "%5.3" ECU_ADDRESS 0x3809DA /end MEASUREMENT
/begin MEASUREMENT fzabgs_w "Fehlerzähler Summe, zählt abgasrelevante Aussetzer über alle Zylinder" UWORD dez 1 100 0 65535 FORMAT "%8.2" ECU_ADDRESS 0x381818 /end MEASUREMENT
/begin MEASUREMENT fzabg_w "Aussetzerzähler" UWORD dez 1 100 0 65535 FORMAT "%8.2" ARRAY_SIZE 4 ECU_ADDRESS 0x38181A /end MEASUREMENT
/begin MEASUREMENT fzans1_w "Konstante für Abregelung des Nachstarts" UWORD fak_uw_b1 1 100 0 0.999985 FORMAT "%9.7" ECU_ADDRESS 0x382080 /end MEASUREMENT
/begin MEASUREMENT fzarv_w "Fehlerzähler, zählt Aussetzer über alle Zylinder" UWORD dez 1 100 0 65535 FORMAT "%8.2" ECU_ADDRESS 0x381822 /end MEASUREMENT
/begin MEASUREMENT fzkats1_w "Fehlerzähler Summe Bank 1, zählt katschädigende Aussetzer über alle Zyl. Bank 1" UWORD dez 1 100 0 65535 FORMAT "%8.2" ECU_ADDRESS 0x381824 /end MEASUREMENT
/begin MEASUREMENT fzkats2_w "Fehlerzähler Summe Bank 2, zählt katschädigende Aussetzer über alle Zyl. Bank 2" UWORD dez 1 100 0 65535 FORMAT "%8.2" ECU_ADDRESS 0x381826 /end MEASUREMENT
/begin MEASUREMENT fzkats_w "Fehlerzähler Summe, zählt katschädigende Aussetzer über alle Zylinder" UWORD dez 1 100 0 65535 FORMAT "%8.2" ECU_ADDRESS 0x381828 /end MEASUREMENT
/begin MEASUREMENT fzkat_w "Fehlerzähler Zdg.  x, zählt kat.schädigende (gewichtete) Aussetzer an Zündung" UWORD dez 1 100 0 65535 FORMAT "%8.2" ARRAY_SIZE 4 ECU_ADDRESS 0x38182A /end MEASUREMENT
/begin MEASUREMENT fzmd "Fehlerzähler Zündung [i] bei Dauerlauf" UWORD dez 1 100 0 65535 FORMAT "%8.2" ARRAY_SIZE 4 ECU_ADDRESS 0x383854 /end MEASUREMENT
/begin MEASUREMENT imltw_w "Integrierter mittl. Luftmassendurchsatz bezogen auf Wartezeit Thermostatdiagn." UWORD m_q0p00014 1 100 0 9.16986 FORMAT "%8.6" ECU_ADDRESS 0x384BAE /end MEASUREMENT
/begin MEASUREMENT ivzabg_w "Intervallzähler für abgasrelevante Aussetzer (0-1000 KW-Umdr. bzw. 0-500 NW-Um.)" UWORD dez 1 100 0 65535 FORMAT "%8.2" ECU_ADDRESS 0x381832 /end MEASUREMENT
/begin MEASUREMENT ivzaint_w "Intervallzähler für Freigabe ti-Abschaltung (0-200 Kw-Umdr.)" UWORD dez 1 100 0 65535 FORMAT "%8.2" ECU_ADDRESS 0x381834 /end MEASUREMENT
/begin MEASUREMENT ivzarv_w "Intervallzähler für Aussetzer (0-60 KW-Umdr.), zur Ausblendung weiterer Funktion" UWORD dez 1 100 0 65535 FORMAT "%8.2" ECU_ADDRESS 0x381836 /end MEASUREMENT
/begin MEASUREMENT ivzkat_w "Intervallzähler für katschädigende Aussetzer (0-200 Kw-Umdr. bzw. 0-100 NW-Um.)" UWORD dez 1 100 0 65535 FORMAT "%8.2" ECU_ADDRESS 0x381838 /end MEASUREMENT
/begin MEASUREMENT kltalu_w "" UWORD t10msxs_uw_b655p35 1 100 0 655.35 FORMAT "%8.4" ECU_ADDRESS 0x380F90 /end MEASUREMENT
/begin MEASUREMENT kswf "Kat.-Schutz-Wichtungsfaktoren, aus KFKSWFS(S)" UBYTE dez 1 100 0 255 FORMAT "%5.1" ECU_ADDRESS 0x3808F8 /end MEASUREMENT
/begin MEASUREMENT lokBits_enwsea "" UBYTE dez 1 100 0 255 FORMAT "%5.1" ECU_ADDRESS 0x38492D /end MEASUREMENT
/begin MEASUREMENT luar "Laufunruhe-Abstandsmass-Referenzwert" SBYTE luquant 1 100 -86.567 85.8907 FORMAT "%5.2" ECU_ADDRESS 0xE40F /end MEASUREMENT
/begin MEASUREMENT luarmn "Laufunruhe-Abstandsmass-Referenzwert Minimun" SBYTE luquant 1 100 -86.567 85.8907 FORMAT "%5.2" ECU_ADDRESS 0xE410 /end MEASUREMENT
/begin MEASUREMENT luaroff "Laufunruhe-Abstandsmass-Referenzwert offset" UBYTE luquant 1 100 0 172.458 FORMAT "%5.1" ECU_ADDRESS 0xE411 /end MEASUREMENT
/begin MEASUREMENT luar_m "Monitor, Laufunruhe-Abstandsmaß-Referenzwert, verzögerte Ausgabe" SBYTE luquant 1 100 -86.567 85.8907 FORMAT "%5.2" ECU_ADDRESS 0xE3DA /end MEASUREMENT
/begin MEASUREMENT lums "Laufunruhe-Mittelwert für Erkennung Mehrfachaussetzer, signed" SBYTE luquant 1 100 -86.567 85.8907 FORMAT "%5.2" ECU_ADDRESS 0xE449 /end MEASUREMENT
/begin MEASUREMENT lums_m "Monitor, Laufunruhe-Mittelwert für Erkennung Mehrfachaussetzer, signed" SBYTE luquant 1 100 -86.567 85.8907 FORMAT "%5.2" ECU_ADDRESS 0xE441 /end MEASUREMENT
/begin MEASUREMENT lurms "Laufunruhe-Referenzwert für Mehrfachaussetzererkennung, -> Vgl. mit Lum, signed" SBYTE luquant 1 100 -86.567 85.8907 FORMAT "%5.2" ECU_ADDRESS 0xE415 /end MEASUREMENT
/begin MEASUREMENT lurms_m "Monitor, Laufunruhe-Referenzwert für Mehrfachaussetzererkenng, signed" SBYTE luquant 1 100 -86.567 85.8907 FORMAT "%5.2" ECU_ADDRESS 0xE440 /end MEASUREMENT
/begin MEASUREMENT lurs "Laufunruhe-Referenzwert, signed" SBYTE luquant 1 100 -86.567 85.8907 FORMAT "%5.2" ECU_ADDRESS 0xE3E6 /end MEASUREMENT
/begin MEASUREMENT lursktm "tmot-abhängiger offset zum Laufunruhe-Referenzwert dlurs, signed" SBYTE luquant 1 100 -86.567 85.8907 FORMAT "%5.2" ECU_ADDRESS 0xE420 /end MEASUREMENT
/begin MEASUREMENT lurste "" UBYTE fak_ub_b2 1 100 0 1.99219 FORMAT "%5.3" ECU_ADDRESS 0xF89C /end MEASUREMENT
/begin MEASUREMENT lurs_m "Monitor Laufunruhe-Referenzwert, signed" SBYTE luquant 1 100 -86.567 85.8907 FORMAT "%5.2" ECU_ADDRESS 0xE43E /end MEASUREMENT
/begin MEASUREMENT lurs_min "Wert von LUR falls Adaption nicht abgeschlossen, Wert aus LURMIN*" UBYTE luquant 1 100 0 172.458 FORMAT "%5.1" ECU_ADDRESS 0xE3E7 /end MEASUREMENT
/begin MEASUREMENT luts "Laufunruhe-Testgröße, signed" SBYTE luquant 1 100 -86.567 85.8907 FORMAT "%5.2" ECU_ADDRESS 0xE3E0 /end MEASUREMENT
/begin MEASUREMENT luts1 "Laufunruhe-Testgröße von Zylinder 1 bzw. Zündung 1, signed" SBYTE luquant 1 100 -86.567 85.8907 FORMAT "%5.2" ECU_ADDRESS 0xE3EF /end MEASUREMENT
/begin MEASUREMENT luts2 "Laufunruhe-Testgröße von Zylinder 2 bzw. Zündung 2, signed" SBYTE luquant 1 100 -86.567 85.8907 FORMAT "%5.2" ECU_ADDRESS 0xE3F0 /end MEASUREMENT
/begin MEASUREMENT luts3 "Laufunruhe-Testgröße von Zylinder 3 bzw. Zündung 3, signed" SBYTE luquant 1 100 -86.567 85.8907 FORMAT "%5.2" ECU_ADDRESS 0xE3F1 /end MEASUREMENT
/begin MEASUREMENT luts4 "Laufunruhe-Testgröße von Zylinder 4 bzw. Zündung 4, signed" SBYTE luquant 1 100 -86.567 85.8907 FORMAT "%5.2" ECU_ADDRESS 0xE3F2 /end MEASUREMENT
/begin MEASUREMENT luts5 "Laufunruhe-Testgröße von Zylinder 5 bzw. Zündung 5, signed" SBYTE luquant 1 100 -86.567 85.8907 FORMAT "%5.2" ECU_ADDRESS 0xE3F3 /end MEASUREMENT
/begin MEASUREMENT luts6 "Laufunruhe-Testgröße von Zylinder 6 bzw. Zündung 6, signed" SBYTE luquant 1 100 -86.567 85.8907 FORMAT "%5.2" ECU_ADDRESS 0xE3F4 /end MEASUREMENT
/begin MEASUREMENT luts7 "Laufunruhe-Testgröße von Zylinder 7 bzw. Zündung 7, signed" SBYTE luquant 1 100 -86.567 85.8907 FORMAT "%5.2" ECU_ADDRESS 0xE3F5 /end MEASUREMENT
/begin MEASUREMENT luts8 "Laufunruhe-Testgröße von Zylinder 8 bzw. Zündung 8, signed" SBYTE luquant 1 100 -86.567 85.8907 FORMAT "%5.2" ECU_ADDRESS 0xE3F6 /end MEASUREMENT
/begin MEASUREMENT luts_m "Monitor Laufunruhe-Testgröße, signed" SBYTE luquant 1 100 -86.567 85.8907 FORMAT "%5.2" ECU_ADDRESS 0xE43D /end MEASUREMENT
/begin MEASUREMENT m6amsl "Mode 6 - Speicher: Anzahl Werteblöcke bei Prüfung Sekundärluftmasse" UBYTE dez 1 100 0 255 FORMAT "%5.1" ECU_ADDRESS 0x383250 /end MEASUREMENT
/begin MEASUREMENT m6cmsl "Mode 6 - Speicher: Component ID für Prüfung Sekundärluftsystem" UBYTE dez 1 100 0 255 FORMAT "%5.1" ECU_ADDRESS 0x383251 /end MEASUREMENT
/begin MEASUREMENT m6cmslv "Mode 6 - Speicher: Component ID für Prüfung Dichtheit Sekundärluftsystem" UBYTE dez 1 100 0 255 FORMAT "%5.1" ECU_ADDRESS 0x383252 /end MEASUREMENT
/begin MEASUREMENT m6cthm "Mode 6 - Speicher: Component ID für Thermostat-Monitoring" UBYTE dez 1 100 0 255 FORMAT "%5.1" ECU_ADDRESS 0x384022 /end MEASUREMENT
/begin MEASUREMENT m6smslv_w "Mode 6 - Speicher: Schwellwert bei Ventildichtheitsprüfung" UWORD dez 1 100 0 65535 FORMAT "%8.2" ECU_ADDRESS 0x383454 /end MEASUREMENT
/begin MEASUREMENT m6smsl_w "Mode 6 - Speicher: Schwellwert bei Prüfung Sekundärluftmasse" UWORD dez 1 100 0 65535 FORMAT "%8.2" ECU_ADDRESS 0x383456 /end MEASUREMENT
/begin MEASUREMENT m6sthm_w "Mode 6 - Speicher: Schwellwert für Thermostat-Monitoring" UWORD dez 1 100 0 65535 FORMAT "%8.2" ECU_ADDRESS 0x384062 /end MEASUREMENT
/begin MEASUREMENT m6wmslv_w "Mode 6 - Speicher: Messwert Ventildichtheit" UWORD dez 1 100 0 65535 FORMAT "%8.2" ECU_ADDRESS 0x383458 /end MEASUREMENT
/begin MEASUREMENT m6wmsl_w "Mode 6 - Speicher: Messwert Sekundärluftmasse bei SL-Einblasung" UWORD dez 1 100 0 65535 FORMAT "%8.2" ECU_ADDRESS 0x38345A /end MEASUREMENT
/begin MEASUREMENT m6wthm_w "Mode 6 - Speicher: Meßwert für Thermostat-Monitoring" UWORD dez 1 100 0 65535 FORMAT "%8.2" ECU_ADDRESS 0x384064 /end MEASUREMENT
/begin MEASUREMENT milstat "bit container, Status des DMIL-Moduls" UBYTE dez 1 100 0 255 FORMAT "%5.1" ECU_ADDRESS 0x384821 /end MEASUREMENT
/begin MEASUREMENT milstatNOV "" UBYTE dez 1 100 0 255 FORMAT "%5.1" ECU_ADDRESS 0x384005 /end MEASUREMENT
/begin MEASUREMENT mi_duf "Istmoment beim Ansprechen des Momentenvergleichs in der Funktionsüberwachung" UBYTE rel_ub_b99p6 1 100 0 99.6094 FORMAT "%5.2" ECU_ADDRESS 0x380B1E /end MEASUREMENT
/begin MEASUREMENT mletanzs_w "Zwischenspeicher: Auf den Zündwinkelwirkungsgrad 100% normierter Luftmassenstrom" UWORD m_q0p004 1 100 0 262.14 FORMAT "%8.4" ECU_ADDRESS 0x385344 /end MEASUREMENT
/begin MEASUREMENT mletan_w "Auf den Zündwinkelwirkungsgrad 100% normierter Luftmassenstrom" UWORD m_q0p004 1 100 0 262.14 FORMAT "%8.4" ECU_ADDRESS 0x385346 /end MEASUREMENT
/begin MEASUREMENT mpfad "Momenten-Pfad in Funktion und Funktionsüberwachung als Umweltbedingung für Diag." UBYTE dez 1 100 0 255 FORMAT "%5.1" ECU_ADDRESS 0x380B1F /end MEASUREMENT
/begin MEASUREMENT msdkoo_w "Massenstrom Drosselklappe ohne offset" UWORD m_q0p1 1 100 0 6553.5 FORMAT "%8.3" ECU_ADDRESS 0x385348 /end MEASUREMENT
/begin MEASUREMENT mslift "Istwert Sekundärluftmasse, gefiltert, temporär" UBYTE m_q0p4 1 100 0 102 FORMAT "%5.1" ECU_ADDRESS 0x384816 /end MEASUREMENT
/begin MEASUREMENT mslnenn "Nennwert Sekundärluftmasse" UBYTE m_q0p4 1 100 0 102 FORMAT "%5.1" ECU_ADDRESS 0x383253 /end MEASUREMENT
/begin MEASUREMENT mslnf "Nenn-Sekundärluftmasse, gefiltert" UBYTE m_q0p4 1 100 0 102 FORMAT "%5.1" ECU_ADDRESS 0x384817 /end MEASUREMENT
/begin MEASUREMENT mslnt "Nenn-Sekundärluftmasse, temporär" UBYTE m_q0p4 1 100 0 102 FORMAT "%5.1" ECU_ADDRESS 0x384818 /end MEASUREMENT
/begin MEASUREMENT mslt_w "temporäre Sekundärluftmasse" UWORD m_uw_b6553p5 1 100 0 6553.5 FORMAT "%8.3" ECU_ADDRESS 0x3849F0 /end MEASUREMENT
/begin MEASUREMENT mslvft_w "Sekundärluftventilundichtheit, gefiltert, temporär (word)" SWORD m_q0p0015625 1 100 -51.2 51.1984 FORMAT "%8.5" ECU_ADDRESS 0x3849F2 /end MEASUREMENT
/begin MEASUREMENT mslvt_w "temporäre Ventilleckage" SWORD m_sw_q0p1 1 100 -3276.8 3276.7 FORMAT "%8.3" ECU_ADDRESS 0x3849F4 /end MEASUREMENT
/begin MEASUREMENT mslv_w "Sekundärluftmasse für Ventildichtheitsprüfung (word)" UWORD m_q0p0015625 1 100 0 102.398 FORMAT "%8.4" ECU_ADDRESS 0x3849F6 /end MEASUREMENT
/begin MEASUREMENT mstedtef_w "Massenstrom Tankentlüftungsventil (gefiltert) für DTEV" UWORD m_q0p0031 1 100 0 204.797 FORMAT "%8.4" ECU_ADDRESS 0x38534A /end MEASUREMENT
/begin MEASUREMENT nmaxfc_w "Zähler, Anzahl Überschreitungen der kritischen Drehzahl" UWORD dez 1 100 0 65535 FORMAT "%8.2" ECU_ADDRESS 0x38403A /end MEASUREMENT
/begin MEASUREMENT nmotdtf_w "Gefilterter Wert  nmot_w" UWORD nmot_uw_q0p25 1 100 0 16383.8 FORMAT "%8.2" ECU_ADDRESS 0x38534C /end MEASUREMENT
/begin MEASUREMENT nsactr "Nachstartcounter" UBYTE fak_ub_b2 1 100 0 1.99219 FORMAT "%5.3" ECU_ADDRESS 0x3809DB /end MEASUREMENT
/begin MEASUREMENT nswrl "Ausgang KF KFNSWRL Wichtung Nachstartanhebung" UBYTE fak_ub_b2 1 100 0 1.99219 FORMAT "%5.3" ECU_ADDRESS 0x3809DC /end MEASUREMENT
/begin MEASUREMENT nwfctrmne "Fehlerzähler zur Entprellung Min-Fehler bei Einlaßnockenwellensteller" UBYTE dez 1 100 0 255 FORMAT "%5.1" ECU_ADDRESS 0x384027 /end MEASUREMENT
/begin MEASUREMENT nwfctrmxe "Fehlerzähler zur Entprellung Max-Fehler bei Einlaßnockenwellensteller" UBYTE dez 1 100 0 255 FORMAT "%5.1" ECU_ADDRESS 0x384028 /end MEASUREMENT
/begin MEASUREMENT phpw "Phasensignal Pegelwechsel (8 Bit Schieberegister)" UBYTE dez 1 100 0 255 FORMAT "%5.1" ECU_ADDRESS 0x38091F /end MEASUREMENT
/begin MEASUREMENT rltedte_w "Aus DTEV ermittelte relative Füllung über das Tankentlüftungsventil" UWORD rel_uw_q0p0234 1 100 0 1535.98 FORMAT "%8.3" ECU_ADDRESS 0x38534E /end MEASUREMENT
/begin MEASUREMENT rl_m "Monitor, relative Luftfüllung" UBYTE rel_ub_q0p75 1 100 0 191.25 FORMAT "%5.1" ECU_ADDRESS 0xE43F /end MEASUREMENT
/begin MEASUREMENT rmsl "relative Sekundärluftmasse" UBYTE fak_ub_b2 1 100 0 1.99219 FORMAT "%5.3" ECU_ADDRESS 0x384819 /end MEASUREMENT
/begin MEASUREMENT rmslf "relative Sekundärluftmasse gefiltert" UBYTE fak_ub_b2 1 100 0 1.99219 FORMAT "%5.3" ECU_ADDRESS 0x384002 /end MEASUREMENT
/begin MEASUREMENT rmslt "relative Sekundärluftmasse ohne Offset- Korrektur" UBYTE fak_ub_b2 1 100 0 1.99219 FORMAT "%5.3" ECU_ADDRESS 0x38481A /end MEASUREMENT
/begin MEASUREMENT rmstevf_w "aktueller Meßwert für relative TEV-Güte" SWORD rel_sw_b200 1 100 -200 199.994 FORMAT "%8.4" ECU_ADDRESS 0x385350 /end MEASUREMENT
/begin MEASUREMENT rmstevuf_w "aktueller, unsigned Meßwert für relative TEV-Güte" UWORD rel_uw_b200 1 100 0 199.997 FORMAT "%8.4" ECU_ADDRESS 0x385352 /end MEASUREMENT
/begin MEASUREMENT rmstev_w "Langzeitgespeicherter Meßwert der relativen TEV-Güte" UWORD rel_uw_b200 1 100 0 199.997 FORMAT "%8.4" ECU_ADDRESS 0x38408C /end MEASUREMENT
/begin MEASUREMENT rstMon_um "" UWORD dez 1 100 0 65535 FORMAT "%8.2" ECU_ADDRESS 0x380884 /end MEASUREMENT
/begin MEASUREMENT rstpfad "Reset-Pfad als Umweltbedingung für Rechnerüberwachungs-Diagnoseeintrag" UBYTE dez 1 100 0 255 FORMAT "%5.1" ECU_ADDRESS 0x380B21 /end MEASUREMENT
/begin MEASUREMENT skapfad "SKA-Pfad als Umweltbedingung für Funktionsüberwachungs-Diagnoseeintrag" UBYTE dez 1 100 0 255 FORMAT "%5.1" ECU_ADDRESS 0x380B20 /end MEASUREMENT
/begin MEASUREMENT slp_an "" UBYTE dez 1 100 0 255 FORMAT "%5.1" ECU_ADDRESS 0x380897 /end MEASUREMENT
/begin MEASUREMENT tadtea "rel. TEV-Öffnung aus Tankentlüftungsdiagnose" UBYTE rel_ub_b99p6 1 100 0 99.6094 FORMAT "%5.2" ECU_ADDRESS 0x384905 /end MEASUREMENT
/begin MEASUREMENT tadteazs "Letzter Tastverhältniswert aus Tankentlüftungsdiagnose" UBYTE rel_ub_b99p6 1 100 0 99.6094 FORMAT "%5.2" ECU_ADDRESS 0x384906 /end MEASUREMENT
/begin MEASUREMENT tamb "Umgebungstemperatur" UBYTE temp_ub_q0p75_o48 1 100 -48 143.25 FORMAT "%5.1" ECU_ADDRESS 0x3848B2 /end MEASUREMENT
/begin MEASUREMENT tankl_E_w "" UWORD dez 1 100 0 65535 FORMAT "%8.2" ECU_ADDRESS 0x38195E /end MEASUREMENT
/begin MEASUREMENT tankl_fsp_w "" UWORD dez 1 100 0 65535 FORMAT "%8.2" ECU_ADDRESS 0x381960 /end MEASUREMENT
/begin MEASUREMENT tankl_nt_w "" UWORD dez 1 100 0 65535 FORMAT "%8.2" ECU_ADDRESS 0x383C3C /end MEASUREMENT
/begin MEASUREMENT tankl_tl_w "" UWORD dez 1 100 0 65535 FORMAT "%8.2" ECU_ADDRESS 0x383C3E /end MEASUREMENT
/begin MEASUREMENT tankl_Z_w "" UWORD dez 1 100 0 65535 FORMAT "%8.2" ECU_ADDRESS 0x381962 /end MEASUREMENT
/begin MEASUREMENT tc6tesc "Ausgabe-Code SCAN-Tool Mode 6 aus TES-Diagnose" UBYTE dez 1 100 0 255 FORMAT "%5.1" ECU_ADDRESS 0x384025 /end MEASUREMENT
/begin MEASUREMENT tc6tess "Ausgabe Schwellwert SCAN-Tool Mode 6 aus TES-Diagnose" UWORD dez 1 100 0 65535 FORMAT "%8.2" ECU_ADDRESS 0x38408E /end MEASUREMENT
/begin MEASUREMENT tc6tesw "Ausgabe Prüfwert SCAN-Tool Mode 6 aus TES-Diagnose" UWORD dez 1 100 0 65535 FORMAT "%8.2" ECU_ADDRESS 0x384090 /end MEASUREMENT
/begin MEASUREMENT tdtesta "Zeit DTEV Aufsteuerprüfung aktiv" UBYTE t100msxs_ub_b25p5 1 100 0 25.5 FORMAT "%5.2" ECU_ADDRESS 0x384907 /end MEASUREMENT
/begin MEASUREMENT tdtetevo "Zeit Tastverhälnis aus DTEV größer Schwelle" UBYTE t100msxs_ub_b25p5 1 100 0 25.5 FORMAT "%5.2" ECU_ADDRESS 0x384908 /end MEASUREMENT
/begin MEASUREMENT tmstem "Motortemperatur bei Startende in Memory" UBYTE temp_ub_q0p75_o48 1 100 -48 143.25 FORMAT "%5.1" ECU_ADDRESS 0x384820 /end MEASUREMENT
/begin MEASUREMENT tnstmd "" UBYTE t40msxs_ub_q0p04 1 100 0 10.2 FORMAT "%5.2" ECU_ADDRESS 0xF89D /end MEASUREMENT
/begin MEASUREMENT tntevzu "Zeit nach Schließen des TEVs" UBYTE t100msxs_ub_b25p5 1 100 0 25.5 FORMAT "%5.2" ECU_ADDRESS 0x384909 /end MEASUREMENT
/begin MEASUREMENT top_w "Operating time seit powerfail" UWORD t6minxmin_q6 1 100 0 393210 FORMAT "%8.1" ECU_ADDRESS 0x383C38 /end MEASUREMENT
/begin MEASUREMENT tpsvlssa "Periodendauer (Sondensignal vor Kat) für DLSSA" UBYTE dez 1 100 0 255 FORMAT "%5.1" ARRAY_SIZE 2 ECU_ADDRESS 0x384000 /end MEASUREMENT
/begin MEASUREMENT tripkm "Kilometerzähler ab Fahrtbeginn" UBYTE km_ub_q0p10 1 100 0 25.5 FORMAT "%5.2" ECU_ADDRESS 0x3848B3 /end MEASUREMENT
/begin MEASUREMENT tsroh_w "Segmentzeit unkorrigiert" UWORD tsquant 1 100 0 53738.7 FORMAT "%8.2" ECU_ADDRESS 0x380C1E /end MEASUREMENT
/begin MEASUREMENT tuspnf "gefilterte Zeit zw. pos. und neg. usvk-Flanke, DLSSA" UBYTE dez 1 100 0 255 FORMAT "%5.1" ARRAY_SIZE 2 ECU_ADDRESS 0x383249 /end MEASUREMENT
/begin MEASUREMENT tvfrrdte "Verzögerungszeit für Zurücksetzen des Lambda-Reglers nach Schließen des TEVs" UBYTE t100msxs_ub_b25p5 1 100 0 25.5 FORMAT "%5.2" ECU_ADDRESS 0x38490A /end MEASUREMENT
/begin MEASUREMENT twdthm_w "Wartezeit für Motorerwärmung vor Thermostatdiagnose" UWORD t10msxs_uw_b655p35 1 100 0 655.35 FORMAT "%8.4" ECU_ADDRESS 0x384BB0 /end MEASUREMENT
/begin MEASUREMENT tz "" UBYTE dez 1 100 0 255 FORMAT "%5.1" ECU_ADDRESS 0x38090C /end MEASUREMENT
/begin MEASUREMENT usmnsan "minimal erkannter Sondenspannungswert v.K. (neu), DLSSA" UBYTE spg_ub_b1p33 1 100 0 1.33 FORMAT "%5.3" ARRAY_SIZE 2 ECU_ADDRESS 0x38324B /end MEASUREMENT
/begin MEASUREMENT usmxsan "maximal erkannter Sondenspannungswert v.K. (neu), DLSSA" UBYTE spg_ub_b1p33 1 100 0 1.33 FORMAT "%5.3" ARRAY_SIZE 2 ECU_ADDRESS 0x38324D /end MEASUREMENT
/begin MEASUREMENT usrj "Regelschwelle der Lambdaregelung, ohne Offset, DLSSA" UBYTE spg_ub_b1p33 1 100 0 1.33 FORMAT "%5.3" ECU_ADDRESS 0x380898 /end MEASUREMENT
/begin MEASUREMENT wuccnt "Warm-up cycle - counter seit Fehlerspeicher gelöscht" UBYTE dez 1 100 0 255 FORMAT "%5.1" ECU_ADDRESS 0x383312 /end MEASUREMENT
/begin MEASUREMENT zphnok "Zähler Fehler auf Phasensignal" UBYTE dez 1 100 0 255 FORMAT "%5.1" ECU_ADDRESS 0x380920 /end MEASUREMENT
/begin MEASUREMENT zzuend "Zähler Zündung, zählt alle Zündungen aller Zylinder" UWORD dez 1 100 0 65535 FORMAT "%8.2" ARRAY_SIZE 2 ECU_ADDRESS 0x383850 /end MEASUREMENT
/begin MEASUREMENT zzyldmd "SW-Zylinderzähler für DMD" UBYTE dez 1 100 0 255 FORMAT "%5.1" ECU_ADDRESS 0x38088D /end MEASUREMENT
/begin MEASUREMENT Z_ase_old "" UWORD B_TRUE 1 100 0 1 BIT_MASK 0x2 FORMAT "%13.11" ECU_ADDRESS 0x381962 /end MEASUREMENT
/begin MEASUREMENT Z_ask_old "" UWORD B_TRUE 1 100 0 1 BIT_MASK 0x1 FORMAT "%13.11" ECU_ADDRESS 0x381962 /end MEASUREMENT
/begin MEASUREMENT Z_frao_old "" UWORD B_TRUE 1 100 0 1 BIT_MASK 0x40 FORMAT "%13.11" ECU_ADDRESS 0x381962 /end MEASUREMENT
/begin MEASUREMENT Z_frau_old "" UWORD B_TRUE 1 100 0 1 BIT_MASK 0x10 FORMAT "%13.11" ECU_ADDRESS 0x381962 /end MEASUREMENT
/begin MEASUREMENT Z_rkat_old "" UWORD B_TRUE 1 100 0 1 BIT_MASK 0x4 FORMAT "%13.11" ECU_ADDRESS 0x381962 /end MEASUREMENT
/begin MEASUREMENT Z_rkaz_old "" UWORD B_TRUE 1 100 0 1 BIT_MASK 0x100 FORMAT "%13.11" ECU_ADDRESS 0x381962 /end MEASUREMENT
/begin FUNCTION DMDLU "4.130     Diagnose misfire detection; Laufunruhe"
 /begin DEF_CHARACTERISTIC ANALUN_0_A ANALUN_1_A ANALUST DMXRLU FIAMALU FIMALU_0_A FIMALU_1_A FLUV1 FLUV2 KFAMAL_0_A KFAMAL_1_A KFAMAL1 KFLURB_0_A KFLURB_1_A KFLURB1 KFLURB2 KFLURBZ KFLURM_0_A KFLURM_1_A KFLURM1 LURKTM LURMIN1_0_A LURMIN1_1_A LURMIN2_0_A LURMIN2_1_A LURMIN3 LURMINKH NFLUV P_ZYL TNALU /end DEF_CHARACTERISTIC
 /begin REF_CHARACTERISTIC SNM08DMUB SRL08DMUB STM08DMUB /end REF_CHARACTERISTIC
 /begin IN_MEASUREMENT B_cdmd B_kh B_ll cd_bits1_w dmrkh esst_snm08dmub esst_srl08dmub esst_stm08dmub nmot rl tmot vfzg /end IN_MEASUREMENT
 /begin OUT_MEASUREMENT B_analu_m B_luerk_m B_lustop_m B_mdstim_m B_mdzyl1_m B_tnalu_m flurkh lums_m lurms_m lurs_m lurs_min luts_m rl_m /end OUT_MEASUREMENT
 /begin LOC_MEASUREMENT famal lums lurms lurs lursktm luts luts1 luts2 luts3 luts4 luts5 luts6 luts7 luts8 /end LOC_MEASUREMENT
 /begin SUB_FUNCTION /end SUB_FUNCTION
/end FUNCTION
/begin FUNCTION DMDLUA "4.40      Diagnose Misfire Detection Laufunruhe Abstandsmass" /begin DEF_CHARACTERISTIC DMXRFL FLUTN KFLUAR_0_A KFLUAR_1_A KFLUAR1 KFLUAR2 KFLUARZ /end DEF_CHARACTERISTIC /begin REF_CHARACTERISTIC SNM08DMUB SRL08DMUB /end REF_CHARACTERISTIC /begin IN_MEASUREMENT esst_snm08dmub esst_srl08dmub nmot rl /end IN_MEASUREMENT
 /begin OUT_MEASUREMENT B_luaerk_m fflutn fluts fluts1 fluts2 fluts3 fluts4 fluts5 fluts6 fluts7 fluts8 fluts_m luar luarmn luaroff luar_m /end OUT_MEASUREMENT
 /begin LOC_MEASUREMENT /end LOC_MEASUREMENT
 /begin SUB_FUNCTION /end SUB_FUNCTION
/end FUNCTION
/begin FUNCTION DMDLU_C "" /begin DEF_CHARACTERISTIC LURBRL8_0_A LURBRL8_1_A LURKH_0_A LURKH_1_A LURST /end DEF_CHARACTERISTIC /begin REF_CHARACTERISTIC /end REF_CHARACTERISTIC /begin IN_MEASUREMENT dmrkh rl /end IN_MEASUREMENT /begin OUT_MEASUREMENT lurste tnstmd /end OUT_MEASUREMENT /begin LOC_MEASUREMENT /end LOC_MEASUREMENT /begin SUB_FUNCTION /end SUB_FUNCTION /end FUNCTION
/begin FUNCTION DMDMIL "3.90      Fehlerbehandlung der Aussetzererkennung, Ansteuerung der MIL und Heilung"
 /begin DEF_CHARACTERISTIC AFNTOL AHEAGW AHEAGWS AHEARV AHEKA AHEKS1B1 AHEKS1B2 AHEKSB1 AHEKSB2 AINTKAN AZYTIAB CWDALA CWDMDE FAINTEN FASKIV1 KFKSWF MILANTI TMASKIV1 /end DEF_CHARACTERISTIC
 /begin REF_CHARACTERISTIC SNM08DMUB TMWUC /end REF_CHARACTERISTIC
 /begin IN_MEASUREMENT bbdcy B_cdmd B_milstp B_pwf B_synph esst_snm08dmub esst_stm06llub nmot nstat rl tmot /end IN_MEASUREMENT
 /begin OUT_MEASUREMENT afnmn afnmx afrlmn afrlmx aftnmn aftnmx aftrlmn aftrlmx ahearv_w aint azycnt bbdmdmil bbsp1 bbsp2 bfnmn bfnmx bfrlmn bfrlmx B_afklt B_aftklt B_aftwrm B_afwrm B_bfklt B_bfwrm B_blkmd B_mdarv B_mdarvb1 B_mdarvb2 B_mdkat B_mdkatb1 B_mdkatb2 B_milmd B_sp1 B_sp2 B_tiab0 B_tiab1 B_tiab2 B_tiab3 flgtiab fzabgs_w fzabg_w fzarv_w fzkats1_w fzkats2_w fzkats_w fzkat_w ivzabg_w ivzaint_w ivzarv_w ivzkat_w kswf /end OUT_MEASUREMENT
 /begin LOC_MEASUREMENT aintkamin anzainten fivzabg flgkat_w fzmd zzuend /end LOC_MEASUREMENT
 /begin SUB_FUNCTION /end SUB_FUNCTION
/end FUNCTION
/begin FUNCTION DMDMON "2.10      Diagnose misfire detection Monitor Funktion" /begin DEF_CHARACTERISTIC /end DEF_CHARACTERISTIC /begin REF_CHARACTERISTIC /end REF_CHARACTERISTIC /begin IN_MEASUREMENT B_blkmd /end IN_MEASUREMENT /begin OUT_MEASUREMENT B_milabg B_milkat dmdafmb dmdlfmb dmdmilst dmdsfmb_w /end OUT_MEASUREMENT /begin LOC_MEASUREMENT /end LOC_MEASUREMENT /begin SUB_FUNCTION /end SUB_FUNCTION /end FUNCTION
/begin FUNCTION DMDSTP "9.100     Diagnose Misfire Detection; Stopbedingungen"
 /begin DEF_CHARACTERISTIC AVRALU AZSTLU AZSTPON CWSTDMD CWSTPCNF CW_SWE_0__A CW_SWE_1__A DASE_CMD DRLSOLA_0_A DRLSOLA_1_A DRLSOLST_0_A DRLSOLST_1_A KLRLSALULL KLTALUST NGALU_0_A NGALU_1_A NGALUST_0_A NGALUST_1_A NMIALU NMXALU NSTDMD_0_A NSTDMD_1_A RLSALUNG_0_A RLSALUNG_1_A TAMIALU VFZGADMD /end DEF_CHARACTERISTIC
 /begin REF_CHARACTERISTIC SGA08MDUB SNM08DMUB SRL08DMUB /end REF_CHARACTERISTIC
 /begin IN_MEASUREMENT B_asc_reg B_autget B_br2k B_cdmd B_dkpu B_edkvs B_eev B_enws B_evasel B_evloc B_fbm B_kuppl B_ll B_mdarv B_mdein B_nldg B_nws B_phsnl B_stimnlph B_swe_b B_swe_p B_synph B_tehb esst_sga08mdub esst_snm08dmub esst_srl08dmub gangi nmot nmot_w rl tmst vfzg /end IN_MEASUREMENT
 /begin OUT_MEASUREMENT B_fofstp B_fofstpt B_fonstp B_fonstpt B_luena B_lustop B_lustopt B_lustopu B_mddrla B_mdng B_mdnmot B_mdrl B_mdstopt B_mdstop_m B_mdtnst B_milstp B_swe /end OUT_MEASUREMENT
 /begin LOC_MEASUREMENT fsalunkh kltalu_w /end LOC_MEASUREMENT
 /begin SUB_FUNCTION /end SUB_FUNCTION
/end FUNCTION
/begin FUNCTION DMDSTP_C "" /begin DEF_CHARACTERISTIC SALUNKH_0_A SALUNKH_1_A /end DEF_CHARACTERISTIC /begin REF_CHARACTERISTIC /end REF_CHARACTERISTIC /begin IN_MEASUREMENT dmrkh /end IN_MEASUREMENT /begin OUT_MEASUREMENT /end OUT_MEASUREMENT /begin LOC_MEASUREMENT /end LOC_MEASUREMENT /begin SUB_FUNCTION /end SUB_FUNCTION /end FUNCTION
/begin FUNCTION DMDSYK "" /begin DEF_CHARACTERISTIC /end DEF_CHARACTERISTIC /begin REF_CHARACTERISTIC /end REF_CHARACTERISTIC /begin IN_MEASUREMENT /end IN_MEASUREMENT /begin OUT_MEASUREMENT /end OUT_MEASUREMENT /begin LOC_MEASUREMENT /end LOC_MEASUREMENT /begin SUB_FUNCTION /end SUB_FUNCTION /end FUNCTION
/begin FUNCTION DMDTSB "6.20      Diagnosis Misfire Detection Segmentzeitbildung" /begin DEF_CHARACTERISTIC KAMFZ ZYLKOR /end DEF_CHARACTERISTIC /begin REF_CHARACTERISTIC /end REF_CHARACTERISTIC /begin IN_MEASUREMENT B_trev_inc trevovCtr zzyl /end IN_MEASUREMENT /begin OUT_MEASUREMENT B_nlphdly B_tsroov tsroh_w zzyldmd /end OUT_MEASUREMENT /begin LOC_MEASUREMENT /end LOC_MEASUREMENT /begin SUB_FUNCTION /end SUB_FUNCTION /end FUNCTION
/begin FUNCTION DMDUE "9.190     Diagnose Misfire Detection Overview (Übersicht)" /begin DEF_CHARACTERISTIC /end DEF_CHARACTERISTIC /begin REF_CHARACTERISTIC /end REF_CHARACTERISTIC /begin IN_MEASUREMENT B_milstp nmot zzyldmd /end IN_MEASUREMENT /begin OUT_MEASUREMENT /end OUT_MEASUREMENT /begin LOC_MEASUREMENT /end LOC_MEASUREMENT /begin SUB_FUNCTION /end SUB_FUNCTION /end FUNCTION
/begin FUNCTION DMFB "11.30     OBDII; MIL fremdbestimmt" /begin DEF_CHARACTERISTIC TDMFB /end DEF_CHARACTERISTIC /begin REF_CHARACTERISTIC /end REF_CHARACTERISTIC /begin IN_MEASUREMENT B_milfb B_stend /end IN_MEASUREMENT /begin OUT_MEASUREMENT /end OUT_MEASUREMENT /begin LOC_MEASUREMENT /end LOC_MEASUREMENT /begin SUB_FUNCTION /end SUB_FUNCTION /end FUNCTION
/begin FUNCTION DMIL "26.50     OBDII; MIL-Ansteuerung" /begin DEF_CHARACTERISTIC CWNOMIL TLAED /end DEF_CHARACTERISTIC /begin REF_CHARACTERISTIC /end REF_CHARACTERISTIC /begin IN_MEASUREMENT B_blkfb B_blkmd B_kl15 B_milfb B_milmd B_nmot dfpmMilState /end IN_MEASUREMENT
 /begin OUT_MEASUREMENT B_kmmil B_mil B_milact B_milblk B_milstat milstat milstatNOV /end OUT_MEASUREMENT
 /begin LOC_MEASUREMENT B_blkeb B_mileb B_milst B_nomil /end LOC_MEASUREMENT
 /begin SUB_FUNCTION /end SUB_FUNCTION
/end FUNCTION
/begin FUNCTION DMILE "8.20      OBDII; MIL-Endstufe" /begin DEF_CHARACTERISTIC /end DEF_CHARACTERISTIC /begin REF_CHARACTERISTIC /end REF_CHARACTERISTIC /begin IN_MEASUREMENT B_desee B_mil /end IN_MEASUREMENT /begin OUT_MEASUREMENT /end OUT_MEASUREMENT /begin LOC_MEASUREMENT /end LOC_MEASUREMENT /begin SUB_FUNCTION /end SUB_FUNCTION /end FUNCTION
/begin FUNCTION DNMAX "4.23      Diagnose; Plausibilitätsprüfung Maximaldrehzahl Überschreitung" /begin DEF_CHARACTERISTIC CWDNMAX NMAXF TDNX /end DEF_CHARACTERISTIC /begin REF_CHARACTERISTIC /end REF_CHARACTERISTIC /begin IN_MEASUREMENT nmot_w /end IN_MEASUREMENT /begin OUT_MEASUREMENT nmaxfc_w /end OUT_MEASUREMENT /begin LOC_MEASUREMENT /end LOC_MEASUREMENT /begin SUB_FUNCTION /end SUB_FUNCTION /end FUNCTION
/begin FUNCTION DNWKW "Diagnose Zuordnung der Nockenwelle zur Kurbelwelle" /begin DEF_CHARACTERISTIC TDNWSP WNWSPMN WNWSPMX /end DEF_CHARACTERISTIC /begin REF_CHARACTERISTIC WNWRPS /end REF_CHARACTERISTIC /begin IN_MEASUREMENT B_phad B_spsa wnwsp_w /end IN_MEASUREMENT /begin OUT_MEASUREMENT B_nwkv dnwkwNvBits /end OUT_MEASUREMENT /begin LOC_MEASUREMENT dwnwsp_w /end LOC_MEASUREMENT /begin SUB_FUNCTION /end SUB_FUNCTION /end FUNCTION
/begin FUNCTION DNWSEEIN "1.30      Diagnose der Nockenwellenendstufe (einlaßseitig)" /begin DEF_CHARACTERISTIC /end DEF_CHARACTERISTIC /begin REF_CHARACTERISTIC /end REF_CHARACTERISTIC /begin IN_MEASUREMENT B_desee B_nwse /end IN_MEASUREMENT /begin OUT_MEASUREMENT /end OUT_MEASUREMENT /begin LOC_MEASUREMENT B_enwsea B_enwsena lokBits_enwsea /end LOC_MEASUREMENT /begin SUB_FUNCTION /end SUB_FUNCTION /end FUNCTION
/begin FUNCTION DNWSEIN "1.70      Diagnose Nockenwellensteuerung (Einlaßseitig)"
 /begin DEF_CHARACTERISTIC DWNWSMNE DWNWSMXE NWFDECE NWFINCE NWFMXE TDDNWSMNE TDDNWSMXE /end DEF_CHARACTERISTIC
 /begin REF_CHARACTERISTIC WNWEMAX /end REF_CHARACTERISTIC
 /begin IN_MEASUREMENT B_cdenws B_dnwse B_fa B_fanwsea B_nwse wnwise_w /end IN_MEASUREMENT
 /begin OUT_MEASUREMENT B_denws B_enwsve /end OUT_MEASUREMENT
 /begin LOC_MEASUREMENT B_nwmnoke B_nwmxoke nwfctrmne nwfctrmxe /end LOC_MEASUREMENT
 /begin SUB_FUNCTION /end SUB_FUNCTION
/end FUNCTION
/begin FUNCTION DNWSZF "1.10      Diagnose Nockenwellensteuerung Fehlerzusammenfassung" /begin DEF_CHARACTERISTIC /end DEF_CHARACTERISTIC /begin REF_CHARACTERISTIC /end REF_CHARACTERISTIC /begin IN_MEASUREMENT /end IN_MEASUREMENT /begin OUT_MEASUREMENT B_enws B_enwse dnwszfausbits0 /end OUT_MEASUREMENT /begin LOC_MEASUREMENT /end LOC_MEASUREMENT /begin SUB_FUNCTION /end SUB_FUNCTION /end FUNCTION
/begin FUNCTION DPH "22.20     Diagnose; Plausibilitätsprüfung Phasensensor" /begin DEF_CHARACTERISTIC PHNOKA /end DEF_CHARACTERISTIC /begin REF_CHARACTERISTIC /end REF_CHARACTERISTIC
 /begin IN_MEASUREMENT B_motstop B_nldg B_phad B_phase B_pwf B_st B_stend B_zztab zrph /end IN_MEASUREMENT
 /begin OUT_MEASUREMENT B_nophnldg B_phsok B_switchpg B_vereph phpw zphnok /end OUT_MEASUREMENT
 /begin LOC_MEASUREMENT B_phexor B_phregok dphBits /end LOC_MEASUREMENT
 /begin SUB_FUNCTION /end SUB_FUNCTION
/end FUNCTION
/begin FUNCTION DSELHFS "1.50      Selektion Diagnose Hauptfüllungssensor" /begin DEF_CHARACTERISTIC /end DEF_CHARACTERISTIC /begin REF_CHARACTERISTIC /end REF_CHARACTERISTIC
 /begin IN_MEASUREMENT B_heahfmlm B_hfm B_mnhfmlm B_mxhfmlm B_mxrlroh B_neglgrd B_nplhfmlm /end IN_MEASUREMENT
 /begin OUT_MEASUREMENT B_ehfs B_fedkb /end OUT_MEASUREMENT
 /begin LOC_MEASUREMENT /end LOC_MEASUREMENT
 /begin SUB_FUNCTION /end SUB_FUNCTION
/end FUNCTION
/begin FUNCTION DSGEEP "20.10     Diagnose; Plausibilitätsprüfung SG-EEPROM" /begin DEF_CHARACTERISTIC /end DEF_CHARACTERISTIC /begin REF_CHARACTERISTIC /end REF_CHARACTERISTIC /begin IN_MEASUREMENT /end IN_MEASUREMENT /begin OUT_MEASUREMENT /end OUT_MEASUREMENT /begin LOC_MEASUREMENT /end LOC_MEASUREMENT /begin SUB_FUNCTION /end SUB_FUNCTION /end FUNCTION
/begin FUNCTION DSLPE "9.20      Diagnose; Sekundärluftpumpe Endstufe" /begin DEF_CHARACTERISTIC /end DEF_CHARACTERISTIC /begin REF_CHARACTERISTIC /end REF_CHARACTERISTIC /begin IN_MEASUREMENT B_desee B_slp /end IN_MEASUREMENT /begin OUT_MEASUREMENT /end OUT_MEASUREMENT /begin LOC_MEASUREMENT /end LOC_MEASUREMENT /begin SUB_FUNCTION /end SUB_FUNCTION /end FUNCTION
/begin FUNCTION DSLSLRS "4.300     Diagnose Sekundärluftsystem mit stetiger Lambdaregelung"
 /begin DEF_CHARACTERISTIC ANZRMSL CWDSLSA CWDSLSAD CWDSLSY DFRMDSLS DFRMOFNML DFRMOFNXKT DFRMOFPML DFRMOFPXKT DFRMSLS DMSDRLTM DSLVFZMN DTMDSLA FBWRMSL FHODSL FMSLAMN FMSLAMX IMLATDSL IMLATDSLK IMLDSL KLMLDSLAMX KLMLDSLKMX KLMLDSLMX KLMLDSLOMX MLWDSLAMN MLWDSLKMN MLWDSLMN MLWDSLOMN MSLBAS MSLVMX MSLVMXK MSLVMXX MSLVMXXK RMSLMN RMSLMNK RMSLMNST RMSLMXST RMSLPMN RMSLTMN TANDSLMN TANDSLMX TC6CSL TC6CSLF TC6CSLK TC6CSLN TC6CSLV TDASTAT TDDSLSFG TDFGSLA TDFGSZSLS TDMSLMN1 TDMSLMN4 TDMSLMNK TDMSLOF3 TDMSLOF5 TDMSLOFK TDMSLV TDMSLVK TDPH2SLOF TDPHSLOF TDSLMDRL TDSLMVBA TFIMSLI TFIMSLIK TFIMSLO TFIMSLOK TFIMSLV TFIMSLVK TKATDSL TMDSLAMN TMDSLMN TMDSLMX TMSLADAP TMSLIFT TMSLIFT1 TMSLIFTK TNOMF2 TNOMF3 TNOMF5 TNSTDSL TSBVDSLTMS TWDSLTM TWHLSLP TWMLFE TWMSLMIN ZDSLAMX ZKFRMSLS /end DEF_CHARACTERISTIC
 /begin REF_CHARACTERISTIC /end REF_CHARACTERISTIC
 /begin IN_MEASUREMENT B_bag B_bkvleer B_cdsls B_edkvs B_evloc B_fa B_fasla B_hag B_kh B_kha B_ll B_lrs B_mdarv B_nmot B_pwf B_sbblsu B_slp B_sls B_slsadap B_slsfz B_slsoff B_st B_stend B_te B_vag E_lm E_slpe E_slve E_ta E_tes E_tm fho_w frmx_w frm_w imlatm_w imlpr lamsbg_w lamsoni_w mlbb_w ml_w msl rl_w tans tikatm tkatm tmot tmotab tmst tnse_w vfzg /end IN_MEASUREMENT
 /begin OUT_MEASUREMENT B_cwdslty B_dsl1 B_dsl4 B_dsla B_dslfa B_dslfrg12 B_dsls B_dslsp4 B_dspe B_esls B_fgadllfr B_mslmn B_mslpmn B_sla DSLSLRSausbits DSLSLRSausbits2 fmsla m6amsl m6cmsl m6cmslv m6smslv_w m6smsl_w m6wmslv_w m6wmsl_w /end OUT_MEASUREMENT
 /begin LOC_MEASUREMENT anzmsls_w B_anzsls B_astat B_cwdslt B_cwdsltfa B_cwsla B_dfrmoe B_dfrmoff B_dfrmoff2 B_dsl B_dsl1ab B_dsl1e B_dsl2 B_dsl2ab B_dsl2e B_dsl3 B_dsl3ab B_dsl3e B_dsl45 B_dsl4ab B_dsl4e B_dsl5 B_dsl5ab B_dsl5dly B_dsl5e B_dslerr B_dslfrg B_dslm B_dslmab B_dslme B_dslmes B_dslo B_dsloab B_dsloe B_dslp4 B_dsltab B_dslte B_dsper B_dspes B_errmsl B_errofs B_eslsp B_eslvp B_faslarq B_faslaset B_fgszsla B_fgszsls B_meaoper B_mesausw B_mess B_mnslspr B_mslmin B_mxslvpr B_rmsl B_slar B_slarq B_slas B_slsofw B_szsls B_trfasla B_zslsp B_zslvp dfrmoff_w dmsldrl_w DSLSLRSlokBits1 DSLSLRSlokBits1a DSLSLRSlokBits2 DSLSLRSlokBits2a DSLSLRSlokBits3 DSLSLRSlokBits3a DSLSLRSlokBits5 DSLSLRSlokBits5a fmslav frmfrz_w mslift mslnenn mslnf mslnt mslt_w mslvft_w mslvt_w mslv_w rmsl rmslf rmslt /end LOC_MEASUREMENT
 /begin SUB_FUNCTION /end SUB_FUNCTION
/end FUNCTION
/begin FUNCTION DSLVE "11.10     Diagnose; Plausibilitätsprüfung Sekundärluftventil-Endstufe" /begin DEF_CHARACTERISTIC /end DEF_CHARACTERISTIC /begin REF_CHARACTERISTIC /end REF_CHARACTERISTIC /begin IN_MEASUREMENT B_desee B_slv /end IN_MEASUREMENT /begin OUT_MEASUREMENT /end OUT_MEASUREMENT /begin LOC_MEASUREMENT /end LOC_MEASUREMENT /begin SUB_FUNCTION /end SUB_FUNCTION /end FUNCTION
/begin FUNCTION DSWEA "2.40      Schlechtwegerkennung durch Abfrage eines vom ABS SG generierten Status" /begin DEF_CHARACTERISTIC DTPSWE TVESWER TVESWES TVPWMFR TVPWMFS /end DEF_CHARACTERISTIC /begin REF_CHARACTERISTIC TPSSWE /end REF_CHARACTERISTIC /begin IN_MEASUREMENT B_cdswe B_sweb taswe_w tpswe /end IN_MEASUREMENT /begin OUT_MEASUREMENT /end OUT_MEASUREMENT /begin LOC_MEASUREMENT /end LOC_MEASUREMENT /begin SUB_FUNCTION /end SUB_FUNCTION /end FUNCTION
/begin FUNCTION DT2STC "1.10      Diagnose; Testerkommunikation Start Kommunikation" /begin DEF_CHARACTERISTIC /end DEF_CHARACTERISTIC /begin REF_CHARACTERISTIC /end REF_CHARACTERISTIC /begin IN_MEASUREMENT /end IN_MEASUREMENT /begin OUT_MEASUREMENT /end OUT_MEASUREMENT /begin LOC_MEASUREMENT /end LOC_MEASUREMENT /begin SUB_FUNCTION /end SUB_FUNCTION /end FUNCTION
/begin FUNCTION DTANKL "3.20      Diagnose OBDII Fehler auf Grund eines leeren Tanks" /begin DEF_CHARACTERISTIC TVTANKL /end DEF_CHARACTERISTIC /begin REF_CHARACTERISTIC /end REF_CHARACTERISTIC /begin IN_MEASUREMENT B_cdtankl B_sp1 B_tal cd_bits1_w /end IN_MEASUREMENT
 /begin OUT_MEASUREMENT B_asent B_asetl B_asknt B_asktl B_first B_fraont B_fraotl B_fraunt B_frautl B_ntal B_rkatnt B_rkattl B_rkaznt B_rkaztl B_second B_sp1_old B_tal01 B_tal_old E_ase_fsp E_ase_old E_ask_fsp E_ask_old E_frao_fsp E_frao_old E_frau_fsp E_frau_old E_rkat_fsp E_rkat_old E_rkaz_fsp E_rkaz_old E_tankl_old tankl_E_w tankl_fsp_w tankl_nt_w tankl_tl_w tankl_Z_w tz Z_ase_old Z_ask_old Z_frao_old Z_frau_old Z_rkat_old Z_rkaz_old /end OUT_MEASUREMENT
 /begin LOC_MEASUREMENT /end LOC_MEASUREMENT
 /begin SUB_FUNCTION /end SUB_FUNCTION
/end FUNCTION
/begin FUNCTION DTEV "Diagnose Tankentlüftungsventil (OBDII)"
 /begin DEF_CHARACTERISTIC APDTEFRE APDTEVX AVDTEVX CWDLDPTE CWDTEAPP CWDTEV CWUTEKU DFRMDTEE DFRMDTEF DFRMDTEM DMLDTEFN DMLDTEFX DMLDTEMN DMLDTEMX DMSNTEMN DMSNTEMX DMVTEVDO DNDTEO DNDTEU DNNSOL ETAZWTEN FHODTEA FKADPMN FRMDPMO FRMDPMU FRMDTEVO FRMDTEVU FTEADDPO FTEADDPU FTEADSZ IMSDTEVA KFDETATE KFTVFRR KIDMSNTE KIRMSMS MLDTEFPF MLDTEPF RKADTEVO RKADTEVU RMSTEVIO RMSTEVMN RMSTEVMX TADTEAMX TADTEMX TC6TECI TC6TECL TC6TECNL TC6TECP TC6TECRF TC6TECRM TC6TECT TDTEFA TDTESZO TDTESZU TDTEZAM TFRMDTEE TMDTEU TMEWDTEU TMNST TMUDTEU TPERDTE TSTM TTEVAZ TVDTEABG TVDTEB TVDTEE TVDTELLA TVDTEVP TVDTEVPM TVDTEVZ ZFNMOT ZFRMFIL ZFRMXAF ZKRMSTEV ZMLETAN ZMSTEDTE ZRLTEDTE /end DEF_CHARACTERISTIC
 /begin REF_CHARACTERISTIC CLDPTVC /end REF_CHARACTERISTIC
 /begin IN_MEASUREMENT B_cdtes B_dldpte B_dllra B_dsls B_edkvs B_enws B_fa B_fates B_fs B_gae B_gap B_grdst B_hag B_koe B_ldpi B_ll B_llr B_lr B_m8te B_mdarv B_nldg B_nmot B_nswo1 B_pwf B_sls B_tevioi B_teviot dfuelsan_w dmvad_w etazwist fho_w fkatei fklaf_w frmit_w frmn_w frmxa_w frmx_w ftead_w ftefsoll_w ftvdk imsteini ml ml_w msndkoo_w mstedte nmot_w nsol rkat_w rkaz_w tans tateout tispldpx_w tispldp_w tmew tmot tnse_w tpldptcx_w tpldptc_w tumg umsrln_w vfzg /end IN_MEASUREMENT
 /begin OUT_MEASUREMENT apdtev avdtev azpdtefre B_dteaa B_dteaam B_dtefrr B_dtes B_dtest B_ftedab B_rmsval dmsnte_w DTEVNonVolbits frdter_w rltedte_w rmstev_w tadtea tadteazs tc6tesc tc6tess tc6tesw /end OUT_MEASUREMENT
 /begin LOC_MEASUREMENT B_dteaab B_dteabu B_dteanfl B_dteend B_dteendl B_dteenf B_dtefre B_dtelab B_dtelbm B_dtelbr B_dtelnm B_dtelnmb B_dtelnmv B_dtenam B_dtephm B_dtepm B_dterab B_dterap B_dteres B_dternm B_dtezam B_teviol B_teviolm B_teviop B_tevior B_tevnio B_tevniom B_tumanst detazwte dmletanf_w dmletanu dmletan_w etazwif etazwkte frmfdif_w frmfref_w frmitf_w frmxaf_w fthozs_w mletanzs_w mletan_w msdkoo_w mstedtef_w nmotdtf_w rmstevf_w rmstevuf_w tdtesta tdtetevo tntevzu tumanst tvfrrdte /end LOC_MEASUREMENT
 /begin SUB_FUNCTION /end SUB_FUNCTION
/end FUNCTION
/begin FUNCTION DTEVE "9.30      Diagnose; Tankentlüftungsventil - Endstufe" /begin DEF_CHARACTERISTIC /end DEF_CHARACTERISTIC /begin REF_CHARACTERISTIC /end REF_CHARACTERISTIC /begin IN_MEASUREMENT B_desee tateout /end IN_MEASUREMENT /begin OUT_MEASUREMENT B_atev B_ztev /end OUT_MEASUREMENT /begin LOC_MEASUREMENT /end LOC_MEASUREMENT /begin SUB_FUNCTION /end SUB_FUNCTION /end FUNCTION
/begin FUNCTION DTHM "7.10      Diagnose Thermostat Motor-Kühlmittel"
 /begin DEF_CHARACTERISTIC CWDTHM IDTHMO IDTHMU ITWDTHMMN ITWDTHMMX KFTWDTHM KMDTHMMN KMDTHMMX NDTHMU TC6CTHM TDTHMO TDTHMU THMDMIN TMSDTHMO TMSDTHMU /end DEF_CHARACTERISTIC
 /begin REF_CHARACTERISTIC /end REF_CHARACTERISTIC
 /begin IN_MEASUREMENT B_nmot B_pwf B_tmsrt imlatm nmot tans tmotlin tmst tnst_w tum vfzg_w /end IN_MEASUREMENT
 /begin OUT_MEASUREMENT B_bbdthm B_cwdthm B_twdthm imltw_w m6cthm m6sthm_w m6wthm_w tripkm twdthm_w /end OUT_MEASUREMENT
 /begin LOC_MEASUREMENT B_ethmr B_temp1 B_temp2 B_zthmr DTHMlokBits tamb /end LOC_MEASUREMENT
 /begin SUB_FUNCTION /end SUB_FUNCTION
/end FUNCTION
/begin FUNCTION DTIP "1.30      OBDII; Tester-Interface Package" /begin DEF_CHARACTERISTIC /end DEF_CHARACTERISTIC /begin REF_CHARACTERISTIC /end REF_CHARACTERISTIC /begin IN_MEASUREMENT cw_erfil fcmEnd FCMTab /end IN_MEASUREMENT /begin OUT_MEASUREMENT ffzdfp /end OUT_MEASUREMENT /begin LOC_MEASUREMENT /end LOC_MEASUREMENT /begin SUB_FUNCTION /end SUB_FUNCTION /end FUNCTION
/begin FUNCTION DTOP "1.0       Diagnose; Betriebszeit" /begin DEF_CHARACTERISTIC /end DEF_CHARACTERISTIC /begin REF_CHARACTERISTIC /end REF_CHARACTERISTIC /begin IN_MEASUREMENT B_pwf /end IN_MEASUREMENT /begin OUT_MEASUREMENT top_w /end OUT_MEASUREMENT /begin LOC_MEASUREMENT /end LOC_MEASUREMENT /begin SUB_FUNCTION /end SUB_FUNCTION /end FUNCTION
/begin FUNCTION DTRIG "1.10      OBDII; Auswählbare Trigger für Fehlerpfad-Management" /begin DEF_CHARACTERISTIC /end DEF_CHARACTERISTIC /begin REF_CHARACTERISTIC /end REF_CHARACTERISTIC /begin IN_MEASUREMENT bbdcy bbno bbsp1 bbsp2 bbsp3 bbtim bbwuc /end IN_MEASUREMENT /begin OUT_MEASUREMENT /end OUT_MEASUREMENT /begin LOC_MEASUREMENT /end LOC_MEASUREMENT /begin SUB_FUNCTION /end SUB_FUNCTION /end FUNCTION
/begin FUNCTION DUF "6.30      Diagnose aus der Funktionsüberwachung" /begin DEF_CHARACTERISTIC DUF_T NMN_DUF /end DEF_CHARACTERISTIC /begin REF_CHARACTERISTIC /end REF_CHARACTERISTIC
 /begin IN_MEASUREMENT B_ehfs B_fgr B_fgr_um B_i_ska_um B_mibeg B_msr B_nomsr_um B_nosgs_um B_notlu_fr B_pwgnotfr B_sgs B_sp1s B_sp2s B_spsmin B_ub_ok B_wdk2sel ei_adcc_um ei_ipa_um ei_mver_um ei_nc_um ei_reac_um ei_rlc_um ei_rlip_um ei_spsc_um ei_ubr_um ei_zwc_um mi_um nmot_um /end IN_MEASUREMENT
 /begin OUT_MEASUREMENT duf_c egaspfad mi_duf mpfad skapfad /end OUT_MEASUREMENT
 /begin LOC_MEASUREMENT /end LOC_MEASUREMENT
 /begin SUB_FUNCTION /end SUB_FUNCTION
/end FUNCTION
/begin FUNCTION DUMMY "DUMMY SEKTION"
 /begin DEF_CHARACTERISTIC ATVFETTO ATVFETTU ATVMAGO ATVMAGU TPSVKMN TPSVKMX TUSPNMN TUSPNMX USMNSAMN USMNSAMX USMXSAMN USMXSAMX /end DEF_CHARACTERISTIC
 /begin REF_CHARACTERISTIC /end REF_CHARACTERISTIC
 /begin IN_MEASUREMENT /end IN_MEASUREMENT
 /begin OUT_MEASUREMENT atvfett atvmager B_blkfb evsup0 slp_an tpsvlssa tuspnf usmnsan usmxsan usrj /end OUT_MEASUREMENT
 /begin LOC_MEASUREMENT /end LOC_MEASUREMENT
 /begin SUB_FUNCTION /end SUB_FUNCTION
/end FUNCTION
/begin FUNCTION DUMWEX "4.10      Diagose; Erweiterte Umweltbedingumgen" /begin DEF_CHARACTERISTIC /end DEF_CHARACTERISTIC /begin REF_CHARACTERISTIC /end REF_CHARACTERISTIC /begin IN_MEASUREMENT kmstand_w top_w /end IN_MEASUREMENT /begin OUT_MEASUREMENT /end OUT_MEASUREMENT /begin LOC_MEASUREMENT /end LOC_MEASUREMENT /begin SUB_FUNCTION /end SUB_FUNCTION /end FUNCTION
/begin FUNCTION DUR "1.20      Diagnose aus der Rechnerüberwachung" /begin DEF_CHARACTERISTIC /end DEF_CHARACTERISTIC /begin REF_CHARACTERISTIC /end REF_CHARACTERISTIC /begin IN_MEASUREMENT /end IN_MEASUREMENT /begin OUT_MEASUREMENT rstpfad /end OUT_MEASUREMENT /begin LOC_MEASUREMENT rstMon_um /end LOC_MEASUREMENT /begin SUB_FUNCTION /end SUB_FUNCTION /end FUNCTION
/begin FUNCTION DVFZ "17.10     Diagnose: Plausibilitätsprüfung Fahrzeuggeschwindigkeit" /begin DEF_CHARACTERISTIC NDV NDVO TDV TMDV VDMN /end DEF_CHARACTERISTIC /begin REF_CHARACTERISTIC /end REF_CHARACTERISTIC /begin IN_MEASUREMENT B_sa nmot tmot vfzroh_w /end IN_MEASUREMENT /begin OUT_MEASUREMENT /end OUT_MEASUREMENT /begin LOC_MEASUREMENT /end LOC_MEASUREMENT /begin SUB_FUNCTION /end SUB_FUNCTION /end FUNCTION
/begin FUNCTION DWUC "14.20     OBDII; Erfüllung Bedingung 'warm up cycle'" /begin DEF_CHARACTERISTIC DTMWUC TMWUC TMWUCST /end DEF_CHARACTERISTIC /begin REF_CHARACTERISTIC /end REF_CHARACTERISTIC /begin IN_MEASUREMENT B_pwf B_stend tmot /end IN_MEASUREMENT /begin OUT_MEASUREMENT bbwuc B_nowuc B_wuc wuccnt /end OUT_MEASUREMENT /begin LOC_MEASUREMENT tmstem /end LOC_MEASUREMENT /begin SUB_FUNCTION /end SUB_FUNCTION /end FUNCTION
/begin FUNCTION DZUEET "1.30      Diagnose Zuendendstufentreiber" /begin DEF_CHARACTERISTIC DZUPHL DZUPKSMS DZUPKSUB DZUPSIG /end DEF_CHARACTERISTIC /begin REF_CHARACTERISTIC ESKONF_0_A ESKONF_1_A /end REF_CHARACTERISTIC /begin IN_MEASUREMENT B_desee zndact zndsucc /end IN_MEASUREMENT /begin OUT_MEASUREMENT dzuhlzl dzuksmszl dzuksubzl dzusigzl /end OUT_MEASUREMENT /begin LOC_MEASUREMENT /end LOC_MEASUREMENT /begin SUB_FUNCTION /end SUB_FUNCTION /end FUNCTION
/begin FUNCTION _EEPROM "11.30     EEPROM-Behandlung" /begin DEF_CHARACTERISTIC /end DEF_CHARACTERISTIC /begin REF_CHARACTERISTIC /end REF_CHARACTERISTIC /begin IN_MEASUREMENT /end IN_MEASUREMENT /begin OUT_MEASUREMENT /end OUT_MEASUREMENT /begin LOC_MEASUREMENT /end LOC_MEASUREMENT /begin SUB_FUNCTION /end SUB_FUNCTION /end FUNCTION
/begin FUNCTION ESGRU "23.30     Grundeinspritzungen" /begin DEF_CHARACTERISTIC FRKAP_0_A FRKAP_1_A KFLF /end DEF_CHARACTERISTIC /begin REF_CHARACTERISTIC /end REF_CHARACTERISTIC /begin IN_MEASUREMENT nmot rl vsfrk vstfrk /end IN_MEASUREMENT /begin OUT_MEASUREMENT fgru /end OUT_MEASUREMENT /begin LOC_MEASUREMENT /end LOC_MEASUREMENT /begin SUB_FUNCTION /end SUB_FUNCTION /end FUNCTION
/begin FUNCTION ESNSWL "3.20      Einspritzung Nachstart und Warmlauf"
 /begin DEF_CHARACTERISTIC FNSHO FNSSM_0_A FNSSM_1_A FNSSM_2_A FNSSM_3_A FWSTAB1 FWSTAB2 FWSTAB3 FWSTAS1 FWSTAS2 FZANSSA1_0_A FZANSSA1_1_A FZANSSA2_0_A FZANSSA2_1_A FZANSSM1_0_A FZANSSM1_1_A FZANSSM2_0_A FZANSSM2_1_A FZANSSM3_0_A FZANSSM3_1_A KFFWL_0_A KFFWL_1_A KFFWL_2_A KFFWL_3_A KFFWLRL_0_A KFFWLRL_1_A KFFWLW_0_A KFFWLW_1_A KFFWLW_2_A KFFWLW_3_A KFNSA_0_A KFNSA_1_A KFNSWRL_0_A KFNSWRL_1_A KFWLHO KFWSTAARL KFWWLML KFWWNS KLZANSFHO SZANSSM1_0_A SZANSSM1_1_A SZANSSM2_0_A SZANSSM2_1_A ZDGZA1 ZDGZA2 ZDGZA3 /end DEF_CHARACTERISTIC
 /begin REF_CHARACTERISTIC FHO04ESUB SIM06ESUW SKS06ESUB SNM06ESUB SRP06ESUB STA06ESUB STM12ESUB STS08ESUB STS12ESUB /end REF_CHARACTERISTIC
 /begin IN_MEASUREMENT B_hst B_staa B_stendes B_wks esst_fho04esub esst_sim06esuw esst_sks06esub esst_snm06esub esst_srp06esub esst_sta06esub esst_stm12esub esst_sts08esub esst_sts12esub fho imlatm_w kstaa nmot rlp tabst_w tans tmot tmst vstfns vstfwl /end IN_MEASUREMENT
 /begin OUT_MEASUREMENT B_fnsoff esnswlbits fnswlst_w fnswl_w fns_w fwl /end OUT_MEASUREMENT
 /begin LOC_MEASUREMENT abr1_count fktns_w fwlrl fzans1_w nsactr nswrl /end LOC_MEASUREMENT
 /begin SUB_FUNCTION /end SUB_FUNCTION
/end FUNCTION
/begin COMPU_METHOD B_TRUE "boolsche Zustände, positive Logik" TAB_VERB "%6.3" "" COMPU_TAB_REF B_TRUE /end COMPU_METHOD
/begin COMPU_VTAB B_TRUE "boolsche Zustände, positive Logik" TAB_VERB 2 0 "----" 1 "TRUE" /end COMPU_VTAB
/begin COMPU_METHOD dez "1 : 1 Umrechnug (dez/hex)" RAT_FUNC "%6.2" "" COEFFS 0 1 0 0 0 1 /end COMPU_METHOD
/begin COMPU_METHOD fak_q0p03815 "" RAT_FUNC "%6.4" "%/(s*kg/h)" COEFFS 0 65536 0 0 0 2500 /end COMPU_METHOD
/begin COMPU_METHOD fak_sb_b1 "" RAT_FUNC "%6.4" "-" COEFFS 0 256 0 0 0 2 /end COMPU_METHOD
/begin COMPU_METHOD fak_sw_b1 "" RAT_FUNC "%7.6" "-" COEFFS 0 65536 0 0 0 2 /end COMPU_METHOD
/begin COMPU_METHOD fak_sw_b64 "" RAT_FUNC "%6.4" "-" COEFFS 0 65536 0 0 0 128 /end COMPU_METHOD
/begin COMPU_METHOD fak_ub_b0p25 "" RAT_FUNC "%10.7" "-" COEFFS 0 256 0 0 0 0.25 /end COMPU_METHOD
/begin COMPU_METHOD fak_ub_b1 "" RAT_FUNC "%6.4" "-" COEFFS 0 256 0 0 0 1 /end COMPU_METHOD
/begin COMPU_METHOD fak_ub_b2 "" RAT_FUNC "%6.4" "-" COEFFS 0 256 0 0 0 2 /end COMPU_METHOD
/begin COMPU_METHOD fak_ub_b4 "" RAT_FUNC "%6.4" "-" COEFFS 0 256 0 0 0 4 /end COMPU_METHOD
/begin COMPU_METHOD fak_uw_b1 "" RAT_FUNC "%7.6" "-" COEFFS 0 65536 0 0 0 1 /end COMPU_METHOD
/begin COMPU_METHOD fak_uw_b16 "" RAT_FUNC "%6.5" "-" COEFFS 0 65536 0 0 0 16 /end COMPU_METHOD
/begin COMPU_METHOD fak_uw_b2 "" RAT_FUNC "%7.6" "-" COEFFS 0 65536 0 0 0 2 /end COMPU_METHOD
/begin COMPU_METHOD fak_uw_b4 "" RAT_FUNC "%7.6" "-" COEFFS 0 65536 0 0 0 4 /end COMPU_METHOD
/begin COMPU_METHOD km_ub_q0p10 "" RAT_FUNC "%6.3" "km" COEFFS 0 10 0 0 0 1 /end COMPU_METHOD
/begin COMPU_METHOD kw_q0p0019 "" RAT_FUNC "%6.4" "°KW" COEFFS 0 512 0 0 0 1 /end COMPU_METHOD
/begin COMPU_METHOD kw_q0p0156 "" RAT_FUNC "%6.4" "°KW" COEFFS 0 64 0 0 0 1 /end COMPU_METHOD
/begin COMPU_METHOD kw_tooth_sy "" RAT_FUNC "%6.2" "°KW" COEFFS 0 0.166667 0 0 0 1 /end COMPU_METHOD
/begin COMPU_METHOD luquant "Umrechnung Laufunruhe in DMD" RAT_FUNC "%6.3" "(Umdr./sec)^2" COEFFS 0 1.47862 0 0 0 1 /end COMPU_METHOD
/begin COMPU_METHOD luquant_w "Umrechnung Laufunruhe Word-Größen in DMD" RAT_FUNC "%6.4" "(Umdr./sec)^2" COEFFS 0 378.528 0 0 0 1 /end COMPU_METHOD
/begin COMPU_METHOD m_q0p00014 "" RAT_FUNC "%6.5" "kg/s" COEFFS 0 714678 0 0 0 100 /end COMPU_METHOD
/begin COMPU_METHOD m_q0p0015625 "" RAT_FUNC "%6.4" "kg/h" COEFFS 0 640 0 0 0 1 /end COMPU_METHOD
/begin COMPU_METHOD m_q0p00195 "" RAT_FUNC "%6.4" "kg/(h*s)" COEFFS 0 65536 0 0 0 128 /end COMPU_METHOD
/begin COMPU_METHOD m_q0p0031 "" RAT_FUNC "%6.4" "kg/h" COEFFS 0 320 0 0 0 1 /end COMPU_METHOD
/begin COMPU_METHOD m_q0p004 "" RAT_FUNC "%6.4" "kg/h" COEFFS 0 250 0 0 0 1 /end COMPU_METHOD
/begin COMPU_METHOD m_q0p1 "" RAT_FUNC "%6.3" "kg/h" COEFFS 0 10 0 0 0 1 /end COMPU_METHOD
/begin COMPU_METHOD m_q0p4 "" RAT_FUNC "%6.3" "kg/h" COEFFS 0 1 0 0 0 0.4 /end COMPU_METHOD
/begin COMPU_METHOD m_sw_q0p1 "" RAT_FUNC "%6.3" "kg/h" COEFFS 0 1 0 0 0 0.1 /end COMPU_METHOD
/begin COMPU_METHOD m_ub_b1020 "" RAT_FUNC "%6.2" "kg/h" COEFFS 0 1 0 0 0 4 /end COMPU_METHOD
/begin COMPU_METHOD m_ub_b23p3 "" RAT_FUNC "%6.3" "kg" COEFFS 0 2812.5 0 0 0 256 /end COMPU_METHOD
/begin COMPU_METHOD m_ub_b25p6 "" RAT_FUNC "%6.3" "kg/h" COEFFS 0 256 0 0 0 25.6 /end COMPU_METHOD
/begin COMPU_METHOD m_ub_q0p0444 "" RAT_FUNC "%6.4" "g" COEFFS 0 1 0 0 0 0.0444 /end COMPU_METHOD
/begin COMPU_METHOD m_uw_b23p3 "" RAT_FUNC "%6.5" "kg" COEFFS 0 2812.5 0 0 0 1 /end COMPU_METHOD
/begin COMPU_METHOD m_uw_b6553p5 "" RAT_FUNC "%6.3" "kg/h" COEFFS 0 1 0 0 0 0.1 /end COMPU_METHOD
/begin COMPU_METHOD nmotg_sw_q0p39 "" RAT_FUNC "%6.3" "U/min/s" COEFFS 0 1 0 0 0 0.39063 /end COMPU_METHOD
/begin COMPU_METHOD nmot_ub_q10 "" RAT_FUNC "%6.1" "U/min" COEFFS 0 1 0 0 0 10 /end COMPU_METHOD
/begin COMPU_METHOD nmot_ub_q40 "" RAT_FUNC "%6.1" "Upm" COEFFS 0 1 0 0 0 40 /end COMPU_METHOD
/begin COMPU_METHOD nmot_uw_q0p25 "" RAT_FUNC "%6.3" "U/min" COEFFS 0 1 0 0 0 0.25 /end COMPU_METHOD
/begin COMPU_METHOD nw_dmdstp_sy "" RAT_FUNC "%6.3" "NwU" COEFFS 0 4 0 0 0 1 /end COMPU_METHOD
/begin COMPU_METHOD relNWU_q0p0234 "" RAT_FUNC "%6.4" "%/NWU" COEFFS 0 32 0 0 0 0.75 /end COMPU_METHOD
/begin COMPU_METHOD rel_sw_b100 "" RAT_FUNC "%6.4" "%" COEFFS 0 32768 0 0 0 100 /end COMPU_METHOD
/begin COMPU_METHOD rel_sw_b1536 "" RAT_FUNC "%6.4" "%" COEFFS 0 65536 0 0 0 3072 /end COMPU_METHOD
/begin COMPU_METHOD rel_sw_b200 "" RAT_FUNC "%6.4" "%" COEFFS 0 65536 0 0 0 400 /end COMPU_METHOD
/begin COMPU_METHOD rel_ub_b127p5 "" RAT_FUNC "%6.3" "%" COEFFS 0 2 0 0 0 1 /end COMPU_METHOD
/begin COMPU_METHOD rel_ub_b99p6 "" RAT_FUNC "%6.3" "%" COEFFS 0 256 0 0 0 100 /end COMPU_METHOD
/begin COMPU_METHOD rel_ub_q0p75 "" RAT_FUNC "%6.3" "%" COEFFS 0 1 0 0 0 0.75 /end COMPU_METHOD
/begin COMPU_METHOD rel_uw_b200 "" RAT_FUNC "%6.4" "%" COEFFS 0 65536 0 0 0 200 /end COMPU_METHOD
/begin COMPU_METHOD rel_uw_q0p0234 "" RAT_FUNC "%6.4" "%" COEFFS 0 32 0 0 0 0.75 /end COMPU_METHOD
/begin COMPU_METHOD spg_ub_b1p33 "" RAT_FUNC "%6.4" "V" COEFFS 0 255 0 0 0 1.33 /end COMPU_METHOD
/begin COMPU_METHOD t100msxms_ub_b255 "" RAT_FUNC "%6.2" "ms" COEFFS 0 1 0 0 0 1 /end COMPU_METHOD
/begin COMPU_METHOD t100msxs_ub_b25p5 "" RAT_FUNC "%6.3" "s" COEFFS 0 1 0 0 0 0.1 /end COMPU_METHOD
/begin COMPU_METHOD t100msxs_uw_b6553p5 "" RAT_FUNC "%6.3" "s" COEFFS 0 1 0 0 0 0.1 /end COMPU_METHOD
/begin COMPU_METHOD t100msxs_uw_b6553p6 "" RAT_FUNC "%6.3" "s" COEFFS 0 10 0 0 0 1 /end COMPU_METHOD
/begin COMPU_METHOD t10msxs_ub_b2p55 "" RAT_FUNC "%6.4" "s" COEFFS 0 1 0 0 0 0.01 /end COMPU_METHOD
/begin COMPU_METHOD t10msxs_uw_b655p35 "" RAT_FUNC "%6.4" "s" COEFFS 0 1 0 0 0 0.01 /end COMPU_METHOD
/begin COMPU_METHOD t1sxs_ub_b255 "" RAT_FUNC "%6.2" "s" COEFFS 0 1 0 0 0 1 /end COMPU_METHOD
/begin COMPU_METHOD t1sxs_uw_b65535 "" RAT_FUNC "%6.2" "s" COEFFS 0 1 0 0 0 1 /end COMPU_METHOD
/begin COMPU_METHOD t1sxs_uw_q1 "" RAT_FUNC "%6.2" "s" COEFFS 0 1 0 0 0 1 /end COMPU_METHOD
/begin COMPU_METHOD t200msxs_ub_b51 "" RAT_FUNC "%6.3" "s" COEFFS 0 1 0 0 0 0.2 /end COMPU_METHOD
/begin COMPU_METHOD t40msxs_ub_q0p04 "" RAT_FUNC "%6.4" "s" COEFFS 0 1 0 0 0 0.04 /end COMPU_METHOD
/begin COMPU_METHOD t50msxs_ub_b12p75 "" RAT_FUNC "%6.4" "s" COEFFS 0 1 0 0 0 0.05 /end COMPU_METHOD
/begin COMPU_METHOD t6minxmin_q6 "" RAT_FUNC "%6.2" "min" COEFFS 0 1 0 0 0 6 /end COMPU_METHOD
/begin COMPU_METHOD temp_ub_b191p25 "" RAT_FUNC "%6.3" "Grad C" COEFFS 0 1 0 0 0 0.75 /end COMPU_METHOD
/begin COMPU_METHOD temp_ub_q0p75_o48 "" RAT_FUNC "%6.2" "Grad C" COEFFS 0 1 48 0 0 0.75 /end COMPU_METHOD
/begin COMPU_METHOD temp_ub_q5_o50 "" RAT_FUNC "%6.2" "Grad C" COEFFS 0 1 50 0 0 5 /end COMPU_METHOD
/begin COMPU_METHOD tsquant "Umrechnung Segmentzeit in DMD" RAT_FUNC "%6.2" "us" COEFFS 0 1.21951 0 0 0 1 /end COMPU_METHOD
/begin COMPU_METHOD t_q0p1 "" RAT_FUNC "%6.3" "s" COEFFS 0 10 0 0 0 1 /end COMPU_METHOD
/begin COMPU_METHOD vfzg_ub_q1p25 "" RAT_FUNC "%6.2" "km/h" COEFFS 0 1 0 0 0 1.25 /end COMPU_METHOD
/begin COMPU_METHOD vfzg_uw_b512 "" RAT_FUNC "%6.4" "km/h" COEFFS 0 65536 0 0 0 512 /end COMPU_METHOD
/begin COMPU_METHOD zk100msxs_ub_b25p5 "" RAT_FUNC "%6.3" "s" COEFFS 0 0 256 0 10 0 /end COMPU_METHOD
/begin COMPU_METHOD zk100msxs_uw_b6553 "" RAT_FUNC "%12.4" "s" COEFFS 0 0 65536 0 10 0 /end COMPU_METHOD
/begin COMPU_METHOD zue_dmdstp "" RAT_FUNC "%6.2" "Zuendungen" COEFFS 0 1 0 0 0 1 /end COMPU_METHOD
/begin COMPU_METHOD default "" RAT_FUNC "%6.2" "" COEFFS 0 1 0 0 0 1 /end COMPU_METHOD
/begin RECORD_LAYOUT GkfWSb FNC_VALUES 1 SBYTE COLUMN_DIR DIRECT /end RECORD_LAYOUT
/begin RECORD_LAYOUT GkfWUb FNC_VALUES 1 UBYTE COLUMN_DIR DIRECT /end RECORD_LAYOUT
/begin RECORD_LAYOUT GklWSb FNC_VALUES 1 SBYTE COLUMN_DIR DIRECT /end RECORD_LAYOUT
/begin RECORD_LAYOUT GklWUb FNC_VALUES 1 UBYTE COLUMN_DIR DIRECT /end RECORD_LAYOUT
/begin RECORD_LAYOUT GklWUw FNC_VALUES 1 UWORD COLUMN_DIR DIRECT /end RECORD_LAYOUT
/begin RECORD_LAYOUT KfAxUbAyUbSstxUbSstyUbWUb NO_AXIS_PTS_X 1 UBYTE NO_AXIS_PTS_Y 2 UBYTE AXIS_PTS_X 3 UBYTE INDEX_INCR DIRECT AXIS_PTS_Y 4 UBYTE INDEX_INCR DIRECT FNC_VALUES 5 UBYTE COLUMN_DIR DIRECT /end RECORD_LAYOUT
/begin RECORD_LAYOUT KfAxUbAyUbSstxUbSstyUwWUb NO_AXIS_PTS_X 1 UBYTE NO_AXIS_PTS_Y 2 UBYTE AXIS_PTS_X 3 UBYTE INDEX_INCR DIRECT AXIS_PTS_Y 4 UWORD INDEX_INCR DIRECT FNC_VALUES 5 UBYTE COLUMN_DIR DIRECT /end RECORD_LAYOUT
/begin RECORD_LAYOUT KfAxUbAyUbSstxUwSstyUwWUw NO_AXIS_PTS_X 1 UWORD NO_AXIS_PTS_Y 2 UWORD AXIS_PTS_X 3 UWORD INDEX_INCR DIRECT AXIS_PTS_Y 4 UWORD INDEX_INCR DIRECT FNC_VALUES 5 UWORD COLUMN_DIR DIRECT /end RECORD_LAYOUT
/begin RECORD_LAYOUT KlAUbSstUbWSb NO_AXIS_PTS_X 1 UBYTE AXIS_PTS_X 2 UBYTE INDEX_INCR DIRECT FNC_VALUES 3 SBYTE COLUMN_DIR DIRECT /end RECORD_LAYOUT
/begin RECORD_LAYOUT KlAUbSstUbWUb NO_AXIS_PTS_X 1 UBYTE AXIS_PTS_X 2 UBYTE INDEX_INCR DIRECT FNC_VALUES 3 UBYTE COLUMN_DIR DIRECT /end RECORD_LAYOUT
/begin RECORD_LAYOUT KlAUbSstUbWUw NO_AXIS_PTS_X 1 UBYTE AXIS_PTS_X 2 UBYTE INDEX_INCR DIRECT FNC_VALUES 3 UWORD COLUMN_DIR DIRECT /end RECORD_LAYOUT
/begin RECORD_LAYOUT KlAUwSstUwWSw NO_AXIS_PTS_X 1 UWORD AXIS_PTS_X 2 UWORD INDEX_INCR DIRECT FNC_VALUES 3 SWORD COLUMN_DIR DIRECT /end RECORD_LAYOUT
/begin RECORD_LAYOUT KlAUwSstUwWUw NO_AXIS_PTS_X 1 UWORD AXIS_PTS_X 2 UWORD INDEX_INCR DIRECT FNC_VALUES 3 UWORD COLUMN_DIR DIRECT /end RECORD_LAYOUT
/begin RECORD_LAYOUT KwSb FNC_VALUES 1 SBYTE COLUMN_DIR DIRECT /end RECORD_LAYOUT
/begin RECORD_LAYOUT KwSw FNC_VALUES 1 SWORD COLUMN_DIR DIRECT /end RECORD_LAYOUT
/begin RECORD_LAYOUT KwUb FNC_VALUES 1 UBYTE COLUMN_DIR DIRECT /end RECORD_LAYOUT
/begin RECORD_LAYOUT KwUw FNC_VALUES 1 UWORD COLUMN_DIR DIRECT /end RECORD_LAYOUT
/begin RECORD_LAYOUT SstAUbSstUb NO_AXIS_PTS_X 1 UBYTE AXIS_PTS_X 2 UBYTE INDEX_INCR DIRECT /end RECORD_LAYOUT
/begin RECORD_LAYOUT SstAUwSstUw NO_AXIS_PTS_X 1 UWORD AXIS_PTS_X 2 UWORD INDEX_INCR DIRECT /end RECORD_LAYOUT
/end MODULE
/end PROJECT
