ASAP2_VERSION 1 3
/begin PROJECT S1103A_25G5_0 "S1103A"
/begin HEADER "" VERSION "S1103A_25G5_0" PROJECT_NO S1103A_25G5_0 /end HEADER
/begin MODULE DIM ""
/begin MOD_COMMON "" BYTE_ORDER MSB_LAST ALIGNMENT_BYTE 1 ALIGNMENT_WORD 2 ALIGNMENT_LONG 2 /end MOD_COMMON
/begin CHARACTERISTIC ANZEAUS "" VALUE 0x8FCE0F KwUb 3.000 dez 4.000 7.000 FORMAT "%5.3" /end CHARACTERISTIC
/begin CHARACTERISTIC ANZLVMXA "" VALUE 0x8FD27E KwUb 255.0 dez 0.00 255.0 FORMAT "%5.1" /end CHARACTERISTIC
/begin CHARACTERISTIC ANZLVMXE "" VALUE 0x8FD27F KwUb 255.0 dez 0.00 255.0 FORMAT "%5.1" /end CHARACTERISTIC
/begin CHARACTERISTIC AUFW100M "" VALUE 0x8EBFFE KwUw 1310700. t20usxus_q20 0.00 1310700. FORMAT "%8.0" /end CHARACTERISTIC
/begin CHARACTERISTIC AUFW10MS "" VALUE 0x8FD25F KwUb 5100. t20usxus_q20 0.00 5100. FORMAT "%5.0" /end CHARACTERISTIC
/begin CHARACTERISTIC AUFW20MS "" VALUE 0x8FECC2 KwUw 1310700. t20usxus_q20 0.00 1310700. FORMAT "%8.0" /end CHARACTERISTIC
/begin CHARACTERISTIC AUFWSYNC "" VALUE 0x8FD260 KwUb 5100. t20usxus_q20 0.00 5100. FORMAT "%5.0" /end CHARACTERISTIC
/begin CHARACTERISTIC CDAGR "" VALUE 0x8E0010 KwUb 255.0 dez 0.00 255.0 FORMAT "%5.1" /end CHARACTERISTIC
/begin CHARACTERISTIC CDAGRL "" VALUE 0x8E0011 KwUb 255.0 dez 0.00 255.0 FORMAT "%5.1" /end CHARACTERISTIC
/begin CHARACTERISTIC CDATR "" VALUE 0x8E0012 KwUb 255.0 dez 0.00 255.0 FORMAT "%5.1" /end CHARACTERISTIC
/begin CHARACTERISTIC CDATS "" VALUE 0x8E0013 KwUb 255.0 dez 0.00 255.0 FORMAT "%5.1" /end CHARACTERISTIC
/begin CHARACTERISTIC CDBKVP "" VALUE 0x8E0014 KwUb 255.0 dez 0.00 255.0 FORMAT "%5.1" /end CHARACTERISTIC
/begin CHARACTERISTIC CDDSBKV "" VALUE 0x8E0015 KwUb 255.0 dez 0.00 255.0 FORMAT "%5.1" /end CHARACTERISTIC
/begin CHARACTERISTIC CDDST "" VALUE 0x8E0016 KwUb 255.0 dez 0.00 255.0 FORMAT "%5.1" /end CHARACTERISTIC
/begin CHARACTERISTIC CDDYLSU "" VALUE 0x8E0017 KwUb 255.0 dez 0.00 255.0 FORMAT "%5.1" /end CHARACTERISTIC
/begin CHARACTERISTIC CDEGFE "" VALUE 0x8E0018 KwUb 255.0 dez 0.00 255.0 FORMAT "%5.1" /end CHARACTERISTIC
/begin CHARACTERISTIC CDEHFM "" VALUE 0x8E0019 KwUb 255.0 dez 0.00 255.0 FORMAT "%5.1" /end CHARACTERISTIC
/begin CHARACTERISTIC CDGGGTS "" VALUE 0x8E001A KwUb 255.0 dez 0.00 255.0 FORMAT "%5.1" /end CHARACTERISTIC
/begin CHARACTERISTIC CDHELSU "" VALUE 0x8E001B KwUb 255.0 dez 0.00 255.0 FORMAT "%5.1" /end CHARACTERISTIC
/begin CHARACTERISTIC CDHRLSU "" VALUE 0x8E001C KwUb 255.0 dez 0.00 255.0 FORMAT "%5.1" /end CHARACTERISTIC
/begin CHARACTERISTIC CDHRLSUE "" VALUE 0x8E001D KwUb 255.0 dez 0.00 255.0 FORMAT "%5.1" /end CHARACTERISTIC
/begin CHARACTERISTIC CDHSH "" VALUE 0x8E001E KwUb 255.0 dez 0.00 255.0 FORMAT "%5.1" /end CHARACTERISTIC
/begin CHARACTERISTIC CDHSHE "" VALUE 0x8E001F KwUb 255.0 dez 0.00 255.0 FORMAT "%5.1" /end CHARACTERISTIC
/begin CHARACTERISTIC CDHSV "" VALUE 0x8E0020 KwUb 255.0 dez 0.00 255.0 FORMAT "%5.1" /end CHARACTERISTIC
/begin CHARACTERISTIC CDHSVE "" VALUE 0x8E0021 KwUb 255.0 dez 0.00 255.0 FORMAT "%5.1" /end CHARACTERISTIC
/begin CHARACTERISTIC CDICLSU "" VALUE 0x8E0022 KwUb 255.0 dez 0.00 255.0 FORMAT "%5.1" /end CHARACTERISTIC
/begin CHARACTERISTIC CDKAT "" VALUE 0x8E0023 KwUb 255.0 dez 0.00 255.0 FORMAT "%5.1" /end CHARACTERISTIC
/begin CHARACTERISTIC CDKVS "" VALUE 0x8E0024 KwUb 255.0 dez 0.00 255.0 FORMAT "%5.1" /end CHARACTERISTIC
/begin CHARACTERISTIC CDLASF "" VALUE 0x8E0025 KwUb 255.0 dez 0.00 255.0 FORMAT "%5.1" /end CHARACTERISTIC
/begin CHARACTERISTIC CDLASH "" VALUE 0x8E0026 KwUb 255.0 dez 0.00 255.0 FORMAT "%5.1" /end CHARACTERISTIC
/begin CHARACTERISTIC CDLATP "" VALUE 0x8E0027 KwUb 255.0 dez 0.00 255.0 FORMAT "%5.1" /end CHARACTERISTIC
/begin CHARACTERISTIC CDLATV "" VALUE 0x8E0028 KwUb 255.0 dez 0.00 255.0 FORMAT "%5.1" /end CHARACTERISTIC
/begin CHARACTERISTIC CDLDP "" VALUE 0x8E0029 KwUb 255.0 dez 0.00 255.0 FORMAT "%5.1" /end CHARACTERISTIC
/begin CHARACTERISTIC CDLLR "" VALUE 0x8E002A KwUb 255.0 dez 0.00 255.0 FORMAT "%5.1" /end CHARACTERISTIC
/begin CHARACTERISTIC CDLSA "" VALUE 0x8E002B KwUb 255.0 dez 0.00 255.0 FORMAT "%5.1" /end CHARACTERISTIC
/begin CHARACTERISTIC CDLSFHV "" VALUE 0x8E002C KwUb 255.0 dez 0.00 255.0 FORMAT "%5.1" /end CHARACTERISTIC
/begin CHARACTERISTIC CDLSH "" VALUE 0x8E002D KwUb 255.0 dez 0.00 255.0 FORMAT "%5.1" /end CHARACTERISTIC
/begin CHARACTERISTIC CDLSHV "" VALUE 0x8E002E KwUb 255.0 dez 0.00 255.0 FORMAT "%5.1" /end CHARACTERISTIC
/begin CHARACTERISTIC CDLSV "" VALUE 0x8E002F KwUb 255.0 dez 0.00 255.0 FORMAT "%5.1" /end CHARACTERISTIC
/begin CHARACTERISTIC CDLSVV "" VALUE 0x8E0030 KwUb 255.0 dez 0.00 255.0 FORMAT "%5.1" /end CHARACTERISTIC
/begin CHARACTERISTIC CDMD "" VALUE 0x8E0031 KwUb 255.0 dez 0.00 255.0 FORMAT "%5.1" /end CHARACTERISTIC
/begin CHARACTERISTIC CDNWS "" VALUE 0x8E0032 KwUb 255.0 dez 0.00 255.0 FORMAT "%5.1" /end CHARACTERISTIC
/begin CHARACTERISTIC CDPLLSU "" VALUE 0x8E0033 KwUb 255.0 dez 0.00 255.0 FORMAT "%5.1" /end CHARACTERISTIC
/begin CHARACTERISTIC CDSALSU "" VALUE 0x8E0034 KwUb 255.0 dez 0.00 255.0 FORMAT "%5.1" /end CHARACTERISTIC
/begin CHARACTERISTIC CDSLS "" VALUE 0x8E0035 KwUb 255.0 dez 0.00 255.0 FORMAT "%5.1" /end CHARACTERISTIC
/begin CHARACTERISTIC CDSWE "" VALUE 0x8E0036 KwUb 255.0 dez 0.00 255.0 FORMAT "%5.1" /end CHARACTERISTIC
/begin CHARACTERISTIC CDTANKL "" VALUE 0x8E0037 KwUb 255.0 dez 0.00 255.0 FORMAT "%5.1" /end CHARACTERISTIC
/begin CHARACTERISTIC CDTES "" VALUE 0x8E0038 KwUb 255.0 dez 0.00 255.0 FORMAT "%5.1" /end CHARACTERISTIC
/begin CHARACTERISTIC CDULSU "" VALUE 0x8E0039 KwUb 255.0 dez 0.00 255.0 FORMAT "%5.1" /end CHARACTERISTIC
/begin CHARACTERISTIC CDWVERAD "" VALUE 0x8E003A KwUb 255.0 dez 0.00 255.0 FORMAT "%5.1" /end CHARACTERISTIC
/begin CHARACTERISTIC CWADRES "" VALUE 0x8E003B KwUb 255.0 dez 0.00 255.0 FORMAT "%5.1" /end CHARACTERISTIC
/begin CHARACTERISTIC CWAU2 "" VALUE 0x8E1B6E KwUb 255.0 dez 0.00 255.0 FORMAT "%5.1" /end CHARACTERISTIC
/begin CHARACTERISTIC CWDLSU "" VALUE 0x8E003C KwUb 255.0 dez 0.00 255.0 FORMAT "%5.1" /end CHARACTERISTIC
/begin CHARACTERISTIC CWDMIL "" VALUE 0x8E1A6B KwUb 255.0 dez 0.00 255.0 FORMAT "%5.1" /end CHARACTERISTIC
/begin CHARACTERISTIC CWERFIL "" VALUE 0x8E003D KwUb 255.0 dez 0.00 255.0 FORMAT "%5.1" /end CHARACTERISTIC
/begin CHARACTERISTIC CWFASL "" VALUE 0x8E02CD KwUb 255.0 dez 0.00 255.0 FORMAT "%5.1" /end CHARACTERISTIC
/begin CHARACTERISTIC CWGRABH "" VALUE 0x8E003E KwUb 255.0 dez 0.00 255.0 FORMAT "%5.1" /end CHARACTERISTIC
/begin CHARACTERISTIC CWKMMILSCT "" VALUE 0x8E003F KwUb 255.0 dez 0.00 255.0 FORMAT "%5.1" /end CHARACTERISTIC
/begin CHARACTERISTIC CWKONABG "" VALUE 0x8E0040 KwUb 255.0 dez 0.00 255.0 FORMAT "%5.1" /end CHARACTERISTIC
/begin CHARACTERISTIC CWKONFLS "" VALUE 0x8E0041 KwUb 255.0 dez 0.00 255.0 FORMAT "%5.1" /end CHARACTERISTIC
/begin CHARACTERISTIC CWKONFZ1 "" VALUE 0x8E0042 KwUb 255.0 dez 0.00 255.0 FORMAT "%5.1" /end CHARACTERISTIC
/begin CHARACTERISTIC CWKONLS "" VALUE 0x8E0043 KwUb 255.0 dez 0.00 255.0 FORMAT "%5.1" /end CHARACTERISTIC
/begin CHARACTERISTIC CWLSFA "" VALUE 0x8E0044 KwUb 255.0 dez 0.00 255.0 FORMAT "%5.1" /end CHARACTERISTIC
/begin CHARACTERISTIC CWLSHA "" VALUE 0x8E0045 KwUb 255.0 dez 0.00 255.0 FORMAT "%5.1" /end CHARACTERISTIC
/begin CHARACTERISTIC CWMDAPP "" VALUE 0x8E0046 KwUb 255.0 dez 0.00 255.0 FORMAT "%5.1" /end CHARACTERISTIC
/begin CHARACTERISTIC CWMDZUL "" VALUE 0x8FD254 KwUb 255.0 dez 0.00 255.0 FORMAT "%5.1" /end CHARACTERISTIC
/begin CHARACTERISTIC CWNLPH "" VALUE 0x8FCE10 KwUb 255.0 dez 0.00 255.0 FORMAT "%5.1" /end CHARACTERISTIC
/begin CHARACTERISTIC CWNWEHOE "" VALUE 0x8FD28D KwUb 255.0 dez 0.00 255.0 FORMAT "%5.1" /end CHARACTERISTIC
/begin CHARACTERISTIC CWNWEVDA "" VALUE 0x8E3B91 KwUb 255.0 dez 0.00 255.0 FORMAT "%5.1" /end CHARACTERISTIC
/begin CHARACTERISTIC CWNWEVO "" VALUE 0x8FD280 KwUb 255.0 dez 0.00 255.0 FORMAT "%5.1" /end CHARACTERISTIC
/begin CHARACTERISTIC CWNWFW "" VALUE 0x8E3A10 KwUb 255.0 dez 0.00 255.0 FORMAT "%5.1" /end CHARACTERISTIC
/begin CHARACTERISTIC CWOBD "" VALUE 0x8E0047 KwUb 255.0 dez 0.00 255.0 FORMAT "%5.1" /end CHARACTERISTIC
/begin CHARACTERISTIC CWPKAPP "" VALUE 0x8E1A6C KwUb 255.0 dez 0.00 255.0 FORMAT "%5.1" /end CHARACTERISTIC
/begin CHARACTERISTIC CWPWF "" VALUE 0x8E0054 KwUb 255.0 dez 0.00 255.0 FORMAT "%5.1" /end CHARACTERISTIC
/begin CHARACTERISTIC CWRPSLSU "" VALUE 0x8E3508 KwUb 255.0 dez 0.00 255.0 FORMAT "%5.1" /end CHARACTERISTIC
/begin CHARACTERISTIC CWSCTMDE "" VALUE 0x8E0048 KwUb 255.0 dez 0.00 255.0 FORMAT "%5.1" /end CHARACTERISTIC
/begin CHARACTERISTIC CWSLS "" VALUE 0x8E0049 KwUb 255.0 dez 0.00 255.0 FORMAT "%5.1" /end CHARACTERISTIC
/begin CHARACTERISTIC CWTF "" VALUE 0x8E004A KwUb 255.0 dez 0.00 255.0 FORMAT "%5.1" /end CHARACTERISTIC
/begin CHARACTERISTIC CWUHR "" VALUE 0x8E004B KwUb 255.0 dez 0.00 255.0 FORMAT "%5.1" /end CHARACTERISTIC
/begin CHARACTERISTIC DATAID "" ASCII 0x8E004F KtxC 255.0 defaultAscii 0.00 255.0 NUMBER 4 /end CHARACTERISTIC
/begin CHARACTERISTIC DMAUFN "" CURVE 0x8F0EE8 KlAUwSstUwWUw 99.99847 rel_uw_b100 0.00 99.99847 FORMAT "%8.5"
 /begin AXIS_DESCR STD_AXIS nmot_w nmot_uw_q0p25 8 0.00 16383.75 FORMAT "%8.2" DEPOSIT ABSOLUTE /end AXIS_DESCR
/end CHARACTERISTIC
/begin CHARACTERISTIC DMRDNW "" VALUE 0x8EF2AE KwUw 99.99847 rel_uw_b100 0.00 99.99847 FORMAT "%8.5" /end CHARACTERISTIC
/begin CHARACTERISTIC DNABW "" VALUE 0x8FDBDC KwSw 16383.75 nmot_sw_q0p25 -8192.000 8191.750 FORMAT "%8.3" /end CHARACTERISTIC
/begin CHARACTERISTIC DNMAX "" VALUE 0x8FEB7E KwUw 16383.75 nmot_uw_q0p25 0.00 16383.75 FORMAT "%8.2" /end CHARACTERISTIC
/begin CHARACTERISTIC DNSIAB "" VALUE 0x8FEB80 KwSw 8191.750 nmot_sw_q0p25 0.00 8191.750 FORMAT "%8.3" /end CHARACTERISTIC
/begin CHARACTERISTIC DPSLV "" VALUE 0x8E02CE KwUb 1275. p_ub_q5 0.00 1275. FORMAT "%5.0" /end CHARACTERISTIC
/begin CHARACTERISTIC DTOELKNWHA "" VALUE 0x8F000A KwUw 1535.977 temp_q0p0234 0.00 1535.977 FORMAT "%8.3" /end CHARACTERISTIC
/begin CHARACTERISTIC DWNWABGA "" CURVE 0x8F000C GklWUw 511.9922 kw_q0p0078 0.00 511.9922 FORMAT "%8.4"
 /begin AXIS_DESCR COM_AXIS nmot_w nmot_uw_q0p25 5 0.00 16383.75 FORMAT "%8.2" AXIS_PTS_REF SNM05NWUW /end AXIS_DESCR
/end CHARACTERISTIC
/begin CHARACTERISTIC DWNWABGE "" CURVE 0x8EF2C2 GklWUw 511.9922 kw_q0p0078 0.00 511.9922 FORMAT "%8.4"
 /begin AXIS_DESCR COM_AXIS nmot_w nmot_uw_q0p25 5 0.00 16383.75 FORMAT "%8.2" AXIS_PTS_REF SNM05NWUW /end AXIS_DESCR
/end CHARACTERISTIC
/begin CHARACTERISTIC DWNWAMXA "" CURVE 0x8F0016 GklWUw 511.9922 kw_q0p0078 0.00 511.9922 FORMAT "%8.4"
 /begin AXIS_DESCR COM_AXIS nmot_w nmot_uw_q0p25 5 0.00 16383.75 FORMAT "%8.2" AXIS_PTS_REF SNM05NWUW /end AXIS_DESCR
/end CHARACTERISTIC
/begin CHARACTERISTIC DWNWAMXE "" CURVE 0x8EFDF6 GklWUw 511.9922 kw_q0p0078 0.00 511.9922 FORMAT "%8.4"
 /begin AXIS_DESCR COM_AXIS nmot_w nmot_uw_q0p25 5 0.00 16383.75 FORMAT "%8.2" AXIS_PTS_REF SNM05NWUW /end AXIS_DESCR
/end CHARACTERISTIC
/begin CHARACTERISTIC DWNWESTPA "" MAP 0x8EF272 GkfWSw 511.9922 kw_sw_q0p0078 -256.0000 255.9922 FORMAT "%8.4"
 /begin AXIS_DESCR COM_AXIS nmot_w nmot_uw_q0p25 5 0.00 16383.75 FORMAT "%8.2" AXIS_PTS_REF SNM05NWUW /end AXIS_DESCR
 /begin AXIS_DESCR COM_AXIS toelk_w temp_q0p0234_o273 6 -273.1500 1262.827 FORMAT "%8.3" AXIS_PTS_REF STO06NWUW /end AXIS_DESCR
/end CHARACTERISTIC
/begin CHARACTERISTIC DWNWSBGLA "" VALUE 0x8FEFA6 KwUw 255.8984 kw_q0p0078 0.00 255.8984 FORMAT "%8.4" /end CHARACTERISTIC
/begin CHARACTERISTIC DWNWSBGLE "" VALUE 0x8FEF96 KwUw 511.9922 kw_q0p0078 0.00 511.9922 FORMAT "%8.4" /end CHARACTERISTIC
/begin CHARACTERISTIC DWNWSHKA "" VALUE 0x8FEF66 KwSw 512.0000 kw_sw_q0p0078 -256.0000 256.0000 FORMAT "%8.4" /end CHARACTERISTIC
/begin CHARACTERISTIC DWNWSHKE "" VALUE 0x8FEF68 KwSw 512.0000 kw_sw_q0p0078 -256.0000 256.0000 FORMAT "%8.4" /end CHARACTERISTIC
/begin CHARACTERISTIC DWNWSTPA "" VALUE 0x8FEF6A KwSw 512.0000 kw_sw_q0p0078 -256.0000 256.0000 FORMAT "%8.4" /end CHARACTERISTIC
/begin CHARACTERISTIC DWNWSTPE "" VALUE 0x8FEF6C KwSw 512.0000 kw_sw_q0p0078 -256.0000 256.0000 FORMAT "%8.4" /end CHARACTERISTIC
/begin CHARACTERISTIC DWNWSTPEA "" VALUE 0x8FEF6E KwSw 512.0000 kw_sw_q0p0078 -256.0000 256.0000 FORMAT "%8.4" /end CHARACTERISTIC
/begin CHARACTERISTIC DWNWSTPEE "" VALUE 0x8FEF70 KwSw 512.0000 kw_sw_q0p0078 -256.0000 256.0000 FORMAT "%8.4" /end CHARACTERISTIC
/begin CHARACTERISTIC DWNWSVPA "" VALUE 0x8FEF72 KwSw 512.0000 kw_sw_q0p0078 -256.0000 256.0000 FORMAT "%8.4" /end CHARACTERISTIC
/begin CHARACTERISTIC DWNWSVPE "" VALUE 0x8FEF74 KwSw 512.0000 kw_sw_q0p0078 -256.0000 256.0000 FORMAT "%8.4" /end CHARACTERISTIC
/begin CHARACTERISTIC DWNWVPA "" VALUE 0x8FEF76 KwSw 512.0000 kw_sw_q0p0078 -256.0000 256.0000 FORMAT "%8.4" /end CHARACTERISTIC
/begin CHARACTERISTIC DWNWVPE "" VALUE 0x8FEF78 KwSw 512.0000 kw_sw_q0p0078 -256.0000 256.0000 FORMAT "%8.4" /end CHARACTERISTIC
/begin CHARACTERISTIC DWNWVSA "" VALUE 0x8FEF7A KwSw 512.0000 kw_sw_q0p0078 -256.0000 256.0000 FORMAT "%8.4" /end CHARACTERISTIC
/begin CHARACTERISTIC DYNMXNL "" VALUE 0x8FDC1E KwUw 40000.00 t5usxus_q5 0.00 40000.00 FORMAT "%8.2" /end CHARACTERISTIC
/begin CHARACTERISTIC DZWETA "" CURVE 0x8FD2B0 FklWSb 191.3 zw_sb_q0p75 -96.00 95.25 FORMAT "%5.2"
 /begin AXIS_DESCR FIX_AXIS etazws rel_ub_b127p5 201 0.00 100.0 FORMAT "%5.1" FIX_AXIS_PAR 0 0 201 /end AXIS_DESCR
/end CHARACTERISTIC
/begin AXIS_PTS FHO04ESUB "" 0x8E01C4 fho SstAUbSstUb 3.984 fak_ub_b4 4 0.00 3.984 FORMAT "%5.3" DEPOSIT ABSOLUTE /end AXIS_PTS
/begin CHARACTERISTIC FIRNLIGN "" VALUE 0x8FCE24 KwUb 255.0 kw_q1 0.00 255.0 FORMAT "%5.1" /end CHARACTERISTIC
/begin CHARACTERISTIC FKKVS "" MAP 0x8EA48E KfAxUbAyUbSstxUbSstyUwWUw 1.999969 fak_uw_b2 0.00 1.999969 FORMAT "%8.6"
 /begin AXIS_DESCR STD_AXIS nmot nmot_ub_q40 16 0.00 10200. FORMAT "%5.0" DEPOSIT ABSOLUTE /end AXIS_DESCR
 /begin AXIS_DESCR STD_AXIS tevfakge_w tinjection_sy 16 0.00 209.7120 FORMAT "%8.4" DEPOSIT ABSOLUTE /end AXIS_DESCR
/end CHARACTERISTIC
/begin CHARACTERISTIC FMSL "" VALUE 0x8E02CF KwUb 1.992 fak_ub_b2 0.00 1.992 FORMAT "%5.3" /end CHARACTERISTIC
/begin CHARACTERISTIC FMSL2 "" VALUE 0x8E02D0 KwUb 1.992 fak_ub_b2 0.00 1.992 FORMAT "%5.3" /end CHARACTERISTIC
/begin CHARACTERISTIC FMSLOFF "" VALUE 0x8E02D1 KwUb 0.9961 fak_ub_b1 0.00 0.9961 /end CHARACTERISTIC
/begin CHARACTERISTIC FMSRHOL "" CURVE 0x8E5C1C KlAUwSstUwWUw 1.999969 fak_uw_b2 0.00 1.999969 FORMAT "%8.6"
 /begin AXIS_DESCR STD_AXIS frhokor_w fak_uw_b4 4 0.00 3.999939 FORMAT "%8.6" DEPOSIT ABSOLUTE /end AXIS_DESCR
/end CHARACTERISTIC
/begin CHARACTERISTIC FMSTMOT "" CURVE 0x8E02D2 KlAUbSstUbWUb 1.992 fak_ub_b2 0.00 1.992 FORMAT "%5.3"
 /begin AXIS_DESCR STD_AXIS tmot temp_ub_q0p75_o48 8 -48.00 143.3 FORMAT "%5.1" DEPOSIT ABSOLUTE /end AXIS_DESCR
/end CHARACTERISTIC
/begin CHARACTERISTIC FNLMI0 "" VALUE 0x8FCE25 KwUb 7.969 fak_ub_b8 0.00 7.969 FORMAT "%5.3" /end CHARACTERISTIC
/begin CHARACTERISTIC FNLMI1 "" VALUE 0x8FCE26 KwUb 7.969 fak_ub_b8 0.00 7.969 FORMAT "%5.3" /end CHARACTERISTIC
/begin CHARACTERISTIC FNLMI2 "" VALUE 0x8FCE27 KwUb 7.969 fak_ub_b8 0.00 7.969 FORMAT "%5.3" /end CHARACTERISTIC
/begin CHARACTERISTIC FNWSKRA "" CURVE 0x8E3C16 KlAUbSstUbWUb 1.000 fak_ub_b2 0.00 1.000 FORMAT "%5.3"
 /begin AXIS_DESCR STD_AXIS wkrma zw_ub_qn0p75 3 -191.3 0.00 FORMAT "%5.1" DEPOSIT ABSOLUTE /end AXIS_DESCR
/end CHARACTERISTIC
/begin CHARACTERISTIC FNWSKRE "" CURVE 0x8E3B0A KlAUbSstUbWUb 1.000 fak_ub_b2 0.00 1.000 FORMAT "%5.3"
 /begin AXIS_DESCR STD_AXIS wkrma zw_ub_qn0p75 3 -191.3 0.00 FORMAT "%5.1" DEPOSIT ABSOLUTE /end AXIS_DESCR
/end CHARACTERISTIC
/begin CHARACTERISTIC FRLFSDP "" CURVE 0x8EA6C0 KlAUwSstSwWUw 1.999969 fak_uw_b2 0.00 1.999969 FORMAT "%8.6"
 /begin AXIS_DESCR STD_AXIS dpus_w p_sw_q0p078 11 -2560.000 2559.922 FORMAT "%8.3" DEPOSIT ABSOLUTE /end AXIS_DESCR
/end CHARACTERISTIC
/begin CHARACTERISTIC GANGNWLLPA "" VALUE 0x8E3C1D KwUb 255.0 dez 0.00 255.0 FORMAT "%5.1" /end CHARACTERISTIC
/begin CHARACTERISTIC IMLSLMNTMS "" CURVE 0x8E02E3 KlAUbSstUbWUb 0.9961 fak_ub_b1 0.00 0.9961
 /begin AXIS_DESCR STD_AXIS tmst temp_ub_q0p75_o48 4 -48.00 143.3 FORMAT "%5.1" DEPOSIT ABSOLUTE /end AXIS_DESCR
/end CHARACTERISTIC
/begin CHARACTERISTIC IMLSLMXTMS "" CURVE 0x8E02EC KlAUbSstUbWUb 0.9961 fak_ub_b1 0.00 0.9961
 /begin AXIS_DESCR STD_AXIS tmst temp_ub_q0p75_o48 4 -48.00 143.3 FORMAT "%5.1" DEPOSIT ABSOLUTE /end AXIS_DESCR
/end CHARACTERISTIC
/begin CHARACTERISTIC IMLSLSA "" VALUE 0x8E5C2E KwUw 4660.267 m_uw_b4660 0.00 4660.267 FORMAT "%8.3" /end CHARACTERISTIC
/begin CHARACTERISTIC IMLSLSE "" VALUE 0x8E5C30 KwUw 4660.267 m_uw_b4660 0.00 4660.267 FORMAT "%8.3" /end CHARACTERISTIC
/begin CHARACTERISTIC IPREFLSUB "" VALUE 0x8E3509 KwUb 15.00 dez 0.00 15.00 FORMAT "%5.2" /end CHARACTERISTIC
/begin CHARACTERISTIC IPREFLSUE "" VALUE 0x8E350A KwUb 15.00 dez 0.00 15.00 FORMAT "%5.2" /end CHARACTERISTIC
/begin CHARACTERISTIC ITNMXH "" VALUE 0x8EBEC2 KwUw 6553.500 t100msxs_uw_b6553p5 0.00 6553.500 FORMAT "%8.3" /end CHARACTERISTIC
/begin CHARACTERISTIC KFDMP "" MAP 0x8E334A GkfWUb 99.61 rel_ub_b99p6 0.00 99.61 FORMAT "%5.2"
 /begin AXIS_DESCR COM_AXIS wped relPED_ub_b100 8 0.00 100.0 FORMAT "%5.1" AXIS_PTS_REF SWP08MFUB /end AXIS_DESCR
 /begin AXIS_DESCR COM_AXIS nmot nmot_ub_q40 8 0.00 10200. FORMAT "%5.0" AXIS_PTS_REF SNM08MFUB /end AXIS_DESCR
/end CHARACTERISTIC
/begin CHARACTERISTIC KFDMT "" MAP 0x8E338A GkfWUb 99.61 rel_ub_b99p6 0.00 99.61 FORMAT "%5.2"
 /begin AXIS_DESCR COM_AXIS tmotmn temp_ub_q0p75_o48 8 -48.00 143.3 FORMAT "%5.1" AXIS_PTS_REF STM08MFUB /end AXIS_DESCR
 /begin AXIS_DESCR COM_AXIS nmot nmot_ub_q40 8 0.00 10200. FORMAT "%5.0" AXIS_PTS_REF SNM08MFUB /end AXIS_DESCR
/end CHARACTERISTIC
/begin CHARACTERISTIC KFDWNWSUE "" MAP 0x8EF2CC GkfWSw 511.9922 kw_sw_q0p0078 -256.0000 255.9922 FORMAT "%8.4"
 /begin AXIS_DESCR COM_AXIS nmot_w nmot_uw_q0p25 16 0.00 16383.75 FORMAT "%8.2" AXIS_PTS_REF SNM16NEUW /end AXIS_DESCR
 /begin AXIS_DESCR COM_AXIS rlnw_w rel_uw_q0p0234 16 0.00 1535.977 FORMAT "%8.3" AXIS_PTS_REF SRL16NEUW /end AXIS_DESCR
/end CHARACTERISTIC
/begin CHARACTERISTIC KFFMSML "" MAP 0x8E02F5 KfAxUbAyUbSstxUbSstyUbWUb 1.992 fak_ub_b2 0.00 1.992 FORMAT "%5.3"
 /begin AXIS_DESCR STD_AXIS nmot nmot_ub_q40 8 0.00 10200. FORMAT "%5.0" DEPOSIT ABSOLUTE /end AXIS_DESCR
 /begin AXIS_DESCR STD_AXIS rl rel_ub_q0p75 8 0.00 191.3 FORMAT "%5.1" DEPOSIT ABSOLUTE /end AXIS_DESCR
/end CHARACTERISTIC
/begin CHARACTERISTIC KFFNWA "" MAP 0x8E3A11 KfAxUbAyUbSstxUbSstyUbWUb 0.9961 fak_ub_b1 0.00 0.9961 /begin AXIS_DESCR STD_AXIS fnwua fak_ub_b1 6 0.00 0.9961 DEPOSIT ABSOLUTE /end AXIS_DESCR
 /begin AXIS_DESCR STD_AXIS rl rel_ub_q0p75 6 0.00 191.3 FORMAT "%5.1" DEPOSIT ABSOLUTE /end AXIS_DESCR
/end CHARACTERISTIC
/begin CHARACTERISTIC KFFNWE "" MAP 0x8E3A43 KfAxUbAyUbSstxUbSstyUbWUb 0.9961 fak_ub_b1 0.00 0.9961 /begin AXIS_DESCR STD_AXIS fnwue fak_ub_b1 6 0.00 0.9961 DEPOSIT ABSOLUTE /end AXIS_DESCR
 /begin AXIS_DESCR STD_AXIS rl rel_ub_q0p75 6 0.00 191.3 FORMAT "%5.1" DEPOSIT ABSOLUTE /end AXIS_DESCR
/end CHARACTERISTIC
/begin CHARACTERISTIC KFMOF "" MAP 0x8E33CA GkfWUb 99.61 rel_ub_b99p6 0.00 99.61 FORMAT "%5.2"
 /begin AXIS_DESCR COM_AXIS mizuvfil rel_ub_b99p6 8 0.00 99.61 FORMAT "%5.2" AXIS_PTS_REF SMO08MFUB /end AXIS_DESCR
 /begin AXIS_DESCR COM_AXIS nmot nmot_ub_q40 8 0.00 10200. FORMAT "%5.0" AXIS_PTS_REF SNM08MFUB /end AXIS_DESCR
/end CHARACTERISTIC
/begin CHARACTERISTIC KFNWKHA "" MAP 0x8F0020 GkfWSw 511.9922 kw_sw_q0p0078 -256.0000 255.9922 FORMAT "%8.4"
 /begin AXIS_DESCR COM_AXIS nmot_w nmot_uw_q0p25 16 0.00 16383.75 FORMAT "%8.2" AXIS_PTS_REF SNM16NAUW /end AXIS_DESCR
 /begin AXIS_DESCR COM_AXIS rlnw_w rel_uw_q0p0234 16 0.00 1535.977 FORMAT "%8.3" AXIS_PTS_REF SRL16NAUW /end AXIS_DESCR
/end CHARACTERISTIC
/begin CHARACTERISTIC KFNWKHE "" MAP 0x8EF4CC GkfWSw 511.9922 kw_sw_q0p0078 -256.0000 255.9922 FORMAT "%8.4"
 /begin AXIS_DESCR COM_AXIS nmot_w nmot_uw_q0p25 16 0.00 16383.75 FORMAT "%8.2" AXIS_PTS_REF SNM16NEUW /end AXIS_DESCR
 /begin AXIS_DESCR COM_AXIS rlnw_w rel_uw_q0p0234 8 0.00 1535.977 FORMAT "%8.3" AXIS_PTS_REF SRL08NEUW /end AXIS_DESCR
/end CHARACTERISTIC
/begin CHARACTERISTIC KFNWKHKA "" MAP 0x8F0220 GkfWSw 511.9922 kw_sw_q0p0078 -256.0000 255.9922 FORMAT "%8.4"
 /begin AXIS_DESCR COM_AXIS nmot_w nmot_uw_q0p25 16 0.00 16383.75 FORMAT "%8.2" AXIS_PTS_REF SNM16NAUW /end AXIS_DESCR
 /begin AXIS_DESCR COM_AXIS rlnw_w rel_uw_q0p0234 16 0.00 1535.977 FORMAT "%8.3" AXIS_PTS_REF SRL16NAUW /end AXIS_DESCR
/end CHARACTERISTIC
/begin CHARACTERISTIC KFNWKHKE "" MAP 0x8EF5CC GkfWSw 511.9922 kw_sw_q0p0078 -256.0000 255.9922 FORMAT "%8.4"
 /begin AXIS_DESCR COM_AXIS nmot_w nmot_uw_q0p25 16 0.00 16383.75 FORMAT "%8.2" AXIS_PTS_REF SNM16NEUW /end AXIS_DESCR
 /begin AXIS_DESCR COM_AXIS rlnw_w rel_uw_q0p0234 8 0.00 1535.977 FORMAT "%8.3" AXIS_PTS_REF SRL08NEUW /end AXIS_DESCR
/end CHARACTERISTIC
/begin CHARACTERISTIC KFNWKHLLA "" MAP 0x8F0420 GkfWSw 511.9922 kw_sw_q0p0078 -256.0000 255.9922 FORMAT "%8.4"
 /begin AXIS_DESCR COM_AXIS nmot_w nmot_uw_q0p25 5 0.00 16383.75 FORMAT "%8.2" AXIS_PTS_REF SNM05NAUW /end AXIS_DESCR
 /begin AXIS_DESCR COM_AXIS rlnw_w rel_uw_q0p0234 5 0.00 1535.977 FORMAT "%8.3" AXIS_PTS_REF SRL05NAUW /end AXIS_DESCR
/end CHARACTERISTIC
/begin CHARACTERISTIC KFNWKHLLE "" MAP 0x8EF6CC GkfWSw 511.9922 kw_sw_q0p0078 -256.0000 255.9922 FORMAT "%8.4"
 /begin AXIS_DESCR COM_AXIS nmot_w nmot_uw_q0p25 5 0.00 16383.75 FORMAT "%8.2" AXIS_PTS_REF SNM05NEUW /end AXIS_DESCR
 /begin AXIS_DESCR COM_AXIS rlnw_w rel_uw_q0p0234 5 0.00 1535.977 FORMAT "%8.3" AXIS_PTS_REF SRL05NEUW /end AXIS_DESCR
/end CHARACTERISTIC
/begin CHARACTERISTIC KFNWKHLLKA "" MAP 0x8F0452 GkfWSw 511.9922 kw_sw_q0p0078 -256.0000 255.9922 FORMAT "%8.4"
 /begin AXIS_DESCR COM_AXIS nmot_w nmot_uw_q0p25 5 0.00 16383.75 FORMAT "%8.2" AXIS_PTS_REF SNM05NAUW /end AXIS_DESCR
 /begin AXIS_DESCR COM_AXIS rlnw_w rel_uw_q0p0234 5 0.00 1535.977 FORMAT "%8.3" AXIS_PTS_REF SRL05NAUW /end AXIS_DESCR
/end CHARACTERISTIC
/begin CHARACTERISTIC KFNWKHLLKE "" MAP 0x8EF6FE GkfWSw 511.9922 kw_sw_q0p0078 -256.0000 255.9922 FORMAT "%8.4"
 /begin AXIS_DESCR COM_AXIS nmot_w nmot_uw_q0p25 5 0.00 16383.75 FORMAT "%8.2" AXIS_PTS_REF SNM05NEUW /end AXIS_DESCR
 /begin AXIS_DESCR COM_AXIS rlnw_w rel_uw_q0p0234 5 0.00 1535.977 FORMAT "%8.3" AXIS_PTS_REF SRL05NEUW /end AXIS_DESCR
/end CHARACTERISTIC
/begin CHARACTERISTIC KFNWKRA "" MAP 0x8F0484 GkfWSw 511.9922 kw_sw_q0p0078 -256.0000 255.9922 FORMAT "%8.4"
 /begin AXIS_DESCR COM_AXIS nmot_w nmot_uw_q0p25 16 0.00 16383.75 FORMAT "%8.2" AXIS_PTS_REF SNM16NAUW /end AXIS_DESCR
 /begin AXIS_DESCR COM_AXIS rlnw_w rel_uw_q0p0234 16 0.00 1535.977 FORMAT "%8.3" AXIS_PTS_REF SRL16NAUW /end AXIS_DESCR
/end CHARACTERISTIC
/begin CHARACTERISTIC KFNWKRE "" MAP 0x8EF730 GkfWSw 511.9922 kw_sw_q0p0078 -256.0000 255.9922 FORMAT "%8.4"
 /begin AXIS_DESCR COM_AXIS nmot_w nmot_uw_q0p25 16 0.00 16383.75 FORMAT "%8.2" AXIS_PTS_REF SNM16NEUW /end AXIS_DESCR
 /begin AXIS_DESCR COM_AXIS rlnw_w rel_uw_q0p0234 8 0.00 1535.977 FORMAT "%8.3" AXIS_PTS_REF SRL08NEUW /end AXIS_DESCR
/end CHARACTERISTIC
/begin CHARACTERISTIC KFNWLLA "" MAP 0x8F0684 GkfWSw 511.9922 kw_sw_q0p0078 -256.0000 255.9922 FORMAT "%8.4"
 /begin AXIS_DESCR COM_AXIS nmot_w nmot_uw_q0p25 5 0.00 16383.75 FORMAT "%8.2" AXIS_PTS_REF SNM05NAUW /end AXIS_DESCR
 /begin AXIS_DESCR COM_AXIS rlnw_w rel_uw_q0p0234 5 0.00 1535.977 FORMAT "%8.3" AXIS_PTS_REF SRL05NAUW /end AXIS_DESCR
/end CHARACTERISTIC
/begin CHARACTERISTIC KFNWLLE "" MAP 0x8EF830 GkfWSw 511.9922 kw_sw_q0p0078 -256.0000 255.9922 FORMAT "%8.4"
 /begin AXIS_DESCR COM_AXIS nmot_w nmot_uw_q0p25 5 0.00 16383.75 FORMAT "%8.2" AXIS_PTS_REF SNM05NEUW /end AXIS_DESCR
 /begin AXIS_DESCR COM_AXIS rlnw_w rel_uw_q0p0234 5 0.00 1535.977 FORMAT "%8.3" AXIS_PTS_REF SRL05NEUW /end AXIS_DESCR
/end CHARACTERISTIC
/begin CHARACTERISTIC KFNWLLHA "" MAP 0x8F06B6 GkfWSw 511.9922 kw_sw_q0p0078 -256.0000 255.9922 FORMAT "%8.4"
 /begin AXIS_DESCR COM_AXIS nmot_w nmot_uw_q0p25 5 0.00 16383.75 FORMAT "%8.2" AXIS_PTS_REF SNM05NAUW /end AXIS_DESCR
 /begin AXIS_DESCR COM_AXIS rlnw_w rel_uw_q0p0234 5 0.00 1535.977 FORMAT "%8.3" AXIS_PTS_REF SRL05NAUW /end AXIS_DESCR
/end CHARACTERISTIC
/begin CHARACTERISTIC KFNWSA "" MAP 0x8F06E8 GkfWSw 511.9922 kw_sw_q0p0078 -256.0000 255.9922 FORMAT "%8.4"
 /begin AXIS_DESCR COM_AXIS nmot_w nmot_uw_q0p25 16 0.00 16383.75 FORMAT "%8.2" AXIS_PTS_REF SNM16NAUW /end AXIS_DESCR
 /begin AXIS_DESCR COM_AXIS rlnw_w rel_uw_q0p0234 16 0.00 1535.977 FORMAT "%8.3" AXIS_PTS_REF SRL16NAUW /end AXIS_DESCR
/end CHARACTERISTIC
/begin CHARACTERISTIC KFNWSE "" MAP 0x8EF862 GkfWSw 511.9922 kw_sw_q0p0078 -256.0000 255.9922 FORMAT "%8.4"
 /begin AXIS_DESCR COM_AXIS nmot_w nmot_uw_q0p25 16 0.00 16383.75 FORMAT "%8.2" AXIS_PTS_REF SNM16NEUW /end AXIS_DESCR
 /begin AXIS_DESCR COM_AXIS rlnw_w rel_uw_q0p0234 16 0.00 1535.977 FORMAT "%8.3" AXIS_PTS_REF SRL16NEUW /end AXIS_DESCR
/end CHARACTERISTIC
/begin CHARACTERISTIC KFNWSHA "" MAP 0x8F08E8 GkfWSw 511.9922 kw_sw_q0p0078 -256.0000 255.9922 FORMAT "%8.4"
 /begin AXIS_DESCR COM_AXIS nmot_w nmot_uw_q0p25 16 0.00 16383.75 FORMAT "%8.2" AXIS_PTS_REF SNM16NAUW /end AXIS_DESCR
 /begin AXIS_DESCR COM_AXIS rlnw_w rel_uw_q0p0234 16 0.00 1535.977 FORMAT "%8.3" AXIS_PTS_REF SRL16NAUW /end AXIS_DESCR
/end CHARACTERISTIC
/begin CHARACTERISTIC KFNWTMA "" MAP 0x8E3C1E KfAxUbAyUbSstxUbSstyUbWUb 1.992 fak_ub_b2 0.00 1.992 FORMAT "%5.3"
 /begin AXIS_DESCR STD_AXIS tmot temp_ub_q0p75_o48 4 -48.00 143.3 FORMAT "%5.1" DEPOSIT ABSOLUTE /end AXIS_DESCR
 /begin AXIS_DESCR STD_AXIS tmst temp_ub_q0p75_o48 4 -48.00 143.3 FORMAT "%5.1" DEPOSIT ABSOLUTE /end AXIS_DESCR
/end CHARACTERISTIC
/begin CHARACTERISTIC KFNWTME "" MAP 0x8E3B11 KfAxUbAyUbSstxUbSstyUbWUb 1.992 fak_ub_b2 0.00 1.992 FORMAT "%5.3"
 /begin AXIS_DESCR STD_AXIS tmot temp_ub_q0p75_o48 4 -48.00 143.3 FORMAT "%5.1" DEPOSIT ABSOLUTE /end AXIS_DESCR
 /begin AXIS_DESCR STD_AXIS tmst temp_ub_q0p75_o48 4 -48.00 143.3 FORMAT "%5.1" DEPOSIT ABSOLUTE /end AXIS_DESCR
/end CHARACTERISTIC
/begin CHARACTERISTIC KFNWWLA "" MAP 0x8F0AE8 GkfWSw 511.9922 kw_sw_q0p0078 -256.0000 255.9922 FORMAT "%8.4"
 /begin AXIS_DESCR COM_AXIS nmot_w nmot_uw_q0p25 16 0.00 16383.75 FORMAT "%8.2" AXIS_PTS_REF SNM16NAUW /end AXIS_DESCR
 /begin AXIS_DESCR COM_AXIS rlnw_w rel_uw_q0p0234 16 0.00 1535.977 FORMAT "%8.3" AXIS_PTS_REF SRL16NAUW /end AXIS_DESCR
/end CHARACTERISTIC
/begin CHARACTERISTIC KFNWWLE "" MAP 0x8EFA62 GkfWSw 511.9922 kw_sw_q0p0078 -256.0000 255.9922 FORMAT "%8.4"
 /begin AXIS_DESCR COM_AXIS nmot_w nmot_uw_q0p25 16 0.00 16383.75 FORMAT "%8.2" AXIS_PTS_REF SNM16NEUW /end AXIS_DESCR
 /begin AXIS_DESCR COM_AXIS rlnw_w rel_uw_q0p0234 16 0.00 1535.977 FORMAT "%8.3" AXIS_PTS_REF SRL16NEUW /end AXIS_DESCR
/end CHARACTERISTIC
/begin CHARACTERISTIC KFNWWLLA "" MAP 0x8F0CE8 GkfWSw 511.9922 kw_sw_q0p0078 -256.0000 255.9922 FORMAT "%8.4"
 /begin AXIS_DESCR COM_AXIS nmot_w nmot_uw_q0p25 5 0.00 16383.75 FORMAT "%8.2" AXIS_PTS_REF SNM05NAUW /end AXIS_DESCR
 /begin AXIS_DESCR COM_AXIS rlnw_w rel_uw_q0p0234 5 0.00 1535.977 FORMAT "%8.3" AXIS_PTS_REF SRL05NAUW /end AXIS_DESCR
/end CHARACTERISTIC
/begin CHARACTERISTIC KFNWWLLE "" MAP 0x8EFC62 GkfWSw 511.9922 kw_sw_q0p0078 -256.0000 255.9922 FORMAT "%8.4"
 /begin AXIS_DESCR COM_AXIS nmot_w nmot_uw_q0p25 5 0.00 16383.75 FORMAT "%8.2" AXIS_PTS_REF SNM05NEUW /end AXIS_DESCR
 /begin AXIS_DESCR COM_AXIS rlnw_w rel_uw_q0p0234 5 0.00 1535.977 FORMAT "%8.3" AXIS_PTS_REF SRL05NEUW /end AXIS_DESCR
/end CHARACTERISTIC
/begin CHARACTERISTIC KFNWWUA "" MAP 0x8EED46 KfAxUwAyUwSstxUwSstyUwWSw 511.9922 kw_sw_q0p0078 -256.0000 255.9922 FORMAT "%8.4"
 /begin AXIS_DESCR STD_AXIS nmot_w nmot_uw_q0p25 18 0.00 16383.75 FORMAT "%8.2" DEPOSIT ABSOLUTE /end AXIS_DESCR
 /begin AXIS_DESCR STD_AXIS rlnw_w rel_uw_q0p0234 16 0.00 1535.977 FORMAT "%8.3" DEPOSIT ABSOLUTE /end AXIS_DESCR
/end CHARACTERISTIC
/begin CHARACTERISTIC KFNWWUE "" MAP 0x8EEFCE KfAxUwAyUwSstxUwSstyUwWSw 511.9922 kw_sw_q0p0078 -256.0000 255.9922 FORMAT "%8.4"
 /begin AXIS_DESCR STD_AXIS nmot_w nmot_uw_q0p25 18 0.00 16383.75 FORMAT "%8.2" DEPOSIT ABSOLUTE /end AXIS_DESCR
 /begin AXIS_DESCR STD_AXIS rlnw_w rel_uw_q0p0234 16 0.00 1535.977 FORMAT "%8.3" DEPOSIT ABSOLUTE /end AXIS_DESCR
/end CHARACTERISTIC
/begin CHARACTERISTIC KFPBRKLM "" MAP 0x8E97E4 KfAxUwAyUwSstxSwSstyUwWUw 1.999969 fak_uw_b2 0.00 1.999969 FORMAT "%8.6"
 /begin AXIS_DESCR STD_AXIS wdkba_w relDK_q0p02441 12 -800.0000 799.9756 FORMAT "%8.4" DEPOSIT ABSOLUTE /end AXIS_DESCR
 /begin AXIS_DESCR STD_AXIS nmot_w nmot_uw_q0p25 12 0.00 16383.75 FORMAT "%8.2" DEPOSIT ABSOLUTE /end AXIS_DESCR
/end CHARACTERISTIC
/begin CHARACTERISTIC KFPBRKNWLM "" MAP 0x8E9938 KfAxUwAyUwSstxSwSstyUwWUw 1.999969 fak_uw_b2 0.00 1.999969 FORMAT "%8.6"
 /begin AXIS_DESCR STD_AXIS wdkba_w relDK_q0p02441 12 -800.0000 799.9756 FORMAT "%8.4" DEPOSIT ABSOLUTE /end AXIS_DESCR
 /begin AXIS_DESCR STD_AXIS nmot_w nmot_uw_q0p25 12 0.00 16383.75 FORMAT "%8.2" DEPOSIT ABSOLUTE /end AXIS_DESCR
/end CHARACTERISTIC
/begin CHARACTERISTIC KFPZU "" MAP 0x8E340A GkfWUb 99.61 rel_ub_b99p6 0.00 99.61 FORMAT "%5.2"
 /begin AXIS_DESCR COM_AXIS wped relPED_ub_b100 8 0.00 100.0 FORMAT "%5.1" AXIS_PTS_REF SWP08MFUB /end AXIS_DESCR
 /begin AXIS_DESCR COM_AXIS nmot nmot_ub_q40 8 0.00 10200. FORMAT "%5.0" AXIS_PTS_REF SNM08MFUB /end AXIS_DESCR
/end CHARACTERISTIC
/begin CHARACTERISTIC KFWNWSAPA "" MAP 0x8F0D1A KfAxUwAyUwSstxUwSstyUwWSw 511.9922 kw_sw_q0p0078 -256.0000 255.9922 FORMAT "%8.4"
 /begin AXIS_DESCR STD_AXIS nmot_w nmot_uw_q0p25 12 0.00 16383.75 FORMAT "%8.2" DEPOSIT ABSOLUTE /end AXIS_DESCR
 /begin AXIS_DESCR STD_AXIS rk_w rel_uw_b3072 8 0.00 3071.953 FORMAT "%8.3" DEPOSIT ABSOLUTE /end AXIS_DESCR
/end CHARACTERISTIC
/begin CHARACTERISTIC KFWNWSAPE "" MAP 0x8EFC94 KfAxUwAyUwSstxUwSstyUwWSw 511.9922 kw_sw_q0p0078 -256.0000 255.9922 FORMAT "%8.4"
 /begin AXIS_DESCR STD_AXIS nmot_w nmot_uw_q0p25 12 0.00 16383.75 FORMAT "%8.2" DEPOSIT ABSOLUTE /end AXIS_DESCR
 /begin AXIS_DESCR STD_AXIS rk_w rel_uw_b3072 8 0.00 3071.953 FORMAT "%8.3" DEPOSIT ABSOLUTE /end AXIS_DESCR
/end CHARACTERISTIC
/begin CHARACTERISTIC KINMXNL "" VALUE 0x8E32B4 KwUb 4.864 relnmot_q0p01907 0.00 4.864 FORMAT "%5.3" /end CHARACTERISTIC
/begin CHARACTERISTIC KINMXRLG "" MAP 0x8E32B5 GkfWUb 4.864 relnmot_q0p01907 0.00 4.864 FORMAT "%5.3"
 /begin AXIS_DESCR COM_AXIS rl rel_ub_q0p75 8 0.00 191.3 FORMAT "%5.1" AXIS_PTS_REF SRL08NXUB /end AXIS_DESCR
 /begin AXIS_DESCR COM_AXIS gangi dez 8 0.00 255.0 FORMAT "%5.1" AXIS_PTS_REF SGA08MDUB /end AXIS_DESCR
/end CHARACTERISTIC
/begin CHARACTERISTIC KLDMMX "" CURVE 0x8E344A GklWUb 99.61 rel_ub_b99p6 0.00 99.61 FORMAT "%5.2"
 /begin AXIS_DESCR COM_AXIS nmot nmot_ub_q40 8 0.00 10200. FORMAT "%5.0" AXIS_PTS_REF SNM08MFUB /end AXIS_DESCR
/end CHARACTERISTIC
/begin CHARACTERISTIC KLDTPH "" CURVE 0x8FCE28 FklWUb 0.9961 fak_q0p0039 0.00 0.9961
 /begin AXIS_DESCR FIX_AXIS dtsegph_w t5usxus_q5 16 -40960.00 35840.00 FORMAT "%8.2" FIX_AXIS_PAR -8192 10 16 /end AXIS_DESCR
/end CHARACTERISTIC
/begin CHARACTERISTIC KLDTPHST "" CURVE 0x8FCE38 FklWUb 0.9961 fak_q0p0039 0.00 0.9961
 /begin AXIS_DESCR FIX_AXIS dtsegph_w t5usxus_q5 16 -40960.00 35840.00 FORMAT "%8.2" FIX_AXIS_PAR -8192 10 16 /end AXIS_DESCR
/end CHARACTERISTIC
/begin CHARACTERISTIC KLDYNCOR "" CURVE 0x8E7D64 KlAUbSstUbWUw 60000.00 t5usxus_q5 0.00 60000.00 FORMAT "%8.2"
 /begin AXIS_DESCR STD_AXIS tmot temp_ub_q0p75_o48 4 -48.00 143.3 FORMAT "%5.1" DEPOSIT ABSOLUTE /end AXIS_DESCR
/end CHARACTERISTIC
/begin CHARACTERISTIC KLLLRZU "" CURVE 0x8E3452 GklWUb 99.61 rel_ub_b99p6 0.00 99.61 FORMAT "%5.2"
 /begin AXIS_DESCR COM_AXIS nmot nmot_ub_q40 8 0.00 10200. FORMAT "%5.0" AXIS_PTS_REF SNM08MFUB /end AXIS_DESCR
/end CHARACTERISTIC
/begin CHARACTERISTIC KLMIMAX "" CURVE 0x8E345A GklWUb 99.61 rel_ub_b99p6 0.00 99.61 FORMAT "%5.2"
 /begin AXIS_DESCR COM_AXIS nmot nmot_ub_q40 8 0.00 10200. FORMAT "%5.0" AXIS_PTS_REF SNM08MFUB /end AXIS_DESCR
/end CHARACTERISTIC
/begin CHARACTERISTIC KLMIMIN "" CURVE 0x8EBF00 GklWUw 99.99847 rel_uw_b100 0.00 99.99847 FORMAT "%8.5"
 /begin AXIS_DESCR COM_AXIS nmot nmot_ub_q40 8 0.00 10200. FORMAT "%5.0" AXIS_PTS_REF SNM08MFUB /end AXIS_DESCR
/end CHARACTERISTIC
/begin CHARACTERISTIC KLMZUMN "" CURVE 0x8E3462 GklWUb 99.61 rel_ub_b99p6 0.00 99.61 FORMAT "%5.2"
 /begin AXIS_DESCR COM_AXIS nmot nmot_ub_q40 8 0.00 10200. FORMAT "%5.0" AXIS_PTS_REF SNM08MFUB /end AXIS_DESCR
/end CHARACTERISTIC
/begin CHARACTERISTIC KLNLPHN "" CURVE 0x8FCE48 FklWSb 15.94 kw_q0p0625 -8.000 7.938 FORMAT "%5.3"
 /begin AXIS_DESCR FIX_AXIS nmot nmot_ub_q40 16 0.00 4800. FORMAT "%5.0" FIX_AXIS_PAR 0 3 16 /end AXIS_DESCR
/end CHARACTERISTIC
/begin CHARACTERISTIC KLTNMXPR "" CURVE 0x8E3337 FklWUb 5.100 t20msxs_ub_b5p1 0.00 5.100 FORMAT "%5.3"
 /begin AXIS_DESCR FIX_AXIS gangi dez 8 0.00 7.000 FORMAT "%5.3" FIX_AXIS_PAR 0 0 8 /end AXIS_DESCR
/end CHARACTERISTIC
/begin CHARACTERISTIC KLTNRDE "" CURVE 0x8E0902 KlAUbSstUbWUb 255.0 t1msxms_q1 0.00 255.0 FORMAT "%5.1"
 /begin AXIS_DESCR STD_AXIS tmot temp_ub_q0p75_o48 3 -48.00 143.3 FORMAT "%5.1" DEPOSIT ABSOLUTE /end AXIS_DESCR
/end CHARACTERISTIC
/begin CHARACTERISTIC KLTOELNWH "" CURVE 0x8F0E06 KlAUwSstUwWUw 1535.977 temp_q0p0234_o273 -273.1500 1262.827 FORMAT "%8.3"
 /begin AXIS_DESCR STD_AXIS kmstand_w s_q6_km 2 0.00 393210.0 FORMAT "%8.1" DEPOSIT ABSOLUTE /end AXIS_DESCR
/end CHARACTERISTIC
/begin CHARACTERISTIC KLTVNW "" CURVE 0x8E3B2B KlAUbSstUbWUb 12.75 t50msxs_q0p05 0.00 12.75 FORMAT "%5.2"
 /begin AXIS_DESCR STD_AXIS tmot temp_ub_q0p75_o48 6 -48.00 143.3 FORMAT "%5.1" DEPOSIT ABSOLUTE /end AXIS_DESCR
/end CHARACTERISTIC
/begin CHARACTERISTIC KLWNWI "" CURVE 0x8FCE58 FklWUb 0.9961 fak_q0p0039 0.00 0.9961
 /begin AXIS_DESCR FIX_AXIS wnwix_w kw_sw_b128 16 -127.9961 112.0039 FORMAT "%8.4" FIX_AXIS_PAR -32767 12 16 /end AXIS_DESCR
/end CHARACTERISTIC
/begin CHARACTERISTIC KMITIBGR "" VALUE 0x8E1A6D KwUb 76.00 rkti_k_sy 0.00 76.00 FORMAT "%5.2" /end CHARACTERISTIC
/begin CHARACTERISTIC KNLSYN "" VALUE 0x8FCE68 KwUb 7.969 fak_ub_b8 0.00 7.969 FORMAT "%5.3" /end CHARACTERISTIC
/begin CHARACTERISTIC KRKTE "" VALUE 0x8EA6EE KwUw 8.738000 rkti11_sy 0.00 8.738000 FORMAT "%8.6" /end CHARACTERISTIC
/begin CHARACTERISTIC KTNWSABGKA "" MAP 0x8E3C48 GkfWUb 2.54000 zk10msxs_ub_b2p55 0.0100000 2.55000 FORMAT "%7.5"
 /begin AXIS_DESCR COM_AXIS nmot nmot_ub_q40 5 0.00 10200. FORMAT "%5.0" AXIS_PTS_REF SNM05NWUB /end AXIS_DESCR
 /begin AXIS_DESCR COM_AXIS tmot temp_ub_q0p75_o48 5 -48.00 143.3 FORMAT "%5.1" AXIS_PTS_REF STM05NWUB /end AXIS_DESCR
/end CHARACTERISTIC
/begin CHARACTERISTIC KTNWSABGKE "" MAP 0x8E3B46 GkfWUb 2.54000 zk10msxs_ub_b2p55 0.0100000 2.55000 FORMAT "%7.5"
 /begin AXIS_DESCR COM_AXIS nmot nmot_ub_q40 5 0.00 10200. FORMAT "%5.0" AXIS_PTS_REF SNM05NWUB /end AXIS_DESCR
 /begin AXIS_DESCR COM_AXIS tmot temp_ub_q0p75_o48 5 -48.00 143.3 FORMAT "%5.1" AXIS_PTS_REF STM05NWUB /end AXIS_DESCR
/end CHARACTERISTIC
/begin CHARACTERISTIC KTNWSNABGA "" MAP 0x8E3C61 GkfWUb 2.54000 zk10msxs_ub_b2p55 0.0100000 2.55000 FORMAT "%7.5"
 /begin AXIS_DESCR COM_AXIS nmot nmot_ub_q40 5 0.00 10200. FORMAT "%5.0" AXIS_PTS_REF SNM05NWUB /end AXIS_DESCR
 /begin AXIS_DESCR COM_AXIS tmot temp_ub_q0p75_o48 5 -48.00 143.3 FORMAT "%5.1" AXIS_PTS_REF STM05NWUB /end AXIS_DESCR
/end CHARACTERISTIC
/begin CHARACTERISTIC KTNWSNABGE "" MAP 0x8E3B5F GkfWUb 2.54000 zk10msxs_ub_b2p55 0.0100000 2.55000 FORMAT "%7.5"
 /begin AXIS_DESCR COM_AXIS nmot nmot_ub_q40 5 0.00 10200. FORMAT "%5.0" AXIS_PTS_REF SNM05NWUB /end AXIS_DESCR
 /begin AXIS_DESCR COM_AXIS tmot temp_ub_q0p75_o48 5 -48.00 143.3 FORMAT "%5.1" AXIS_PTS_REF STM05NWUB /end AXIS_DESCR
/end CHARACTERISTIC
/begin CHARACTERISTIC KTNWSPABGA "" MAP 0x8E3C7A GkfWUb 2.54000 zk10msxs_ub_b2p55 0.0100000 2.55000 FORMAT "%7.5"
 /begin AXIS_DESCR COM_AXIS nmot nmot_ub_q40 5 0.00 10200. FORMAT "%5.0" AXIS_PTS_REF SNM05NWUB /end AXIS_DESCR
 /begin AXIS_DESCR COM_AXIS tmot temp_ub_q0p75_o48 5 -48.00 143.3 FORMAT "%5.1" AXIS_PTS_REF STM05NWUB /end AXIS_DESCR
/end CHARACTERISTIC
/begin CHARACTERISTIC KTNWSPABGE "" MAP 0x8E3B78 GkfWUb 2.54000 zk10msxs_ub_b2p55 0.0100000 2.55000 FORMAT "%7.5"
 /begin AXIS_DESCR COM_AXIS nmot nmot_ub_q40 5 0.00 10200. FORMAT "%5.0" AXIS_PTS_REF SNM05NWUB /end AXIS_DESCR
 /begin AXIS_DESCR COM_AXIS tmot temp_ub_q0p75_o48 5 -48.00 143.3 FORMAT "%5.1" AXIS_PTS_REF STM05NWUB /end AXIS_DESCR
/end CHARACTERISTIC
/begin CHARACTERISTIC LAMSAUF "" VALUE 0x8EA7AE KwUw 15.99976 fak_uw_b16 0.00 15.99976 FORMAT "%8.5" /end CHARACTERISTIC
/begin CHARACTERISTIC LAMSAUM "" VALUE 0x8EA7B0 KwUw 15.99976 fak_uw_b16 0.00 15.99976 FORMAT "%8.5" /end CHARACTERISTIC
/begin CHARACTERISTIC MDIMX "" VALUE 0x8FD24C KwUb 99.61 rel_ub_b99p6 0.00 99.61 FORMAT "%5.2" /end CHARACTERISTIC
/begin CHARACTERISTIC MLSLMX "" VALUE 0x8E5C32 KwUw 6553.500 m_q0p1 0.00 6553.500 FORMAT "%8.3" /end CHARACTERISTIC
/begin CHARACTERISTIC MSLUB "" CURVE 0x8E5C34 KlAUwSstUwWUw 102.3984 m_uw_b102p4 0.00 102.3984 FORMAT "%8.4"
 /begin AXIS_DESCR STD_AXIS ubsqf_w spg_q0p00039 8 0.00 25.59961 FORMAT "%8.5" DEPOSIT ABSOLUTE /end AXIS_DESCR
/end CHARACTERISTIC
/begin CHARACTERISTIC MXNLFEHL "" VALUE 0x8FCE69 KwUb 8.000 dez 0.00 8.000 FORMAT "%5.3" /end CHARACTERISTIC
/begin CHARACTERISTIC MXSHKA "" VALUE 0x8E3AF5 KwUb 255.0 dez 0.00 255.0 FORMAT "%5.1" /end CHARACTERISTIC
/begin CHARACTERISTIC MXSHKE "" VALUE 0x8E3AF6 KwUb 255.0 dez 0.00 255.0 FORMAT "%5.1" /end CHARACTERISTIC
/begin CHARACTERISTIC MZFFIL "" VALUE 0x8FEB84 KwUw 655.34999985 zk10msxs_uw_b655 0.010000152590 655.36000000 FORMAT "%12.8" /end CHARACTERISTIC
/begin CHARACTERISTIC MZFTV "" VALUE 0x8FEB86 KwUw 327.67000000 tz10msxs_uw_b327p68 0.010000000000 327.68000000 FORMAT "%12.8" /end CHARACTERISTIC
/begin CHARACTERISTIC NFANWS "" VALUE 0x8E3AFD KwUb 10200. nmot_ub_q40 0.00 10200. FORMAT "%5.0" /end CHARACTERISTIC
/begin CHARACTERISTIC NGNWLLNA "" VALUE 0x8FD281 KwSb 25500. nmotg_sb_q100 -12800. 12700. FORMAT "%5.0" /end CHARACTERISTIC
/begin CHARACTERISTIC NMAX "" VALUE 0x8FEB82 KwUw 16383.75 nmot_uw_q0p25 0.00 16383.75 FORMAT "%8.2" /end CHARACTERISTIC
/begin CHARACTERISTIC NMAXDV "" VALUE 0x8EBEC4 KwUw 16383.75 nmot_uw_q0p25 0.00 16383.75 FORMAT "%8.2" /end CHARACTERISTIC
/begin CHARACTERISTIC NMAXDVG "" CURVE 0x8EBEC6 FklWUw 16383.75 nmot_uw_q0p25 0.00 16383.75 FORMAT "%8.2"
 /begin AXIS_DESCR FIX_AXIS gangi dez 8 0.00 7.000 FORMAT "%5.3" FIX_AXIS_PAR 0 0 8 /end AXIS_DESCR
/end CHARACTERISTIC
/begin CHARACTERISTIC NMAXDZ "" VALUE 0x8EBED6 KwUw 16383.75 nmot_uw_q0p25 0.00 16383.75 FORMAT "%8.2" /end CHARACTERISTIC
/begin CHARACTERISTIC NMAXGA "" CURVE 0x8EBED8 FklWUw 16383.75 nmot_uw_q0p25 0.00 16383.75 FORMAT "%8.2"
 /begin AXIS_DESCR FIX_AXIS gangi dez 8 0.00 7.000 FORMAT "%5.3" FIX_AXIS_PAR 0 0 8 /end AXIS_DESCR
/end CHARACTERISTIC
/begin CHARACTERISTIC NMAXKR "" VALUE 0x8EBEE8 KwUw 16383.75 nmot_uw_q0p25 0.00 16383.75 FORMAT "%8.2" /end CHARACTERISTIC
/begin CHARACTERISTIC NMAXNL "" VALUE 0x8EBEEA KwUw 16383.75 nmot_uw_q0p25 0.00 16383.75 FORMAT "%8.2" /end CHARACTERISTIC
/begin CHARACTERISTIC NMAXOGGA "" CURVE 0x8EBEEC FklWUw 16383.75 nmot_uw_q0p25 0.00 16383.75 FORMAT "%8.2"
 /begin AXIS_DESCR FIX_AXIS gangi dez 8 0.00 7.000 FORMAT "%5.3" FIX_AXIS_PAR 0 0 8 /end AXIS_DESCR
/end CHARACTERISTIC
/begin CHARACTERISTIC NMKFNWLLA "" VALUE 0x8F0E10 KwUw 16383.75 nmot_uw_q0p25 0.00 16383.75 FORMAT "%8.2" /end CHARACTERISTIC
/begin CHARACTERISTIC NMKFNWLLE "" VALUE 0x8EFD80 KwUw 16383.75 nmot_uw_q0p25 0.00 16383.75 FORMAT "%8.2" /end CHARACTERISTIC
/begin CHARACTERISTIC NMOTRDE "" VALUE 0x8FCE04 KwUb 2550. nmot_ub_q10 0.00 2550. FORMAT "%5.0" /end CHARACTERISTIC
/begin CHARACTERISTIC NMXPNL "" VALUE 0x8E32F5 KwUb 0.7782 relnmot_q0p003052 0.00 0.7782 /end CHARACTERISTIC
/begin CHARACTERISTIC NMXPRLG "" MAP 0x8E32F6 GkfWUb 0.7782 relnmot_q0p003052 0.00 0.7782
 /begin AXIS_DESCR COM_AXIS rl rel_ub_q0p75 8 0.00 191.3 FORMAT "%5.1" AXIS_PTS_REF SRL08NXUB /end AXIS_DESCR
 /begin AXIS_DESCR COM_AXIS gangi dez 8 0.00 255.0 FORMAT "%5.1" AXIS_PTS_REF SGA08MDUB /end AXIS_DESCR
/end CHARACTERISTIC
/begin CHARACTERISTIC NNWSHKMN "" VALUE 0x8FD282 KwUb 10200. nmot_ub_q40 0.00 10200. FORMAT "%5.0" /end CHARACTERISTIC
/begin CHARACTERISTIC NNWSHKMX "" VALUE 0x8FD283 KwUb 10200. nmot_ub_q40 0.00 10200. FORMAT "%5.0" /end CHARACTERISTIC
/begin CHARACTERISTIC NPHERKMN "" VALUE 0x8FCE11 KwUb 10200. nmot_ub_q40 0.00 10200. FORMAT "%5.0" /end CHARACTERISTIC
/begin CHARACTERISTIC NPHERKMX "" VALUE 0x8FCE12 KwUb 10200. nmot_ub_q40 0.00 10200. FORMAT "%5.0" /end CHARACTERISTIC
/begin CHARACTERISTIC NPHINVMN "" VALUE 0x8FCE13 KwUb 10200. nmot_ub_q40 0.00 10200. FORMAT "%5.0" /end CHARACTERISTIC
/begin CHARACTERISTIC NPHINVMX "" VALUE 0x8FCE14 KwUb 10200. nmot_ub_q40 0.00 10200. FORMAT "%5.0" /end CHARACTERISTIC
/begin CHARACTERISTIC NSTART "" VALUE 0x8FD255 KwUb 10200. nmot_ub_q40 0.00 10200. FORMAT "%5.0" /end CHARACTERISTIC
/begin CHARACTERISTIC NSTEND "" VALUE 0x8FD256 KwUb 10200. nmot_ub_q40 0.00 10200. FORMAT "%5.0" /end CHARACTERISTIC
/begin CHARACTERISTIC NSWO1 "" VALUE 0x8E004C KwUb 10200. nmot_ub_q40 0.00 10200. FORMAT "%5.0" /end CHARACTERISTIC
/begin CHARACTERISTIC NSWO2 "" VALUE 0x8E004D KwUb 10200. nmot_ub_q40 0.00 10200. FORMAT "%5.0" /end CHARACTERISTIC
/begin CHARACTERISTIC NWTMKHA "" CURVE 0x8E3C38 KlAUbSstUbWUb 1.992 fak_ub_b2 0.00 1.992 FORMAT "%5.3"
 /begin AXIS_DESCR STD_AXIS tmst temp_ub_q0p75_o48 6 -48.00 143.3 FORMAT "%5.1" DEPOSIT ABSOLUTE /end AXIS_DESCR
/end CHARACTERISTIC
/begin CHARACTERISTIC NWTMKHE "" CURVE 0x8E3B38 KlAUbSstUbWUb 1.992 fak_ub_b2 0.00 1.992 FORMAT "%5.3"
 /begin AXIS_DESCR STD_AXIS tmst temp_ub_q0p75_o48 6 -48.00 143.3 FORMAT "%5.1" DEPOSIT ABSOLUTE /end AXIS_DESCR
/end CHARACTERISTIC
/begin CHARACTERISTIC NWUEBER0 "" VALUE 0x8EF256 KwSw 511.9922 kw_sw_q0p0078 -256.0000 255.9922 FORMAT "%8.4" /end CHARACTERISTIC
/begin CHARACTERISTIC NWUEBER1 "" VALUE 0x8EF258 KwSw 511.9922 kw_sw_q0p0078 -256.0000 255.9922 FORMAT "%8.4" /end CHARACTERISTIC
/begin CHARACTERISTIC NWUEBER2 "" VALUE 0x8EF25A KwSw 511.9922 kw_sw_q0p0078 -256.0000 255.9922 FORMAT "%8.4" /end CHARACTERISTIC
/begin CHARACTERISTIC NWUEBER3 "" VALUE 0x8EF25C KwSw 511.9922 kw_sw_q0p0078 -256.0000 255.9922 FORMAT "%8.4" /end CHARACTERISTIC
/begin CHARACTERISTIC PSAPES "" VALUE 0x8EA6F0 KwUw 2559.961 p_uw_q0p039 0.00 2559.961 FORMAT "%8.3" /end CHARACTERISTIC
/begin CHARACTERISTIC PVMITIBGR "" VALUE 0x8E1A6E KwUb 7.600 rkti_p_sy 0.00 7.600 FORMAT "%5.3" /end CHARACTERISTIC
/begin CHARACTERISTIC RDUNDEF "" VALUE 0x8FCE05 KwUb 1530. kw_q6 0.00 1530. FORMAT "%5.0" /end CHARACTERISTIC
/begin CHARACTERISTIC RESETMAX "" VALUE 0x8E3505 KwUb 1.000 dez 0.00 1.000 FORMAT "%5.3" /end CHARACTERISTIC
/begin CHARACTERISTIC RLPHERKMN "" VALUE 0x8FCE15 KwUb 191.3 rel_ub_q0p75 0.00 191.3 FORMAT "%5.1" /end CHARACTERISTIC
/begin CHARACTERISTIC RLPHERKMX "" VALUE 0x8FCE16 KwUb 191.3 rel_ub_q0p75 0.00 191.3 FORMAT "%5.1" /end CHARACTERISTIC
/begin AXIS_PTS SAN12ESUW "" 0x8E5A04 anztib_w SstAUwSstUw 65535.00 dez 12 0.00 65535.00 FORMAT "%8.2" DEPOSIT ABSOLUTE /end AXIS_PTS
/begin AXIS_PTS SDK10TEUB "" 0x8E0089 wdkba SstAUbSstUb 100.0 relDK_ub_b100 10 0.00 100.0 FORMAT "%5.1" DEPOSIT ABSOLUTE /end AXIS_PTS
/begin AXIS_PTS SEZ06TMUB "" 0x8E0094 etazwimt SstAUbSstUb 127.5 rel_ub_b127p5 6 0.00 127.5 FORMAT "%5.1" DEPOSIT ABSOLUTE /end AXIS_PTS
/begin AXIS_PTS SFR05TEUB "" 0x8E009B frmit SstAUbSstUb 1.992 fak_ub_b2 5 0.00 1.992 FORMAT "%5.3" DEPOSIT ABSOLUTE /end AXIS_PTS
/begin AXIS_PTS SGA06MDUB "" 0x8E5974 gangi SstAUbSstUb 255.0 dez 6 0.00 255.0 FORMAT "%5.1" DEPOSIT ABSOLUTE /end AXIS_PTS
/begin AXIS_PTS SGA08MDUB "" 0x8E01C9 gangi SstAUbSstUb 255.0 dez 8 0.00 255.0 FORMAT "%5.1" DEPOSIT ABSOLUTE /end AXIS_PTS
/begin CHARACTERISTIC SHKNWMXA "" VALUE 0x8FD284 KwUb 255.0 dez 0.00 255.0 FORMAT "%5.1" /end CHARACTERISTIC
/begin CHARACTERISTIC SHKNWMXE "" VALUE 0x8FD285 KwUb 255.0 dez 0.00 255.0 FORMAT "%5.1" /end CHARACTERISTIC
/begin AXIS_PTS SIM06ESUW "" 0x8E597C imlatm_w SstAUwSstUw 23.30133 m_uw_b23p3 6 0.00 23.30133 FORMAT "%8.5" DEPOSIT ABSOLUTE /end AXIS_PTS
/begin AXIS_PTS SKS06ESUB "" 0x8E01D2 kstaa SstAUbSstUb 1.992 fak_ub_b2 6 0.00 1.992 FORMAT "%5.3" DEPOSIT ABSOLUTE /end AXIS_PTS
/begin AXIS_PTS SLA05ESUB "" 0x8E5A1E ladiff_w SstAUwSstUw 1.999969 fak_sw_b1 5 -1.000000 0.9999695 FORMAT "%8.6" DEPOSIT ABSOLUTE /end AXIS_PTS
/begin AXIS_PTS SLA09OPUW "" 0x8E5BAE lambas_w SstAUwSstUw 15.99976 fak_uw_b16 9 0.00 15.99976 FORMAT "%8.5" DEPOSIT ABSOLUTE /end AXIS_PTS
/begin AXIS_PTS SLX06TMUW "" 0x8E598A lamsbg_w SstAUwSstUw 15.99976 fak_uw_b16 6 0.00 15.99976 FORMAT "%8.5" DEPOSIT ABSOLUTE /end AXIS_PTS
/begin AXIS_PTS SLY06TMUW "" 0x8E5998 lamsbg2_w SstAUwSstUw 15.99976 fak_uw_b16 6 0.00 15.99976 FORMAT "%8.5" DEPOSIT ABSOLUTE /end AXIS_PTS
/begin AXIS_PTS SM108LHSW "" 0x8E59A6 dlashkm_w SstASwSstSw 1.999969 fak_sw_b1 8 -1.000000 0.9999695 FORMAT "%8.6" DEPOSIT ABSOLUTE /end AXIS_PTS
/begin AXIS_PTS SM208LHSW "" 0x8E59B8 dlashkm2_w SstASwSstSw 1.999969 fak_sw_b1 8 -1.000000 0.9999695 FORMAT "%8.6" DEPOSIT ABSOLUTE /end AXIS_PTS
/begin AXIS_PTS SMI04LLUB "" 0x8E5A2A mifa_w SstAUwSstUw 99.99847 rel_uw_b100 4 0.00 99.99847 FORMAT "%8.5" DEPOSIT ABSOLUTE /end AXIS_PTS
/begin AXIS_PTS SML05DKUB "" 0x8E00A1 ml SstAUbSstUb 1020. m_ub_b1020 5 0.00 1020. FORMAT "%5.0" DEPOSIT ABSOLUTE /end AXIS_PTS
/begin AXIS_PTS SML06TEUB "" 0x8E00A7 ml SstAUbSstUb 1020. m_ub_b1020 6 0.00 1020. FORMAT "%5.0" DEPOSIT ABSOLUTE /end AXIS_PTS
/begin AXIS_PTS SML06TMUW "" 0x8E59CA ml_w SstAUwSstUw 6553.500 m_uw_b6553p5 6 0.00 6553.500 FORMAT "%8.3" DEPOSIT ABSOLUTE /end AXIS_PTS
/begin AXIS_PTS SML07TMUW "" 0x8E59D8 ml_w SstAUwSstUw 6553.500 m_uw_b6553p5 7 0.00 6553.500 FORMAT "%8.3" DEPOSIT ABSOLUTE /end AXIS_PTS
/begin AXIS_PTS SML08LHUB "" 0x8E00AE ml SstAUbSstUb 1020. m_ub_b1020 8 0.00 1020. FORMAT "%5.0" DEPOSIT ABSOLUTE /end AXIS_PTS
/begin AXIS_PTS SMO08MFUB "" 0x8E346A mizuvfil SstAUbSstUb 99.61 rel_ub_b99p6 8 0.00 99.61 FORMAT "%5.2" DEPOSIT ABSOLUTE /end AXIS_PTS
/begin AXIS_PTS SMT06TMUW "" 0x8E59E8 ml_w SstAUwSstUw 6553.500 m_uw_b6553p5 6 0.00 6553.500 FORMAT "%8.3" DEPOSIT ABSOLUTE /end AXIS_PTS
/begin AXIS_PTS SNG06LLSB "" 0x8E01D9 ngfil SstAUbSstSb 25500. nmotg_sb_q100 6 -12800. 12700. FORMAT "%5.0" DEPOSIT ABSOLUTE /end AXIS_PTS
/begin AXIS_PTS SNM04ZUUB "" 0x8E02C3 nmot SstAUbSstUb 10200. nmot_ub_q40 4 0.00 10200. FORMAT "%5.0" DEPOSIT ABSOLUTE /end AXIS_PTS
/begin AXIS_PTS SNM05DKUB "" 0x8E00B7 nmot SstAUbSstUb 10200. nmot_ub_q40 5 0.00 10200. FORMAT "%5.0" DEPOSIT ABSOLUTE /end AXIS_PTS
/begin AXIS_PTS SNM05NAUW "" 0x8E5AAA nmot_w SstAUwSstUw 16383.75 nmot_uw_q0p25 5 0.00 16383.75 FORMAT "%8.2" DEPOSIT ABSOLUTE /end AXIS_PTS
/begin AXIS_PTS SNM05NEUW "" 0x8E5AB6 nmot_w SstAUwSstUw 16383.75 nmot_uw_q0p25 5 0.00 16383.75 FORMAT "%8.2" DEPOSIT ABSOLUTE /end AXIS_PTS
/begin AXIS_PTS SNM05NWUB "" 0x8E02AE nmot SstAUbSstUb 10200. nmot_ub_q40 5 0.00 10200. FORMAT "%5.0" DEPOSIT ABSOLUTE /end AXIS_PTS
/begin AXIS_PTS SNM05NWUW "" 0x8E5AC2 nmot_w SstAUwSstUw 16383.75 nmot_uw_q0p25 5 0.00 16383.75 FORMAT "%8.2" DEPOSIT ABSOLUTE /end AXIS_PTS
/begin AXIS_PTS SNM06ESUB "" 0x8E00BD nmot SstAUbSstUb 10200. nmot_ub_q40 6 0.00 10200. FORMAT "%5.0" DEPOSIT ABSOLUTE /end AXIS_PTS
/begin AXIS_PTS SNM06LLUB "" 0x8E5A34 nmot_w SstAUwSstUw 16383.75 nmot_uw_q0p25 6 0.00 16383.75 FORMAT "%8.2" DEPOSIT ABSOLUTE /end AXIS_PTS
/begin AXIS_PTS SNM06MDUW "" 0x8E59F6 nmot_w SstAUwSstUw 16383.75 nmot_uw_q0p25 6 0.00 16383.75 FORMAT "%8.2" DEPOSIT ABSOLUTE /end AXIS_PTS
/begin AXIS_PTS SNM06NWUB "" 0x8E00C4 nmot SstAUbSstUb 10200. nmot_ub_q40 6 0.00 10200. FORMAT "%5.0" DEPOSIT ABSOLUTE /end AXIS_PTS
/begin AXIS_PTS SNM07ESUB "" 0x8E00CB nmot SstAUbSstUb 10200. nmot_ub_q40 7 0.00 10200. FORMAT "%5.0" DEPOSIT ABSOLUTE /end AXIS_PTS
/begin AXIS_PTS SNM08FEUB "" 0x8E00D3 nmot SstAUbSstUb 10200. nmot_ub_q40 8 0.00 10200. FORMAT "%5.0" DEPOSIT ABSOLUTE /end AXIS_PTS
/begin AXIS_PTS SNM08LHUB "" 0x8E00DC nmot SstAUbSstUb 10200. nmot_ub_q40 8 0.00 10200. FORMAT "%5.0" DEPOSIT ABSOLUTE /end AXIS_PTS
/begin AXIS_PTS SNM08MFUB "" 0x8E3473 nmot SstAUbSstUb 10200. nmot_ub_q40 8 0.00 10200. FORMAT "%5.0" DEPOSIT ABSOLUTE /end AXIS_PTS
/begin AXIS_PTS SNM08OPUB "" 0x8E01E0 nmot SstAUbSstUb 10200. nmot_ub_q40 8 0.00 10200. FORMAT "%5.0" DEPOSIT ABSOLUTE /end AXIS_PTS
/begin AXIS_PTS SNM08__UB "" 0x8E00E5 nmot SstAUbSstUb 10200. nmot_ub_q40 8 0.00 10200. FORMAT "%5.0" DEPOSIT ABSOLUTE /end AXIS_PTS
/begin AXIS_PTS SNM10LSUB "" 0x8E01E9 nmot SstAUbSstUb 10200. nmot_ub_q40 10 0.00 10200. FORMAT "%5.0" DEPOSIT ABSOLUTE /end AXIS_PTS
/begin AXIS_PTS SNM10TEUB "" 0x8E00EE nmot SstAUbSstUb 10200. nmot_ub_q40 10 0.00 10200. FORMAT "%5.0" DEPOSIT ABSOLUTE /end AXIS_PTS
/begin AXIS_PTS SNM12ESUB "" 0x8E01F4 nmot SstAUbSstUb 10200. nmot_ub_q40 12 0.00 10200. FORMAT "%5.0" DEPOSIT ABSOLUTE /end AXIS_PTS
/begin AXIS_PTS SNM12FEUB "" 0x8E0201 nmot SstAUbSstUb 10200. nmot_ub_q40 12 0.00 10200. FORMAT "%5.0" DEPOSIT ABSOLUTE /end AXIS_PTS
/begin AXIS_PTS SNM16CIUB "" 0x8E00F9 nmot SstAUbSstUb 10200. nmot_ub_q40 16 0.00 10200. FORMAT "%5.0" DEPOSIT ABSOLUTE /end AXIS_PTS
/begin AXIS_PTS SNM16KRDYUB "" 0x8E010A nmot SstAUbSstUb 10200. nmot_ub_q40 16 0.00 10200. FORMAT "%5.0" DEPOSIT ABSOLUTE /end AXIS_PTS
/begin AXIS_PTS SNM16KRUB "" 0x8E011B nmot SstAUbSstUb 10200. nmot_ub_q40 16 0.00 10200. FORMAT "%5.0" DEPOSIT ABSOLUTE /end AXIS_PTS
/begin AXIS_PTS SNM16NAUW "" 0x8E5ADC nmot_w SstAUwSstUw 16383.75 nmot_uw_q0p25 16 0.00 16383.75 FORMAT "%8.2" DEPOSIT ABSOLUTE /end AXIS_PTS
/begin AXIS_PTS SNM16NEUW "" 0x8E5AFE nmot_w SstAUwSstUw 16383.75 nmot_uw_q0p25 16 0.00 16383.75 FORMAT "%8.2" DEPOSIT ABSOLUTE /end AXIS_PTS
/begin AXIS_PTS SNM16OPUW "" 0x8E5A42 nmot_w SstAUwSstUw 16383.75 nmot_uw_q0p25 16 0.00 16383.75 FORMAT "%8.2" DEPOSIT ABSOLUTE /end AXIS_PTS
/begin AXIS_PTS SNM16ZUUW "" 0x8E5A64 nmot_w SstAUwSstUw 16383.75 nmot_uw_q0p25 16 0.00 16383.75 FORMAT "%8.2" DEPOSIT ABSOLUTE /end AXIS_PTS
/begin AXIS_PTS SNM16__UW "" 0x8E5BC2 nmot_w SstAUwSstUw 16383.75 nmot_uw_q0p25 16 0.00 16383.75 FORMAT "%8.2" DEPOSIT ABSOLUTE /end AXIS_PTS
/begin AXIS_PTS SNS04ZUSB "" 0x8E02C8 dns SstAUbSstSb 2550. nmotd_sb_q10 4 -1280. 1270. FORMAT "%5.0" DEPOSIT ABSOLUTE /end AXIS_PTS
/begin AXIS_PTS SQM05TEUB "" 0x8E020E qmsdyn SstAUbSstUb 15.94 fak_ub_b16 5 0.00 15.94 FORMAT "%5.2" DEPOSIT ABSOLUTE /end AXIS_PTS
/begin AXIS_PTS SRL03KRUB "" 0x8E012C rl SstAUbSstUb 191.3 rel_ub_q0p75 3 0.00 191.3 FORMAT "%5.1" DEPOSIT ABSOLUTE /end AXIS_PTS
/begin AXIS_PTS SRL04KRUB "" 0x8E0130 rl SstAUbSstUb 191.3 rel_ub_q0p75 4 0.00 191.3 FORMAT "%5.1" DEPOSIT ABSOLUTE /end AXIS_PTS
/begin AXIS_PTS SRL05NAUW "" 0x8E5B20 rlnw_w SstAUwSstUw 1535.977 rel_uw_q0p0234 5 0.00 1535.977 FORMAT "%8.3" DEPOSIT ABSOLUTE /end AXIS_PTS
/begin AXIS_PTS SRL05NEUW "" 0x8E5B2C rlnw_w SstAUwSstUw 1535.977 rel_uw_q0p0234 5 0.00 1535.977 FORMAT "%8.3" DEPOSIT ABSOLUTE /end AXIS_PTS
/begin AXIS_PTS SRL06ESUB "" 0x8E0214 rl SstAUbSstUb 191.3 rel_ub_q0p75 6 0.00 191.3 FORMAT "%5.1" DEPOSIT ABSOLUTE /end AXIS_PTS
/begin AXIS_PTS SRL06KRUB "" 0x8E0135 rl SstAUbSstUb 191.3 rel_ub_q0p75 6 0.00 191.3 FORMAT "%5.1" DEPOSIT ABSOLUTE /end AXIS_PTS
/begin AXIS_PTS SRL08DMUB "" 0x8E021B rl SstAUbSstUb 191.3 rel_ub_q0p75 8 0.00 191.3 FORMAT "%5.1" DEPOSIT ABSOLUTE /end AXIS_PTS
/begin AXIS_PTS SRL08NEUW "" 0x8E5B4A rlnw_w SstAUwSstUw 1535.977 rel_uw_q0p0234 8 0.00 1535.977 FORMAT "%8.3" DEPOSIT ABSOLUTE /end AXIS_PTS
/begin AXIS_PTS SRL08NXUB "" 0x8E013C rl SstAUbSstUb 191.3 rel_ub_q0p75 8 0.00 191.3 FORMAT "%5.1" DEPOSIT ABSOLUTE /end AXIS_PTS
/begin AXIS_PTS SRL10LSUB "" 0x8E0224 rl SstAUbSstUb 191.3 rel_ub_q0p75 10 0.00 191.3 FORMAT "%5.1" DEPOSIT ABSOLUTE /end AXIS_PTS
/begin AXIS_PTS SRL11OPUW "" 0x8E5BE4 rl_w SstAUwSstUw 1535.977 rel_uw_q0p0234 11 0.00 1535.977 FORMAT "%8.3" DEPOSIT ABSOLUTE /end AXIS_PTS
/begin AXIS_PTS SRL12ESUB "" 0x8E022F rl SstAUbSstUb 191.3 rel_ub_q0p75 12 0.00 191.3 FORMAT "%5.1" DEPOSIT ABSOLUTE /end AXIS_PTS
/begin AXIS_PTS SRL12ZUUW "" 0x8E5A86 rl_w SstAUwSstUw 1535.977 rel_uw_q0p0234 12 0.00 1535.977 FORMAT "%8.3" DEPOSIT ABSOLUTE /end AXIS_PTS
/begin AXIS_PTS SRL16NAUW "" 0x8E5B5C rlnw_w SstAUwSstUw 1535.977 rel_uw_q0p0234 16 0.00 1535.977 FORMAT "%8.3" DEPOSIT ABSOLUTE /end AXIS_PTS
/begin AXIS_PTS SRL16NEUW "" 0x8E5B7E rlnw_w SstAUwSstUw 1535.977 rel_uw_q0p0234 16 0.00 1535.977 FORMAT "%8.3" DEPOSIT ABSOLUTE /end AXIS_PTS
/begin AXIS_PTS SRP06ESUB "" 0x8E023C rlp SstAUbSstUb 191.3 rel_ub_q0p75 6 0.00 191.3 FORMAT "%5.1" DEPOSIT ABSOLUTE /end AXIS_PTS
/begin AXIS_PTS SRR07OPUW "" 0x8E5BFC rri_w SstAUwSstUw 99.99847 rel_uw_b100 7 0.00 99.99847 FORMAT "%8.5" DEPOSIT ABSOLUTE /end AXIS_PTS
/begin AXIS_PTS ST107TMUB "" 0x8E0145 tabgmst SstAUbSstUb 1275. temp_ub_q5_o50 7 -50.00 1225. FORMAT "%5.0" DEPOSIT ABSOLUTE /end AXIS_PTS
/begin AXIS_PTS ST207TMUB "" 0x8E014D tabgmst2 SstAUbSstUb 1275. temp_ub_q5_o50 7 -50.00 1225. FORMAT "%5.0" DEPOSIT ABSOLUTE /end AXIS_PTS
/begin AXIS_PTS ST307TMUB "" 0x8E0155 tkatmst SstAUbSstUb 1275. temp_ub_q5_o50 7 -50.00 1225. FORMAT "%5.0" DEPOSIT ABSOLUTE /end AXIS_PTS
/begin AXIS_PTS ST407TMUB "" 0x8E015D tkatmst2 SstAUbSstUb 1275. temp_ub_q5_o50 7 -50.00 1225. FORMAT "%5.0" DEPOSIT ABSOLUTE /end AXIS_PTS
/begin AXIS_PTS STA04LLUB "" 0x8E5AA0 tans SstAUwSstUw 191.3 temp_ub_q0p75_o48 4 -48.00 143.3 FORMAT "%5.1" DEPOSIT ABSOLUTE /end AXIS_PTS
/begin AXIS_PTS STA06ESUB "" 0x8E0165 tans SstAUbSstUb 191.3 temp_ub_q0p75_o48 6 -48.00 143.3 FORMAT "%5.1" DEPOSIT ABSOLUTE /end AXIS_PTS
/begin AXIS_PTS STA12ESUB "" 0x8E0243 tans SstAUbSstUb 191.3 temp_ub_q0p75_o48 12 -48.00 143.3 FORMAT "%5.1" DEPOSIT ABSOLUTE /end AXIS_PTS
/begin AXIS_PTS STA12WLUB "" 0x8E0250 tans SstAUbSstUb 191.3 temp_ub_q0p75_o48 12 -48.00 143.3 FORMAT "%5.1" DEPOSIT ABSOLUTE /end AXIS_PTS
/begin AXIS_PTS STK04SAUB "" 0x8E016C tkatm SstAUbSstUb 1275. temp_ub_q5_o50 4 -50.00 1225. FORMAT "%5.0" DEPOSIT ABSOLUTE /end AXIS_PTS
/begin AXIS_PTS STM04FEUB "" 0x8E025D tmot SstAUbSstUb 191.3 temp_ub_q0p75_o48 4 -48.00 143.3 FORMAT "%5.1" DEPOSIT ABSOLUTE /end AXIS_PTS
/begin AXIS_PTS STM04SAUB "" 0x8E0262 tmot SstAUbSstUb 191.3 temp_ub_q0p75_o48 4 -48.00 143.3 FORMAT "%5.1" DEPOSIT ABSOLUTE /end AXIS_PTS
/begin AXIS_PTS STM04__UB "" 0x8E0171 tmot SstAUbSstUb 191.3 temp_ub_q0p75_o48 4 -48.00 143.3 FORMAT "%5.1" DEPOSIT ABSOLUTE /end AXIS_PTS
/begin AXIS_PTS STM05NWUB "" 0x8E02B4 tmot SstAUbSstUb 191.3 temp_ub_q0p75_o48 5 -48.00 143.3 FORMAT "%5.1" DEPOSIT ABSOLUTE /end AXIS_PTS
/begin AXIS_PTS STM05SAUB "" 0x8E0176 tmot SstAUbSstUb 191.3 temp_ub_q0p75_o48 5 -48.00 143.3 FORMAT "%5.1" DEPOSIT ABSOLUTE /end AXIS_PTS
/begin AXIS_PTS STM05TMUB "" 0x8E017C tmst SstAUbSstUb 191.3 temp_ub_q0p75_o48 5 -48.00 143.3 FORMAT "%5.1" DEPOSIT ABSOLUTE /end AXIS_PTS
/begin AXIS_PTS STM06LLUB "" 0x8E0182 tmot SstAUbSstUb 191.3 temp_ub_q0p75_o48 6 -48.00 143.3 FORMAT "%5.1" DEPOSIT ABSOLUTE /end AXIS_PTS
/begin AXIS_PTS STM06NWUB "" 0x8E0189 tmot SstAUbSstUb 191.3 temp_ub_q0p75_o48 6 -48.00 143.3 FORMAT "%5.1" DEPOSIT ABSOLUTE /end AXIS_PTS
/begin AXIS_PTS STM06__UB "" 0x8E0190 tmot SstAUbSstUb 191.3 temp_ub_q0p75_o48 6 -48.00 143.3 FORMAT "%5.1" DEPOSIT ABSOLUTE /end AXIS_PTS
/begin AXIS_PTS STM08DMUB "" 0x8E0267 tmot SstAUbSstUb 191.3 temp_ub_q0p75_o48 8 -48.00 143.3 FORMAT "%5.1" DEPOSIT ABSOLUTE /end AXIS_PTS
/begin AXIS_PTS STM08MDUB "" 0x8E0197 tmot SstAUbSstUb 191.3 temp_ub_q0p75_o48 8 -48.00 143.3 FORMAT "%5.1" DEPOSIT ABSOLUTE /end AXIS_PTS
/begin AXIS_PTS STM08MFUB "" 0x8E347C tmotmn SstAUbSstUb 191.3 temp_ub_q0p75_o48 8 -48.00 143.3 FORMAT "%5.1" DEPOSIT ABSOLUTE /end AXIS_PTS
/begin AXIS_PTS STM08OPUB "" 0x8E0270 tmot SstAUbSstUb 191.3 temp_ub_q0p75_o48 8 -48.00 143.3 FORMAT "%5.1" DEPOSIT ABSOLUTE /end AXIS_PTS
/begin AXIS_PTS STM08__UB "" 0x8E02BA tmot SstAUbSstUb 191.3 temp_ub_q0p75_o48 8 -48.00 143.3 FORMAT "%5.1" DEPOSIT ABSOLUTE /end AXIS_PTS
/begin AXIS_PTS STM09ESUB "" 0x8E01A0 tmot SstAUbSstUb 191.3 temp_ub_q0p75_o48 9 -48.00 143.3 FORMAT "%5.1" DEPOSIT ABSOLUTE /end AXIS_PTS
/begin AXIS_PTS STM10__UB "" 0x8E01AA tmot SstAUbSstUb 191.3 temp_ub_q0p75_o48 10 -48.00 143.3 FORMAT "%5.1" DEPOSIT ABSOLUTE /end AXIS_PTS
/begin AXIS_PTS STM12ESUB "" 0x8E0279 tmot SstAUbSstUb 191.3 temp_ub_q0p75_o48 12 -48.00 143.3 FORMAT "%5.1" DEPOSIT ABSOLUTE /end AXIS_PTS
/begin AXIS_PTS STN06LLUB "" 0x8E01B5 tnst SstAUbSstUb 255.0 t1sxs_ub_b255 6 0.00 255.0 FORMAT "%5.1" DEPOSIT ABSOLUTE /end AXIS_PTS
/begin AXIS_PTS STO06NWUW "" 0x8E5BA0 toelk_w SstAUwSstUw 1535.977 temp_q0p0234_o273 6 -273.1500 1262.827 FORMAT "%8.3" DEPOSIT ABSOLUTE /end AXIS_PTS
/begin AXIS_PTS STS08ESUB "" 0x8E0286 tmst SstAUbSstUb 191.3 temp_ub_q0p75_o48 8 -48.00 143.3 FORMAT "%5.1" DEPOSIT ABSOLUTE /end AXIS_PTS
/begin AXIS_PTS STS12ESUB "" 0x8E028F tmst SstAUbSstUb 191.3 temp_ub_q0p75_o48 12 -48.00 143.3 FORMAT "%5.1" DEPOSIT ABSOLUTE /end AXIS_PTS
/begin AXIS_PTS SUE08MFUB "" 0x8E029C uevges SstAUbSstUb 25.50 fak_q0p1 8 0.00 25.50 FORMAT "%5.2" DEPOSIT ABSOLUTE /end AXIS_PTS
/begin AXIS_PTS SUV07MDUB "" 0x8E01BC uefktget SstAUbSstUb 25.50 uefktget_ub_b25p4 7 0.00 25.50 FORMAT "%5.2" DEPOSIT ABSOLUTE /end AXIS_PTS
/begin AXIS_PTS SWE07OPSW "" 0x8E5C0C wnwe_w SstASwSstSw 511.9922 kw_q0p0078 7 -256.0000 255.9922 FORMAT "%8.4" DEPOSIT ABSOLUTE /end AXIS_PTS
/begin AXIS_PTS SWP08MFUB "" 0x8E3485 wped SstAUbSstUb 100.0 relPED_ub_b100 8 0.00 100.0 FORMAT "%5.1" DEPOSIT ABSOLUTE /end AXIS_PTS
/begin AXIS_PTS SWP08OPUB "" 0x8E02A5 wped SstAUbSstUb 100.0 relPED_ub_b100 8 0.00 100.0 FORMAT "%5.1" DEPOSIT ABSOLUTE /end AXIS_PTS
/begin CHARACTERISTIC TANSMN "" VALUE 0x8FD257 KwUb 191.3 temp_ub_q0p75_o48 -48.00 143.3 FORMAT "%5.1" /end CHARACTERISTIC
/begin CHARACTERISTIC TANWSVA "" VALUE 0x8E3AF7 KwUb 25.50 t_q0p1 0.00 25.50 FORMAT "%5.2" /end CHARACTERISTIC
/begin CHARACTERISTIC TANWSVE "" VALUE 0x8E3AF8 KwUb 25.50 t_q0p1 0.00 25.50 FORMAT "%5.2" /end CHARACTERISTIC
/begin CHARACTERISTIC TASLSO "" VALUE 0x8E0347 KwUb 191.3 temp_ub_q0p75_o48 -48.00 143.3 FORMAT "%5.1" /end CHARACTERISTIC
/begin CHARACTERISTIC TASLSU "" VALUE 0x8E0348 KwUb 191.3 temp_ub_q0p75_o48 -48.00 143.3 FORMAT "%5.1" /end CHARACTERISTIC
/begin CHARACTERISTIC TDDSLA "" VALUE 0x8E0349 KwUb 25.50 t100msxs_ub_b25p5 0.00 25.50 FORMAT "%5.2" /end CHARACTERISTIC
/begin CHARACTERISTIC TDSLKT "" VALUE 0x8E034A KwUb 25.50 t100msxs_ub_b25p5 0.00 25.50 FORMAT "%5.2" /end CHARACTERISTIC
/begin CHARACTERISTIC TEMIN "" VALUE 0x8FE6A0 KwUw 209.7120 tinjection_sy 0.00 209.7120 FORMAT "%8.4" /end CHARACTERISTIC
/begin CHARACTERISTIC TEMINVA "" VALUE 0x8FE6A2 KwUw 209.7120 tinjection_sy 0.00 209.7120 FORMAT "%8.4" /end CHARACTERISTIC
/begin CHARACTERISTIC TFASLAMN "" VALUE 0x8E5C56 KwUw 6553.500 t100msxs_uw_b6553p6 0.00 6553.500 FORMAT "%8.3" /end CHARACTERISTIC
/begin CHARACTERISTIC TKERRPSON "" VALUE 0x8EDC7C KwUw 1535.977 temp_q0p0234_o273 -273.1500 1262.827 FORMAT "%8.3" /end CHARACTERISTIC
/begin CHARACTERISTIC TLMSSLAB "" VALUE 0x8E034B KwUb 25.40 t100msxs_ub_b25p5 0.1000 25.50 FORMAT "%5.2" /end CHARACTERISTIC
/begin CHARACTERISTIC TLMSSLMX "" VALUE 0x8E034C KwUb 255.0 t100msxs_ub_b255 0.00 255.0 FORMAT "%5.1" /end CHARACTERISTIC
/begin CHARACTERISTIC TLMSSLTNS "" VALUE 0x8E5C58 KwUw 655.3500 t10msxs_uw_b655p35 0.00 655.3500 FORMAT "%8.4" /end CHARACTERISTIC
/begin CHARACTERISTIC TMAU "" VALUE 0x8E1B6F KwUb 191.3 temp_ub_q0p75_o48 -48.00 143.3 FORMAT "%5.1" /end CHARACTERISTIC
/begin CHARACTERISTIC TMBST "" VALUE 0x8FD258 KwUb 2.550 t10msxs_ub_b2p55 0.00 2.550 FORMAT "%5.3" /end CHARACTERISTIC
/begin CHARACTERISTIC TMFASLMN "" VALUE 0x8E034D KwUb 191.3 temp_ub_q0p75_o48 -48.00 143.3 FORMAT "%5.1" /end CHARACTERISTIC
/begin CHARACTERISTIC TMNSMN "" VALUE 0x8FD259 KwUb 191.3 temp_ub_q0p75_o48 -48.00 143.3 FORMAT "%5.1" /end CHARACTERISTIC
/begin CHARACTERISTIC TMNWLLKHA "" VALUE 0x8E3C45 KwUb 191.3 temp_ub_q0p75_o48 -48.00 143.3 FORMAT "%5.1" /end CHARACTERISTIC
/begin CHARACTERISTIC TMOMIN "" VALUE 0x8FD25A KwUb 191.3 temp_ub_q0p75_o48 -48.00 143.3 FORMAT "%5.1" /end CHARACTERISTIC
/begin CHARACTERISTIC TMOTNMX "" VALUE 0x8EBEFC KwUb 191.3 temp_ub_q0p75_o48 -48.00 143.3 FORMAT "%5.1" /end CHARACTERISTIC
/begin CHARACTERISTIC TMSSLO "" VALUE 0x8E034E KwUb 191.3 temp_ub_q0p75_o48 -48.00 143.3 FORMAT "%5.1" /end CHARACTERISTIC
/begin CHARACTERISTIC TMSSLSTO "" VALUE 0x8E034F KwUb 191.3 temp_ub_q0p75_o48 -48.00 143.3 FORMAT "%5.1" /end CHARACTERISTIC
/begin CHARACTERISTIC TMSSLSTU "" VALUE 0x8E0350 KwUb 191.3 temp_ub_q0p75_o48 -48.00 143.3 FORMAT "%5.1" /end CHARACTERISTIC
/begin CHARACTERISTIC TMSSLU "" VALUE 0x8E0351 KwUb 191.3 temp_ub_q0p75_o48 -48.00 143.3 FORMAT "%5.1" /end CHARACTERISTIC
/begin CHARACTERISTIC TNLPHWAIT "" VALUE 0x8E7D72 KwUw 30000.00 t5usxus_q5 0.00 30000.00 FORMAT "%8.2" /end CHARACTERISTIC
/begin CHARACTERISTIC TNLSGMN "" VALUE 0x8EDB30 KwUw 6553.300 t100msxs_uw_b6553p6 0.2000000 6553.500 FORMAT "%8.3" /end CHARACTERISTIC
/begin CHARACTERISTIC TNLSGMX "" VALUE 0x8EDB32 KwUw 6553.500 t100msxs_uw_b6553p6 0.00 6553.500 FORMAT "%8.3" /end CHARACTERISTIC
/begin CHARACTERISTIC TNLSYNMN "" VALUE 0x8FDC20 KwUw 2615400. t40usxus_q40 6000.000 2621400. FORMAT "%8.0" /end CHARACTERISTIC
/begin CHARACTERISTIC TNLSYNMX "" VALUE 0x8FDC22 KwUw 400000.0 t40usxus_q40 0.00 400000.0 FORMAT "%8.1" /end CHARACTERISTIC
/begin CHARACTERISTIC TNMXH "" VALUE 0x8EBEFE KwUw 6553.500 t100msxs_uw_b6553p5 0.00 6553.500 FORMAT "%8.3" /end CHARACTERISTIC
/begin CHARACTERISTIC TNSC "" VALUE 0x8FEB88 KwUw 1310.700 t20msxs_uw_q0p02 0.00 1310.700 FORMAT "%8.3" /end CHARACTERISTIC
/begin CHARACTERISTIC TNSOF "" VALUE 0x8FD25B KwUb 5.100 t20msxs_ub_b5p1 0.00 5.100 FORMAT "%5.3" /end CHARACTERISTIC
/begin CHARACTERISTIC TNSTAU "" VALUE 0x8E1B70 KwUb 127.5 t500msxs_ub_b127p5 0.00 127.5 FORMAT "%5.1" /end CHARACTERISTIC
/begin CHARACTERISTIC TNWAPTA "" VALUE 0x8E3AFE KwUb 12.70 t50msxs_q0p05 0.05000 12.75 FORMAT "%5.2" /end CHARACTERISTIC
/begin CHARACTERISTIC TNWAPTE "" VALUE 0x8E3AFF KwUb 12.70 t50msxs_q0p05 0.05000 12.75 FORMAT "%5.2" /end CHARACTERISTIC
/begin CHARACTERISTIC TNWFARA "" VALUE 0x8EF2B0 KwUw 3276.7499992 zk50msxs_uw_b3276p8 0.050000762951 3276.8000000 FORMAT "%12.7" /end CHARACTERISTIC
/begin CHARACTERISTIC TNWFARE "" VALUE 0x8EF2B2 KwUw 3276.7499992 zk50msxs_uw_b3276p8 0.050000762951 3276.8000000 FORMAT "%12.7" /end CHARACTERISTIC
/begin CHARACTERISTIC TNWLLAMXA "" VALUE 0x8FEF7C KwUw 655.3500 t10msxs_uw_b655p35 0.00 655.3500 FORMAT "%8.4" /end CHARACTERISTIC
/begin CHARACTERISTIC TNWLLNA "" VALUE 0x8FD286 KwUb 2.550 t10msxs_ub_b2p55 0.00 2.550 FORMAT "%5.3" /end CHARACTERISTIC
/begin CHARACTERISTIC TNWLVA "" VALUE 0x8FD287 KwUb 12.75 t50msxs_ub_b12p75 0.00 12.75 FORMAT "%5.2" /end CHARACTERISTIC
/begin CHARACTERISTIC TNWLVE "" VALUE 0x8FD288 KwUb 12.75 t50msxs_ub_b12p75 0.00 12.75 FORMAT "%5.2" /end CHARACTERISTIC
/begin CHARACTERISTIC TNWLVRPA "" VALUE 0x8FD289 KwUb 12.75 t50msxs_ub_b12p75 0.00 12.75 FORMAT "%5.2" /end CHARACTERISTIC
/begin CHARACTERISTIC TNWLVRPE "" VALUE 0x8FD28A KwUb 12.75 t50msxs_ub_b12p75 0.00 12.75 FORMAT "%5.2" /end CHARACTERISTIC
/begin CHARACTERISTIC TNWPPTA "" VALUE 0x8E3B00 KwUb 12.70 t50msxs_q0p05 0.05000 12.75 FORMAT "%5.2" /end CHARACTERISTIC
/begin CHARACTERISTIC TNWPPTE "" VALUE 0x8E3B01 KwUb 12.70 t50msxs_q0p05 0.05000 12.75 FORMAT "%5.2" /end CHARACTERISTIC
/begin CHARACTERISTIC TNWSBGLA "" VALUE 0x8FD29D KwUb 2.45192 zk10msxs_ub_b2p55 0.0980769 2.55000 FORMAT "%7.5" /end CHARACTERISTIC
/begin CHARACTERISTIC TNWSBGLE "" VALUE 0x8FD28E KwUb 2.54000 zk10msxs_ub_b2p55 0.0100000 2.55000 FORMAT "%7.5" /end CHARACTERISTIC
/begin CHARACTERISTIC TNWSBGNSTA "" CURVE 0x8F0E12 KlAUwSstUwWUw 655.3500 t10msxs_uw_b655p35 0.00 655.3500 FORMAT "%8.4"
 /begin AXIS_DESCR STD_AXIS tmst temp_ub_q0p75_o48 4 -48.00 143.3 FORMAT "%5.1" DEPOSIT ABSOLUTE /end AXIS_DESCR
/end CHARACTERISTIC
/begin CHARACTERISTIC TNWSBGNSTE "" CURVE 0x8EFD82 KlAUwSstUwWUw 655.3500 t10msxs_uw_b655p35 0.00 655.3500 FORMAT "%8.4"
 /begin AXIS_DESCR STD_AXIS tmst temp_ub_q0p75_o48 4 -48.00 143.3 FORMAT "%5.1" DEPOSIT ABSOLUTE /end AXIS_DESCR
/end CHARACTERISTIC
/begin CHARACTERISTIC TNWSHK "" VALUE 0x8E3AF9 KwUb 12.75 t50msxs_ub_b12p75 0.00 12.75 FORMAT "%5.2" /end CHARACTERISTIC
/begin CHARACTERISTIC TNWSHKAA "" VALUE 0x8FD28B KwUb 12.75 t50msxs_ub_b12p75 0.00 12.75 FORMAT "%5.2" /end CHARACTERISTIC
/begin CHARACTERISTIC TNWSHKAE "" VALUE 0x8FD28C KwUb 12.75 t50msxs_ub_b12p75 0.00 12.75 FORMAT "%5.2" /end CHARACTERISTIC
/begin CHARACTERISTIC TNWSTPA "" VALUE 0x8E3AFA KwUb 12.75 t50msxs_ub_b12p75 0.00 12.75 FORMAT "%5.2" /end CHARACTERISTIC
/begin CHARACTERISTIC TNWSVA "" VALUE 0x8E3AFB KwUb 25.50 t_q0p1 0.00 25.50 FORMAT "%5.2" /end CHARACTERISTIC
/begin CHARACTERISTIC TNWSVE "" VALUE 0x8E3AFC KwUb 25.50 t_q0p1 0.00 25.50 FORMAT "%5.2" /end CHARACTERISTIC
/begin CHARACTERISTIC TNWVBGNA "" VALUE 0x8E3B02 KwUb 12.70 t50msxs_q0p05 0.05000 12.75 FORMAT "%5.2" /end CHARACTERISTIC
/begin CHARACTERISTIC TNWVBGNE "" VALUE 0x8E3B03 KwUb 12.70 t50msxs_q0p05 0.05000 12.75 FORMAT "%5.2" /end CHARACTERISTIC
/begin CHARACTERISTIC TNWWSPA "" VALUE 0x8E3C46 KwUb 50.80 t200msxs_ub_b51 0.2000 51.00 FORMAT "%5.2" /end CHARACTERISTIC
/begin CHARACTERISTIC TNWWSPE "" VALUE 0x8E3B45 KwUb 50.80 t200msxs_ub_b51 0.2000 51.00 FORMAT "%5.2" /end CHARACTERISTIC
/begin CHARACTERISTIC TPHERKMN "" VALUE 0x8FCE17 KwUb 191.3 temp_ub_q0p75_o48 -48.00 143.3 FORMAT "%5.1" /end CHARACTERISTIC
/begin CHARACTERISTIC TPHSABSP "" VALUE 0x8FCE18 KwUb 255.0 t1sxs_ub_b255 0.00 255.0 FORMAT "%5.1" /end CHARACTERISTIC
/begin CHARACTERISTIC TPHSSP "" VALUE 0x8FCE19 KwUb 255.0 t1sxs_ub_b255 0.00 255.0 FORMAT "%5.1" /end CHARACTERISTIC
/begin CHARACTERISTIC TSLABB "" VALUE 0x8E0352 KwUb 25.40 t100msxs_ub_b25p5 0.1000 25.50 FORMAT "%5.2" /end CHARACTERISTIC
/begin CHARACTERISTIC TSLPMN "" VALUE 0x8E0353 KwUb 25.40 t100msxs_ub_b25p5 0.1000 25.50 FORMAT "%5.2" /end CHARACTERISTIC
/begin CHARACTERISTIC TSLUBST "" VALUE 0x8E0354 KwUb 25.50 t100msxs_ub_b25p5 0.00 25.50 FORMAT "%5.2" /end CHARACTERISTIC
/begin CHARACTERISTIC TVAUAK "" VALUE 0x8EA7B2 KwUw 6553.500 t100msxs_uw_b6553p5 0.00 6553.500 FORMAT "%8.3" /end CHARACTERISTIC
/begin CHARACTERISTIC TVAUF "" VALUE 0x8EA7B4 KwUw 6553.500 t100msxs_uw_b6553p5 0.00 6553.500 FORMAT "%8.3" /end CHARACTERISTIC
/begin CHARACTERISTIC TVAUM "" VALUE 0x8EA7B6 KwUw 6553.500 t100msxs_uw_b6553p5 0.00 6553.500 FORMAT "%8.3" /end CHARACTERISTIC
/begin CHARACTERISTIC TVDSLVON "" VALUE 0x8E0355 KwUb 25.50 t100msxs_ub_b25p5 0.00 25.50 FORMAT "%5.2" /end CHARACTERISTIC
/begin CHARACTERISTIC TVRPSONMX "" VALUE 0x8EDC7E KwUw 6553.500 t_q0p1 0.00 6553.500 FORMAT "%8.3" /end CHARACTERISTIC
/begin CHARACTERISTIC TVSLP2 "" VALUE 0x8E0356 KwUb 25.50 t100msxs_ub_b25p5 0.00 25.50 FORMAT "%5.2" /end CHARACTERISTIC
/begin CHARACTERISTIC TVSLVOFF "" VALUE 0x8E0357 KwUb 25.50 t100msxs_ub_b25p5 0.00 25.50 FORMAT "%5.2" /end CHARACTERISTIC
/begin CHARACTERISTIC TVSLVON "" VALUE 0x8E0358 KwUb 25.50 t100msxs_ub_b25p5 0.00 25.50 FORMAT "%5.2" /end CHARACTERISTIC
/begin CHARACTERISTIC TVTSPEV "" CURVE 0x8EA6F2 KlAUwSstUwWUw 209.7120 tinjection_sy 0.00 209.7120 FORMAT "%8.4"
 /begin AXIS_DESCR STD_AXIS evtmodev temp_ub_q0p75_o48 4 -48.00 143.3 FORMAT "%5.1" DEPOSIT ABSOLUTE /end AXIS_DESCR
/end CHARACTERISTIC
/begin CHARACTERISTIC TVUB "" CURVE 0x8EA706 KlAUbSstUbWUw 209.7120 tinjection_sy 0.00 209.7120 FORMAT "%8.4"
 /begin AXIS_DESCR STD_AXIS ub spg_ubatt_sy 5 0.00 17.93 FORMAT "%5.2" DEPOSIT ABSOLUTE /end AXIS_DESCR
/end CHARACTERISTIC
/begin CHARACTERISTIC UBDTRDE "" VALUE 0x8E0909 KwUb 17.95 spg_ubatt 0.00 17.95 FORMAT "%5.2" /end CHARACTERISTIC
/begin CHARACTERISTIC UBNLMN "" VALUE 0x8E3502 KwUb 17.95 spg_ubatt 0.00 17.95 FORMAT "%5.2" /end CHARACTERISTIC
/begin CHARACTERISTIC UBSLMN "" VALUE 0x8E5C5A KwUw 25.59961 spg_q0p00039 0.00 25.59961 FORMAT "%8.5" /end CHARACTERISTIC
/begin CHARACTERISTIC UBSLMX "" VALUE 0x8E5C5C KwUw 25.59961 spg_q0p00039 0.00 25.59961 FORMAT "%8.5" /end CHARACTERISTIC
/begin CHARACTERISTIC UBSLSTMN "" VALUE 0x8E5C5E KwUw 25.59961 spg_q0p00039 0.00 25.59961 FORMAT "%8.5" /end CHARACTERISTIC
/begin CHARACTERISTIC VFZGAU "" VALUE 0x8E1B71 KwUb 318.8 vfzg_ub_q1p25 0.00 318.8 FORMAT "%5.1" /end CHARACTERISTIC
/begin CHARACTERISTIC VNMX "" VALUE 0x8E3336 KwUb 318.8 vfzg_ub_q1p25 0.00 318.8 FORMAT "%5.1" /end CHARACTERISTIC
/begin CHARACTERISTIC VNWLLPA "" VALUE 0x8E3C47 KwUb 318.8 vfzg_ub_q1p25 0.00 318.8 FORMAT "%5.1" /end CHARACTERISTIC
/begin CHARACTERISTIC VSLS "" VALUE 0x8E0359 KwUb 318.8 vfzg_ub_q1p25 0.00 318.8 FORMAT "%5.1" /end CHARACTERISTIC
/begin CHARACTERISTIC WESSOT "" VALUE 0x8FC500 KwUb 717.2 kw_q2p8125 0.00 717.2 FORMAT "%5.1" /end CHARACTERISTIC
/begin CHARACTERISTIC WNSRFIXE "" CURVE 0x8EFD94 GklWSw 511.9922 kw_sw_q0p0078 -256.0000 255.9922 FORMAT "%8.4"
 /begin AXIS_DESCR COM_AXIS nmot_w nmot_uw_q0p25 16 0.00 16383.75 FORMAT "%8.2" AXIS_PTS_REF SNM16NEUW /end AXIS_DESCR
/end CHARACTERISTIC
/begin CHARACTERISTIC WNWBKVA "" VALUE 0x8FEFA8 KwSw 511.9922 kw_sw_q0p0078 -256.0000 255.9922 FORMAT "%8.4" /end CHARACTERISTIC
/begin CHARACTERISTIC WNWBKVE "" VALUE 0x8FEF98 KwSw 511.9922 kw_sw_q0p0078 -256.0000 255.9922 FORMAT "%8.4" /end CHARACTERISTIC
/begin CHARACTERISTIC WNWDSHKA "" CURVE 0x8F0E24 KlAUwSstUwWSw 511.9922 kw_sw_q0p0078 -256.0000 255.9922 FORMAT "%8.4"
 /begin AXIS_DESCR STD_AXIS fho_w fak_uw_b4 4 0.00 3.999939 FORMAT "%8.6" DEPOSIT ABSOLUTE /end AXIS_DESCR
/end CHARACTERISTIC
/begin CHARACTERISTIC WNWDSHKE "" CURVE 0x8EFDB4 KlAUwSstUwWSw 511.9922 kw_sw_q0p0078 -256.0000 255.9922 FORMAT "%8.4"
 /begin AXIS_DESCR STD_AXIS fho_w fak_uw_b4 4 0.00 3.999939 FORMAT "%8.6" DEPOSIT ABSOLUTE /end AXIS_DESCR
/end CHARACTERISTIC
/begin CHARACTERISTIC WNWRAS "" VALUE 0x8F0E36 KwSw 511.9922 kw_sw_q0p0078 -256.0000 255.9922 FORMAT "%8.4" /end CHARACTERISTIC
/begin CHARACTERISTIC WNWREO "" VALUE 0x8FEF9A KwSw 511.9922 kw_sw_q0p0078 -256.0000 255.9922 FORMAT "%8.4" /end CHARACTERISTIC
/begin CHARACTERISTIC WNWSAAPP "" VALUE 0x8F0E38 KwSw 511.9922 kw_sw_q0p0078 -256.0000 255.9922 FORMAT "%8.4" /end CHARACTERISTIC
/begin CHARACTERISTIC WNWSAPFA "" VALUE 0x8F0E3A KwSw 511.9922 kw_sw_q0p0078 -256.0000 255.9922 FORMAT "%8.4" /end CHARACTERISTIC
/begin CHARACTERISTIC WNWSAPFE "" VALUE 0x8EFDC6 KwSw 511.9922 kw_sw_q0p0078 -256.0000 255.9922 FORMAT "%8.4" /end CHARACTERISTIC
/begin CHARACTERISTIC WNWSAPSA "" VALUE 0x8F0E3C KwSw 511.9922 kw_sw_q0p0078 -256.0000 255.9922 FORMAT "%8.4" /end CHARACTERISTIC
/begin CHARACTERISTIC WNWSAPSE "" VALUE 0x8EFDC8 KwSw 511.9922 kw_sw_q0p0078 -256.0000 255.9922 FORMAT "%8.4" /end CHARACTERISTIC
/begin CHARACTERISTIC WNWSEAPP "" VALUE 0x8EFDCA KwSw 511.9922 kw_sw_q0p0078 -256.0000 255.9922 FORMAT "%8.4" /end CHARACTERISTIC
/begin CHARACTERISTIC WNWSGUDA "" VALUE 0x8F0E3E KwSw 511.9922 kw_sw_q0p0078 -256.0000 255.9922 FORMAT "%8.4" /end CHARACTERISTIC
/begin CHARACTERISTIC WNWSGUDE "" VALUE 0x8EFDCC KwSw 511.9922 kw_sw_q0p0078 -256.0000 255.9922 FORMAT "%8.4" /end CHARACTERISTIC
/begin CHARACTERISTIC WNWSMNA "" VALUE 0x8F0E40 KwSw 511.9922 kw_sw_q0p0078 -256.0000 255.9922 FORMAT "%8.4" /end CHARACTERISTIC
/begin CHARACTERISTIC WNWSMNE "" VALUE 0x8EFDCE KwSw 511.9922 kw_sw_q0p0078 -256.0000 255.9922 FORMAT "%8.4" /end CHARACTERISTIC
/begin CHARACTERISTIC WNWSMXA "" VALUE 0x8F0E42 KwSw 511.9922 kw_sw_q0p0078 -256.0000 255.9922 FORMAT "%8.4" /end CHARACTERISTIC
/begin CHARACTERISTIC WNWSMXE "" VALUE 0x8EFDD0 KwSw 511.9922 kw_sw_q0p0078 -256.0000 255.9922 FORMAT "%8.4" /end CHARACTERISTIC
/begin CHARACTERISTIC WNWSTA "" CURVE 0x8F0E44 KlASwSstSwWSw 511.9922 kw_sw_q0p0078 -256.0000 255.9922 FORMAT "%8.4"
 /begin AXIS_DESCR STD_AXIS tmot temp_ub_q0p75_o48 4 -48.00 143.3 FORMAT "%5.1" DEPOSIT ABSOLUTE /end AXIS_DESCR
/end CHARACTERISTIC
/begin CHARACTERISTIC WNWSTE "" CURVE 0x8EFDD2 KlAUbSstSwWSw 511.9922 kw_sw_q0p0078 -256.0000 255.9922 FORMAT "%8.4"
 /begin AXIS_DESCR STD_AXIS tmot temp_ub_q0p75_o48 4 -48.00 143.3 FORMAT "%5.1" DEPOSIT ABSOLUTE /end AXIS_DESCR
/end CHARACTERISTIC
/begin CHARACTERISTIC WNWSWOFA "" CURVE 0x8F0E56 KlASwSstSwWSw 511.9922 kw_sw_q0p0078 -256.0000 255.9922 FORMAT "%8.4"
 /begin AXIS_DESCR STD_AXIS tumg temp_ub_q0p75_o48 4 -48.00 143.3 FORMAT "%5.1" DEPOSIT ABSOLUTE /end AXIS_DESCR
/end CHARACTERISTIC
/begin CHARACTERISTIC WNWSWOFE "" CURVE 0x8EFDE4 KlAUbSstSwWSw 511.9922 kw_sw_q0p0078 -256.0000 255.9922 FORMAT "%8.4"
 /begin AXIS_DESCR STD_AXIS tumg temp_ub_q0p75_o48 4 -48.00 143.3 FORMAT "%5.1" DEPOSIT ABSOLUTE /end AXIS_DESCR
/end CHARACTERISTIC
/begin CHARACTERISTIC WNWVAS "" VALUE 0x8FEFAA KwSw 511.9922 kw_sw_q0p0078 -256.0000 255.9922 FORMAT "%8.4" /end CHARACTERISTIC
/begin CHARACTERISTIC ZFLMSSL "" VALUE 0x8E035A KwUb 25.4996 zk100msxs_ub_b25p5 0.100392 25.6000 FORMAT "%7.4" /end CHARACTERISTIC
/begin CHARACTERISTIC ZKSLPOFF "" VALUE 0x8E035B KwUb 25.4996 zk100msxs_ub_b25p5 0.100392 25.6000 FORMAT "%7.4" /end CHARACTERISTIC
/begin CHARACTERISTIC ZKSLPON "" VALUE 0x8E035C KwUb 25.4996 zk100msxs_ub_b25p5 0.100392 25.6000 FORMAT "%7.4" /end CHARACTERISTIC
/begin CHARACTERISTIC ZKSLSOFML "" CURVE 0x8E5C60 KlAUwSstUwWUw 6553.4999985 zk100msxs_uw_b6553 0.10000152590 6553.6000000 FORMAT "%12.7"
 /begin AXIS_DESCR STD_AXIS ml_w m_uw_b6553p5 4 0.00 6553.500 FORMAT "%8.3" DEPOSIT ABSOLUTE /end AXIS_DESCR
/end CHARACTERISTIC
/begin CHARACTERISTIC ZKSLSONML "" CURVE 0x8E5C72 KlAUwSstUwWUw 6553.4999985 zk100msxs_uw_b6553 0.10000152590 6553.6000000 FORMAT "%12.7"
 /begin AXIS_DESCR STD_AXIS ml_w m_uw_b6553p5 4 0.00 6553.500 FORMAT "%8.3" DEPOSIT ABSOLUTE /end AXIS_DESCR
/end CHARACTERISTIC
/begin CHARACTERISTIC ZTSPEV "" VALUE 0x8EA704 KwUw 6553.4999985 zk100msxs_uw_b6553 0.10000152590 6553.6000000 FORMAT "%12.7" /end CHARACTERISTIC
/begin CHARACTERISTIC ZYLEAUS "" VALUE 0x8FCE1A KwUb 255.0 dez 0.00 255.0 FORMAT "%5.1" /end CHARACTERISTIC
/begin MEASUREMENT anzeausb "" UBYTE dez 1 100 0.00 255.0 FORMAT "%5.1" ECU_ADDRESS 0xF0701 /end MEASUREMENT
/begin MEASUREMENT anzlvnwa "" UBYTE dez 1 100 0.00 255.0 FORMAT "%5.1" ECU_ADDRESS 0xF0BDD /end MEASUREMENT
/begin MEASUREMENT anzlvnwe "" UBYTE dez 1 100 0.00 255.0 FORMAT "%5.1" ECU_ADDRESS 0xF0BDE /end MEASUREMENT
/begin MEASUREMENT B_2ph "" UWORD B_TRUE 1 100 0.00 1.00000000000 BIT_MASK 0x1 FORMAT "%13.11" ECU_ADDRESS 0xFD48 /end MEASUREMENT
/begin MEASUREMENT B_3ph "" UWORD B_TRUE 1 100 0.00 1.00000000000 BIT_MASK 0x2 FORMAT "%13.11" ECU_ADDRESS 0xFD48 /end MEASUREMENT
/begin MEASUREMENT B_4wd "" UWORD B_TRUE 1 100 0.00 1.00000000000 BIT_MASK 0x1 FORMAT "%13.11" ECU_ADDRESS 0xFD00 /end MEASUREMENT
/begin MEASUREMENT B_abstnl "" UWORD B_TRUE 1 100 0.00 1.00000000000 BIT_MASK 0x2 FORMAT "%13.11" ECU_ADDRESS 0xFD00 /end MEASUREMENT
/begin MEASUREMENT B_abw "" UBYTE B_TRUE 1 100 0.00 1.00000000000 BIT_MASK 0x8 FORMAT "%13.11" ECU_ADDRESS 0xF06EE /end MEASUREMENT
/begin MEASUREMENT B_adrkra "" UWORD B_TRUE 1 100 0.00 1.00000000000 BIT_MASK 0x4 FORMAT "%13.11" ECU_ADDRESS 0xFD00 /end MEASUREMENT
/begin MEASUREMENT B_adrldra "" UWORD B_TRUE 1 100 0.00 1.00000000000 BIT_MASK 0x8 FORMAT "%13.11" ECU_ADDRESS 0xFD00 /end MEASUREMENT
/begin MEASUREMENT B_adrlra "" UWORD B_TRUE 1 100 0.00 1.00000000000 BIT_MASK 0x10 FORMAT "%13.11" ECU_ADDRESS 0xFD00 /end MEASUREMENT
/begin MEASUREMENT B_adrmdver "" UWORD B_TRUE 1 100 0.00 1.00000000000 BIT_MASK 0x20 FORMAT "%13.11" ECU_ADDRESS 0xFD00 /end MEASUREMENT
/begin MEASUREMENT B_adrmsdk "" UWORD B_TRUE 1 100 0.00 1.00000000000 BIT_MASK 0x40 FORMAT "%13.11" ECU_ADDRESS 0xFD00 /end MEASUREMENT
/begin MEASUREMENT B_adrsta "" UWORD B_TRUE 1 100 0.00 1.00000000000 BIT_MASK 0x80 FORMAT "%13.11" ECU_ADDRESS 0xFD00 /end MEASUREMENT
/begin MEASUREMENT B_anlaus "" UBYTE B_TRUE 1 100 0.00 1.00000000000 BIT_MASK 0x1 FORMAT "%13.11" ECU_ADDRESS 0xF06EE /end MEASUREMENT
/begin MEASUREMENT B_anwva "" UBYTE B_TRUE 1 100 0.00 1.00000000000 BIT_MASK 0x4 FORMAT "%13.11" ECU_ADDRESS 0xF0BE1 /end MEASUREMENT
/begin MEASUREMENT B_anwve "" UBYTE B_TRUE 1 100 0.00 1.00000000000 BIT_MASK 0x2 FORMAT "%13.11" ECU_ADDRESS 0xF0BE1 /end MEASUREMENT
/begin MEASUREMENT B_asrfz "" UWORD B_TRUE 1 100 0.00 1.00000000000 BIT_MASK 0x100 FORMAT "%13.11" ECU_ADDRESS 0xFD00 /end MEASUREMENT
/begin MEASUREMENT B_auakt "" UWORD B_TRUE 1 100 0.00 1.00000000000 BIT_MASK 0x8000 FORMAT "%13.11" ECU_ADDRESS 0xFD70 /end MEASUREMENT
/begin MEASUREMENT B_autget "" UWORD B_TRUE 1 100 0.00 1.00000000000 BIT_MASK 0x200 FORMAT "%13.11" ECU_ADDRESS 0xFD00 /end MEASUREMENT
/begin MEASUREMENT B_bbkoptuf "" UBYTE B_TRUE 1 100 0.00 1.00000000000 BIT_MASK 0x1 FORMAT "%13.11" ECU_ADDRESS 0xF0B45 /end MEASUREMENT
/begin MEASUREMENT B_break1a "" UBYTE B_TRUE 1 100 0.00 1.00000000000 BIT_MASK 0x1 FORMAT "%13.11" ECU_ADDRESS 0xF0BE2 /end MEASUREMENT
/begin MEASUREMENT B_break1e "" UBYTE B_TRUE 1 100 0.00 1.00000000000 BIT_MASK 0x4 FORMAT "%13.11" ECU_ADDRESS 0xF0BE2 /end MEASUREMENT
/begin MEASUREMENT B_break2a "" UBYTE B_TRUE 1 100 0.00 1.00000000000 BIT_MASK 0x2 FORMAT "%13.11" ECU_ADDRESS 0xF0BE2 /end MEASUREMENT
/begin MEASUREMENT B_break2e "" UBYTE B_TRUE 1 100 0.00 1.00000000000 BIT_MASK 0x8 FORMAT "%13.11" ECU_ADDRESS 0xF0BE2 /end MEASUREMENT
/begin MEASUREMENT B_cdagr "" UWORD B_TRUE 1 100 0.00 1.00000000000 BIT_MASK 0x8000 FORMAT "%13.11" ECU_ADDRESS 0xF0CA4 /end MEASUREMENT
/begin MEASUREMENT B_cdagrl "" UWORD B_TRUE 1 100 0.00 1.00000000000 BIT_MASK 0x200 FORMAT "%13.11" ECU_ADDRESS 0xF0CA6 /end MEASUREMENT
/begin MEASUREMENT B_cdanws "" UWORD B_TRUE 1 100 0.00 1.00000000000 BIT_MASK 0x2000 FORMAT "%13.11" ECU_ADDRESS 0xF0CA6 /end MEASUREMENT
/begin MEASUREMENT B_cdatr "" UWORD B_TRUE 1 100 0.00 1.00000000000 BIT_MASK 0x400 FORMAT "%13.11" ECU_ADDRESS 0xF0CA4 /end MEASUREMENT
/begin MEASUREMENT B_cdats "" UWORD B_TRUE 1 100 0.00 1.00000000000 BIT_MASK 0x200 FORMAT "%13.11" ECU_ADDRESS 0xF0CA4 /end MEASUREMENT
/begin MEASUREMENT B_cdbkvp "" UWORD B_TRUE 1 100 0.00 1.00000000000 BIT_MASK 0x20 FORMAT "%13.11" ECU_ADDRESS 0xF0CA8 /end MEASUREMENT
/begin MEASUREMENT B_cddsbkv "" UWORD B_TRUE 1 100 0.00 1.00000000000 BIT_MASK 0x10 FORMAT "%13.11" ECU_ADDRESS 0xF0CA8 /end MEASUREMENT
/begin MEASUREMENT B_cddst "" UWORD B_TRUE 1 100 0.00 1.00000000000 BIT_MASK 0x1000 FORMAT "%13.11" ECU_ADDRESS 0xF0CA4 /end MEASUREMENT
/begin MEASUREMENT B_cddylsu "" UWORD B_TRUE 1 100 0.00 1.00000000000 BIT_MASK 0x800 FORMAT "%13.11" ECU_ADDRESS 0xF0CA8 /end MEASUREMENT
/begin MEASUREMENT B_cdegfe "" UWORD B_TRUE 1 100 0.00 1.00000000000 BIT_MASK 0x40 FORMAT "%13.11" ECU_ADDRESS 0xF0CA8 /end MEASUREMENT
/begin MEASUREMENT B_cdehfm "" UWORD B_TRUE 1 100 0.00 1.00000000000 BIT_MASK 0x4000 FORMAT "%13.11" ECU_ADDRESS 0xF0CA6 /end MEASUREMENT
/begin MEASUREMENT B_cdenws "" UWORD B_TRUE 1 100 0.00 1.00000000000 BIT_MASK 0x2 FORMAT "%13.11" ECU_ADDRESS 0xF0CA6 /end MEASUREMENT
/begin MEASUREMENT B_cdgts "" UWORD B_TRUE 1 100 0.00 1.00000000000 BIT_MASK 0x400 FORMAT "%13.11" ECU_ADDRESS 0xFD00 /end MEASUREMENT
/begin MEASUREMENT B_cdhelsu "" UWORD B_TRUE 1 100 0.00 1.00000000000 BIT_MASK 0x8000 FORMAT "%13.11" ECU_ADDRESS 0xF0CA8 /end MEASUREMENT
/begin MEASUREMENT B_cdhrlsu "" UWORD B_TRUE 1 100 0.00 1.00000000000 BIT_MASK 0x800 FORMAT "%13.11" ECU_ADDRESS 0xF0CA6 /end MEASUREMENT
/begin MEASUREMENT B_cdhrlsue "" UWORD B_TRUE 1 100 0.00 1.00000000000 BIT_MASK 0x1000 FORMAT "%13.11" ECU_ADDRESS 0xF0CA6 /end MEASUREMENT
/begin MEASUREMENT B_cdhsh "" UWORD B_TRUE 1 100 0.00 1.00000000000 BIT_MASK 0x80 FORMAT "%13.11" ECU_ADDRESS 0xF0CA4 /end MEASUREMENT
/begin MEASUREMENT B_cdhshe "" UWORD B_TRUE 1 100 0.00 1.00000000000 BIT_MASK 0x80 FORMAT "%13.11" ECU_ADDRESS 0xF0CA6 /end MEASUREMENT
/begin MEASUREMENT B_cdhsv "" UWORD B_TRUE 1 100 0.00 1.00000000000 BIT_MASK 0x40 FORMAT "%13.11" ECU_ADDRESS 0xF0CA4 /end MEASUREMENT
/begin MEASUREMENT B_cdhsve "" UWORD B_TRUE 1 100 0.00 1.00000000000 BIT_MASK 0x100 FORMAT "%13.11" ECU_ADDRESS 0xF0CA6 /end MEASUREMENT
/begin MEASUREMENT B_cdiclsu "" UWORD B_TRUE 1 100 0.00 1.00000000000 BIT_MASK 0x1000 FORMAT "%13.11" ECU_ADDRESS 0xF0CA8 /end MEASUREMENT
/begin MEASUREMENT B_cdkat "" UWORD B_TRUE 1 100 0.00 1.00000000000 BIT_MASK 0x100 FORMAT "%13.11" ECU_ADDRESS 0xF0CA4 /end MEASUREMENT
/begin MEASUREMENT B_cdkvs "" UWORD B_TRUE 1 100 0.00 1.00000000000 BIT_MASK 0x800 FORMAT "%13.11" ECU_ADDRESS 0xF0CA4 /end MEASUREMENT
/begin MEASUREMENT B_cdlasf "" UWORD B_TRUE 1 100 0.00 1.00000000000 BIT_MASK 0x8000 FORMAT "%13.11" ECU_ADDRESS 0xF0CA6 /end MEASUREMENT
/begin MEASUREMENT B_cdlash "" UWORD B_TRUE 1 100 0.00 1.00000000000 BIT_MASK 0x40 FORMAT "%13.11" ECU_ADDRESS 0xF0CA6 /end MEASUREMENT
/begin MEASUREMENT B_cdlatp "" UWORD B_TRUE 1 100 0.00 1.00000000000 BIT_MASK 0x10 FORMAT "%13.11" ECU_ADDRESS 0xF0CA6 /end MEASUREMENT
/begin MEASUREMENT B_cdlatv "" UWORD B_TRUE 1 100 0.00 1.00000000000 BIT_MASK 0x20 FORMAT "%13.11" ECU_ADDRESS 0xF0CA6 /end MEASUREMENT
/begin MEASUREMENT B_cdldp "" UWORD B_TRUE 1 100 0.00 1.00000000000 BIT_MASK 0x4000 FORMAT "%13.11" ECU_ADDRESS 0xF0CA4 /end MEASUREMENT
/begin MEASUREMENT B_cdllr "" UWORD B_TRUE 1 100 0.00 1.00000000000 BIT_MASK 0x8 FORMAT "%13.11" ECU_ADDRESS 0xF0CA6 /end MEASUREMENT
/begin MEASUREMENT B_cdlsa "" UWORD B_TRUE 1 100 0.00 1.00000000000 BIT_MASK 0x20 FORMAT "%13.11" ECU_ADDRESS 0xF0CA4 /end MEASUREMENT
/begin MEASUREMENT B_cdlsfhv "" UWORD B_TRUE 1 100 0.00 1.00000000000 BIT_MASK 0x2 FORMAT "%13.11" ECU_ADDRESS 0xF0CAA /end MEASUREMENT
/begin MEASUREMENT B_cdlsh "" UWORD B_TRUE 1 100 0.00 1.00000000000 BIT_MASK 0x10 FORMAT "%13.11" ECU_ADDRESS 0xF0CA4 /end MEASUREMENT
/begin MEASUREMENT B_cdlshv "" UWORD B_TRUE 1 100 0.00 1.00000000000 BIT_MASK 0x8 FORMAT "%13.11" ECU_ADDRESS 0xF0CA8 /end MEASUREMENT
/begin MEASUREMENT B_cdlsv "" UWORD B_TRUE 1 100 0.00 1.00000000000 BIT_MASK 0x8 FORMAT "%13.11" ECU_ADDRESS 0xF0CA4 /end MEASUREMENT
/begin MEASUREMENT B_cdlsvv "" UWORD B_TRUE 1 100 0.00 1.00000000000 BIT_MASK 0x400 FORMAT "%13.11" ECU_ADDRESS 0xF0CA6 /end MEASUREMENT
/begin MEASUREMENT B_cdmd "" UWORD B_TRUE 1 100 0.00 1.00000000000 BIT_MASK 0x1 FORMAT "%13.11" ECU_ADDRESS 0xF0CA4 /end MEASUREMENT
/begin MEASUREMENT B_cdnws "" UWORD B_TRUE 1 100 0.00 1.00000000000 BIT_MASK 0x4 FORMAT "%13.11" ECU_ADDRESS 0xF0CA6 /end MEASUREMENT
/begin MEASUREMENT B_cdpllsu "" UWORD B_TRUE 1 100 0.00 1.00000000000 BIT_MASK 0x2000 FORMAT "%13.11" ECU_ADDRESS 0xF0CA8 /end MEASUREMENT
/begin MEASUREMENT B_cdsalsu "" UWORD B_TRUE 1 100 0.00 1.00000000000 BIT_MASK 0x1 FORMAT "%13.11" ECU_ADDRESS 0xF0CAA /end MEASUREMENT
/begin MEASUREMENT B_cdsls "" UWORD B_TRUE 1 100 0.00 1.00000000000 BIT_MASK 0x1 FORMAT "%13.11" ECU_ADDRESS 0xF0CA6 /end MEASUREMENT
/begin MEASUREMENT B_cdswe "" UWORD B_TRUE 1 100 0.00 1.00000000000 BIT_MASK 0x2 FORMAT "%13.11" ECU_ADDRESS 0xF0CA4 /end MEASUREMENT
/begin MEASUREMENT B_cdtankl "" UWORD B_TRUE 1 100 0.00 1.00000000000 BIT_MASK 0x4 FORMAT "%13.11" ECU_ADDRESS 0xF0CA4 /end MEASUREMENT
/begin MEASUREMENT B_cdtes "" UWORD B_TRUE 1 100 0.00 1.00000000000 BIT_MASK 0x2000 FORMAT "%13.11" ECU_ADDRESS 0xF0CA4 /end MEASUREMENT
/begin MEASUREMENT B_cdulsu "" UWORD B_TRUE 1 100 0.00 1.00000000000 BIT_MASK 0x4000 FORMAT "%13.11" ECU_ADDRESS 0xF0CA8 /end MEASUREMENT
/begin MEASUREMENT B_cvt "" UWORD B_TRUE 1 100 0.00 1.00000000000 BIT_MASK 0x800 FORMAT "%13.11" ECU_ADDRESS 0xFD00 /end MEASUREMENT
/begin MEASUREMENT B_cwlshdyn "" UWORD B_TRUE 1 100 0.00 1.00000000000 BIT_MASK 0x1000 FORMAT "%13.11" ECU_ADDRESS 0xFD00 /end MEASUREMENT
/begin MEASUREMENT B_cwlshmf "" UWORD B_TRUE 1 100 0.00 1.00000000000 BIT_MASK 0x2000 FORMAT "%13.11" ECU_ADDRESS 0xFD00 /end MEASUREMENT
/begin MEASUREMENT B_cwlshsch "" UWORD B_TRUE 1 100 0.00 1.00000000000 BIT_MASK 0x4000 FORMAT "%13.11" ECU_ADDRESS 0xFD00 /end MEASUREMENT
/begin MEASUREMENT B_cwlshvl "" UWORD B_TRUE 1 100 0.00 1.00000000000 BIT_MASK 0x80 FORMAT "%13.11" ECU_ADDRESS 0xF0CA8 /end MEASUREMENT
/begin MEASUREMENT B_delaysyn "" UWORD B_TRUE 1 100 0.00 1.00000000000 BIT_MASK 0x4 FORMAT "%13.11" ECU_ADDRESS 0xFD42 /end MEASUREMENT
/begin MEASUREMENT B_dknolu "" UWORD B_TRUE 1 100 0.00 1.00000000000 BIT_MASK 0x200 FORMAT "%13.11" ECU_ADDRESS 0xFD60 /end MEASUREMENT
/begin MEASUREMENT B_dknot "" UWORD B_TRUE 1 100 0.00 1.00000000000 BIT_MASK 0x400 FORMAT "%13.11" ECU_ADDRESS 0xFD60 /end MEASUREMENT
/begin MEASUREMENT B_dkpiu "" UWORD B_TRUE 1 100 0.00 1.00000000000 BIT_MASK 0x800 FORMAT "%13.11" ECU_ADDRESS 0xFD60 /end MEASUREMENT
/begin MEASUREMENT B_dkpru "" UWORD B_TRUE 1 100 0.00 1.00000000000 BIT_MASK 0x1000 FORMAT "%13.11" ECU_ADDRESS 0xFD60 /end MEASUREMENT
/begin MEASUREMENT B_dkpu "" UWORD B_TRUE 1 100 0.00 1.00000000000 BIT_MASK 0x2000 FORMAT "%13.11" ECU_ADDRESS 0xFD60 /end MEASUREMENT
/begin MEASUREMENT B_dkunb "" UWORD B_TRUE 1 100 0.00 1.00000000000 BIT_MASK 0x4000 FORMAT "%13.11" ECU_ADDRESS 0xFD60 /end MEASUREMENT
/begin MEASUREMENT B_dopzue "" UWORD B_TRUE 1 100 0.00 1.00000000000 BIT_MASK 0x8 FORMAT "%13.11" ECU_ADDRESS 0xFD42 /end MEASUREMENT
/begin MEASUREMENT B_dslreset "" UBYTE B_TRUE 1 100 0.00 1.00000000000 BIT_MASK 0x2 FORMAT "%13.11" ECU_ADDRESS 0xF05D4 /end MEASUREMENT
/begin MEASUREMENT B_dslset "" UBYTE B_TRUE 1 100 0.00 1.00000000000 BIT_MASK 0x1 FORMAT "%13.11" ECU_ADDRESS 0xF05D4 /end MEASUREMENT
/begin MEASUREMENT B_dslvh "" UWORD B_TRUE 1 100 0.00 1.00000000000 BIT_MASK 0x8000 FORMAT "%13.11" ECU_ADDRESS 0xFD00 /end MEASUREMENT
/begin MEASUREMENT B_dssakt "" UWORD B_TRUE 1 100 0.00 1.00000000000 BIT_MASK 0x8 FORMAT "%13.11" ECU_ADDRESS 0xFD6C /end MEASUREMENT
/begin MEASUREMENT B_dssv "" UWORD B_TRUE 1 100 0.00 1.00000000000 BIT_MASK 0x1 FORMAT "%13.11" ECU_ADDRESS 0xFD02 /end MEASUREMENT
/begin MEASUREMENT B_dssvnl "" UWORD B_TRUE 1 100 0.00 1.00000000000 BIT_MASK 0x2 FORMAT "%13.11" ECU_ADDRESS 0xFD02 /end MEASUREMENT
/begin MEASUREMENT B_dsuv "" UWORD B_TRUE 1 100 0.00 1.00000000000 BIT_MASK 0x4 FORMAT "%13.11" ECU_ADDRESS 0xFD02 /end MEASUREMENT
/begin MEASUREMENT B_enabrde "" UWORD B_TRUE 1 100 0.00 1.00000000000 BIT_MASK 0x40 FORMAT "%13.11" ECU_ADDRESS 0xFD40 /end MEASUREMENT
/begin MEASUREMENT B_enimiti "" UBYTE B_TRUE 1 100 0.00 1.00000000000 BIT_MASK 0x1 FORMAT "%13.11" ECU_ADDRESS 0xF08DD /end MEASUREMENT
/begin MEASUREMENT B_ensynnl "" UWORD B_TRUE 1 100 0.00 1.00000000000 BIT_MASK 0x4 FORMAT "%13.11" ECU_ADDRESS 0xFD48 /end MEASUREMENT
/begin MEASUREMENT B_eslpe "" UBYTE B_TRUE 1 100 0.00 1.00000000000 BIT_MASK 0x2 FORMAT "%13.11" ECU_ADDRESS 0xF05D3 /end MEASUREMENT
/begin MEASUREMENT B_eslve "" UBYTE B_TRUE 1 100 0.00 1.00000000000 BIT_MASK 0x4 FORMAT "%13.11" ECU_ADDRESS 0xF05D3 /end MEASUREMENT
/begin MEASUREMENT B_fanwftva "" UBYTE B_TRUE 1 100 0.00 1.00000000000 BIT_MASK 0x4 FORMAT "%13.11" ECU_ADDRESS 0xF0BFD /end MEASUREMENT
/begin MEASUREMENT B_fanwftve "" UBYTE B_TRUE 1 100 0.00 1.00000000000 BIT_MASK 0x40 FORMAT "%13.11" ECU_ADDRESS 0xF0BFD /end MEASUREMENT
/begin MEASUREMENT B_fanwsaa "" UBYTE B_TRUE 1 100 0.00 1.00000000000 BIT_MASK 0x2 FORMAT "%13.11" ECU_ADDRESS 0xF0BFD /end MEASUREMENT
/begin MEASUREMENT B_fanwsea "" UBYTE B_TRUE 1 100 0.00 1.00000000000 BIT_MASK 0x20 FORMAT "%13.11" ECU_ADDRESS 0xF0BFD /end MEASUREMENT
/begin MEASUREMENT B_fanwstaa "" UBYTE B_TRUE 1 100 0.00 1.00000000000 BIT_MASK 0x1 FORMAT "%13.11" ECU_ADDRESS 0xF0BFD /end MEASUREMENT
/begin MEASUREMENT B_fanwstae "" UBYTE B_TRUE 1 100 0.00 1.00000000000 BIT_MASK 0x10 FORMAT "%13.11" ECU_ADDRESS 0xF0BFD /end MEASUREMENT
/begin MEASUREMENT B_fanwta "" UBYTE B_TRUE 1 100 0.00 1.00000000000 BIT_MASK 0x8 FORMAT "%13.11" ECU_ADDRESS 0xF0BFD /end MEASUREMENT
/begin MEASUREMENT B_fanwte "" UBYTE B_TRUE 1 100 0.00 1.00000000000 BIT_MASK 0x80 FORMAT "%13.11" ECU_ADDRESS 0xF0BFD /end MEASUREMENT
/begin MEASUREMENT B_fasla "" UWORD B_TRUE 1 100 0.00 1.00000000000 BIT_MASK 0x20 FORMAT "%13.11" ECU_ADDRESS 0xFD18 /end MEASUREMENT
/begin MEASUREMENT B_fnwea "" UBYTE B_TRUE 1 100 0.00 1.00000000000 BIT_MASK 0x1 FORMAT "%13.11" ECU_ADDRESS 0xF418C /end MEASUREMENT
/begin MEASUREMENT B_fnwea2 "" UBYTE B_TRUE 1 100 0.00 1.00000000000 BIT_MASK 0x2 FORMAT "%13.11" ECU_ADDRESS 0xF418C /end MEASUREMENT
/begin MEASUREMENT B_fnwea3 "" UBYTE B_TRUE 1 100 0.00 1.00000000000 BIT_MASK 0x4 FORMAT "%13.11" ECU_ADDRESS 0xF418C /end MEASUREMENT
/begin MEASUREMENT B_fpwdkap "" UWORD B_TRUE 1 100 0.00 1.00000000000 BIT_MASK 0x8 FORMAT "%13.11" ECU_ADDRESS 0xFD02 /end MEASUREMENT
/begin MEASUREMENT B_gapnldg "" UWORD B_TRUE 1 100 0.00 1.00000000000 BIT_MASK 0x8 FORMAT "%13.11" ECU_ADDRESS 0xFD48 /end MEASUREMENT
/begin MEASUREMENT B_gra6p "" UWORD B_TRUE 1 100 0.00 1.00000000000 BIT_MASK 0x10 FORMAT "%13.11" ECU_ADDRESS 0xFD02 /end MEASUREMENT
/begin MEASUREMENT B_gracan "" UWORD B_TRUE 1 100 0.00 1.00000000000 BIT_MASK 0x20 FORMAT "%13.11" ECU_ADDRESS 0xFD02 /end MEASUREMENT
/begin MEASUREMENT B_hfmv "" UWORD B_TRUE 1 100 0.00 1.00000000000 BIT_MASK 0x40 FORMAT "%13.11" ECU_ADDRESS 0xFD02 /end MEASUREMENT
/begin MEASUREMENT B_inidtf "" UWORD B_TRUE 1 100 0.00 1.00000000000 BIT_MASK 0x8000 FORMAT "%13.11" ECU_ADDRESS 0xFDAA /end MEASUREMENT
/begin MEASUREMENT B_i_ska_fr "" UWORD B_TRUE 1 100 0.00 1.00000000000 BIT_MASK 0x8000 FORMAT "%13.11" ECU_ADDRESS 0xFD60 /end MEASUREMENT
/begin MEASUREMENT B_katfz "" UWORD B_TRUE 1 100 0.00 1.00000000000 BIT_MASK 0x80 FORMAT "%13.11" ECU_ADDRESS 0xFD02 /end MEASUREMENT
/begin MEASUREMENT B_kath "" UWORD B_TRUE 1 100 0.00 1.00000000000 BIT_MASK 0x100 FORMAT "%13.11" ECU_ADDRESS 0xFD02 /end MEASUREMENT
/begin MEASUREMENT B_kllknl "" UWORD B_TRUE 1 100 0.00 1.00000000000 BIT_MASK 0x10 FORMAT "%13.11" ECU_ADDRESS 0xFD48 /end MEASUREMENT
/begin MEASUREMENT B_kmmilsct "" UWORD B_TRUE 1 100 0.00 1.00000000000 BIT_MASK 0x200 FORMAT "%13.11" ECU_ADDRESS 0xFD02 /end MEASUREMENT
/begin MEASUREMENT B_ldsafw "" UWORD B_TRUE 1 100 0.00 1.00000000000 BIT_MASK 0x400 FORMAT "%13.11" ECU_ADDRESS 0xFD02 /end MEASUREMENT
/begin MEASUREMENT B_ldsapp "" UWORD B_TRUE 1 100 0.00 1.00000000000 BIT_MASK 0x800 FORMAT "%13.11" ECU_ADDRESS 0xFD02 /end MEASUREMENT
/begin MEASUREMENT B_lkklnl "" UWORD B_TRUE 1 100 0.00 1.00000000000 BIT_MASK 0x20 FORMAT "%13.11" ECU_ADDRESS 0xFD48 /end MEASUREMENT
/begin MEASUREMENT B_lmsslof "" UWORD B_TRUE 1 100 0.00 1.00000000000 BIT_MASK 0x40 FORMAT "%13.11" ECU_ADDRESS 0xFD18 /end MEASUREMENT
/begin MEASUREMENT B_ls4 "" UWORD B_TRUE 1 100 0.00 1.00000000000 BIT_MASK 0x1000 FORMAT "%13.11" ECU_ADDRESS 0xFD02 /end MEASUREMENT
/begin MEASUREMENT B_ls42 "" UWORD B_TRUE 1 100 0.00 1.00000000000 BIT_MASK 0x2000 FORMAT "%13.11" ECU_ADDRESS 0xFD02 /end MEASUREMENT
/begin MEASUREMENT B_lsf "" UWORD B_TRUE 1 100 0.00 1.00000000000 BIT_MASK 0x4000 FORMAT "%13.11" ECU_ADDRESS 0xFD02 /end MEASUREMENT
/begin MEASUREMENT B_lsf2 "" UWORD B_TRUE 1 100 0.00 1.00000000000 BIT_MASK 0x8000 FORMAT "%13.11" ECU_ADDRESS 0xFD02 /end MEASUREMENT
/begin MEASUREMENT B_lsh "" UWORD B_TRUE 1 100 0.00 1.00000000000 BIT_MASK 0x1 FORMAT "%13.11" ECU_ADDRESS 0xFD04 /end MEASUREMENT
/begin MEASUREMENT B_lsh2 "" UWORD B_TRUE 1 100 0.00 1.00000000000 BIT_MASK 0x2 FORMAT "%13.11" ECU_ADDRESS 0xFD04 /end MEASUREMENT
/begin MEASUREMENT B_lsv "" UWORD B_TRUE 1 100 0.00 1.00000000000 BIT_MASK 0x4 FORMAT "%13.11" ECU_ADDRESS 0xFD04 /end MEASUREMENT
/begin MEASUREMENT B_lsv2 "" UWORD B_TRUE 1 100 0.00 1.00000000000 BIT_MASK 0x8 FORMAT "%13.11" ECU_ADDRESS 0xFD04 /end MEASUREMENT
/begin MEASUREMENT B_lzs_dash "" UBYTE B_TRUE 1 100 0.00 1.00000000000 BIT_MASK 0x10 FORMAT "%13.11" ECU_ADDRESS 0x382145 /end MEASUREMENT
/begin MEASUREMENT B_lzs_kr "" UBYTE B_TRUE 1 100 0.00 1.00000000000 BIT_MASK 0x1 FORMAT "%13.11" ECU_ADDRESS 0x382145 /end MEASUREMENT
/begin MEASUREMENT B_lzs_ldr "" UBYTE B_TRUE 1 100 0.00 1.00000000000 BIT_MASK 0x4 FORMAT "%13.11" ECU_ADDRESS 0x382145 /end MEASUREMENT
/begin MEASUREMENT B_lzs_lr "" UBYTE B_TRUE 1 100 0.00 1.00000000000 BIT_MASK 0x2 FORMAT "%13.11" ECU_ADDRESS 0x382145 /end MEASUREMENT
/begin MEASUREMENT B_lzs_lsd "" UBYTE B_TRUE 1 100 0.00 1.00000000000 BIT_MASK 0x8 FORMAT "%13.11" ECU_ADDRESS 0x382145 /end MEASUREMENT
/begin MEASUREMENT B_lzs_sa "" UBYTE B_TRUE 1 100 0.00 1.00000000000 BIT_MASK 0x20 FORMAT "%13.11" ECU_ADDRESS 0x382145 /end MEASUREMENT
/begin MEASUREMENT B_m8te "" UBYTE B_TRUE 1 100 0.00 1.00000000000 BIT_MASK 0x1 FORMAT "%13.11" ECU_ADDRESS 0xF06D3 /end MEASUREMENT
/begin MEASUREMENT B_m9cvnclr "" UBYTE B_TRUE 1 100 0.00 1.00000000000 BIT_MASK 0x2 FORMAT "%13.11" ECU_ADDRESS 0xF06D3 /end MEASUREMENT
/begin MEASUREMENT B_mbst "" UWORD B_TRUE 1 100 0.00 1.00000000000 BIT_MASK 0x1 FORMAT "%13.11" ECU_ADDRESS 0xFDAC /end MEASUREMENT
/begin MEASUREMENT B_mdbglst "" UWORD B_TRUE 1 100 0.00 1.00000000000 BIT_MASK 0x2 FORMAT "%13.11" ECU_ADDRESS 0xFDAC /end MEASUREMENT
/begin MEASUREMENT B_mdblst "" UWORD B_TRUE 1 100 0.00 1.00000000000 BIT_MASK 0x4 FORMAT "%13.11" ECU_ADDRESS 0xFDAC /end MEASUREMENT
/begin MEASUREMENT B_mdbresl "" UWORD B_TRUE 1 100 0.00 1.00000000000 BIT_MASK 0x8 FORMAT "%13.11" ECU_ADDRESS 0xFDAC /end MEASUREMENT
/begin MEASUREMENT B_mdbza "" UWORD B_TRUE 1 100 0.00 1.00000000000 BIT_MASK 0x10 FORMAT "%13.11" ECU_ADDRESS 0xFDAC /end MEASUREMENT
/begin MEASUREMENT B_mde8e "" UWORD B_TRUE 1 100 0.00 1.00000000000 BIT_MASK 0x10 FORMAT "%13.11" ECU_ADDRESS 0xFD04 /end MEASUREMENT
/begin MEASUREMENT B_mde9e "" UWORD B_TRUE 1 100 0.00 1.00000000000 BIT_MASK 0x20 FORMAT "%13.11" ECU_ADDRESS 0xFD04 /end MEASUREMENT
/begin MEASUREMENT B_motstop "" UWORD B_TRUE 1 100 0.00 1.00000000000 BIT_MASK 0x80 FORMAT "%13.11" ECU_ADDRESS 0xFD40 /end MEASUREMENT
/begin MEASUREMENT B_msloff "" UWORD B_TRUE 1 100 0.00 1.00000000000 BIT_MASK 0x80 FORMAT "%13.11" ECU_ADDRESS 0xFD18 /end MEASUREMENT
/begin MEASUREMENT B_mslon "" UWORD B_TRUE 1 100 0.00 1.00000000000 BIT_MASK 0x100 FORMAT "%13.11" ECU_ADDRESS 0xFD18 /end MEASUREMENT
/begin MEASUREMENT B_mt "" UWORD B_TRUE 1 100 0.00 1.00000000000 BIT_MASK 0x40 FORMAT "%13.11" ECU_ADDRESS 0xFD04 /end MEASUREMENT
/begin MEASUREMENT B_mzns "" UWORD B_TRUE 1 100 0.00 1.00000000000 BIT_MASK 0x20 FORMAT "%13.11" ECU_ADDRESS 0xFDAC /end MEASUREMENT
/begin MEASUREMENT B_nachl "" UWORD B_TRUE 1 100 0.00 1.00000000000 BIT_MASK 0x8000 FORMAT "%13.11" ECU_ADDRESS 0x382F3A /end MEASUREMENT
/begin MEASUREMENT B_nachlend "" UWORD B_TRUE 1 100 0.00 1.00000000000 BIT_MASK 0x4000 FORMAT "%13.11" ECU_ADDRESS 0x382F3A /end MEASUREMENT
/begin MEASUREMENT B_nachlram "" UWORD B_TRUE 1 100 0.00 1.00000000000 BIT_MASK 0x40 FORMAT "%13.11" ECU_ADDRESS 0xFDAE /end MEASUREMENT
/begin MEASUREMENT B_nachlstp "" UWORD B_TRUE 1 100 0.00 1.00000000000 BIT_MASK 0x2000 FORMAT "%13.11" ECU_ADDRESS 0x382F3A /end MEASUREMENT
/begin MEASUREMENT B_niveau "" UWORD B_TRUE 1 100 0.00 1.00000000000 BIT_MASK 0x80 FORMAT "%13.11" ECU_ADDRESS 0xFD04 /end MEASUREMENT
/begin MEASUREMENT B_nlacls "" UWORD B_TRUE 1 100 0.00 1.00000000000 BIT_MASK 0x2 FORMAT "%13.11" ECU_ADDRESS 0x382F3A /end MEASUREMENT
/begin MEASUREMENT B_nlale "" UWORD B_TRUE 1 100 0.00 1.00000000000 BIT_MASK 0x1 FORMAT "%13.11" ECU_ADDRESS 0x382F3A /end MEASUREMENT
/begin MEASUREMENT B_nlatm "" UWORD B_TRUE 1 100 0.00 1.00000000000 BIT_MASK 0x800 FORMAT "%13.11" ECU_ADDRESS 0x382F3A /end MEASUREMENT
/begin MEASUREMENT B_nlcan "" UWORD B_TRUE 1 100 0.00 1.00000000000 BIT_MASK 0x200 FORMAT "%13.11" ECU_ADDRESS 0x382F3A /end MEASUREMENT
/begin MEASUREMENT B_nldtafx "" UWORD B_TRUE 1 100 0.00 1.00000000000 BIT_MASK 0x8 FORMAT "%13.11" ECU_ADDRESS 0x382F38 /end MEASUREMENT
/begin MEASUREMENT B_nldte "" UWORD B_TRUE 1 100 0.00 1.00000000000 BIT_MASK 0x100 FORMAT "%13.11" ECU_ADDRESS 0x382F3A /end MEASUREMENT
/begin MEASUREMENT B_nldval "" UWORD B_TRUE 1 100 0.00 1.00000000000 BIT_MASK 0x1 FORMAT "%13.11" ECU_ADDRESS 0x382F38 /end MEASUREMENT
/begin MEASUREMENT B_nldve "" UWORD B_TRUE 1 100 0.00 1.00000000000 BIT_MASK 0x1000 FORMAT "%13.11" ECU_ADDRESS 0x382F3A /end MEASUREMENT
/begin MEASUREMENT B_nlEEPR "" UWORD B_TRUE 1 100 0.00 1.00000000000 BIT_MASK 0x20 FORMAT "%13.11" ECU_ADDRESS 0x382F3A /end MEASUREMENT
/begin MEASUREMENT B_nletm "" UWORD B_TRUE 1 100 0.00 1.00000000000 BIT_MASK 0x4 FORMAT "%13.11" ECU_ADDRESS 0x382F38 /end MEASUREMENT
/begin MEASUREMENT B_nlmls "" UWORD B_TRUE 1 100 0.00 1.00000000000 BIT_MASK 0x8 FORMAT "%13.11" ECU_ADDRESS 0x382F3A /end MEASUREMENT
/begin MEASUREMENT B_nlobd "" UWORD B_TRUE 1 100 0.00 1.00000000000 BIT_MASK 0x10 FORMAT "%13.11" ECU_ADDRESS 0x382F3A /end MEASUREMENT
/begin MEASUREMENT B_nlph "" UWORD B_TRUE 1 100 0.00 1.00000000000 BIT_MASK 0x10 FORMAT "%13.11" ECU_ADDRESS 0xFD42 /end MEASUREMENT
/begin MEASUREMENT B_nlsgls "" UWORD B_TRUE 1 100 0.00 1.00000000000 BIT_MASK 0x40 FORMAT "%13.11" ECU_ADDRESS 0x382F3A /end MEASUREMENT
/begin MEASUREMENT B_nlsiko "" UWORD B_TRUE 1 100 0.00 1.00000000000 BIT_MASK 0x80 FORMAT "%13.11" ECU_ADDRESS 0x382F3A /end MEASUREMENT
/begin MEASUREMENT B_nlubr "" UWORD B_TRUE 1 100 0.00 1.00000000000 BIT_MASK 0x2 FORMAT "%13.11" ECU_ADDRESS 0x382F38 /end MEASUREMENT
/begin MEASUREMENT B_nlwfs "" UWORD B_TRUE 1 100 0.00 1.00000000000 BIT_MASK 0x400 FORMAT "%13.11" ECU_ADDRESS 0x382F3A /end MEASUREMENT
/begin MEASUREMENT B_nlwst "" UWORD B_TRUE 1 100 0.00 1.00000000000 BIT_MASK 0x4 FORMAT "%13.11" ECU_ADDRESS 0x382F3A /end MEASUREMENT
/begin MEASUREMENT B_nmax "" UWORD B_TRUE 1 100 0.00 1.00000000000 BIT_MASK 0x400 FORMAT "%13.11" ECU_ADDRESS 0xFDAA /end MEASUREMENT
/begin MEASUREMENT B_nmaxd "" UWORD B_TRUE 1 100 0.00 1.00000000000 BIT_MASK 0x800 FORMAT "%13.11" ECU_ADDRESS 0xFDAA /end MEASUREMENT
/begin MEASUREMENT B_nmaxog "" UBYTE B_TRUE 1 100 0.00 1.00000000000 BIT_MASK 0x1 FORMAT "%13.11" ECU_ADDRESS 0xF0B3F /end MEASUREMENT
/begin MEASUREMENT B_nmxkr "" UBYTE B_TRUE 1 100 0.00 1.00000000000 BIT_MASK 0x2 FORMAT "%13.11" ECU_ADDRESS 0xF0B3F /end MEASUREMENT
/begin MEASUREMENT B_noknldg "" UWORD B_TRUE 1 100 0.00 1.00000000000 BIT_MASK 0x40 FORMAT "%13.11" ECU_ADDRESS 0xFD48 /end MEASUREMENT
/begin MEASUREMENT B_nosynph "" UWORD B_TRUE 1 100 0.00 1.00000000000 BIT_MASK 0x20 FORMAT "%13.11" ECU_ADDRESS 0xFD42 /end MEASUREMENT
/begin MEASUREMENT B_notlu_fr "" UWORD B_TRUE 1 100 0.00 1.00000000000 BIT_MASK 0x1 FORMAT "%13.11" ECU_ADDRESS 0xFD62 /end MEASUREMENT
/begin MEASUREMENT B_nozwe "" UWORD B_TRUE 1 100 0.00 1.00000000000 BIT_MASK 0x20 FORMAT "%13.11" ECU_ADDRESS 0xFDC4 /end MEASUREMENT
/begin MEASUREMENT B_nsakt "" UWORD B_TRUE 1 100 0.00 1.00000000000 BIT_MASK 0x40 FORMAT "%13.11" ECU_ADDRESS 0xFDAC /end MEASUREMENT
/begin MEASUREMENT B_nsend "" UWORD B_TRUE 1 100 0.00 1.00000000000 BIT_MASK 0x80 FORMAT "%13.11" ECU_ADDRESS 0xFDAC /end MEASUREMENT
/begin MEASUREMENT B_nswo1 "" UWORD B_TRUE 1 100 0.00 1.00000000000 BIT_MASK 0x100 FORMAT "%13.11" ECU_ADDRESS 0xFD04 /end MEASUREMENT
/begin MEASUREMENT B_nswo2 "" UWORD B_TRUE 1 100 0.00 1.00000000000 BIT_MASK 0x200 FORMAT "%13.11" ECU_ADDRESS 0xFD04 /end MEASUREMENT
/begin MEASUREMENT B_nwilpa "" UBYTE B_TRUE 1 100 0.00 1.00000000000 BIT_MASK 0x8 FORMAT "%13.11" ECU_ADDRESS 0xF0BE6 /end MEASUREMENT
/begin MEASUREMENT B_nwllna "" UWORD B_TRUE 1 100 0.00 1.00000000000 BIT_MASK 0x4000 FORMAT "%13.11" ECU_ADDRESS 0xFDBE /end MEASUREMENT
/begin MEASUREMENT B_nwlva "" UBYTE B_TRUE 1 100 0.00 1.00000000000 BIT_MASK 0x4 FORMAT "%13.11" ECU_ADDRESS 0xF0BE5 /end MEASUREMENT
/begin MEASUREMENT B_nwlva2 "" UBYTE B_TRUE 1 100 0.00 1.00000000000 BIT_MASK 0x8 FORMAT "%13.11" ECU_ADDRESS 0xF0BE5 /end MEASUREMENT
/begin MEASUREMENT B_nwlve "" UBYTE B_TRUE 1 100 0.00 1.00000000000 BIT_MASK 0x1 FORMAT "%13.11" ECU_ADDRESS 0xF0BE5 /end MEASUREMENT
/begin MEASUREMENT B_nwlve2 "" UBYTE B_TRUE 1 100 0.00 1.00000000000 BIT_MASK 0x2 FORMAT "%13.11" ECU_ADDRESS 0xF0BE5 /end MEASUREMENT
/begin MEASUREMENT B_nwlvrpa "" UBYTE B_TRUE 1 100 0.00 1.00000000000 BIT_MASK 0x10 FORMAT "%13.11" ECU_ADDRESS 0xF0BE6 /end MEASUREMENT
/begin MEASUREMENT B_nwrllna "" UWORD B_TRUE 1 100 0.00 1.00000000000 BIT_MASK 0x8000 FORMAT "%13.11" ECU_ADDRESS 0xFDBE /end MEASUREMENT
/begin MEASUREMENT B_nwsapspa "" UBYTE B_TRUE 1 100 0.00 1.00000000000 BIT_MASK 0x1 FORMAT "%13.11" ECU_ADDRESS 0xF0C20 /end MEASUREMENT
/begin MEASUREMENT B_nwsapspe "" UBYTE B_TRUE 1 100 0.00 1.00000000000 BIT_MASK 0x1 FORMAT "%13.11" ECU_ADDRESS 0xF0C04 /end MEASUREMENT
/begin MEASUREMENT B_nwsbgla "" UWORD B_TRUE 1 100 0.00 1.00000000000 BIT_MASK 0x2 FORMAT "%13.11" ECU_ADDRESS 0xFDC2 /end MEASUREMENT
/begin MEASUREMENT B_nwsbgle "" UWORD B_TRUE 1 100 0.00 1.00000000000 BIT_MASK 0x80 FORMAT "%13.11" ECU_ADDRESS 0xFDC0 /end MEASUREMENT
/begin MEASUREMENT B_nwsebd "" UBYTE B_TRUE 1 100 0.00 1.00000000000 BIT_MASK 0x1 FORMAT "%13.11" ECU_ADDRESS 0xF0C0B /end MEASUREMENT
/begin MEASUREMENT B_nwseva "" UWORD B_TRUE 1 100 0.00 1.00000000000 BIT_MASK 0x1 FORMAT "%13.11" ECU_ADDRESS 0xFDC0 /end MEASUREMENT
/begin MEASUREMENT B_nwseve "" UWORD B_TRUE 1 100 0.00 1.00000000000 BIT_MASK 0x2 FORMAT "%13.11" ECU_ADDRESS 0xFDC0 /end MEASUREMENT
/begin MEASUREMENT B_nwshka "" UBYTE B_TRUE 1 100 0.00 1.00000000000 BIT_MASK 0x10 FORMAT "%13.11" ECU_ADDRESS 0xF0BE2 /end MEASUREMENT
/begin MEASUREMENT B_nwshkaa "" UBYTE B_TRUE 1 100 0.00 1.00000000000 BIT_MASK 0x20 FORMAT "%13.11" ECU_ADDRESS 0xF0BE2 /end MEASUREMENT
/begin MEASUREMENT B_nwshkae "" UBYTE B_TRUE 1 100 0.00 1.00000000000 BIT_MASK 0x40 FORMAT "%13.11" ECU_ADDRESS 0xF0BE2 /end MEASUREMENT
/begin MEASUREMENT B_nwshkapa "" UBYTE B_TRUE 1 100 0.00 1.00000000000 BIT_MASK 0x80 FORMAT "%13.11" ECU_ADDRESS 0xF0BE2 /end MEASUREMENT
/begin MEASUREMENT B_nwshkape "" UBYTE B_TRUE 1 100 0.00 1.00000000000 BIT_MASK 0x1 FORMAT "%13.11" ECU_ADDRESS 0xF0BE3 /end MEASUREMENT
/begin MEASUREMENT B_nwshke "" UBYTE B_TRUE 1 100 0.00 1.00000000000 BIT_MASK 0x2 FORMAT "%13.11" ECU_ADDRESS 0xF0BE3 /end MEASUREMENT
/begin MEASUREMENT B_nwshko "" UBYTE B_TRUE 1 100 0.00 1.00000000000 BIT_MASK 0x4 FORMAT "%13.11" ECU_ADDRESS 0xF0BE3 /end MEASUREMENT
/begin MEASUREMENT B_nwshkrpa "" UBYTE B_TRUE 1 100 0.00 1.00000000000 BIT_MASK 0x8 FORMAT "%13.11" ECU_ADDRESS 0xF0BE3 /end MEASUREMENT
/begin MEASUREMENT B_nwshkrpe "" UBYTE B_TRUE 1 100 0.00 1.00000000000 BIT_MASK 0x10 FORMAT "%13.11" ECU_ADDRESS 0xF0BE3 /end MEASUREMENT
/begin MEASUREMENT B_nwshkta "" UBYTE B_TRUE 1 100 0.00 1.00000000000 BIT_MASK 0x20 FORMAT "%13.11" ECU_ADDRESS 0xF0BE3 /end MEASUREMENT
/begin MEASUREMENT B_nwshkte "" UBYTE B_TRUE 1 100 0.00 1.00000000000 BIT_MASK 0x40 FORMAT "%13.11" ECU_ADDRESS 0xF0BE3 /end MEASUREMENT
/begin MEASUREMENT B_nwsilpa "" UBYTE B_TRUE 1 100 0.00 1.00000000000 BIT_MASK 0x1 FORMAT "%13.11" ECU_ADDRESS 0xF0BE7 /end MEASUREMENT
/begin MEASUREMENT B_nwslla "" UBYTE B_TRUE 1 100 0.00 1.00000000000 BIT_MASK 0x1 FORMAT "%13.11" ECU_ADDRESS 0xF0C1F /end MEASUREMENT
/begin MEASUREMENT B_nwstpa "" UBYTE B_TRUE 1 100 0.00 1.00000000000 BIT_MASK 0x1 FORMAT "%13.11" ECU_ADDRESS 0xF0BE1 /end MEASUREMENT
/begin MEASUREMENT B_nwswg "" UBYTE B_TRUE 1 100 0.00 1.00000000000 BIT_MASK 0x1 FORMAT "%13.11" ECU_ADDRESS 0xF0BD0 /end MEASUREMENT
/begin MEASUREMENT B_nwsyna "" UWORD B_TRUE 1 100 0.00 1.00000000000 BIT_MASK 0x4 FORMAT "%13.11" ECU_ADDRESS 0xFDC0 /end MEASUREMENT
/begin MEASUREMENT B_nwsyne "" UWORD B_TRUE 1 100 0.00 1.00000000000 BIT_MASK 0x8 FORMAT "%13.11" ECU_ADDRESS 0xFDC0 /end MEASUREMENT
/begin MEASUREMENT B_optpherk "" UWORD B_TRUE 1 100 0.00 1.00000000000 BIT_MASK 0x40 FORMAT "%13.11" ECU_ADDRESS 0xFD42 /end MEASUREMENT
/begin MEASUREMENT B_phfalse "" UWORD B_TRUE 1 100 0.00 1.00000000000 BIT_MASK 0x80 FORMAT "%13.11" ECU_ADDRESS 0xFD48 /end MEASUREMENT
/begin MEASUREMENT B_phnldg "" UWORD B_TRUE 1 100 0.00 1.00000000000 BIT_MASK 0x100 FORMAT "%13.11" ECU_ADDRESS 0xFD48 /end MEASUREMENT
/begin MEASUREMENT B_phsnl "" UWORD B_TRUE 1 100 0.00 1.00000000000 BIT_MASK 0x80 FORMAT "%13.11" ECU_ADDRESS 0xFD42 /end MEASUREMENT
/begin MEASUREMENT B_phsnlab "" UWORD B_TRUE 1 100 0.00 1.00000000000 BIT_MASK 0x100 FORMAT "%13.11" ECU_ADDRESS 0xFD42 /end MEASUREMENT
/begin MEASUREMENT B_phsnlinv "" UWORD B_TRUE 1 100 0.00 1.00000000000 BIT_MASK 0x200 FORMAT "%13.11" ECU_ADDRESS 0xFD42 /end MEASUREMENT
/begin MEASUREMENT B_phsnlok "" UWORD B_TRUE 1 100 0.00 1.00000000000 BIT_MASK 0x400 FORMAT "%13.11" ECU_ADDRESS 0xFD42 /end MEASUREMENT
/begin MEASUREMENT B_plsolap "" UWORD B_TRUE 1 100 0.00 1.00000000000 BIT_MASK 0x400 FORMAT "%13.11" ECU_ADDRESS 0xFD04 /end MEASUREMENT
/begin MEASUREMENT B_png "" UWORD B_TRUE 1 100 0.00 1.00000000000 BIT_MASK 0x800 FORMAT "%13.11" ECU_ADDRESS 0xFD04 /end MEASUREMENT
/begin MEASUREMENT B_pwf "" UWORD B_TRUE 1 100 0.00 1.00000000000 BIT_MASK 0x10 FORMAT "%13.11" ECU_ADDRESS 0xFD08 /end MEASUREMENT
/begin MEASUREMENT B_pwfCsErr "" UWORD B_TRUE 1 100 0.00 1.00000000000 BIT_MASK 0x20 FORMAT "%13.11" ECU_ADDRESS 0xFD08 /end MEASUREMENT
/begin MEASUREMENT B_rdeplaus "" UWORD B_TRUE 1 100 0.00 1.00000000000 BIT_MASK 0x100 FORMAT "%13.11" ECU_ADDRESS 0xFD40 /end MEASUREMENT
/begin MEASUREMENT B_rdeundef "" UWORD B_TRUE 1 100 0.00 1.00000000000 BIT_MASK 0x200 FORMAT "%13.11" ECU_ADDRESS 0xFD40 /end MEASUREMENT
/begin MEASUREMENT B_resetsyn "" UWORD B_TRUE 1 100 0.00 1.00000000000 BIT_MASK 0x200 FORMAT "%13.11" ECU_ADDRESS 0xFD48 /end MEASUREMENT
/begin MEASUREMENT B_rphsp "" UWORD B_TRUE 1 100 0.00 1.00000000000 BIT_MASK 0x400 FORMAT "%13.11" ECU_ADDRESS 0xFD48 /end MEASUREMENT
/begin MEASUREMENT B_shken "" UBYTE B_TRUE 1 100 0.00 1.00000000000 BIT_MASK 0x80 FORMAT "%13.11" ECU_ADDRESS 0xF0BE3 /end MEASUREMENT
/begin MEASUREMENT B_sldsl4 "" UBYTE B_TRUE 1 100 0.00 1.00000000000 BIT_MASK 0x4 FORMAT "%13.11" ECU_ADDRESS 0xF05D4 /end MEASUREMENT
/begin MEASUREMENT B_slkhof "" UWORD B_TRUE 1 100 0.00 1.00000000000 BIT_MASK 0x200 FORMAT "%13.11" ECU_ADDRESS 0xFD18 /end MEASUREMENT
/begin MEASUREMENT B_slkt "" UBYTE B_TRUE 1 100 0.00 1.00000000000 BIT_MASK 0x8 FORMAT "%13.11" ECU_ADDRESS 0xF05D4 /end MEASUREMENT
/begin MEASUREMENT B_slp "" UWORD B_TRUE 1 100 0.00 1.00000000000 BIT_MASK 0x400 FORMAT "%13.11" ECU_ADDRESS 0xFD18 /end MEASUREMENT
/begin MEASUREMENT B_slp2 "" UWORD B_TRUE 1 100 0.00 1.00000000000 BIT_MASK 0x800 FORMAT "%13.11" ECU_ADDRESS 0xFD18 /end MEASUREMENT
/begin MEASUREMENT B_slpanst "" UBYTE B_TRUE 1 100 0.00 1.00000000000 BIT_MASK 0x2 FORMAT "%13.11" ECU_ADDRESS 0xF05D5 /end MEASUREMENT
/begin MEASUREMENT B_slpena "" UBYTE B_TRUE 1 100 0.00 1.00000000000 BIT_MASK 0x10 FORMAT "%13.11" ECU_ADDRESS 0xF05D4 /end MEASUREMENT
/begin MEASUREMENT B_slpmn "" UWORD B_TRUE 1 100 0.00 1.00000000000 BIT_MASK 0x1000 FORMAT "%13.11" ECU_ADDRESS 0xFD18 /end MEASUREMENT
/begin MEASUREMENT B_slpmn2 "" UWORD B_TRUE 1 100 0.00 1.00000000000 BIT_MASK 0x2000 FORMAT "%13.11" ECU_ADDRESS 0xFD18 /end MEASUREMENT
/begin MEASUREMENT B_slpoff "" UWORD B_TRUE 1 100 0.00 1.00000000000 BIT_MASK 0x4000 FORMAT "%13.11" ECU_ADDRESS 0xFD18 /end MEASUREMENT
/begin MEASUREMENT B_slpofst "" UBYTE B_TRUE 1 100 0.00 1.00000000000 BIT_MASK 0x20 FORMAT "%13.11" ECU_ADDRESS 0xF05D4 /end MEASUREMENT
/begin MEASUREMENT B_sls "" UWORD B_TRUE 1 100 0.00 1.00000000000 BIT_MASK 0x8000 FORMAT "%13.11" ECU_ADDRESS 0xFD18 /end MEASUREMENT
/begin MEASUREMENT B_slsadap "" UWORD B_TRUE 1 100 0.00 1.00000000000 BIT_MASK 0x1 FORMAT "%13.11" ECU_ADDRESS 0xFD1A /end MEASUREMENT
/begin MEASUREMENT B_slsdis "" UBYTE B_TRUE 1 100 0.00 1.00000000000 BIT_MASK 0x80 FORMAT "%13.11" ECU_ADDRESS 0xF05D4 /end MEASUREMENT
/begin MEASUREMENT B_slserr "" UBYTE B_TRUE 1 100 0.00 1.00000000000 BIT_MASK 0x1 FORMAT "%13.11" ECU_ADDRESS 0xF05D5 /end MEASUREMENT
/begin MEASUREMENT B_slsfz "" UWORD B_TRUE 1 100 0.00 1.00000000000 BIT_MASK 0x1000 FORMAT "%13.11" ECU_ADDRESS 0xFD04 /end MEASUREMENT
/begin MEASUREMENT B_slsinhi "" UBYTE B_TRUE 1 100 0.00 1.00000000000 BIT_MASK 0x40 FORMAT "%13.11" ECU_ADDRESS 0xF05D4 /end MEASUREMENT
/begin MEASUREMENT B_slsoab "" UWORD B_TRUE 1 100 0.00 1.00000000000 BIT_MASK 0x2 FORMAT "%13.11" ECU_ADDRESS 0xFD1A /end MEASUREMENT
/begin MEASUREMENT B_slsoff "" UWORD B_TRUE 1 100 0.00 1.00000000000 BIT_MASK 0x4 FORMAT "%13.11" ECU_ADDRESS 0xFD1A /end MEASUREMENT
/begin MEASUREMENT B_slv "" UWORD B_TRUE 1 100 0.00 1.00000000000 BIT_MASK 0x8 FORMAT "%13.11" ECU_ADDRESS 0xFD1A /end MEASUREMENT
/begin MEASUREMENT B_stat1to2a "" UBYTE B_TRUE 1 100 0.00 1.00000000000 BIT_MASK 0x1 FORMAT "%13.11" ECU_ADDRESS 0xF0BE4 /end MEASUREMENT
/begin MEASUREMENT B_stat1to2e "" UBYTE B_TRUE 1 100 0.00 1.00000000000 BIT_MASK 0x4 FORMAT "%13.11" ECU_ADDRESS 0xF0BE4 /end MEASUREMENT
/begin MEASUREMENT B_stat2to1a "" UBYTE B_TRUE 1 100 0.00 1.00000000000 BIT_MASK 0x2 FORMAT "%13.11" ECU_ADDRESS 0xF0BE4 /end MEASUREMENT
/begin MEASUREMENT B_stat2to1e "" UBYTE B_TRUE 1 100 0.00 1.00000000000 BIT_MASK 0x8 FORMAT "%13.11" ECU_ADDRESS 0xF0BE4 /end MEASUREMENT
/begin MEASUREMENT B_stimnlph "" UWORD B_TRUE 1 100 0.00 1.00000000000 BIT_MASK 0x800 FORMAT "%13.11" ECU_ADDRESS 0xFD42 /end MEASUREMENT
/begin MEASUREMENT B_stpsyna "" UWORD B_TRUE 1 100 0.00 1.00000000000 BIT_MASK 0x10 FORMAT "%13.11" ECU_ADDRESS 0xFDC0 /end MEASUREMENT
/begin MEASUREMENT B_stpsyne "" UWORD B_TRUE 1 100 0.00 1.00000000000 BIT_MASK 0x20 FORMAT "%13.11" ECU_ADDRESS 0xFDC0 /end MEASUREMENT
/begin MEASUREMENT B_sunw "" UBYTE B_TRUE 1 100 0.00 1.00000000000 BIT_MASK 0x1 FORMAT "%13.11" ECU_ADDRESS 0xF0C03 /end MEASUREMENT
/begin MEASUREMENT B_synnldg "" UWORD B_TRUE 1 100 0.00 1.00000000000 BIT_MASK 0x800 FORMAT "%13.11" ECU_ADDRESS 0xFD48 /end MEASUREMENT
/begin MEASUREMENT B_synoknl "" UWORD B_TRUE 1 100 0.00 1.00000000000 BIT_MASK 0x1000 FORMAT "%13.11" ECU_ADDRESS 0xFD48 /end MEASUREMENT
/begin MEASUREMENT B_temin "" UWORD B_TRUE 1 100 0.00 1.00000000000 BIT_MASK 0x40 FORMAT "%13.11" ECU_ADDRESS 0xFD70 /end MEASUREMENT
/begin MEASUREMENT B_temin2 "" UWORD B_TRUE 1 100 0.00 1.00000000000 BIT_MASK 0x80 FORMAT "%13.11" ECU_ADDRESS 0xFD70 /end MEASUREMENT
/begin MEASUREMENT B_tfu "" UWORD B_TRUE 1 100 0.00 1.00000000000 BIT_MASK 0x2000 FORMAT "%13.11" ECU_ADDRESS 0xFD04 /end MEASUREMENT
/begin MEASUREMENT B_tmnmax "" UBYTE B_TRUE 1 100 0.00 1.00000000000 BIT_MASK 0x4 FORMAT "%13.11" ECU_ADDRESS 0xF0B3F /end MEASUREMENT
/begin MEASUREMENT B_tnwlva "" UBYTE B_TRUE 1 100 0.00 1.00000000000 BIT_MASK 0x4 FORMAT "%13.11" ECU_ADDRESS 0xF0BE6 /end MEASUREMENT
/begin MEASUREMENT B_toelnwha "" UBYTE B_TRUE 1 100 0.00 1.00000000000 BIT_MASK 0x8 FORMAT "%13.11" ECU_ADDRESS 0xF0C20 /end MEASUREMENT
/begin MEASUREMENT B_tostat1a "" UBYTE B_TRUE 1 100 0.00 1.00000000000 BIT_MASK 0x10 FORMAT "%13.11" ECU_ADDRESS 0xF0BE4 /end MEASUREMENT
/begin MEASUREMENT B_tostat1e "" UBYTE B_TRUE 1 100 0.00 1.00000000000 BIT_MASK 0x40 FORMAT "%13.11" ECU_ADDRESS 0xF0BE4 /end MEASUREMENT
/begin MEASUREMENT B_tostat2a "" UBYTE B_TRUE 1 100 0.00 1.00000000000 BIT_MASK 0x20 FORMAT "%13.11" ECU_ADDRESS 0xF0BE4 /end MEASUREMENT
/begin MEASUREMENT B_tostat2e "" UBYTE B_TRUE 1 100 0.00 1.00000000000 BIT_MASK 0x80 FORMAT "%13.11" ECU_ADDRESS 0xF0BE4 /end MEASUREMENT
/begin MEASUREMENT B_uhrrmin "" UWORD B_TRUE 1 100 0.00 1.00000000000 BIT_MASK 0x4000 FORMAT "%13.11" ECU_ADDRESS 0xFD04 /end MEASUREMENT
/begin MEASUREMENT B_uhrrsec "" UWORD B_TRUE 1 100 0.00 1.00000000000 BIT_MASK 0x8000 FORMAT "%13.11" ECU_ADDRESS 0xFD04 /end MEASUREMENT
/begin MEASUREMENT B_verrueck "" UBYTE B_TRUE 1 100 0.00 1.00000000000 BIT_MASK 0x2 FORMAT "%13.11" ECU_ADDRESS 0xF06EE /end MEASUREMENT
/begin MEASUREMENT B_waitgap "" UBYTE B_TRUE 1 100 0.00 1.00000000000 BIT_MASK 0x4 FORMAT "%13.11" ECU_ADDRESS 0xF06EE /end MEASUREMENT
/begin MEASUREMENT B_wdksap "" UWORD B_TRUE 1 100 0.00 1.00000000000 BIT_MASK 0x1 FORMAT "%13.11" ECU_ADDRESS 0xFD06 /end MEASUREMENT
/begin MEASUREMENT B_wnstvhe "" UWORD B_TRUE 1 100 0.00 1.00000000000 BIT_MASK 0x40 FORMAT "%13.11" ECU_ADDRESS 0xFDC0 /end MEASUREMENT
/begin MEASUREMENT B_wnwioutx "" UWORD B_TRUE 1 100 0.00 1.00000000000 BIT_MASK 0x2000 FORMAT "%13.11" ECU_ADDRESS 0xFD48 /end MEASUREMENT
/begin MEASUREMENT B_wnws0a "" UWORD B_TRUE 1 100 0.00 1.00000000000 BIT_MASK 0x4 FORMAT "%13.11" ECU_ADDRESS 0xFDC2 /end MEASUREMENT
/begin MEASUREMENT B_wnws0e "" UBYTE B_TRUE 1 100 0.00 1.00000000000 BIT_MASK 0x1 FORMAT "%13.11" ECU_ADDRESS 0xF0C02 /end MEASUREMENT
/begin MEASUREMENT B_zwappl "" UWORD B_TRUE 1 100 0.00 1.00000000000 BIT_MASK 0x2 FORMAT "%13.11" ECU_ADDRESS 0xFD06 /end MEASUREMENT
/begin MEASUREMENT B_zwvzm "" UWORD B_TRUE 1 100 0.00 1.00000000000 BIT_MASK 0x40 FORMAT "%13.11" ECU_ADDRESS 0xFDC4 /end MEASUREMENT
/begin MEASUREMENT cd_bits1_w "" UWORD dez 1 100 0.00 65535.00 FORMAT "%8.2" ECU_ADDRESS 0xF0CA4 /end MEASUREMENT
/begin MEASUREMENT cd_bits2_w "" UWORD dez 1 100 0.00 65535.00 FORMAT "%8.2" ECU_ADDRESS 0xF0CA6 /end MEASUREMENT
/begin MEASUREMENT cd_bits3_w "" UWORD dez 1 100 0.00 65535.00 FORMAT "%8.2" ECU_ADDRESS 0xF0CA8 /end MEASUREMENT
/begin MEASUREMENT cd_bits4_w "" UWORD dez 1 100 0.00 65535.00 FORMAT "%8.2" ECU_ADDRESS 0xF0CAA /end MEASUREMENT
/begin MEASUREMENT cntbg_w "" UWORD dez 1 100 0.00 65535.00 FORMAT "%8.2" ECU_ADDRESS 0xF2676 /end MEASUREMENT
/begin MEASUREMENT ctrshknwa "" UBYTE dez 1 100 0.00 255.0 FORMAT "%5.1" ECU_ADDRESS 0xF0BDF /end MEASUREMENT
/begin MEASUREMENT ctrshknwe "" UBYTE dez 1 100 0.00 255.0 FORMAT "%5.1" ECU_ADDRESS 0xF0BE0 /end MEASUREMENT
/begin MEASUREMENT ctr_anwva "" UBYTE dez 1 100 0.00 255.0 FORMAT "%5.1" ECU_ADDRESS 0xF4197 /end MEASUREMENT
/begin MEASUREMENT ctr_anwve "" UBYTE dez 1 100 0.00 255.0 FORMAT "%5.1" ECU_ADDRESS 0xF4198 /end MEASUREMENT
/begin MEASUREMENT ctr_RSABlock "" UWORD dez 1 100 0.00 65535.00 FORMAT "%8.2" ECU_ADDRESS 0xF2674 /end MEASUREMENT
/begin MEASUREMENT cw_erfil "" UBYTE dez 1 100 0.00 255.0 FORMAT "%5.1" ECU_ADDRESS 0xF0500 /end MEASUREMENT
/begin MEASUREMENT cw_obd "" UBYTE dez 1 100 0.00 255.0 FORMAT "%5.1" ECU_ADDRESS 0xF0501 /end MEASUREMENT
/begin MEASUREMENT cyclebg_w "" UWORD runtime2_sy 1 100 0.00 838848.0 FORMAT "%8.1" ECU_ADDRESS 0xF4E56 /end MEASUREMENT
/begin MEASUREMENT dmaufr_w "" UWORD rel_uw_b100 1 100 0.00 99.99847 FORMAT "%8.5" ECU_ADDRESS 0xF2C32 /end MEASUREMENT
/begin MEASUREMENT dmnmxi_w "" UWORD rel_uw_b100 1 100 0.00 99.99847 FORMAT "%8.5" ECU_ADDRESS 0xF25A6 /end MEASUREMENT
/begin MEASUREMENT dmnmxp_w "" SWORD rel_sw_b100 1 100 -100.0000 99.99695 FORMAT "%8.4" ECU_ADDRESS 0xF25A8 /end MEASUREMENT
/begin MEASUREMENT dmrdnw_w "" UWORD rel_uw_b100 1 100 0.00 99.99847 FORMAT "%8.5" ECU_ADDRESS 0xF4F4A /end MEASUREMENT
/begin MEASUREMENT dnsi_w "" SWORD nmot_sw_q0p25 1 100 -8192.000 8191.750 FORMAT "%8.3" ECU_ADDRESS 0xF25AA /end MEASUREMENT
/begin MEASUREMENT dpsfglm_w "" SWORD p_sw_q0p039 1 100 -1280.000 1279.961 FORMAT "%8.3" ECU_ADDRESS 0xF1C82 /end MEASUREMENT
/begin MEASUREMENT dpsfg_w "" SWORD p_sw_q0p039 1 100 -1280.000 1279.961 FORMAT "%8.3" ECU_ADDRESS 0xF1C92 /end MEASUREMENT
/begin MEASUREMENT dpus_w "" SWORD p_sw_q0p078 1 100 -2560.000 2559.922 FORMAT "%8.3" ECU_ADDRESS 0xF4620 /end MEASUREMENT
/begin MEASUREMENT drl_w "" SWORD rel_sw_q0p0234 1 100 -768.0000 767.9766 FORMAT "%8.4" ECU_ADDRESS 0xF1C94 /end MEASUREMENT
/begin MEASUREMENT dtimx_w "" SWORD tinjection_sy 1 100 -104.8576 104.8544 FORMAT "%8.4" ECU_ADDRESS 0xF4622 /end MEASUREMENT
/begin MEASUREMENT dtsegph_w "" SWORD t5usxus_q5 1 100 -163840.0 163835.0 FORMAT "%8.1" ECU_ADDRESS 0xF178E /end MEASUREMENT
/begin MEASUREMENT dwnwabga_w "" UWORD kw_q0p0078 1 100 0.00 511.9922 FORMAT "%8.4" ECU_ADDRESS 0xF2BD0 /end MEASUREMENT
/begin MEASUREMENT dwnwabge_w "" UWORD kw_q0p0078 1 100 0.00 511.9922 FORMAT "%8.4" ECU_ADDRESS 0xF2B72 /end MEASUREMENT
/begin MEASUREMENT dwnwamxa_w "" UWORD kw_q0p0078 1 100 0.00 511.9922 FORMAT "%8.4" ECU_ADDRESS 0xF2BD2 /end MEASUREMENT
/begin MEASUREMENT dwnwamxe_w "" UWORD kw_q0p0078 1 100 0.00 511.9922 FORMAT "%8.4" ECU_ADDRESS 0xF2B74 /end MEASUREMENT
/begin MEASUREMENT dwnwasa2_w "" SWORD kw_sw_q0p0078 1 100 -256.0000 255.9922 FORMAT "%8.4" ECU_ADDRESS 0xF2B32 /end MEASUREMENT
/begin MEASUREMENT dwnwasa_w "" SWORD kw_sw_q0p0078 1 100 -256.0000 255.9922 FORMAT "%8.4" ECU_ADDRESS 0xF2B34 /end MEASUREMENT
/begin MEASUREMENT dwnwstpa_w "" SWORD kw_sw_q0p0078 1 100 -256.0000 255.9922 FORMAT "%8.4" ECU_ADDRESS 0xF2B36 /end MEASUREMENT
/begin MEASUREMENT dwnwsue_w "" SWORD kw_q0p0078 1 100 -256.0000 255.9922 FORMAT "%8.4" ECU_ADDRESS 0xF4F54 /end MEASUREMENT
/begin MEASUREMENT dzws "" SBYTE zw_sb_q0p75 1 100 -96.00 95.25 FORMAT "%5.2" ECU_ADDRESS 0xF0C3B /end MEASUREMENT
/begin MEASUREMENT esst_fho04esub "" UWORD dez 1 100 0.00 65535.00 FORMAT "%8.2" ECU_ADDRESS 0xF12D0 /end MEASUREMENT
/begin MEASUREMENT esst_san12esuw "" UWORD dez 1 100 0.00 65535.00 FORMAT "%8.2" ECU_ADDRESS 0xF12D2 /end MEASUREMENT
/begin MEASUREMENT esst_sdk10teub "" UWORD dez 1 100 0.00 65535.00 FORMAT "%8.2" ECU_ADDRESS 0xF4284 /end MEASUREMENT
/begin MEASUREMENT esst_sez06tmub "" UWORD dez 1 100 0.00 65535.00 FORMAT "%8.2" ECU_ADDRESS 0xF4286 /end MEASUREMENT
/begin MEASUREMENT esst_sfr05teub "" UWORD dez 1 100 0.00 65535.00 FORMAT "%8.2" ECU_ADDRESS 0xF4288 /end MEASUREMENT
/begin MEASUREMENT esst_sga06mdub "" UWORD dez 1 100 0.00 65535.00 FORMAT "%8.2" ECU_ADDRESS 0xF428A /end MEASUREMENT
/begin MEASUREMENT esst_sga08mdub "" UWORD dez 1 100 0.00 65535.00 FORMAT "%8.2" ECU_ADDRESS 0xF12D4 /end MEASUREMENT
/begin MEASUREMENT esst_sim06esuw "" UWORD dez 1 100 0.00 65535.00 FORMAT "%8.2" ECU_ADDRESS 0xF428C /end MEASUREMENT
/begin MEASUREMENT esst_sks06esub "" UWORD dez 1 100 0.00 65535.00 FORMAT "%8.2" ECU_ADDRESS 0xF12D6 /end MEASUREMENT
/begin MEASUREMENT esst_sla05esub "" UWORD dez 1 100 0.00 65535.00 FORMAT "%8.2" ECU_ADDRESS 0xF12D8 /end MEASUREMENT
/begin MEASUREMENT esst_sla09opuw "" UWORD dez 1 100 0.00 65535.00 FORMAT "%8.2" ECU_ADDRESS 0xF1316 /end MEASUREMENT
/begin MEASUREMENT esst_slx06tmuw "" UWORD dez 1 100 0.00 65535.00 FORMAT "%8.2" ECU_ADDRESS 0xF428E /end MEASUREMENT
/begin MEASUREMENT esst_sly06tmuw "" UWORD dez 1 100 0.00 65535.00 FORMAT "%8.2" ECU_ADDRESS 0xF4290 /end MEASUREMENT
/begin MEASUREMENT esst_sm108lhsw "" UWORD dez 1 100 0.00 65535.00 FORMAT "%8.2" ECU_ADDRESS 0xF4292 /end MEASUREMENT
/begin MEASUREMENT esst_sm208lhsw "" UWORD dez 1 100 0.00 65535.00 FORMAT "%8.2" ECU_ADDRESS 0xF4294 /end MEASUREMENT
/begin MEASUREMENT esst_smi04llub "" UWORD dez 1 100 0.00 65535.00 FORMAT "%8.2" ECU_ADDRESS 0xF12DA /end MEASUREMENT
/begin MEASUREMENT esst_sml05dkub "" UWORD dez 1 100 0.00 65535.00 FORMAT "%8.2" ECU_ADDRESS 0xF4296 /end MEASUREMENT
/begin MEASUREMENT esst_sml06teub "" UWORD dez 1 100 0.00 65535.00 FORMAT "%8.2" ECU_ADDRESS 0xF4298 /end MEASUREMENT
/begin MEASUREMENT esst_sml06tmuw "" UWORD dez 1 100 0.00 65535.00 FORMAT "%8.2" ECU_ADDRESS 0xF429A /end MEASUREMENT
/begin MEASUREMENT esst_sml07tmuw "" UWORD dez 1 100 0.00 65535.00 FORMAT "%8.2" ECU_ADDRESS 0xF429C /end MEASUREMENT
/begin MEASUREMENT esst_sml08lhub "" UWORD dez 1 100 0.00 65535.00 FORMAT "%8.2" ECU_ADDRESS 0xF429E /end MEASUREMENT
/begin MEASUREMENT esst_smo08mfub "" UWORD dez 1 100 0.00 65535.00 FORMAT "%8.2" ECU_ADDRESS 0xF25C0 /end MEASUREMENT
/begin MEASUREMENT esst_smt06tmuw "" UWORD dez 1 100 0.00 65535.00 FORMAT "%8.2" ECU_ADDRESS 0xF42A0 /end MEASUREMENT
/begin MEASUREMENT esst_sng06llsb "" UWORD dez 1 100 0.00 65535.00 FORMAT "%8.2" ECU_ADDRESS 0xF12DC /end MEASUREMENT
/begin MEASUREMENT esst_snm04zuub "" UWORD dez 1 100 0.00 65535.00 FORMAT "%8.2" ECU_ADDRESS 0xF1318 /end MEASUREMENT
/begin MEASUREMENT esst_snm05dkub "" UWORD dez 1 100 0.00 65535.00 FORMAT "%8.2" ECU_ADDRESS 0xF42A2 /end MEASUREMENT
/begin MEASUREMENT esst_snm06esub "" UWORD dez 1 100 0.00 65535.00 FORMAT "%8.2" ECU_ADDRESS 0xF42A4 /end MEASUREMENT
/begin MEASUREMENT esst_snm06llub "" UWORD dez 1 100 0.00 65535.00 FORMAT "%8.2" ECU_ADDRESS 0xF12DE /end MEASUREMENT
/begin MEASUREMENT esst_snm06mduw "" UWORD dez 1 100 0.00 65535.00 FORMAT "%8.2" ECU_ADDRESS 0xF42A6 /end MEASUREMENT
/begin MEASUREMENT esst_snm06nwub "" UWORD dez 1 100 0.00 65535.00 FORMAT "%8.2" ECU_ADDRESS 0xF42A8 /end MEASUREMENT
/begin MEASUREMENT esst_snm07esub "" UWORD dez 1 100 0.00 65535.00 FORMAT "%8.2" ECU_ADDRESS 0xF42AA /end MEASUREMENT
/begin MEASUREMENT esst_snm08feub "" UWORD dez 1 100 0.00 65535.00 FORMAT "%8.2" ECU_ADDRESS 0xF42AC /end MEASUREMENT
/begin MEASUREMENT esst_snm08lhub "" UWORD dez 1 100 0.00 65535.00 FORMAT "%8.2" ECU_ADDRESS 0xF42AE /end MEASUREMENT
/begin MEASUREMENT esst_snm08mfub "" UWORD dez 1 100 0.00 65535.00 FORMAT "%8.2" ECU_ADDRESS 0xF25C2 /end MEASUREMENT
/begin MEASUREMENT esst_snm08opub "" UWORD dez 1 100 0.00 65535.00 FORMAT "%8.2" ECU_ADDRESS 0xF12E0 /end MEASUREMENT
/begin MEASUREMENT esst_snm08__ub "" UWORD dez 1 100 0.00 65535.00 FORMAT "%8.2" ECU_ADDRESS 0xF42B0 /end MEASUREMENT
/begin MEASUREMENT esst_snm10lsub "" UWORD dez 1 100 0.00 65535.00 FORMAT "%8.2" ECU_ADDRESS 0xF12E2 /end MEASUREMENT
/begin MEASUREMENT esst_snm10teub "" UWORD dez 1 100 0.00 65535.00 FORMAT "%8.2" ECU_ADDRESS 0xF42B2 /end MEASUREMENT
/begin MEASUREMENT esst_snm12esub "" UWORD dez 1 100 0.00 65535.00 FORMAT "%8.2" ECU_ADDRESS 0xF12E4 /end MEASUREMENT
/begin MEASUREMENT esst_snm12feub "" UWORD dez 1 100 0.00 65535.00 FORMAT "%8.2" ECU_ADDRESS 0xF12E6 /end MEASUREMENT
/begin MEASUREMENT esst_snm16ciub "" UWORD dez 1 100 0.00 65535.00 FORMAT "%8.2" ECU_ADDRESS 0xF42B4 /end MEASUREMENT
/begin MEASUREMENT esst_snm16krdyub "" UWORD dez 1 100 0.00 65535.00 FORMAT "%8.2" ECU_ADDRESS 0xF42B6 /end MEASUREMENT
/begin MEASUREMENT esst_snm16krub "" UWORD dez 1 100 0.00 65535.00 FORMAT "%8.2" ECU_ADDRESS 0xF42B8 /end MEASUREMENT
/begin MEASUREMENT esst_snm16opuw "" UWORD dez 1 100 0.00 65535.00 FORMAT "%8.2" ECU_ADDRESS 0xF12E8 /end MEASUREMENT
/begin MEASUREMENT esst_snm16zuuw "" UWORD dez 1 100 0.00 65535.00 FORMAT "%8.2" ECU_ADDRESS 0xF12EA /end MEASUREMENT
/begin MEASUREMENT esst_snm16__uw "" UWORD dez 1 100 0.00 65535.00 FORMAT "%8.2" ECU_ADDRESS 0xF131A /end MEASUREMENT
/begin MEASUREMENT esst_sns04zusb "" UWORD dez 1 100 0.00 65535.00 FORMAT "%8.2" ECU_ADDRESS 0xF131C /end MEASUREMENT
/begin MEASUREMENT esst_sqm05teub "" UWORD dez 1 100 0.00 65535.00 FORMAT "%8.2" ECU_ADDRESS 0xF12EC /end MEASUREMENT
/begin MEASUREMENT esst_srl03krub "" UWORD dez 1 100 0.00 65535.00 FORMAT "%8.2" ECU_ADDRESS 0xF42BA /end MEASUREMENT
/begin MEASUREMENT esst_srl04krub "" UWORD dez 1 100 0.00 65535.00 FORMAT "%8.2" ECU_ADDRESS 0xF42BC /end MEASUREMENT
/begin MEASUREMENT esst_srl06esub "" UWORD dez 1 100 0.00 65535.00 FORMAT "%8.2" ECU_ADDRESS 0xF12EE /end MEASUREMENT
/begin MEASUREMENT esst_srl06krub "" UWORD dez 1 100 0.00 65535.00 FORMAT "%8.2" ECU_ADDRESS 0xF42BE /end MEASUREMENT
/begin MEASUREMENT esst_srl08dmub "" UWORD dez 1 100 0.00 65535.00 FORMAT "%8.2" ECU_ADDRESS 0xF12F0 /end MEASUREMENT
/begin MEASUREMENT esst_srl08nxub "" UWORD dez 1 100 0.00 65535.00 FORMAT "%8.2" ECU_ADDRESS 0xF42C0 /end MEASUREMENT
/begin MEASUREMENT esst_srl10lsub "" UWORD dez 1 100 0.00 65535.00 FORMAT "%8.2" ECU_ADDRESS 0xF12F2 /end MEASUREMENT
/begin MEASUREMENT esst_srl11opuw "" UWORD dez 1 100 0.00 65535.00 FORMAT "%8.2" ECU_ADDRESS 0xF131E /end MEASUREMENT
/begin MEASUREMENT esst_srl12esub "" UWORD dez 1 100 0.00 65535.00 FORMAT "%8.2" ECU_ADDRESS 0xF12F4 /end MEASUREMENT
/begin MEASUREMENT esst_srl12zuuw "" UWORD dez 1 100 0.00 65535.00 FORMAT "%8.2" ECU_ADDRESS 0xF12F6 /end MEASUREMENT
/begin MEASUREMENT esst_srp06esub "" UWORD dez 1 100 0.00 65535.00 FORMAT "%8.2" ECU_ADDRESS 0xF12F8 /end MEASUREMENT
/begin MEASUREMENT esst_srr07opuw "" UWORD dez 1 100 0.00 65535.00 FORMAT "%8.2" ECU_ADDRESS 0xF1320 /end MEASUREMENT
/begin MEASUREMENT esst_st107tmub "" UWORD dez 1 100 0.00 65535.00 FORMAT "%8.2" ECU_ADDRESS 0xF42C2 /end MEASUREMENT
/begin MEASUREMENT esst_st207tmub "" UWORD dez 1 100 0.00 65535.00 FORMAT "%8.2" ECU_ADDRESS 0xF42C4 /end MEASUREMENT
/begin MEASUREMENT esst_st307tmub "" UWORD dez 1 100 0.00 65535.00 FORMAT "%8.2" ECU_ADDRESS 0xF42C6 /end MEASUREMENT
/begin MEASUREMENT esst_st407tmub "" UWORD dez 1 100 0.00 65535.00 FORMAT "%8.2" ECU_ADDRESS 0xF42C8 /end MEASUREMENT
/begin MEASUREMENT esst_sta04llub "" UWORD dez 1 100 0.00 65535.00 FORMAT "%8.2" ECU_ADDRESS 0xF12FA /end MEASUREMENT
/begin MEASUREMENT esst_sta06esub "" UWORD dez 1 100 0.00 65535.00 FORMAT "%8.2" ECU_ADDRESS 0xF42CA /end MEASUREMENT
/begin MEASUREMENT esst_sta12esub "" UWORD dez 1 100 0.00 65535.00 FORMAT "%8.2" ECU_ADDRESS 0xF12FC /end MEASUREMENT
/begin MEASUREMENT esst_sta12wlub "" UWORD dez 1 100 0.00 65535.00 FORMAT "%8.2" ECU_ADDRESS 0xF12FE /end MEASUREMENT
/begin MEASUREMENT esst_stk04saub "" UWORD dez 1 100 0.00 65535.00 FORMAT "%8.2" ECU_ADDRESS 0xF42CC /end MEASUREMENT
/begin MEASUREMENT esst_stm04feub "" UWORD dez 1 100 0.00 65535.00 FORMAT "%8.2" ECU_ADDRESS 0xF1300 /end MEASUREMENT
/begin MEASUREMENT esst_stm04saub "" UWORD dez 1 100 0.00 65535.00 FORMAT "%8.2" ECU_ADDRESS 0xF1302 /end MEASUREMENT
/begin MEASUREMENT esst_stm04__ub "" UWORD dez 1 100 0.00 65535.00 FORMAT "%8.2" ECU_ADDRESS 0xF42CE /end MEASUREMENT
/begin MEASUREMENT esst_stm05saub "" UWORD dez 1 100 0.00 65535.00 FORMAT "%8.2" ECU_ADDRESS 0xF42D0 /end MEASUREMENT
/begin MEASUREMENT esst_stm05tmub "" UWORD dez 1 100 0.00 65535.00 FORMAT "%8.2" ECU_ADDRESS 0xF42D2 /end MEASUREMENT
/begin MEASUREMENT esst_stm06llub "" UWORD dez 1 100 0.00 65535.00 FORMAT "%8.2" ECU_ADDRESS 0xF42D4 /end MEASUREMENT
/begin MEASUREMENT esst_stm06nwub "" UWORD dez 1 100 0.00 65535.00 FORMAT "%8.2" ECU_ADDRESS 0xF42D6 /end MEASUREMENT
/begin MEASUREMENT esst_stm06__ub "" UWORD dez 1 100 0.00 65535.00 FORMAT "%8.2" ECU_ADDRESS 0xF42D8 /end MEASUREMENT
/begin MEASUREMENT esst_stm08dmub "" UWORD dez 1 100 0.00 65535.00 FORMAT "%8.2" ECU_ADDRESS 0xF1304 /end MEASUREMENT
/begin MEASUREMENT esst_stm08mdub "" UWORD dez 1 100 0.00 65535.00 FORMAT "%8.2" ECU_ADDRESS 0xF42DA /end MEASUREMENT
/begin MEASUREMENT esst_stm08mfub "" UWORD dez 1 100 0.00 65535.00 FORMAT "%8.2" ECU_ADDRESS 0xF25C4 /end MEASUREMENT
/begin MEASUREMENT esst_stm08opub "" UWORD dez 1 100 0.00 65535.00 FORMAT "%8.2" ECU_ADDRESS 0xF1306 /end MEASUREMENT
/begin MEASUREMENT esst_stm08__ub "" UWORD dez 1 100 0.00 65535.00 FORMAT "%8.2" ECU_ADDRESS 0xF42FE /end MEASUREMENT
/begin MEASUREMENT esst_stm09esub "" UWORD dez 1 100 0.00 65535.00 FORMAT "%8.2" ECU_ADDRESS 0xF42DC /end MEASUREMENT
/begin MEASUREMENT esst_stm10__ub "" UWORD dez 1 100 0.00 65535.00 FORMAT "%8.2" ECU_ADDRESS 0xF42DE /end MEASUREMENT
/begin MEASUREMENT esst_stm12esub "" UWORD dez 1 100 0.00 65535.00 FORMAT "%8.2" ECU_ADDRESS 0xF1308 /end MEASUREMENT
/begin MEASUREMENT esst_stn06llub "" UWORD dez 1 100 0.00 65535.00 FORMAT "%8.2" ECU_ADDRESS 0xF42E0 /end MEASUREMENT
/begin MEASUREMENT esst_sts08esub "" UWORD dez 1 100 0.00 65535.00 FORMAT "%8.2" ECU_ADDRESS 0xF130A /end MEASUREMENT
/begin MEASUREMENT esst_sts12esub "" UWORD dez 1 100 0.00 65535.00 FORMAT "%8.2" ECU_ADDRESS 0xF130C /end MEASUREMENT
/begin MEASUREMENT esst_sue08mfub "" UWORD dez 1 100 0.00 65535.00 FORMAT "%8.2" ECU_ADDRESS 0xF130E /end MEASUREMENT
/begin MEASUREMENT esst_suv07mdub "" UWORD dez 1 100 0.00 65535.00 FORMAT "%8.2" ECU_ADDRESS 0xF42E2 /end MEASUREMENT
/begin MEASUREMENT esst_swe07opsw "" UWORD dez 1 100 0.00 65535.00 FORMAT "%8.2" ECU_ADDRESS 0xF1322 /end MEASUREMENT
/begin MEASUREMENT esst_swp08mfub "" UWORD dez 1 100 0.00 65535.00 FORMAT "%8.2" ECU_ADDRESS 0xF25C6 /end MEASUREMENT
/begin MEASUREMENT esst_swp08opub "" UWORD dez 1 100 0.00 65535.00 FORMAT "%8.2" ECU_ADDRESS 0xF1310 /end MEASUREMENT
/begin MEASUREMENT etazws "" UBYTE rel_ub_b127p5 1 100 0.00 127.5 FORMAT "%5.1" ECU_ADDRESS 0xF0C3C /end MEASUREMENT
/begin MEASUREMENT evtmodev "" UBYTE temp_ub_q0p75_o48 1 100 -48.00 143.3 FORMAT "%5.1" ECU_ADDRESS 0xF40E4 /end MEASUREMENT
/begin MEASUREMENT flamsl2_w "" UWORD fak_uw_b16 1 100 0.00 15.99976 FORMAT "%8.5" ECU_ADDRESS 0xF4322 /end MEASUREMENT
/begin MEASUREMENT flamsl_w "" UWORD fak_uw_b16 1 100 0.00 15.99976 FORMAT "%8.5" ECU_ADDRESS 0xF4324 /end MEASUREMENT
/begin MEASUREMENT flmssl "" UBYTE fak_ub_b1 1 100 0.00 0.9961 ECU_ADDRESS 0xF400A /end MEASUREMENT
/begin MEASUREMENT fmsagd "" UBYTE fak_ub_b2 1 100 0.00 1.992 FORMAT "%5.3" ECU_ADDRESS 0xF400B /end MEASUREMENT
/begin MEASUREMENT fmsldyn "" UBYTE fak_ub_b1 1 100 0.00 0.9961 ECU_ADDRESS 0xF400C /end MEASUREMENT
/begin MEASUREMENT fmslkor "" UBYTE fak_ub_b8 1 100 0.00 7.969 FORMAT "%5.3" ECU_ADDRESS 0xF400D /end MEASUREMENT
/begin MEASUREMENT fmslrho "" UBYTE fak_ub_b2 1 100 0.00 1.992 FORMAT "%5.3" ECU_ADDRESS 0xF400E /end MEASUREMENT
/begin MEASUREMENT fmsltm "" UBYTE fak_ub_b2 1 100 0.00 1.992 FORMAT "%5.3" ECU_ADDRESS 0xF400F /end MEASUREMENT
/begin MEASUREMENT fnwaa "" UBYTE fak_ub_b1 1 100 0.00 0.9961 ECU_ADDRESS 0xF0BDB /end MEASUREMENT
/begin MEASUREMENT fnwea "" UBYTE fak_ub_b1 1 100 0.00 0.9961 ECU_ADDRESS 0xF4188 /end MEASUREMENT
/begin MEASUREMENT fnwea1 "" UBYTE fak_ub_b1 1 100 0.00 0.9961 ECU_ADDRESS 0xF4189 /end MEASUREMENT
/begin MEASUREMENT fnwea2 "" UBYTE fak_ub_b1 1 100 0.00 0.9961 ECU_ADDRESS 0xF418A /end MEASUREMENT
/begin MEASUREMENT fnwea3 "" UBYTE fak_ub_b1 1 100 0.00 0.9961 ECU_ADDRESS 0xF418B /end MEASUREMENT
/begin MEASUREMENT fnwtmkha "" UBYTE fak_ub_b2 1 100 0.00 1.992 FORMAT "%5.3" ECU_ADDRESS 0xF41A5 /end MEASUREMENT
/begin MEASUREMENT fnwtmkhe "" UBYTE fak_ub_b2 1 100 0.00 1.992 FORMAT "%5.3" ECU_ADDRESS 0xF419E /end MEASUREMENT
/begin MEASUREMENT fnwua "" UBYTE fak_ub_b1 1 100 0.00 0.9961 ECU_ADDRESS 0xF0BCE /end MEASUREMENT
/begin MEASUREMENT fnwue "" UBYTE fak_ub_b1 1 100 0.00 0.9961 ECU_ADDRESS 0xF0BCF /end MEASUREMENT
/begin MEASUREMENT fnwue1lc_w "" SWORD fak_sw_b256 1 100 -256.0000 255.9922 FORMAT "%8.4" ECU_ADDRESS 0xF4F3E /end MEASUREMENT
/begin MEASUREMENT fnwue2lc_w "" SWORD fak_sw_b256 1 100 -256.0000 255.9922 FORMAT "%8.4" ECU_ADDRESS 0xF4F40 /end MEASUREMENT
/begin MEASUREMENT fnwue3lc_w "" SWORD fak_sw_b256 1 100 -256.0000 255.9922 FORMAT "%8.4" ECU_ADDRESS 0xF4F42 /end MEASUREMENT
/begin MEASUREMENT fnwu_w "" UWORD fak_uw_b2 1 100 0.00 1.999969 FORMAT "%8.6" ECU_ADDRESS 0xF2AFE /end MEASUREMENT
/begin MEASUREMENT fnwwarma "" UBYTE fak_ub_b2 1 100 0.00 1.992 FORMAT "%5.3" ECU_ADDRESS 0xF41A6 /end MEASUREMENT
/begin MEASUREMENT fnwwarme "" UBYTE fak_ub_b2 1 100 0.00 1.992 FORMAT "%5.3" ECU_ADDRESS 0xF419F /end MEASUREMENT
/begin MEASUREMENT fpbrkdlm_w "" UWORD fak_uw_b2 1 100 0.00 1.999969 FORMAT "%8.6" ECU_ADDRESS 0xF45E0 /end MEASUREMENT
/begin MEASUREMENT fpbrkds_w "" UWORD fak_uw_b2 1 100 0.00 1.999969 FORMAT "%8.6" ECU_ADDRESS 0xF1C96 /end MEASUREMENT
/begin MEASUREMENT frkte_w "" UWORD rkti11_sy 1 100 0.00 8.738000 FORMAT "%8.6" ECU_ADDRESS 0xF4624 /end MEASUREMENT
/begin MEASUREMENT fslpdyn "" UBYTE fak_ub_b1 1 100 0.00 0.9961 ECU_ADDRESS 0xF4010 /end MEASUREMENT
/begin MEASUREMENT ftek2_w "" UWORD fak_uw_b2 1 100 0.00 1.999969 FORMAT "%8.6" ECU_ADDRESS 0xF1E50 /end MEASUREMENT
/begin MEASUREMENT ftek_w "" UWORD fak_uw_b2 1 100 0.00 1.999969 FORMAT "%8.6" ECU_ADDRESS 0xF1E52 /end MEASUREMENT
/begin MEASUREMENT grundwert "" UBYTE dez 1 100 0.00 255.0 FORMAT "%5.1" ECU_ADDRESS 0xF0502 /end MEASUREMENT
/begin MEASUREMENT imlsla_w "" UWORD m_uw_b4660 1 100 0.00 4660.267 FORMAT "%8.3" ECU_ADDRESS 0xF4326 /end MEASUREMENT
/begin MEASUREMENT imlsle_w "" UWORD m_uw_b4660 1 100 0.00 4660.267 FORMAT "%8.3" ECU_ADDRESS 0xF4328 /end MEASUREMENT
/begin MEASUREMENT iprefanf "" UBYTE dez 1 100 0.00 15.00 FORMAT "%5.2" ECU_ADDRESS 0xF4163 /end MEASUREMENT
/begin MEASUREMENT iprefanf2 "" UBYTE dez 1 100 0.00 15.00 FORMAT "%5.2" ECU_ADDRESS 0xF4164 /end MEASUREMENT
/begin MEASUREMENT kinmx "" UBYTE relnmot_q0p01907 1 100 0.00 4.864 FORMAT "%5.3" ECU_ADDRESS 0xF0B3E /end MEASUREMENT
/begin MEASUREMENT ko2vk2_w "" UWORD fak_uw_b16 1 100 0.00 15.99976 FORMAT "%8.5" ECU_ADDRESS 0xF27B0 /end MEASUREMENT
/begin MEASUREMENT ko2vk_w "" UWORD fak_uw_b16 1 100 0.00 15.99976 FORMAT "%8.5" ECU_ADDRESS 0xF27B2 /end MEASUREMENT
/begin MEASUREMENT lamau_w "" UWORD fak_uw_b16 1 100 0.00 15.99976 FORMAT "%8.5" ECU_ADDRESS 0xF4632 /end MEASUREMENT
/begin MEASUREMENT laufz100_w "" UWORD runtime1_sy 1 100 0.00 52428.00 FORMAT "%8.2" ECU_ADDRESS 0xF4E58 /end MEASUREMENT
/begin MEASUREMENT laufz10m_w "" UWORD runtime1_sy 1 100 0.00 52428.00 FORMAT "%8.2" ECU_ADDRESS 0xF2678 /end MEASUREMENT
/begin MEASUREMENT laufz1m_w "" UWORD runtime1_sy 1 100 0.00 52428.00 FORMAT "%8.2" ECU_ADDRESS 0xE1D8 /end MEASUREMENT
/begin MEASUREMENT laufz1s_w "" UWORD runtime1_sy 1 100 0.00 52428.00 FORMAT "%8.2" ECU_ADDRESS 0xF4E5A /end MEASUREMENT
/begin MEASUREMENT laufz200_w "" UWORD runtime1_sy 1 100 0.00 52428.00 FORMAT "%8.2" ECU_ADDRESS 0xF4E5C /end MEASUREMENT
/begin MEASUREMENT laufz20m_w "" UWORD runtime1_sy 1 100 0.00 52428.00 FORMAT "%8.2" ECU_ADDRESS 0xF267A /end MEASUREMENT
/begin MEASUREMENT laufz2m_w "" UWORD runtime1_sy 1 100 0.00 52428.00 FORMAT "%8.2" ECU_ADDRESS 0xE1DA /end MEASUREMENT
/begin MEASUREMENT laufz50m_w "" UWORD runtime1_sy 1 100 0.00 52428.00 FORMAT "%8.2" ECU_ADDRESS 0xF4E5E /end MEASUREMENT
/begin MEASUREMENT laufz5m_w "" UWORD runtime1_sy 1 100 0.00 52428.00 FORMAT "%8.2" ECU_ADDRESS 0xE1DC /end MEASUREMENT
/begin MEASUREMENT laufzbg_w "" UWORD runtime1_sy 1 100 0.00 52428.00 FORMAT "%8.2" ECU_ADDRESS 0xF4E60 /end MEASUREMENT
/begin MEASUREMENT laufzmbg_w "" UWORD runtime1_sy 1 100 0.00 52428.00 FORMAT "%8.2" ECU_ADDRESS 0xF4E62 /end MEASUREMENT
/begin MEASUREMENT laufzmfa_w "" UWORD runtime1_sy 1 100 0.00 52428.00 FORMAT "%8.2" ECU_ADDRESS 0xF267C /end MEASUREMENT
/begin MEASUREMENT laufzsyn2_w "" UWORD runtime1_sy 1 100 0.00 52428.00 FORMAT "%8.2" ECU_ADDRESS 0xF267E /end MEASUREMENT
/begin MEASUREMENT laufzsyn_w "" UWORD runtime1_sy 1 100 0.00 52428.00 FORMAT "%8.2" ECU_ADDRESS 0xF2680 /end MEASUREMENT
/begin MEASUREMENT lzmaxnmot "" UBYTE nmot_ub_q40 1 100 0.00 10200. FORMAT "%5.0" ECU_ADDRESS 0x382143 /end MEASUREMENT
/begin MEASUREMENT lzmaxrl "" UBYTE rel_ub_b99p6 1 100 0.00 99.61 FORMAT "%5.2" ECU_ADDRESS 0x382144 /end MEASUREMENT
/begin MEASUREMENT lzmaxstate "" UBYTE dez 1 100 0.00 255.0 FORMAT "%5.1" ECU_ADDRESS 0x382145 /end MEASUREMENT
/begin MEASUREMENT lzmaxwdkba "" UBYTE relDK_ub_b100 1 100 0.00 100.0 FORMAT "%5.1" ECU_ADDRESS 0x382146 /end MEASUREMENT
/begin MEASUREMENT lzmaxwped "" UBYTE rel_ub_b99p6 1 100 0.00 99.61 FORMAT "%5.2" ECU_ADDRESS 0x382147 /end MEASUREMENT
/begin MEASUREMENT mdverbmx_w "" UWORD rel_uw_b100 1 100 0.00 99.99847 FORMAT "%8.5" ECU_ADDRESS 0xF25C8 /end MEASUREMENT
/begin MEASUREMENT minmx_w "" UWORD rel_uw_b100 1 100 0.00 99.99847 FORMAT "%8.5" ECU_ADDRESS 0xF25AC /end MEASUREMENT
/begin MEASUREMENT miszullb_w "" UWORD rel_uw_b100 1 100 0.00 99.99847 FORMAT "%8.5" ECU_ADDRESS 0xF25CA /end MEASUREMENT
/begin MEASUREMENT miszull_w "" UWORD rel_uw_b100 1 100 0.00 99.99847 FORMAT "%8.5" ECU_ADDRESS 0xF25CC /end MEASUREMENT
/begin MEASUREMENT miszul_w "" UWORD rel_uw_b100 1 100 0.00 99.99847 FORMAT "%8.5" ECU_ADDRESS 0xF25CE /end MEASUREMENT
/begin MEASUREMENT mitibgri_w "" UWORD rel_uw_b100 1 100 0.00 99.99847 FORMAT "%8.5" ECU_ADDRESS 0xF4626 /end MEASUREMENT
/begin MEASUREMENT mitibgrp_w "" SWORD rel_uw_b100 1 100 -50.00000 49.99847 FORMAT "%8.5" ECU_ADDRESS 0xF4628 /end MEASUREMENT
/begin MEASUREMENT mitibgr_w "" UWORD rel_uw_b100 1 100 0.00 99.99847 FORMAT "%8.5" ECU_ADDRESS 0xF462A /end MEASUREMENT
/begin MEASUREMENT mizufil_w "" UWORD rel_uw_b100 1 100 0.00 99.99847 FORMAT "%8.5" ECU_ADDRESS 0xF25D0 /end MEASUREMENT
/begin MEASUREMENT mizuofil "" UBYTE rel_ub_b99p6 1 100 0.00 99.61 FORMAT "%5.2" ECU_ADDRESS 0xF0B46 /end MEASUREMENT
/begin MEASUREMENT mizutmp_w "" UWORD rel_uw_b100 1 100 0.00 99.99847 FORMAT "%8.5" ECU_ADDRESS 0xF25D2 /end MEASUREMENT
/begin MEASUREMENT mizuvfil "" UBYTE rel_ub_b99p6 1 100 0.00 99.61 FORMAT "%5.2" ECU_ADDRESS 0xF0B47 /end MEASUREMENT
/begin MEASUREMENT ml "" UBYTE m_ub_b1020 1 100 0.00 1020. FORMAT "%5.0" ECU_ADDRESS 0xE176 /end MEASUREMENT
/begin MEASUREMENT ml_w "" UWORD m_uw_b6553p5 1 100 0.00 6553.500 FORMAT "%8.3" ECU_ADDRESS 0xE178 /end MEASUREMENT
/begin MEASUREMENT mrko "" UBYTE rel_ub_b200 1 100 0.00 199.2 FORMAT "%5.1" ECU_ADDRESS 0xF08EA /end MEASUREMENT
/begin MEASUREMENT mrko_w "" UWORD rel_uw_b200 1 100 0.00 199.9969 FORMAT "%8.4" ECU_ADDRESS 0xF1E90 /end MEASUREMENT
/begin MEASUREMENT msfabr_w "" UWORD m_uw_b6553p5 1 100 0.00 6553.500 FORMAT "%8.3" ECU_ADDRESS 0xF1C98 /end MEASUREMENT
/begin MEASUREMENT msfebr_w "" UWORD m_uw_b6553p5 1 100 0.00 6553.500 FORMAT "%8.3" ECU_ADDRESS 0xF1C9A /end MEASUREMENT
/begin MEASUREMENT msl "" UBYTE m_ub_q0p4 1 100 0.00 102.0 FORMAT "%5.1" ECU_ADDRESS 0xF4011 /end MEASUREMENT
/begin MEASUREMENT msl2 "" UBYTE m_ub_q0p4 1 100 0.00 102.0 FORMAT "%5.1" ECU_ADDRESS 0xF4012 /end MEASUREMENT
/begin MEASUREMENT msl2_w "" UWORD m_uw_b6553p5 1 100 0.00 6553.500 FORMAT "%8.3" ECU_ADDRESS 0xF432A /end MEASUREMENT
/begin MEASUREMENT mslkorr_w "" UWORD m_uw_b6553p5 1 100 0.00 6553.500 FORMAT "%8.3" ECU_ADDRESS 0xF432C /end MEASUREMENT
/begin MEASUREMENT mslpub_w "" UWORD m_uw_b6553p5 1 100 0.00 6553.500 FORMAT "%8.3" ECU_ADDRESS 0xF432E /end MEASUREMENT
/begin MEASUREMENT mslstat "" UBYTE m_ub_q0p4 1 100 0.00 102.0 FORMAT "%5.1" ECU_ADDRESS 0xF4013 /end MEASUREMENT
/begin MEASUREMENT mslstat_w "" UWORD m_uw_b6553p5 1 100 0.00 6553.500 FORMAT "%8.3" ECU_ADDRESS 0xF4330 /end MEASUREMENT
/begin MEASUREMENT msl_w "" UWORD m_uw_b6553p5 1 100 0.00 6553.500 FORMAT "%8.3" ECU_ADDRESS 0xF4332 /end MEASUREMENT
/begin MEASUREMENT mtsegph_w "" UWORD t40usxus_q40 1 100 0.00 2621400. FORMAT "%8.0" ECU_ADDRESS 0xF1790 /end MEASUREMENT
/begin MEASUREMENT nmax_w "" UWORD nmot_uw_q0p25 1 100 0.00 16383.75 FORMAT "%8.2" ECU_ADDRESS 0xF25AE /end MEASUREMENT
/begin MEASUREMENT nmotpr_w "" UWORD nmot_uw_q0p25 1 100 0.00 16383.75 FORMAT "%8.2" ECU_ADDRESS 0xF25B0 /end MEASUREMENT
/begin MEASUREMENT nmxpr "" UBYTE relnmot_q0p003052 1 100 0.00 0.7782 ECU_ADDRESS 0xF0B40 /end MEASUREMENT
/begin MEASUREMENT nsber_w "" UWORD nmot_uw_q0p25 1 100 0.00 16383.75 FORMAT "%8.2" ECU_ADDRESS 0xF25B2 /end MEASUREMENT
/begin MEASUREMENT nsynnldg "" UBYTE dez 1 100 0.00 255.0 FORMAT "%5.1" ECU_ADDRESS 0xF0712 /end MEASUREMENT
/begin MEASUREMENT nsynnlph "" UBYTE dez 1 100 0.00 255.0 FORMAT "%5.1" ECU_ADDRESS 0xF0702 /end MEASUREMENT
/begin MEASUREMENT nwsollalokbits "" UBYTE dez 1 100 0.00 255.0 FORMAT "%5.1" ECU_ADDRESS 0xF0C20 /end MEASUREMENT
/begin MEASUREMENT NWSOLLEausbits_10ms "" UBYTE dez 1 100 0.00 255.0 FORMAT "%5.1" ECU_ADDRESS 0xF0C02 /end MEASUREMENT
/begin MEASUREMENT NWSOLLEausbits_koop "" UBYTE dez 1 100 0.00 255.0 FORMAT "%5.1" ECU_ADDRESS 0xF0C03 /end MEASUREMENT
/begin MEASUREMENT NWSOLLElokbits_koop "" UBYTE dez 1 100 0.00 255.0 FORMAT "%5.1" ECU_ADDRESS 0xF0C04 /end MEASUREMENT
/begin MEASUREMENT o2adap2_w "" SWORD relO2_q9p765Em4 1 100 -32.00000 31.99902 FORMAT "%8.5" ECU_ADDRESS 0xF27B4 /end MEASUREMENT
/begin MEASUREMENT o2adap_w "" SWORD relO2_q9p765Em4 1 100 -32.00000 31.99902 FORMAT "%8.5" ECU_ADDRESS 0xF27B6 /end MEASUREMENT
/begin MEASUREMENT pbrlm_w "" UWORD p_uw_q0p039 1 100 0.00 2559.961 FORMAT "%8.3" ECU_ADDRESS 0xF1C84 /end MEASUREMENT
/begin MEASUREMENT pdck_state "" UBYTE dez 1 100 0.00 255.0 FORMAT "%5.1" ECU_ADDRESS 0xF4000 /end MEASUREMENT
/begin MEASUREMENT PercentToResetmax_w "" UWORD rel_uw_b100 1 100 0.00 99.99847 FORMAT "%8.5" ECU_ADDRESS 0x384086 /end MEASUREMENT
/begin MEASUREMENT PercentToReset_w "" UWORD rel_uw_b100 1 100 0.00 99.99847 FORMAT "%8.5" ECU_ADDRESS 0xF4E64 /end MEASUREMENT
/begin MEASUREMENT perffilt_w "" UWORD rel_q0p025 1 100 0.00 1638.375 FORMAT "%8.3" ECU_ADDRESS 0xF2682 /end MEASUREMENT
/begin MEASUREMENT perfilt_bg "" UWORD rel_uw_b100 1 100 0.00 99.99847 FORMAT "%8.5" ECU_ADDRESS 0xF2684 /end MEASUREMENT
/begin MEASUREMENT perfmax_w "" UWORD rel_q0p025 1 100 0.00 1638.375 FORMAT "%8.3" ECU_ADDRESS 0x382F3E /end MEASUREMENT
/begin MEASUREMENT perform_bg "" UWORD rel_uw_b100 1 100 0.00 99.99847 FORMAT "%8.5" ECU_ADDRESS 0xF2686 /end MEASUREMENT
/begin MEASUREMENT perform_w "" UWORD rel_q0p025 1 100 0.00 1638.375 FORMAT "%8.3" ECU_ADDRESS 0xF2688 /end MEASUREMENT
/begin MEASUREMENT peri40ms_w "" UWORD runtime2_sy 1 100 0.00 838848.0 FORMAT "%8.1" ECU_ADDRESS 0xF268A /end MEASUREMENT
/begin MEASUREMENT phLosCtr_w "" UWORD dez 1 100 0.00 65535.00 FORMAT "%8.2" ECU_ADDRESS 0x382ECE /end MEASUREMENT
/begin MEASUREMENT ps "" UBYTE p_ub_q10 1 100 0.00 2550. FORMAT "%5.0" ECU_ADDRESS 0xF08BA /end MEASUREMENT
/begin MEASUREMENT psfglm_w "" UWORD p_uw_q0p039 1 100 0.00 2559.961 FORMAT "%8.3" ECU_ADDRESS 0xF1C86 /end MEASUREMENT
/begin MEASUREMENT psfg_w "" UWORD p_uw_q0p039 1 100 0.00 2559.961 FORMAT "%8.3" ECU_ADDRESS 0xF1C9C /end MEASUREMENT
/begin MEASUREMENT pslm_w "" UWORD p_uw_q0p039 1 100 0.00 2559.961 FORMAT "%8.3" ECU_ADDRESS 0xF1C88 /end MEASUREMENT
/begin MEASUREMENT ps_w "" UWORD p_uw_q0p039 1 100 0.00 2559.961 FORMAT "%8.3" ECU_ADDRESS 0xE17A /end MEASUREMENT
/begin MEASUREMENT rdeBits "" UBYTE dez 1 100 0.00 255.0 FORMAT "%5.1" ECU_ADDRESS 0xF06EE /end MEASUREMENT
/begin MEASUREMENT rfges_w "" UWORD rel_uw_q0p0234 1 100 0.00 1535.977 FORMAT "%8.3" ECU_ADDRESS 0xE17C /end MEASUREMENT
/begin MEASUREMENT rflmorgi_w "" UWORD rel_uw_q0p0234 1 100 0.00 1535.977 FORMAT "%8.3" ECU_ADDRESS 0xF1C8A /end MEASUREMENT
/begin MEASUREMENT rforgi_w "" UWORD rel_uw_q0p0234 1 100 0.00 1535.977 FORMAT "%8.3" ECU_ADDRESS 0xF1C9E /end MEASUREMENT
/begin MEASUREMENT rfrextlm_w "" UWORD rel_uw_q0p0234 1 100 0.00 1535.977 FORMAT "%8.3" ECU_ADDRESS 0xF1C8C /end MEASUREMENT
/begin MEASUREMENT RKTIlokbits "" UBYTE dez 1 100 0.00 255.0 FORMAT "%5.1" ECU_ADDRESS 0xF08DD /end MEASUREMENT
/begin MEASUREMENT rl "" UBYTE rel_ub_q0p75 1 100 0.00 191.3 FORMAT "%5.1" ECU_ADDRESS 0xE177 /end MEASUREMENT
/begin MEASUREMENT rlfglm_w "" UWORD rel_uw_q0p0234 1 100 0.00 1535.977 FORMAT "%8.3" ECU_ADDRESS 0xF1C8E /end MEASUREMENT
/begin MEASUREMENT rlfg_w "" UWORD rel_uw_q0p0234 1 100 0.00 1535.977 FORMAT "%8.3" ECU_ADDRESS 0xF1CA0 /end MEASUREMENT
/begin MEASUREMENT rlossCtr_w "" UWORD dez 1 100 0.00 65535.00 FORMAT "%8.2" ECU_ADDRESS 0x382F40 /end MEASUREMENT
/begin MEASUREMENT rl_w "" UWORD rel_uw_q0p0234 1 100 0.00 1535.977 FORMAT "%8.3" ECU_ADDRESS 0xE17E /end MEASUREMENT
/begin MEASUREMENT rstMon "" UWORD dez 1 100 0.00 65535.00 FORMAT "%8.2" ARRAY_SIZE 12 ECU_ADDRESS 0x384034 /end MEASUREMENT
/begin MEASUREMENT rstMonIdx "" UWORD dez 1 100 0.00 65535.00 FORMAT "%8.2" ECU_ADDRESS 0x38404C /end MEASUREMENT
/begin MEASUREMENT scattBits "" UBYTE dez 1 100 0.00 255.0 FORMAT "%5.1" ECU_ADDRESS 0xF06D3 /end MEASUREMENT
/begin MEASUREMENT statetnwa "" UBYTE dez 1 100 0.00 255.0 FORMAT "%5.1" ECU_ADDRESS 0xF4199 /end MEASUREMENT
/begin MEASUREMENT statetnwe "" UBYTE dez 1 100 0.00 255.0 FORMAT "%5.1" ECU_ADDRESS 0xF419A /end MEASUREMENT
/begin MEASUREMENT statnwshka "" UBYTE dez 1 100 0.00 255.0 FORMAT "%5.1" ECU_ADDRESS 0xF0BE9 /end MEASUREMENT
/begin MEASUREMENT statnwshke "" UBYTE dez 1 100 0.00 255.0 FORMAT "%5.1" ECU_ADDRESS 0xF0BEA /end MEASUREMENT
/begin MEASUREMENT swOffD2Bits "" UWORD dez 1 100 0.00 65535.00 FORMAT "%8.2" ECU_ADDRESS 0x382F38 /end MEASUREMENT
/begin MEASUREMENT swOffDlBits "" UWORD dez 1 100 0.00 65535.00 FORMAT "%8.2" ECU_ADDRESS 0x382F3A /end MEASUREMENT
/begin MEASUREMENT system_stack_w "" UWORD rel_uw_b100 1 100 0.00 99.99847 FORMAT "%8.5" ECU_ADDRESS 0x384088 /end MEASUREMENT
/begin MEASUREMENT te2_w "" UWORD tinjection_sy 1 100 0.00 209.7120 FORMAT "%8.4" ECU_ADDRESS 0xF1E54 /end MEASUREMENT
/begin MEASUREMENT tevfa2_w "" UWORD tinjection_sy 1 100 0.00 209.7120 FORMAT "%8.4" ECU_ADDRESS 0xF1E56 /end MEASUREMENT
/begin MEASUREMENT tevfakge_w "" UWORD tinjection_sy 1 100 0.00 209.7120 FORMAT "%8.4" ECU_ADDRESS 0xF1E58 /end MEASUREMENT
/begin MEASUREMENT tevfa_w "" UWORD tinjection_sy 1 100 0.00 209.7120 FORMAT "%8.4" ECU_ADDRESS 0xF1E5A /end MEASUREMENT
/begin MEASUREMENT te_w "" UWORD tinjection_sy 1 100 0.00 209.7120 FORMAT "%8.4" ECU_ADDRESS 0xF1E5C /end MEASUREMENT
/begin MEASUREMENT ti2_w "" UWORD tinjection5_sy 1 100 0.00 1048.560 FORMAT "%8.3" ECU_ADDRESS 0xF1E5E /end MEASUREMENT
/begin MEASUREMENT timxth_w "" UWORD tinjection_sy 1 100 0.00 209.7120 FORMAT "%8.4" ECU_ADDRESS 0xF462C /end MEASUREMENT
/begin MEASUREMENT timx_w "" UWORD tinjection_sy 1 100 0.00 209.7120 FORMAT "%8.4" ECU_ADDRESS 0xF462E /end MEASUREMENT
/begin MEASUREMENT ti_b1 "" UWORD tinjection_sy 1 100 0.00 209.7120 FORMAT "%8.4" ECU_ADDRESS 0xF1E60 /end MEASUREMENT
/begin MEASUREMENT ti_b2 "" UWORD tinjection_sy 1 100 0.00 209.7120 FORMAT "%8.4" ECU_ADDRESS 0xF1E62 /end MEASUREMENT
/begin MEASUREMENT ti_tvu_w "" UWORD tinjection_sy 1 100 0.00 209.7120 FORMAT "%8.4" ECU_ADDRESS 0xE188 /end MEASUREMENT
/begin MEASUREMENT ti_w "" UWORD tinjection5_sy 1 100 0.00 1048.560 FORMAT "%8.3" ECU_ADDRESS 0xF1E64 /end MEASUREMENT
/begin MEASUREMENT tmotmn "" UBYTE temp_ub_q0p75_o48 1 100 -48.00 143.3 FORMAT "%5.1" ECU_ADDRESS 0xF0B48 /end MEASUREMENT
/begin MEASUREMENT tnachl_w "" UWORD t100msxs_uw_b6553p6 1 100 0.00 6553.500 FORMAT "%8.3" ECU_ADDRESS 0x382F3C /end MEASUREMENT
/begin MEASUREMENT tnbmphs0_w "" UWORD t5usxus_q5 1 100 0.00 327675.0 FORMAT "%8.1" ECU_ADDRESS 0xF1792 /end MEASUREMENT
/begin MEASUREMENT tnbmrde "" UBYTE t1msxms_q1 1 100 0.00 255.0 FORMAT "%5.1" ECU_ADDRESS 0xE084 /end MEASUREMENT
/begin MEASUREMENT tnbmrde1 "" UBYTE t1msxms_q1 1 100 0.00 255.0 FORMAT "%5.1" ECU_ADDRESS 0xE085 /end MEASUREMENT
/begin MEASUREMENT tnbmrde2 "" UBYTE t1msxms_q1 1 100 0.00 255.0 FORMAT "%5.1" ECU_ADDRESS 0xE086 /end MEASUREMENT
/begin MEASUREMENT tnscCtr_w "" UWORD t20msxs_uw_q0p02 1 100 0.00 1310.700 FORMAT "%8.3" ECU_ADDRESS 0xF25D4 /end MEASUREMENT
/begin MEASUREMENT tnsofCtr "" UBYTE t20msxs_ub_b5p1 1 100 0.00 5.100 FORMAT "%5.3" ECU_ADDRESS 0xF0B49 /end MEASUREMENT
/begin MEASUREMENT tnwsbga "" UBYTE zk10msxs_ub_b2p55 1 100 0.0100000 2.55000 FORMAT "%7.5" ECU_ADDRESS 0xF0C21 /end MEASUREMENT
/begin MEASUREMENT tnwsbge "" UBYTE zk10msxs_ub_b2p55 1 100 0.0100000 2.55000 FORMAT "%7.5" ECU_ADDRESS 0xF0C05 /end MEASUREMENT
/begin MEASUREMENT tnwsbnsa_w "" UWORD t10msxs_uw_b655p35 1 100 0.00 655.3500 FORMAT "%8.4" ECU_ADDRESS 0xF2BD4 /end MEASUREMENT
/begin MEASUREMENT tnwsbnse_w "" UWORD t10msxs_uw_b655p35 1 100 0.00 655.3500 FORMAT "%8.4" ECU_ADDRESS 0xF4F56 /end MEASUREMENT
/begin MEASUREMENT tPh1_w "" UWORD t40usxus_q40 1 100 0.00 2621400. FORMAT "%8.0" ECU_ADDRESS 0xF1794 /end MEASUREMENT
/begin MEASUREMENT tsegph_w "" UWORD t40usxus_q40 1 100 0.00 2621400. FORMAT "%8.0" ECU_ADDRESS 0xF1796 /end MEASUREMENT
/begin MEASUREMENT tvnwe "" UBYTE t50msxs_q0p05 1 100 0.00 12.75 FORMAT "%5.2" ECU_ADDRESS 0xF41A0 /end MEASUREMENT
/begin MEASUREMENT tvsp_w "" UWORD tinjection_sy 1 100 0.00 209.7120 FORMAT "%8.4" ECU_ADDRESS 0xF4630 /end MEASUREMENT
/begin MEASUREMENT tvu_w "" UWORD tinjection_sy 1 100 0.00 209.7120 FORMAT "%8.4" ECU_ADDRESS 0xF1E66 /end MEASUREMENT
/begin MEASUREMENT ubrde "" UBYTE spg_ubatt 1 100 0.00 17.95 FORMAT "%5.2" ECU_ADDRESS 0xF06EF /end MEASUREMENT
/begin MEASUREMENT user_stack_w "" UWORD rel_uw_b100 1 100 0.00 99.99847 FORMAT "%8.5" ECU_ADDRESS 0x38408A /end MEASUREMENT
/begin MEASUREMENT wdnwsa_w "" SWORD kw_sw_q0p0078 1 100 -256.0000 255.9922 FORMAT "%8.4" ECU_ADDRESS 0xF2BD6 /end MEASUREMENT
/begin MEASUREMENT wdnwse_w "" SWORD kw_sw_q0p0078 1 100 -256.0000 255.9922 FORMAT "%8.4" ECU_ADDRESS 0xF2B76 /end MEASUREMENT
/begin MEASUREMENT wessbm "" UBYTE kw_q2p8125 1 100 0.00 717.2 FORMAT "%5.1" ECU_ADDRESS 0xF0503 /end MEASUREMENT
/begin MEASUREMENT wkwas_rde "" UBYTE kw_q6 1 100 0.00 1530. FORMAT "%5.0" ECU_ADDRESS 0xF06F0 /end MEASUREMENT
/begin MEASUREMENT wnshkmna_w "" SWORD kw_sw_q0p0078 1 100 -256.0000 255.9922 FORMAT "%8.4" ECU_ADDRESS 0xF2B38 /end MEASUREMENT
/begin MEASUREMENT wnshkmne_w "" SWORD kw_sw_q0p0078 1 100 -256.0000 255.9922 FORMAT "%8.4" ECU_ADDRESS 0xF2B3A /end MEASUREMENT
/begin MEASUREMENT wnshkmxa_w "" SWORD kw_sw_q0p0078 1 100 -256.0000 255.9922 FORMAT "%8.4" ECU_ADDRESS 0xF2B3C /end MEASUREMENT
/begin MEASUREMENT wnshkmxe_w "" SWORD kw_sw_q0p0078 1 100 -256.0000 255.9922 FORMAT "%8.4" ECU_ADDRESS 0xF2B3E /end MEASUREMENT
/begin MEASUREMENT wnsrfixe_w "" SWORD kw_sw_q0p0078 1 100 -256.0000 255.9922 FORMAT "%8.4" ECU_ADDRESS 0xF4F58 /end MEASUREMENT
/begin MEASUREMENT wnstvhe_w "" SWORD kw_sw_q0p0078 1 100 -256.0000 255.9922 FORMAT "%8.4" ECU_ADDRESS 0xF2B40 /end MEASUREMENT
/begin MEASUREMENT wnvuhoms_w "" UWORD kw_q0p0078 1 100 0.00 511.9922 FORMAT "%8.4" ECU_ADDRESS 0xF2B00 /end MEASUREMENT
/begin MEASUREMENT wnwahom_w "" SWORD kw_sw_q0p0078 1 100 -256.0000 255.9922 FORMAT "%8.4" ECU_ADDRESS 0xF4F84 /end MEASUREMENT
/begin MEASUREMENT wnwass "" UBYTE kw_ub_q0p5 1 100 0.00 127.5 FORMAT "%5.1" ECU_ADDRESS 0xF41A7 /end MEASUREMENT
/begin MEASUREMENT wnwdshka_w "" SWORD kw_sw_q0p0078 1 100 -256.0000 255.9922 FORMAT "%8.4" ECU_ADDRESS 0xF4F86 /end MEASUREMENT
/begin MEASUREMENT wnwdshke_w "" SWORD kw_sw_q0p0078 1 100 -256.0000 255.9922 FORMAT "%8.4" ECU_ADDRESS 0xF4F5A /end MEASUREMENT
/begin MEASUREMENT wnwehom_w "" SWORD kw_sw_q0p0078 1 100 -256.0000 255.9922 FORMAT "%8.4" ECU_ADDRESS 0xF4F5C /end MEASUREMENT
/begin MEASUREMENT wnweos "" UBYTE kw_ub_q0p5 1 100 0.00 127.5 FORMAT "%5.1" ECU_ADDRESS 0xF41A1 /end MEASUREMENT
/begin MEASUREMENT wnwgv_w "" UWORD kw_q0p0078 1 100 0.00 511.9922 FORMAT "%8.4" ECU_ADDRESS 0xF2B02 /end MEASUREMENT
/begin MEASUREMENT wnwisa_w "" SWORD kw_q0p0039 1 100 -128.0000 127.9961 FORMAT "%8.4" ECU_ADDRESS 0xF2B22 /end MEASUREMENT
/begin MEASUREMENT wnwise_w "" SWORD kw_q0p0039 1 100 -128.0000 127.9961 FORMAT "%8.4" ECU_ADDRESS 0xF2B24 /end MEASUREMENT
/begin MEASUREMENT wnwix_w "" SWORD kw_sw_b128 1 100 -128.0000 127.9961 FORMAT "%8.4" ECU_ADDRESS 0xF1798 /end MEASUREMENT
/begin MEASUREMENT wnwkha_w "" SWORD kw_sw_q0p0078 1 100 -256.0000 255.9922 FORMAT "%8.4" ECU_ADDRESS 0xF4F88 /end MEASUREMENT
/begin MEASUREMENT wnwkhe_w "" SWORD kw_sw_q0p0078 1 100 -256.0000 255.9922 FORMAT "%8.4" ECU_ADDRESS 0xF4F5E /end MEASUREMENT
/begin MEASUREMENT wnwkhlla_w "" SWORD kw_sw_q0p0078 1 100 -256.0000 255.9922 FORMAT "%8.4" ECU_ADDRESS 0xF4F8A /end MEASUREMENT
/begin MEASUREMENT wnwkhlle_w "" SWORD kw_sw_q0p0078 1 100 -256.0000 255.9922 FORMAT "%8.4" ECU_ADDRESS 0xF4F60 /end MEASUREMENT
/begin MEASUREMENT wnwkwasx_w "" UWORD kw_q0p0156 1 100 0.00 1023.984 FORMAT "%8.3" ECU_ADDRESS 0xF179A /end MEASUREMENT
/begin MEASUREMENT wnwsaa_w "" SWORD kw_sw_q0p0078 1 100 -256.0000 255.9922 FORMAT "%8.4" ECU_ADDRESS 0xF4F8C /end MEASUREMENT
/begin MEASUREMENT wnwsae_w "" SWORD kw_sw_q0p0078 1 100 -256.0000 255.9922 FORMAT "%8.4" ECU_ADDRESS 0xF4F62 /end MEASUREMENT
/begin MEASUREMENT wnwsapa_w "" SWORD kw_sw_q0p0078 1 100 -256.0000 255.9922 FORMAT "%8.4" ECU_ADDRESS 0xF4F8E /end MEASUREMENT
/begin MEASUREMENT wnwsape_w "" SWORD kw_sw_q0p0078 1 100 -256.0000 255.9922 FORMAT "%8.4" ECU_ADDRESS 0xF4F64 /end MEASUREMENT
/begin MEASUREMENT wnwsa_w "" SWORD kw_sw_q0p0078 1 100 -256.0000 255.9922 FORMAT "%8.4" ECU_ADDRESS 0xF2BD8 /end MEASUREMENT
/begin MEASUREMENT wnwsbga_w "" SWORD kw_sw_q0p0078 1 100 -256.0000 255.9922 FORMAT "%8.4" ECU_ADDRESS 0xF2BDA /end MEASUREMENT
/begin MEASUREMENT wnwsbge_w "" SWORD kw_sw_q0p0078 1 100 -256.0000 255.9922 FORMAT "%8.4" ECU_ADDRESS 0xF2B78 /end MEASUREMENT
/begin MEASUREMENT wnwseva_w "" SWORD kw_sw_q0p0078 1 100 -256.0000 255.9922 FORMAT "%8.4" ECU_ADDRESS 0xF2B42 /end MEASUREMENT
/begin MEASUREMENT wnwseve_w "" SWORD kw_sw_q0p0078 1 100 -256.0000 255.9922 FORMAT "%8.4" ECU_ADDRESS 0xF2B44 /end MEASUREMENT
/begin MEASUREMENT wnwse_w "" SWORD kw_sw_q0p0078 1 100 -256.0000 255.9922 FORMAT "%8.4" ECU_ADDRESS 0xF2B7A /end MEASUREMENT
/begin MEASUREMENT wnwsfaa_w "" SWORD kw_sw_q0p0078 1 100 -256.0000 255.9922 FORMAT "%8.4" ECU_ADDRESS 0xF4F4C /end MEASUREMENT
/begin MEASUREMENT wnwsfae_w "" SWORD kw_sw_q0p0078 1 100 -256.0000 255.9922 FORMAT "%8.4" ECU_ADDRESS 0xF4F4E /end MEASUREMENT
/begin MEASUREMENT wnwshka_w "" SWORD kw_sw_q0p0078 1 100 -256.0000 255.9922 FORMAT "%8.4" ECU_ADDRESS 0xF2B46 /end MEASUREMENT
/begin MEASUREMENT wnwshke_w "" SWORD kw_sw_q0p0078 1 100 -256.0000 255.9922 FORMAT "%8.4" ECU_ADDRESS 0xF2B48 /end MEASUREMENT
/begin MEASUREMENT wnwskwa_w "" SWORD kw_sw_q0p0078 1 100 -256.0000 255.9922 FORMAT "%8.4" ECU_ADDRESS 0xF4F90 /end MEASUREMENT
/begin MEASUREMENT wnwskwe_w "" SWORD kw_sw_q0p0078 1 100 -256.0000 255.9922 FORMAT "%8.4" ECU_ADDRESS 0xF4F66 /end MEASUREMENT
/begin MEASUREMENT wnwskwka_w "" SWORD kw_sw_q0p0078 1 100 -256.0000 255.9922 FORMAT "%8.4" ECU_ADDRESS 0xF4F92 /end MEASUREMENT
/begin MEASUREMENT wnwskwke_w "" SWORD kw_sw_q0p0078 1 100 -256.0000 255.9922 FORMAT "%8.4" ECU_ADDRESS 0xF4F68 /end MEASUREMENT
/begin MEASUREMENT wnwskwla_w "" SWORD kw_sw_q0p0078 1 100 -256.0000 255.9922 FORMAT "%8.4" ECU_ADDRESS 0xF4F94 /end MEASUREMENT
/begin MEASUREMENT wnwskwle_w "" SWORD kw_sw_q0p0078 1 100 -256.0000 255.9922 FORMAT "%8.4" ECU_ADDRESS 0xF4F6A /end MEASUREMENT
/begin MEASUREMENT wnwslva2_w "" SWORD kw_sw_q0p0078 1 100 -256.0000 255.9922 FORMAT "%8.4" ECU_ADDRESS 0xF2B4A /end MEASUREMENT
/begin MEASUREMENT wnwslva_w "" SWORD kw_sw_q0p0078 1 100 -256.0000 255.9922 FORMAT "%8.4" ECU_ADDRESS 0xF2B4C /end MEASUREMENT
/begin MEASUREMENT wnwslve2_w "" SWORD kw_sw_q0p0078 1 100 -256.0000 255.9922 FORMAT "%8.4" ECU_ADDRESS 0xF2B4E /end MEASUREMENT
/begin MEASUREMENT wnwslve_w "" SWORD kw_sw_q0p0078 1 100 -256.0000 255.9922 FORMAT "%8.4" ECU_ADDRESS 0xF2B50 /end MEASUREMENT
/begin MEASUREMENT wnwsmna_w "" SWORD kw_sw_q0p0078 1 100 -256.0000 255.9922 FORMAT "%8.4" ECU_ADDRESS 0xF4F96 /end MEASUREMENT
/begin MEASUREMENT wnwsmne_w "" SWORD kw_sw_q0p0078 1 100 -256.0000 255.9922 FORMAT "%8.4" ECU_ADDRESS 0xF4F6C /end MEASUREMENT
/begin MEASUREMENT wnwsmxa_w "" SWORD kw_sw_q0p0078 1 100 -256.0000 255.9922 FORMAT "%8.4" ECU_ADDRESS 0xF4F98 /end MEASUREMENT
/begin MEASUREMENT wnwsmxe_w "" SWORD kw_sw_q0p0078 1 100 -256.0000 255.9922 FORMAT "%8.4" ECU_ADDRESS 0xF4F6E /end MEASUREMENT
/begin MEASUREMENT wnwspasx_w "" UWORD kw_q0p0156 1 100 0.00 1023.984 FORMAT "%8.3" ECU_ADDRESS 0xF179C /end MEASUREMENT
/begin MEASUREMENT wnwsrfie_w "" SWORD kw_sw_q0p0078 1 100 -256.0000 255.9922 FORMAT "%8.4" ECU_ADDRESS 0xF2B7C /end MEASUREMENT
/begin MEASUREMENT wnwsswa_w "" SWORD kw_sw_q0p0078 1 100 -256.0000 255.9922 FORMAT "%8.4" ECU_ADDRESS 0xF2BDC /end MEASUREMENT
/begin MEASUREMENT wnwsswe_w "" SWORD kw_sw_q0p0078 1 100 -256.0000 255.9922 FORMAT "%8.4" ECU_ADDRESS 0xF2B7E /end MEASUREMENT
/begin MEASUREMENT wnwsta_w "" SWORD kw_sw_q0p0078 1 100 -256.0000 255.9922 FORMAT "%8.4" ECU_ADDRESS 0xF2B52 /end MEASUREMENT
/begin MEASUREMENT wnwstba_w "" SWORD kw_sw_q0p0078 1 100 -256.0000 255.9922 FORMAT "%8.4" ECU_ADDRESS 0xF2B54 /end MEASUREMENT
/begin MEASUREMENT wnwste_w "" SWORD kw_sw_q0p0078 1 100 -256.0000 255.9922 FORMAT "%8.4" ECU_ADDRESS 0xF2B56 /end MEASUREMENT
/begin MEASUREMENT wnwstpa_w "" SWORD kw_sw_q0p0078 1 100 -256.0000 255.9922 FORMAT "%8.4" ECU_ADDRESS 0xF2B58 /end MEASUREMENT
/begin MEASUREMENT wnwsyna_w "" SWORD kw_sw_q0p0078 1 100 -256.0000 255.9922 FORMAT "%8.4" ECU_ADDRESS 0xF2B5A /end MEASUREMENT
/begin MEASUREMENT wnwsyne_w "" SWORD kw_sw_q0p0078 1 100 -256.0000 255.9922 FORMAT "%8.4" ECU_ADDRESS 0xF2B5C /end MEASUREMENT
/begin MEASUREMENT wnwue "" UBYTE kw_q0p5 1 100 0.00 127.5 FORMAT "%5.1" ECU_ADDRESS 0xF0BD1 /end MEASUREMENT
/begin MEASUREMENT wnwue_w "" UWORD kw_q0p0019 1 100 0.00 127.9980 FORMAT "%8.4" ECU_ADDRESS 0xF2B04 /end MEASUREMENT
/begin MEASUREMENT wnwug_w "" SWORD kw_q0p0078 1 100 -256.0000 255.9922 FORMAT "%8.4" ECU_ADDRESS 0xF2B06 /end MEASUREMENT
/begin MEASUREMENT wnwu_w "" SWORD kw_q0p0078 1 100 -256.0000 255.9922 FORMAT "%8.4" ECU_ADDRESS 0xF2B08 /end MEASUREMENT
/begin MEASUREMENT wnwva_w "" SWORD kw_q0p0078 1 100 -256.0000 255.9922 FORMAT "%8.4" ECU_ADDRESS 0xF2B0A /end MEASUREMENT
/begin MEASUREMENT wnwve_w "" SWORD kw_q0p0078 1 100 -256.0000 255.9922 FORMAT "%8.4" ECU_ADDRESS 0xF2B0C /end MEASUREMENT
/begin MEASUREMENT wnwvg_w "" UWORD kw_q0p0019 1 100 0.00 127.9980 FORMAT "%8.4" ECU_ADDRESS 0xF2B0E /end MEASUREMENT
/begin MEASUREMENT wnwvumxa_w "" UWORD kw_q0p0078 1 100 0.00 511.9922 FORMAT "%8.4" ECU_ADDRESS 0xF2B10 /end MEASUREMENT
/begin MEASUREMENT wnwvumxe_w "" UWORD kw_q0p0078 1 100 0.00 511.9922 FORMAT "%8.4" ECU_ADDRESS 0xF2B12 /end MEASUREMENT
/begin MEASUREMENT wnwvumx_w "" UWORD kw_q0p0078 1 100 0.00 511.9922 FORMAT "%8.4" ECU_ADDRESS 0xF2B14 /end MEASUREMENT
/begin MEASUREMENT wnwvu_w "" UWORD kw_q0p0078 1 100 0.00 511.9922 FORMAT "%8.4" ECU_ADDRESS 0xF2B16 /end MEASUREMENT
/begin MEASUREMENT znlphausf "" UBYTE dez 1 100 0.00 255.0 FORMAT "%5.1" ECU_ADDRESS 0xF0703 /end MEASUREMENT
/begin MEASUREMENT znlphausr "" UBYTE dez 1 100 0.00 255.0 FORMAT "%5.1" ECU_ADDRESS 0xF0704 /end MEASUREMENT
/begin MEASUREMENT znlphstim "" UBYTE dez 1 100 0.00 255.0 FORMAT "%5.1" ECU_ADDRESS 0xF0705 /end MEASUREMENT
/begin MEASUREMENT zphflsyn "" UBYTE dez 1 100 0.00 255.0 FORMAT "%5.1" ECU_ADDRESS 0xF0713 /end MEASUREMENT
/begin MEASUREMENT zphflx "" UBYTE dez 1 100 0.00 255.0 FORMAT "%5.1" ECU_ADDRESS 0xF0714 /end MEASUREMENT
/begin MEASUREMENT zwsol "" SBYTE zw_sb_q0p75 1 100 -96.00 95.25 FORMAT "%5.2" ECU_ADDRESS 0xF0C3D /end MEASUREMENT
/begin MEASUREMENT zyleausb "" UBYTE dez 1 100 0.00 255.0 FORMAT "%5.1" ECU_ADDRESS 0xF0706 /end MEASUREMENT
/begin MEASUREMENT zzbank "" UWORD dez 1 100 0.00 65535.00 FORMAT "%8.2" ECU_ADDRESS 0xF0CAC /end MEASUREMENT
/begin FUNCTION MDZUL "4.100"
 /begin DEF_CHARACTERISTIC CWMDZUL KFDMP KFDMT KFMOF KFPZU KLDMMX KLLLRZU KLMIMAX KLMIMIN KLMZUMN MZFFIL MZFTV NSTART NSTEND SMO08MFUB SNM08MFUB STM08MFUB SWP08MFUB TANSMN TMBST TMNSMN TMOMIN TNSC TNSOF /end DEF_CHARACTERISTIC
 /begin REF_CHARACTERISTIC MDIMX /end REF_CHARACTERISTIC
 /begin IN_MEASUREMENT B_fgr B_klmzu_um B_mrakt B_msr B_mzns_um B_sgs dmllrl_w dmrmx_w etazwbm etazwmn fnstab_w mdslw_w mdverf_w mdvervf_w nmot tans tmot tnst_w wped /end IN_MEASUREMENT
 /begin OUT_MEASUREMENT B_bbkoptuf B_mdbglst B_mdblst B_mdbresl B_mdbza miszull_w miszul_w /end OUT_MEASUREMENT
 /begin LOC_MEASUREMENT B_inidtf B_mbst B_mzns B_nsakt B_nsend esst_smo08mfub esst_snm08mfub esst_stm08mfub esst_swp08mfub mdverbmx_w miszullb_w mizufil_w mizuofil mizutmp_w mizuvfil tmotmn tnscCtr_w tnsofCtr /end LOC_MEASUREMENT
/end FUNCTION
/begin FUNCTION MDZW "1.122" /begin DEF_CHARACTERISTIC DMAUFN DZWETA /end DEF_CHARACTERISTIC
 /begin IN_MEASUREMENT B_zwvs B_zwvz etazaist mibas_w miopt_w misol_w mizsol_w mizwmn_w nmot_w redist zwopt /end IN_MEASUREMENT
 /begin OUT_MEASUREMENT B_nozwe dmaufr_w etazws zwsol /end OUT_MEASUREMENT
 /begin LOC_MEASUREMENT B_zwvzm dzws /end LOC_MEASUREMENT
/end FUNCTION
/begin FUNCTION MOTAUS "5.80" /begin DEF_CHARACTERISTIC TNLSGMN TNLSGMX UBNLMN /end DEF_CHARACTERISTIC /begin IN_MEASUREMENT B_kl15 B_pwf B_stend ub /end IN_MEASUREMENT
 /begin OUT_MEASUREMENT B_nachl B_nachlend B_nachlram B_nachlstp B_nlacls B_nlale B_nlatm B_nlcan B_nldtafx B_nldte B_nldval B_nldve B_nlEEPR B_nletm B_nlmls B_nlobd B_nlsgls B_nlsiko B_nlubr B_nlwfs B_nlwst swOffD2Bits swOffDlBits tnachl_w /end OUT_MEASUREMENT
/end FUNCTION
/begin FUNCTION MRKOMD "1.10" /begin IN_MEASUREMENT milsol_w mimax_w mimin_w /end IN_MEASUREMENT /begin OUT_MEASUREMENT mrko mrko_w /end OUT_MEASUREMENT /end FUNCTION
/begin FUNCTION NLDG "2.70"
 /begin DEF_CHARACTERISTIC DYNMXNL FIRNLIGN FNLMI0 FNLMI1 FNLMI2 KLDTPH KLDTPHST KLDYNCOR KLNLPHN KLWNWI KNLSYN MXNLFEHL TNLPHWAIT TNLSYNMN TNLSYNMX /end DEF_CHARACTERISTIC
 /begin REF_CHARACTERISTIC CWNWREF /end REF_CHARACTERISTIC
 /begin IN_MEASUREMENT B_nldg B_phad B_phad2 B_phnegtiv B_phsok B_phsok2 B_st B_switchpg B_wnwi2out B_wnwiout nmot synstate tmot wnwi2_ad_w wnwi_ad_w wnwkwas2_w wnwkwas_w wnwspas2_w wnwspas_w zphfl zphfl2 /end IN_MEASUREMENT
 /begin OUT_MEASUREMENT B_phnldg B_synnldg nsynnldg zphflsyn /end OUT_MEASUREMENT
 /begin LOC_MEASUREMENT B_2ph B_3ph B_ensynnl B_gapnldg B_kllknl B_lkklnl B_noknldg B_phfalse B_resetsyn B_rphsp B_synoknl B_wnwioutx dtsegph_w mtsegph_w tnbmphs0_w tPh1_w tsegph_w wnwix_w wnwkwasx_w wnwspasx_w zphflx /end LOC_MEASUREMENT
/end FUNCTION
/begin FUNCTION NLPH "5.40"
 /begin DEF_CHARACTERISTIC ANZEAUS CWNLPH NPHERKMN NPHERKMX NPHINVMN NPHINVMX RLPHERKMN RLPHERKMX TPHERKMN TPHSABSP TPHSSP ZYLEAUS /end DEF_CHARACTERISTIC
 /begin IN_MEASUREMENT B_bm B_dluerk B_ll B_luaerk B_luerk B_lustop B_mdstim B_mdstop B_nldg B_nlphea B_pha2act B_phaact B_phsok B_phsok2 B_pwf B_synph fdmd flg nmot rl synstate tmot zzyl /end IN_MEASUREMENT
 /begin OUT_MEASUREMENT anzeausb B_dopzue B_nlph B_nosynph B_phsnl B_phsnlab B_phsnlinv B_phsnlok B_stimnlph nsynnlph phLosCtr_w znlphausf znlphausr znlphstim zyleausb /end OUT_MEASUREMENT
 /begin LOC_MEASUREMENT B_delaysyn B_optpherk /end LOC_MEASUREMENT
/end FUNCTION
/begin FUNCTION NMAXMD "19.30"
 /begin DEF_CHARACTERISTIC DNMAX DNSIAB ITNMXH KINMXNL KINMXRLG KLTNMXPR MDIMX NMAX NMAXDV NMAXDVG NMAXDZ NMAXGA NMAXKR NMAXNL NMAXOGGA NMXPNL NMXPRLG TMOTNMX TNMXH VNMX /end DEF_CHARACTERISTIC
 /begin REF_CHARACTERISTIC DNMAXH SGA08MDUB SRL08NXUB /end REF_CHARACTERISTIC
 /begin IN_MEASUREMENT B_autget B_dknolu B_dkpu B_dopzue B_krdws B_nldg B_nmaxext esst_sga08mdub esst_srl08nxub gangi mifab_w ndcdis_w ngfil_w nmaxext_w nmot_w rl tmot vfzg /end IN_MEASUREMENT
 /begin OUT_MEASUREMENT B_nmax minmx_w nsber_w /end OUT_MEASUREMENT
 /begin LOC_MEASUREMENT B_nmaxd B_nmaxog B_nmxkr B_tmnmax dmnmxi_w dmnmxp_w dnsi_w kinmx nmax_w nmotpr_w nmxpr /end LOC_MEASUREMENT
/end FUNCTION
/begin FUNCTION NWEVDA "2.10" /begin DEF_CHARACTERISTIC CWNWEVDA /end DEF_CHARACTERISTIC /begin IN_MEASUREMENT B_dktlp /end IN_MEASUREMENT /begin OUT_MEASUREMENT B_nwsebd /end OUT_MEASUREMENT /end FUNCTION
/begin FUNCTION NWEVO "1.170"
 /begin DEF_CHARACTERISTIC ANZLVMXA ANZLVMXE CWNWEVO DWNWESTPA DWNWSHKA DWNWSHKE DWNWSTPA DWNWSTPE DWNWSTPEA DWNWSTPEE DWNWSVPA DWNWSVPE DWNWVPA DWNWVPE DWNWVSA MXSHKA MXSHKE NGNWLLNA NNWSHKMN NNWSHKMX SHKNWMXA SHKNWMXE TANWSVA TANWSVE TNWLLAMXA TNWLLNA TNWLVA TNWLVE TNWLVRPA TNWLVRPE TNWSHK TNWSHKAA TNWSHKAE TNWSTPA TNWSVA TNWSVE /end DEF_CHARACTERISTIC
 /begin REF_CHARACTERISTIC SNM05NWUW STO06NWUW WNWRAS WNWREO /end REF_CHARACTERISTIC
 /begin IN_MEASUREMENT B_brems B_enwsva B_enwsve B_fanwsaa B_fanwsea B_kuppl B_nmin B_nwrposa B_nws B_nwsst B_sa esst_snm05nwuw esst_sto06nwuw ngfil nmot nmot_w toelk_w wnwa_w wnwe_w wnwsaa_w wnwsae_w wnwsa_w wnwse_w wnwsfaa_w wnwsfae_w wnwsmna_w wnwsmne_w wnwsmxa_w wnwsmxe_w /end IN_MEASUREMENT
 /begin OUT_MEASUREMENT B_anwva B_anwve B_nwllna B_nwseva B_nwseve B_nwstpa wnwseva_w wnwseve_w /end OUT_MEASUREMENT
 /begin LOC_MEASUREMENT anzlvnwa anzlvnwe B_break1a B_break1e B_break2a B_break2e B_nwilpa B_nwlva B_nwlva2 B_nwlve B_nwlve2 B_nwlvrpa B_nwrllna B_nwshka B_nwshkaa B_nwshkae B_nwshkapa B_nwshkape B_nwshke B_nwshko B_nwshkrpa B_nwshkrpe B_nwshkta B_nwshkte B_nwsilpa B_nwsyna B_nwsyne B_shken B_stat1to2a B_stat1to2e B_stat2to1a B_stat2to1e B_stpsyna B_stpsyne B_tnwlva B_tostat1a B_tostat1e B_tostat2a B_tostat2e B_wnstvhe ctrshknwa ctrshknwe ctr_anwva ctr_anwve dwnwasa2_w dwnwasa_w dwnwstpa_w statnwshka statnwshke wnshkmna_w wnshkmne_w wnshkmxa_w wnshkmxe_w wnstvhe_w wnwshka_w wnwshke_w wnwslva2_w wnwslva_w wnwslve2_w wnwslve_w wnwsta_w wnwstba_w wnwste_w wnwstpa_w wnwsyna_w wnwsyne_w /end LOC_MEASUREMENT
/end FUNCTION
/begin FUNCTION NWFW "2.60"
 /begin DEF_CHARACTERISTIC CWNWFW KFFNWA KFFNWE KFNWWUA KFNWWUE NWUEBER0 NWUEBER1 NWUEBER2 NWUEBER3 /end DEF_CHARACTERISTIC
 /begin IN_MEASUREMENT fnwua fnwue nmot_w rl rlnw_w wnwe_w wnwsmxa_w wnwsmxe_w wnwva_w wnwve_w /end IN_MEASUREMENT
 /begin OUT_MEASUREMENT B_fnwea B_fnwea2 B_fnwea3 fnwaa fnwea fnwea1 fnwea2 fnwea3 /end OUT_MEASUREMENT
 /begin LOC_MEASUREMENT fnwue1lc_w fnwue2lc_w fnwue3lc_w /end LOC_MEASUREMENT
/end FUNCTION
/begin FUNCTION NWSFAT "1.30"
 /begin DEF_CHARACTERISTIC DMRDNW NFANWS TNWAPTA TNWAPTE TNWFARA TNWFARE TNWPPTA TNWPPTE TNWVBGNA TNWVBGNE /end DEF_CHARACTERISTIC
 /begin IN_MEASUREMENT B_dnwsa B_dnwse B_fa B_fanwsa B_fanwse nmot wnwsmna_w wnwsmne_w wnwsmxa_w wnwsmxe_w /end IN_MEASUREMENT
 /begin OUT_MEASUREMENT B_fanwftva B_fanwftve B_fanwsaa B_fanwsea B_fanwstaa B_fanwstae B_fanwta B_fanwte dmrdnw_w wnwsfaa_w wnwsfae_w /end OUT_MEASUREMENT
 /begin LOC_MEASUREMENT statetnwa statetnwe /end LOC_MEASUREMENT
/end FUNCTION
/begin FUNCTION NWSOLLA "13.30"
 /begin DEF_CHARACTERISTIC DTOELKNWHA DWNWABGA DWNWAMXA DWNWSBGLA FNWSKRA GANGNWLLPA KFNWKHA KFNWKHKA KFNWKHLLA KFNWKHLLKA KFNWKRA KFNWLLA KFNWLLHA KFNWSA KFNWSHA KFNWTMA KFNWWLA KFNWWLLA KFWNWSAPA KLTOELNWH KTNWSABGKA KTNWSNABGA KTNWSPABGA NMKFNWLLA NWTMKHA TMNWLLKHA TNWSBGLA TNWSBGNSTA TNWWSPA VNWLLPA WNWBKVA WNWDSHKA WNWRAS WNWSAAPP WNWSAPFA WNWSAPSA WNWSGUDA WNWSMNA WNWSMXA WNWSTA WNWSWOFA WNWVAS /end DEF_CHARACTERISTIC
 /begin REF_CHARACTERISTIC SNM05NAUW SNM05NWUB SNM05NWUW SNM16NAUW SRL05NAUW SRL08NAUW SRL16NAUW STM05NWUB /end REF_CHARACTERISTIC
 /begin IN_MEASUREMENT B_bbkoptuf B_bkvnwab B_dnwsa B_enwsva B_fanwstaa B_fnwstva B_ll B_nwrposa B_nwsapkfa B_nwsappa B_nwsebd B_nwseva B_nwsguda B_nwskflla B_nwssprga B_nwsst B_nwvfa B_wnwsmxfa esst_snm05nauw esst_snm05nwub esst_snm05nwuw esst_snm16nauw esst_srl05nauw esst_srl08nauw esst_srl16nauw esst_stm05nwub fho_w fnwkha gangi kmstand_w nmot nmot_w rk_w rlnw_w tmot tmst tnst_w toelk_w tumg vfzg wkrma wnwadmxa_w wnwa_w wnwseva_w wnwsfaa_w /end IN_MEASUREMENT
 /begin OUT_MEASUREMENT B_nwsbgla B_nwslla B_wnws0a wnwahom_w wnwass wnwsaa_w wnwsa_w wnwsmna_w wnwsmxa_w /end OUT_MEASUREMENT
 /begin LOC_MEASUREMENT B_nwsapspa B_toelnwha dwnwabga_w dwnwamxa_w fnwtmkha fnwwarma nwsollalokbits tnwsbga tnwsbnsa_w wdnwsa_w wnwdshka_w wnwkha_w wnwkhlla_w wnwsapa_w wnwsbga_w wnwskwa_w wnwskwka_w wnwskwla_w wnwsswa_w /end LOC_MEASUREMENT
/end FUNCTION
/begin FUNCTION NWSOLLE "13.10"
 /begin DEF_CHARACTERISTIC CWNWEHOE DWNWABGE DWNWAMXE DWNWSBGLE FNWSKRE KFDWNWSUE KFNWKHE KFNWKHKE KFNWKHLLE KFNWKHLLKE KFNWKRE KFNWLLE KFNWSE KFNWTME KFNWWLE KFNWWLLE KFWNWSAPE KLTVNW KTNWSABGKE KTNWSNABGE KTNWSPABGE NMKFNWLLE NWTMKHE TNWSBGLE TNWSBGNSTE TNWWSPE WNSRFIXE WNWBKVE WNWDSHKE WNWREO WNWSAPFE WNWSAPSE WNWSEAPP WNWSGUDE WNWSMNE WNWSMXE WNWSTE WNWSWOFE /end DEF_CHARACTERISTIC
 /begin REF_CHARACTERISTIC SNM05NEUW SNM05NWUB SNM05NWUW SNM16NEUW SRL05NEUW SRL08NEUW SRL16NEUW STM05NWUB /end REF_CHARACTERISTIC
 /begin IN_MEASUREMENT B_bkvnwab B_dnwse B_enwsve B_fanwstae B_fnwstve B_ll B_nwrpose B_nws B_nwsapkfe B_nwsappe B_nwsebd B_nwseve B_nwsgude B_nwskflle B_nwssprge B_nwsst B_nwvfe B_su B_wnwsmxfe dwnsrfie_w esst_snm05neuw esst_snm05nwub esst_snm05nwuw esst_snm16neuw esst_srl05neuw esst_srl08neuw esst_srl16neuw esst_stm05nwub fho_w fnwkhe nmot nmot_w rk_w rlnw_w tmot tmst tnst_w tumg tvsuae wkrma wnwadmne_w wnwe_w wnwseve_w wnwsfae_w /end IN_MEASUREMENT
 /begin OUT_MEASUREMENT B_nwsbgle B_sunw B_wnws0e NWSOLLEausbits_10ms NWSOLLEausbits_koop wnsrfixe_w wnwehom_w wnweos wnwsae_w wnwse_w wnwsmne_w wnwsmxe_w /end OUT_MEASUREMENT
 /begin LOC_MEASUREMENT B_nwsapspe dwnwabge_w dwnwamxe_w dwnwsue_w fnwtmkhe fnwwarme NWSOLLElokbits_koop tnwsbge tnwsbnse_w tvnwe wdnwse_w wnwdshke_w wnwkhe_w wnwkhlle_w wnwsape_w wnwsbge_w wnwskwe_w wnwskwke_w wnwskwle_w wnwsrfie_w wnwsswe_w /end LOC_MEASUREMENT
/end FUNCTION
/begin FUNCTION NWSYVAR "2.30" /begin IN_MEASUREMENT wnwi2_ad_w wnwi_ad_w /end IN_MEASUREMENT /begin OUT_MEASUREMENT wnwisa_w wnwise_w /end OUT_MEASUREMENT /end FUNCTION
/begin FUNCTION NWWUE "5.50" /begin REF_CHARACTERISTIC WNWRAS WNWREO /end REF_CHARACTERISTIC
 /begin IN_MEASUREMENT B_dnwsa B_dnwse B_enwsva B_enwsve wnwahom_w wnwa_w wnwehom_w wnwe_w wnwsmna_w wnwsmne_w wnwsmxa_w wnwsmxe_w /end IN_MEASUREMENT
 /begin OUT_MEASUREMENT B_nwswg fnwua fnwue fnwu_w wnvuhoms_w wnwgv_w wnwue wnwue_w wnwva_w wnwve_w wnwvg_w wnwvumxa_w wnwvumxe_w wnwvumx_w wnwvu_w /end OUT_MEASUREMENT
 /begin LOC_MEASUREMENT wnwug_w wnwu_w /end LOC_MEASUREMENT
/end FUNCTION
/begin FUNCTION PDCK "3.10" /begin DEF_CHARACTERISTIC DATAID /end DEF_CHARACTERISTIC /begin OUT_MEASUREMENT pdck_state /end OUT_MEASUREMENT /end FUNCTION
/begin FUNCTION PHAS "" /begin IN_MEASUREMENT B_nldg B_phas2 B_phase B_phnegtiv B_switchpg zrph zrph2 /end IN_MEASUREMENT /end FUNCTION
/begin FUNCTION PK "" /end FUNCTION
/begin FUNCTION PROKON "4.20"
 /begin DEF_CHARACTERISTIC CDAGR CDAGRL CDATR CDATS CDBKVP CDDSBKV CDDST CDDYLSU CDEGFE CDEHFM CDGGGTS CDHELSU CDHRLSU CDHRLSUE CDHSH CDHSHE CDHSV CDHSVE CDICLSU CDKAT CDKVS CDLASF CDLASH CDLATP CDLATV CDLDP CDLLR CDLSA CDLSFHV CDLSH CDLSHV CDLSV CDLSVV CDMD CDNWS CDPLLSU CDSALSU CDSLS CDSWE CDTANKL CDTES CDULSU CDWVERAD CWADRES CWDLSU CWERFIL CWGRABH CWKMMILSCT CWKONABG CWKONFLS CWKONFZ1 CWKONLS CWLSFA CWLSHA CWMDAPP CWOBD CWSCTMDE CWSLS CWTF CWUHR NSWO1 NSWO2 WESSOT /end DEF_CHARACTERISTIC
 /begin IN_MEASUREMENT nmot /end IN_MEASUREMENT
 /begin OUT_MEASUREMENT B_4wd B_abstnl B_adrkra B_adrldra B_adrlra B_adrmdver B_adrmsdk B_adrsta B_asrfz B_autget B_cdagr B_cdagrl B_cdanws B_cdatr B_cdats B_cdbkvp B_cddsbkv B_cddst B_cddylsu B_cdegfe B_cdehfm B_cdenws B_cdgts B_cdhelsu B_cdhrlsu B_cdhrlsue B_cdhsh B_cdhshe B_cdhsv B_cdhsve B_cdiclsu B_cdkat B_cdkvs B_cdlasf B_cdlash B_cdlatp B_cdlatv B_cdldp B_cdllr B_cdlsa B_cdlsfhv B_cdlsh B_cdlshv B_cdlsv B_cdlsvv B_cdmd B_cdnws B_cdpllsu B_cdsalsu B_cdsls B_cdswe B_cdtankl B_cdtes B_cdulsu B_cvt B_cwlshdyn B_cwlshmf B_cwlshsch B_cwlshvl B_dslvh B_dssv B_dssvnl B_dsuv B_fpwdkap B_gra6p B_gracan B_hfmv B_katfz B_kath B_kmmilsct B_ldsafw B_ldsapp B_ls4 B_ls42 B_lsf B_lsf2 B_lsh B_lsh2 B_lsv B_lsv2 B_mde8e B_mde9e B_mt B_niveau B_nswo1 B_nswo2 B_plsolap B_png B_slsfz B_tfu B_uhrrmin B_uhrrsec B_wdksap B_zwappl cd_bits1_w cd_bits2_w cd_bits3_w cd_bits4_w cw_erfil cw_obd grundwert wessbm zzbank /end OUT_MEASUREMENT
/end FUNCTION
/begin FUNCTION PWFD "1.70" /begin DEF_CHARACTERISTIC CWPWF /end DEF_CHARACTERISTIC /begin OUT_MEASUREMENT B_pwf B_pwfCsErr /end OUT_MEASUREMENT /end FUNCTION
/begin FUNCTION RDE "1.40" /begin DEF_CHARACTERISTIC DNABW KLTNRDE NMOTRDE RDUNDEF UBDTRDE /end DEF_CHARACTERISTIC
 /begin IN_MEASUREMENT B_fbm B_nmin dnmot_w nmotll synstate tmot ub vfzg_w wkwbzm0_w wkw_w wub zzseg /end IN_MEASUREMENT
 /begin OUT_MEASUREMENT B_enabrde B_motstop B_rdeplaus B_rdeundef /end OUT_MEASUREMENT
 /begin LOC_MEASUREMENT B_abw B_anlaus B_verrueck B_waitgap rdeBits tnbmrde tnbmrde1 tnbmrde2 ubrde wkwas_rde /end LOC_MEASUREMENT
/end FUNCTION
/begin FUNCTION RKTI "11.40"
 /begin DEF_CHARACTERISTIC CWDMIL CWPKAPP FKKVS FRLFSDP KMITIBGR KRKTE PSAPES PVMITIBGR TEMIN TEMINVA TVTSPEV TVUB ZTSPEV /end DEF_CHARACTERISTIC
 /begin IN_MEASUREMENT B_ba B_bag B_stend B_va evtmod mifab_w nmot nmot_w ps_w pu_w rk2_w rk_w ub vsfpses /end IN_MEASUREMENT
 /begin OUT_MEASUREMENT B_temin B_temin2 dtimx_w evtmodev mitibgr_w ti2_w timxth_w timx_w ti_b1 ti_b2 ti_tvu_w ti_w tvsp_w /end OUT_MEASUREMENT
 /begin LOC_MEASUREMENT B_enimiti dpus_w frkte_w ftek2_w ftek_w mitibgri_w mitibgrp_w RKTIlokbits te2_w tevfa2_w tevfakge_w tevfa_w te_w tvu_w /end LOC_MEASUREMENT
/end FUNCTION
/begin FUNCTION RPSLSU "2.20" /begin DEF_CHARACTERISTIC CWRPSLSU IPREFLSUB IPREFLSUE TKERRPSON TVRPSONMX /end DEF_CHARACTERISTIC /begin IN_MEASUREMENT B_hsv B_hsv2 B_nmot tkerlsu2_w tkerlsu_w /end IN_MEASUREMENT /begin OUT_MEASUREMENT iprefanf iprefanf2 /end OUT_MEASUREMENT /end FUNCTION
/begin FUNCTION RSA "" /begin LOC_MEASUREMENT ctr_RSABlock /end LOC_MEASUREMENT /end FUNCTION
/begin FUNCTION RSTMON "4.90" /begin IN_MEASUREMENT B_pwf /end IN_MEASUREMENT /begin OUT_MEASUREMENT rstMon rstMonIdx /end OUT_MEASUREMENT /end FUNCTION
/begin FUNCTION RUNTIME "" /begin DEF_CHARACTERISTIC AUFW100M AUFW10MS AUFW20MS AUFWSYNC RESETMAX /end DEF_CHARACTERISTIC
 /begin IN_MEASUREMENT B_dash B_kr B_llr B_lrs B_lsd B_sa nmot nmot_w rl systemStackUsage userStackUsage wdkba wped /end IN_MEASUREMENT
 /begin OUT_MEASUREMENT B_lzs_dash B_lzs_kr B_lzs_ldr B_lzs_lr B_lzs_lsd B_lzs_sa cyclebg_w laufz100_w laufz10m_w laufz1m_w laufz1s_w laufz200_w laufz20m_w laufz2m_w laufz50m_w laufz5m_w laufzbg_w laufzmbg_w laufzmfa_w laufzsyn2_w laufzsyn_w lzmaxnmot lzmaxrl lzmaxstate lzmaxwdkba lzmaxwped PercentToResetmax_w PercentToReset_w perffilt_w perfilt_bg perfmax_w perform_bg perform_w peri40ms_w rlossCtr_w system_stack_w user_stack_w /end OUT_MEASUREMENT
 /begin LOC_MEASUREMENT cntbg_w /end LOC_MEASUREMENT
/end FUNCTION
/begin FUNCTION SALSU "100.10" /begin IN_MEASUREMENT o2vk2_w o2vk_w /end IN_MEASUREMENT /begin OUT_MEASUREMENT ko2vk2_w ko2vk_w o2adap2_w o2adap_w /end OUT_MEASUREMENT /end FUNCTION
/begin FUNCTION SCATT "20.90" /begin IN_MEASUREMENT B_m9cvnout B_mde9e fcmEnd /end IN_MEASUREMENT /begin OUT_MEASUREMENT B_m8te B_m9cvnclr scattBits /end OUT_MEASUREMENT /end FUNCTION
/begin FUNCTION SGAAU "4.30"
 /begin DEF_CHARACTERISTIC CWAU2 LAMSAUF LAMSAUM TMAU TNSTAU TVAUAK TVAUF TVAUM VFZGAU /end DEF_CHARACTERISTIC
 /begin REF_CHARACTERISTIC TMDMN /end REF_CHARACTERISTIC
 /begin IN_MEASUREMENT B_ll tmot tmotlin tnst_w vfzg /end IN_MEASUREMENT
 /begin OUT_MEASUREMENT B_auakt lamau_w /end OUT_MEASUREMENT
/end FUNCTION
/begin FUNCTION SLS "88.220"
 /begin DEF_CHARACTERISTIC CWFASL DPSLV FMSL FMSL2 FMSLOFF FMSRHOL FMSTMOT IMLSLMNTMS IMLSLMXTMS IMLSLSA IMLSLSE KFFMSML MLSLMX MSLUB TASLSO TASLSU TDDSLA TDSLKT TFASLAMN TLMSSLAB TLMSSLMX TLMSSLTNS TMFASLMN TMSSLO TMSSLSTO TMSSLSTU TMSSLU TSLABB TSLPMN TSLUBST TVDSLVON TVSLP2 TVSLVOFF TVSLVON UBSLMN UBSLMX UBSLSTMN VSLS ZFLMSSL ZKSLPOFF ZKSLPON ZKSLSOFML ZKSLSONML /end DEF_CHARACTERISTIC
 /begin REF_CHARACTERISTIC CWSLS /end REF_CHARACTERISTIC
 /begin IN_MEASUREMENT B_atmtpl B_brems B_dslfa B_dslsp4 B_dspe B_fa B_fasls B_fs B_kh B_kha B_khab B_kuppl B_ll B_mslmn B_nmot B_slsfz B_st B_stend fmsla fmsla2 frhokor_w imlpr mlbb2_w mlbb_w ml_w nmot ps_w pu rl tans tmot tmst tnst_w ubsqf_w verhmsb2_w verhmsb_w vfzg /end IN_MEASUREMENT
 /begin OUT_MEASUREMENT B_eslpe B_eslve B_fasla B_lmsslof B_msloff B_slkhof B_slp B_slp2 B_slpmn B_slpmn2 B_slpoff B_sls B_slsadap B_slsoab B_slsoff B_slv flamsl2_w flamsl_w flmssl fmslrho msl msl2 msl2_w mslstat mslstat_w msl_w /end OUT_MEASUREMENT
 /begin LOC_MEASUREMENT B_dslreset B_dslset B_mslon B_sldsl4 B_slkt B_slpanst B_slpena B_slpofst B_slsdis B_slserr B_slsinhi fmsagd fmsldyn fmslkor fmsltm fslpdyn imlsla_w imlsle_w mslkorr_w mslpub_w /end LOC_MEASUREMENT
/end FUNCTION
/begin FUNCTION SREAKT "7.70"
 /begin IN_MEASUREMENT B_appnolu B_dkp1e B_dkp2e B_dkpaw B_dlrbe B_dlrpide B_fproab B_fprzab B_i_ska_um B_nlpne B_ubdve B_ub_ok B_umauab B_wdksive /end IN_MEASUREMENT
 /begin OUT_MEASUREMENT B_dknolu B_dknot B_dkpiu B_dkpru B_dkpu B_i_ska_fr B_notlu_fr /end OUT_MEASUREMENT
 /begin LOC_MEASUREMENT B_dkunb /end LOC_MEASUREMENT
/end FUNCTION
/begin FUNCTION SRMHFM "1.10" /begin DEF_CHARACTERISTIC KFPBRKLM KFPBRKNWLM /end DEF_CHARACTERISTIC
 /begin IN_MEASUREMENT fnwue fupsrl_w fvisrm_w nmot_w pbrint_w psmx_w pu_w rlfgroh_w wdkba_w /end IN_MEASUREMENT
 /begin OUT_MEASUREMENT dpsfglm_w psfglm_w /end OUT_MEASUREMENT
 /begin LOC_MEASUREMENT fpbrkdlm_w pbrlm_w pslm_w rflmorgi_w rfrextlm_w rlfglm_w /end LOC_MEASUREMENT
/end FUNCTION
/begin FUNCTION SRMSEL "1.50"
 /begin IN_MEASUREMENT B_hfm dpsfglm_w fpbrkdlm_w psfglm_w pslm_w pu_w rflmorgi_w rir_w rlfglm_w rlr_w umsrln_w /end IN_MEASUREMENT
 /begin OUT_MEASUREMENT B_dssakt dpsfg_w drl_w fpbrkds_w ml ml_w msfabr_w msfebr_w ps psfg_w ps_w rfges_w rforgi_w rl rlfg_w rl_w /end OUT_MEASUREMENT
/end FUNCTION
/begin FUNCTION SSTB ""
 /begin DEF_CHARACTERISTIC FHO04ESUB SAN12ESUW SDK10TEUB SEZ06TMUB SFR05TEUB SGA06MDUB SGA08MDUB SIM06ESUW SKS06ESUB SLA05ESUB SLX06TMUW SLY06TMUW SM108LHSW SM208LHSW SMI04LLUB SML05DKUB SML06TEUB SML06TMUW SML07TMUW SML08LHUB SMT06TMUW SNG06LLSB SNM05DKUB SNM06ESUB SNM06LLUB SNM06MDUW SNM06NWUB SNM07ESUB SNM08FEUB SNM08LHUB SNM08OPUB SNM08__UB SNM10LSUB SNM10TEUB SNM12ESUB SNM12FEUB SNM16CIUB SNM16KRDYUB SNM16KRUB SNM16OPUW SNM16ZUUW SQM05TEUB SRL03KRUB SRL04KRUB SRL06ESUB SRL06KRUB SRL08DMUB SRL08NXUB SRL10LSUB SRL12ESUB SRL12ZUUW SRP06ESUB ST107TMUB ST207TMUB ST307TMUB ST407TMUB STA04LLUB STA06ESUB STA12ESUB STA12WLUB STK04SAUB STM04FEUB STM04SAUB STM04__UB STM05SAUB STM05TMUB STM06LLUB STM06NWUB STM06__UB STM08DMUB STM08MDUB STM08OPUB STM09ESUB STM10__UB STM12ESUB STN06LLUB STS08ESUB STS12ESUB SUE08MFUB SUV07MDUB SWP08OPUB /end DEF_CHARACTERISTIC
 /begin IN_MEASUREMENT anztib_w dlashkm2_w dlashkm_w etazwimt fho frmit gangi imlatm_w kstaa ladiff_w lamsbg2_w lamsbg_w mifa_w ml ml_w msabg ngfil nmot nmot_w pu qmsdyn rl rlp rl_w tabgmst tabgmst2 tabstatm_w tans tkatm tkatmst tkatmst2 tmot tmst tnst uefktget uevges wdkba wped /end IN_MEASUREMENT
 /begin OUT_MEASUREMENT esst_fho04esub esst_san12esuw esst_sdk10teub esst_sez06tmub esst_sfr05teub esst_sga06mdub esst_sga08mdub esst_sim06esuw esst_sks06esub esst_sla05esub esst_slx06tmuw esst_sly06tmuw esst_sm108lhsw esst_sm208lhsw esst_smi04llub esst_sml05dkub esst_sml06teub esst_sml06tmuw esst_sml07tmuw esst_sml08lhub esst_smt06tmuw esst_sng06llsb esst_snm05dkub esst_snm06esub esst_snm06llub esst_snm06mduw esst_snm06nwub esst_snm07esub esst_snm08feub esst_snm08lhub esst_snm08opub esst_snm08__ub esst_snm10lsub esst_snm10teub esst_snm12esub esst_snm12feub esst_snm16ciub esst_snm16krdyub esst_snm16krub esst_snm16opuw esst_snm16zuuw esst_sqm05teub esst_srl03krub esst_srl04krub esst_srl06esub esst_srl06krub esst_srl08dmub esst_srl08nxub esst_srl10lsub esst_srl12esub esst_srl12zuuw esst_srp06esub esst_st107tmub esst_st207tmub esst_st307tmub esst_st407tmub esst_sta04llub esst_sta06esub esst_sta12esub esst_sta12wlub esst_stk04saub esst_stm04feub esst_stm04saub esst_stm04__ub esst_stm05saub esst_stm05tmub esst_stm06llub esst_stm06nwub esst_stm06__ub esst_stm08dmub esst_stm08mdub esst_stm08opub esst_stm09esub esst_stm10__ub esst_stm12esub esst_stn06llub esst_sts08esub esst_sts12esub esst_sue08mfub esst_suv07mdub esst_swp08opub /end OUT_MEASUREMENT
/end FUNCTION
/begin FUNCTION SSTBNWSV ""
 /begin DEF_CHARACTERISTIC SLA09OPUW SNM04ZUUB SNM16__UW SNS04ZUSB SRL11OPUW SRR07OPUW STM08__UB SWE07OPSW /end DEF_CHARACTERISTIC
 /begin IN_MEASUREMENT dns lambas_w nmot nmot_w rl_w rri_w tmot wnwe_w /end IN_MEASUREMENT
 /begin OUT_MEASUREMENT esst_sla09opuw esst_snm04zuub esst_snm16__uw esst_sns04zusb esst_srl11opuw esst_srr07opuw esst_stm08__ub esst_swe07opsw /end OUT_MEASUREMENT
/end FUNCTION
/begin COMPU_METHOD B_TRUE "" TAB_VERB "%6.3" "" COMPU_TAB_REF B_TRUE /end COMPU_METHOD
/begin COMPU_VTAB B_TRUE "" TAB_VERB 2 0 "----" 1 "TRUE" /end COMPU_VTAB
/begin COMPU_METHOD dez "" RAT_FUNC "%6.2" "" COEFFS 0 1 0 0 0 1 /end COMPU_METHOD
/begin COMPU_METHOD fak_q0p0039 "" RAT_FUNC "%6.4" "-" COEFFS 0 256 0 0 0 1 /end COMPU_METHOD
/begin COMPU_METHOD fak_q0p1 "" RAT_FUNC "%6.3" "-" COEFFS 0 1 0 0 0 0.1 /end COMPU_METHOD
/begin COMPU_METHOD fak_sw_b1 "" RAT_FUNC "%7.6" "-" COEFFS 0 65536 0 0 0 2 /end COMPU_METHOD
/begin COMPU_METHOD fak_sw_b256 "" RAT_FUNC "%6.4" "-" COEFFS 0 65536 0 0 0 512 /end COMPU_METHOD
/begin COMPU_METHOD fak_ub_b1 "" RAT_FUNC "%6.4" "-" COEFFS 0 256 0 0 0 1 /end COMPU_METHOD
/begin COMPU_METHOD fak_ub_b16 "" RAT_FUNC "%6.4" "-" COEFFS 0 256 0 0 0 16 /end COMPU_METHOD
/begin COMPU_METHOD fak_ub_b2 "" RAT_FUNC "%6.4" "-" COEFFS 0 256 0 0 0 2 /end COMPU_METHOD
/begin COMPU_METHOD fak_ub_b4 "" RAT_FUNC "%6.4" "-" COEFFS 0 256 0 0 0 4 /end COMPU_METHOD
/begin COMPU_METHOD fak_ub_b8 "" RAT_FUNC "%6.4" "-" COEFFS 0 256 0 0 0 8 /end COMPU_METHOD
/begin COMPU_METHOD fak_uw_b16 "" RAT_FUNC "%6.5" "-" COEFFS 0 65536 0 0 0 16 /end COMPU_METHOD
/begin COMPU_METHOD fak_uw_b2 "" RAT_FUNC "%7.6" "-" COEFFS 0 65536 0 0 0 2 /end COMPU_METHOD
/begin COMPU_METHOD fak_uw_b4 "" RAT_FUNC "%7.6" "-" COEFFS 0 65536 0 0 0 4 /end COMPU_METHOD
/begin COMPU_METHOD kw_q0p0019 "" RAT_FUNC "%6.4" "Grad KW" COEFFS 0 512 0 0 0 1 /end COMPU_METHOD
/begin COMPU_METHOD kw_q0p0039 "" RAT_FUNC "%6.4" "Grad KW" COEFFS 0 256 0 0 0 1 /end COMPU_METHOD
/begin COMPU_METHOD kw_q0p0078 "" RAT_FUNC "%6.4" "Grad KW" COEFFS 0 128 0 0 0 1 /end COMPU_METHOD
/begin COMPU_METHOD kw_q0p0156 "" RAT_FUNC "%6.4" "Grad KW" COEFFS 0 64 0 0 0 1 /end COMPU_METHOD
/begin COMPU_METHOD kw_q0p0625 "" RAT_FUNC "%6.4" "Grad KW" COEFFS 0 16 0 0 0 1 /end COMPU_METHOD
/begin COMPU_METHOD kw_q0p5 "" RAT_FUNC "%6.3" "Grad KW" COEFFS 0 2 0 0 0 1 /end COMPU_METHOD
/begin COMPU_METHOD kw_q1 "" RAT_FUNC "%6.2" "Grad KW" COEFFS 0 1 0 0 0 1 /end COMPU_METHOD
/begin COMPU_METHOD kw_q2p8125 "" RAT_FUNC "%6.2" "°KW" COEFFS 0 1 0 0 0 2.8125 /end COMPU_METHOD
/begin COMPU_METHOD kw_q6 "" RAT_FUNC "%6.2" "Grad KW" COEFFS 0 1 0 0 0 6 /end COMPU_METHOD
/begin COMPU_METHOD kw_sw_b128 "" RAT_FUNC "%6.4" "Grad KW" COEFFS 0 65536 0 0 0 256 /end COMPU_METHOD
/begin COMPU_METHOD kw_sw_q0p0078 "" RAT_FUNC "%6.4" "Grad KW" COEFFS 0 128 0 0 0 1 /end COMPU_METHOD
/begin COMPU_METHOD kw_ub_q0p5 "" RAT_FUNC "%6.3" "Grad KW" COEFFS 0 256 0 0 0 128 /end COMPU_METHOD
/begin COMPU_METHOD m_q0p1 "" RAT_FUNC "%6.3" "kg/h" COEFFS 0 10 0 0 0 1 /end COMPU_METHOD
/begin COMPU_METHOD m_ub_b1020 "" RAT_FUNC "%6.2" "kg/h" COEFFS 0 1 0 0 0 4 /end COMPU_METHOD
/begin COMPU_METHOD m_ub_q0p4 "" RAT_FUNC "%6.3" "kg/h" COEFFS 0 1 0 0 0 0.4 /end COMPU_METHOD
/begin COMPU_METHOD m_uw_b102p4 "" RAT_FUNC "%6.4" "kg/h" COEFFS 0 65536 0 0 0 102.4 /end COMPU_METHOD
/begin COMPU_METHOD m_uw_b23p3 "" RAT_FUNC "%6.5" "kg" COEFFS 0 2812.5 0 0 0 1 /end COMPU_METHOD
/begin COMPU_METHOD m_uw_b4660 "" RAT_FUNC "%6.4" "g" COEFFS 0 3600 0 0 0 256 /end COMPU_METHOD
/begin COMPU_METHOD m_uw_b6553p5 "" RAT_FUNC "%6.3" "kg/h" COEFFS 0 1 0 0 0 0.1 /end COMPU_METHOD
/begin COMPU_METHOD nmotd_sb_q10 "" RAT_FUNC "%6.1" "1/min" COEFFS 0 1 0 0 0 10 /end COMPU_METHOD
/begin COMPU_METHOD nmotg_sb_q100 "" RAT_FUNC "%6.0" "1/min/s" COEFFS 0 1 0 0 0 100 /end COMPU_METHOD
/begin COMPU_METHOD nmot_sw_q0p25 "" RAT_FUNC "%6.3" "1/min" COEFFS 0 1 0 0 0 0.25 /end COMPU_METHOD
/begin COMPU_METHOD nmot_ub_q10 "" RAT_FUNC "%6.1" "1/min" COEFFS 0 1 0 0 0 10 /end COMPU_METHOD
/begin COMPU_METHOD nmot_ub_q40 "" RAT_FUNC "%6.1" "1/min" COEFFS 0 1 0 0 0 40 /end COMPU_METHOD
/begin COMPU_METHOD nmot_uw_q0p25 "" RAT_FUNC "%6.3" "1/min" COEFFS 0 1 0 0 0 0.25 /end COMPU_METHOD
/begin COMPU_METHOD p_sw_q0p039 "" RAT_FUNC "%6.4" "hPa" COEFFS 0 256 0 0 0 10 /end COMPU_METHOD
/begin COMPU_METHOD p_sw_q0p078 "" RAT_FUNC "%6.4" "hPa" COEFFS 0 65536 0 0 0 5120 /end COMPU_METHOD
/begin COMPU_METHOD p_ub_q10 "" RAT_FUNC "%6.1" "hPa" COEFFS 0 1 0 0 0 10 /end COMPU_METHOD
/begin COMPU_METHOD p_ub_q5 "" RAT_FUNC "%6.2" "hPa" COEFFS 0 1 0 0 0 5 /end COMPU_METHOD
/begin COMPU_METHOD p_uw_q0p039 "" RAT_FUNC "%6.4" "hPa" COEFFS 0 256 0 0 0 10 /end COMPU_METHOD
/begin COMPU_METHOD relDK_q0p02441 "" RAT_FUNC "%6.4" "%DK" COEFFS 0 65536 0 0 0 1600 /end COMPU_METHOD
/begin COMPU_METHOD relDK_ub_b100 "" RAT_FUNC "%6.3" "%DK" COEFFS 0 255 0 0 0 100 /end COMPU_METHOD
/begin COMPU_METHOD relnmot_q0p003052 "" RAT_FUNC "%6.4" "%/(U/min)" COEFFS 0 8192 0 0 0 25 /end COMPU_METHOD
/begin COMPU_METHOD relnmot_q0p01907 "" RAT_FUNC "%6.4" "%/(U/min)/s" COEFFS 0 32768 0 0 0 625 /end COMPU_METHOD
/begin COMPU_METHOD relO2_q9p765Em4 "" RAT_FUNC "%6.5" "% O2" COEFFS 0 1024 0 0 0 1 /end COMPU_METHOD
/begin COMPU_METHOD relPED_ub_b100 "" RAT_FUNC "%6.3" "%PED" COEFFS 0 255 0 0 0 100 /end COMPU_METHOD
/begin COMPU_METHOD rel_q0p025 "" RAT_FUNC "%6.4" "%" COEFFS 0 1 0 0 0 0.025 /end COMPU_METHOD
/begin COMPU_METHOD rel_sw_b100 "" RAT_FUNC "%6.4" "%" COEFFS 0 32768 0 0 0 100 /end COMPU_METHOD
/begin COMPU_METHOD rel_sw_q0p0234 "" RAT_FUNC "%6.4" "%/seg" COEFFS 0 32 0 0 0 0.75 /end COMPU_METHOD
/begin COMPU_METHOD rel_ub_b127p5 "" RAT_FUNC "%6.3" "%" COEFFS 0 2 0 0 0 1 /end COMPU_METHOD
/begin COMPU_METHOD rel_ub_b200 "" RAT_FUNC "%6.3" "%" COEFFS 0 256 0 0 0 200 /end COMPU_METHOD
/begin COMPU_METHOD rel_ub_b99p6 "" RAT_FUNC "%6.3" "%" COEFFS 0 256 0 0 0 100 /end COMPU_METHOD
/begin COMPU_METHOD rel_ub_q0p75 "" RAT_FUNC "%6.3" "%" COEFFS 0 1 0 0 0 0.75 /end COMPU_METHOD
/begin COMPU_METHOD rel_uw_b100 "" RAT_FUNC "%6.4" "%" COEFFS 0 65536 0 0 0 100 /end COMPU_METHOD
/begin COMPU_METHOD rel_uw_b200 "" RAT_FUNC "%6.4" "%" COEFFS 0 65536 0 0 0 200 /end COMPU_METHOD
/begin COMPU_METHOD rel_uw_b3072 "" RAT_FUNC "%6.4" "%" COEFFS 0 65536 0 0 0 3072 /end COMPU_METHOD
/begin COMPU_METHOD rel_uw_q0p0234 "" RAT_FUNC "%6.4" "%" COEFFS 0 32 0 0 0 0.75 /end COMPU_METHOD
/begin COMPU_METHOD rkti11_sy "" RAT_FUNC "%6.5" "ms/%" COEFFS 0 7500 0 0 0 1 /end COMPU_METHOD
/begin COMPU_METHOD rkti_k_sy "" RAT_FUNC "%6.3" "%/(ms*s)" COEFFS 0 3.3554432 0 0 0 1 /end COMPU_METHOD
/begin COMPU_METHOD rkti_p_sy "" RAT_FUNC "%6.4" "%/ms" COEFFS 0 33.554432 0 0 0 1 /end COMPU_METHOD
/begin COMPU_METHOD runtime1_sy "" RAT_FUNC "%6.2" "us" COEFFS 0 1.25 0 0 0 1 /end COMPU_METHOD
/begin COMPU_METHOD runtime2_sy "" RAT_FUNC "%6.1" "us" COEFFS 0 0.078125 0 0 0 1 /end COMPU_METHOD
/begin COMPU_METHOD spg_q0p00039 "" RAT_FUNC "%6.5" "V" COEFFS 0 1 0 0 0 0.000390625 /end COMPU_METHOD
/begin COMPU_METHOD spg_ubatt "" RAT_FUNC "%6.4" "V" COEFFS 0 1 0 0 0 0.0704 /end COMPU_METHOD
/begin COMPU_METHOD spg_ubatt_sy "" RAT_FUNC "%6.4" "V" COEFFS 0 14.2222222222222 0 0 0 1 /end COMPU_METHOD
/begin COMPU_METHOD s_q6_km "" RAT_FUNC "%6.2" "km" COEFFS 0 1 0 0 0 6 /end COMPU_METHOD
/begin COMPU_METHOD t100msxs_ub_b255 "" RAT_FUNC "%6.2" "s" COEFFS 0 1 0 0 0 1 /end COMPU_METHOD
/begin COMPU_METHOD t100msxs_ub_b25p5 "" RAT_FUNC "%6.3" "s" COEFFS 0 1 0 0 0 0.1 /end COMPU_METHOD
/begin COMPU_METHOD t100msxs_uw_b6553p5 "" RAT_FUNC "%6.3" "s" COEFFS 0 1 0 0 0 0.1 /end COMPU_METHOD
/begin COMPU_METHOD t100msxs_uw_b6553p6 "" RAT_FUNC "%6.3" "s" COEFFS 0 10 0 0 0 1 /end COMPU_METHOD
/begin COMPU_METHOD t10msxs_ub_b2p55 "" RAT_FUNC "%6.4" "s" COEFFS 0 1 0 0 0 0.01 /end COMPU_METHOD
/begin COMPU_METHOD t10msxs_uw_b655p35 "" RAT_FUNC "%6.4" "s" COEFFS 0 1 0 0 0 0.01 /end COMPU_METHOD
/begin COMPU_METHOD t1msxms_q1 "" RAT_FUNC "%6.2" "ms" COEFFS 0 1 0 0 0 1 /end COMPU_METHOD
/begin COMPU_METHOD t1sxs_ub_b255 "" RAT_FUNC "%6.2" "s" COEFFS 0 1 0 0 0 1 /end COMPU_METHOD
/begin COMPU_METHOD t200msxs_ub_b51 "" RAT_FUNC "%6.3" "s" COEFFS 0 1 0 0 0 0.2 /end COMPU_METHOD
/begin COMPU_METHOD t20msxs_ub_b5p1 "" RAT_FUNC "%6.4" "s" COEFFS 0 1 0 0 0 0.02 /end COMPU_METHOD
/begin COMPU_METHOD t20msxs_uw_q0p02 "" RAT_FUNC "%6.4" "s" COEFFS 0 1 0 0 0 0.02 /end COMPU_METHOD
/begin COMPU_METHOD t20usxus_q20 "" RAT_FUNC "%6.1" "us" COEFFS 0 1 0 0 0 20 /end COMPU_METHOD
/begin COMPU_METHOD t40usxus_q40 "" RAT_FUNC "%6.1" "us" COEFFS 0 1 0 0 0 40 /end COMPU_METHOD
/begin COMPU_METHOD t500msxs_ub_b127p5 "" RAT_FUNC "%6.3" "s" COEFFS 0 1 0 0 0 0.5 /end COMPU_METHOD
/begin COMPU_METHOD t50msxs_q0p05 "" RAT_FUNC "%6.4" "s" COEFFS 0 1 0 0 0 0.05 /end COMPU_METHOD
/begin COMPU_METHOD t50msxs_ub_b12p75 "" RAT_FUNC "%6.4" "s" COEFFS 0 1 0 0 0 0.05 /end COMPU_METHOD
/begin COMPU_METHOD t5usxus_q5 "" RAT_FUNC "%6.2" "us" COEFFS 0 1 0 0 0 5 /end COMPU_METHOD
/begin COMPU_METHOD temp_q0p0234 "" RAT_FUNC "%6.4" "K" COEFFS 0 256 0 0 0 6 /end COMPU_METHOD
/begin COMPU_METHOD temp_q0p0234_o273 "" RAT_FUNC "%6.1" "Grad C" COEFFS 0 1 273.15 0 0 0.0234375 /end COMPU_METHOD
/begin COMPU_METHOD temp_ub_q0p75_o48 "" RAT_FUNC "%6.2" "Grad C" COEFFS 0 1 48 0 0 0.75 /end COMPU_METHOD
/begin COMPU_METHOD temp_ub_q5_o50 "" RAT_FUNC "%6.2" "Grad C" COEFFS 0 1 50 0 0 5 /end COMPU_METHOD
/begin COMPU_METHOD tinjection5_sy "" RAT_FUNC "%6.4" "ms" COEFFS 0 62.5 0 0 0 1 /end COMPU_METHOD
/begin COMPU_METHOD tinjection_sy "" RAT_FUNC "%6.4" "ms" COEFFS 0 312.5 0 0 0 1 /end COMPU_METHOD
/begin COMPU_METHOD tz10msxs_uw_b327p68 "" RAT_FUNC "%6.2" "s" COEFFS 0 0 327.68 0 1 0 /end COMPU_METHOD
/begin COMPU_METHOD t_q0p1 "" RAT_FUNC "%6.3" "s" COEFFS 0 10 0 0 0 1 /end COMPU_METHOD
/begin COMPU_METHOD uefktget_ub_b25p4 "" RAT_FUNC "%6.3" "" COEFFS 0 10 0 0 0 1 /end COMPU_METHOD
/begin COMPU_METHOD vfzg_ub_q1p25 "" RAT_FUNC "%6.2" "km/h" COEFFS 0 1 0 0 0 1.25 /end COMPU_METHOD
/begin COMPU_METHOD zk100msxs_ub_b25p5 "" RAT_FUNC "%6.3" "s" COEFFS 0 0 256 0 10 0 /end COMPU_METHOD
/begin COMPU_METHOD zk100msxs_uw_b6553 "" RAT_FUNC "%6.1" "s" COEFFS 0 0 65536 0 10 0 /end COMPU_METHOD
/begin COMPU_METHOD zk10msxs_ub_b2p55 "" RAT_FUNC "%6.4" "s" COEFFS 0 0 255 0 100 0 /end COMPU_METHOD
/begin COMPU_METHOD zk10msxs_uw_b655 "" RAT_FUNC "%6.2" "s" COEFFS 0 0 65536 0 100 0 /end COMPU_METHOD
/begin COMPU_METHOD zk50msxs_uw_b3276p8 "" RAT_FUNC "%6.1" "s" COEFFS 0 0 65536 0 20 0 /end COMPU_METHOD
/begin COMPU_METHOD zw_sb_q0p75 "" RAT_FUNC "%6.3" "Grad KW" COEFFS 0 255 0 0 0 191.25 /end COMPU_METHOD
/begin COMPU_METHOD zw_ub_qn0p75 "" RAT_FUNC "%6.4" "Grad KW" COEFFS 0 1 0 0 0 -0.75 /end COMPU_METHOD
/begin COMPU_METHOD defaultAscii "" RAT_FUNC "%6.2" "" COEFFS 0 1 0 0 0 1 /end COMPU_METHOD
/begin RECORD_LAYOUT FklWSb FNC_VALUES 1 SBYTE COLUMN_DIR DIRECT /end RECORD_LAYOUT
/begin RECORD_LAYOUT FklWUb FNC_VALUES 1 UBYTE COLUMN_DIR DIRECT /end RECORD_LAYOUT
/begin RECORD_LAYOUT FklWUw FNC_VALUES 1 UWORD COLUMN_DIR DIRECT /end RECORD_LAYOUT
/begin RECORD_LAYOUT GkfWSw FNC_VALUES 1 SWORD COLUMN_DIR DIRECT /end RECORD_LAYOUT
/begin RECORD_LAYOUT GkfWUb FNC_VALUES 1 UBYTE COLUMN_DIR DIRECT /end RECORD_LAYOUT
/begin RECORD_LAYOUT GklWSw FNC_VALUES 1 SWORD COLUMN_DIR DIRECT /end RECORD_LAYOUT
/begin RECORD_LAYOUT GklWUb FNC_VALUES 1 UBYTE COLUMN_DIR DIRECT /end RECORD_LAYOUT
/begin RECORD_LAYOUT GklWUw FNC_VALUES 1 UWORD COLUMN_DIR DIRECT /end RECORD_LAYOUT
/begin RECORD_LAYOUT KfAxUbAyUbSstxUbSstyUbWUb NO_AXIS_PTS_X 1 UBYTE NO_AXIS_PTS_Y 2 UBYTE AXIS_PTS_X 3 UBYTE INDEX_INCR DIRECT AXIS_PTS_Y 4 UBYTE INDEX_INCR DIRECT FNC_VALUES 5 UBYTE COLUMN_DIR DIRECT /end RECORD_LAYOUT
/begin RECORD_LAYOUT KfAxUbAyUbSstxUbSstyUwWUw NO_AXIS_PTS_X 1 UBYTE NO_AXIS_PTS_Y 2 UBYTE AXIS_PTS_X 3 UBYTE INDEX_INCR DIRECT AXIS_PTS_Y 4 UWORD INDEX_INCR DIRECT FNC_VALUES 5 UWORD COLUMN_DIR DIRECT /end RECORD_LAYOUT
/begin RECORD_LAYOUT KfAxUwAyUwSstxSwSstyUwWUw NO_AXIS_PTS_X 1 UWORD NO_AXIS_PTS_Y 2 UWORD AXIS_PTS_X 3 SWORD INDEX_INCR DIRECT AXIS_PTS_Y 4 UWORD INDEX_INCR DIRECT FNC_VALUES 5 UWORD COLUMN_DIR DIRECT /end RECORD_LAYOUT
/begin RECORD_LAYOUT KfAxUwAyUwSstxUwSstyUwWSw NO_AXIS_PTS_X 1 UWORD NO_AXIS_PTS_Y 2 UWORD AXIS_PTS_X 3 UWORD INDEX_INCR DIRECT AXIS_PTS_Y 4 UWORD INDEX_INCR DIRECT FNC_VALUES 5 SWORD COLUMN_DIR DIRECT /end RECORD_LAYOUT
/begin RECORD_LAYOUT KlASwSstSwWSw NO_AXIS_PTS_X 1 SWORD AXIS_PTS_X 2 SWORD INDEX_INCR DIRECT FNC_VALUES 3 SWORD COLUMN_DIR DIRECT /end RECORD_LAYOUT
/begin RECORD_LAYOUT KlAUbSstSwWSw NO_AXIS_PTS_X 1 SWORD AXIS_PTS_X 2 SWORD INDEX_INCR DIRECT FNC_VALUES 3 SWORD COLUMN_DIR DIRECT /end RECORD_LAYOUT
/begin RECORD_LAYOUT KlAUbSstUbWUb NO_AXIS_PTS_X 1 UBYTE AXIS_PTS_X 2 UBYTE INDEX_INCR DIRECT FNC_VALUES 3 UBYTE COLUMN_DIR DIRECT /end RECORD_LAYOUT
/begin RECORD_LAYOUT KlAUbSstUbWUw NO_AXIS_PTS_X 1 UBYTE AXIS_PTS_X 2 UBYTE INDEX_INCR DIRECT FNC_VALUES 3 UWORD COLUMN_DIR DIRECT /end RECORD_LAYOUT
/begin RECORD_LAYOUT KlAUwSstSwWUw NO_AXIS_PTS_X 1 UWORD AXIS_PTS_X 2 SWORD INDEX_INCR DIRECT FNC_VALUES 3 UWORD COLUMN_DIR DIRECT /end RECORD_LAYOUT
/begin RECORD_LAYOUT KlAUwSstUwWSw NO_AXIS_PTS_X 1 UWORD AXIS_PTS_X 2 UWORD INDEX_INCR DIRECT FNC_VALUES 3 SWORD COLUMN_DIR DIRECT /end RECORD_LAYOUT
/begin RECORD_LAYOUT KlAUwSstUwWUw NO_AXIS_PTS_X 1 UWORD AXIS_PTS_X 2 UWORD INDEX_INCR DIRECT FNC_VALUES 3 UWORD COLUMN_DIR DIRECT /end RECORD_LAYOUT
/begin RECORD_LAYOUT KtxC FNC_VALUES 1 UBYTE COLUMN_DIR DIRECT /end RECORD_LAYOUT
/begin RECORD_LAYOUT KwSb FNC_VALUES 1 SBYTE COLUMN_DIR DIRECT /end RECORD_LAYOUT
/begin RECORD_LAYOUT KwSw FNC_VALUES 1 SWORD COLUMN_DIR DIRECT /end RECORD_LAYOUT
/begin RECORD_LAYOUT KwUb FNC_VALUES 1 UBYTE COLUMN_DIR DIRECT /end RECORD_LAYOUT
/begin RECORD_LAYOUT KwUw FNC_VALUES 1 UWORD COLUMN_DIR DIRECT /end RECORD_LAYOUT
/begin RECORD_LAYOUT SstASwSstSw NO_AXIS_PTS_X 1 SWORD AXIS_PTS_X 2 SWORD INDEX_INCR DIRECT /end RECORD_LAYOUT
/begin RECORD_LAYOUT SstAUbSstSb NO_AXIS_PTS_X 1 SBYTE AXIS_PTS_X 2 SBYTE INDEX_INCR DIRECT /end RECORD_LAYOUT
/begin RECORD_LAYOUT SstAUbSstUb NO_AXIS_PTS_X 1 UBYTE AXIS_PTS_X 2 UBYTE INDEX_INCR DIRECT /end RECORD_LAYOUT
/begin RECORD_LAYOUT SstAUwSstUw NO_AXIS_PTS_X 1 UWORD AXIS_PTS_X 2 UWORD INDEX_INCR DIRECT /end RECORD_LAYOUT
/end MODULE
/end PROJECT
