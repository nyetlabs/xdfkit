ASAP2_VERSION 1 3
/begin PROJECT X505R_24d1_0 "4019.XX"
/begin HEADER "" VERSION "X505R_24d1_0" PROJECT_NO X505R_24d1_0 /end HEADER
/begin MODULE DIM ""
/begin MOD_COMMON "" BYTE_ORDER MSB_LAST ALIGNMENT_BYTE 1 ALIGNMENT_WORD 2 ALIGNMENT_LONG 2 /end MOD_COMMON
/begin CHARACTERISTIC CDCAAA "Dummy: Tabellenanfang" VAL_BLK 0x813368 KwbUw 65535.00 dez 0.00 65535.00 FORMAT "%8.2" NUMBER 4 /end CHARACTERISTIC
/begin CHARACTERISTIC CDCAAVE "Codewort CARB: Absperrventil Aktivkohlefilter (Endstufe)" VAL_BLK 0x813380 KwbUw 65535.00 dez 0.00 65535.00 FORMAT "%8.2" NUMBER 4 /end CHARACTERISTIC
/begin CHARACTERISTIC CDCAGRE "Codewort CARB:	Überwachung AGR-Endstufe" VAL_BLK 0x813388 KwbUw 65535.00 dez 0.00 65535.00 FORMAT "%8.2" NUMBER 4 /end CHARACTERISTIC
/begin CHARACTERISTIC CDCATR "CARB Code Abgastemperaturregelung" VAL_BLK 0x813398 KwbUw 65535.00 dez 0.00 65535.00 FORMAT "%8.2" NUMBER 4 /end CHARACTERISTIC
/begin CHARACTERISTIC CDCATR2 "CARB Code Abgastemperaturregelung Bank 2" VAL_BLK 0x8133A0 KwbUw 65535.00 dez 0.00 65535.00 FORMAT "%8.2" NUMBER 4 /end CHARACTERISTIC
/begin CHARACTERISTIC CDCATRD "" VAL_BLK 0x8133A8 KwbUw 65535.00 dez 0.00 65535.00 FORMAT "%8.2" NUMBER 4 /end CHARACTERISTIC
/begin CHARACTERISTIC CDCATRD2 "" VAL_BLK 0x8133B0 KwbUw 65535.00 dez 0.00 65535.00 FORMAT "%8.2" NUMBER 4 /end CHARACTERISTIC
/begin CHARACTERISTIC CDCATS "CARB Code Abgastemperatursensor" VAL_BLK 0x8133B8 KwbUw 65535.00 dez 0.00 65535.00 FORMAT "%8.2" NUMBER 4 /end CHARACTERISTIC
/begin CHARACTERISTIC CDCBKVP "Codewort CARB: Bremskraftverstärker Pumpe" VAL_BLK 0x8133C0 KwbUw 65535.00 dez 0.00 65535.00 FORMAT "%8.2" NUMBER 4 /end CHARACTERISTIC
/begin CHARACTERISTIC CDCBKVPE "Codewort CARB: BKVPE (Bremskraftverstärker Pumpe)" VAL_BLK 0x8133C8 KwbUw 65535.00 dez 0.00 65535.00 FORMAT "%8.2" NUMBER 4 /end CHARACTERISTIC
/begin CHARACTERISTIC CDCBM "Codewort CARB: Bezugsmarkengeber" VAL_BLK 0x8133D0 KwbUw 65535.00 dez 0.00 65535.00 FORMAT "%8.2" NUMBER 4 /end CHARACTERISTIC
/begin CHARACTERISTIC CDCCV "Codewort CARB: Diagnose Kurbelgehäuseentlüftung" VAL_BLK 0x813430 KwbUw 65535.00 dez 0.00 65535.00 FORMAT "%8.2" NUMBER 4 /end CHARACTERISTIC
/begin CHARACTERISTIC CDCDK "Codewort CARB:	DK - Potentiometer" VAL_BLK 0x813438 KwbUw 65535.00 dez 0.00 65535.00 FORMAT "%8.2" NUMBER 4 /end CHARACTERISTIC
/begin CHARACTERISTIC CDCDK1P "Codewort CARB: Drosselklappe 1. Poti" VAL_BLK 0x813440 KwbUw 65535.00 dez 0.00 65535.00 FORMAT "%8.2" NUMBER 4 /end CHARACTERISTIC
/begin CHARACTERISTIC CDCDK2P "Codewort CARB: Drosselklappe 2. Poti" VAL_BLK 0x813448 KwbUw 65535.00 dez 0.00 65535.00 FORMAT "%8.2" NUMBER 4 /end CHARACTERISTIC
/begin CHARACTERISTIC CDCDVEE "Codewort CARB: DV-E Endstufe" VAL_BLK 0x813478 KwbUw 65535.00 dez 0.00 65535.00 FORMAT "%8.2" NUMBER 4 /end CHARACTERISTIC
/begin CHARACTERISTIC CDCDVEF "Codewort CARB: DV-E Fehler bei Federprüfung" VAL_BLK 0x813480 KwbUw 65535.00 dez 0.00 65535.00 FORMAT "%8.2" NUMBER 4 /end CHARACTERISTIC
/begin CHARACTERISTIC CDCDVEFO "" VAL_BLK 0x813488 KwbUw 65535.00 dez 0.00 65535.00 FORMAT "%8.2" NUMBER 4 /end CHARACTERISTIC
/begin CHARACTERISTIC CDCDVEL "Codewort CARB: DV-E Lageabweichung" VAL_BLK 0x813490 KwbUw 65535.00 dez 0.00 65535.00 FORMAT "%8.2" NUMBER 4 /end CHARACTERISTIC
/begin CHARACTERISTIC CDCDVEN "Codewort CARB: DV-E Fehler bei Prüfung Notluftposition" VAL_BLK 0x813498 KwbUw 65535.00 dez 0.00 65535.00 FORMAT "%8.2" NUMBER 4 /end CHARACTERISTIC
/begin CHARACTERISTIC CDCDVER "Codewort CARB: DV-E Regelbereich" VAL_BLK 0x8134A0 KwbUw 65535.00 dez 0.00 65535.00 FORMAT "%8.2" NUMBER 4 /end CHARACTERISTIC
/begin CHARACTERISTIC CDCDVET "" VAL_BLK 0x8134A8 KwbUw 65535.00 dez 0.00 65535.00 FORMAT "%8.2" NUMBER 4 /end CHARACTERISTIC
/begin CHARACTERISTIC CDCDVEU "Codewort CARB: DV-E Fehler beim UMA-Lernen" VAL_BLK 0x8134B0 KwbUw 65535.00 dez 0.00 65535.00 FORMAT "%8.2" NUMBER 4 /end CHARACTERISTIC
/begin CHARACTERISTIC CDCDVEUB "" VAL_BLK 0x8134B8 KwbUw 65535.00 dez 0.00 65535.00 FORMAT "%8.2" NUMBER 4 /end CHARACTERISTIC
/begin CHARACTERISTIC CDCDVEUW "" VAL_BLK 0x8134C0 KwbUw 65535.00 dez 0.00 65535.00 FORMAT "%8.2" NUMBER 4 /end CHARACTERISTIC
/begin CHARACTERISTIC CDCDVEV "Codewort CARB: DV-E Fehler bei Verstärkerabgleich" VAL_BLK 0x8134C8 KwbUw 65535.00 dez 0.00 65535.00 FORMAT "%8.2" NUMBER 4 /end CHARACTERISTIC
/begin CHARACTERISTIC CDCENWS "Codewort Carb: Nockenwellensteuerung Einlass Nockenwelle" VAL_BLK 0x8134E0 KwbUw 65535.00 dez 0.00 65535.00 FORMAT "%8.2" NUMBER 4 /end CHARACTERISTIC
/begin CHARACTERISTIC CDCENWSE "Codewort CARB: Einlaßnockenwelle- Endstufe" VAL_BLK 0x8134E8 KwbUw 65535.00 dez 0.00 65535.00 FORMAT "%8.2" NUMBER 4 /end CHARACTERISTIC
/begin CHARACTERISTIC CDCEPCLE "Codewort CARB: Fahrverhaltens- Fehlerlampe ( Endstufe )" VAL_BLK 0x8134F0 KwbUw 65535.00 dez 0.00 65535.00 FORMAT "%8.2" NUMBER 4 /end CHARACTERISTIC
/begin CHARACTERISTIC CDCEV1 "Codewort CARB: EV von Zyl. 1" VAL_BLK 0x8134F8 KwbUw 65535.00 dez 0.00 65535.00 FORMAT "%8.2" NUMBER 4 /end CHARACTERISTIC
/begin CHARACTERISTIC CDCEV2 "Codewort CARB: EV von Zyl. 2" VAL_BLK 0x813500 KwbUw 65535.00 dez 0.00 65535.00 FORMAT "%8.2" NUMBER 4 /end CHARACTERISTIC
/begin CHARACTERISTIC CDCEV3 "Codewort CARB: EV von Zyl. 3" VAL_BLK 0x813508 KwbUw 65535.00 dez 0.00 65535.00 FORMAT "%8.2" NUMBER 4 /end CHARACTERISTIC
/begin CHARACTERISTIC CDCEV4 "Codewort CARB: EV von Zyl. 4" VAL_BLK 0x813510 KwbUw 65535.00 dez 0.00 65535.00 FORMAT "%8.2" NUMBER 4 /end CHARACTERISTIC
/begin CHARACTERISTIC CDCHSH "Codewort CARB:	Lambdasonden-Heizung hinter Katalysator" VAL_BLK 0x813560 KwbUw 65535.00 dez 0.00 65535.00 FORMAT "%8.2" NUMBER 4 /end CHARACTERISTIC
/begin CHARACTERISTIC CDCHSH2 "Codewort CARB:	Lambdasonden-Heizung hinter Katalysator; (Bank2)" VAL_BLK 0x813568 KwbUw 65535.00 dez 0.00 65535.00 FORMAT "%8.2" NUMBER 4 /end CHARACTERISTIC
/begin CHARACTERISTIC CDCHSHE "Codewort CARB: Endstufe Heizung Sonde hinter Kat." VAL_BLK 0x813570 KwbUw 65535.00 dez 0.00 65535.00 FORMAT "%8.2" NUMBER 4 /end CHARACTERISTIC
/begin CHARACTERISTIC CDCHSV "Codewort CARB:	Lambdasonden-Heizung vor Katalysator" VAL_BLK 0x813578 KwbUw 65535.00 dez 0.00 65535.00 FORMAT "%8.2" NUMBER 4 /end CHARACTERISTIC
/begin CHARACTERISTIC CDCHSV2 "Codewort CARB:	Lambdasonden-Heizung vor Katalysator; (Bank2)" VAL_BLK 0x813580 KwbUw 65535.00 dez 0.00 65535.00 FORMAT "%8.2" NUMBER 4 /end CHARACTERISTIC
/begin CHARACTERISTIC CDCHSVSA "Codewort CARB:	Lambdasonden-Heizung vor Katalysator" VAL_BLK 0x813588 KwbUw 65535.00 dez 0.00 65535.00 FORMAT "%8.2" NUMBER 4 /end CHARACTERISTIC
/begin CHARACTERISTIC CDCHSVSA2 "Codewort CARB:	Lambdasonden-Heizung 2 vor Katalysator" VAL_BLK 0x813590 KwbUw 65535.00 dez 0.00 65535.00 FORMAT "%8.2" NUMBER 4 /end CHARACTERISTIC
/begin CHARACTERISTIC CDCKAT "Codewort CARB:	Katalysator-Konvertierung" VAL_BLK 0x813598 KwbUw 65535.00 dez 0.00 65535.00 FORMAT "%8.2" NUMBER 4 /end CHARACTERISTIC
/begin CHARACTERISTIC CDCKPE "Codewort CARB: EKP-Relais Endstufe" VAL_BLK 0x8135A0 KwbUw 65535.00 dez 0.00 65535.00 FORMAT "%8.2" NUMBER 4 /end CHARACTERISTIC
/begin CHARACTERISTIC CDCKRA01 "Codewort CARB: Klopfregelanschlag Zylinder 1" VAL_BLK 0x8135A8 KwbUw 65535.00 dez 0.00 65535.00 FORMAT "%8.2" NUMBER 4 /end CHARACTERISTIC
/begin CHARACTERISTIC CDCKRA02 "Codewort CARB: Klopfregelanschlag Zylinder 2" VAL_BLK 0x8135B0 KwbUw 65535.00 dez 0.00 65535.00 FORMAT "%8.2" NUMBER 4 /end CHARACTERISTIC
/begin CHARACTERISTIC CDCKRA03 "Codewort CARB: Klopfregelanschlag Zylinder 3" VAL_BLK 0x8135B8 KwbUw 65535.00 dez 0.00 65535.00 FORMAT "%8.2" NUMBER 4 /end CHARACTERISTIC
/begin CHARACTERISTIC CDCKRA04 "Codewort CARB: Klopfregelanschlag Zylinder 4" VAL_BLK 0x8135C0 KwbUw 65535.00 dez 0.00 65535.00 FORMAT "%8.2" NUMBER 4 /end CHARACTERISTIC
/begin CHARACTERISTIC CDCKRNT "Codewort CARB:	Klopfregelung Nulltest" VAL_BLK 0x8135C8 KwbUw 65535.00 dez 0.00 65535.00 FORMAT "%8.2" NUMBER 4 /end CHARACTERISTIC
/begin CHARACTERISTIC CDCKROF "Codewort CARB: Klopfregelung Offset" VAL_BLK 0x8135D0 KwbUw 65535.00 dez 0.00 65535.00 FORMAT "%8.2" NUMBER 4 /end CHARACTERISTIC
/begin CHARACTERISTIC CDCKRTP "Codewort CARB: Klopfregelung Testimpulse" VAL_BLK 0x8135D8 KwbUw 65535.00 dez 0.00 65535.00 FORMAT "%8.2" NUMBER 4 /end CHARACTERISTIC
/begin CHARACTERISTIC CDCKS1 "Codewort CARB:	Klopfsensor 1" VAL_BLK 0x8135E0 KwbUw 65535.00 dez 0.00 65535.00 FORMAT "%8.2" NUMBER 4 /end CHARACTERISTIC
/begin CHARACTERISTIC CDCKS2 "Codewort CARB:	Klopfsensor 2" VAL_BLK 0x8135E8 KwbUw 65535.00 dez 0.00 65535.00 FORMAT "%8.2" NUMBER 4 /end CHARACTERISTIC
/begin CHARACTERISTIC CDCKS3 "Codewort CARB:	Klopfsensor 3" VAL_BLK 0x8135F0 KwbUw 65535.00 dez 0.00 65535.00 FORMAT "%8.2" NUMBER 4 /end CHARACTERISTIC
/begin CHARACTERISTIC CDCKS4 "Codewort CARB:	Klopfsensor 4" VAL_BLK 0x8135F8 KwbUw 65535.00 dez 0.00 65535.00 FORMAT "%8.2" NUMBER 4 /end CHARACTERISTIC
/begin CHARACTERISTIC CDCLDE "Codewort CARB: Ladedrucksteuerventil (Endstufe)" VAL_BLK 0x813618 KwbUw 65535.00 dez 0.00 65535.00 FORMAT "%8.2" NUMBER 4 /end CHARACTERISTIC
/begin CHARACTERISTIC CDCLM "Codewort CARB:	LMM/HLM/HFM" VAL_BLK 0x813658 KwbUw 65535.00 dez 0.00 65535.00 FORMAT "%8.2" NUMBER 4 /end CHARACTERISTIC
/begin CHARACTERISTIC CDCMILE "Codewort CARB: MIL-Endstufe" VAL_BLK 0x8136A8 KwbUw 65535.00 dez 0.00 65535.00 FORMAT "%8.2" NUMBER 4 /end CHARACTERISTIC
/begin CHARACTERISTIC CDCN "Codewort CARB: Drehzahlsignalgeber" VAL_BLK 0x8136B0 KwbUw 65535.00 dez 0.00 65535.00 FORMAT "%8.2" NUMBER 4 /end CHARACTERISTIC
/begin CHARACTERISTIC CDCNWSE "Codewort CARB: Nockenwellensteuerungsventil Endstufe" VAL_BLK 0x8136C0 KwbUw 65535.00 dez 0.00 65535.00 FORMAT "%8.2" NUMBER 4 /end CHARACTERISTIC
/begin CHARACTERISTIC CDCSLPE "Codewort CARB: Sekundärluftpumpe (Endstufe)" VAL_BLK 0x813700 KwbUw 65535.00 dez 0.00 65535.00 FORMAT "%8.2" NUMBER 4 /end CHARACTERISTIC
/begin CHARACTERISTIC CDCSLVE "Codewort CARB: Sekundärluftventil (Endstufe)" VAL_BLK 0x813718 KwbUw 65535.00 dez 0.00 65535.00 FORMAT "%8.2" NUMBER 4 /end CHARACTERISTIC
/begin CHARACTERISTIC CDCTEVE "Codewort CARB:	Tankentlüftungsventil Endstufe" VAL_BLK 0x813750 KwbUw 65535.00 dez 0.00 65535.00 FORMAT "%8.2" NUMBER 4 /end CHARACTERISTIC
/begin CHARACTERISTIC CDCUVSE "Codewort CARB: Umluftventil-Steuerung Endstufe" VAL_BLK 0x8137C0 KwbUw 65535.00 dez 0.00 65535.00 FORMAT "%8.2" NUMBER 4 /end CHARACTERISTIC
/begin CHARACTERISTIC CDCZET1 "" VAL_BLK 0x8137E0 KwbUw 65535.00 dez 0.00 65535.00 FORMAT "%8.2" NUMBER 4 /end CHARACTERISTIC
/begin CHARACTERISTIC CDCZET2 "" VAL_BLK 0x8137E8 KwbUw 65535.00 dez 0.00 65535.00 FORMAT "%8.2" NUMBER 4 /end CHARACTERISTIC
/begin CHARACTERISTIC CDCZET3 "" VAL_BLK 0x8137F0 KwbUw 65535.00 dez 0.00 65535.00 FORMAT "%8.2" NUMBER 4 /end CHARACTERISTIC
/begin CHARACTERISTIC CDCZET4 "" VAL_BLK 0x8137F8 KwbUw 65535.00 dez 0.00 65535.00 FORMAT "%8.2" NUMBER 4 /end CHARACTERISTIC
/begin CHARACTERISTIC CDCZZZ "Dummy: Tabellenende" VAL_BLK 0x813800 KwbUw 65535.00 dez 0.00 65535.00 FORMAT "%8.2" NUMBER 4 /end CHARACTERISTIC
/begin CHARACTERISTIC CDKAAA "Dummy: Tabellenanfang" VAL_BLK 0x813808 KwbUw 65535.00 dez 0.00 65535.00 FORMAT "%8.2" NUMBER 4 /end CHARACTERISTIC
/begin CHARACTERISTIC CDKAAVE "Codewort Kunde: Absperrventil Aktivkohlefilter (Endstufe)" VAL_BLK 0x813820 KwbUw 65535.00 dez 0.00 65535.00 FORMAT "%8.2" NUMBER 4 /end CHARACTERISTIC
/begin CHARACTERISTIC CDKAGRE "Codewort Kunde: Überwachung AGR-Endstufe" VAL_BLK 0x813828 KwbUw 65535.00 dez 0.00 65535.00 FORMAT "%8.2" NUMBER 4 /end CHARACTERISTIC
/begin CHARACTERISTIC CDKATR "Codewort Kunde: Abgastemperaturregelung Bank 2" VAL_BLK 0x813838 KwbUw 65535.00 dez 0.00 65535.00 FORMAT "%8.2" NUMBER 4 /end CHARACTERISTIC
/begin CHARACTERISTIC CDKATR2 "" VAL_BLK 0x813840 KwbUw 65535.00 dez 0.00 65535.00 FORMAT "%8.2" NUMBER 4 /end CHARACTERISTIC
/begin CHARACTERISTIC CDKATRD "" VAL_BLK 0x813848 KwbUw 65535.00 dez 0.00 65535.00 FORMAT "%8.2" NUMBER 4 /end CHARACTERISTIC
/begin CHARACTERISTIC CDKATRD2 "" VAL_BLK 0x813850 KwbUw 65535.00 dez 0.00 65535.00 FORMAT "%8.2" NUMBER 4 /end CHARACTERISTIC
/begin CHARACTERISTIC CDKATS "Codewort Kunde: Abgastemperaturesensor" VAL_BLK 0x813858 KwbUw 65535.00 dez 0.00 65535.00 FORMAT "%8.2" NUMBER 4 /end CHARACTERISTIC
/begin CHARACTERISTIC CDKBKVP "" VAL_BLK 0x813860 KwbUw 65535.00 dez 0.00 65535.00 FORMAT "%8.2" NUMBER 4 /end CHARACTERISTIC
/begin CHARACTERISTIC CDKBKVPE "" VAL_BLK 0x813868 KwbUw 65535.00 dez 0.00 65535.00 FORMAT "%8.2" NUMBER 4 /end CHARACTERISTIC
/begin CHARACTERISTIC CDKBM "Codewort Kunde: Bezugsmarkengeber" VAL_BLK 0x813870 KwbUw 65535.00 dez 0.00 65535.00 FORMAT "%8.2" NUMBER 4 /end CHARACTERISTIC
/begin CHARACTERISTIC CDKCV "Codewort Kunde: Diagnose Kurbelgehäuseentlüftung" VAL_BLK 0x8138D0 KwbUw 65535.00 dez 0.00 65535.00 FORMAT "%8.2" NUMBER 4 /end CHARACTERISTIC
/begin CHARACTERISTIC CDKDK "Codewort Kunde: DK - Potentiometer" VAL_BLK 0x8138D8 KwbUw 65535.00 dez 0.00 65535.00 FORMAT "%8.2" NUMBER 4 /end CHARACTERISTIC
/begin CHARACTERISTIC CDKDK1P "Codewort Kunde: Drosselklappe 1. Poti" VAL_BLK 0x8138E0 KwbUw 65535.00 dez 0.00 65535.00 FORMAT "%8.2" NUMBER 4 /end CHARACTERISTIC
/begin CHARACTERISTIC CDKDK2P "Codewort Kunde: Drosselklappenpotentiometer 2" VAL_BLK 0x8138E8 KwbUw 65535.00 dez 0.00 65535.00 FORMAT "%8.2" NUMBER 4 /end CHARACTERISTIC
/begin CHARACTERISTIC CDKDVEE "Codewort Kunde: DV-E Endstufe" VAL_BLK 0x813918 KwbUw 65535.00 dez 0.00 65535.00 FORMAT "%8.2" NUMBER 4 /end CHARACTERISTIC
/begin CHARACTERISTIC CDKDVEF "Codewort Kunde: DV-E Fehler bei Federprüfung" VAL_BLK 0x813920 KwbUw 65535.00 dez 0.00 65535.00 FORMAT "%8.2" NUMBER 4 /end CHARACTERISTIC
/begin CHARACTERISTIC CDKDVEFO "" VAL_BLK 0x813928 KwbUw 65535.00 dez 0.00 65535.00 FORMAT "%8.2" NUMBER 4 /end CHARACTERISTIC
/begin CHARACTERISTIC CDKDVEL "Codewort Kunde: DV-E Lageabweichung" VAL_BLK 0x813930 KwbUw 65535.00 dez 0.00 65535.00 FORMAT "%8.2" NUMBER 4 /end CHARACTERISTIC
/begin CHARACTERISTIC CDKDVEN "Codewort Kunde: DV-E Fehler bei Prüfung Notlufposition" VAL_BLK 0x813938 KwbUw 65535.00 dez 0.00 65535.00 FORMAT "%8.2" NUMBER 4 /end CHARACTERISTIC
/begin CHARACTERISTIC CDKDVER "Codewort Kunde: DV-E Regelbereich" VAL_BLK 0x813940 KwbUw 65535.00 dez 0.00 65535.00 FORMAT "%8.2" NUMBER 4 /end CHARACTERISTIC
/begin CHARACTERISTIC CDKDVET "" VAL_BLK 0x813948 KwbUw 65535.00 dez 0.00 65535.00 FORMAT "%8.2" NUMBER 4 /end CHARACTERISTIC
/begin CHARACTERISTIC CDKDVEU "Codewort Kunde: DV-E Fehler beim UMA-Lernen" VAL_BLK 0x813950 KwbUw 65535.00 dez 0.00 65535.00 FORMAT "%8.2" NUMBER 4 /end CHARACTERISTIC
/begin CHARACTERISTIC CDKDVEUB "" VAL_BLK 0x813958 KwbUw 65535.00 dez 0.00 65535.00 FORMAT "%8.2" NUMBER 4 /end CHARACTERISTIC
/begin CHARACTERISTIC CDKDVEUW "" VAL_BLK 0x813960 KwbUw 65535.00 dez 0.00 65535.00 FORMAT "%8.2" NUMBER 4 /end CHARACTERISTIC
/begin CHARACTERISTIC CDKDVEV "Codewort Kunde: DV-E Fehler bei Verstärkerabgleich" VAL_BLK 0x813968 KwbUw 65535.00 dez 0.00 65535.00 FORMAT "%8.2" NUMBER 4 /end CHARACTERISTIC
/begin CHARACTERISTIC CDKENWS "Codewort Kunde: Nockenwellensteuerung Einlass Nockenwelle" VAL_BLK 0x813980 KwbUw 65535.00 dez 0.00 65535.00 FORMAT "%8.2" NUMBER 4 /end CHARACTERISTIC
/begin CHARACTERISTIC CDKENWSE "Codewort Kunde: Einlaßnockenwelle- Endstufe" VAL_BLK 0x813988 KwbUw 65535.00 dez 0.00 65535.00 FORMAT "%8.2" NUMBER 4 /end CHARACTERISTIC
/begin CHARACTERISTIC CDKEPCLE "Codewort Kunde: Fahrverhaltens- Fehlerlampe ( Endstufe )" VAL_BLK 0x813990 KwbUw 65535.00 dez 0.00 65535.00 FORMAT "%8.2" NUMBER 4 /end CHARACTERISTIC
/begin CHARACTERISTIC CDKEV1 "Codewort Kunde: EV von Zyl. 1" VAL_BLK 0x813998 KwbUw 65535.00 dez 0.00 65535.00 FORMAT "%8.2" NUMBER 4 /end CHARACTERISTIC
/begin CHARACTERISTIC CDKEV2 "Codewort Kunde: EV von Zyl. 2" VAL_BLK 0x8139A0 KwbUw 65535.00 dez 0.00 65535.00 FORMAT "%8.2" NUMBER 4 /end CHARACTERISTIC
/begin CHARACTERISTIC CDKEV3 "Codewort Kunde: EV von Zyl. 3" VAL_BLK 0x8139A8 KwbUw 65535.00 dez 0.00 65535.00 FORMAT "%8.2" NUMBER 4 /end CHARACTERISTIC
/begin CHARACTERISTIC CDKEV4 "Codewort Kunde: EV von Zyl. 4" VAL_BLK 0x8139B0 KwbUw 65535.00 dez 0.00 65535.00 FORMAT "%8.2" NUMBER 4 /end CHARACTERISTIC
/begin CHARACTERISTIC CDKHSH "Codewort Kunde:Lambdasonden-Heizung hinter Katalysator" VAL_BLK 0x813A00 KwbUw 65535.00 dez 0.00 65535.00 FORMAT "%8.2" NUMBER 4 /end CHARACTERISTIC
/begin CHARACTERISTIC CDKHSH2 "Codewort Kunde:	Lambdasonden-Heizung hinter Katalysator, Bank 2" VAL_BLK 0x813A08 KwbUw 65535.00 dez 0.00 65535.00 FORMAT "%8.2" NUMBER 4 /end CHARACTERISTIC
/begin CHARACTERISTIC CDKHSHE "Codewort Kunde: Endstufe Heizung Sonde hinter Kat." VAL_BLK 0x813A10 KwbUw 65535.00 dez 0.00 65535.00 FORMAT "%8.2" NUMBER 4 /end CHARACTERISTIC
/begin CHARACTERISTIC CDKHSV "Codewort Kunde: Lambdasonden-Heizung vor Katalysator" VAL_BLK 0x813A18 KwbUw 65535.00 dez 0.00 65535.00 FORMAT "%8.2" NUMBER 4 /end CHARACTERISTIC
/begin CHARACTERISTIC CDKHSV2 "Codewort Kunde:	Lambdasonden-Heizung vor Katalysator, Bank 2" VAL_BLK 0x813A20 KwbUw 65535.00 dez 0.00 65535.00 FORMAT "%8.2" NUMBER 4 /end CHARACTERISTIC
/begin CHARACTERISTIC CDKHSVSA "" VAL_BLK 0x813A28 KwbUw 65535.00 dez 0.00 65535.00 FORMAT "%8.2" NUMBER 4 /end CHARACTERISTIC
/begin CHARACTERISTIC CDKHSVSA2 "" VAL_BLK 0x813A30 KwbUw 65535.00 dez 0.00 65535.00 FORMAT "%8.2" NUMBER 4 /end CHARACTERISTIC
/begin CHARACTERISTIC CDKKAT "Codewort Kunde:	Katalysator-Konvertierung" VAL_BLK 0x813A38 KwbUw 65535.00 dez 0.00 65535.00 FORMAT "%8.2" NUMBER 4 /end CHARACTERISTIC
/begin CHARACTERISTIC CDKKPE "Codewort Kunde: EKP-Relais Endstufe" VAL_BLK 0x813A40 KwbUw 65535.00 dez 0.00 65535.00 FORMAT "%8.2" NUMBER 4 /end CHARACTERISTIC
/begin CHARACTERISTIC CDKKRA01 "Codewort Kunde: Klopfregelanschlag Zylinder 1" VAL_BLK 0x813A48 KwbUw 65535.00 dez 0.00 65535.00 FORMAT "%8.2" NUMBER 4 /end CHARACTERISTIC
/begin CHARACTERISTIC CDKKRA02 "Codewort Kunde: Klopfregelanschlag Zylinder 2" VAL_BLK 0x813A50 KwbUw 65535.00 dez 0.00 65535.00 FORMAT "%8.2" NUMBER 4 /end CHARACTERISTIC
/begin CHARACTERISTIC CDKKRA03 "Codewort Kunde: Klopfregelanschlag Zylinder 3" VAL_BLK 0x813A58 KwbUw 65535.00 dez 0.00 65535.00 FORMAT "%8.2" NUMBER 4 /end CHARACTERISTIC
/begin CHARACTERISTIC CDKKRA04 "Codewort Kunde: Klopfregelanschlag Zylinder 4" VAL_BLK 0x813A60 KwbUw 65535.00 dez 0.00 65535.00 FORMAT "%8.2" NUMBER 4 /end CHARACTERISTIC
/begin CHARACTERISTIC CDKKRNT "Codewort Kunde:	Klopfregelung Nulltest" VAL_BLK 0x813A68 KwbUw 65535.00 dez 0.00 65535.00 FORMAT "%8.2" NUMBER 4 /end CHARACTERISTIC
/begin CHARACTERISTIC CDKKROF "Codewort Kunde:	Klopfregelung Offset" VAL_BLK 0x813A70 KwbUw 65535.00 dez 0.00 65535.00 FORMAT "%8.2" NUMBER 4 /end CHARACTERISTIC
/begin CHARACTERISTIC CDKKRTP "Codewort Kunde: Klopfregelung Testimpuls" VAL_BLK 0x813A78 KwbUw 65535.00 dez 0.00 65535.00 FORMAT "%8.2" NUMBER 4 /end CHARACTERISTIC
/begin CHARACTERISTIC CDKKS1 "Codewort Kunde:	Klopfsensor 1" VAL_BLK 0x813A80 KwbUw 65535.00 dez 0.00 65535.00 FORMAT "%8.2" NUMBER 4 /end CHARACTERISTIC
/begin CHARACTERISTIC CDKKS2 "Codewort Kunde:	Klopfsensor 2" VAL_BLK 0x813A88 KwbUw 65535.00 dez 0.00 65535.00 FORMAT "%8.2" NUMBER 4 /end CHARACTERISTIC
/begin CHARACTERISTIC CDKKS3 "Codewort Kunde:	Klopfsensor 3" VAL_BLK 0x813A90 KwbUw 65535.00 dez 0.00 65535.00 FORMAT "%8.2" NUMBER 4 /end CHARACTERISTIC
/begin CHARACTERISTIC CDKKS4 "Codewort Kunde:	Klopfsensor 4" VAL_BLK 0x813A98 KwbUw 65535.00 dez 0.00 65535.00 FORMAT "%8.2" NUMBER 4 /end CHARACTERISTIC
/begin CHARACTERISTIC CDKLDE "Codeword Kunde: Ladedrucksteuerventil (Endstufe)" VAL_BLK 0x813AB8 KwbUw 65535.00 dez 0.00 65535.00 FORMAT "%8.2" NUMBER 4 /end CHARACTERISTIC
/begin CHARACTERISTIC CDKLM "Codewort Kunde:	LMM/HLM/HFM" VAL_BLK 0x813AF8 KwbUw 65535.00 dez 0.00 65535.00 FORMAT "%8.2" NUMBER 4 /end CHARACTERISTIC
/begin CHARACTERISTIC CDKMILE "Codewort Kunde: MIL-Endstufe" VAL_BLK 0x813B48 KwbUw 65535.00 dez 0.00 65535.00 FORMAT "%8.2" NUMBER 4 /end CHARACTERISTIC
/begin CHARACTERISTIC CDKN "Codewort Kunde: Drehzahlsignalgeber" VAL_BLK 0x813B50 KwbUw 65535.00 dez 0.00 65535.00 FORMAT "%8.2" NUMBER 4 /end CHARACTERISTIC
/begin CHARACTERISTIC CDKNWSE "Codewort Kunde: Nockenwellensteuerungsventil Endstufe" VAL_BLK 0x813B60 KwbUw 65535.00 dez 0.00 65535.00 FORMAT "%8.2" NUMBER 4 /end CHARACTERISTIC
/begin CHARACTERISTIC CDKSLPE "Codewort Kunde: Sekundärluftpumpe  (Endstufe)" VAL_BLK 0x813BA0 KwbUw 65535.00 dez 0.00 65535.00 FORMAT "%8.2" NUMBER 4 /end CHARACTERISTIC
/begin CHARACTERISTIC CDKSLVE "Codewort Kunde:	Sekundärluftventil (Endstufe)" VAL_BLK 0x813BB8 KwbUw 65535.00 dez 0.00 65535.00 FORMAT "%8.2" NUMBER 4 /end CHARACTERISTIC
/begin CHARACTERISTIC CDKTEVE "Codewort Kunde:	Tankentlüftungsventil Endstufe" VAL_BLK 0x813BF0 KwbUw 65535.00 dez 0.00 65535.00 FORMAT "%8.2" NUMBER 4 /end CHARACTERISTIC
/begin CHARACTERISTIC CDKUVSE "Codeword Kunde: Endstufe Umluftventil turbo" VAL_BLK 0x813C60 KwbUw 65535.00 dez 0.00 65535.00 FORMAT "%8.2" NUMBER 4 /end CHARACTERISTIC
/begin CHARACTERISTIC CDKZET1 "" VAL_BLK 0x813C80 KwbUw 65535.00 dez 0.00 65535.00 FORMAT "%8.2" NUMBER 4 /end CHARACTERISTIC
/begin CHARACTERISTIC CDKZET2 "" VAL_BLK 0x813C88 KwbUw 65535.00 dez 0.00 65535.00 FORMAT "%8.2" NUMBER 4 /end CHARACTERISTIC
/begin CHARACTERISTIC CDKZET3 "" VAL_BLK 0x813C90 KwbUw 65535.00 dez 0.00 65535.00 FORMAT "%8.2" NUMBER 4 /end CHARACTERISTIC
/begin CHARACTERISTIC CDKZET4 "" VAL_BLK 0x813C98 KwbUw 65535.00 dez 0.00 65535.00 FORMAT "%8.2" NUMBER 4 /end CHARACTERISTIC
/begin CHARACTERISTIC CDKZZZ "Dummy: Tabellenendeng" VAL_BLK 0x813CA0 KwbUw 65535.00 dez 0.00 65535.00 FORMAT "%8.2" NUMBER 4 /end CHARACTERISTIC
/begin CHARACTERISTIC CDTAAA "Dummy: Tabellenanfang" VALUE 0x813CA8 KwUw 65535.00 dez 0.00 65535.00 FORMAT "%8.2" /end CHARACTERISTIC
/begin CHARACTERISTIC CDTAAVE "Codewort Tester: Absperrventil Aktivkohlefilter (Endst.)" VALUE 0x813CAE KwUw 65535.00 dez 0.00 65535.00 FORMAT "%8.2" /end CHARACTERISTIC
/begin CHARACTERISTIC CDTAGRE "Codewort Tester: Überwachung AGR-Endstufe" VALUE 0x813CB0 KwUw 65535.00 dez 0.00 65535.00 FORMAT "%8.2" /end CHARACTERISTIC
/begin CHARACTERISTIC CDTATR "Fehlerpfadcode Abgastemperaturregelung" VALUE 0x813CB4 KwUw 65535.00 dez 0.00 65535.00 FORMAT "%8.2" /end CHARACTERISTIC
/begin CHARACTERISTIC CDTATR2 "Fehlerpfadcode Abgastemperaturregelung Bank 2" VALUE 0x813CB6 KwUw 65535.00 dez 0.00 65535.00 FORMAT "%8.2" /end CHARACTERISTIC
/begin CHARACTERISTIC CDTATRD "" VALUE 0x813CB8 KwUw 65535.00 dez 0.00 65535.00 FORMAT "%8.2" /end CHARACTERISTIC
/begin CHARACTERISTIC CDTATRD2 "" VALUE 0x813CBA KwUw 65535.00 dez 0.00 65535.00 FORMAT "%8.2" /end CHARACTERISTIC
/begin CHARACTERISTIC CDTATS "Codewort Tester: Abgastemperatursensor" VALUE 0x813CBC KwUw 65535.00 dez 0.00 65535.00 FORMAT "%8.2" /end CHARACTERISTIC
/begin CHARACTERISTIC CDTBKVP "" VALUE 0x813CBE KwUw 65535.00 dez 0.00 65535.00 FORMAT "%8.2" /end CHARACTERISTIC
/begin CHARACTERISTIC CDTBKVPE "" VALUE 0x813CC0 KwUw 65535.00 dez 0.00 65535.00 FORMAT "%8.2" /end CHARACTERISTIC
/begin CHARACTERISTIC CDTBM "Codewort Tester: Bezugsmarkengeber" VALUE 0x813CC2 KwUw 65535.00 dez 0.00 65535.00 FORMAT "%8.2" /end CHARACTERISTIC
/begin CHARACTERISTIC CDTCV "Codewort Tester: Diagnose Kurbelgehäuseentlüftung" VALUE 0x813CDA KwUw 65535.00 dez 0.00 65535.00 FORMAT "%8.2" /end CHARACTERISTIC
/begin CHARACTERISTIC CDTDK "Codewort Tester: DK - Potentiometer" VALUE 0x813CDC KwUw 65535.00 dez 0.00 65535.00 FORMAT "%8.2" /end CHARACTERISTIC
/begin CHARACTERISTIC CDTDK1P "Codewort Tester: Drosselklappe 1. Poti" VALUE 0x813CDE KwUw 65535.00 dez 0.00 65535.00 FORMAT "%8.2" /end CHARACTERISTIC
/begin CHARACTERISTIC CDTDK2P "Codewort Tester: Drosselklappenpotentiometer 2" VALUE 0x813CE0 KwUw 65535.00 dez 0.00 65535.00 FORMAT "%8.2" /end CHARACTERISTIC
/begin CHARACTERISTIC CDTDVEE "Codewort Tester: DV-E Endstufe" VALUE 0x813CEC KwUw 65535.00 dez 0.00 65535.00 FORMAT "%8.2" /end CHARACTERISTIC
/begin CHARACTERISTIC CDTDVEF "Codewort Tester: DV-E Fehler bei Federprüfung" VALUE 0x813CEE KwUw 65535.00 dez 0.00 65535.00 FORMAT "%8.2" /end CHARACTERISTIC
/begin CHARACTERISTIC CDTDVEFO "" VALUE 0x813CF0 KwUw 65535.00 dez 0.00 65535.00 FORMAT "%8.2" /end CHARACTERISTIC
/begin CHARACTERISTIC CDTDVEL "Codewort Tester: DV-E Lageabweichung" VALUE 0x813CF2 KwUw 65535.00 dez 0.00 65535.00 FORMAT "%8.2" /end CHARACTERISTIC
/begin CHARACTERISTIC CDTDVEN "Codewort Tester: DV-E Fehler bei Prüfung Notlufposition" VALUE 0x813CF4 KwUw 65535.00 dez 0.00 65535.00 FORMAT "%8.2" /end CHARACTERISTIC
/begin CHARACTERISTIC CDTDVER "Codewort Tester: DV-E Regelbereich" VALUE 0x813CF6 KwUw 65535.00 dez 0.00 65535.00 FORMAT "%8.2" /end CHARACTERISTIC
/begin CHARACTERISTIC CDTDVET "" VALUE 0x813CF8 KwUw 65535.00 dez 0.00 65535.00 FORMAT "%8.2" /end CHARACTERISTIC
/begin CHARACTERISTIC CDTDVEU "Codewort Tester: DV-E Fehler beim UMA-Lernen" VALUE 0x813CFA KwUw 65535.00 dez 0.00 65535.00 FORMAT "%8.2" /end CHARACTERISTIC
/begin CHARACTERISTIC CDTDVEUB "" VALUE 0x813CFC KwUw 65535.00 dez 0.00 65535.00 FORMAT "%8.2" /end CHARACTERISTIC
/begin CHARACTERISTIC CDTDVEUW "" VALUE 0x813CFE KwUw 65535.00 dez 0.00 65535.00 FORMAT "%8.2" /end CHARACTERISTIC
/begin CHARACTERISTIC CDTDVEV "Codewort Tester: DV-E Fehler bei Verstärkerabgleich" VALUE 0x813D00 KwUw 65535.00 dez 0.00 65535.00 FORMAT "%8.2" /end CHARACTERISTIC
/begin CHARACTERISTIC CDTENWS "Codewort Tester: Nockenwellensteuerung Einlass Nockenwelle" VALUE 0x813D06 KwUw 65535.00 dez 0.00 65535.00 FORMAT "%8.2" /end CHARACTERISTIC
/begin CHARACTERISTIC CDTENWSE "Codewort Tester: Einlaßnockenwelle- Endstufe" VALUE 0x813D08 KwUw 65535.00 dez 0.00 65535.00 FORMAT "%8.2" /end CHARACTERISTIC
/begin CHARACTERISTIC CDTEPCLE "Codewort Tester: Fahrverhaltens- Fehllampe ( Endstufe )" VALUE 0x813D0A KwUw 65535.00 dez 0.00 65535.00 FORMAT "%8.2" /end CHARACTERISTIC
/begin CHARACTERISTIC CDTEV1 "Codewort Tester: EV von Zyl. 1" VALUE 0x813D0C KwUw 65535.00 dez 0.00 65535.00 FORMAT "%8.2" /end CHARACTERISTIC
/begin CHARACTERISTIC CDTEV2 "Codewort Tester: EV von Zyl. 2" VALUE 0x813D0E KwUw 65535.00 dez 0.00 65535.00 FORMAT "%8.2" /end CHARACTERISTIC
/begin CHARACTERISTIC CDTEV3 "Codewort Tester: EV von Zyl. 3" VALUE 0x813D10 KwUw 65535.00 dez 0.00 65535.00 FORMAT "%8.2" /end CHARACTERISTIC
/begin CHARACTERISTIC CDTEV4 "Codewort Tester: EV von Zyl. 4" VALUE 0x813D12 KwUw 65535.00 dez 0.00 65535.00 FORMAT "%8.2" /end CHARACTERISTIC
/begin CHARACTERISTIC CDTHSH "Codewort Tester: Lambdasonden-Heizung hinter Katalysator" VALUE 0x813D26 KwUw 65535.00 dez 0.00 65535.00 FORMAT "%8.2" /end CHARACTERISTIC
/begin CHARACTERISTIC CDTHSH2 "Codewort Tester: Lambdasonden-Heizung hinter Kat., Bank 2" VALUE 0x813D28 KwUw 65535.00 dez 0.00 65535.00 FORMAT "%8.2" /end CHARACTERISTIC
/begin CHARACTERISTIC CDTHSHE "Codewort Tester: Endstufe Lambdasonden-Heizung hinter Katalysator" VALUE 0x813D2A KwUw 65535.00 dez 0.00 65535.00 FORMAT "%8.2" /end CHARACTERISTIC
/begin CHARACTERISTIC CDTHSV "Codewort Tester: Lambdasonden-Heizung vor Katalysator" VALUE 0x813D2C KwUw 65535.00 dez 0.00 65535.00 FORMAT "%8.2" /end CHARACTERISTIC
/begin CHARACTERISTIC CDTHSV2 "Codewort Tester: Lambdasonden-Heizung vor Kat., Bank 2" VALUE 0x813D2E KwUw 65535.00 dez 0.00 65535.00 FORMAT "%8.2" /end CHARACTERISTIC
/begin CHARACTERISTIC CDTHSVSA "Codewort Tester: Lambdasonden-Heizung vor Katalysator" VALUE 0x813D30 KwUw 65535.00 dez 0.00 65535.00 FORMAT "%8.2" /end CHARACTERISTIC
/begin CHARACTERISTIC CDTHSVSA2 "Codewort Tester: Lambdasonden-Heizung vor Kat., Bank 2" VALUE 0x813D32 KwUw 65535.00 dez 0.00 65535.00 FORMAT "%8.2" /end CHARACTERISTIC
/begin CHARACTERISTIC CDTKAT "Codewort Tester: Katalysator-Konvertierung" VALUE 0x813D34 KwUw 65535.00 dez 0.00 65535.00 FORMAT "%8.2" /end CHARACTERISTIC
/begin CHARACTERISTIC CDTKPE "Codewort Tester: EKP-Relais Endstufe" VALUE 0x813D36 KwUw 65535.00 dez 0.00 65535.00 FORMAT "%8.2" /end CHARACTERISTIC
/begin CHARACTERISTIC CDTKRA01 "" VALUE 0x813D38 KwUw 65535.00 dez 0.00 65535.00 FORMAT "%8.2" /end CHARACTERISTIC
/begin CHARACTERISTIC CDTKRA02 "" VALUE 0x813D3A KwUw 65535.00 dez 0.00 65535.00 FORMAT "%8.2" /end CHARACTERISTIC
/begin CHARACTERISTIC CDTKRA03 "" VALUE 0x813D3C KwUw 65535.00 dez 0.00 65535.00 FORMAT "%8.2" /end CHARACTERISTIC
/begin CHARACTERISTIC CDTKRA04 "" VALUE 0x813D3E KwUw 65535.00 dez 0.00 65535.00 FORMAT "%8.2" /end CHARACTERISTIC
/begin CHARACTERISTIC CDTKRNT "Codewort Tester: Klopfregelung Nulltest" VALUE 0x813D40 KwUw 65535.00 dez 0.00 65535.00 FORMAT "%8.2" /end CHARACTERISTIC
/begin CHARACTERISTIC CDTKROF "Codewort Tester: Klopfregelung Offset" VALUE 0x813D42 KwUw 65535.00 dez 0.00 65535.00 FORMAT "%8.2" /end CHARACTERISTIC
/begin CHARACTERISTIC CDTKRTP "Codewort Tester: Klopfregelung Testimpuls" VALUE 0x813D44 KwUw 65535.00 dez 0.00 65535.00 FORMAT "%8.2" /end CHARACTERISTIC
/begin CHARACTERISTIC CDTKS1 "Codewort Tester: Klopfsensor 1" VALUE 0x813D46 KwUw 65535.00 dez 0.00 65535.00 FORMAT "%8.2" /end CHARACTERISTIC
/begin CHARACTERISTIC CDTKS2 "Codewort Tester: Klopfsensor 2" VALUE 0x813D48 KwUw 65535.00 dez 0.00 65535.00 FORMAT "%8.2" /end CHARACTERISTIC
/begin CHARACTERISTIC CDTKS3 "Codewort Tester: Klopfsensor 3" VALUE 0x813D4A KwUw 65535.00 dez 0.00 65535.00 FORMAT "%8.2" /end CHARACTERISTIC
/begin CHARACTERISTIC CDTKS4 "Codewort Tester: Klopfsensor 4" VALUE 0x813D4C KwUw 65535.00 dez 0.00 65535.00 FORMAT "%8.2" /end CHARACTERISTIC
/begin CHARACTERISTIC CDTLDE "Codewort Tester: Ladedrucksteuerventil (Endstufe)" VALUE 0x813D54 KwUw 65535.00 dez 0.00 65535.00 FORMAT "%8.2" /end CHARACTERISTIC
/begin CHARACTERISTIC CDTLM "Codewort Tester: LMM/HLM/HFM" VALUE 0x813D64 KwUw 65535.00 dez 0.00 65535.00 FORMAT "%8.2" /end CHARACTERISTIC
/begin CHARACTERISTIC CDTMILE "Codewort Tester: MIL-Endstufe" VALUE 0x813D78 KwUw 65535.00 dez 0.00 65535.00 FORMAT "%8.2" /end CHARACTERISTIC
/begin CHARACTERISTIC CDTN "Codewort Tester: Drehzahlsignalgeber" VALUE 0x813D7A KwUw 65535.00 dez 0.00 65535.00 FORMAT "%8.2" /end CHARACTERISTIC
/begin CHARACTERISTIC CDTNWSE "Codewort Tester: Nockenwellensteuerungsventil Endstufe" VALUE 0x813D7E KwUw 65535.00 dez 0.00 65535.00 FORMAT "%8.2" /end CHARACTERISTIC
/begin CHARACTERISTIC CDTSLPE "Codewort Tester: Sekundärluftpumpe (Endstufe)" VALUE 0x813D8E KwUw 65535.00 dez 0.00 65535.00 FORMAT "%8.2" /end CHARACTERISTIC
/begin CHARACTERISTIC CDTSLVE "Codewort Tester: Sekundärluftventil (Endstufe)" VALUE 0x813D94 KwUw 65535.00 dez 0.00 65535.00 FORMAT "%8.2" /end CHARACTERISTIC
/begin CHARACTERISTIC CDTTEVE "Codewort Tester: Tankentlüftungsventil Endstufe" VALUE 0x813DA2 KwUw 65535.00 dez 0.00 65535.00 FORMAT "%8.2" /end CHARACTERISTIC
/begin CHARACTERISTIC CDTUVSE "Codewort Tester: Endstufe Umluftventil Turbo" VALUE 0x813DBE KwUw 65535.00 dez 0.00 65535.00 FORMAT "%8.2" /end CHARACTERISTIC
/begin CHARACTERISTIC CDTZET1 "" VALUE 0x813DC6 KwUw 65535.00 dez 0.00 65535.00 FORMAT "%8.2" /end CHARACTERISTIC
/begin CHARACTERISTIC CDTZET2 "" VALUE 0x813DC8 KwUw 65535.00 dez 0.00 65535.00 FORMAT "%8.2" /end CHARACTERISTIC
/begin CHARACTERISTIC CDTZET3 "" VALUE 0x813DCA KwUw 65535.00 dez 0.00 65535.00 FORMAT "%8.2" /end CHARACTERISTIC
/begin CHARACTERISTIC CDTZET4 "" VALUE 0x813DCC KwUw 65535.00 dez 0.00 65535.00 FORMAT "%8.2" /end CHARACTERISTIC
/begin CHARACTERISTIC CDTZZZ "Dummy: Tabellenende" VALUE 0x813DCE KwUw 65535.00 dez 0.00 65535.00 FORMAT "%8.2" /end CHARACTERISTIC
/begin CHARACTERISTIC CLAAAA "Dummy: Tabellenanfang" VALUE 0x810763 KwUb 255.0 dez 0.00 255.0 FORMAT "%5.1" /end CHARACTERISTIC
/begin CHARACTERISTIC CLAAAVE "Fehlerklasse: Absperrventil Aktivkohlefilter (Endstufe)" VALUE 0x810766 KwUb 255.0 dez 0.00 255.0 FORMAT "%5.1" /end CHARACTERISTIC
/begin CHARACTERISTIC CLAAGRE "Fehlerklasse: AGR-Ventil Endstufe" VALUE 0x810767 KwUb 255.0 dez 0.00 255.0 FORMAT "%5.1" /end CHARACTERISTIC
/begin CHARACTERISTIC CLAATR "Fehlerklasse Abgastemperaturregelung" VALUE 0x810769 KwUb 255.0 dez 0.00 255.0 FORMAT "%5.1" /end CHARACTERISTIC
/begin CHARACTERISTIC CLAATR2 "Fehlerklasse Abgastemperaturregelung Bank 2" VALUE 0x81076A KwUb 255.0 dez 0.00 255.0 FORMAT "%5.1" /end CHARACTERISTIC
/begin CHARACTERISTIC CLAATRD "" VALUE 0x81076B KwUb 255.0 dez 0.00 255.0 FORMAT "%5.1" /end CHARACTERISTIC
/begin CHARACTERISTIC CLAATRD2 "" VALUE 0x81076C KwUb 255.0 dez 0.00 255.0 FORMAT "%5.1" /end CHARACTERISTIC
/begin CHARACTERISTIC CLAATS "Fehlerklasse Abgastemperatursensor" VALUE 0x81076D KwUb 255.0 dez 0.00 255.0 FORMAT "%5.1" /end CHARACTERISTIC
/begin CHARACTERISTIC CLABKVP "" VALUE 0x81076E KwUb 255.0 dez 0.00 255.0 FORMAT "%5.1" /end CHARACTERISTIC
/begin CHARACTERISTIC CLABKVPE "" VALUE 0x81076F KwUb 255.0 dez 0.00 255.0 FORMAT "%5.1" /end CHARACTERISTIC
/begin CHARACTERISTIC CLABM "Fehlerklasse: Bezugsmarkengeber" VALUE 0x810770 KwUb 255.0 dez 0.00 255.0 FORMAT "%5.1" /end CHARACTERISTIC
/begin CHARACTERISTIC CLACV "Fehlerklasse: Diagnose Kurbelgehäuseentlüftung" VALUE 0x81077C KwUb 255.0 dez 0.00 255.0 FORMAT "%5.1" /end CHARACTERISTIC
/begin CHARACTERISTIC CLADK "Fehlerklasse: DK- Potentiometer" VALUE 0x81077D KwUb 255.0 dez 0.00 255.0 FORMAT "%5.1" /end CHARACTERISTIC
/begin CHARACTERISTIC CLADK1P "Fehlerklassse: Drosselklappe 1. Poti" VALUE 0x81077E KwUb 255.0 dez 0.00 255.0 FORMAT "%5.1" /end CHARACTERISTIC
/begin CHARACTERISTIC CLADK2P "Fehlerklasse: Drosselklappenpotentiometer 2" VALUE 0x81077F KwUb 255.0 dez 0.00 255.0 FORMAT "%5.1" /end CHARACTERISTIC
/begin CHARACTERISTIC CLADVEE "Fehlerklasse: DV-E Endstufe" VALUE 0x810785 KwUb 255.0 dez 0.00 255.0 FORMAT "%5.1" /end CHARACTERISTIC
/begin CHARACTERISTIC CLADVEF "Fehlerklasse: DV-E Fehler bei Federprüfung" VALUE 0x810786 KwUb 255.0 dez 0.00 255.0 FORMAT "%5.1" /end CHARACTERISTIC
/begin CHARACTERISTIC CLADVEFO "" VALUE 0x810787 KwUb 255.0 dez 0.00 255.0 FORMAT "%5.1" /end CHARACTERISTIC
/begin CHARACTERISTIC CLADVEL "Fehlerklasse: DV-E Lageabweichung" VALUE 0x810788 KwUb 255.0 dez 0.00 255.0 FORMAT "%5.1" /end CHARACTERISTIC
/begin CHARACTERISTIC CLADVEN "Fehlerklasse: DV-E Fehler bei Prüfung Notluftposition" VALUE 0x810789 KwUb 255.0 dez 0.00 255.0 FORMAT "%5.1" /end CHARACTERISTIC
/begin CHARACTERISTIC CLADVER "Fehlerklasse: DV-E Regelbereich" VALUE 0x81078A KwUb 255.0 dez 0.00 255.0 FORMAT "%5.1" /end CHARACTERISTIC
/begin CHARACTERISTIC CLADVET "" VALUE 0x81078B KwUb 255.0 dez 0.00 255.0 FORMAT "%5.1" /end CHARACTERISTIC
/begin CHARACTERISTIC CLADVEU "Fehlerklasse: DV-E Fehler beim UMA-Lernen" VALUE 0x81078C KwUb 255.0 dez 0.00 255.0 FORMAT "%5.1" /end CHARACTERISTIC
/begin CHARACTERISTIC CLADVEUB "" VALUE 0x81078D KwUb 255.0 dez 0.00 255.0 FORMAT "%5.1" /end CHARACTERISTIC
/begin CHARACTERISTIC CLADVEUW "" VALUE 0x81078E KwUb 255.0 dez 0.00 255.0 FORMAT "%5.1" /end CHARACTERISTIC
/begin CHARACTERISTIC CLADVEV "Fehlerklasse: DV-E Fehler bei Verstärkerabgleich" VALUE 0x81078F KwUb 255.0 dez 0.00 255.0 FORMAT "%5.1" /end CHARACTERISTIC
/begin CHARACTERISTIC CLAENWS "Fehlerklasse: Nockenwellensteuerung Einlass Nockenwelle" VALUE 0x810792 KwUb 255.0 dez 0.00 255.0 FORMAT "%5.1" /end CHARACTERISTIC
/begin CHARACTERISTIC CLAENWSE "Fehlerklasse: Einlaßnockenwelle- Endstufe" VALUE 0x810793 KwUb 255.0 dez 0.00 255.0 FORMAT "%5.1" /end CHARACTERISTIC
/begin CHARACTERISTIC CLAEPCLE "Fehlerklasse: Fahrverhaltens- Fehllampe ( Endstufe )" VALUE 0x810794 KwUb 255.0 dez 0.00 255.0 FORMAT "%5.1" /end CHARACTERISTIC
/begin CHARACTERISTIC CLAEV1 "Fehlerklasse: EV Endtsufe 1" VALUE 0x810795 KwUb 255.0 dez 0.00 255.0 FORMAT "%5.1" /end CHARACTERISTIC
/begin CHARACTERISTIC CLAEV2 "Fehlerklasse: EV Endstufe 2" VALUE 0x810796 KwUb 255.0 dez 0.00 255.0 FORMAT "%5.1" /end CHARACTERISTIC
/begin CHARACTERISTIC CLAEV3 "Fehlerklasse: EV Endstufe 3" VALUE 0x810797 KwUb 255.0 dez 0.00 255.0 FORMAT "%5.1" /end CHARACTERISTIC
/begin CHARACTERISTIC CLAEV4 "Fehlerklasse: EV Endstufe 4" VALUE 0x810798 KwUb 255.0 dez 0.00 255.0 FORMAT "%5.1" /end CHARACTERISTIC
/begin CHARACTERISTIC CLAHSH "Fehlerklasse: Heizung Lambdasonde hinter Kat" VALUE 0x8107A2 KwUb 255.0 dez 0.00 255.0 FORMAT "%5.1" /end CHARACTERISTIC
/begin CHARACTERISTIC CLAHSH2 "Fehlerklasse: Heizung Lambdasonde 2 hinter Kat" VALUE 0x8107A3 KwUb 255.0 dez 0.00 255.0 FORMAT "%5.1" /end CHARACTERISTIC
/begin CHARACTERISTIC CLAHSHE "Fehlerklasse: Endstufe Heizung Lambdasonde hinter Kat" VALUE 0x8107A4 KwUb 255.0 dez 0.00 255.0 FORMAT "%5.1" /end CHARACTERISTIC
/begin CHARACTERISTIC CLAHSV "Fehlerklasse: Heizung Lambdasonde vor Kat" VALUE 0x8107A5 KwUb 255.0 dez 0.00 255.0 FORMAT "%5.1" /end CHARACTERISTIC
/begin CHARACTERISTIC CLAHSV2 "Fehlerklasse: Heizung Lambdasonde 2 vor Kat" VALUE 0x8107A6 KwUb 255.0 dez 0.00 255.0 FORMAT "%5.1" /end CHARACTERISTIC
/begin CHARACTERISTIC CLAHSVSA "Fehlerklasse: Heizung Lambdasonde vor Kat" VALUE 0x8107A7 KwUb 255.0 dez 0.00 255.0 FORMAT "%5.1" /end CHARACTERISTIC
/begin CHARACTERISTIC CLAHSVSA2 "Fehlerklasse: Heizung Lambdasonde 2 vor Kat" VALUE 0x8107A8 KwUb 255.0 dez 0.00 255.0 FORMAT "%5.1" /end CHARACTERISTIC
/begin CHARACTERISTIC CLAKAT "Fehlerklasse: Katalysator" VALUE 0x8107A9 KwUb 255.0 dez 0.00 255.0 FORMAT "%5.1" /end CHARACTERISTIC
/begin CHARACTERISTIC CLAKPE "Fehlerklasse: EKP-Relais Endstufe" VALUE 0x8107AA KwUb 255.0 dez 0.00 255.0 FORMAT "%5.1" /end CHARACTERISTIC
/begin CHARACTERISTIC CLAKRA01 "Fehlerklasse: Klopfregelanschlag Zylinder 1" VALUE 0x8107AB KwUb 255.0 dez 0.00 255.0 FORMAT "%5.1" /end CHARACTERISTIC
/begin CHARACTERISTIC CLAKRA02 "Fehlerklasse: Klopfregelanschlag Zylinder 2" VALUE 0x8107AC KwUb 255.0 dez 0.00 255.0 FORMAT "%5.1" /end CHARACTERISTIC
/begin CHARACTERISTIC CLAKRA03 "Fehlerklasse: Klopfregelanschlag Zylinder 3" VALUE 0x8107AD KwUb 255.0 dez 0.00 255.0 FORMAT "%5.1" /end CHARACTERISTIC
/begin CHARACTERISTIC CLAKRA04 "Fehlerklasse: Klopfregelanschlag Zylinder 4" VALUE 0x8107AE KwUb 255.0 dez 0.00 255.0 FORMAT "%5.1" /end CHARACTERISTIC
/begin CHARACTERISTIC CLAKRNT "Fehlerklasse: Klopfregelung Nulltest" VALUE 0x8107AF KwUb 255.0 dez 0.00 255.0 FORMAT "%5.1" /end CHARACTERISTIC
/begin CHARACTERISTIC CLAKROF "Fehlerklasse: Klopfreglung Offset" VALUE 0x8107B0 KwUb 255.0 dez 0.00 255.0 FORMAT "%5.1" /end CHARACTERISTIC
/begin CHARACTERISTIC CLAKRTP "Fehlerklasse: Klopfregelung Testimpuls" VALUE 0x8107B1 KwUb 255.0 dez 0.00 255.0 FORMAT "%5.1" /end CHARACTERISTIC
/begin CHARACTERISTIC CLAKS1 "Fehlerklasse: Klopfsensor 1" VALUE 0x8107B2 KwUb 255.0 dez 0.00 255.0 FORMAT "%5.1" /end CHARACTERISTIC
/begin CHARACTERISTIC CLAKS2 "Fehlerklasse: Klopfsensor 2" VALUE 0x8107B3 KwUb 255.0 dez 0.00 255.0 FORMAT "%5.1" /end CHARACTERISTIC
/begin CHARACTERISTIC CLAKS3 "Fehlerklasse: Klopfsensor 3" VALUE 0x8107B4 KwUb 255.0 dez 0.00 255.0 FORMAT "%5.1" /end CHARACTERISTIC
/begin CHARACTERISTIC CLAKS4 "Fehlerklasse: Klopfsensor 4" VALUE 0x8107B5 KwUb 255.0 dez 0.00 255.0 FORMAT "%5.1" /end CHARACTERISTIC
/begin CHARACTERISTIC CLALDE "Fehlerklasse: LDR-Taktventil Endstufe" VALUE 0x8107B9 KwUb 255.0 dez 0.00 255.0 FORMAT "%5.1" /end CHARACTERISTIC
/begin CHARACTERISTIC CLALM "Fehlerklasse: Hauptfüllungssignal" VALUE 0x8107C1 KwUb 255.0 dez 0.00 255.0 FORMAT "%5.1" /end CHARACTERISTIC
/begin CHARACTERISTIC CLAMILE "Fehlerklasse: MIL-Endstufe" VALUE 0x8107CB KwUb 255.0 dez 0.00 255.0 FORMAT "%5.1" /end CHARACTERISTIC
/begin CHARACTERISTIC CLAN "Fehlerklasse: Drehzahlgeber" VALUE 0x8107CC KwUb 255.0 dez 0.00 255.0 FORMAT "%5.1" /end CHARACTERISTIC
/begin CHARACTERISTIC CLANWSE "Fehlerklasse: Nockenwellensteuerungsventil Endstufe" VALUE 0x8107CE KwUb 255.0 dez 0.00 255.0 FORMAT "%5.1" /end CHARACTERISTIC
/begin CHARACTERISTIC CLASLPE "Fehlerklasse: Sekundärluftpumpe Endstufe" VALUE 0x8107D6 KwUb 255.0 dez 0.00 255.0 FORMAT "%5.1" /end CHARACTERISTIC
/begin CHARACTERISTIC CLASLVE "Fehlerklasse: Sekundärluftventil Endstufe" VALUE 0x8107D9 KwUb 255.0 dez 0.00 255.0 FORMAT "%5.1" /end CHARACTERISTIC
/begin CHARACTERISTIC CLATEVE "Fehlerklasse: Tankentlüftungsventil Endstufe" VALUE 0x8107E0 KwUb 255.0 dez 0.00 255.0 FORMAT "%5.1" /end CHARACTERISTIC
/begin CHARACTERISTIC CLAUVSE "Fehlerklasse: Endstufe Umluftventil Turbo" VALUE 0x8107EE KwUb 255.0 dez 0.00 255.0 FORMAT "%5.1" /end CHARACTERISTIC
/begin CHARACTERISTIC CLAZET1 "" VALUE 0x8107F2 KwUb 255.0 dez 0.00 255.0 FORMAT "%5.1" /end CHARACTERISTIC
/begin CHARACTERISTIC CLAZET2 "" VALUE 0x8107F3 KwUb 255.0 dez 0.00 255.0 FORMAT "%5.1" /end CHARACTERISTIC
/begin CHARACTERISTIC CLAZET3 "" VALUE 0x8107F4 KwUb 255.0 dez 0.00 255.0 FORMAT "%5.1" /end CHARACTERISTIC
/begin CHARACTERISTIC CLAZET4 "" VALUE 0x8107F5 KwUb 255.0 dez 0.00 255.0 FORMAT "%5.1" /end CHARACTERISTIC
/begin CHARACTERISTIC CLAZZZ "Dummy: Tabellenende" VALUE 0x8107F6 KwUb 255.0 dez 0.00 255.0 FORMAT "%5.1" /end CHARACTERISTIC
/begin CHARACTERISTIC FFTAAA "Dummy: Tabellenanfang" VAL_BLK 0x8107F7 KwbUb 255.0 dez 0.00 255.0 FORMAT "%5.1" NUMBER 2 /end CHARACTERISTIC
/begin CHARACTERISTIC FFTAAVE "Freeze Frame Tabelle: Absperrventil Aktivkohlefilter (Endstufe)" VAL_BLK 0x8107FD KwbUb 255.0 dez 0.00 255.0 FORMAT "%5.1" NUMBER 2 /end CHARACTERISTIC
/begin CHARACTERISTIC FFTAGRE "Freeze Frame Tabelle: AGR-Ventil Endstufe" VAL_BLK 0x8107FF KwbUb 255.0 dez 0.00 255.0 FORMAT "%5.1" NUMBER 2 /end CHARACTERISTIC
/begin CHARACTERISTIC FFTATR "Tabelle der Umweltbed. Abgastemperaturregelung" VAL_BLK 0x810803 KwbUb 255.0 dez 0.00 255.0 FORMAT "%5.1" NUMBER 2 /end CHARACTERISTIC
/begin CHARACTERISTIC FFTATR2 "Tabelle der Umweltbed. Abgastemperaturregelung Bank 2" VAL_BLK 0x810805 KwbUb 255.0 dez 0.00 255.0 FORMAT "%5.1" NUMBER 2 /end CHARACTERISTIC
/begin CHARACTERISTIC FFTATRD "" VAL_BLK 0x810807 KwbUb 255.0 dez 0.00 255.0 FORMAT "%5.1" NUMBER 2 /end CHARACTERISTIC
/begin CHARACTERISTIC FFTATRD2 "" VAL_BLK 0x810809 KwbUb 255.0 dez 0.00 255.0 FORMAT "%5.1" NUMBER 2 /end CHARACTERISTIC
/begin CHARACTERISTIC FFTATS "Tabelle der Umweltbed. Abgastemperatursensor" VAL_BLK 0x81080B KwbUb 255.0 dez 0.00 255.0 FORMAT "%5.1" NUMBER 2 /end CHARACTERISTIC
/begin CHARACTERISTIC FFTBKVP "" VAL_BLK 0x81080D KwbUb 255.0 dez 0.00 255.0 FORMAT "%5.1" NUMBER 2 /end CHARACTERISTIC
/begin CHARACTERISTIC FFTBKVPE "" VAL_BLK 0x81080F KwbUb 255.0 dez 0.00 255.0 FORMAT "%5.1" NUMBER 2 /end CHARACTERISTIC
/begin CHARACTERISTIC FFTBM "Freeze Frame Tabelle: Bezugsmarkengeber" VAL_BLK 0x810811 KwbUb 255.0 dez 0.00 255.0 FORMAT "%5.1" NUMBER 2 /end CHARACTERISTIC
/begin CHARACTERISTIC FFTCV "Freeze Frame Tabelle: Diagnose Kurbelgehäuseentlüftung" VAL_BLK 0x810829 KwbUb 255.0 dez 0.00 255.0 FORMAT "%5.1" NUMBER 2 /end CHARACTERISTIC
/begin CHARACTERISTIC FFTDK "Freeze Frame Tabelle: DK- Potentiometer" VAL_BLK 0x81082B KwbUb 255.0 dez 0.00 255.0 FORMAT "%5.1" NUMBER 2 /end CHARACTERISTIC
/begin CHARACTERISTIC FFTDK1P "Freeze Frame Tabelle: Drosselklappe 1. Poti" VAL_BLK 0x81082D KwbUb 255.0 dez 0.00 255.0 FORMAT "%5.1" NUMBER 2 /end CHARACTERISTIC
/begin CHARACTERISTIC FFTDK2P "Freeze Frame Tabelle: Drosselklappenpotentiometer 2" VAL_BLK 0x81082F KwbUb 255.0 dez 0.00 255.0 FORMAT "%5.1" NUMBER 2 /end CHARACTERISTIC
/begin CHARACTERISTIC FFTDVEE "Freeze Frame Tabelle: DV-E Endstufe" VAL_BLK 0x81083B KwbUb 255.0 dez 0.00 255.0 FORMAT "%5.1" NUMBER 2 /end CHARACTERISTIC
/begin CHARACTERISTIC FFTDVEF "Freeze Frame Tabelle: DV-E Fehler bei Federprüfung" VAL_BLK 0x81083D KwbUb 255.0 dez 0.00 255.0 FORMAT "%5.1" NUMBER 2 /end CHARACTERISTIC
/begin CHARACTERISTIC FFTDVEFO "" VAL_BLK 0x81083F KwbUb 255.0 dez 0.00 255.0 FORMAT "%5.1" NUMBER 2 /end CHARACTERISTIC
/begin CHARACTERISTIC FFTDVEL "Freeze Frame Tabelle: DV-E Lageabweichung" VAL_BLK 0x810841 KwbUb 255.0 dez 0.00 255.0 FORMAT "%5.1" NUMBER 2 /end CHARACTERISTIC
/begin CHARACTERISTIC FFTDVEN "Freeze Frame Tabelle: DV-E Fehler bei Prüfung Notluftposition" VAL_BLK 0x810843 KwbUb 255.0 dez 0.00 255.0 FORMAT "%5.1" NUMBER 2 /end CHARACTERISTIC
/begin CHARACTERISTIC FFTDVER "Freeze Frame Tabelle: DV-E Regelbereich" VAL_BLK 0x810845 KwbUb 255.0 dez 0.00 255.0 FORMAT "%5.1" NUMBER 2 /end CHARACTERISTIC
/begin CHARACTERISTIC FFTDVET "" VAL_BLK 0x810847 KwbUb 255.0 dez 0.00 255.0 FORMAT "%5.1" NUMBER 2 /end CHARACTERISTIC
/begin CHARACTERISTIC FFTDVEU "Freeze Frame Tabelle: DV-E Fehler beim UMA-Lernen" VAL_BLK 0x810849 KwbUb 255.0 dez 0.00 255.0 FORMAT "%5.1" NUMBER 2 /end CHARACTERISTIC
/begin CHARACTERISTIC FFTDVEUB "" VAL_BLK 0x81084B KwbUb 255.0 dez 0.00 255.0 FORMAT "%5.1" NUMBER 2 /end CHARACTERISTIC
/begin CHARACTERISTIC FFTDVEUW "" VAL_BLK 0x81084D KwbUb 255.0 dez 0.00 255.0 FORMAT "%5.1" NUMBER 2 /end CHARACTERISTIC
/begin CHARACTERISTIC FFTDVEV "Freeze Frame Tabelle: DV-E Fehler bei Verstärkerabgleich" VAL_BLK 0x81084F KwbUb 255.0 dez 0.00 255.0 FORMAT "%5.1" NUMBER 2 /end CHARACTERISTIC
/begin CHARACTERISTIC FFTENWS "Freeze Frame Tabelle: Nockenwellensteuerung Einlass Nockenwelle" VAL_BLK 0x810855 KwbUb 255.0 dez 0.00 255.0 FORMAT "%5.1" NUMBER 2 /end CHARACTERISTIC
/begin CHARACTERISTIC FFTENWSE "Freeze Frame Tabelle: Einlaßnockenwelle- Endstufe" VAL_BLK 0x810857 KwbUb 255.0 dez 0.00 255.0 FORMAT "%5.1" NUMBER 2 /end CHARACTERISTIC
/begin CHARACTERISTIC FFTEPCLE "Freeze Frame Tabelle: Fahrverhaltens- Fehllampe ( Endstufe )" VAL_BLK 0x810859 KwbUb 255.0 dez 0.00 255.0 FORMAT "%5.1" NUMBER 2 /end CHARACTERISTIC
/begin CHARACTERISTIC FFTEV1 "Freeze Frame Tabelle: EV Endstufe 1" VAL_BLK 0x81085B KwbUb 255.0 dez 0.00 255.0 FORMAT "%5.1" NUMBER 2 /end CHARACTERISTIC
/begin CHARACTERISTIC FFTEV2 "Freeze Frame Tabelle: EV Endstufe 2" VAL_BLK 0x81085D KwbUb 255.0 dez 0.00 255.0 FORMAT "%5.1" NUMBER 2 /end CHARACTERISTIC
/begin CHARACTERISTIC FFTEV3 "Freeze Frame Tabelle: EV Endstufe 3" VAL_BLK 0x81085F KwbUb 255.0 dez 0.00 255.0 FORMAT "%5.1" NUMBER 2 /end CHARACTERISTIC
/begin CHARACTERISTIC FFTEV4 "Freeze Frame Tabelle: EV Endstufe 4" VAL_BLK 0x810861 KwbUb 255.0 dez 0.00 255.0 FORMAT "%5.1" NUMBER 2 /end CHARACTERISTIC
/begin CHARACTERISTIC FFTHSH "Tabelle Umweltbedingungen Heizung Lambdasonde hinter Kat" VAL_BLK 0x810875 KwbUb 255.0 dez 0.00 255.0 FORMAT "%5.1" NUMBER 2 /end CHARACTERISTIC
/begin CHARACTERISTIC FFTHSH2 "Tabelle Umweltbedingungen Heizung Lambdasonde hinter Kat Bank2" VAL_BLK 0x810877 KwbUb 255.0 dez 0.00 255.0 FORMAT "%5.1" NUMBER 2 /end CHARACTERISTIC
/begin CHARACTERISTIC FFTHSHE "Tabelle Umweltbedingungen Endstufe Heizung Lambdasonde hinter Kat" VAL_BLK 0x810879 KwbUb 255.0 dez 0.00 255.0 FORMAT "%5.1" NUMBER 2 /end CHARACTERISTIC
/begin CHARACTERISTIC FFTHSV "Tabelle Umweltbedingungen Heizung Lambdasonde vor Kat" VAL_BLK 0x81087B KwbUb 255.0 dez 0.00 255.0 FORMAT "%5.1" NUMBER 2 /end CHARACTERISTIC
/begin CHARACTERISTIC FFTHSV2 "Tabelle Umweltbedingungen Heizung Lambdasonde vor Kat Bank2" VAL_BLK 0x81087D KwbUb 255.0 dez 0.00 255.0 FORMAT "%5.1" NUMBER 2 /end CHARACTERISTIC
/begin CHARACTERISTIC FFTHSVSA "Tabelle Umweltbedingungen Heizung Lambdasonde vor Kat" VAL_BLK 0x81087F KwbUb 255.0 dez 0.00 255.0 FORMAT "%5.1" NUMBER 2 /end CHARACTERISTIC
/begin CHARACTERISTIC FFTHSVSA2 "Tabelle Umweltbedingungen Heizung Lambdasonde vor Kat Bank2" VAL_BLK 0x810881 KwbUb 255.0 dez 0.00 255.0 FORMAT "%5.1" NUMBER 2 /end CHARACTERISTIC
/begin CHARACTERISTIC FFTKAT "Freeze Frame Tabelle: Katalysator" VAL_BLK 0x810883 KwbUb 255.0 dez 0.00 255.0 FORMAT "%5.1" NUMBER 2 /end CHARACTERISTIC
/begin CHARACTERISTIC FFTKPE "Freeze Frame Tabelle: EKP-Relais Endstufe" VAL_BLK 0x810885 KwbUb 255.0 dez 0.00 255.0 FORMAT "%5.1" NUMBER 2 /end CHARACTERISTIC
/begin CHARACTERISTIC FFTKRA01 "Freeze Frame Tabelle: Klopfregelanschlag Zylinder 1" VAL_BLK 0x810887 KwbUb 255.0 dez 0.00 255.0 FORMAT "%5.1" NUMBER 2 /end CHARACTERISTIC
/begin CHARACTERISTIC FFTKRA02 "Freeze Frame Tabelle: Klopfregelanschlag Zylinder 2" VAL_BLK 0x810889 KwbUb 255.0 dez 0.00 255.0 FORMAT "%5.1" NUMBER 2 /end CHARACTERISTIC
/begin CHARACTERISTIC FFTKRA03 "Freeze Frame Tabelle: Klopfregelanschlag Zylinder 3" VAL_BLK 0x81088B KwbUb 255.0 dez 0.00 255.0 FORMAT "%5.1" NUMBER 2 /end CHARACTERISTIC
/begin CHARACTERISTIC FFTKRA04 "Freeze Frame Tabelle: Klopfregelanschlag Zylinder 4" VAL_BLK 0x81088D KwbUb 255.0 dez 0.00 255.0 FORMAT "%5.1" NUMBER 2 /end CHARACTERISTIC
/begin CHARACTERISTIC FFTKRNT "Freeze frame Tabelle: Klopfregelung Nulltest" VAL_BLK 0x81088F KwbUb 255.0 dez 0.00 255.0 FORMAT "%5.1" NUMBER 2 /end CHARACTERISTIC
/begin CHARACTERISTIC FFTKROF "Freeze Frame Tabelle: Klopfregelung Offset" VAL_BLK 0x810891 KwbUb 255.0 dez 0.00 255.0 FORMAT "%5.1" NUMBER 2 /end CHARACTERISTIC
/begin CHARACTERISTIC FFTKRTP "Freeze Frame Tabelle: Klopfregelung Testimpuls" VAL_BLK 0x810893 KwbUb 255.0 dez 0.00 255.0 FORMAT "%5.1" NUMBER 2 /end CHARACTERISTIC
/begin CHARACTERISTIC FFTKS1 "Freeze Frame Tabelle: Klopfsensor 1" VAL_BLK 0x810895 KwbUb 255.0 dez 0.00 255.0 FORMAT "%5.1" NUMBER 2 /end CHARACTERISTIC
/begin CHARACTERISTIC FFTKS2 "Freeze Frame Tabelle: Klopfsensor 2" VAL_BLK 0x810897 KwbUb 255.0 dez 0.00 255.0 FORMAT "%5.1" NUMBER 2 /end CHARACTERISTIC
/begin CHARACTERISTIC FFTKS3 "Freeze Frame Tabelle: Klopfsensor 3" VAL_BLK 0x810899 KwbUb 255.0 dez 0.00 255.0 FORMAT "%5.1" NUMBER 2 /end CHARACTERISTIC
/begin CHARACTERISTIC FFTKS4 "Freeze Frame Tabelle: Klopfsensor 4" VAL_BLK 0x81089B KwbUb 255.0 dez 0.00 255.0 FORMAT "%5.1" NUMBER 2 /end CHARACTERISTIC
/begin CHARACTERISTIC FFTLDE "Freeze Frame Tabelle: LDR Taktventil Endstufe" VAL_BLK 0x8108A3 KwbUb 255.0 dez 0.00 255.0 FORMAT "%5.1" NUMBER 2 /end CHARACTERISTIC
/begin CHARACTERISTIC FFTLM "Freeze Frame Tabelle: Hauptfüllungssensor" VAL_BLK 0x8108B3 KwbUb 255.0 dez 0.00 255.0 FORMAT "%5.1" NUMBER 2 /end CHARACTERISTIC
/begin CHARACTERISTIC FFTMILE "Freeze Frame Tabelle: MIL-Endstufe" VAL_BLK 0x8108C7 KwbUb 255.0 dez 0.00 255.0 FORMAT "%5.1" NUMBER 2 /end CHARACTERISTIC
/begin CHARACTERISTIC FFTN "Freeze Frame Tabelle: Drehzahlgeber" VAL_BLK 0x8108C9 KwbUb 255.0 dez 0.00 255.0 FORMAT "%5.1" NUMBER 2 /end CHARACTERISTIC
/begin CHARACTERISTIC FFTNWSE "Freeze Frame Tabelle: Nockenwellensteuerungsventil Endstufe" VAL_BLK 0x8108CD KwbUb 255.0 dez 0.00 255.0 FORMAT "%5.1" NUMBER 2 /end CHARACTERISTIC
/begin CHARACTERISTIC FFTSLPE "Freeze Frame Tabelle: Sekundärluftpumpe Endstufe" VAL_BLK 0x8108DD KwbUb 255.0 dez 0.00 255.0 FORMAT "%5.1" NUMBER 2 /end CHARACTERISTIC
/begin CHARACTERISTIC FFTSLVE "Freeze Frame Tabelle: Sekundärluftventil Endstufe" VAL_BLK 0x8108E3 KwbUb 255.0 dez 0.00 255.0 FORMAT "%5.1" NUMBER 2 /end CHARACTERISTIC
/begin CHARACTERISTIC FFTTEVE "Freeze Frame Tabelle: Tankentlüftungsventil Endstufe" VAL_BLK 0x8108F1 KwbUb 255.0 dez 0.00 255.0 FORMAT "%5.1" NUMBER 2 /end CHARACTERISTIC
/begin CHARACTERISTIC FFTUVSE "Freeze Frame Tabelle:Endstufe Umluftventil Turbo" VAL_BLK 0x81090D KwbUb 255.0 dez 0.00 255.0 FORMAT "%5.1" NUMBER 2 /end CHARACTERISTIC
/begin CHARACTERISTIC FFTZET1 "" VAL_BLK 0x810915 KwbUb 255.0 dez 0.00 255.0 FORMAT "%5.1" NUMBER 2 /end CHARACTERISTIC
/begin CHARACTERISTIC FFTZET2 "" VAL_BLK 0x810917 KwbUb 255.0 dez 0.00 255.0 FORMAT "%5.1" NUMBER 2 /end CHARACTERISTIC
/begin CHARACTERISTIC FFTZET3 "" VAL_BLK 0x810919 KwbUb 255.0 dez 0.00 255.0 FORMAT "%5.1" NUMBER 2 /end CHARACTERISTIC
/begin CHARACTERISTIC FFTZET4 "" VAL_BLK 0x81091B KwbUb 255.0 dez 0.00 255.0 FORMAT "%5.1" NUMBER 2 /end CHARACTERISTIC
/begin CHARACTERISTIC FFTZZZ "Dummy: Tabellenende" VAL_BLK 0x81091D KwbUb 255.0 dez 0.00 255.0 FORMAT "%5.1" NUMBER 2 /end CHARACTERISTIC
/begin CHARACTERISTIC TSFAAA "Dummy: Tabellenanfang" VALUE 0x81091F KwUb 255.0 dez 0.00 255.0 FORMAT "%5.1" /end CHARACTERISTIC
/begin CHARACTERISTIC TSFAAVE "Fehlersummenzeit: Absperrventil Aktivkohlefilter (Endstufe)" VALUE 0x810922 KwUb 255.0 dez 0.00 255.0 FORMAT "%5.1" /end CHARACTERISTIC
/begin CHARACTERISTIC TSFAGRE "Fehlersummenzeit: Überwachung AGR-Endstufe" VALUE 0x810923 KwUb 255.0 dez 0.00 255.0 FORMAT "%5.1" /end CHARACTERISTIC
/begin CHARACTERISTIC TSFATR "Fehlerschwere Abgastemperaturregelung" VALUE 0x810925 KwUb 255.0 dez 0.00 255.0 FORMAT "%5.1" /end CHARACTERISTIC
/begin CHARACTERISTIC TSFATR2 "Fehlerschwere Abgastemperaturregelung Bank 2" VALUE 0x810926 KwUb 255.0 dez 0.00 255.0 FORMAT "%5.1" /end CHARACTERISTIC
/begin CHARACTERISTIC TSFATRD "" VALUE 0x810927 KwUb 255.0 dez 0.00 255.0 FORMAT "%5.1" /end CHARACTERISTIC
/begin CHARACTERISTIC TSFATRD2 "" VALUE 0x810928 KwUb 255.0 dez 0.00 255.0 FORMAT "%5.1" /end CHARACTERISTIC
/begin CHARACTERISTIC TSFATS "Fehlerschwere Abgastemperatursensor" VALUE 0x810929 KwUb 255.0 dez 0.00 255.0 FORMAT "%5.1" /end CHARACTERISTIC
/begin CHARACTERISTIC TSFBKVP "" VALUE 0x81092A KwUb 255.0 dez 0.00 255.0 FORMAT "%5.1" /end CHARACTERISTIC
/begin CHARACTERISTIC TSFBKVPE "" VALUE 0x81092B KwUb 255.0 dez 0.00 255.0 FORMAT "%5.1" /end CHARACTERISTIC
/begin CHARACTERISTIC TSFBM "Fehlersummenzeit: Bezugsmarkengeber" VALUE 0x81092C KwUb 255.0 dez 0.00 255.0 FORMAT "%5.1" /end CHARACTERISTIC
/begin CHARACTERISTIC TSFCV "Fehlersummenzeit: Diagnose Kurbelgehäuseentlüftung" VALUE 0x810938 KwUb 255.0 dez 0.00 255.0 FORMAT "%5.1" /end CHARACTERISTIC
/begin CHARACTERISTIC TSFDK "Fehlersummenzeit: DK - Potentiometer" VALUE 0x810939 KwUb 255.0 dez 0.00 255.0 FORMAT "%5.1" /end CHARACTERISTIC
/begin CHARACTERISTIC TSFDK1P "Fehlersummenzeit: Drosselklappe 1. Poti" VALUE 0x81093A KwUb 255.0 dez 0.00 255.0 FORMAT "%5.1" /end CHARACTERISTIC
/begin CHARACTERISTIC TSFDK2P "Fehlersummenzeit: Drosselklappenpotentiometer 2" VALUE 0x81093B KwUb 255.0 dez 0.00 255.0 FORMAT "%5.1" /end CHARACTERISTIC
/begin CHARACTERISTIC TSFDVEE "Fehlersummenzeit: DV-E Endstufe" VALUE 0x810941 KwUb 255.0 dez 0.00 255.0 FORMAT "%5.1" /end CHARACTERISTIC
/begin CHARACTERISTIC TSFDVEF "Fehlersummenzeit: DV-E Fehler bei Federprüfung" VALUE 0x810942 KwUb 255.0 dez 0.00 255.0 FORMAT "%5.1" /end CHARACTERISTIC
/begin CHARACTERISTIC TSFDVEFO "" VALUE 0x810943 KwUb 255.0 dez 0.00 255.0 FORMAT "%5.1" /end CHARACTERISTIC
/begin CHARACTERISTIC TSFDVEL "Fehlersummenzeit: DV-E Lageabweichung" VALUE 0x810944 KwUb 255.0 dez 0.00 255.0 FORMAT "%5.1" /end CHARACTERISTIC
/begin CHARACTERISTIC TSFDVEN "Fehlersummenzeit: DV-E Fehler bei Prüfung Notluftposition" VALUE 0x810945 KwUb 255.0 dez 0.00 255.0 FORMAT "%5.1" /end CHARACTERISTIC
/begin CHARACTERISTIC TSFDVER "Fehlersummenzeit: DV-E Regelbereich" VALUE 0x810946 KwUb 255.0 dez 0.00 255.0 FORMAT "%5.1" /end CHARACTERISTIC
/begin CHARACTERISTIC TSFDVET "" VALUE 0x810947 KwUb 255.0 dez 0.00 255.0 FORMAT "%5.1" /end CHARACTERISTIC
/begin CHARACTERISTIC TSFDVEU "Fehlersummenzeit: DV-E Fehler beim UMA-Lernen" VALUE 0x810948 KwUb 255.0 dez 0.00 255.0 FORMAT "%5.1" /end CHARACTERISTIC
/begin CHARACTERISTIC TSFDVEUB "" VALUE 0x810949 KwUb 255.0 dez 0.00 255.0 FORMAT "%5.1" /end CHARACTERISTIC
/begin CHARACTERISTIC TSFDVEUW "" VALUE 0x81094A KwUb 255.0 dez 0.00 255.0 FORMAT "%5.1" /end CHARACTERISTIC
/begin CHARACTERISTIC TSFDVEV "Fehlersummenzeit: DV-E Fehler bei Verstärkerabgleich" VALUE 0x81094B KwUb 255.0 dez 0.00 255.0 FORMAT "%5.1" /end CHARACTERISTIC
/begin CHARACTERISTIC TSFENWS "Fehlersummenzeit: Nockenwellensteuerung Einlass Nockenwelle" VALUE 0x81094E KwUb 255.0 dez 0.00 255.0 FORMAT "%5.1" /end CHARACTERISTIC
/begin CHARACTERISTIC TSFENWSE "Fehlersummenzeit: Einlaßnockenwelle- Endstufe" VALUE 0x81094F KwUb 255.0 dez 0.00 255.0 FORMAT "%5.1" /end CHARACTERISTIC
/begin CHARACTERISTIC TSFEPCLE "Fehlersummenzeit: Fahrverhaltens- Fehllampe ( Endstufe )" VALUE 0x810950 KwUb 255.0 dez 0.00 255.0 FORMAT "%5.1" /end CHARACTERISTIC
/begin CHARACTERISTIC TSFEV1 "Fehlersummenzeit: EV von Zyl. 1" VALUE 0x810951 KwUb 255.0 dez 0.00 255.0 FORMAT "%5.1" /end CHARACTERISTIC
/begin CHARACTERISTIC TSFEV2 "Fehlersummenzeit: EV von Zyl. 2" VALUE 0x810952 KwUb 255.0 dez 0.00 255.0 FORMAT "%5.1" /end CHARACTERISTIC
/begin CHARACTERISTIC TSFEV3 "Fehlersummenzeit: EV von Zyl. 3" VALUE 0x810953 KwUb 255.0 dez 0.00 255.0 FORMAT "%5.1" /end CHARACTERISTIC
/begin CHARACTERISTIC TSFEV4 "Fehlersummenzeit: EV von Zyl. 4" VALUE 0x810954 KwUb 255.0 dez 0.00 255.0 FORMAT "%5.1" /end CHARACTERISTIC
/begin CHARACTERISTIC TSFHSH "Fehlersummenzeit: Lambdasonden-Heizung hinter Katalysator" VALUE 0x81095E KwUb 255.0 dez 0.00 255.0 FORMAT "%5.1" /end CHARACTERISTIC
/begin CHARACTERISTIC TSFHSH2 "Fehlersummenzeit: Lambdasonden-Heizung hinter Katalysator, Bank 2" VALUE 0x81095F KwUb 255.0 dez 0.00 255.0 FORMAT "%5.1" /end CHARACTERISTIC
/begin CHARACTERISTIC TSFHSHE "Fehlersummenzeit: Endstufe Heizung Sonde hinter Kat." VALUE 0x810960 KwUb 255.0 dez 0.00 255.0 FORMAT "%5.1" /end CHARACTERISTIC
/begin CHARACTERISTIC TSFHSV "Fehlersummenzeit: Lambdasonden-Heizung vor Katalysator" VALUE 0x810961 KwUb 255.0 dez 0.00 255.0 FORMAT "%5.1" /end CHARACTERISTIC
/begin CHARACTERISTIC TSFHSV2 "Fehlersummenzeit: Lambdasonden-Heizung vor Katalysator, Bank 2" VALUE 0x810962 KwUb 255.0 dez 0.00 255.0 FORMAT "%5.1" /end CHARACTERISTIC
/begin CHARACTERISTIC TSFHSVSA "Fehlersummenzeit: Lambdasonden-Heizung vor Katalysator" VALUE 0x810963 KwUb 255.0 dez 0.00 255.0 FORMAT "%5.1" /end CHARACTERISTIC
/begin CHARACTERISTIC TSFHSVSA2 "Fehlersummenzeit: Lambdasonden-Heizung vor Katalysator, Bank 2" VALUE 0x810964 KwUb 255.0 dez 0.00 255.0 FORMAT "%5.1" /end CHARACTERISTIC
/begin CHARACTERISTIC TSFKAT "Fehlersummenzeit: Katalysator-Konvertierung" VALUE 0x810965 KwUb 255.0 dez 0.00 255.0 FORMAT "%5.1" /end CHARACTERISTIC
/begin CHARACTERISTIC TSFKPE "Fehlersummenzeit: EKP-Relais Endstufe" VALUE 0x810966 KwUb 255.0 dez 0.00 255.0 FORMAT "%5.1" /end CHARACTERISTIC
/begin CHARACTERISTIC TSFKRA01 "Fehlersummenzeit: Klopfregelanschlag Zylinder 1" VALUE 0x810967 KwUb 255.0 dez 0.00 255.0 FORMAT "%5.1" /end CHARACTERISTIC
/begin CHARACTERISTIC TSFKRA02 "Fehlersummenzeit: Klopfregelanschlag Zylinder 2" VALUE 0x810968 KwUb 255.0 dez 0.00 255.0 FORMAT "%5.1" /end CHARACTERISTIC
/begin CHARACTERISTIC TSFKRA03 "Fehlersummenzeit: Klopfregelanschlag Zylinder 3" VALUE 0x810969 KwUb 255.0 dez 0.00 255.0 FORMAT "%5.1" /end CHARACTERISTIC
/begin CHARACTERISTIC TSFKRA04 "Fehlersummenzeit: Klopfregelanschlag Zylinder 4" VALUE 0x81096A KwUb 255.0 dez 0.00 255.0 FORMAT "%5.1" /end CHARACTERISTIC
/begin CHARACTERISTIC TSFKRNT "Fehlersummenzeit: Klopfregelung Nulltest" VALUE 0x81096B KwUb 255.0 dez 0.00 255.0 FORMAT "%5.1" /end CHARACTERISTIC
/begin CHARACTERISTIC TSFKROF "Fehlersummenzeit: Klopfregelung Offset" VALUE 0x81096C KwUb 255.0 dez 0.00 255.0 FORMAT "%5.1" /end CHARACTERISTIC
/begin CHARACTERISTIC TSFKRTP "Fehlersummenzeit: Klopfregelung Testimpuls" VALUE 0x81096D KwUb 255.0 dez 0.00 255.0 FORMAT "%5.1" /end CHARACTERISTIC
/begin CHARACTERISTIC TSFKS1 "Fehlersummenzeit: Klopfsensor 1" VALUE 0x81096E KwUb 255.0 dez 0.00 255.0 FORMAT "%5.1" /end CHARACTERISTIC
/begin CHARACTERISTIC TSFKS2 "Fehlersummenzeit: Klopfsensor 2" VALUE 0x81096F KwUb 255.0 dez 0.00 255.0 FORMAT "%5.1" /end CHARACTERISTIC
/begin CHARACTERISTIC TSFKS3 "Fehlersummenzeit: Klopfsensor 3" VALUE 0x810970 KwUb 255.0 dez 0.00 255.0 FORMAT "%5.1" /end CHARACTERISTIC
/begin CHARACTERISTIC TSFKS4 "Fehlersummenzeit: Klopfsensor 4" VALUE 0x810971 KwUb 255.0 dez 0.00 255.0 FORMAT "%5.1" /end CHARACTERISTIC
/begin CHARACTERISTIC TSFLDE "Fehlersummenzeit: Ladedrucksteuerventil (Endstufe)" VALUE 0x810975 KwUb 255.0 dez 0.00 255.0 FORMAT "%5.1" /end CHARACTERISTIC
/begin CHARACTERISTIC TSFLM "Fehlersummenzeit: LMM/HLM/HFM" VALUE 0x81097D KwUb 255.0 dez 0.00 255.0 FORMAT "%5.1" /end CHARACTERISTIC
/begin CHARACTERISTIC TSFMILE "Fehlersummenzeit: MIL-Endstufe" VALUE 0x810987 KwUb 255.0 dez 0.00 255.0 FORMAT "%5.1" /end CHARACTERISTIC
/begin CHARACTERISTIC TSFN "Fehlersummenzeit: Drehzahlgeber" VALUE 0x810988 KwUb 255.0 dez 0.00 255.0 FORMAT "%5.1" /end CHARACTERISTIC
/begin CHARACTERISTIC TSFNWSE "Fehlersummenzeit: Nockenwellensteuerungsventil Endstufe" VALUE 0x81098A KwUb 255.0 dez 0.00 255.0 FORMAT "%5.1" /end CHARACTERISTIC
/begin CHARACTERISTIC TSFSLPE "Fehlersummenzeit: Sekundärluftpumpe (Endstufe)" VALUE 0x810992 KwUb 255.0 dez 0.00 255.0 FORMAT "%5.1" /end CHARACTERISTIC
/begin CHARACTERISTIC TSFSLVE "Fehlersummenzeit: Sekundärluftventil (Endstufe)" VALUE 0x810995 KwUb 255.0 dez 0.00 255.0 FORMAT "%5.1" /end CHARACTERISTIC
/begin CHARACTERISTIC TSFTEVE "Fehlersummenzeit: Tankentlüftungsventil Endstufe" VALUE 0x81099C KwUb 255.0 dez 0.00 255.0 FORMAT "%5.1" /end CHARACTERISTIC
/begin CHARACTERISTIC TSFUVSE "Fehlersummenzeit: Endstufe Umluftventil Turbo" VALUE 0x8109AA KwUb 255.0 dez 0.00 255.0 FORMAT "%5.1" /end CHARACTERISTIC
/begin CHARACTERISTIC TSFZET1 "" VALUE 0x8109AE KwUb 255.0 dez 0.00 255.0 FORMAT "%5.1" /end CHARACTERISTIC
/begin CHARACTERISTIC TSFZET2 "" VALUE 0x8109AF KwUb 255.0 dez 0.00 255.0 FORMAT "%5.1" /end CHARACTERISTIC
/begin CHARACTERISTIC TSFZET3 "" VALUE 0x8109B0 KwUb 255.0 dez 0.00 255.0 FORMAT "%5.1" /end CHARACTERISTIC
/begin CHARACTERISTIC TSFZET4 "" VALUE 0x8109B1 KwUb 255.0 dez 0.00 255.0 FORMAT "%5.1" /end CHARACTERISTIC
/begin CHARACTERISTIC TSFZZZ "Dummy: Tabellenende" VALUE 0x8109B2 KwUb 255.0 dez 0.00 255.0 FORMAT "%5.1" /end CHARACTERISTIC
/begin MEASUREMENT B_beaave "Bedingung Bandendeanforderung setzt Fehler Absperrventil Aktivkohlefilt Endstufe" UWORD B_TRUE 1 100 0 1 BIT_MASK 0x20 FORMAT "%13.11" ECU_ADDRESS 0x38390E /end MEASUREMENT
/begin MEASUREMENT B_beagre "Bedingung Bandende-Funktionsanforderung AGR-Endstufendiagnose" UWORD B_TRUE 1 100 0 1 BIT_MASK 0x20 FORMAT "%13.11" ECU_ADDRESS 0x383910 /end MEASUREMENT
/begin MEASUREMENT B_beatr "" UWORD B_TRUE 1 100 0 1 BIT_MASK 0x20 FORMAT "%13.11" ECU_ADDRESS 0x383914 /end MEASUREMENT
/begin MEASUREMENT B_beatr2 "" UWORD B_TRUE 1 100 0 1 BIT_MASK 0x20 FORMAT "%13.11" ECU_ADDRESS 0x383916 /end MEASUREMENT
/begin MEASUREMENT B_beatrd "" UWORD B_TRUE 1 100 0 1 BIT_MASK 0x20 FORMAT "%13.11" ECU_ADDRESS 0x383918 /end MEASUREMENT
/begin MEASUREMENT B_beatrd2 "" UWORD B_TRUE 1 100 0 1 BIT_MASK 0x20 FORMAT "%13.11" ECU_ADDRESS 0x38391A /end MEASUREMENT
/begin MEASUREMENT B_beats "Bedingung: Bandendefunktionanford. für Temperatursensor" UWORD B_TRUE 1 100 0 1 BIT_MASK 0x20 FORMAT "%13.11" ECU_ADDRESS 0x38391C /end MEASUREMENT
/begin MEASUREMENT B_bebkvp "Bedingung Bandende-Funktionsanforderung BKV-Pumpe" UWORD B_TRUE 1 100 0 1 BIT_MASK 0x20 FORMAT "%13.11" ECU_ADDRESS 0x38391E /end MEASUREMENT
/begin MEASUREMENT B_bebkvpe "Bedingung Bandende-Funktionsanforderung BKV-Pumpe Endstufe" UWORD B_TRUE 1 100 0 1 BIT_MASK 0x20 FORMAT "%13.11" ECU_ADDRESS 0x383920 /end MEASUREMENT
/begin MEASUREMENT B_bebm "Bedingung Bandende-Funktionsanforderung Bezugsmarke erkannt" UWORD B_TRUE 1 100 0 1 BIT_MASK 0x20 FORMAT "%13.11" ECU_ADDRESS 0x383922 /end MEASUREMENT
/begin MEASUREMENT B_becv "Bedingung Bandendetest Diagnose Kurbelgehäuseentlüftung" UWORD B_TRUE 1 100 0 1 BIT_MASK 0x20 FORMAT "%13.11" ECU_ADDRESS 0x38393A /end MEASUREMENT
/begin MEASUREMENT B_bedk "Bedingung Bandende-Funktionsanforderung Drosselklappe" UWORD B_TRUE 1 100 0 1 BIT_MASK 0x20 FORMAT "%13.11" ECU_ADDRESS 0x38393C /end MEASUREMENT
/begin MEASUREMENT B_bedk1p "" UWORD B_TRUE 1 100 0 1 BIT_MASK 0x20 FORMAT "%13.11" ECU_ADDRESS 0x38393E /end MEASUREMENT
/begin MEASUREMENT B_bedk2p "" UWORD B_TRUE 1 100 0 1 BIT_MASK 0x20 FORMAT "%13.11" ECU_ADDRESS 0x383940 /end MEASUREMENT
/begin MEASUREMENT B_bedvee "" UWORD B_TRUE 1 100 0 1 BIT_MASK 0x20 FORMAT "%13.11" ECU_ADDRESS 0x38394C /end MEASUREMENT
/begin MEASUREMENT B_bedvef "" UWORD B_TRUE 1 100 0 1 BIT_MASK 0x20 FORMAT "%13.11" ECU_ADDRESS 0x38394E /end MEASUREMENT
/begin MEASUREMENT B_bedvefo "" UWORD B_TRUE 1 100 0 1 BIT_MASK 0x20 FORMAT "%13.11" ECU_ADDRESS 0x383950 /end MEASUREMENT
/begin MEASUREMENT B_bedvel "" UWORD B_TRUE 1 100 0 1 BIT_MASK 0x20 FORMAT "%13.11" ECU_ADDRESS 0x383952 /end MEASUREMENT
/begin MEASUREMENT B_bedven "" UWORD B_TRUE 1 100 0 1 BIT_MASK 0x20 FORMAT "%13.11" ECU_ADDRESS 0x383954 /end MEASUREMENT
/begin MEASUREMENT B_bedver "" UWORD B_TRUE 1 100 0 1 BIT_MASK 0x20 FORMAT "%13.11" ECU_ADDRESS 0x383956 /end MEASUREMENT
/begin MEASUREMENT B_bedvet "" UWORD B_TRUE 1 100 0 1 BIT_MASK 0x20 FORMAT "%13.11" ECU_ADDRESS 0x383958 /end MEASUREMENT
/begin MEASUREMENT B_bedveu "" UWORD B_TRUE 1 100 0 1 BIT_MASK 0x20 FORMAT "%13.11" ECU_ADDRESS 0x38395A /end MEASUREMENT
/begin MEASUREMENT B_bedveub "" UWORD B_TRUE 1 100 0 1 BIT_MASK 0x20 FORMAT "%13.11" ECU_ADDRESS 0x38395C /end MEASUREMENT
/begin MEASUREMENT B_bedveuw "" UWORD B_TRUE 1 100 0 1 BIT_MASK 0x20 FORMAT "%13.11" ECU_ADDRESS 0x38395E /end MEASUREMENT
/begin MEASUREMENT B_bedvev "" UWORD B_TRUE 1 100 0 1 BIT_MASK 0x20 FORMAT "%13.11" ECU_ADDRESS 0x383960 /end MEASUREMENT
/begin MEASUREMENT B_beenws "Bedingung Bandende-Funktionsanforderung NWS (Einlass,Bank1)" UWORD B_TRUE 1 100 0 1 BIT_MASK 0x20 FORMAT "%13.11" ECU_ADDRESS 0x383966 /end MEASUREMENT
/begin MEASUREMENT B_beenwse "Bedingung Bandende-Funktionsanforderung NWS Endstufe (Bank1, Einlaß)" UWORD B_TRUE 1 100 0 1 BIT_MASK 0x20 FORMAT "%13.11" ECU_ADDRESS 0x383968 /end MEASUREMENT
/begin MEASUREMENT B_beepcle "" UWORD B_TRUE 1 100 0 1 BIT_MASK 0x20 FORMAT "%13.11" ECU_ADDRESS 0x38396A /end MEASUREMENT
/begin MEASUREMENT B_beev1 "Bedingung Bandendeanforderung  für Fehler Endstufe EV1" UWORD B_TRUE 1 100 0 1 BIT_MASK 0x20 FORMAT "%13.11" ECU_ADDRESS 0x38396C /end MEASUREMENT
/begin MEASUREMENT B_beev2 "Bedingung Bandendeanforderung  für Fehler Endstufe EV2" UWORD B_TRUE 1 100 0 1 BIT_MASK 0x20 FORMAT "%13.11" ECU_ADDRESS 0x38396E /end MEASUREMENT
/begin MEASUREMENT B_beev3 "Bedingung Bandendeanforderung  für Fehler Endstufe EV3" UWORD B_TRUE 1 100 0 1 BIT_MASK 0x20 FORMAT "%13.11" ECU_ADDRESS 0x383970 /end MEASUREMENT
/begin MEASUREMENT B_beev4 "Bedingung Bandendeanforderung  für Fehler Endstufe EV4" UWORD B_TRUE 1 100 0 1 BIT_MASK 0x20 FORMAT "%13.11" ECU_ADDRESS 0x383972 /end MEASUREMENT
/begin MEASUREMENT B_behsh "Bedingung: Bandendefunktionanford. für %DHLS" UWORD B_TRUE 1 100 0 1 BIT_MASK 0x20 FORMAT "%13.11" ECU_ADDRESS 0x383986 /end MEASUREMENT
/begin MEASUREMENT B_behsh2 "Bedingung: Bandendefunktionanford. für %DHLS Bank 2" UWORD B_TRUE 1 100 0 1 BIT_MASK 0x20 FORMAT "%13.11" ECU_ADDRESS 0x383988 /end MEASUREMENT
/begin MEASUREMENT B_behshe "Bedingung Bandende-Funktionsanforderung Endstufe Sondenheizung nach Kat" UWORD B_TRUE 1 100 0 1 BIT_MASK 0x20 FORMAT "%13.11" ECU_ADDRESS 0x38398A /end MEASUREMENT
/begin MEASUREMENT B_behsv "Bedingung: Bandendefunktionanford. für %DHRLSU" UWORD B_TRUE 1 100 0 1 BIT_MASK 0x20 FORMAT "%13.11" ECU_ADDRESS 0x38398C /end MEASUREMENT
/begin MEASUREMENT B_behsv2 "Bedingung: Bandendefunktionanford. für %DHRLSU, Bank 2" UWORD B_TRUE 1 100 0 1 BIT_MASK 0x20 FORMAT "%13.11" ECU_ADDRESS 0x38398E /end MEASUREMENT
/begin MEASUREMENT B_behsvsa "Bedingung: Bandendefunktionanford. für %DHLSU" UWORD B_TRUE 1 100 0 1 BIT_MASK 0x20 FORMAT "%13.11" ECU_ADDRESS 0x383990 /end MEASUREMENT
/begin MEASUREMENT B_behsvsa2 "Bedingung: Bandendefunktionanford. für %DHLSU, Bank 2" UWORD B_TRUE 1 100 0 1 BIT_MASK 0x20 FORMAT "%13.11" ECU_ADDRESS 0x383992 /end MEASUREMENT
/begin MEASUREMENT B_bekat "Bedingung Bandende-Funktionsanforderung Katalysatordiagnose" UWORD B_TRUE 1 100 0 1 BIT_MASK 0x20 FORMAT "%13.11" ECU_ADDRESS 0x383994 /end MEASUREMENT
/begin MEASUREMENT B_bekpe "Bedingung Bandendeanforderung für Fehler Endstufe EKP" UWORD B_TRUE 1 100 0 1 BIT_MASK 0x20 FORMAT "%13.11" ECU_ADDRESS 0x383996 /end MEASUREMENT
/begin MEASUREMENT B_bekrnt "Bedingung Bandende-Funktionsanforderung Klopfregelung Diagnose Nulltest" UWORD B_TRUE 1 100 0 1 BIT_MASK 0x20 FORMAT "%13.11" ECU_ADDRESS 0x3839A0 /end MEASUREMENT
/begin MEASUREMENT B_bekrof "Bedingung Bandende-Funktionsanforderung Klopfregelung Diagnose Integrator Offset" UWORD B_TRUE 1 100 0 1 BIT_MASK 0x20 FORMAT "%13.11" ECU_ADDRESS 0x3839A2 /end MEASUREMENT
/begin MEASUREMENT B_bekrtp "Bedingung Bandende-Funktionsanforderung Klopfregelung Diagnose Testpuls" UWORD B_TRUE 1 100 0 1 BIT_MASK 0x20 FORMAT "%13.11" ECU_ADDRESS 0x3839A4 /end MEASUREMENT
/begin MEASUREMENT B_beks1 "Bedingung Bandende-Funktionsanforderung Diagnose Klopfsensor 1" UWORD B_TRUE 1 100 0 1 BIT_MASK 0x20 FORMAT "%13.11" ECU_ADDRESS 0x3839A6 /end MEASUREMENT
/begin MEASUREMENT B_beks2 "Bedingung Bandende-Funktionsanforderung Diagnose Klopfsensor 2" UWORD B_TRUE 1 100 0 1 BIT_MASK 0x20 FORMAT "%13.11" ECU_ADDRESS 0x3839A8 /end MEASUREMENT
/begin MEASUREMENT B_beks3 "Bedingung Bandende-Funktionsanforderung Diagnose Klopfsensor 3" UWORD B_TRUE 1 100 0 1 BIT_MASK 0x20 FORMAT "%13.11" ECU_ADDRESS 0x3839AA /end MEASUREMENT
/begin MEASUREMENT B_beks4 "Bedingung Bandende-Funktionsanforderung Diagnose Klopfsensor 1" UWORD B_TRUE 1 100 0 1 BIT_MASK 0x20 FORMAT "%13.11" ECU_ADDRESS 0x3839AC /end MEASUREMENT
/begin MEASUREMENT B_belde "Bedingung: Fehlereintrag  LDR-Taktventil (Bandende)" UWORD B_TRUE 1 100 0 1 BIT_MASK 0x20 FORMAT "%13.11" ECU_ADDRESS 0x3839B4 /end MEASUREMENT
/begin MEASUREMENT B_belm "Bedingung Bandende-Funktionsanforderung Luftmassensensor (HFM/DSS)" UWORD B_TRUE 1 100 0 1 BIT_MASK 0x20 FORMAT "%13.11" ECU_ADDRESS 0x3839C4 /end MEASUREMENT
/begin MEASUREMENT B_bemile "Bedingung Bandende-Funktionsanforderung Endstufe Fehlerlampe" UWORD B_TRUE 1 100 0 1 BIT_MASK 0x20 FORMAT "%13.11" ECU_ADDRESS 0x3839D8 /end MEASUREMENT
/begin MEASUREMENT B_ben "" UWORD B_TRUE 1 100 0 1 BIT_MASK 0x20 FORMAT "%13.11" ECU_ADDRESS 0x3839DA /end MEASUREMENT
/begin MEASUREMENT B_benwse "Bedingung Bandende-Funktionsanforderung NWS" UWORD B_TRUE 1 100 0 1 BIT_MASK 0x20 FORMAT "%13.11" ECU_ADDRESS 0x3839DE /end MEASUREMENT
/begin MEASUREMENT B_beslpe "Bedingung Bandendeanforderung setzt Fehler Sekundärluftpumpe Endstufe" UWORD B_TRUE 1 100 0 1 BIT_MASK 0x20 FORMAT "%13.11" ECU_ADDRESS 0x3839EE /end MEASUREMENT
/begin MEASUREMENT B_beslve "Bedingung Bandendeanforderung setzt Fehler Sekundärluftventil Endstufe" UWORD B_TRUE 1 100 0 1 BIT_MASK 0x20 FORMAT "%13.11" ECU_ADDRESS 0x3839F4 /end MEASUREMENT
/begin MEASUREMENT B_beteve "Bedingung Bandendeanford. für Fehler Tanentlüftungsventil Endstufe" UWORD B_TRUE 1 100 0 1 BIT_MASK 0x20 FORMAT "%13.11" ECU_ADDRESS 0x383A02 /end MEASUREMENT
/begin MEASUREMENT B_beuvse "Bedingung: Fehlereintrag  Umluftventil turbo (Bandende)" UWORD B_TRUE 1 100 0 1 BIT_MASK 0x20 FORMAT "%13.11" ECU_ADDRESS 0x383A1E /end MEASUREMENT
/begin MEASUREMENT B_bezet1 "" UWORD B_TRUE 1 100 0 1 BIT_MASK 0x20 FORMAT "%13.11" ECU_ADDRESS 0x383A26 /end MEASUREMENT
/begin MEASUREMENT B_bezet2 "" UWORD B_TRUE 1 100 0 1 BIT_MASK 0x20 FORMAT "%13.11" ECU_ADDRESS 0x383A28 /end MEASUREMENT
/begin MEASUREMENT B_bezet3 "" UWORD B_TRUE 1 100 0 1 BIT_MASK 0x20 FORMAT "%13.11" ECU_ADDRESS 0x383A2A /end MEASUREMENT
/begin MEASUREMENT B_bezet4 "" UWORD B_TRUE 1 100 0 1 BIT_MASK 0x20 FORMAT "%13.11" ECU_ADDRESS 0x383A2C /end MEASUREMENT
/begin MEASUREMENT B_bkaave "Bedingung Ersatzwert aktiv Tankdiagnose, AAVE-Ventil Endstufe" UWORD B_TRUE 1 100 0 1 BIT_MASK 0x40 FORMAT "%13.11" ECU_ADDRESS 0x38390E /end MEASUREMENT
/begin MEASUREMENT B_bkagre "Bedingung: Abgasrückführungsventil Endstufe" UWORD B_TRUE 1 100 0 1 BIT_MASK 0x40 FORMAT "%13.11" ECU_ADDRESS 0x383910 /end MEASUREMENT
/begin MEASUREMENT B_bkatr "Bedingung Ersatzwert aktiv Abgastemperaturregelung" UWORD B_TRUE 1 100 0 1 BIT_MASK 0x40 FORMAT "%13.11" ECU_ADDRESS 0x383914 /end MEASUREMENT
/begin MEASUREMENT B_bkatr2 "Bedingung Ersatzwert aktiv Abgastemperaturregelung Bank 2" UWORD B_TRUE 1 100 0 1 BIT_MASK 0x40 FORMAT "%13.11" ECU_ADDRESS 0x383916 /end MEASUREMENT
/begin MEASUREMENT B_bkatrd "" UWORD B_TRUE 1 100 0 1 BIT_MASK 0x40 FORMAT "%13.11" ECU_ADDRESS 0x383918 /end MEASUREMENT
/begin MEASUREMENT B_bkatrd2 "" UWORD B_TRUE 1 100 0 1 BIT_MASK 0x40 FORMAT "%13.11" ECU_ADDRESS 0x38391A /end MEASUREMENT
/begin MEASUREMENT B_bkats "Bedingung Ersatzwert aktiv Abgastemperatursensor" UWORD B_TRUE 1 100 0 1 BIT_MASK 0x40 FORMAT "%13.11" ECU_ADDRESS 0x38391C /end MEASUREMENT
/begin MEASUREMENT B_bkbkvp "Bedingung Ersatzwert aktiv: BKV-Pumpe" UWORD B_TRUE 1 100 0 1 BIT_MASK 0x40 FORMAT "%13.11" ECU_ADDRESS 0x38391E /end MEASUREMENT
/begin MEASUREMENT B_bkbkvpe "Bedingung: Bremskraftverstärker-Pumpe-Endstufe aktiv" UWORD B_TRUE 1 100 0 1 BIT_MASK 0x40 FORMAT "%13.11" ECU_ADDRESS 0x383920 /end MEASUREMENT
/begin MEASUREMENT B_bkbm "Bedingung Ersatzwert aktiv: Bezugsmarke" UWORD B_TRUE 1 100 0 1 BIT_MASK 0x40 FORMAT "%13.11" ECU_ADDRESS 0x383922 /end MEASUREMENT
/begin MEASUREMENT B_bkcv "Backup-Bit Diagnose Kurbelgehäuseentlüftung" UWORD B_TRUE 1 100 0 1 BIT_MASK 0x40 FORMAT "%13.11" ECU_ADDRESS 0x38393A /end MEASUREMENT
/begin MEASUREMENT B_bkdk "Bedingung Eratzwert aktiv: Fehler Drosselklappenpoti löschen" UWORD B_TRUE 1 100 0 1 BIT_MASK 0x40 FORMAT "%13.11" ECU_ADDRESS 0x38393C /end MEASUREMENT
/begin MEASUREMENT B_bkdk1p "Bedingung Ersatzwert aktiv: Drosselklappe 1.Poti" UWORD B_TRUE 1 100 0 1 BIT_MASK 0x40 FORMAT "%13.11" ECU_ADDRESS 0x38393E /end MEASUREMENT
/begin MEASUREMENT B_bkdk2p "Bedingung Ersatzwert aktiv: Drosselklappe 2.Poti" UWORD B_TRUE 1 100 0 1 BIT_MASK 0x40 FORMAT "%13.11" ECU_ADDRESS 0x383940 /end MEASUREMENT
/begin MEASUREMENT B_bkdvee "Bedingung: DV-E Endstufe" UWORD B_TRUE 1 100 0 1 BIT_MASK 0x40 FORMAT "%13.11" ECU_ADDRESS 0x38394C /end MEASUREMENT
/begin MEASUREMENT B_bkdvef "Bedingung: DV-E Fehler bei Federprüfung" UWORD B_TRUE 1 100 0 1 BIT_MASK 0x40 FORMAT "%13.11" ECU_ADDRESS 0x38394E /end MEASUREMENT
/begin MEASUREMENT B_bkdvefo "" UWORD B_TRUE 1 100 0 1 BIT_MASK 0x40 FORMAT "%13.11" ECU_ADDRESS 0x383950 /end MEASUREMENT
/begin MEASUREMENT B_bkdvel "Bedingung: DV-E Lageabweichung" UWORD B_TRUE 1 100 0 1 BIT_MASK 0x40 FORMAT "%13.11" ECU_ADDRESS 0x383952 /end MEASUREMENT
/begin MEASUREMENT B_bkdven "Ersatzwert aktiv: DV-E Notluftposition" UWORD B_TRUE 1 100 0 1 BIT_MASK 0x40 FORMAT "%13.11" ECU_ADDRESS 0x383954 /end MEASUREMENT
/begin MEASUREMENT B_bkdver "Bedingung: DV-E Regelbereich" UWORD B_TRUE 1 100 0 1 BIT_MASK 0x40 FORMAT "%13.11" ECU_ADDRESS 0x383956 /end MEASUREMENT
/begin MEASUREMENT B_bkdvet "" UWORD B_TRUE 1 100 0 1 BIT_MASK 0x40 FORMAT "%13.11" ECU_ADDRESS 0x383958 /end MEASUREMENT
/begin MEASUREMENT B_bkdveu "Ersatzwert aktiv: DV-E UMA-Lernen" UWORD B_TRUE 1 100 0 1 BIT_MASK 0x40 FORMAT "%13.11" ECU_ADDRESS 0x38395A /end MEASUREMENT
/begin MEASUREMENT B_bkdveub "" UWORD B_TRUE 1 100 0 1 BIT_MASK 0x40 FORMAT "%13.11" ECU_ADDRESS 0x38395C /end MEASUREMENT
/begin MEASUREMENT B_bkdveuw "Bedingung Ersatzwert aktiv: Fehler bei UMA-Wiederlernen" UWORD B_TRUE 1 100 0 1 BIT_MASK 0x40 FORMAT "%13.11" ECU_ADDRESS 0x38395E /end MEASUREMENT
/begin MEASUREMENT B_bkdvev "Ersatzwert aktiv: DV-E Verstärkerabgleich" UWORD B_TRUE 1 100 0 1 BIT_MASK 0x40 FORMAT "%13.11" ECU_ADDRESS 0x383960 /end MEASUREMENT
/begin MEASUREMENT B_bkenws "Bedingung Ersatzwert aktiv: NWS (Einlass,Bank1)" UWORD B_TRUE 1 100 0 1 BIT_MASK 0x40 FORMAT "%13.11" ECU_ADDRESS 0x383966 /end MEASUREMENT
/begin MEASUREMENT B_bkenwse "Bedingung Ersatzwert aktiv: NWS Endstufe (Bank1, Einlaß)" UWORD B_TRUE 1 100 0 1 BIT_MASK 0x40 FORMAT "%13.11" ECU_ADDRESS 0x383968 /end MEASUREMENT
/begin MEASUREMENT B_bkepcle "Bedingung: Fahrverhaltens-Fehllampe Endstufe" UWORD B_TRUE 1 100 0 1 BIT_MASK 0x40 FORMAT "%13.11" ECU_ADDRESS 0x38396A /end MEASUREMENT
/begin MEASUREMENT B_bkev1 "Bedingung: Einspritzventil 1 aktiv" UWORD B_TRUE 1 100 0 1 BIT_MASK 0x40 FORMAT "%13.11" ECU_ADDRESS 0x38396C /end MEASUREMENT
/begin MEASUREMENT B_bkev2 "Bedingung: Einspritzventil 2 aktiv" UWORD B_TRUE 1 100 0 1 BIT_MASK 0x40 FORMAT "%13.11" ECU_ADDRESS 0x38396E /end MEASUREMENT
/begin MEASUREMENT B_bkev3 "Bedingung: Einspritzventil 3 aktiv" UWORD B_TRUE 1 100 0 1 BIT_MASK 0x40 FORMAT "%13.11" ECU_ADDRESS 0x383970 /end MEASUREMENT
/begin MEASUREMENT B_bkev4 "Bedingung: Einspritzventil 4 aktiv" UWORD B_TRUE 1 100 0 1 BIT_MASK 0x40 FORMAT "%13.11" ECU_ADDRESS 0x383972 /end MEASUREMENT
/begin MEASUREMENT B_bkhsh "Bedingung: Lambdasondenheizung hinter Kat. aktiv" UWORD B_TRUE 1 100 0 1 BIT_MASK 0x40 FORMAT "%13.11" ECU_ADDRESS 0x383986 /end MEASUREMENT
/begin MEASUREMENT B_bkhsh2 "Bedingung: Lambdasondenheizung hinter Kat. aktiv, Bank 2" UWORD B_TRUE 1 100 0 1 BIT_MASK 0x40 FORMAT "%13.11" ECU_ADDRESS 0x383988 /end MEASUREMENT
/begin MEASUREMENT B_bkhshe "Bedingung: Lambdasondenheizung hinter Kat. Endstufe" UWORD B_TRUE 1 100 0 1 BIT_MASK 0x40 FORMAT "%13.11" ECU_ADDRESS 0x38398A /end MEASUREMENT
/begin MEASUREMENT B_bkhsv "Bedingung:Lambdasondenheizung vor Kat. aktiv" UWORD B_TRUE 1 100 0 1 BIT_MASK 0x40 FORMAT "%13.11" ECU_ADDRESS 0x38398C /end MEASUREMENT
/begin MEASUREMENT B_bkhsv2 "Bedingung:Lambdasondenheizung vor Kat. aktiv, Bank 2" UWORD B_TRUE 1 100 0 1 BIT_MASK 0x40 FORMAT "%13.11" ECU_ADDRESS 0x38398E /end MEASUREMENT
/begin MEASUREMENT B_bkhsvsa "Bedingung:Lambdasondenheizung vor Kat. aktiv" UWORD B_TRUE 1 100 0 1 BIT_MASK 0x40 FORMAT "%13.11" ECU_ADDRESS 0x383990 /end MEASUREMENT
/begin MEASUREMENT B_bkhsvsa2 "Bedingung:Lambdasondenheizung vor Kat. aktiv, Bank 2" UWORD B_TRUE 1 100 0 1 BIT_MASK 0x40 FORMAT "%13.11" ECU_ADDRESS 0x383992 /end MEASUREMENT
/begin MEASUREMENT B_bkkat "Bedingung Ersatzwert für Katalysator" UWORD B_TRUE 1 100 0 1 BIT_MASK 0x40 FORMAT "%13.11" ECU_ADDRESS 0x383994 /end MEASUREMENT
/begin MEASUREMENT B_bkkpe "Bedingung Ersatzwert für EKP-Relais Endstufe" UWORD B_TRUE 1 100 0 1 BIT_MASK 0x40 FORMAT "%13.11" ECU_ADDRESS 0x383996 /end MEASUREMENT
/begin MEASUREMENT B_bkkrnt "Bedingung: Klopfregelung Nulltest aktiv" UWORD B_TRUE 1 100 0 1 BIT_MASK 0x40 FORMAT "%13.11" ECU_ADDRESS 0x3839A0 /end MEASUREMENT
/begin MEASUREMENT B_bkkrof "Bedingung: Klopfregelung Offset aktiv" UWORD B_TRUE 1 100 0 1 BIT_MASK 0x40 FORMAT "%13.11" ECU_ADDRESS 0x3839A2 /end MEASUREMENT
/begin MEASUREMENT B_bkkrtp "Bedingung: Klopfregelung Testimpuls aktiv" UWORD B_TRUE 1 100 0 1 BIT_MASK 0x40 FORMAT "%13.11" ECU_ADDRESS 0x3839A4 /end MEASUREMENT
/begin MEASUREMENT B_bkks1 "Bedingung: Klopfsensor 1 aktiv" UWORD B_TRUE 1 100 0 1 BIT_MASK 0x40 FORMAT "%13.11" ECU_ADDRESS 0x3839A6 /end MEASUREMENT
/begin MEASUREMENT B_bkks2 "Bedingung: Klopfsensor 2 aktiv" UWORD B_TRUE 1 100 0 1 BIT_MASK 0x40 FORMAT "%13.11" ECU_ADDRESS 0x3839A8 /end MEASUREMENT
/begin MEASUREMENT B_bkks3 "Bedingung: Klopfsensor 3 aktiv" UWORD B_TRUE 1 100 0 1 BIT_MASK 0x40 FORMAT "%13.11" ECU_ADDRESS 0x3839AA /end MEASUREMENT
/begin MEASUREMENT B_bkks4 "Bedingung: Klopfsensor 4 aktiv" UWORD B_TRUE 1 100 0 1 BIT_MASK 0x40 FORMAT "%13.11" ECU_ADDRESS 0x3839AC /end MEASUREMENT
/begin MEASUREMENT B_bklde "Bedingung: Ladedrucksteuerventil Endstufe aktiv" UWORD B_TRUE 1 100 0 1 BIT_MASK 0x40 FORMAT "%13.11" ECU_ADDRESS 0x3839B4 /end MEASUREMENT
/begin MEASUREMENT B_bklm "Bedingung: Hauptlastsensor aktiv" UWORD B_TRUE 1 100 0 1 BIT_MASK 0x40 FORMAT "%13.11" ECU_ADDRESS 0x3839C4 /end MEASUREMENT
/begin MEASUREMENT B_bkmile "Bedingung: MIL-Endstufe aktiv" UWORD B_TRUE 1 100 0 1 BIT_MASK 0x40 FORMAT "%13.11" ECU_ADDRESS 0x3839D8 /end MEASUREMENT
/begin MEASUREMENT B_bkn "Bedingung: Drehzahlsignalgeber aktiv" UWORD B_TRUE 1 100 0 1 BIT_MASK 0x40 FORMAT "%13.11" ECU_ADDRESS 0x3839DA /end MEASUREMENT
/begin MEASUREMENT B_bknwse "Bedingung: Nockenwellensteuerung Endstufe aktiv" UWORD B_TRUE 1 100 0 1 BIT_MASK 0x40 FORMAT "%13.11" ECU_ADDRESS 0x3839DE /end MEASUREMENT
/begin MEASUREMENT B_bkslpe "Bedingung: Sekundärluftpumpe ( Endstufe) aktiv" UWORD B_TRUE 1 100 0 1 BIT_MASK 0x40 FORMAT "%13.11" ECU_ADDRESS 0x3839EE /end MEASUREMENT
/begin MEASUREMENT B_bkslve "Bedingung: Sekundärluftventil Endstufe" UWORD B_TRUE 1 100 0 1 BIT_MASK 0x40 FORMAT "%13.11" ECU_ADDRESS 0x3839F4 /end MEASUREMENT
/begin MEASUREMENT B_bkteve "Bedingung: Tankentlüftungsventil Endstufe aktiv" UWORD B_TRUE 1 100 0 1 BIT_MASK 0x40 FORMAT "%13.11" ECU_ADDRESS 0x383A02 /end MEASUREMENT
/begin MEASUREMENT B_bkuvse "Bedingung: Endstufe Umluftventil Turbo aktiv" UWORD B_TRUE 1 100 0 1 BIT_MASK 0x40 FORMAT "%13.11" ECU_ADDRESS 0x383A1E /end MEASUREMENT
/begin MEASUREMENT B_bkzet1 "" UWORD B_TRUE 1 100 0 1 BIT_MASK 0x40 FORMAT "%13.11" ECU_ADDRESS 0x383A26 /end MEASUREMENT
/begin MEASUREMENT B_bkzet2 "" UWORD B_TRUE 1 100 0 1 BIT_MASK 0x40 FORMAT "%13.11" ECU_ADDRESS 0x383A28 /end MEASUREMENT
/begin MEASUREMENT B_bkzet3 "" UWORD B_TRUE 1 100 0 1 BIT_MASK 0x40 FORMAT "%13.11" ECU_ADDRESS 0x383A2A /end MEASUREMENT
/begin MEASUREMENT B_bkzet4 "" UWORD B_TRUE 1 100 0 1 BIT_MASK 0x40 FORMAT "%13.11" ECU_ADDRESS 0x383A2C /end MEASUREMENT
/begin MEASUREMENT B_claave "Bedingung Fehlerpfad AAVE löschen" UWORD B_TRUE 1 100 0 1 BIT_MASK 0x80 FORMAT "%13.11" ECU_ADDRESS 0x38390E /end MEASUREMENT
/begin MEASUREMENT B_clagre "Bedingung Fehlerpfad AGR-Endstufe löschen" UWORD B_TRUE 1 100 0 1 BIT_MASK 0x80 FORMAT "%13.11" ECU_ADDRESS 0x383910 /end MEASUREMENT
/begin MEASUREMENT B_clatr "Bedingung: Fehler Abgastemperaturregelung löschen" UWORD B_TRUE 1 100 0 1 BIT_MASK 0x80 FORMAT "%13.11" ECU_ADDRESS 0x383914 /end MEASUREMENT
/begin MEASUREMENT B_clatr2 "Bedingung: Fehler Abgastemperaturregelung Bank 2 löschen" UWORD B_TRUE 1 100 0 1 BIT_MASK 0x80 FORMAT "%13.11" ECU_ADDRESS 0x383916 /end MEASUREMENT
/begin MEASUREMENT B_clatrd "" UWORD B_TRUE 1 100 0 1 BIT_MASK 0x80 FORMAT "%13.11" ECU_ADDRESS 0x383918 /end MEASUREMENT
/begin MEASUREMENT B_clatrd2 "" UWORD B_TRUE 1 100 0 1 BIT_MASK 0x80 FORMAT "%13.11" ECU_ADDRESS 0x38391A /end MEASUREMENT
/begin MEASUREMENT B_clats "Bedingung: Fehler Abgastemperatursensor löschen" UWORD B_TRUE 1 100 0 1 BIT_MASK 0x80 FORMAT "%13.11" ECU_ADDRESS 0x38391C /end MEASUREMENT
/begin MEASUREMENT B_clbkvp "Bedingung: Fehlerpfad Bremskraftverstärker-Pumpe löschen" UWORD B_TRUE 1 100 0 1 BIT_MASK 0x80 FORMAT "%13.11" ECU_ADDRESS 0x38391E /end MEASUREMENT
/begin MEASUREMENT B_clbkvpe "Bedingung Fehlerpfad Bremskraftverstärker-Pumpe-Endstufe löschen" UWORD B_TRUE 1 100 0 1 BIT_MASK 0x80 FORMAT "%13.11" ECU_ADDRESS 0x383920 /end MEASUREMENT
/begin MEASUREMENT B_clbm "Bedingung Fehlerpfad Bezugsmarkengeber löschen" UWORD B_TRUE 1 100 0 1 BIT_MASK 0x80 FORMAT "%13.11" ECU_ADDRESS 0x383922 /end MEASUREMENT
/begin MEASUREMENT B_clcv "Bedingung Fehlerpfad E_cv löschen" UWORD B_TRUE 1 100 0 1 BIT_MASK 0x80 FORMAT "%13.11" ECU_ADDRESS 0x38393A /end MEASUREMENT
/begin MEASUREMENT B_cldk "Bedingung Fehlerpfad DK (Drosselklappen-Poti) löschen" UWORD B_TRUE 1 100 0 1 BIT_MASK 0x80 FORMAT "%13.11" ECU_ADDRESS 0x38393C /end MEASUREMENT
/begin MEASUREMENT B_cldk1p "Bedingung Fehlerpfad DK1P (Drosselklappen-Poti 1) löschen" UWORD B_TRUE 1 100 0 1 BIT_MASK 0x80 FORMAT "%13.11" ECU_ADDRESS 0x38393E /end MEASUREMENT
/begin MEASUREMENT B_cldk2p "Bedingung Fehlerpfad DK2P (Drosselklappen-Poti 2) löschen" UWORD B_TRUE 1 100 0 1 BIT_MASK 0x80 FORMAT "%13.11" ECU_ADDRESS 0x383940 /end MEASUREMENT
/begin MEASUREMENT B_cldvee "Flag für Löschmaßnahmen: DV-E Endstufe" UWORD B_TRUE 1 100 0 1 BIT_MASK 0x80 FORMAT "%13.11" ECU_ADDRESS 0x38394C /end MEASUREMENT
/begin MEASUREMENT B_cldvef "Flag für Löschung: DV-E Fehler bei Federprüfung" UWORD B_TRUE 1 100 0 1 BIT_MASK 0x80 FORMAT "%13.11" ECU_ADDRESS 0x38394E /end MEASUREMENT
/begin MEASUREMENT B_cldvefo "Flag für Löschung: Fehler bei Federprüfung ""Öffnen""" UWORD B_TRUE 1 100 0 1 BIT_MASK 0x80 FORMAT "%13.11" ECU_ADDRESS 0x383950 /end MEASUREMENT
/begin MEASUREMENT B_cldvel "Flag für Löschmaßnahmen: DV-E Lageabweichung" UWORD B_TRUE 1 100 0 1 BIT_MASK 0x80 FORMAT "%13.11" ECU_ADDRESS 0x383952 /end MEASUREMENT
/begin MEASUREMENT B_cldven "Flag für Löschung: DV-E Fehler bei Prüfung Notluftposition" UWORD B_TRUE 1 100 0 1 BIT_MASK 0x80 FORMAT "%13.11" ECU_ADDRESS 0x383954 /end MEASUREMENT
/begin MEASUREMENT B_cldver "Flag für Löschmaßnahmen: DV-E Regelabweichung" UWORD B_TRUE 1 100 0 1 BIT_MASK 0x80 FORMAT "%13.11" ECU_ADDRESS 0x383956 /end MEASUREMENT
/begin MEASUREMENT B_cldvet "Flag für Löschung: DV-E-Tauscherkennung ohne Adaption" UWORD B_TRUE 1 100 0 1 BIT_MASK 0x80 FORMAT "%13.11" ECU_ADDRESS 0x383958 /end MEASUREMENT
/begin MEASUREMENT B_cldveu "Flag für Löschung: DV-E Fehler beim UMA-Lernen" UWORD B_TRUE 1 100 0 1 BIT_MASK 0x80 FORMAT "%13.11" ECU_ADDRESS 0x38395A /end MEASUREMENT
/begin MEASUREMENT B_cldveub "Flag für Löschung: DV-E-Adaption Abbruch wg. Umweltbedingung" UWORD B_TRUE 1 100 0 1 BIT_MASK 0x80 FORMAT "%13.11" ECU_ADDRESS 0x38395C /end MEASUREMENT
/begin MEASUREMENT B_cldveuw "Flag für Löschung: Fehler bei UMA-Wiederlernen" UWORD B_TRUE 1 100 0 1 BIT_MASK 0x80 FORMAT "%13.11" ECU_ADDRESS 0x38395E /end MEASUREMENT
/begin MEASUREMENT B_cldvev "Flag für Löschung: DV-E Fehler bei Verstärkerabgleich" UWORD B_TRUE 1 100 0 1 BIT_MASK 0x80 FORMAT "%13.11" ECU_ADDRESS 0x383960 /end MEASUREMENT
/begin MEASUREMENT B_clenws "Bedingung Fehlerpfad Nockenwellensteuerung (Einlaß,Bank1) löschen" UWORD B_TRUE 1 100 0 1 BIT_MASK 0x80 FORMAT "%13.11" ECU_ADDRESS 0x383966 /end MEASUREMENT
/begin MEASUREMENT B_clenwse "Bedingung Fehlerpfad Nockenwellensteuerung Endstufe löschen (Bank1,Einlaß)" UWORD B_TRUE 1 100 0 1 BIT_MASK 0x80 FORMAT "%13.11" ECU_ADDRESS 0x383968 /end MEASUREMENT
/begin MEASUREMENT B_clepcle "Bedingung Fehlerpfad EPCL-Endstufe löschen" UWORD B_TRUE 1 100 0 1 BIT_MASK 0x80 FORMAT "%13.11" ECU_ADDRESS 0x38396A /end MEASUREMENT
/begin MEASUREMENT B_clev1 "Bedingung Fehlerpfad EV 1 löschen" UWORD B_TRUE 1 100 0 1 BIT_MASK 0x80 FORMAT "%13.11" ECU_ADDRESS 0x38396C /end MEASUREMENT
/begin MEASUREMENT B_clev2 "Bedingung Fehlerpfad EV 2 löschen" UWORD B_TRUE 1 100 0 1 BIT_MASK 0x80 FORMAT "%13.11" ECU_ADDRESS 0x38396E /end MEASUREMENT
/begin MEASUREMENT B_clev3 "Bedingung Fehlerpfad EV 3 löschen" UWORD B_TRUE 1 100 0 1 BIT_MASK 0x80 FORMAT "%13.11" ECU_ADDRESS 0x383970 /end MEASUREMENT
/begin MEASUREMENT B_clev4 "Bedingung Fehlerpfad EV 4 löschen" UWORD B_TRUE 1 100 0 1 BIT_MASK 0x80 FORMAT "%13.11" ECU_ADDRESS 0x383972 /end MEASUREMENT
/begin MEASUREMENT B_clhsh "Bedingung Fehlerpfad DHLSHK löschen" UWORD B_TRUE 1 100 0 1 BIT_MASK 0x80 FORMAT "%13.11" ECU_ADDRESS 0x383986 /end MEASUREMENT
/begin MEASUREMENT B_clhsh2 "Bedingung Fehlerpfad DHLSHK2 löschen" UWORD B_TRUE 1 100 0 1 BIT_MASK 0x80 FORMAT "%13.11" ECU_ADDRESS 0x383988 /end MEASUREMENT
/begin MEASUREMENT B_clhshe "Bedingung Fehlerpfad DHLSHK löschen (Endstufe)" UWORD B_TRUE 1 100 0 1 BIT_MASK 0x80 FORMAT "%13.11" ECU_ADDRESS 0x38398A /end MEASUREMENT
/begin MEASUREMENT B_clhsv "Bedingung Fehlerpfad DHLSVK löschen" UWORD B_TRUE 1 100 0 1 BIT_MASK 0x80 FORMAT "%13.11" ECU_ADDRESS 0x38398C /end MEASUREMENT
/begin MEASUREMENT B_clhsv2 "Bedingung Fehlerpfad DHLSVK2 löschen" UWORD B_TRUE 1 100 0 1 BIT_MASK 0x80 FORMAT "%13.11" ECU_ADDRESS 0x38398E /end MEASUREMENT
/begin MEASUREMENT B_clhsvsa "Bedingung Fehlerpfad DHLSUSA löschen" UWORD B_TRUE 1 100 0 1 BIT_MASK 0x80 FORMAT "%13.11" ECU_ADDRESS 0x383990 /end MEASUREMENT
/begin MEASUREMENT B_clhsvsa2 "Bedingung Fehlerpfad DHLSUSA2 löschen" UWORD B_TRUE 1 100 0 1 BIT_MASK 0x80 FORMAT "%13.11" ECU_ADDRESS 0x383992 /end MEASUREMENT
/begin MEASUREMENT B_clkat "Bedingung Fehlerpfad DKAT löschen" UWORD B_TRUE 1 100 0 1 BIT_MASK 0x80 FORMAT "%13.11" ECU_ADDRESS 0x383994 /end MEASUREMENT
/begin MEASUREMENT B_clkpe "Bedingung Fehlerpfad EKP-Relais Endstufe löschen" UWORD B_TRUE 1 100 0 1 BIT_MASK 0x80 FORMAT "%13.11" ECU_ADDRESS 0x383996 /end MEASUREMENT
/begin MEASUREMENT B_clkra01 "Bedingung Fehlerpfad Klopfregelanschlag Zylinder 1 löschen" UWORD B_TRUE 1 100 0 1 BIT_MASK 0x80 FORMAT "%13.11" ECU_ADDRESS 0x383998 /end MEASUREMENT
/begin MEASUREMENT B_clkra02 "Bedingung Fehlerpfad Klopfregelanschlag Zylinder 2 löschen" UWORD B_TRUE 1 100 0 1 BIT_MASK 0x80 FORMAT "%13.11" ECU_ADDRESS 0x38399A /end MEASUREMENT
/begin MEASUREMENT B_clkra03 "Bedingung Fehlerpfad Klopfregelanschlag Zylinder 3 löschen" UWORD B_TRUE 1 100 0 1 BIT_MASK 0x80 FORMAT "%13.11" ECU_ADDRESS 0x38399C /end MEASUREMENT
/begin MEASUREMENT B_clkra04 "Bedingung Fehlerpfad Klopfregelanschlag Zylinder 4 löschen" UWORD B_TRUE 1 100 0 1 BIT_MASK 0x80 FORMAT "%13.11" ECU_ADDRESS 0x38399E /end MEASUREMENT
/begin MEASUREMENT B_clkrnt "Bedingung Fehlerpfad KR-Diagnose Integratorsteigung löschen" UWORD B_TRUE 1 100 0 1 BIT_MASK 0x80 FORMAT "%13.11" ECU_ADDRESS 0x3839A0 /end MEASUREMENT
/begin MEASUREMENT B_clkrof "Bedingung Fehlerpfad KR-Diagnose Resetwert löschen" UWORD B_TRUE 1 100 0 1 BIT_MASK 0x80 FORMAT "%13.11" ECU_ADDRESS 0x3839A2 /end MEASUREMENT
/begin MEASUREMENT B_clkrtp "Bedingung Fehlerpfad KR-Diagnose Testimpuls löschen" UWORD B_TRUE 1 100 0 1 BIT_MASK 0x80 FORMAT "%13.11" ECU_ADDRESS 0x3839A4 /end MEASUREMENT
/begin MEASUREMENT B_clks1 "Bedingung: Fehlerpfad löschen, Klopfsensor 1" UWORD B_TRUE 1 100 0 1 BIT_MASK 0x80 FORMAT "%13.11" ECU_ADDRESS 0x3839A6 /end MEASUREMENT
/begin MEASUREMENT B_clks2 "Bedingung: Fehlerpfad löschen, Klopfsensor 2" UWORD B_TRUE 1 100 0 1 BIT_MASK 0x80 FORMAT "%13.11" ECU_ADDRESS 0x3839A8 /end MEASUREMENT
/begin MEASUREMENT B_clks3 "Bedingung: Fehlerpfad löschen, Klopfsensor 3" UWORD B_TRUE 1 100 0 1 BIT_MASK 0x80 FORMAT "%13.11" ECU_ADDRESS 0x3839AA /end MEASUREMENT
/begin MEASUREMENT B_clks4 "Bedingung: Fehlerpfad löschen, Klopfsensor 4" UWORD B_TRUE 1 100 0 1 BIT_MASK 0x80 FORMAT "%13.11" ECU_ADDRESS 0x3839AC /end MEASUREMENT
/begin MEASUREMENT B_cllde "Bedingung Fehlerpfad LDE löschen" UWORD B_TRUE 1 100 0 1 BIT_MASK 0x80 FORMAT "%13.11" ECU_ADDRESS 0x3839B4 /end MEASUREMENT
/begin MEASUREMENT B_cllm "Bedingung: Fehlerpfad Hauptfüllungssensor löschen" UWORD B_TRUE 1 100 0 1 BIT_MASK 0x80 FORMAT "%13.11" ECU_ADDRESS 0x3839C4 /end MEASUREMENT
/begin MEASUREMENT B_clmile "Bedingung Fehlerpfad MIL-Endstufe löschen" UWORD B_TRUE 1 100 0 1 BIT_MASK 0x80 FORMAT "%13.11" ECU_ADDRESS 0x3839D8 /end MEASUREMENT
/begin MEASUREMENT B_cln "Bedingung Fehlerpfad Drehzahlgeber löschen" UWORD B_TRUE 1 100 0 1 BIT_MASK 0x80 FORMAT "%13.11" ECU_ADDRESS 0x3839DA /end MEASUREMENT
/begin MEASUREMENT B_clnwse "Bedingung Fehlerpfad Nockenwellensteuerung Endstufe löschen" UWORD B_TRUE 1 100 0 1 BIT_MASK 0x80 FORMAT "%13.11" ECU_ADDRESS 0x3839DE /end MEASUREMENT
/begin MEASUREMENT B_clslpe "Bedingung: Fehlerpfad Endstufe Sekundärluftpumpe löschen" UWORD B_TRUE 1 100 0 1 BIT_MASK 0x80 FORMAT "%13.11" ECU_ADDRESS 0x3839EE /end MEASUREMENT
/begin MEASUREMENT B_clslve "Bedingung: Fehlerpfad Endstufe Sekundärluftventil löschen" UWORD B_TRUE 1 100 0 1 BIT_MASK 0x80 FORMAT "%13.11" ECU_ADDRESS 0x3839F4 /end MEASUREMENT
/begin MEASUREMENT B_clteve "Bedingung Fehlerphad TEVE löschen" UWORD B_TRUE 1 100 0 1 BIT_MASK 0x80 FORMAT "%13.11" ECU_ADDRESS 0x383A02 /end MEASUREMENT
/begin MEASUREMENT B_cluvse "Bedingung Fehlerpfad UVSE löschen" UWORD B_TRUE 1 100 0 1 BIT_MASK 0x80 FORMAT "%13.11" ECU_ADDRESS 0x383A1E /end MEASUREMENT
/begin MEASUREMENT B_clzet1 "" UWORD B_TRUE 1 100 0 1 BIT_MASK 0x80 FORMAT "%13.11" ECU_ADDRESS 0x383A26 /end MEASUREMENT
/begin MEASUREMENT B_clzet2 "" UWORD B_TRUE 1 100 0 1 BIT_MASK 0x80 FORMAT "%13.11" ECU_ADDRESS 0x383A28 /end MEASUREMENT
/begin MEASUREMENT B_clzet3 "" UWORD B_TRUE 1 100 0 1 BIT_MASK 0x80 FORMAT "%13.11" ECU_ADDRESS 0x383A2A /end MEASUREMENT
/begin MEASUREMENT B_clzet4 "" UWORD B_TRUE 1 100 0 1 BIT_MASK 0x80 FORMAT "%13.11" ECU_ADDRESS 0x383A2C /end MEASUREMENT
/begin MEASUREMENT B_ftaave "Bedingung: Fehlereintrag durch Tester für AAV Endstufe" UWORD B_TRUE 1 100 0 1 BIT_MASK 0x10 FORMAT "%13.11" ECU_ADDRESS 0x38390E /end MEASUREMENT
/begin MEASUREMENT B_ftagre "Bedingung: Fehlereintrag durch Tester" UWORD B_TRUE 1 100 0 1 BIT_MASK 0x10 FORMAT "%13.11" ECU_ADDRESS 0x383910 /end MEASUREMENT
/begin MEASUREMENT B_ftatr "" UWORD B_TRUE 1 100 0 1 BIT_MASK 0x10 FORMAT "%13.11" ECU_ADDRESS 0x383914 /end MEASUREMENT
/begin MEASUREMENT B_ftatr2 "" UWORD B_TRUE 1 100 0 1 BIT_MASK 0x10 FORMAT "%13.11" ECU_ADDRESS 0x383916 /end MEASUREMENT
/begin MEASUREMENT B_ftatrd "" UWORD B_TRUE 1 100 0 1 BIT_MASK 0x10 FORMAT "%13.11" ECU_ADDRESS 0x383918 /end MEASUREMENT
/begin MEASUREMENT B_ftatrd2 "" UWORD B_TRUE 1 100 0 1 BIT_MASK 0x10 FORMAT "%13.11" ECU_ADDRESS 0x38391A /end MEASUREMENT
/begin MEASUREMENT B_ftats "Bedingung Fehlereintrag durch Tester für Abgastemperatursensorsignal" UWORD B_TRUE 1 100 0 1 BIT_MASK 0x10 FORMAT "%13.11" ECU_ADDRESS 0x38391C /end MEASUREMENT
/begin MEASUREMENT B_ftbkvp "Bedingung: Fehlereintrag durch Tester für BKV-Pumpe" UWORD B_TRUE 1 100 0 1 BIT_MASK 0x10 FORMAT "%13.11" ECU_ADDRESS 0x38391E /end MEASUREMENT
/begin MEASUREMENT B_ftbkvpe "Bedingung: Fehlereintrag durch Tester für BKV-Pumpe-Endstufe" UWORD B_TRUE 1 100 0 1 BIT_MASK 0x10 FORMAT "%13.11" ECU_ADDRESS 0x383920 /end MEASUREMENT
/begin MEASUREMENT B_ftbm "" UWORD B_TRUE 1 100 0 1 BIT_MASK 0x10 FORMAT "%13.11" ECU_ADDRESS 0x383922 /end MEASUREMENT
/begin MEASUREMENT B_ftcv "Bedingung Testanforderung" UWORD B_TRUE 1 100 0 1 BIT_MASK 0x10 FORMAT "%13.11" ECU_ADDRESS 0x38393A /end MEASUREMENT
/begin MEASUREMENT B_ftdk "" UWORD B_TRUE 1 100 0 1 BIT_MASK 0x10 FORMAT "%13.11" ECU_ADDRESS 0x38393C /end MEASUREMENT
/begin MEASUREMENT B_ftdk1p "" UWORD B_TRUE 1 100 0 1 BIT_MASK 0x10 FORMAT "%13.11" ECU_ADDRESS 0x38393E /end MEASUREMENT
/begin MEASUREMENT B_ftdk2p "" UWORD B_TRUE 1 100 0 1 BIT_MASK 0x10 FORMAT "%13.11" ECU_ADDRESS 0x383940 /end MEASUREMENT
/begin MEASUREMENT B_ftdvee "" UWORD B_TRUE 1 100 0 1 BIT_MASK 0x10 FORMAT "%13.11" ECU_ADDRESS 0x38394C /end MEASUREMENT
/begin MEASUREMENT B_ftdvef "" UWORD B_TRUE 1 100 0 1 BIT_MASK 0x10 FORMAT "%13.11" ECU_ADDRESS 0x38394E /end MEASUREMENT
/begin MEASUREMENT B_ftdvefo "" UWORD B_TRUE 1 100 0 1 BIT_MASK 0x10 FORMAT "%13.11" ECU_ADDRESS 0x383950 /end MEASUREMENT
/begin MEASUREMENT B_ftdvel "" UWORD B_TRUE 1 100 0 1 BIT_MASK 0x10 FORMAT "%13.11" ECU_ADDRESS 0x383952 /end MEASUREMENT
/begin MEASUREMENT B_ftdven "" UWORD B_TRUE 1 100 0 1 BIT_MASK 0x10 FORMAT "%13.11" ECU_ADDRESS 0x383954 /end MEASUREMENT
/begin MEASUREMENT B_ftdver "" UWORD B_TRUE 1 100 0 1 BIT_MASK 0x10 FORMAT "%13.11" ECU_ADDRESS 0x383956 /end MEASUREMENT
/begin MEASUREMENT B_ftdvet "" UWORD B_TRUE 1 100 0 1 BIT_MASK 0x10 FORMAT "%13.11" ECU_ADDRESS 0x383958 /end MEASUREMENT
/begin MEASUREMENT B_ftdveu "" UWORD B_TRUE 1 100 0 1 BIT_MASK 0x10 FORMAT "%13.11" ECU_ADDRESS 0x38395A /end MEASUREMENT
/begin MEASUREMENT B_ftdveub "" UWORD B_TRUE 1 100 0 1 BIT_MASK 0x10 FORMAT "%13.11" ECU_ADDRESS 0x38395C /end MEASUREMENT
/begin MEASUREMENT B_ftdveuw "" UWORD B_TRUE 1 100 0 1 BIT_MASK 0x10 FORMAT "%13.11" ECU_ADDRESS 0x38395E /end MEASUREMENT
/begin MEASUREMENT B_ftdvev "" UWORD B_TRUE 1 100 0 1 BIT_MASK 0x10 FORMAT "%13.11" ECU_ADDRESS 0x383960 /end MEASUREMENT
/begin MEASUREMENT B_ftenws "Bedingung: Fehlereintrag durch Tester für NWS (Einlaß, Bank1)" UWORD B_TRUE 1 100 0 1 BIT_MASK 0x10 FORMAT "%13.11" ECU_ADDRESS 0x383966 /end MEASUREMENT
/begin MEASUREMENT B_ftenwse "Bedingung: Fehlereintrag durch Tester für NWS Endstufe (Einlaß, Bank1)" UWORD B_TRUE 1 100 0 1 BIT_MASK 0x10 FORMAT "%13.11" ECU_ADDRESS 0x383968 /end MEASUREMENT
/begin MEASUREMENT B_ftepcle "" UWORD B_TRUE 1 100 0 1 BIT_MASK 0x10 FORMAT "%13.11" ECU_ADDRESS 0x38396A /end MEASUREMENT
/begin MEASUREMENT B_ftev1 "Bedingung: Fehlereintrag durch Tester für Endstufendiagnose EV1" UWORD B_TRUE 1 100 0 1 BIT_MASK 0x10 FORMAT "%13.11" ECU_ADDRESS 0x38396C /end MEASUREMENT
/begin MEASUREMENT B_ftev2 "Bedingung: Fehlereintrag durch Tester für Endstufendiagnose EV2" UWORD B_TRUE 1 100 0 1 BIT_MASK 0x10 FORMAT "%13.11" ECU_ADDRESS 0x38396E /end MEASUREMENT
/begin MEASUREMENT B_ftev3 "Bedingung: Fehlereintrag durch Tester für Endstufendiagnose EV3" UWORD B_TRUE 1 100 0 1 BIT_MASK 0x10 FORMAT "%13.11" ECU_ADDRESS 0x383970 /end MEASUREMENT
/begin MEASUREMENT B_ftev4 "Bedingung: Fehlereintrag durch Tester für Endstufendiagnose EV4" UWORD B_TRUE 1 100 0 1 BIT_MASK 0x10 FORMAT "%13.11" ECU_ADDRESS 0x383972 /end MEASUREMENT
/begin MEASUREMENT B_fthsh "Bedingung Fehlereintrag durch Tester für Lambdasonden-Heizung hinter Kat" UWORD B_TRUE 1 100 0 1 BIT_MASK 0x10 FORMAT "%13.11" ECU_ADDRESS 0x383986 /end MEASUREMENT
/begin MEASUREMENT B_fthsh2 "Bedingung Fehlereintrag durch Tester für Lambdasonden-Heizung 2 hinter Kat" UWORD B_TRUE 1 100 0 1 BIT_MASK 0x10 FORMAT "%13.11" ECU_ADDRESS 0x383988 /end MEASUREMENT
/begin MEASUREMENT B_fthshe "Bedingung Fehlereintrag durch Tester für Endstufe LS-Heizung hinter Kat" UWORD B_TRUE 1 100 0 1 BIT_MASK 0x10 FORMAT "%13.11" ECU_ADDRESS 0x38398A /end MEASUREMENT
/begin MEASUREMENT B_fthsv "Bedingung Fehlereintrag durch Tester für LSU-Heizung" UWORD B_TRUE 1 100 0 1 BIT_MASK 0x10 FORMAT "%13.11" ECU_ADDRESS 0x38398C /end MEASUREMENT
/begin MEASUREMENT B_fthsv2 "Bedingung Fehlereintrag durch Tester für LSU-Heizung, Bank 2" UWORD B_TRUE 1 100 0 1 BIT_MASK 0x10 FORMAT "%13.11" ECU_ADDRESS 0x38398E /end MEASUREMENT
/begin MEASUREMENT B_fthsvsa "Bedingung Fehlereintrag durch Tester für LSU-Heizung" UWORD B_TRUE 1 100 0 1 BIT_MASK 0x10 FORMAT "%13.11" ECU_ADDRESS 0x383990 /end MEASUREMENT
/begin MEASUREMENT B_fthsvsa2 "Bedingung Fehlereintrag durch Tester für LSU-Heizung, Bank 2" UWORD B_TRUE 1 100 0 1 BIT_MASK 0x10 FORMAT "%13.11" ECU_ADDRESS 0x383992 /end MEASUREMENT
/begin MEASUREMENT B_ftkat "Bedingung: Fehlereintrag durch Tester für Katalysator" UWORD B_TRUE 1 100 0 1 BIT_MASK 0x10 FORMAT "%13.11" ECU_ADDRESS 0x383994 /end MEASUREMENT
/begin MEASUREMENT B_ftkpe "Bedingung: Fehlereintrag durch Tester für Endstufendiagnose EKP" UWORD B_TRUE 1 100 0 1 BIT_MASK 0x10 FORMAT "%13.11" ECU_ADDRESS 0x383996 /end MEASUREMENT
/begin MEASUREMENT B_ftkrnt "" UWORD B_TRUE 1 100 0 1 BIT_MASK 0x10 FORMAT "%13.11" ECU_ADDRESS 0x3839A0 /end MEASUREMENT
/begin MEASUREMENT B_ftkrof "" UWORD B_TRUE 1 100 0 1 BIT_MASK 0x10 FORMAT "%13.11" ECU_ADDRESS 0x3839A2 /end MEASUREMENT
/begin MEASUREMENT B_ftkrtp "" UWORD B_TRUE 1 100 0 1 BIT_MASK 0x10 FORMAT "%13.11" ECU_ADDRESS 0x3839A4 /end MEASUREMENT
/begin MEASUREMENT B_ftks1 "" UWORD B_TRUE 1 100 0 1 BIT_MASK 0x10 FORMAT "%13.11" ECU_ADDRESS 0x3839A6 /end MEASUREMENT
/begin MEASUREMENT B_ftks2 "" UWORD B_TRUE 1 100 0 1 BIT_MASK 0x10 FORMAT "%13.11" ECU_ADDRESS 0x3839A8 /end MEASUREMENT
/begin MEASUREMENT B_ftks3 "" UWORD B_TRUE 1 100 0 1 BIT_MASK 0x10 FORMAT "%13.11" ECU_ADDRESS 0x3839AA /end MEASUREMENT
/begin MEASUREMENT B_ftks4 "" UWORD B_TRUE 1 100 0 1 BIT_MASK 0x10 FORMAT "%13.11" ECU_ADDRESS 0x3839AC /end MEASUREMENT
/begin MEASUREMENT B_ftlde "Bedingung: Fehlereintrag durch Ladedrucksteuerventil (Tester)" UWORD B_TRUE 1 100 0 1 BIT_MASK 0x10 FORMAT "%13.11" ECU_ADDRESS 0x3839B4 /end MEASUREMENT
/begin MEASUREMENT B_ftlm "Bedingung: Fehlereintrag durch Tester für Luftmassensensor (HFM/DSS/DK)" UWORD B_TRUE 1 100 0 1 BIT_MASK 0x10 FORMAT "%13.11" ECU_ADDRESS 0x3839C4 /end MEASUREMENT
/begin MEASUREMENT B_ftmile "Bedingung: Fehlereintrag durch Tester für Endstufendiagnose Fehlerlampe" UWORD B_TRUE 1 100 0 1 BIT_MASK 0x10 FORMAT "%13.11" ECU_ADDRESS 0x3839D8 /end MEASUREMENT
/begin MEASUREMENT B_ftn "" UWORD B_TRUE 1 100 0 1 BIT_MASK 0x10 FORMAT "%13.11" ECU_ADDRESS 0x3839DA /end MEASUREMENT
/begin MEASUREMENT B_ftnwse "Bedingung: Fehlereintrag durch Tester für Endstufe NWS" UWORD B_TRUE 1 100 0 1 BIT_MASK 0x10 FORMAT "%13.11" ECU_ADDRESS 0x3839DE /end MEASUREMENT
/begin MEASUREMENT B_ftslpe "Bedingung Fehlereintrag durch Tester Sekundärluftpumpe Endstufe" UWORD B_TRUE 1 100 0 1 BIT_MASK 0x10 FORMAT "%13.11" ECU_ADDRESS 0x3839EE /end MEASUREMENT
/begin MEASUREMENT B_ftslve "Bedingung Fehlereintrag durch Tester Sekundärluftventil Endstufe" UWORD B_TRUE 1 100 0 1 BIT_MASK 0x10 FORMAT "%13.11" ECU_ADDRESS 0x3839F4 /end MEASUREMENT
/begin MEASUREMENT B_ftteve "Bedingung Fehlereintrag durch Tester Tankentlüftungsventil Endstufe" UWORD B_TRUE 1 100 0 1 BIT_MASK 0x10 FORMAT "%13.11" ECU_ADDRESS 0x383A02 /end MEASUREMENT
/begin MEASUREMENT B_ftuvse "Bedingung: Fehlereintrag durch Umluftventil turbo (Tester)" UWORD B_TRUE 1 100 0 1 BIT_MASK 0x10 FORMAT "%13.11" ECU_ADDRESS 0x383A1E /end MEASUREMENT
/begin MEASUREMENT B_ftzet1 "" UWORD B_TRUE 1 100 0 1 BIT_MASK 0x10 FORMAT "%13.11" ECU_ADDRESS 0x383A26 /end MEASUREMENT
/begin MEASUREMENT B_ftzet2 "" UWORD B_TRUE 1 100 0 1 BIT_MASK 0x10 FORMAT "%13.11" ECU_ADDRESS 0x383A28 /end MEASUREMENT
/begin MEASUREMENT B_ftzet3 "" UWORD B_TRUE 1 100 0 1 BIT_MASK 0x10 FORMAT "%13.11" ECU_ADDRESS 0x383A2A /end MEASUREMENT
/begin MEASUREMENT B_ftzet4 "" UWORD B_TRUE 1 100 0 1 BIT_MASK 0x10 FORMAT "%13.11" ECU_ADDRESS 0x383A2C /end MEASUREMENT
/begin MEASUREMENT B_mnaave "Fehlerart: Kurzschluß Masse Absperrventil Aktivkohlefilter (Endstufe)" UWORD B_TRUE 1 100 0 1 BIT_MASK 0x200 FORMAT "%13.11" ECU_ADDRESS 0x38390E /end MEASUREMENT
/begin MEASUREMENT B_mnagre "Fehlertype: Kurzschluß nach Masse Endstufe AGR-Ventil" UWORD B_TRUE 1 100 0 1 BIT_MASK 0x200 FORMAT "%13.11" ECU_ADDRESS 0x383910 /end MEASUREMENT
/begin MEASUREMENT B_mnatr "Bedingung: Min-Fehler Abgastemperaturregelung" UWORD B_TRUE 1 100 0 1 BIT_MASK 0x200 FORMAT "%13.11" ECU_ADDRESS 0x383914 /end MEASUREMENT
/begin MEASUREMENT B_mnatr2 "Bedingung: Min-Fehler Abgastemperaturregelung Bank 2" UWORD B_TRUE 1 100 0 1 BIT_MASK 0x200 FORMAT "%13.11" ECU_ADDRESS 0x383916 /end MEASUREMENT
/begin MEASUREMENT B_mnatrd "" UWORD B_TRUE 1 100 0 1 BIT_MASK 0x200 FORMAT "%13.11" ECU_ADDRESS 0x383918 /end MEASUREMENT
/begin MEASUREMENT B_mnatrd2 "" UWORD B_TRUE 1 100 0 1 BIT_MASK 0x200 FORMAT "%13.11" ECU_ADDRESS 0x38391A /end MEASUREMENT
/begin MEASUREMENT B_mnats "Fehlerart:  Min-Fehler Abgastemperatursensor" UWORD B_TRUE 1 100 0 1 BIT_MASK 0x200 FORMAT "%13.11" ECU_ADDRESS 0x38391C /end MEASUREMENT
/begin MEASUREMENT B_mnbkvp "Bedingung: min. Fehler BKV-Pumpe" UWORD B_TRUE 1 100 0 1 BIT_MASK 0x200 FORMAT "%13.11" ECU_ADDRESS 0x38391E /end MEASUREMENT
/begin MEASUREMENT B_mnbkvpe "Fehlerart: Kurzschluß Masse an BKV-Pumpe-Endstufe" UWORD B_TRUE 1 100 0 1 BIT_MASK 0x200 FORMAT "%13.11" ECU_ADDRESS 0x383920 /end MEASUREMENT
/begin MEASUREMENT B_mnbm "Fehlertyp: häufige Korrektur bei einem Zahn zuwenig" UWORD B_TRUE 1 100 0 1 BIT_MASK 0x200 FORMAT "%13.11" ECU_ADDRESS 0x383922 /end MEASUREMENT
/begin MEASUREMENT B_mncv "Fehlerart: Leckage nach Drosselklappe" UWORD B_TRUE 1 100 0 1 BIT_MASK 0x200 FORMAT "%13.11" ECU_ADDRESS 0x38393A /end MEASUREMENT
/begin MEASUREMENT B_mndk "Fehlertype: Kurzschluß nach Masse Drosselklappenpoti" UWORD B_TRUE 1 100 0 1 BIT_MASK 0x200 FORMAT "%13.11" ECU_ADDRESS 0x38393C /end MEASUREMENT
/begin MEASUREMENT B_mndk1p "Fehlertyp min.: Drosselklappe 1. Poti" UWORD B_TRUE 1 100 0 1 BIT_MASK 0x200 FORMAT "%13.11" ECU_ADDRESS 0x38393E /end MEASUREMENT
/begin MEASUREMENT B_mndk2p "Fehlertyp min.: Drosselklappe 2. Poti" UWORD B_TRUE 1 100 0 1 BIT_MASK 0x200 FORMAT "%13.11" ECU_ADDRESS 0x383940 /end MEASUREMENT
/begin MEASUREMENT B_mndvee "Fehlerzyp min.: DV-E Endstufe" UWORD B_TRUE 1 100 0 1 BIT_MASK 0x200 FORMAT "%13.11" ECU_ADDRESS 0x38394C /end MEASUREMENT
/begin MEASUREMENT B_mndvef "Fehlertyp min.: DV-E Fehler bei Prüfung der öffnenden Feder" UWORD B_TRUE 1 100 0 1 BIT_MASK 0x200 FORMAT "%13.11" ECU_ADDRESS 0x38394E /end MEASUREMENT
/begin MEASUREMENT B_mndvefo "Fehlertyp min.: Fehler bei Federprüfung ""Öffnen""" UWORD B_TRUE 1 100 0 1 BIT_MASK 0x200 FORMAT "%13.11" ECU_ADDRESS 0x383950 /end MEASUREMENT
/begin MEASUREMENT B_mndvel "Fehlertyp min.: DV-E Lageabweichung" UWORD B_TRUE 1 100 0 1 BIT_MASK 0x200 FORMAT "%13.11" ECU_ADDRESS 0x383952 /end MEASUREMENT
/begin MEASUREMENT B_mndven "Fehlertyp min.: DV-E Fehler bei Prüfung Notluftposition" UWORD B_TRUE 1 100 0 1 BIT_MASK 0x200 FORMAT "%13.11" ECU_ADDRESS 0x383954 /end MEASUREMENT
/begin MEASUREMENT B_mndver "Fehlerzyp min.: DV-E Regelbereich, kurzfristig überschritten" UWORD B_TRUE 1 100 0 1 BIT_MASK 0x200 FORMAT "%13.11" ECU_ADDRESS 0x383956 /end MEASUREMENT
/begin MEASUREMENT B_mndvet "" UWORD B_TRUE 1 100 0 1 BIT_MASK 0x200 FORMAT "%13.11" ECU_ADDRESS 0x383958 /end MEASUREMENT
/begin MEASUREMENT B_mndveu "Fehlertyp min.: DV-E Fehler beim UMA-Lernen" UWORD B_TRUE 1 100 0 1 BIT_MASK 0x200 FORMAT "%13.11" ECU_ADDRESS 0x38395A /end MEASUREMENT
/begin MEASUREMENT B_mndveub "Fehlertyp min.: DV-E-Adaption Abbruch wg. Umweltbed/Unterspng" UWORD B_TRUE 1 100 0 1 BIT_MASK 0x200 FORMAT "%13.11" ECU_ADDRESS 0x38395C /end MEASUREMENT
/begin MEASUREMENT B_mndveuw "" UWORD B_TRUE 1 100 0 1 BIT_MASK 0x200 FORMAT "%13.11" ECU_ADDRESS 0x38395E /end MEASUREMENT
/begin MEASUREMENT B_mndvev "Fehlertyp min.: DV-E Fehler bei Verstärkerabgleich" UWORD B_TRUE 1 100 0 1 BIT_MASK 0x200 FORMAT "%13.11" ECU_ADDRESS 0x383960 /end MEASUREMENT
/begin MEASUREMENT B_mnenws "Bed. Nockenwellenverstellung hat Frühposition nicht erreicht (Einlaß,Bank1)" UWORD B_TRUE 1 100 0 1 BIT_MASK 0x200 FORMAT "%13.11" ECU_ADDRESS 0x383966 /end MEASUREMENT
/begin MEASUREMENT B_mnenwse "Fehlerart: Kurzschluß Masse Nockenwellensteuerungsventil Endstufe" UWORD B_TRUE 1 100 0 1 BIT_MASK 0x200 FORMAT "%13.11" ECU_ADDRESS 0x383968 /end MEASUREMENT
/begin MEASUREMENT B_mnepcle "Fehlerart: Kurzschluß Masse an EPCL-Endstufe" UWORD B_TRUE 1 100 0 1 BIT_MASK 0x200 FORMAT "%13.11" ECU_ADDRESS 0x38396A /end MEASUREMENT
/begin MEASUREMENT B_mnev1 "Fehlerart: Kurzschluß Masse an Endstufe EV1" UWORD B_TRUE 1 100 0 1 BIT_MASK 0x200 FORMAT "%13.11" ECU_ADDRESS 0x38396C /end MEASUREMENT
/begin MEASUREMENT B_mnev2 "Fehlerart: Kurzschluß Masse an Endstufe EV2" UWORD B_TRUE 1 100 0 1 BIT_MASK 0x200 FORMAT "%13.11" ECU_ADDRESS 0x38396E /end MEASUREMENT
/begin MEASUREMENT B_mnev3 "Fehlerart: Kurzschluß Masse an Endstufe EV3" UWORD B_TRUE 1 100 0 1 BIT_MASK 0x200 FORMAT "%13.11" ECU_ADDRESS 0x383970 /end MEASUREMENT
/begin MEASUREMENT B_mnev4 "Fehlerart: Kurzschluß Masse an Endstufe EV4" UWORD B_TRUE 1 100 0 1 BIT_MASK 0x200 FORMAT "%13.11" ECU_ADDRESS 0x383972 /end MEASUREMENT
/begin MEASUREMENT B_mnhsh "Kurzschluß Heizung Lambdasonde hinter Kat nach Masse" UWORD B_TRUE 1 100 0 1 BIT_MASK 0x200 FORMAT "%13.11" ECU_ADDRESS 0x383986 /end MEASUREMENT
/begin MEASUREMENT B_mnhsh2 "Kurzschluß Heizung Lambdasonde2 hinter Kat nach Masse" UWORD B_TRUE 1 100 0 1 BIT_MASK 0x200 FORMAT "%13.11" ECU_ADDRESS 0x383988 /end MEASUREMENT
/begin MEASUREMENT B_mnhshe "Kurzschluß Heizung Lambdasonde hinter Kat nach Masse (Endstufe)" UWORD B_TRUE 1 100 0 1 BIT_MASK 0x200 FORMAT "%13.11" ECU_ADDRESS 0x38398A /end MEASUREMENT
/begin MEASUREMENT B_mnhsv "Kurzschluß Heizung Lambdasonde vor Kat nach Masse" UWORD B_TRUE 1 100 0 1 BIT_MASK 0x200 FORMAT "%13.11" ECU_ADDRESS 0x38398C /end MEASUREMENT
/begin MEASUREMENT B_mnhsv2 "Kurzschluß Heizung Lambdasonde2 vor Kat nach Masse" UWORD B_TRUE 1 100 0 1 BIT_MASK 0x200 FORMAT "%13.11" ECU_ADDRESS 0x38398E /end MEASUREMENT
/begin MEASUREMENT B_mnhsvsa "Min-Fehler erkannt" UWORD B_TRUE 1 100 0 1 BIT_MASK 0x200 FORMAT "%13.11" ECU_ADDRESS 0x383990 /end MEASUREMENT
/begin MEASUREMENT B_mnhsvsa2 "Min-Fehler erkannt Bank 2" UWORD B_TRUE 1 100 0 1 BIT_MASK 0x200 FORMAT "%13.11" ECU_ADDRESS 0x383992 /end MEASUREMENT
/begin MEASUREMENT B_mnkat "Fehlertyp 'Minimalwert' erkannt (Katalysator defekt)" UWORD B_TRUE 1 100 0 1 BIT_MASK 0x200 FORMAT "%13.11" ECU_ADDRESS 0x383994 /end MEASUREMENT
/begin MEASUREMENT B_mnkpe "Bedingung für Fehlertyp Kurzschluß nach Masse für EKP-Relais Endstufe erkannt" UWORD B_TRUE 1 100 0 1 BIT_MASK 0x200 FORMAT "%13.11" ECU_ADDRESS 0x383996 /end MEASUREMENT
/begin MEASUREMENT B_mnkrnt "Fehlertyp min.: Klopfregelung Nulltest" UWORD B_TRUE 1 100 0 1 BIT_MASK 0x200 FORMAT "%13.11" ECU_ADDRESS 0x3839A0 /end MEASUREMENT
/begin MEASUREMENT B_mnkrof "Fehlertyp min.: Klopfregelung Offset" UWORD B_TRUE 1 100 0 1 BIT_MASK 0x200 FORMAT "%13.11" ECU_ADDRESS 0x3839A2 /end MEASUREMENT
/begin MEASUREMENT B_mnkrtp "Fehlertyp min.: Klopfregelung Testimpuls" UWORD B_TRUE 1 100 0 1 BIT_MASK 0x200 FORMAT "%13.11" ECU_ADDRESS 0x3839A4 /end MEASUREMENT
/begin MEASUREMENT B_mnks1 "Bedingung: Min-Fehler Klopfsensor 1" UWORD B_TRUE 1 100 0 1 BIT_MASK 0x200 FORMAT "%13.11" ECU_ADDRESS 0x3839A6 /end MEASUREMENT
/begin MEASUREMENT B_mnks2 "Bedingung: Min-Fehler Klopfsensor 2" UWORD B_TRUE 1 100 0 1 BIT_MASK 0x200 FORMAT "%13.11" ECU_ADDRESS 0x3839A8 /end MEASUREMENT
/begin MEASUREMENT B_mnks3 "Bedingung: Min-Fehler Klopfsensor 3" UWORD B_TRUE 1 100 0 1 BIT_MASK 0x200 FORMAT "%13.11" ECU_ADDRESS 0x3839AA /end MEASUREMENT
/begin MEASUREMENT B_mnks4 "Bedingung: Min-fehler Klopfsensor 4" UWORD B_TRUE 1 100 0 1 BIT_MASK 0x200 FORMAT "%13.11" ECU_ADDRESS 0x3839AC /end MEASUREMENT
/begin MEASUREMENT B_mnlde "Fehlertyp: Kurzschluß Masse LDR-Taktventil" UWORD B_TRUE 1 100 0 1 BIT_MASK 0x200 FORMAT "%13.11" ECU_ADDRESS 0x3839B4 /end MEASUREMENT
/begin MEASUREMENT B_mnlm "Bedingung: min-Fehler Hauptfüllungssensor" UWORD B_TRUE 1 100 0 1 BIT_MASK 0x200 FORMAT "%13.11" ECU_ADDRESS 0x3839C4 /end MEASUREMENT
/begin MEASUREMENT B_mnmile "Fehlerart: Kurzschluß Masse an MIL-Endstufe" UWORD B_TRUE 1 100 0 1 BIT_MASK 0x200 FORMAT "%13.11" ECU_ADDRESS 0x3839D8 /end MEASUREMENT
/begin MEASUREMENT B_mnn "Fehlerart: Synchronisationsmarke häufig nicht gefunden" UWORD B_TRUE 1 100 0 1 BIT_MASK 0x200 FORMAT "%13.11" ECU_ADDRESS 0x3839DA /end MEASUREMENT
/begin MEASUREMENT B_mnnwse "Fehlerart: Kurzschluß Masse Nockenwellensteuerungsventil Endstufe" UWORD B_TRUE 1 100 0 1 BIT_MASK 0x200 FORMAT "%13.11" ECU_ADDRESS 0x3839DE /end MEASUREMENT
/begin MEASUREMENT B_mnslpe "Fehlertype: Kurzschluß nach Masse Endstufe Sekundärluftpumpe" UWORD B_TRUE 1 100 0 1 BIT_MASK 0x200 FORMAT "%13.11" ECU_ADDRESS 0x3839EE /end MEASUREMENT
/begin MEASUREMENT B_mnslve "Fehlertype: Kurzschluß nach Masse Endstufe Sekundärluftventil" UWORD B_TRUE 1 100 0 1 BIT_MASK 0x200 FORMAT "%13.11" ECU_ADDRESS 0x3839F4 /end MEASUREMENT
/begin MEASUREMENT B_mnteve "Fehlertyp: Kurzschluß Masse Tankentlüftungsventil Endstufe" UWORD B_TRUE 1 100 0 1 BIT_MASK 0x200 FORMAT "%13.11" ECU_ADDRESS 0x383A02 /end MEASUREMENT
/begin MEASUREMENT B_mnuvse "Fehlertyp: Kurzschluß Masse Umluftventil Turbo" UWORD B_TRUE 1 100 0 1 BIT_MASK 0x200 FORMAT "%13.11" ECU_ADDRESS 0x383A1E /end MEASUREMENT
/begin MEASUREMENT B_mnzet1 "" UWORD B_TRUE 1 100 0 1 BIT_MASK 0x200 FORMAT "%13.11" ECU_ADDRESS 0x383A26 /end MEASUREMENT
/begin MEASUREMENT B_mnzet2 "" UWORD B_TRUE 1 100 0 1 BIT_MASK 0x200 FORMAT "%13.11" ECU_ADDRESS 0x383A28 /end MEASUREMENT
/begin MEASUREMENT B_mnzet3 "" UWORD B_TRUE 1 100 0 1 BIT_MASK 0x200 FORMAT "%13.11" ECU_ADDRESS 0x383A2A /end MEASUREMENT
/begin MEASUREMENT B_mnzet4 "" UWORD B_TRUE 1 100 0 1 BIT_MASK 0x200 FORMAT "%13.11" ECU_ADDRESS 0x383A2C /end MEASUREMENT
/begin MEASUREMENT B_mxaave "Fehlerart: Kurzschluß Ubat Absperrventil Aktivkohlefilter (Endstufe)" UWORD B_TRUE 1 100 0 1 BIT_MASK 0x100 FORMAT "%13.11" ECU_ADDRESS 0x38390E /end MEASUREMENT
/begin MEASUREMENT B_mxagre "Fehlertype: Kurzschluß nach Ubat Endstufe AGR-Ventil" UWORD B_TRUE 1 100 0 1 BIT_MASK 0x100 FORMAT "%13.11" ECU_ADDRESS 0x383910 /end MEASUREMENT
/begin MEASUREMENT B_mxatr "Maxfehler Abgastemperaturregelung" UWORD B_TRUE 1 100 0 1 BIT_MASK 0x100 FORMAT "%13.11" ECU_ADDRESS 0x383914 /end MEASUREMENT
/begin MEASUREMENT B_mxatr2 "Maxfehler Abgastemperaturregelung Bank 2" UWORD B_TRUE 1 100 0 1 BIT_MASK 0x100 FORMAT "%13.11" ECU_ADDRESS 0x383916 /end MEASUREMENT
/begin MEASUREMENT B_mxatrd "" UWORD B_TRUE 1 100 0 1 BIT_MASK 0x100 FORMAT "%13.11" ECU_ADDRESS 0x383918 /end MEASUREMENT
/begin MEASUREMENT B_mxatrd2 "" UWORD B_TRUE 1 100 0 1 BIT_MASK 0x100 FORMAT "%13.11" ECU_ADDRESS 0x38391A /end MEASUREMENT
/begin MEASUREMENT B_mxats "Fehlerart:  Max-Fehler Abgastemperatursensor" UWORD B_TRUE 1 100 0 1 BIT_MASK 0x100 FORMAT "%13.11" ECU_ADDRESS 0x38391C /end MEASUREMENT
/begin MEASUREMENT B_mxbkvp "Bedingung: max. Fehler BKV-Pumpe" UWORD B_TRUE 1 100 0 1 BIT_MASK 0x100 FORMAT "%13.11" ECU_ADDRESS 0x38391E /end MEASUREMENT
/begin MEASUREMENT B_mxbkvpe "Fehlerart: Kurzschluß Ubat an BKV-Pumpe-Endstufe" UWORD B_TRUE 1 100 0 1 BIT_MASK 0x100 FORMAT "%13.11" ECU_ADDRESS 0x383920 /end MEASUREMENT
/begin MEASUREMENT B_mxbm "Fehlertyp: häufige Korrektur bei einem Zahn zuviel" UWORD B_TRUE 1 100 0 1 BIT_MASK 0x100 FORMAT "%13.11" ECU_ADDRESS 0x383922 /end MEASUREMENT
/begin MEASUREMENT B_mxcv "Fehlerart: Leckage vor Drosselklappe" UWORD B_TRUE 1 100 0 1 BIT_MASK 0x100 FORMAT "%13.11" ECU_ADDRESS 0x38393A /end MEASUREMENT
/begin MEASUREMENT B_mxdk "Fehlertype: Kurzschluß nach Ubat Drosselklappenpoti" UWORD B_TRUE 1 100 0 1 BIT_MASK 0x100 FORMAT "%13.11" ECU_ADDRESS 0x38393C /end MEASUREMENT
/begin MEASUREMENT B_mxdk1p "Fehlertyp max.: Drosselklappe 1. Poti" UWORD B_TRUE 1 100 0 1 BIT_MASK 0x100 FORMAT "%13.11" ECU_ADDRESS 0x38393E /end MEASUREMENT
/begin MEASUREMENT B_mxdk2p "Fehlertyp max.: Drosselklappe 2. Poti" UWORD B_TRUE 1 100 0 1 BIT_MASK 0x100 FORMAT "%13.11" ECU_ADDRESS 0x383940 /end MEASUREMENT
/begin MEASUREMENT B_mxdvee "Fehlertyp max.: DV-E Endstufe" UWORD B_TRUE 1 100 0 1 BIT_MASK 0x100 FORMAT "%13.11" ECU_ADDRESS 0x38394C /end MEASUREMENT
/begin MEASUREMENT B_mxdvef "Fehlertyp max.: DV-E Fehler bei Prüfung der Rückstellfeder" UWORD B_TRUE 1 100 0 1 BIT_MASK 0x100 FORMAT "%13.11" ECU_ADDRESS 0x38394E /end MEASUREMENT
/begin MEASUREMENT B_mxdvefo "Fehlertyp max.: Fehler bei Federprüfung ""Öffnen""" UWORD B_TRUE 1 100 0 1 BIT_MASK 0x100 FORMAT "%13.11" ECU_ADDRESS 0x383950 /end MEASUREMENT
/begin MEASUREMENT B_mxdvel "Fehlerzyp max.: DV-E Lageabweichung" UWORD B_TRUE 1 100 0 1 BIT_MASK 0x100 FORMAT "%13.11" ECU_ADDRESS 0x383952 /end MEASUREMENT
/begin MEASUREMENT B_mxdven "Fehlertyp max.: DV-E Fehler bei Prüfung Notluftposition" UWORD B_TRUE 1 100 0 1 BIT_MASK 0x100 FORMAT "%13.11" ECU_ADDRESS 0x383954 /end MEASUREMENT
/begin MEASUREMENT B_mxdver "Fehlertyp max.: DV-E Regelbereich, langfristig verletzt" UWORD B_TRUE 1 100 0 1 BIT_MASK 0x100 FORMAT "%13.11" ECU_ADDRESS 0x383956 /end MEASUREMENT
/begin MEASUREMENT B_mxdvet "" UWORD B_TRUE 1 100 0 1 BIT_MASK 0x100 FORMAT "%13.11" ECU_ADDRESS 0x383958 /end MEASUREMENT
/begin MEASUREMENT B_mxdveu "Fehlertyp max.: DV-E Fehler beim UMA-Lernen" UWORD B_TRUE 1 100 0 1 BIT_MASK 0x100 FORMAT "%13.11" ECU_ADDRESS 0x38395A /end MEASUREMENT
/begin MEASUREMENT B_mxdveub "Fehlertyp max.: DV-E-Adaption Abbruch wg. Umweltbedingung" UWORD B_TRUE 1 100 0 1 BIT_MASK 0x100 FORMAT "%13.11" ECU_ADDRESS 0x38395C /end MEASUREMENT
/begin MEASUREMENT B_mxdveuw "" UWORD B_TRUE 1 100 0 1 BIT_MASK 0x100 FORMAT "%13.11" ECU_ADDRESS 0x38395E /end MEASUREMENT
/begin MEASUREMENT B_mxdvev "Fehlertyp max.: DV-E Fehler bei Verstärkerabgleich" UWORD B_TRUE 1 100 0 1 BIT_MASK 0x100 FORMAT "%13.11" ECU_ADDRESS 0x383960 /end MEASUREMENT
/begin MEASUREMENT B_mxenws "Bed. Nockenwellenverstellung hat Spätposition nicht erreicht (Einlaß,Bank1)" UWORD B_TRUE 1 100 0 1 BIT_MASK 0x100 FORMAT "%13.11" ECU_ADDRESS 0x383966 /end MEASUREMENT
/begin MEASUREMENT B_mxenwse "Fehlerart: Kurzschluß Ubat Nockenwellensteuerungsventil Endstufe" UWORD B_TRUE 1 100 0 1 BIT_MASK 0x100 FORMAT "%13.11" ECU_ADDRESS 0x383968 /end MEASUREMENT
/begin MEASUREMENT B_mxepcle "Fehlerart: Kurzschluß Ubat an EPCL-Endstufe" UWORD B_TRUE 1 100 0 1 BIT_MASK 0x100 FORMAT "%13.11" ECU_ADDRESS 0x38396A /end MEASUREMENT
/begin MEASUREMENT B_mxev1 "Fehlerart: Kurzschluß UBat an Endstufe EV1" UWORD B_TRUE 1 100 0 1 BIT_MASK 0x100 FORMAT "%13.11" ECU_ADDRESS 0x38396C /end MEASUREMENT
/begin MEASUREMENT B_mxev2 "Fehlerart: Kurzschluß UBat an Endstufe EV2" UWORD B_TRUE 1 100 0 1 BIT_MASK 0x100 FORMAT "%13.11" ECU_ADDRESS 0x38396E /end MEASUREMENT
/begin MEASUREMENT B_mxev3 "Fehlerart: Kurzschluß UBat an Endstufe EV3" UWORD B_TRUE 1 100 0 1 BIT_MASK 0x100 FORMAT "%13.11" ECU_ADDRESS 0x383970 /end MEASUREMENT
/begin MEASUREMENT B_mxev4 "Fehlerart: Kurzschluß UBat an Endstufe EV4" UWORD B_TRUE 1 100 0 1 BIT_MASK 0x100 FORMAT "%13.11" ECU_ADDRESS 0x383972 /end MEASUREMENT
/begin MEASUREMENT B_mxhsh "Kurzschluß Heizung Lambdasonde hinter Kat nach UB" UWORD B_TRUE 1 100 0 1 BIT_MASK 0x100 FORMAT "%13.11" ECU_ADDRESS 0x383986 /end MEASUREMENT
/begin MEASUREMENT B_mxhsh2 "Kurzschluß Heizung Lambdasonde2 hinter Kat nach UB" UWORD B_TRUE 1 100 0 1 BIT_MASK 0x100 FORMAT "%13.11" ECU_ADDRESS 0x383988 /end MEASUREMENT
/begin MEASUREMENT B_mxhshe "Kurzschluß Heizung Lambdasonde hinter Kat nach UB (Endstufe)" UWORD B_TRUE 1 100 0 1 BIT_MASK 0x100 FORMAT "%13.11" ECU_ADDRESS 0x38398A /end MEASUREMENT
/begin MEASUREMENT B_mxhsv "Kurzschluß Heizung Lambdasonde vor Kat nach UB" UWORD B_TRUE 1 100 0 1 BIT_MASK 0x100 FORMAT "%13.11" ECU_ADDRESS 0x38398C /end MEASUREMENT
/begin MEASUREMENT B_mxhsv2 "Kurzschluß Heizung Lambdasonde2 vor Kat nach UB" UWORD B_TRUE 1 100 0 1 BIT_MASK 0x100 FORMAT "%13.11" ECU_ADDRESS 0x38398E /end MEASUREMENT
/begin MEASUREMENT B_mxhsvsa "Max-Fehler erkannt" UWORD B_TRUE 1 100 0 1 BIT_MASK 0x100 FORMAT "%13.11" ECU_ADDRESS 0x383990 /end MEASUREMENT
/begin MEASUREMENT B_mxhsvsa2 "Max-Fehler erkannt Bank 2" UWORD B_TRUE 1 100 0 1 BIT_MASK 0x100 FORMAT "%13.11" ECU_ADDRESS 0x383992 /end MEASUREMENT
/begin MEASUREMENT B_mxkat "Bedingung obere Plausibilitätsschwelle überschritten" UWORD B_TRUE 1 100 0 1 BIT_MASK 0x100 FORMAT "%13.11" ECU_ADDRESS 0x383994 /end MEASUREMENT
/begin MEASUREMENT B_mxkpe "Fehlertyp Kurzschluß nach Ubat für EKP-Relais Endstufe erkannt" UWORD B_TRUE 1 100 0 1 BIT_MASK 0x100 FORMAT "%13.11" ECU_ADDRESS 0x383996 /end MEASUREMENT
/begin MEASUREMENT B_mxkra01 "Fehlertyp max.: Klopfregelanschlag Zylinder 1" UWORD B_TRUE 1 100 0 1 BIT_MASK 0x100 FORMAT "%13.11" ECU_ADDRESS 0x383998 /end MEASUREMENT
/begin MEASUREMENT B_mxkra02 "Fehlertyp max.: Klopfregelanschlag Zylinder 2" UWORD B_TRUE 1 100 0 1 BIT_MASK 0x100 FORMAT "%13.11" ECU_ADDRESS 0x38399A /end MEASUREMENT
/begin MEASUREMENT B_mxkra03 "Fehlertyp max.: Klopfregelanschlag Zylinder 3" UWORD B_TRUE 1 100 0 1 BIT_MASK 0x100 FORMAT "%13.11" ECU_ADDRESS 0x38399C /end MEASUREMENT
/begin MEASUREMENT B_mxkra04 "Fehlertyp max.: Klopfregelanschlag Zylinder 4" UWORD B_TRUE 1 100 0 1 BIT_MASK 0x100 FORMAT "%13.11" ECU_ADDRESS 0x38399E /end MEASUREMENT
/begin MEASUREMENT B_mxkrnt "Fehlertyp max.: Klopfregelung Nulltest" UWORD B_TRUE 1 100 0 1 BIT_MASK 0x100 FORMAT "%13.11" ECU_ADDRESS 0x3839A0 /end MEASUREMENT
/begin MEASUREMENT B_mxkrof "Fehlertyp max.: Klopfregelung Offset" UWORD B_TRUE 1 100 0 1 BIT_MASK 0x100 FORMAT "%13.11" ECU_ADDRESS 0x3839A2 /end MEASUREMENT
/begin MEASUREMENT B_mxkrtp "Fehlertyp max.: Klopfregelung Testimpuls" UWORD B_TRUE 1 100 0 1 BIT_MASK 0x100 FORMAT "%13.11" ECU_ADDRESS 0x3839A4 /end MEASUREMENT
/begin MEASUREMENT B_mxks1 "Bedingung: Max-Fehler Klopfsensor 1" UWORD B_TRUE 1 100 0 1 BIT_MASK 0x100 FORMAT "%13.11" ECU_ADDRESS 0x3839A6 /end MEASUREMENT
/begin MEASUREMENT B_mxks2 "Bedingung: Max-Fehler Klopfsensor 2" UWORD B_TRUE 1 100 0 1 BIT_MASK 0x100 FORMAT "%13.11" ECU_ADDRESS 0x3839A8 /end MEASUREMENT
/begin MEASUREMENT B_mxks3 "Bedingung: Max-Fehler Klopfsensor 3" UWORD B_TRUE 1 100 0 1 BIT_MASK 0x100 FORMAT "%13.11" ECU_ADDRESS 0x3839AA /end MEASUREMENT
/begin MEASUREMENT B_mxks4 "Bedingung: Max-Fehler Klopfsensor 4" UWORD B_TRUE 1 100 0 1 BIT_MASK 0x100 FORMAT "%13.11" ECU_ADDRESS 0x3839AC /end MEASUREMENT
/begin MEASUREMENT B_mxlde "Fehlertyp: Kurzschluß Ubat LDR-Taktventil" UWORD B_TRUE 1 100 0 1 BIT_MASK 0x100 FORMAT "%13.11" ECU_ADDRESS 0x3839B4 /end MEASUREMENT
/begin MEASUREMENT B_mxlm "Bedingung: max-Fehler Hauptfüllungssensor" UWORD B_TRUE 1 100 0 1 BIT_MASK 0x100 FORMAT "%13.11" ECU_ADDRESS 0x3839C4 /end MEASUREMENT
/begin MEASUREMENT B_mxmile "Fehlerart: Kurzschluß Ubat an MIL-Endstufe" UWORD B_TRUE 1 100 0 1 BIT_MASK 0x100 FORMAT "%13.11" ECU_ADDRESS 0x3839D8 /end MEASUREMENT
/begin MEASUREMENT B_mxn "Fehlerart: häufiger Lückenverlust beim Lückencheck" UWORD B_TRUE 1 100 0 1 BIT_MASK 0x100 FORMAT "%13.11" ECU_ADDRESS 0x3839DA /end MEASUREMENT
/begin MEASUREMENT B_mxnwse "Fehlerart: Kurzschluß Ubat Nockenwellensteuerungsventil Endstufe" UWORD B_TRUE 1 100 0 1 BIT_MASK 0x100 FORMAT "%13.11" ECU_ADDRESS 0x3839DE /end MEASUREMENT
/begin MEASUREMENT B_mxslpe "Fehlertype: Kurzschluß nach Ubatt Endstufe Sekundärluftpumpe" UWORD B_TRUE 1 100 0 1 BIT_MASK 0x100 FORMAT "%13.11" ECU_ADDRESS 0x3839EE /end MEASUREMENT
/begin MEASUREMENT B_mxslve "Fehlertype: Kurzschluß nach Masse Endstufe Sekundärluftventil" UWORD B_TRUE 1 100 0 1 BIT_MASK 0x100 FORMAT "%13.11" ECU_ADDRESS 0x3839F4 /end MEASUREMENT
/begin MEASUREMENT B_mxteve "Fehlertyp: Kurzschluß Ubat Tankentlüftungsventil Endstufe" UWORD B_TRUE 1 100 0 1 BIT_MASK 0x100 FORMAT "%13.11" ECU_ADDRESS 0x383A02 /end MEASUREMENT
/begin MEASUREMENT B_mxuvse "Fehlertyp: Kurzschluß Ubat Umluftventil Turbo" UWORD B_TRUE 1 100 0 1 BIT_MASK 0x100 FORMAT "%13.11" ECU_ADDRESS 0x383A1E /end MEASUREMENT
/begin MEASUREMENT B_mxzet1 "" UWORD B_TRUE 1 100 0 1 BIT_MASK 0x100 FORMAT "%13.11" ECU_ADDRESS 0x383A26 /end MEASUREMENT
/begin MEASUREMENT B_mxzet2 "" UWORD B_TRUE 1 100 0 1 BIT_MASK 0x100 FORMAT "%13.11" ECU_ADDRESS 0x383A28 /end MEASUREMENT
/begin MEASUREMENT B_mxzet3 "" UWORD B_TRUE 1 100 0 1 BIT_MASK 0x100 FORMAT "%13.11" ECU_ADDRESS 0x383A2A /end MEASUREMENT
/begin MEASUREMENT B_mxzet4 "" UWORD B_TRUE 1 100 0 1 BIT_MASK 0x100 FORMAT "%13.11" ECU_ADDRESS 0x383A2C /end MEASUREMENT
/begin MEASUREMENT B_npaave "Fehlertyp 'unplausibles Prüfresultat' erkannt (Endstufe AAV)" UWORD B_TRUE 1 100 0 1 BIT_MASK 0x800 FORMAT "%13.11" ECU_ADDRESS 0x38390E /end MEASUREMENT
/begin MEASUREMENT B_npagre "Fehlerart: Abgasrückführungsventil Endstufe" UWORD B_TRUE 1 100 0 1 BIT_MASK 0x800 FORMAT "%13.11" ECU_ADDRESS 0x383910 /end MEASUREMENT
/begin MEASUREMENT B_npatr "Nicht plausibel Fehler Abgastemperaturregelung" UWORD B_TRUE 1 100 0 1 BIT_MASK 0x800 FORMAT "%13.11" ECU_ADDRESS 0x383914 /end MEASUREMENT
/begin MEASUREMENT B_npatr2 "Nicht plausible Fehler Abgastemperaturregelung Bank 2" UWORD B_TRUE 1 100 0 1 BIT_MASK 0x800 FORMAT "%13.11" ECU_ADDRESS 0x383916 /end MEASUREMENT
/begin MEASUREMENT B_npatrd "Bedingung: Unplausible Bankabweichung ATR" UWORD B_TRUE 1 100 0 1 BIT_MASK 0x800 FORMAT "%13.11" ECU_ADDRESS 0x383918 /end MEASUREMENT
/begin MEASUREMENT B_npatrd2 "Bedingung: Unplausible Bankabweichung ATR Bank 2" UWORD B_TRUE 1 100 0 1 BIT_MASK 0x800 FORMAT "%13.11" ECU_ADDRESS 0x38391A /end MEASUREMENT
/begin MEASUREMENT B_npats "Fehlerart:  Nichtplausibel Fehler Abgastemperatursensor" UWORD B_TRUE 1 100 0 1 BIT_MASK 0x800 FORMAT "%13.11" ECU_ADDRESS 0x38391C /end MEASUREMENT
/begin MEASUREMENT B_npbkvp "Fehlertyp unplaus.: Bremskraftverstärler-Pumpe" UWORD B_TRUE 1 100 0 1 BIT_MASK 0x800 FORMAT "%13.11" ECU_ADDRESS 0x38391E /end MEASUREMENT
/begin MEASUREMENT B_npbkvpe "Fehlerart: Zustand nicht plausibel an BKV-Pumpe-Endstufe" UWORD B_TRUE 1 100 0 1 BIT_MASK 0x800 FORMAT "%13.11" ECU_ADDRESS 0x383920 /end MEASUREMENT
/begin MEASUREMENT B_npbm "Fehlertyp: Bezugsmarkenfehler beim Lückencheck" UWORD B_TRUE 1 100 0 1 BIT_MASK 0x800 FORMAT "%13.11" ECU_ADDRESS 0x383922 /end MEASUREMENT
/begin MEASUREMENT B_npcv "Fehlerart: NN" UWORD B_TRUE 1 100 0 1 BIT_MASK 0x800 FORMAT "%13.11" ECU_ADDRESS 0x38393A /end MEASUREMENT
/begin MEASUREMENT B_npdk "Bedingung unplausible Potisignale von der Drosselklappe" UWORD B_TRUE 1 100 0 1 BIT_MASK 0x800 FORMAT "%13.11" ECU_ADDRESS 0x38393C /end MEASUREMENT
/begin MEASUREMENT B_npdk1p "Fehlertyp unplaus.: Drosselklappe 1. Poti" UWORD B_TRUE 1 100 0 1 BIT_MASK 0x800 FORMAT "%13.11" ECU_ADDRESS 0x38393E /end MEASUREMENT
/begin MEASUREMENT B_npdk2p "Fehlertyp unplaus.: Drosselklappe 2. Poti" UWORD B_TRUE 1 100 0 1 BIT_MASK 0x800 FORMAT "%13.11" ECU_ADDRESS 0x383940 /end MEASUREMENT
/begin MEASUREMENT B_npdvee "Fehlerzyp unplaus.: DV-E Endstufe" UWORD B_TRUE 1 100 0 1 BIT_MASK 0x800 FORMAT "%13.11" ECU_ADDRESS 0x38394C /end MEASUREMENT
/begin MEASUREMENT B_npdvef "Fehlertyp unplaus.: DV-E Fehler bei Federprüfung" UWORD B_TRUE 1 100 0 1 BIT_MASK 0x800 FORMAT "%13.11" ECU_ADDRESS 0x38394E /end MEASUREMENT
/begin MEASUREMENT B_npdvefo "" UWORD B_TRUE 1 100 0 1 BIT_MASK 0x800 FORMAT "%13.11" ECU_ADDRESS 0x383950 /end MEASUREMENT
/begin MEASUREMENT B_npdvel "Fehlerzyp unplaus.: DV-E Lageabweichung" UWORD B_TRUE 1 100 0 1 BIT_MASK 0x800 FORMAT "%13.11" ECU_ADDRESS 0x383952 /end MEASUREMENT
/begin MEASUREMENT B_npdven "Fehlertyp unplaus.: DV-E Fehler bei Prüfung Notluftposition" UWORD B_TRUE 1 100 0 1 BIT_MASK 0x800 FORMAT "%13.11" ECU_ADDRESS 0x383954 /end MEASUREMENT
/begin MEASUREMENT B_npdver "Fehlerzyp unplaus.: DV-E Regelbereich" UWORD B_TRUE 1 100 0 1 BIT_MASK 0x800 FORMAT "%13.11" ECU_ADDRESS 0x383956 /end MEASUREMENT
/begin MEASUREMENT B_npdvet "Fehlertyp ""unplausibel"": DV-E-Tauscherkennung ohne Adaption" UWORD B_TRUE 1 100 0 1 BIT_MASK 0x800 FORMAT "%13.11" ECU_ADDRESS 0x383958 /end MEASUREMENT
/begin MEASUREMENT B_npdveu "Fehlertyp unplaus.: DV-E Fehler beim UMA-Lernen" UWORD B_TRUE 1 100 0 1 BIT_MASK 0x800 FORMAT "%13.11" ECU_ADDRESS 0x38395A /end MEASUREMENT
/begin MEASUREMENT B_npdveub "" UWORD B_TRUE 1 100 0 1 BIT_MASK 0x800 FORMAT "%13.11" ECU_ADDRESS 0x38395C /end MEASUREMENT
/begin MEASUREMENT B_npdveuw "Fehlertyp ""unplausibel"" bei UMA-Wiederlernen" UWORD B_TRUE 1 100 0 1 BIT_MASK 0x800 FORMAT "%13.11" ECU_ADDRESS 0x38395E /end MEASUREMENT
/begin MEASUREMENT B_npdvev "Fehlertyp unplaus.: DV-E Fehler bei Verstärkerabgleich" UWORD B_TRUE 1 100 0 1 BIT_MASK 0x800 FORMAT "%13.11" ECU_ADDRESS 0x383960 /end MEASUREMENT
/begin MEASUREMENT B_npenws "Bed. Nockenwellenverstellung hat unplausible Position (Einlaß,Bank1)" UWORD B_TRUE 1 100 0 1 BIT_MASK 0x800 FORMAT "%13.11" ECU_ADDRESS 0x383966 /end MEASUREMENT
/begin MEASUREMENT B_npenwse "Fehlertyp unplaus.: Nockenwellensteuerung Endstufe (Einlaß, Bank1)" UWORD B_TRUE 1 100 0 1 BIT_MASK 0x800 FORMAT "%13.11" ECU_ADDRESS 0x383968 /end MEASUREMENT
/begin MEASUREMENT B_npepcle "" UWORD B_TRUE 1 100 0 1 BIT_MASK 0x800 FORMAT "%13.11" ECU_ADDRESS 0x38396A /end MEASUREMENT
/begin MEASUREMENT B_npev1 "Fehlerart: Zustand nicht plausibel EV1" UWORD B_TRUE 1 100 0 1 BIT_MASK 0x800 FORMAT "%13.11" ECU_ADDRESS 0x38396C /end MEASUREMENT
/begin MEASUREMENT B_npev2 "Fehlerart: Zustand nicht plausibel EV2" UWORD B_TRUE 1 100 0 1 BIT_MASK 0x800 FORMAT "%13.11" ECU_ADDRESS 0x38396E /end MEASUREMENT
/begin MEASUREMENT B_npev3 "Fehlerart: Zustand nicht plausibel EV3" UWORD B_TRUE 1 100 0 1 BIT_MASK 0x800 FORMAT "%13.11" ECU_ADDRESS 0x383970 /end MEASUREMENT
/begin MEASUREMENT B_npev4 "Fehlerart: Zustand nicht plausibel EV4" UWORD B_TRUE 1 100 0 1 BIT_MASK 0x800 FORMAT "%13.11" ECU_ADDRESS 0x383972 /end MEASUREMENT
/begin MEASUREMENT B_nphsh "Nernstwiderstand Sonde hinter Kat zu groß" UWORD B_TRUE 1 100 0 1 BIT_MASK 0x800 FORMAT "%13.11" ECU_ADDRESS 0x383986 /end MEASUREMENT
/begin MEASUREMENT B_nphsh2 "Nernstwiderstand Sonde 2 hinter Kat zu groß" UWORD B_TRUE 1 100 0 1 BIT_MASK 0x800 FORMAT "%13.11" ECU_ADDRESS 0x383988 /end MEASUREMENT
/begin MEASUREMENT B_nphshe "Nicht plausibler Fehler: Lambda-Sonden Heizung hinter Kat. (Endstufe)" UWORD B_TRUE 1 100 0 1 BIT_MASK 0x800 FORMAT "%13.11" ECU_ADDRESS 0x38398A /end MEASUREMENT
/begin MEASUREMENT B_nphsv "Nernstwiderstand Sonde vor Kat zu groß" UWORD B_TRUE 1 100 0 1 BIT_MASK 0x800 FORMAT "%13.11" ECU_ADDRESS 0x38398C /end MEASUREMENT
/begin MEASUREMENT B_nphsv2 "Nernstwiderstand Sonde 2 vor Kat zu groß" UWORD B_TRUE 1 100 0 1 BIT_MASK 0x800 FORMAT "%13.11" ECU_ADDRESS 0x38398E /end MEASUREMENT
/begin MEASUREMENT B_nphsvsa "  reduzierte  LSU-Heizung oder LSU-Kennlinie abgeflacht" UWORD B_TRUE 1 100 0 1 BIT_MASK 0x800 FORMAT "%13.11" ECU_ADDRESS 0x383990 /end MEASUREMENT
/begin MEASUREMENT B_nphsvsa2 "  reduzierte  LSU_2-Heizung oder LSU_2-Kennlinie abgeflacht" UWORD B_TRUE 1 100 0 1 BIT_MASK 0x800 FORMAT "%13.11" ECU_ADDRESS 0x383992 /end MEASUREMENT
/begin MEASUREMENT B_npkat "Fehlertyp 'unplausibles Prüfresultat' erkannt (Katalysator)" UWORD B_TRUE 1 100 0 1 BIT_MASK 0x800 FORMAT "%13.11" ECU_ADDRESS 0x383994 /end MEASUREMENT
/begin MEASUREMENT B_npkpe "Bedingung für Fehlertyp 'Wert unplausibel' für EKP-Relais Endstufe erkannt" UWORD B_TRUE 1 100 0 1 BIT_MASK 0x800 FORMAT "%13.11" ECU_ADDRESS 0x383996 /end MEASUREMENT
/begin MEASUREMENT B_npkrnt "Bedingung Plausibilitätsfehler der KR-Diagnose Integratorsteigung" UWORD B_TRUE 1 100 0 1 BIT_MASK 0x800 FORMAT "%13.11" ECU_ADDRESS 0x3839A0 /end MEASUREMENT
/begin MEASUREMENT B_npkrof "Bedingung Plausibilitätsfehler der KR-Diagnose Resetwert" UWORD B_TRUE 1 100 0 1 BIT_MASK 0x800 FORMAT "%13.11" ECU_ADDRESS 0x3839A2 /end MEASUREMENT
/begin MEASUREMENT B_npkrtp "Bedingung Plausibilitätsfehler der KR-Diagnose Testimpuls" UWORD B_TRUE 1 100 0 1 BIT_MASK 0x800 FORMAT "%13.11" ECU_ADDRESS 0x3839A4 /end MEASUREMENT
/begin MEASUREMENT B_npks1 "Nicht plausibler Fehler: Klopfsensor 1" UWORD B_TRUE 1 100 0 1 BIT_MASK 0x800 FORMAT "%13.11" ECU_ADDRESS 0x3839A6 /end MEASUREMENT
/begin MEASUREMENT B_npks2 "Nicht plausibler Fehler: Klopfsensor 2" UWORD B_TRUE 1 100 0 1 BIT_MASK 0x800 FORMAT "%13.11" ECU_ADDRESS 0x3839A8 /end MEASUREMENT
/begin MEASUREMENT B_npks3 "Nicht plausibler Fehler: Klopfsensor 3" UWORD B_TRUE 1 100 0 1 BIT_MASK 0x800 FORMAT "%13.11" ECU_ADDRESS 0x3839AA /end MEASUREMENT
/begin MEASUREMENT B_npks4 "Nicht plausibler Fehler: Klopfsensor 4" UWORD B_TRUE 1 100 0 1 BIT_MASK 0x800 FORMAT "%13.11" ECU_ADDRESS 0x3839AC /end MEASUREMENT
/begin MEASUREMENT B_nplde "Nicht plausibler Fehler: Ladedrucksteuerventil Endstufe" UWORD B_TRUE 1 100 0 1 BIT_MASK 0x800 FORMAT "%13.11" ECU_ADDRESS 0x3839B4 /end MEASUREMENT
/begin MEASUREMENT B_nplm "Bedingung Plausfehler Hauptfüllungssensor" UWORD B_TRUE 1 100 0 1 BIT_MASK 0x800 FORMAT "%13.11" ECU_ADDRESS 0x3839C4 /end MEASUREMENT
/begin MEASUREMENT B_npmile "Fehlerart: Zustand nicht plausibel an MIL-Endstufe" UWORD B_TRUE 1 100 0 1 BIT_MASK 0x800 FORMAT "%13.11" ECU_ADDRESS 0x3839D8 /end MEASUREMENT
/begin MEASUREMENT B_npn "Fehlerart: häufiger Bezugsmarkenfehler beim Lückencheck" UWORD B_TRUE 1 100 0 1 BIT_MASK 0x800 FORMAT "%13.11" ECU_ADDRESS 0x3839DA /end MEASUREMENT
/begin MEASUREMENT B_npnwse "Nicht plausibler Fehler: Nockenwellenverstellung Endstufe" UWORD B_TRUE 1 100 0 1 BIT_MASK 0x800 FORMAT "%13.11" ECU_ADDRESS 0x3839DE /end MEASUREMENT
/begin MEASUREMENT B_npslpe "Nicht plausibler Fehler: Sekundärluftpumpe Endstufe" UWORD B_TRUE 1 100 0 1 BIT_MASK 0x800 FORMAT "%13.11" ECU_ADDRESS 0x3839EE /end MEASUREMENT
/begin MEASUREMENT B_npslve "Fehlerart: Offsetwert Sekundärluftmasse Endstufe" UWORD B_TRUE 1 100 0 1 BIT_MASK 0x800 FORMAT "%13.11" ECU_ADDRESS 0x3839F4 /end MEASUREMENT
/begin MEASUREMENT B_npteve "Nicht plausibler Fehler: Tankentlüftungsventil Endstufe" UWORD B_TRUE 1 100 0 1 BIT_MASK 0x800 FORMAT "%13.11" ECU_ADDRESS 0x383A02 /end MEASUREMENT
/begin MEASUREMENT B_npuvse "Nicht plausibler  Fehler: Endstufe Umluftventil Turbo" UWORD B_TRUE 1 100 0 1 BIT_MASK 0x800 FORMAT "%13.11" ECU_ADDRESS 0x383A1E /end MEASUREMENT
/begin MEASUREMENT B_npzet1 "" UWORD B_TRUE 1 100 0 1 BIT_MASK 0x800 FORMAT "%13.11" ECU_ADDRESS 0x383A26 /end MEASUREMENT
/begin MEASUREMENT B_npzet2 "" UWORD B_TRUE 1 100 0 1 BIT_MASK 0x800 FORMAT "%13.11" ECU_ADDRESS 0x383A28 /end MEASUREMENT
/begin MEASUREMENT B_npzet3 "" UWORD B_TRUE 1 100 0 1 BIT_MASK 0x800 FORMAT "%13.11" ECU_ADDRESS 0x383A2A /end MEASUREMENT
/begin MEASUREMENT B_npzet4 "" UWORD B_TRUE 1 100 0 1 BIT_MASK 0x800 FORMAT "%13.11" ECU_ADDRESS 0x383A2C /end MEASUREMENT
/begin MEASUREMENT B_siaave "Fehlerart: Leitungsabfall Absperrventil Aktivkohlefilter (Endstufe)" UWORD B_TRUE 1 100 0 1 BIT_MASK 0x400 FORMAT "%13.11" ECU_ADDRESS 0x38390E /end MEASUREMENT
/begin MEASUREMENT B_siagre "Fehlertype: Leitungsabfall Endstufe AGR-Ventil" UWORD B_TRUE 1 100 0 1 BIT_MASK 0x400 FORMAT "%13.11" ECU_ADDRESS 0x383910 /end MEASUREMENT
/begin MEASUREMENT B_siatr "Signalfehler Abgastemperaturregelung" UWORD B_TRUE 1 100 0 1 BIT_MASK 0x400 FORMAT "%13.11" ECU_ADDRESS 0x383914 /end MEASUREMENT
/begin MEASUREMENT B_siatr2 "Signalfehler Abgastemperaturregelung Bank 2" UWORD B_TRUE 1 100 0 1 BIT_MASK 0x400 FORMAT "%13.11" ECU_ADDRESS 0x383916 /end MEASUREMENT
/begin MEASUREMENT B_siatrd "" UWORD B_TRUE 1 100 0 1 BIT_MASK 0x400 FORMAT "%13.11" ECU_ADDRESS 0x383918 /end MEASUREMENT
/begin MEASUREMENT B_siatrd2 "" UWORD B_TRUE 1 100 0 1 BIT_MASK 0x400 FORMAT "%13.11" ECU_ADDRESS 0x38391A /end MEASUREMENT
/begin MEASUREMENT B_siats "Fehlerart:  Signalfehler Abgastemperatursensor" UWORD B_TRUE 1 100 0 1 BIT_MASK 0x400 FORMAT "%13.11" ECU_ADDRESS 0x38391C /end MEASUREMENT
/begin MEASUREMENT B_sibkvp "Fehlerart: Bremskraftverstärker-Pumpe" UWORD B_TRUE 1 100 0 1 BIT_MASK 0x400 FORMAT "%13.11" ECU_ADDRESS 0x38391E /end MEASUREMENT
/begin MEASUREMENT B_sibkvpe "Fehlerart: Unterbrechung an BKV-Pumpe-Endstufe" UWORD B_TRUE 1 100 0 1 BIT_MASK 0x400 FORMAT "%13.11" ECU_ADDRESS 0x383920 /end MEASUREMENT
/begin MEASUREMENT B_sibm "Fehlertyp: keine Bezugsmarke im Start gefunden" UWORD B_TRUE 1 100 0 1 BIT_MASK 0x400 FORMAT "%13.11" ECU_ADDRESS 0x383922 /end MEASUREMENT
/begin MEASUREMENT B_sicv "Fehlerart: NN" UWORD B_TRUE 1 100 0 1 BIT_MASK 0x400 FORMAT "%13.11" ECU_ADDRESS 0x38393A /end MEASUREMENT
/begin MEASUREMENT B_sidk "Fehlertyp signal: Drosselklappenpoti" UWORD B_TRUE 1 100 0 1 BIT_MASK 0x400 FORMAT "%13.11" ECU_ADDRESS 0x38393C /end MEASUREMENT
/begin MEASUREMENT B_sidk1p "Fehlendes Signal: Drosselklappe 1. Poti" UWORD B_TRUE 1 100 0 1 BIT_MASK 0x400 FORMAT "%13.11" ECU_ADDRESS 0x38393E /end MEASUREMENT
/begin MEASUREMENT B_sidk2p "Fehlendes Signal: Drosselklappe 2. Poti" UWORD B_TRUE 1 100 0 1 BIT_MASK 0x400 FORMAT "%13.11" ECU_ADDRESS 0x383940 /end MEASUREMENT
/begin MEASUREMENT B_sidvee "Fehlertyp sig.: DV-E Endstufe" UWORD B_TRUE 1 100 0 1 BIT_MASK 0x400 FORMAT "%13.11" ECU_ADDRESS 0x38394C /end MEASUREMENT
/begin MEASUREMENT B_sidvef "Fehlertyp sig.: DV-E Fehler bei Federprüfung" UWORD B_TRUE 1 100 0 1 BIT_MASK 0x400 FORMAT "%13.11" ECU_ADDRESS 0x38394E /end MEASUREMENT
/begin MEASUREMENT B_sidvefo "" UWORD B_TRUE 1 100 0 1 BIT_MASK 0x400 FORMAT "%13.11" ECU_ADDRESS 0x383950 /end MEASUREMENT
/begin MEASUREMENT B_sidvel "Fehlertyp sig.: DV-E Lageabweichung" UWORD B_TRUE 1 100 0 1 BIT_MASK 0x400 FORMAT "%13.11" ECU_ADDRESS 0x383952 /end MEASUREMENT
/begin MEASUREMENT B_sidven "Fehlertyp sig.: DV-E Fehler bei Prüfung Notluftposition" UWORD B_TRUE 1 100 0 1 BIT_MASK 0x400 FORMAT "%13.11" ECU_ADDRESS 0x383954 /end MEASUREMENT
/begin MEASUREMENT B_sidver "Fehlertyp sig.: DV-E Regelbereich" UWORD B_TRUE 1 100 0 1 BIT_MASK 0x400 FORMAT "%13.11" ECU_ADDRESS 0x383956 /end MEASUREMENT
/begin MEASUREMENT B_sidvet "" UWORD B_TRUE 1 100 0 1 BIT_MASK 0x400 FORMAT "%13.11" ECU_ADDRESS 0x383958 /end MEASUREMENT
/begin MEASUREMENT B_sidveu "Fehlertyp sig.: DV-E Fehler beim UMA-Lernen" UWORD B_TRUE 1 100 0 1 BIT_MASK 0x400 FORMAT "%13.11" ECU_ADDRESS 0x38395A /end MEASUREMENT
/begin MEASUREMENT B_sidveub "" UWORD B_TRUE 1 100 0 1 BIT_MASK 0x400 FORMAT "%13.11" ECU_ADDRESS 0x38395C /end MEASUREMENT
/begin MEASUREMENT B_sidveuw "" UWORD B_TRUE 1 100 0 1 BIT_MASK 0x400 FORMAT "%13.11" ECU_ADDRESS 0x38395E /end MEASUREMENT
/begin MEASUREMENT B_sidvev "Fehlertyp sig.: DV-E Fehler bei Verstärkerabgleich" UWORD B_TRUE 1 100 0 1 BIT_MASK 0x400 FORMAT "%13.11" ECU_ADDRESS 0x383960 /end MEASUREMENT
/begin MEASUREMENT B_sienws "Fehlerart: Leitungsabfall Nockenwellensteuerungsventil (Bank1, Einlaß)" UWORD B_TRUE 1 100 0 1 BIT_MASK 0x400 FORMAT "%13.11" ECU_ADDRESS 0x383966 /end MEASUREMENT
/begin MEASUREMENT B_sienwse "Fehlerart: Leitungsabfall Nockenwellensteuerungsventil Endstufe (Bank1, Einlaß)" UWORD B_TRUE 1 100 0 1 BIT_MASK 0x400 FORMAT "%13.11" ECU_ADDRESS 0x383968 /end MEASUREMENT
/begin MEASUREMENT B_siepcle "Fehlerart: Unterbrechung an EPCL-Endstufe" UWORD B_TRUE 1 100 0 1 BIT_MASK 0x400 FORMAT "%13.11" ECU_ADDRESS 0x38396A /end MEASUREMENT
/begin MEASUREMENT B_siev1 "Fehlerart: Unterbrechung an Endstufe EV1" UWORD B_TRUE 1 100 0 1 BIT_MASK 0x400 FORMAT "%13.11" ECU_ADDRESS 0x38396C /end MEASUREMENT
/begin MEASUREMENT B_siev2 "Fehlerart: Unterbrechung an Endstufe EV2" UWORD B_TRUE 1 100 0 1 BIT_MASK 0x400 FORMAT "%13.11" ECU_ADDRESS 0x38396E /end MEASUREMENT
/begin MEASUREMENT B_siev3 "Fehlerart: Unterbrechung an Endstufe EV3" UWORD B_TRUE 1 100 0 1 BIT_MASK 0x400 FORMAT "%13.11" ECU_ADDRESS 0x383970 /end MEASUREMENT
/begin MEASUREMENT B_siev4 "Fehlerart: Unterbrechung an Endstufe EV4" UWORD B_TRUE 1 100 0 1 BIT_MASK 0x400 FORMAT "%13.11" ECU_ADDRESS 0x383972 /end MEASUREMENT
/begin MEASUREMENT B_sihsh "Lastabfall Sondenheizung hinter Kat" UWORD B_TRUE 1 100 0 1 BIT_MASK 0x400 FORMAT "%13.11" ECU_ADDRESS 0x383986 /end MEASUREMENT
/begin MEASUREMENT B_sihsh2 "Lastabfall Sondenheizung2 hinter Kat" UWORD B_TRUE 1 100 0 1 BIT_MASK 0x400 FORMAT "%13.11" ECU_ADDRESS 0x383988 /end MEASUREMENT
/begin MEASUREMENT B_sihshe "Lastabfall Sondenheizung hinter Kat (Endstufe)" UWORD B_TRUE 1 100 0 1 BIT_MASK 0x400 FORMAT "%13.11" ECU_ADDRESS 0x38398A /end MEASUREMENT
/begin MEASUREMENT B_sihsv "Lastabfall Sondenheizung vor Kat" UWORD B_TRUE 1 100 0 1 BIT_MASK 0x400 FORMAT "%13.11" ECU_ADDRESS 0x38398C /end MEASUREMENT
/begin MEASUREMENT B_sihsv2 "Lastabfall Sondenheizung2 vor Kat" UWORD B_TRUE 1 100 0 1 BIT_MASK 0x400 FORMAT "%13.11" ECU_ADDRESS 0x38398E /end MEASUREMENT
/begin MEASUREMENT B_sihsvsa "Signal - Fehler erkannt" UWORD B_TRUE 1 100 0 1 BIT_MASK 0x400 FORMAT "%13.11" ECU_ADDRESS 0x383990 /end MEASUREMENT
/begin MEASUREMENT B_sihsvsa2 "Signal - Fehler erkannt Bank 2" UWORD B_TRUE 1 100 0 1 BIT_MASK 0x400 FORMAT "%13.11" ECU_ADDRESS 0x383992 /end MEASUREMENT
/begin MEASUREMENT B_sikat "Fehlertyp 'Signal fehlt' für DKAT erkannt" UWORD B_TRUE 1 100 0 1 BIT_MASK 0x400 FORMAT "%13.11" ECU_ADDRESS 0x383994 /end MEASUREMENT
/begin MEASUREMENT B_sikpe "Bedingung für Fehlertyp Leitungsabfall für EKP-Relais Endstufe erkannt" UWORD B_TRUE 1 100 0 1 BIT_MASK 0x400 FORMAT "%13.11" ECU_ADDRESS 0x383996 /end MEASUREMENT
/begin MEASUREMENT B_sikrnt "Fehlertyp: Klopfregelung Nulltest" UWORD B_TRUE 1 100 0 1 BIT_MASK 0x400 FORMAT "%13.11" ECU_ADDRESS 0x3839A0 /end MEASUREMENT
/begin MEASUREMENT B_sikrof "Fehlertyp: Klopfregelung Offset" UWORD B_TRUE 1 100 0 1 BIT_MASK 0x400 FORMAT "%13.11" ECU_ADDRESS 0x3839A2 /end MEASUREMENT
/begin MEASUREMENT B_sikrtp "Fehlertyp: Klopfregelung Testimpuls" UWORD B_TRUE 1 100 0 1 BIT_MASK 0x400 FORMAT "%13.11" ECU_ADDRESS 0x3839A4 /end MEASUREMENT
/begin MEASUREMENT B_siks1 "Fehlertyp: Klopfsensor 1" UWORD B_TRUE 1 100 0 1 BIT_MASK 0x400 FORMAT "%13.11" ECU_ADDRESS 0x3839A6 /end MEASUREMENT
/begin MEASUREMENT B_siks2 "Fehlertyp: Klopfsensor 2" UWORD B_TRUE 1 100 0 1 BIT_MASK 0x400 FORMAT "%13.11" ECU_ADDRESS 0x3839A8 /end MEASUREMENT
/begin MEASUREMENT B_siks3 "Fehlertyp: Klopfsensor 3" UWORD B_TRUE 1 100 0 1 BIT_MASK 0x400 FORMAT "%13.11" ECU_ADDRESS 0x3839AA /end MEASUREMENT
/begin MEASUREMENT B_siks4 "Fehlertyp: Klopfsensor 4" UWORD B_TRUE 1 100 0 1 BIT_MASK 0x400 FORMAT "%13.11" ECU_ADDRESS 0x3839AC /end MEASUREMENT
/begin MEASUREMENT B_silde "Fehlertyp: Leitungsabfall LDR-Taktventil" UWORD B_TRUE 1 100 0 1 BIT_MASK 0x400 FORMAT "%13.11" ECU_ADDRESS 0x3839B4 /end MEASUREMENT
/begin MEASUREMENT B_silm "Bedingung Signalfehler Hauptfüllungssensor" UWORD B_TRUE 1 100 0 1 BIT_MASK 0x400 FORMAT "%13.11" ECU_ADDRESS 0x3839C4 /end MEASUREMENT
/begin MEASUREMENT B_simile "Fehlerart: Unterbrechung an MIL-Endstufe" UWORD B_TRUE 1 100 0 1 BIT_MASK 0x400 FORMAT "%13.11" ECU_ADDRESS 0x3839D8 /end MEASUREMENT
/begin MEASUREMENT B_sin "Fehlertyp: kein Drehzahlsignal vorhanden" UWORD B_TRUE 1 100 0 1 BIT_MASK 0x400 FORMAT "%13.11" ECU_ADDRESS 0x3839DA /end MEASUREMENT
/begin MEASUREMENT B_sinwse "Fehlerart: Leitungsabfall Nockenwellensteuerungsventil Endstufe" UWORD B_TRUE 1 100 0 1 BIT_MASK 0x400 FORMAT "%13.11" ECU_ADDRESS 0x3839DE /end MEASUREMENT
/begin MEASUREMENT B_sislpe "Fehlertype: Leitungsabfall Endstufe Sekundärluftpumpe" UWORD B_TRUE 1 100 0 1 BIT_MASK 0x400 FORMAT "%13.11" ECU_ADDRESS 0x3839EE /end MEASUREMENT
/begin MEASUREMENT B_sislve "Fehlertype: Leitungsabfall Endstufe Sekundärluftventil" UWORD B_TRUE 1 100 0 1 BIT_MASK 0x400 FORMAT "%13.11" ECU_ADDRESS 0x3839F4 /end MEASUREMENT
/begin MEASUREMENT B_siteve "Fehlertyp: Leitungsabfall Tankentlüftungsventil Endstufe" UWORD B_TRUE 1 100 0 1 BIT_MASK 0x400 FORMAT "%13.11" ECU_ADDRESS 0x383A02 /end MEASUREMENT
/begin MEASUREMENT B_siuvse "Fehlertyp: Leitungsabfall Umluftventil turbo" UWORD B_TRUE 1 100 0 1 BIT_MASK 0x400 FORMAT "%13.11" ECU_ADDRESS 0x383A1E /end MEASUREMENT
/begin MEASUREMENT B_sizet1 "" UWORD B_TRUE 1 100 0 1 BIT_MASK 0x400 FORMAT "%13.11" ECU_ADDRESS 0x383A26 /end MEASUREMENT
/begin MEASUREMENT B_sizet2 "" UWORD B_TRUE 1 100 0 1 BIT_MASK 0x400 FORMAT "%13.11" ECU_ADDRESS 0x383A28 /end MEASUREMENT
/begin MEASUREMENT B_sizet3 "" UWORD B_TRUE 1 100 0 1 BIT_MASK 0x400 FORMAT "%13.11" ECU_ADDRESS 0x383A2A /end MEASUREMENT
/begin MEASUREMENT B_sizet4 "" UWORD B_TRUE 1 100 0 1 BIT_MASK 0x400 FORMAT "%13.11" ECU_ADDRESS 0x383A2C /end MEASUREMENT
/begin MEASUREMENT E_aaa "Dummy: Tabellenanfang" UWORD B_TRUE 1 100 0 1 BIT_MASK 0x1 FORMAT "%13.11" ECU_ADDRESS 0x383908 /end MEASUREMENT
/begin MEASUREMENT E_aave "Errorflag: Absperrventil Aktivkohlefilter (Endstufe)" UWORD B_TRUE 1 100 0 1 BIT_MASK 0x1 FORMAT "%13.11" ECU_ADDRESS 0x38390E /end MEASUREMENT
/begin MEASUREMENT E_agre "Errorflag: Überwachung AGR-Endstufe" UWORD B_TRUE 1 100 0 1 BIT_MASK 0x1 FORMAT "%13.11" ECU_ADDRESS 0x383910 /end MEASUREMENT
/begin MEASUREMENT E_atr "Errorflag Abgastemperaturregelung" UWORD B_TRUE 1 100 0 1 BIT_MASK 0x1 FORMAT "%13.11" ECU_ADDRESS 0x383914 /end MEASUREMENT
/begin MEASUREMENT E_atr2 "Errorflag Abgastemperaturregelung Bank 2" UWORD B_TRUE 1 100 0 1 BIT_MASK 0x1 FORMAT "%13.11" ECU_ADDRESS 0x383916 /end MEASUREMENT
/begin MEASUREMENT E_atrd "Errorflag: Bankdifferenz ATR" UWORD B_TRUE 1 100 0 1 BIT_MASK 0x1 FORMAT "%13.11" ECU_ADDRESS 0x383918 /end MEASUREMENT
/begin MEASUREMENT E_atrd2 "Errorflag: Bankdifferenz ATR Bank 2" UWORD B_TRUE 1 100 0 1 BIT_MASK 0x1 FORMAT "%13.11" ECU_ADDRESS 0x38391A /end MEASUREMENT
/begin MEASUREMENT E_ats "Errorflag Abgastemperatursensor" UWORD B_TRUE 1 100 0 1 BIT_MASK 0x1 FORMAT "%13.11" ECU_ADDRESS 0x38391C /end MEASUREMENT
/begin MEASUREMENT E_bkvp "Fehlerflag: BKV-Pumpe" UWORD B_TRUE 1 100 0 1 BIT_MASK 0x1 FORMAT "%13.11" ECU_ADDRESS 0x38391E /end MEASUREMENT
/begin MEASUREMENT E_bkvpe "Fehlerflag: BKV-Pumpe-Endstufe" UWORD B_TRUE 1 100 0 1 BIT_MASK 0x1 FORMAT "%13.11" ECU_ADDRESS 0x383920 /end MEASUREMENT
/begin MEASUREMENT E_bm "Errorflag: Bezugsmarkengeber" UWORD B_TRUE 1 100 0 1 BIT_MASK 0x1 FORMAT "%13.11" ECU_ADDRESS 0x383922 /end MEASUREMENT
/begin MEASUREMENT E_cv "Errorflag: Diagnose Kurbelgehäuseentlüftung" UWORD B_TRUE 1 100 0 1 BIT_MASK 0x1 FORMAT "%13.11" ECU_ADDRESS 0x38393A /end MEASUREMENT
/begin MEASUREMENT E_dk "Errorflag: DK - Potentiometer" UWORD B_TRUE 1 100 0 1 BIT_MASK 0x1 FORMAT "%13.11" ECU_ADDRESS 0x38393C /end MEASUREMENT
/begin MEASUREMENT E_dk1p "Errorflag: Drosselklappe 1. Poti" UWORD B_TRUE 1 100 0 1 BIT_MASK 0x1 FORMAT "%13.11" ECU_ADDRESS 0x38393E /end MEASUREMENT
/begin MEASUREMENT E_dk2p "Errorflag: Drosselklappe 2. Poti" UWORD B_TRUE 1 100 0 1 BIT_MASK 0x1 FORMAT "%13.11" ECU_ADDRESS 0x383940 /end MEASUREMENT
/begin MEASUREMENT E_dvee "Errorflag: DV-E Endstufe" UWORD B_TRUE 1 100 0 1 BIT_MASK 0x1 FORMAT "%13.11" ECU_ADDRESS 0x38394C /end MEASUREMENT
/begin MEASUREMENT E_dvef "Errorflag: DV-E Fehler bei Federprüfung" UWORD B_TRUE 1 100 0 1 BIT_MASK 0x1 FORMAT "%13.11" ECU_ADDRESS 0x38394E /end MEASUREMENT
/begin MEASUREMENT E_dvefo "Errorflag: DV-E-Fehler bei Federprüfung ""Öffnen""" UWORD B_TRUE 1 100 0 1 BIT_MASK 0x1 FORMAT "%13.11" ECU_ADDRESS 0x383950 /end MEASUREMENT
/begin MEASUREMENT E_dvel "Errorflag: DV-E Lageabweichung" UWORD B_TRUE 1 100 0 1 BIT_MASK 0x1 FORMAT "%13.11" ECU_ADDRESS 0x383952 /end MEASUREMENT
/begin MEASUREMENT E_dven "Errorflag: DV-E Fehler bei Prüfung Notluftposition" UWORD B_TRUE 1 100 0 1 BIT_MASK 0x1 FORMAT "%13.11" ECU_ADDRESS 0x383954 /end MEASUREMENT
/begin MEASUREMENT E_dver "Errorflag: DV-E Regelbereich" UWORD B_TRUE 1 100 0 1 BIT_MASK 0x1 FORMAT "%13.11" ECU_ADDRESS 0x383956 /end MEASUREMENT
/begin MEASUREMENT E_dvet "Errorflag: DV-E-Tauscherkennung ohne Adaption" UWORD B_TRUE 1 100 0 1 BIT_MASK 0x1 FORMAT "%13.11" ECU_ADDRESS 0x383958 /end MEASUREMENT
/begin MEASUREMENT E_dveu "Errorflag: DV-E Fehler beim UMA-Lernen" UWORD B_TRUE 1 100 0 1 BIT_MASK 0x1 FORMAT "%13.11" ECU_ADDRESS 0x38395A /end MEASUREMENT
/begin MEASUREMENT E_dveub "Errorflag: DV-E-Adaption Abbruch wg. Umweltbedingung" UWORD B_TRUE 1 100 0 1 BIT_MASK 0x1 FORMAT "%13.11" ECU_ADDRESS 0x38395C /end MEASUREMENT
/begin MEASUREMENT E_dveuw "Errorflag: Fehler bei UMA-Wiederlernen" UWORD B_TRUE 1 100 0 1 BIT_MASK 0x1 FORMAT "%13.11" ECU_ADDRESS 0x38395E /end MEASUREMENT
/begin MEASUREMENT E_dvev "Errorflag: DV-E Fehler bei Verstärkerabgleich" UWORD B_TRUE 1 100 0 1 BIT_MASK 0x1 FORMAT "%13.11" ECU_ADDRESS 0x383960 /end MEASUREMENT
/begin MEASUREMENT E_enws "Errorflag: Nockenwellensteuerung (Einlaß,Bank1)" UWORD B_TRUE 1 100 0 1 BIT_MASK 0x1 FORMAT "%13.11" ECU_ADDRESS 0x383966 /end MEASUREMENT
/begin MEASUREMENT E_enwse "Errorflag: Endstufe Nockenwellensteuerung (Einlaß, Bank1)" UWORD B_TRUE 1 100 0 1 BIT_MASK 0x1 FORMAT "%13.11" ECU_ADDRESS 0x383968 /end MEASUREMENT
/begin MEASUREMENT E_epcle "Fehlerflag: EPCL-Endstufe" UWORD B_TRUE 1 100 0 1 BIT_MASK 0x1 FORMAT "%13.11" ECU_ADDRESS 0x38396A /end MEASUREMENT
/begin MEASUREMENT E_ev1 "Errorflag: EV von Zyl. 1" UWORD B_TRUE 1 100 0 1 BIT_MASK 0x1 FORMAT "%13.11" ECU_ADDRESS 0x38396C /end MEASUREMENT
/begin MEASUREMENT E_ev2 "Errorflag: EV von Zyl. 2" UWORD B_TRUE 1 100 0 1 BIT_MASK 0x1 FORMAT "%13.11" ECU_ADDRESS 0x38396E /end MEASUREMENT
/begin MEASUREMENT E_ev3 "Errorflag: EV von Zyl. 3" UWORD B_TRUE 1 100 0 1 BIT_MASK 0x1 FORMAT "%13.11" ECU_ADDRESS 0x383970 /end MEASUREMENT
/begin MEASUREMENT E_ev4 "Errorflag: EV von Zyl. 4" UWORD B_TRUE 1 100 0 1 BIT_MASK 0x1 FORMAT "%13.11" ECU_ADDRESS 0x383972 /end MEASUREMENT
/begin MEASUREMENT E_hsh "Errorflag: Lambdasonden-Heizung hinter Katalysator" UWORD B_TRUE 1 100 0 1 BIT_MASK 0x1 FORMAT "%13.11" ECU_ADDRESS 0x383986 /end MEASUREMENT
/begin MEASUREMENT E_hsh2 "Errorflag: Lambdasonden-Heizung hinter Katalysator Bank 2" UWORD B_TRUE 1 100 0 1 BIT_MASK 0x1 FORMAT "%13.11" ECU_ADDRESS 0x383988 /end MEASUREMENT
/begin MEASUREMENT E_hshe "Errorflag: Lambdasonden-Heizung hinter Katalysator (Endstufe)" UWORD B_TRUE 1 100 0 1 BIT_MASK 0x1 FORMAT "%13.11" ECU_ADDRESS 0x38398A /end MEASUREMENT
/begin MEASUREMENT E_hsv "Errorflag: Lambdasonden-Heizung vor Katalysator" UWORD B_TRUE 1 100 0 1 BIT_MASK 0x1 FORMAT "%13.11" ECU_ADDRESS 0x38398C /end MEASUREMENT
/begin MEASUREMENT E_hsv2 "Errorflag: Lambdasonden-Heizung vor Katalysator Bank 2" UWORD B_TRUE 1 100 0 1 BIT_MASK 0x1 FORMAT "%13.11" ECU_ADDRESS 0x38398E /end MEASUREMENT
/begin MEASUREMENT E_hsvsa "Errorflag: reduzierte  LSU-Heizung oder LSU-Kennlinie abgeflacht" UWORD B_TRUE 1 100 0 1 BIT_MASK 0x1 FORMAT "%13.11" ECU_ADDRESS 0x383990 /end MEASUREMENT
/begin MEASUREMENT E_hsvsa2 "Errorflag: reduzierte  LSU_2-Heizung oder LSU_2-Kennlinie abgeflacht" UWORD B_TRUE 1 100 0 1 BIT_MASK 0x1 FORMAT "%13.11" ECU_ADDRESS 0x383992 /end MEASUREMENT
/begin MEASUREMENT E_kat "Errorflag: Katalysator-Konvertierung" UWORD B_TRUE 1 100 0 1 BIT_MASK 0x1 FORMAT "%13.11" ECU_ADDRESS 0x383994 /end MEASUREMENT
/begin MEASUREMENT E_kpe "Errorflag: EKP-Relais Endstufe" UWORD B_TRUE 1 100 0 1 BIT_MASK 0x1 FORMAT "%13.11" ECU_ADDRESS 0x383996 /end MEASUREMENT
/begin MEASUREMENT E_kra01 "Errorflag: Klopfregelanschlag Zyl.1" UWORD B_TRUE 1 100 0 1 BIT_MASK 0x1 FORMAT "%13.11" ECU_ADDRESS 0x383998 /end MEASUREMENT
/begin MEASUREMENT E_kra02 "Errorflag: Klopfregelanschlag Zyl.2" UWORD B_TRUE 1 100 0 1 BIT_MASK 0x1 FORMAT "%13.11" ECU_ADDRESS 0x38399A /end MEASUREMENT
/begin MEASUREMENT E_kra03 "Errorflag: Klopfregelanschlag Zyl.3" UWORD B_TRUE 1 100 0 1 BIT_MASK 0x1 FORMAT "%13.11" ECU_ADDRESS 0x38399C /end MEASUREMENT
/begin MEASUREMENT E_kra04 "Errorflag: Klopfregelanschlag Zyl.4" UWORD B_TRUE 1 100 0 1 BIT_MASK 0x1 FORMAT "%13.11" ECU_ADDRESS 0x38399E /end MEASUREMENT
/begin MEASUREMENT E_krnt "Errorflag: Klopfregelung Nulltest" UWORD B_TRUE 1 100 0 1 BIT_MASK 0x1 FORMAT "%13.11" ECU_ADDRESS 0x3839A0 /end MEASUREMENT
/begin MEASUREMENT E_krof "Errorflag: Klopfregelung Offset" UWORD B_TRUE 1 100 0 1 BIT_MASK 0x1 FORMAT "%13.11" ECU_ADDRESS 0x3839A2 /end MEASUREMENT
/begin MEASUREMENT E_krtp "Errorflag: Klopfregelung Testimpuls" UWORD B_TRUE 1 100 0 1 BIT_MASK 0x1 FORMAT "%13.11" ECU_ADDRESS 0x3839A4 /end MEASUREMENT
/begin MEASUREMENT E_ks1 "Errorflag: Klopfsensor 1" UWORD B_TRUE 1 100 0 1 BIT_MASK 0x1 FORMAT "%13.11" ECU_ADDRESS 0x3839A6 /end MEASUREMENT
/begin MEASUREMENT E_ks2 "Errorflag: Klopfsensor 2" UWORD B_TRUE 1 100 0 1 BIT_MASK 0x1 FORMAT "%13.11" ECU_ADDRESS 0x3839A8 /end MEASUREMENT
/begin MEASUREMENT E_ks3 "Errorflag: Klopfsensor 3" UWORD B_TRUE 1 100 0 1 BIT_MASK 0x1 FORMAT "%13.11" ECU_ADDRESS 0x3839AA /end MEASUREMENT
/begin MEASUREMENT E_ks4 "Errorflag: Klopfsensor 4" UWORD B_TRUE 1 100 0 1 BIT_MASK 0x1 FORMAT "%13.11" ECU_ADDRESS 0x3839AC /end MEASUREMENT
/begin MEASUREMENT E_lde "Errorflag: Ladedrucksteuerventil (Endstufe)" UWORD B_TRUE 1 100 0 1 BIT_MASK 0x1 FORMAT "%13.11" ECU_ADDRESS 0x3839B4 /end MEASUREMENT
/begin MEASUREMENT E_lm "Errorflag: Hauptlastsensor" UWORD B_TRUE 1 100 0 1 BIT_MASK 0x1 FORMAT "%13.11" ECU_ADDRESS 0x3839C4 /end MEASUREMENT
/begin MEASUREMENT E_mile "Fehlerflag: MIL-Endstufe" UWORD B_TRUE 1 100 0 1 BIT_MASK 0x1 FORMAT "%13.11" ECU_ADDRESS 0x3839D8 /end MEASUREMENT
/begin MEASUREMENT E_n "Errorflag: Drehzahlsignalgeber" UWORD B_TRUE 1 100 0 1 BIT_MASK 0x1 FORMAT "%13.11" ECU_ADDRESS 0x3839DA /end MEASUREMENT
/begin MEASUREMENT E_nwse "Errorflag: Nockenwellensteuerungsventil Endstufe" UWORD B_TRUE 1 100 0 1 BIT_MASK 0x1 FORMAT "%13.11" ECU_ADDRESS 0x3839DE /end MEASUREMENT
/begin MEASUREMENT E_slpe "Errorflag: Sekundärluftpumpe (Endstufe)" UWORD B_TRUE 1 100 0 1 BIT_MASK 0x1 FORMAT "%13.11" ECU_ADDRESS 0x3839EE /end MEASUREMENT
/begin MEASUREMENT E_slve "Errorflag: Sekundärluftventil (Endstufe)" UWORD B_TRUE 1 100 0 1 BIT_MASK 0x1 FORMAT "%13.11" ECU_ADDRESS 0x3839F4 /end MEASUREMENT
/begin MEASUREMENT E_teve "Errorflag: Tankentlüftungsventil Endstufe" UWORD B_TRUE 1 100 0 1 BIT_MASK 0x1 FORMAT "%13.11" ECU_ADDRESS 0x383A02 /end MEASUREMENT
/begin MEASUREMENT E_uvse "Errorflag: Endstufe Umluftventil Turbo" UWORD B_TRUE 1 100 0 1 BIT_MASK 0x1 FORMAT "%13.11" ECU_ADDRESS 0x383A1E /end MEASUREMENT
/begin MEASUREMENT E_zet1 "Errorflag: Zündtreiber ZUE1" UWORD B_TRUE 1 100 0 1 BIT_MASK 0x1 FORMAT "%13.11" ECU_ADDRESS 0x383A26 /end MEASUREMENT
/begin MEASUREMENT E_zet2 "Errorflag: Zündtreiber ZUE2" UWORD B_TRUE 1 100 0 1 BIT_MASK 0x1 FORMAT "%13.11" ECU_ADDRESS 0x383A28 /end MEASUREMENT
/begin MEASUREMENT E_zet3 "Errorflag: Zündtreiber ZUE3" UWORD B_TRUE 1 100 0 1 BIT_MASK 0x1 FORMAT "%13.11" ECU_ADDRESS 0x383A2A /end MEASUREMENT
/begin MEASUREMENT E_zet4 "Errorflag: Zündtreiber ZUE4" UWORD B_TRUE 1 100 0 1 BIT_MASK 0x1 FORMAT "%13.11" ECU_ADDRESS 0x383A2C /end MEASUREMENT
/begin MEASUREMENT sfpaaa "Status Fehlerpfad: Tabellenanfang" UWORD dez 1 100 0 65535 FORMAT "%8.2" ECU_ADDRESS 0x383908 /end MEASUREMENT
/begin MEASUREMENT sfpaave "Status Fehlerpfad: AAV-Ventil Endstufe" UWORD default 1 100 0 65535 FORMAT "%8.2" ECU_ADDRESS 0x38390E /end MEASUREMENT
/begin MEASUREMENT sfpagre "Status Fehlerpfad: AGR-Ventil Endstufe" UWORD default 1 100 0 65535 FORMAT "%8.2" ECU_ADDRESS 0x383910 /end MEASUREMENT
/begin MEASUREMENT sfpatr "Status Fehlerpfad Abgastemperaturregelung" UWORD dez 1 100 0 65535 FORMAT "%8.2" ECU_ADDRESS 0x383914 /end MEASUREMENT
/begin MEASUREMENT sfpatr2 "Status Fehlerpfad Abgastemperaturregelung Bank 2" UWORD dez 1 100 0 65535 FORMAT "%8.2" ECU_ADDRESS 0x383916 /end MEASUREMENT
/begin MEASUREMENT sfpatrd "" UWORD dez 1 100 0 65535 FORMAT "%8.2" ECU_ADDRESS 0x383918 /end MEASUREMENT
/begin MEASUREMENT sfpatrd2 "" UWORD dez 1 100 0 65535 FORMAT "%8.2" ECU_ADDRESS 0x38391A /end MEASUREMENT
/begin MEASUREMENT sfpats "Status Fehlerpfad Abgastemperatursensor" UWORD dez 1 100 0 65535 FORMAT "%8.2" ECU_ADDRESS 0x38391C /end MEASUREMENT
/begin MEASUREMENT sfpbkvp "Status Fehlerpfad:  Bremskraftverstärker-Pumpe" UWORD default 1 100 0 65535 FORMAT "%8.2" ECU_ADDRESS 0x38391E /end MEASUREMENT
/begin MEASUREMENT sfpbkvpe "Status Fehlerpfad: BKV-Pumpe - Endstufe" UWORD default 1 100 0 65535 FORMAT "%8.2" ECU_ADDRESS 0x383920 /end MEASUREMENT
/begin MEASUREMENT sfpbm "Status Fehlerpfad: Bezugsmarkengeber" UWORD dez 1 100 0 65535 FORMAT "%8.2" ECU_ADDRESS 0x383922 /end MEASUREMENT
/begin MEASUREMENT sfpcv "Status Fehlerpfad: Diagnose Kurbelgehäuseentlüftung" UWORD default 1 100 0 65535 FORMAT "%8.2" ECU_ADDRESS 0x38393A /end MEASUREMENT
/begin MEASUREMENT sfpdk "Status Fehlerpfad DK: Drosselklappe" UWORD dez 1 100 0 65535 FORMAT "%8.2" ECU_ADDRESS 0x38393C /end MEASUREMENT
/begin MEASUREMENT sfpdk1p "Status Fehlerpfad DK1P: Drosselklappe 1. Poti" UWORD dez 1 100 0 65535 FORMAT "%8.2" ECU_ADDRESS 0x38393E /end MEASUREMENT
/begin MEASUREMENT sfpdk2p "Status Fehlerpfad DK2P: Drosselklappe 2. Poti" UWORD dez 1 100 0 65535 FORMAT "%8.2" ECU_ADDRESS 0x383940 /end MEASUREMENT
/begin MEASUREMENT sfpdvee "Statuswort: DV-E Endstufe" UWORD dez 1 100 0 65535 FORMAT "%8.2" ECU_ADDRESS 0x38394C /end MEASUREMENT
/begin MEASUREMENT sfpdvef "Statuswort: DV-E Fehler bei Federprüfung" UWORD dez 1 100 0 65535 FORMAT "%8.2" ECU_ADDRESS 0x38394E /end MEASUREMENT
/begin MEASUREMENT sfpdvefo "Status Fehlerpfad: DV-E-Fehler bei Federprüfung ""Öffnen""" UWORD dez 1 100 0 65535 FORMAT "%8.2" ECU_ADDRESS 0x383950 /end MEASUREMENT
/begin MEASUREMENT sfpdvel "Statuswort: DV-E Lageabweichung" UWORD dez 1 100 0 65535 FORMAT "%8.2" ECU_ADDRESS 0x383952 /end MEASUREMENT
/begin MEASUREMENT sfpdven "Statuswort: DV-E Fehler bei Prüfung Notluftposition" UWORD dez 1 100 0 65535 FORMAT "%8.2" ECU_ADDRESS 0x383954 /end MEASUREMENT
/begin MEASUREMENT sfpdver "Statuswort: DV-E Regelbereich" UWORD dez 1 100 0 65535 FORMAT "%8.2" ECU_ADDRESS 0x383956 /end MEASUREMENT
/begin MEASUREMENT sfpdvet "Status Fehlerpfad: DV-E-Tauchserkennung ohne Adaption" UWORD dez 1 100 0 65535 FORMAT "%8.2" ECU_ADDRESS 0x383958 /end MEASUREMENT
/begin MEASUREMENT sfpdveu "Statuswort: DV-E Fehler beim UMA-Lernen" UWORD dez 1 100 0 65535 FORMAT "%8.2" ECU_ADDRESS 0x38395A /end MEASUREMENT
/begin MEASUREMENT sfpdveub "Status Fehlerpfad: DV-E-Adaption Abbruch wg. Umweltbedingung" UWORD dez 1 100 0 65535 FORMAT "%8.2" ECU_ADDRESS 0x38395C /end MEASUREMENT
/begin MEASUREMENT sfpdveuw "Status Fehlerpfad: UMA-Wiederlernen" UWORD dez 1 100 0 65535 FORMAT "%8.2" ECU_ADDRESS 0x38395E /end MEASUREMENT
/begin MEASUREMENT sfpdvev "Statuswort: DV-E Fehler bei Verstärkerabgleich" UWORD dez 1 100 0 65535 FORMAT "%8.2" ECU_ADDRESS 0x383960 /end MEASUREMENT
/begin MEASUREMENT sfpenws "Status Fehlerpfad: Nockenwellensteuerung (Einlaß, Bank1)" UWORD dez 1 100 0 65535 FORMAT "%8.2" ECU_ADDRESS 0x383966 /end MEASUREMENT
/begin MEASUREMENT sfpenwse "Status Fehlerpfad: Nockenwellensteuerung Endstufe (Einlaß, Bank1)" UWORD default 1 100 0 65535 FORMAT "%8.2" ECU_ADDRESS 0x383968 /end MEASUREMENT
/begin MEASUREMENT sfpepcle "Status Fehlerpfad: Fahrverhaltens-Fehllampe Endstufe" UWORD default 1 100 0 65535 FORMAT "%8.2" ECU_ADDRESS 0x38396A /end MEASUREMENT
/begin MEASUREMENT sfpev1 "Status Fehlerpfad: EV1" UWORD default 1 100 0 65535 FORMAT "%8.2" ECU_ADDRESS 0x38396C /end MEASUREMENT
/begin MEASUREMENT sfpev2 "Status Fehlerpfad: EV2" UWORD default 1 100 0 65535 FORMAT "%8.2" ECU_ADDRESS 0x38396E /end MEASUREMENT
/begin MEASUREMENT sfpev3 "Status Fehlerpfad: EV3" UWORD default 1 100 0 65535 FORMAT "%8.2" ECU_ADDRESS 0x383970 /end MEASUREMENT
/begin MEASUREMENT sfpev4 "Status Fehlerpfad: EV4" UWORD default 1 100 0 65535 FORMAT "%8.2" ECU_ADDRESS 0x383972 /end MEASUREMENT
/begin MEASUREMENT sfphsh "Status Fehlerpfad: Heizung Lambdasonde hinter Kat" UWORD dez 1 100 0 65535 FORMAT "%8.2" ECU_ADDRESS 0x383986 /end MEASUREMENT
/begin MEASUREMENT sfphsh2 "Status Fehlerpfad: Heizung Lambdasonde 2 hinter Kat" UWORD dez 1 100 0 65535 FORMAT "%8.2" ECU_ADDRESS 0x383988 /end MEASUREMENT
/begin MEASUREMENT sfphshe "Status Fehlerpfad: Endstufe Heizung Lambdasonde hinter Kat" UWORD default 1 100 0 65535 FORMAT "%8.2" ECU_ADDRESS 0x38398A /end MEASUREMENT
/begin MEASUREMENT sfphsv "Status Fehlerpfad: Heizung Lambdasonde vor Kat" UWORD dez 1 100 0 65535 FORMAT "%8.2" ECU_ADDRESS 0x38398C /end MEASUREMENT
/begin MEASUREMENT sfphsv2 "Status Fehlerpfad: Heizung Lambdasonde 2 vor Kat" UWORD dez 1 100 0 65535 FORMAT "%8.2" ECU_ADDRESS 0x38398E /end MEASUREMENT
/begin MEASUREMENT sfphsvsa "Status Fehlerpfad: Heizung Lambdasonde vor Kat" UWORD dez 1 100 0 65535 FORMAT "%8.2" ECU_ADDRESS 0x383990 /end MEASUREMENT
/begin MEASUREMENT sfphsvsa2 "Status Fehlerpfad: Heizung Lambdasonde 2 vor Kat" UWORD dez 1 100 0 65535 FORMAT "%8.2" ECU_ADDRESS 0x383992 /end MEASUREMENT
/begin MEASUREMENT sfpkat "Status Fehlerpfad: Katalysator-Überwachung" UWORD dez 1 100 0 65535 FORMAT "%8.2" ECU_ADDRESS 0x383994 /end MEASUREMENT
/begin MEASUREMENT sfpkpe "Status Fehlerpfad: EKP-Relais Endstufe" UWORD default 1 100 0 65535 FORMAT "%8.2" ECU_ADDRESS 0x383996 /end MEASUREMENT
/begin MEASUREMENT sfpkra01 "Status Fehlerpfad: Klopfregelanschlag Zylinder 1" UWORD dez 1 100 0 65535 FORMAT "%8.2" ECU_ADDRESS 0x383998 /end MEASUREMENT
/begin MEASUREMENT sfpkra02 "Status Fehlerpfad: Klopfregelanschlag Zylinder 2" UWORD dez 1 100 0 65535 FORMAT "%8.2" ECU_ADDRESS 0x38399A /end MEASUREMENT
/begin MEASUREMENT sfpkra03 "Status Fehlerpfad: Klopfregelanschlag Zylinder 3" UWORD dez 1 100 0 65535 FORMAT "%8.2" ECU_ADDRESS 0x38399C /end MEASUREMENT
/begin MEASUREMENT sfpkra04 "Status Fehlerpfad: Klopfregelanschlag Zylinder 4" UWORD dez 1 100 0 65535 FORMAT "%8.2" ECU_ADDRESS 0x38399E /end MEASUREMENT
/begin MEASUREMENT sfpkrnt "Status Fehlerpfad: Klopfregelung Nulltest" UWORD dez 1 100 0 65535 FORMAT "%8.2" ECU_ADDRESS 0x3839A0 /end MEASUREMENT
/begin MEASUREMENT sfpkrof "Status Fehlerpfad: Klopfregelung Offset" UWORD dez 1 100 0 65535 FORMAT "%8.2" ECU_ADDRESS 0x3839A2 /end MEASUREMENT
/begin MEASUREMENT sfpkrtp "Status Fehlerpfad: Klopfregelung Testimpuls" UWORD dez 1 100 0 65535 FORMAT "%8.2" ECU_ADDRESS 0x3839A4 /end MEASUREMENT
/begin MEASUREMENT sfpks1 "Status Fehlerpfad: Klopfsensor 1" UWORD dez 1 100 0 65535 FORMAT "%8.2" ECU_ADDRESS 0x3839A6 /end MEASUREMENT
/begin MEASUREMENT sfpks2 "Status Fehlerpfad: Klopfsensor 2" UWORD dez 1 100 0 65535 FORMAT "%8.2" ECU_ADDRESS 0x3839A8 /end MEASUREMENT
/begin MEASUREMENT sfpks3 "Status Fehlerpfad: Klopfsensor 3" UWORD dez 1 100 0 65535 FORMAT "%8.2" ECU_ADDRESS 0x3839AA /end MEASUREMENT
/begin MEASUREMENT sfpks4 "Status Fehlerpfad: Klopfsensor 4" UWORD dez 1 100 0 65535 FORMAT "%8.2" ECU_ADDRESS 0x3839AC /end MEASUREMENT
/begin MEASUREMENT sfplde "Status Fehlerpfad: Ladedrucksteuerventil Endstufe" UWORD default 1 100 0 65535 FORMAT "%8.2" ECU_ADDRESS 0x3839B4 /end MEASUREMENT
/begin MEASUREMENT sfplm "Status Fehlerpfad: Hauptfüllungssensor" UWORD dez 1 100 0 65535 FORMAT "%8.2" ECU_ADDRESS 0x3839C4 /end MEASUREMENT
/begin MEASUREMENT sfpmile "Status Fehlerpfad: Mil - Endstufe" UWORD default 1 100 0 65535 FORMAT "%8.2" ECU_ADDRESS 0x3839D8 /end MEASUREMENT
/begin MEASUREMENT sfpn "Status Fehlerpfad: Drehzahlgeber" UWORD dez 1 100 0 65535 FORMAT "%8.2" ECU_ADDRESS 0x3839DA /end MEASUREMENT
/begin MEASUREMENT sfpnwse "Status Fehlerpfad: Nockenwellensteuerungsventil Endstufe" UWORD default 1 100 0 65535 FORMAT "%8.2" ECU_ADDRESS 0x3839DE /end MEASUREMENT
/begin MEASUREMENT sfpslpe "Status Fehlerpfad: Sekundärluftpumpe Endstufe" UWORD default 1 100 0 65535 FORMAT "%8.2" ECU_ADDRESS 0x3839EE /end MEASUREMENT
/begin MEASUREMENT sfpslve "Status Fehlerpfad: Sekundärluftventil Endstufe" UWORD default 1 100 0 65535 FORMAT "%8.2" ECU_ADDRESS 0x3839F4 /end MEASUREMENT
/begin MEASUREMENT sfpteve "Status Fehlerpfad: Tanklüftungsventil Endstufe" UWORD default 1 100 0 65535 FORMAT "%8.2" ECU_ADDRESS 0x383A02 /end MEASUREMENT
/begin MEASUREMENT sfpuvse "Status Fehlerpfad: Endstufe Umluftventil Turbo" UWORD default 1 100 0 65535 FORMAT "%8.2" ECU_ADDRESS 0x383A1E /end MEASUREMENT
/begin MEASUREMENT sfpzet1 "" UWORD default 1 100 0 65535 FORMAT "%8.2" ECU_ADDRESS 0x383A26 /end MEASUREMENT
/begin MEASUREMENT sfpzet2 "" UWORD default 1 100 0 65535 FORMAT "%8.2" ECU_ADDRESS 0x383A28 /end MEASUREMENT
/begin MEASUREMENT sfpzet3 "" UWORD default 1 100 0 65535 FORMAT "%8.2" ECU_ADDRESS 0x383A2A /end MEASUREMENT
/begin MEASUREMENT sfpzet4 "" UWORD default 1 100 0 65535 FORMAT "%8.2" ECU_ADDRESS 0x383A2C /end MEASUREMENT
/begin MEASUREMENT sfpzzz "Dummy: Tabellenende" UWORD dez 1 100 0 65535 FORMAT "%8.2" ECU_ADDRESS 0x383A2E /end MEASUREMENT
/begin MEASUREMENT TYPkra01 "" UWORD B_TRUE 1 100 0 1 BIT_MASK 0xf00 FORMAT "%13.11" ECU_ADDRESS 0x383998 /end MEASUREMENT
/begin MEASUREMENT TYPkra02 "" UWORD B_TRUE 1 100 0 1 BIT_MASK 0xf00 FORMAT "%13.11" ECU_ADDRESS 0x38399A /end MEASUREMENT
/begin MEASUREMENT TYPkra03 "" UWORD B_TRUE 1 100 0 1 BIT_MASK 0xf00 FORMAT "%13.11" ECU_ADDRESS 0x38399C /end MEASUREMENT
/begin MEASUREMENT TYPkra04 "" UWORD B_TRUE 1 100 0 1 BIT_MASK 0xf00 FORMAT "%13.11" ECU_ADDRESS 0x38399E /end MEASUREMENT
/begin MEASUREMENT TYP_aave "Fehlertyp: Endstufe AKF-Absperrventil (AAV)" UWORD B_TRUE 1 100 0 1 BIT_MASK 0xf00 FORMAT "%13.11" ECU_ADDRESS 0x38390E /end MEASUREMENT
/begin MEASUREMENT TYP_agre "" UWORD B_TRUE 1 100 0 1 BIT_MASK 0xf00 FORMAT "%13.11" ECU_ADDRESS 0x383910 /end MEASUREMENT
/begin MEASUREMENT TYP_atr "" UWORD B_TRUE 1 100 0 1 BIT_MASK 0xf00 FORMAT "%13.11" ECU_ADDRESS 0x383914 /end MEASUREMENT
/begin MEASUREMENT TYP_atr2 "" UWORD B_TRUE 1 100 0 1 BIT_MASK 0xf00 FORMAT "%13.11" ECU_ADDRESS 0x383916 /end MEASUREMENT
/begin MEASUREMENT TYP_atrd "" UWORD B_TRUE 1 100 0 1 BIT_MASK 0xf00 FORMAT "%13.11" ECU_ADDRESS 0x383918 /end MEASUREMENT
/begin MEASUREMENT TYP_atrd2 "" UWORD B_TRUE 1 100 0 1 BIT_MASK 0xf00 FORMAT "%13.11" ECU_ADDRESS 0x38391A /end MEASUREMENT
/begin MEASUREMENT TYP_ats "" UWORD B_TRUE 1 100 0 1 BIT_MASK 0xf00 FORMAT "%13.11" ECU_ADDRESS 0x38391C /end MEASUREMENT
/begin MEASUREMENT TYP_bkvp "" UWORD B_TRUE 1 100 0 1 BIT_MASK 0xf00 FORMAT "%13.11" ECU_ADDRESS 0x38391E /end MEASUREMENT
/begin MEASUREMENT TYP_bkvpe "" UWORD B_TRUE 1 100 0 1 BIT_MASK 0xf00 FORMAT "%13.11" ECU_ADDRESS 0x383920 /end MEASUREMENT
/begin MEASUREMENT TYP_bm "" UWORD B_TRUE 1 100 0 1 BIT_MASK 0xf00 FORMAT "%13.11" ECU_ADDRESS 0x383922 /end MEASUREMENT
/begin MEASUREMENT TYP_cv "" UWORD B_TRUE 1 100 0 1 BIT_MASK 0xf00 FORMAT "%13.11" ECU_ADDRESS 0x38393A /end MEASUREMENT
/begin MEASUREMENT TYP_dk "" UWORD B_TRUE 1 100 0 1 BIT_MASK 0xf00 FORMAT "%13.11" ECU_ADDRESS 0x38393C /end MEASUREMENT
/begin MEASUREMENT TYP_dk1p "" UWORD B_TRUE 1 100 0 1 BIT_MASK 0xf00 FORMAT "%13.11" ECU_ADDRESS 0x38393E /end MEASUREMENT
/begin MEASUREMENT TYP_dk2p "" UWORD B_TRUE 1 100 0 1 BIT_MASK 0xf00 FORMAT "%13.11" ECU_ADDRESS 0x383940 /end MEASUREMENT
/begin MEASUREMENT TYP_dvee "Fehlertyp: DV-E Endstufe" UWORD B_TRUE 1 100 0 1 BIT_MASK 0xf00 FORMAT "%13.11" ECU_ADDRESS 0x38394C /end MEASUREMENT
/begin MEASUREMENT TYP_dvef "Fehlertyp: DV-E Fehler bei Federprüfung" UWORD B_TRUE 1 100 0 1 BIT_MASK 0xf00 FORMAT "%13.11" ECU_ADDRESS 0x38394E /end MEASUREMENT
/begin MEASUREMENT TYP_dvefo "" UWORD B_TRUE 1 100 0 1 BIT_MASK 0xf00 FORMAT "%13.11" ECU_ADDRESS 0x383950 /end MEASUREMENT
/begin MEASUREMENT TYP_dvel "Fehlertyp: DV-E Lageabweichung" UWORD B_TRUE 1 100 0 1 BIT_MASK 0xf00 FORMAT "%13.11" ECU_ADDRESS 0x383952 /end MEASUREMENT
/begin MEASUREMENT TYP_dven "Fehlertyp: DV-E Fehler bei Prüfung Notluftposition" UWORD B_TRUE 1 100 0 1 BIT_MASK 0xf00 FORMAT "%13.11" ECU_ADDRESS 0x383954 /end MEASUREMENT
/begin MEASUREMENT TYP_dver "Fehlertyp: DV-E Regelbereich" UWORD B_TRUE 1 100 0 1 BIT_MASK 0xf00 FORMAT "%13.11" ECU_ADDRESS 0x383956 /end MEASUREMENT
/begin MEASUREMENT TYP_dvet "" UWORD B_TRUE 1 100 0 1 BIT_MASK 0xf00 FORMAT "%13.11" ECU_ADDRESS 0x383958 /end MEASUREMENT
/begin MEASUREMENT TYP_dveu "Fehlertyp: DV-E Fehler beim UMA-Lernen" UWORD B_TRUE 1 100 0 1 BIT_MASK 0xf00 FORMAT "%13.11" ECU_ADDRESS 0x38395A /end MEASUREMENT
/begin MEASUREMENT TYP_dveub "" UWORD B_TRUE 1 100 0 1 BIT_MASK 0xf00 FORMAT "%13.11" ECU_ADDRESS 0x38395C /end MEASUREMENT
/begin MEASUREMENT TYP_dveuw "" UWORD B_TRUE 1 100 0 1 BIT_MASK 0xf00 FORMAT "%13.11" ECU_ADDRESS 0x38395E /end MEASUREMENT
/begin MEASUREMENT TYP_dvev "Fehlertyp: DV-E Fehler bei Verstärkerabgleich" UWORD B_TRUE 1 100 0 1 BIT_MASK 0xf00 FORMAT "%13.11" ECU_ADDRESS 0x383960 /end MEASUREMENT
/begin MEASUREMENT TYP_enws "" UWORD B_TRUE 1 100 0 1 BIT_MASK 0xf00 FORMAT "%13.11" ECU_ADDRESS 0x383966 /end MEASUREMENT
/begin MEASUREMENT TYP_enwse "" UWORD B_TRUE 1 100 0 1 BIT_MASK 0xf00 FORMAT "%13.11" ECU_ADDRESS 0x383968 /end MEASUREMENT
/begin MEASUREMENT TYP_epcle "" UWORD B_TRUE 1 100 0 1 BIT_MASK 0xf00 FORMAT "%13.11" ECU_ADDRESS 0x38396A /end MEASUREMENT
/begin MEASUREMENT TYP_ev1 "" UWORD B_TRUE 1 100 0 1 BIT_MASK 0xf00 FORMAT "%13.11" ECU_ADDRESS 0x38396C /end MEASUREMENT
/begin MEASUREMENT TYP_ev2 "" UWORD B_TRUE 1 100 0 1 BIT_MASK 0xf00 FORMAT "%13.11" ECU_ADDRESS 0x38396E /end MEASUREMENT
/begin MEASUREMENT TYP_ev3 "" UWORD B_TRUE 1 100 0 1 BIT_MASK 0xf00 FORMAT "%13.11" ECU_ADDRESS 0x383970 /end MEASUREMENT
/begin MEASUREMENT TYP_ev4 "" UWORD B_TRUE 1 100 0 1 BIT_MASK 0xf00 FORMAT "%13.11" ECU_ADDRESS 0x383972 /end MEASUREMENT
/begin MEASUREMENT TYP_hsh "Fehlertyp: Heizung Lambdasonde 1 hinter Kat" UWORD B_TRUE 1 100 0 1 BIT_MASK 0xf00 FORMAT "%13.11" ECU_ADDRESS 0x383986 /end MEASUREMENT
/begin MEASUREMENT TYP_hsh2 "Fehlertyp: Heizung Lambdasonde 2 hinter Kat" UWORD B_TRUE 1 100 0 1 BIT_MASK 0xf00 FORMAT "%13.11" ECU_ADDRESS 0x383988 /end MEASUREMENT
/begin MEASUREMENT TYP_hshe "Fehlertyp: Endstufe Heizung Lambdasonde 1 hinter Kat" UWORD B_TRUE 1 100 0 1 BIT_MASK 0xf00 FORMAT "%13.11" ECU_ADDRESS 0x38398A /end MEASUREMENT
/begin MEASUREMENT TYP_hsv "Fehlertyp: Heizung Lambdasonde 1 vor Kat" UWORD B_TRUE 1 100 0 1 BIT_MASK 0xf00 FORMAT "%13.11" ECU_ADDRESS 0x38398C /end MEASUREMENT
/begin MEASUREMENT TYP_hsv2 "Fehlertyp: Heizung Lambdasonde 2 vor Kat" UWORD B_TRUE 1 100 0 1 BIT_MASK 0xf00 FORMAT "%13.11" ECU_ADDRESS 0x38398E /end MEASUREMENT
/begin MEASUREMENT TYP_hsvsa "" UWORD B_TRUE 1 100 0 1 BIT_MASK 0xf00 FORMAT "%13.11" ECU_ADDRESS 0x383990 /end MEASUREMENT
/begin MEASUREMENT TYP_hsvsa2 "" UWORD B_TRUE 1 100 0 1 BIT_MASK 0xf00 FORMAT "%13.11" ECU_ADDRESS 0x383992 /end MEASUREMENT
/begin MEASUREMENT TYP_kat "Fehlertyp: Katalysator-Diagnose" UWORD B_TRUE 1 100 0 1 BIT_MASK 0xf00 FORMAT "%13.11" ECU_ADDRESS 0x383994 /end MEASUREMENT
/begin MEASUREMENT TYP_kpe "Fehlertyp: EKP-Relais Endstufe" UWORD B_TRUE 1 100 0 1 BIT_MASK 0xf00 FORMAT "%13.11" ECU_ADDRESS 0x383996 /end MEASUREMENT
/begin MEASUREMENT TYP_krnt "" UWORD B_TRUE 1 100 0 1 BIT_MASK 0xf00 FORMAT "%13.11" ECU_ADDRESS 0x3839A0 /end MEASUREMENT
/begin MEASUREMENT TYP_krof "" UWORD B_TRUE 1 100 0 1 BIT_MASK 0xf00 FORMAT "%13.11" ECU_ADDRESS 0x3839A2 /end MEASUREMENT
/begin MEASUREMENT TYP_krtp "" UWORD B_TRUE 1 100 0 1 BIT_MASK 0xf00 FORMAT "%13.11" ECU_ADDRESS 0x3839A4 /end MEASUREMENT
/begin MEASUREMENT TYP_ks1 "" UWORD B_TRUE 1 100 0 1 BIT_MASK 0xf00 FORMAT "%13.11" ECU_ADDRESS 0x3839A6 /end MEASUREMENT
/begin MEASUREMENT TYP_ks2 "" UWORD B_TRUE 1 100 0 1 BIT_MASK 0xf00 FORMAT "%13.11" ECU_ADDRESS 0x3839A8 /end MEASUREMENT
/begin MEASUREMENT TYP_ks3 "" UWORD B_TRUE 1 100 0 1 BIT_MASK 0xf00 FORMAT "%13.11" ECU_ADDRESS 0x3839AA /end MEASUREMENT
/begin MEASUREMENT TYP_ks4 "" UWORD B_TRUE 1 100 0 1 BIT_MASK 0xf00 FORMAT "%13.11" ECU_ADDRESS 0x3839AC /end MEASUREMENT
/begin MEASUREMENT TYP_lde "" UWORD B_TRUE 1 100 0 1 BIT_MASK 0xf00 FORMAT "%13.11" ECU_ADDRESS 0x3839B4 /end MEASUREMENT
/begin MEASUREMENT TYP_lm "" UWORD B_TRUE 1 100 0 1 BIT_MASK 0xf00 FORMAT "%13.11" ECU_ADDRESS 0x3839C4 /end MEASUREMENT
/begin MEASUREMENT TYP_mile "" UWORD B_TRUE 1 100 0 1 BIT_MASK 0xf00 FORMAT "%13.11" ECU_ADDRESS 0x3839D8 /end MEASUREMENT
/begin MEASUREMENT TYP_n "" UWORD B_TRUE 1 100 0 1 BIT_MASK 0xf00 FORMAT "%13.11" ECU_ADDRESS 0x3839DA /end MEASUREMENT
/begin MEASUREMENT TYP_nwse "" UWORD B_TRUE 1 100 0 1 BIT_MASK 0xf00 FORMAT "%13.11" ECU_ADDRESS 0x3839DE /end MEASUREMENT
/begin MEASUREMENT TYP_slpe "" UWORD B_TRUE 1 100 0 1 BIT_MASK 0xf00 FORMAT "%13.11" ECU_ADDRESS 0x3839EE /end MEASUREMENT
/begin MEASUREMENT TYP_slve "" UWORD B_TRUE 1 100 0 1 BIT_MASK 0xf00 FORMAT "%13.11" ECU_ADDRESS 0x3839F4 /end MEASUREMENT
/begin MEASUREMENT TYP_teve "" UWORD B_TRUE 1 100 0 1 BIT_MASK 0xf00 FORMAT "%13.11" ECU_ADDRESS 0x383A02 /end MEASUREMENT
/begin MEASUREMENT TYP_uvse "" UWORD B_TRUE 1 100 0 1 BIT_MASK 0xf00 FORMAT "%13.11" ECU_ADDRESS 0x383A1E /end MEASUREMENT
/begin MEASUREMENT TYP_zet1 "" UWORD B_TRUE 1 100 0 1 BIT_MASK 0xf00 FORMAT "%13.11" ECU_ADDRESS 0x383A26 /end MEASUREMENT
/begin MEASUREMENT TYP_zet2 "" UWORD B_TRUE 1 100 0 1 BIT_MASK 0xf00 FORMAT "%13.11" ECU_ADDRESS 0x383A28 /end MEASUREMENT
/begin MEASUREMENT TYP_zet3 "" UWORD B_TRUE 1 100 0 1 BIT_MASK 0xf00 FORMAT "%13.11" ECU_ADDRESS 0x383A2A /end MEASUREMENT
/begin MEASUREMENT TYP_zet4 "" UWORD B_TRUE 1 100 0 1 BIT_MASK 0xf00 FORMAT "%13.11" ECU_ADDRESS 0x383A2C /end MEASUREMENT
/begin MEASUREMENT Z_aaa "Dummy: Tabellenanfang" UWORD B_TRUE 1 100 0 1 BIT_MASK 0x2 FORMAT "%13.11" ECU_ADDRESS 0x383908 /end MEASUREMENT
/begin MEASUREMENT Z_aave "Zyklusflag: Absperrventil Aktivkohlefilter (Endstufe)" UWORD B_TRUE 1 100 0 1 BIT_MASK 0x2 FORMAT "%13.11" ECU_ADDRESS 0x38390E /end MEASUREMENT
/begin MEASUREMENT Z_agre "Zyklusflag: Abgasrückführungsventil Endstufe" UWORD B_TRUE 1 100 0 1 BIT_MASK 0x2 FORMAT "%13.11" ECU_ADDRESS 0x383910 /end MEASUREMENT
/begin MEASUREMENT Z_atr "Zyklusflag: Abgastemperaturregelung" UWORD B_TRUE 1 100 0 1 BIT_MASK 0x2 FORMAT "%13.11" ECU_ADDRESS 0x383914 /end MEASUREMENT
/begin MEASUREMENT Z_atr2 "Zyklusflag: Abgastemperaturregelung Bank 2" UWORD B_TRUE 1 100 0 1 BIT_MASK 0x2 FORMAT "%13.11" ECU_ADDRESS 0x383916 /end MEASUREMENT
/begin MEASUREMENT Z_atrd "Zyklusflag: Abgastemperaturregelung Differenz" UWORD B_TRUE 1 100 0 1 BIT_MASK 0x2 FORMAT "%13.11" ECU_ADDRESS 0x383918 /end MEASUREMENT
/begin MEASUREMENT Z_atrd2 "Zyklusflag: Abgastemperaturregelung Differenz Bank 2" UWORD B_TRUE 1 100 0 1 BIT_MASK 0x2 FORMAT "%13.11" ECU_ADDRESS 0x38391A /end MEASUREMENT
/begin MEASUREMENT Z_ats "Zyklusflag: Abgastemperatursensor" UWORD B_TRUE 1 100 0 1 BIT_MASK 0x2 FORMAT "%13.11" ECU_ADDRESS 0x38391C /end MEASUREMENT
/begin MEASUREMENT Z_bkvp "Zyklusflag: Bremskraftverstärker-Pumpe" UWORD B_TRUE 1 100 0 1 BIT_MASK 0x2 FORMAT "%13.11" ECU_ADDRESS 0x38391E /end MEASUREMENT
/begin MEASUREMENT Z_bkvpe "Zyklusflag: BKV-Pumpe-Endstufe" UWORD B_TRUE 1 100 0 1 BIT_MASK 0x2 FORMAT "%13.11" ECU_ADDRESS 0x383920 /end MEASUREMENT
/begin MEASUREMENT Z_bm "Zyklusflag: Bezugsmarkengeber" UWORD B_TRUE 1 100 0 1 BIT_MASK 0x2 FORMAT "%13.11" ECU_ADDRESS 0x383922 /end MEASUREMENT
/begin MEASUREMENT Z_cv "Zyklusflag: Diagnose Kurbelgehäuseentlüftung" UWORD B_TRUE 1 100 0 1 BIT_MASK 0x2 FORMAT "%13.11" ECU_ADDRESS 0x38393A /end MEASUREMENT
/begin MEASUREMENT Z_dk "Zyklusflag:	DK - Potentiometer" UWORD B_TRUE 1 100 0 1 BIT_MASK 0x2 FORMAT "%13.11" ECU_ADDRESS 0x38393C /end MEASUREMENT
/begin MEASUREMENT Z_dk1p "Zyklusflag: Drosselklappe 1. Poti" UWORD B_TRUE 1 100 0 1 BIT_MASK 0x2 FORMAT "%13.11" ECU_ADDRESS 0x38393E /end MEASUREMENT
/begin MEASUREMENT Z_dk2p "Zyklusflag: Drosselklappe 2. Poti" UWORD B_TRUE 1 100 0 1 BIT_MASK 0x2 FORMAT "%13.11" ECU_ADDRESS 0x383940 /end MEASUREMENT
/begin MEASUREMENT Z_dvee "Zyklusflag: DV-E Endstufe" UWORD B_TRUE 1 100 0 1 BIT_MASK 0x2 FORMAT "%13.11" ECU_ADDRESS 0x38394C /end MEASUREMENT
/begin MEASUREMENT Z_dvef "Zyklusflag: DV-E Fehler bei Federprüfung" UWORD B_TRUE 1 100 0 1 BIT_MASK 0x2 FORMAT "%13.11" ECU_ADDRESS 0x38394E /end MEASUREMENT
/begin MEASUREMENT Z_dvefo "Zyklusflag: DV-E-Fehler bei Federprüfung ""Öffnen""" UWORD B_TRUE 1 100 0 1 BIT_MASK 0x2 FORMAT "%13.11" ECU_ADDRESS 0x383950 /end MEASUREMENT
/begin MEASUREMENT Z_dvel "Zyklusflag: DV-E Lageabweichung" UWORD B_TRUE 1 100 0 1 BIT_MASK 0x2 FORMAT "%13.11" ECU_ADDRESS 0x383952 /end MEASUREMENT
/begin MEASUREMENT Z_dven "Zyklusflag: DV-E Fehler bei Prüfung Notluftposition" UWORD B_TRUE 1 100 0 1 BIT_MASK 0x2 FORMAT "%13.11" ECU_ADDRESS 0x383954 /end MEASUREMENT
/begin MEASUREMENT Z_dver "Zyklusflag: DV-E Regelbereich" UWORD B_TRUE 1 100 0 1 BIT_MASK 0x2 FORMAT "%13.11" ECU_ADDRESS 0x383956 /end MEASUREMENT
/begin MEASUREMENT Z_dvet "Zyklusflag: DV-E-Tauscherkennung ohne Adaption" UWORD B_TRUE 1 100 0 1 BIT_MASK 0x2 FORMAT "%13.11" ECU_ADDRESS 0x383958 /end MEASUREMENT
/begin MEASUREMENT Z_dveu "Zyklusflag: DV-E Fehler beim UMA-Lernen" UWORD B_TRUE 1 100 0 1 BIT_MASK 0x2 FORMAT "%13.11" ECU_ADDRESS 0x38395A /end MEASUREMENT
/begin MEASUREMENT Z_dveub "Zyklusflag: DV-E-Adaption Abbruch wg. Umweltbedingung" UWORD B_TRUE 1 100 0 1 BIT_MASK 0x2 FORMAT "%13.11" ECU_ADDRESS 0x38395C /end MEASUREMENT
/begin MEASUREMENT Z_dveuw "Zyklusflag: Fehler bei UMA-Wiederlernen" UWORD B_TRUE 1 100 0 1 BIT_MASK 0x2 FORMAT "%13.11" ECU_ADDRESS 0x38395E /end MEASUREMENT
/begin MEASUREMENT Z_dvev "Zyklusflag: DV-E Fehler bei Verstärkerabgleich" UWORD B_TRUE 1 100 0 1 BIT_MASK 0x2 FORMAT "%13.11" ECU_ADDRESS 0x383960 /end MEASUREMENT
/begin MEASUREMENT Z_enws "Zyklusflag: Nockenwellensteuerung (Einlaß,Bank1)" UWORD B_TRUE 1 100 0 1 BIT_MASK 0x2 FORMAT "%13.11" ECU_ADDRESS 0x383966 /end MEASUREMENT
/begin MEASUREMENT Z_enwse "Zyklusflag: Nockenwellensteuerungsventil Endstufe (Bank1,Einlaß)" UWORD B_TRUE 1 100 0 1 BIT_MASK 0x2 FORMAT "%13.11" ECU_ADDRESS 0x383968 /end MEASUREMENT
/begin MEASUREMENT Z_epcle "Zyklusflag: EPCL-Endstufe" UWORD B_TRUE 1 100 0 1 BIT_MASK 0x2 FORMAT "%13.11" ECU_ADDRESS 0x38396A /end MEASUREMENT
/begin MEASUREMENT Z_ev1 "Zyklusflag: EV von Zyl. 1" UWORD B_TRUE 1 100 0 1 BIT_MASK 0x2 FORMAT "%13.11" ECU_ADDRESS 0x38396C /end MEASUREMENT
/begin MEASUREMENT Z_ev2 "Zyklusflag:	EV von Zyl. 2" UWORD B_TRUE 1 100 0 1 BIT_MASK 0x2 FORMAT "%13.11" ECU_ADDRESS 0x38396E /end MEASUREMENT
/begin MEASUREMENT Z_ev3 "Zyklusflag:	EV von Zyl. 3" UWORD B_TRUE 1 100 0 1 BIT_MASK 0x2 FORMAT "%13.11" ECU_ADDRESS 0x383970 /end MEASUREMENT
/begin MEASUREMENT Z_ev4 "Zyklusflag:	EV von Zyl. 4" UWORD B_TRUE 1 100 0 1 BIT_MASK 0x2 FORMAT "%13.11" ECU_ADDRESS 0x383972 /end MEASUREMENT
/begin MEASUREMENT Z_hsh "Zyklusflag:Lambdasonden-Heizung hinter Katalysator" UWORD B_TRUE 1 100 0 1 BIT_MASK 0x2 FORMAT "%13.11" ECU_ADDRESS 0x383986 /end MEASUREMENT
/begin MEASUREMENT Z_hsh2 "Zyklusflag:Lambdasonden-Heizung hinter Katalysator, Bank2" UWORD B_TRUE 1 100 0 1 BIT_MASK 0x2 FORMAT "%13.11" ECU_ADDRESS 0x383988 /end MEASUREMENT
/begin MEASUREMENT Z_hshe "Zyklusflag:Lambdasonden-Heizung hinter Katalysator (Endstufe)" UWORD B_TRUE 1 100 0 1 BIT_MASK 0x2 FORMAT "%13.11" ECU_ADDRESS 0x38398A /end MEASUREMENT
/begin MEASUREMENT Z_hsv "Zyklusflag:Lambdasonden-Heizung vor Katalysator" UWORD B_TRUE 1 100 0 1 BIT_MASK 0x2 FORMAT "%13.11" ECU_ADDRESS 0x38398C /end MEASUREMENT
/begin MEASUREMENT Z_hsv2 "Zyklusflag:Lambdasonden-Heizung vor Katalysator, Bank2" UWORD B_TRUE 1 100 0 1 BIT_MASK 0x2 FORMAT "%13.11" ECU_ADDRESS 0x38398E /end MEASUREMENT
/begin MEASUREMENT Z_hsvsa "Zyklusflag:  reduzierte  LSU-Heizung oder LSU-Kennlinie abgeflacht" UWORD B_TRUE 1 100 0 1 BIT_MASK 0x2 FORMAT "%13.11" ECU_ADDRESS 0x383990 /end MEASUREMENT
/begin MEASUREMENT Z_hsvsa2 "Zyklusflag: reduzierte  LSU_2-Heizung oder LSU_2-Kennlinie abgeflacht" UWORD B_TRUE 1 100 0 1 BIT_MASK 0x2 FORMAT "%13.11" ECU_ADDRESS 0x383992 /end MEASUREMENT
/begin MEASUREMENT Z_kat "Zyklusflag:	Katalysator-Konvertierung" UWORD B_TRUE 1 100 0 1 BIT_MASK 0x2 FORMAT "%13.11" ECU_ADDRESS 0x383994 /end MEASUREMENT
/begin MEASUREMENT Z_kpe "Zyklusflag: EKP-Relais Endstufe" UWORD B_TRUE 1 100 0 1 BIT_MASK 0x2 FORMAT "%13.11" ECU_ADDRESS 0x383996 /end MEASUREMENT
/begin MEASUREMENT Z_kra01 "Zyklusflag: Klopfregelanschlag Zylinder 1" UWORD B_TRUE 1 100 0 1 BIT_MASK 0x2 FORMAT "%13.11" ECU_ADDRESS 0x383998 /end MEASUREMENT
/begin MEASUREMENT Z_kra02 "Zyklusflag: Klopfregelanschlag Zylinder 2" UWORD B_TRUE 1 100 0 1 BIT_MASK 0x2 FORMAT "%13.11" ECU_ADDRESS 0x38399A /end MEASUREMENT
/begin MEASUREMENT Z_kra03 "Zyklusflag: Klopfregelanschlag Zylinder 3" UWORD B_TRUE 1 100 0 1 BIT_MASK 0x2 FORMAT "%13.11" ECU_ADDRESS 0x38399C /end MEASUREMENT
/begin MEASUREMENT Z_kra04 "Zyklusflag: Klopfregelanschlag Zylinder 4" UWORD B_TRUE 1 100 0 1 BIT_MASK 0x2 FORMAT "%13.11" ECU_ADDRESS 0x38399E /end MEASUREMENT
/begin MEASUREMENT Z_krnt "Zyklusflag: Klopfregelung Nulltest" UWORD B_TRUE 1 100 0 1 BIT_MASK 0x2 FORMAT "%13.11" ECU_ADDRESS 0x3839A0 /end MEASUREMENT
/begin MEASUREMENT Z_krof "Zyklusflag: Klopfregelung Offset" UWORD B_TRUE 1 100 0 1 BIT_MASK 0x2 FORMAT "%13.11" ECU_ADDRESS 0x3839A2 /end MEASUREMENT
/begin MEASUREMENT Z_krtp "Zyklusflag: Klopfregelung Testimpuls" UWORD B_TRUE 1 100 0 1 BIT_MASK 0x2 FORMAT "%13.11" ECU_ADDRESS 0x3839A4 /end MEASUREMENT
/begin MEASUREMENT Z_ks1 "Zyklusflag: Klopfsensor 1" UWORD B_TRUE 1 100 0 1 BIT_MASK 0x2 FORMAT "%13.11" ECU_ADDRESS 0x3839A6 /end MEASUREMENT
/begin MEASUREMENT Z_ks2 "Zyklusflag: Klopfsensor 2" UWORD B_TRUE 1 100 0 1 BIT_MASK 0x2 FORMAT "%13.11" ECU_ADDRESS 0x3839A8 /end MEASUREMENT
/begin MEASUREMENT Z_ks3 "Zyklusflag: Klopfsensor 3" UWORD B_TRUE 1 100 0 1 BIT_MASK 0x2 FORMAT "%13.11" ECU_ADDRESS 0x3839AA /end MEASUREMENT
/begin MEASUREMENT Z_ks4 "Zyklusflag: Klopfsensor 4" UWORD B_TRUE 1 100 0 1 BIT_MASK 0x2 FORMAT "%13.11" ECU_ADDRESS 0x3839AC /end MEASUREMENT
/begin MEASUREMENT Z_lde "Zyklusflag: Ladedrucksteuerventil (Endstufe)" UWORD B_TRUE 1 100 0 1 BIT_MASK 0x2 FORMAT "%13.11" ECU_ADDRESS 0x3839B4 /end MEASUREMENT
/begin MEASUREMENT Z_lm "Zyklusflag:	LMM/HLM/HFM" UWORD B_TRUE 1 100 0 1 BIT_MASK 0x2 FORMAT "%13.11" ECU_ADDRESS 0x3839C4 /end MEASUREMENT
/begin MEASUREMENT Z_mile "Zyklusflag: MIL-Endstufe" UWORD B_TRUE 1 100 0 1 BIT_MASK 0x2 FORMAT "%13.11" ECU_ADDRESS 0x3839D8 /end MEASUREMENT
/begin MEASUREMENT Z_n "Zyklusflag: Drehzahlsignalgeber" UWORD B_TRUE 1 100 0 1 BIT_MASK 0x2 FORMAT "%13.11" ECU_ADDRESS 0x3839DA /end MEASUREMENT
/begin MEASUREMENT Z_nwse "Zyklusflag: Nockenwellensteuerungsventil Endstufe" UWORD B_TRUE 1 100 0 1 BIT_MASK 0x2 FORMAT "%13.11" ECU_ADDRESS 0x3839DE /end MEASUREMENT
/begin MEASUREMENT Z_slpe "Zyklusflag: Sekundärluftpumpe (Endstufe)" UWORD B_TRUE 1 100 0 1 BIT_MASK 0x2 FORMAT "%13.11" ECU_ADDRESS 0x3839EE /end MEASUREMENT
/begin MEASUREMENT Z_slve "Zyklusflag:	Sekundärluftventil (Endstufe)" UWORD B_TRUE 1 100 0 1 BIT_MASK 0x2 FORMAT "%13.11" ECU_ADDRESS 0x3839F4 /end MEASUREMENT
/begin MEASUREMENT Z_teve "Zyklusflag:	Tankentlüftungsventil Endstufe" UWORD B_TRUE 1 100 0 1 BIT_MASK 0x2 FORMAT "%13.11" ECU_ADDRESS 0x383A02 /end MEASUREMENT
/begin MEASUREMENT Z_uvse "Zyklusflag: Endstufe Umluftventil Turbo" UWORD B_TRUE 1 100 0 1 BIT_MASK 0x2 FORMAT "%13.11" ECU_ADDRESS 0x383A1E /end MEASUREMENT
/begin MEASUREMENT Z_zet1 "" UWORD B_TRUE 1 100 0 1 BIT_MASK 0x2 FORMAT "%13.11" ECU_ADDRESS 0x383A26 /end MEASUREMENT
/begin MEASUREMENT Z_zet2 "" UWORD B_TRUE 1 100 0 1 BIT_MASK 0x2 FORMAT "%13.11" ECU_ADDRESS 0x383A28 /end MEASUREMENT
/begin MEASUREMENT Z_zet3 "" UWORD B_TRUE 1 100 0 1 BIT_MASK 0x2 FORMAT "%13.11" ECU_ADDRESS 0x383A2A /end MEASUREMENT
/begin MEASUREMENT Z_zet4 "" UWORD B_TRUE 1 100 0 1 BIT_MASK 0x2 FORMAT "%13.11" ECU_ADDRESS 0x383A2C /end MEASUREMENT
/begin FUNCTION DFPM_DATR ""
 /begin DEF_CHARACTERISTIC CDCATR CDCATR2 CDCATRD CDCATRD2 CDKATR CDKATR2 CDKATRD CDKATRD2 CDTATR CDTATR2 CDTATRD CDTATRD2 CLAATR CLAATR2 CLAATRD CLAATRD2 FFTATR FFTATR2 FFTATRD FFTATRD2 TSFATR TSFATR2 TSFATRD TSFATRD2 /end DEF_CHARACTERISTIC
 /begin REF_CHARACTERISTIC /end REF_CHARACTERISTIC
 /begin IN_MEASUREMENT /end IN_MEASUREMENT
 /begin OUT_MEASUREMENT B_beatr B_beatr2 B_beatrd B_beatrd2 B_bkatr B_bkatr2 B_bkatrd B_bkatrd2 B_clatr B_clatr2 B_clatrd B_clatrd2 B_ftatr B_ftatr2 B_ftatrd B_ftatrd2 B_mnatr B_mnatr2 B_mnatrd B_mnatrd2 B_mxatr B_mxatr2 B_mxatrd B_mxatrd2 B_npatr B_npatr2 B_npatrd B_npatrd2 B_siatr B_siatr2 B_siatrd B_siatrd2 E_atr E_atr2 E_atrd E_atrd2 sfpatr sfpatr2 sfpatrd sfpatrd2 TYP_atr TYP_atr2 TYP_atrd TYP_atrd2 Z_atr Z_atr2 Z_atrd Z_atrd2 /end OUT_MEASUREMENT
 /begin LOC_MEASUREMENT /end LOC_MEASUREMENT
 /begin SUB_FUNCTION /end SUB_FUNCTION
/end FUNCTION
/begin FUNCTION DFPM_DATS "" /begin DEF_CHARACTERISTIC CDCATS CDKATS CDTATS CLAATS FFTATS TSFATS /end DEF_CHARACTERISTIC /begin REF_CHARACTERISTIC /end REF_CHARACTERISTIC /begin IN_MEASUREMENT /end IN_MEASUREMENT
 /begin OUT_MEASUREMENT B_beats B_bkats B_clats B_ftats B_mnats B_mxats B_npats B_siats E_ats sfpats TYP_ats Z_ats /end OUT_MEASUREMENT
 /begin LOC_MEASUREMENT /end LOC_MEASUREMENT
 /begin SUB_FUNCTION /end SUB_FUNCTION
/end FUNCTION
/begin FUNCTION DFPM_DBKVP "" /begin DEF_CHARACTERISTIC CDCBKVP CDKBKVP CDTBKVP CLABKVP FFTBKVP TSFBKVP /end DEF_CHARACTERISTIC /begin REF_CHARACTERISTIC /end REF_CHARACTERISTIC /begin IN_MEASUREMENT /end IN_MEASUREMENT
 /begin OUT_MEASUREMENT B_bebkvp B_bkbkvp B_clbkvp B_ftbkvp B_mnbkvp B_mxbkvp B_npbkvp B_sibkvp E_bkvp sfpbkvp TYP_bkvp Z_bkvp /end OUT_MEASUREMENT
 /begin LOC_MEASUREMENT /end LOC_MEASUREMENT
 /begin SUB_FUNCTION /end SUB_FUNCTION
/end FUNCTION
/begin FUNCTION DFPM_DCV "" /begin DEF_CHARACTERISTIC CDCCV CDKCV CDTCV CLACV FFTCV TSFCV /end DEF_CHARACTERISTIC /begin REF_CHARACTERISTIC /end REF_CHARACTERISTIC /begin IN_MEASUREMENT /end IN_MEASUREMENT
 /begin OUT_MEASUREMENT B_becv B_bkcv B_clcv B_ftcv B_mncv B_mxcv B_npcv B_sicv E_cv sfpcv TYP_cv Z_cv /end OUT_MEASUREMENT
 /begin LOC_MEASUREMENT /end LOC_MEASUREMENT
 /begin SUB_FUNCTION /end SUB_FUNCTION
/end FUNCTION
/begin FUNCTION DFPM_DDG ""
 /begin DEF_CHARACTERISTIC CDCBM CDCN CDKBM CDKN CDTBM CDTN CLABM CLAN FFTBM FFTN TSFBM TSFN /end DEF_CHARACTERISTIC
 /begin REF_CHARACTERISTIC /end REF_CHARACTERISTIC
 /begin IN_MEASUREMENT /end IN_MEASUREMENT
 /begin OUT_MEASUREMENT B_bebm B_ben B_bkbm B_bkn B_clbm B_cln B_ftbm B_ftn B_mnbm B_mnn B_mxbm B_mxn B_npbm B_npn B_sibm B_sin E_bm E_n sfpbm sfpn TYP_bm TYP_n Z_bm Z_n /end OUT_MEASUREMENT
 /begin LOC_MEASUREMENT /end LOC_MEASUREMENT
 /begin SUB_FUNCTION /end SUB_FUNCTION
/end FUNCTION
/begin FUNCTION DFPM_DDVE ""
 /begin DEF_CHARACTERISTIC CDCDK CDCDK1P CDCDK2P CDCDVEE CDCDVEF CDCDVEFO CDCDVEL CDCDVEN CDCDVER CDCDVET CDCDVEU CDCDVEUB CDCDVEUW CDCDVEV CDKDK CDKDK1P CDKDK2P CDKDVEE CDKDVEF CDKDVEFO CDKDVEL CDKDVEN CDKDVER CDKDVET CDKDVEU CDKDVEUB CDKDVEUW CDKDVEV CDTDK CDTDK1P CDTDK2P CDTDVEE CDTDVEF CDTDVEFO CDTDVEL CDTDVEN CDTDVER CDTDVET CDTDVEU CDTDVEUB CDTDVEUW CDTDVEV CLADK CLADK1P CLADK2P CLADVEE CLADVEF CLADVEFO CLADVEL CLADVEN CLADVER CLADVET CLADVEU CLADVEUB CLADVEUW CLADVEV FFTDK FFTDK1P FFTDK2P FFTDVEE FFTDVEF FFTDVEFO FFTDVEL FFTDVEN FFTDVER FFTDVET FFTDVEU FFTDVEUB FFTDVEUW FFTDVEV TSFDK TSFDK1P TSFDK2P TSFDVEE TSFDVEF TSFDVEFO TSFDVEL TSFDVEN TSFDVER TSFDVET TSFDVEU TSFDVEUB TSFDVEUW TSFDVEV /end DEF_CHARACTERISTIC
 /begin REF_CHARACTERISTIC /end REF_CHARACTERISTIC
 /begin IN_MEASUREMENT /end IN_MEASUREMENT
 /begin OUT_MEASUREMENT B_bedk B_bedk1p B_bedk2p B_bedvee B_bedvef B_bedvefo B_bedvel B_bedven B_bedver B_bedvet B_bedveu B_bedveub B_bedveuw B_bedvev B_bkdk B_bkdk1p B_bkdk2p B_bkdvee B_bkdvef B_bkdvefo B_bkdvel B_bkdven B_bkdver B_bkdvet B_bkdveu B_bkdveub B_bkdveuw B_bkdvev B_cldk B_cldk1p B_cldk2p B_cldvee B_cldvef B_cldvefo B_cldvel B_cldven B_cldver B_cldvet B_cldveu B_cldveub B_cldveuw B_cldvev B_ftdk B_ftdk1p B_ftdk2p B_ftdvee B_ftdvef B_ftdvefo B_ftdvel B_ftdven B_ftdver B_ftdvet B_ftdveu B_ftdveub B_ftdveuw B_ftdvev B_mndk B_mndk1p B_mndk2p B_mndvee B_mndvef B_mndvefo B_mndvel B_mndven B_mndver B_mndvet B_mndveu B_mndveub B_mndveuw B_mndvev B_mxdk B_mxdk1p B_mxdk2p B_mxdvee B_mxdvef B_mxdvefo B_mxdvel B_mxdven B_mxdver B_mxdvet B_mxdveu B_mxdveub B_mxdveuw B_mxdvev B_npdk B_npdk1p B_npdk2p B_npdvee B_npdvef B_npdvefo B_npdvel B_npdven B_npdver B_npdvet B_npdveu B_npdveub B_npdveuw B_npdvev B_sidk B_sidk1p B_sidk2p B_sidvee B_sidvef B_sidvefo B_sidvel B_sidven B_sidver B_sidvet B_sidveu B_sidveub B_sidveuw B_sidvev E_dk E_dk1p E_dk2p E_dvee E_dvef E_dvefo E_dvel E_dven E_dver E_dvet E_dveu E_dveub E_dveuw E_dvev sfpdk sfpdk1p sfpdk2p sfpdvee sfpdvef sfpdvefo sfpdvel sfpdven sfpdver sfpdvet sfpdveu sfpdveub sfpdveuw sfpdvev TYP_dk TYP_dk1p TYP_dk2p TYP_dvee TYP_dvef TYP_dvefo TYP_dvel TYP_dven TYP_dver TYP_dvet TYP_dveu TYP_dveub TYP_dveuw TYP_dvev Z_dk Z_dk1p Z_dk2p Z_dvee Z_dvef Z_dvefo Z_dvel Z_dven Z_dver Z_dvet Z_dveu Z_dveub Z_dveuw Z_dvev /end OUT_MEASUREMENT
 /begin LOC_MEASUREMENT /end LOC_MEASUREMENT
 /begin SUB_FUNCTION /end SUB_FUNCTION
/end FUNCTION
/begin FUNCTION DFPM_DEKON ""
 /begin DEF_CHARACTERISTIC CDCAAVE CDCAGRE CDCBKVPE CDCENWSE CDCEPCLE CDCEV1 CDCEV2 CDCEV3 CDCEV4 CDCHSHE CDCKPE CDCLDE CDCMILE CDCNWSE CDCSLPE CDCSLVE CDCTEVE CDCUVSE CDCZET1 CDCZET2 CDCZET3 CDCZET4 CDKAAVE CDKAGRE CDKBKVPE CDKENWSE CDKEPCLE CDKEV1 CDKEV2 CDKEV3 CDKEV4 CDKHSHE CDKKPE CDKLDE CDKMILE CDKNWSE CDKSLPE CDKSLVE CDKTEVE CDKUVSE CDKZET1 CDKZET2 CDKZET3 CDKZET4 CDTAAVE CDTAGRE CDTBKVPE CDTENWSE CDTEPCLE CDTEV1 CDTEV2 CDTEV3 CDTEV4 CDTHSHE CDTKPE CDTLDE CDTMILE CDTNWSE CDTSLPE CDTSLVE CDTTEVE CDTUVSE CDTZET1 CDTZET2 CDTZET3 CDTZET4 CLAAAVE CLAAGRE CLABKVPE CLAENWSE CLAEPCLE CLAEV1 CLAEV2 CLAEV3 CLAEV4 CLAHSHE CLAKPE CLALDE CLAMILE CLANWSE CLASLPE CLASLVE CLATEVE CLAUVSE CLAZET1 CLAZET2 CLAZET3 CLAZET4 FFTAAVE FFTAGRE FFTBKVPE FFTENWSE FFTEPCLE FFTEV1 FFTEV2 FFTEV3 FFTEV4 FFTHSHE FFTKPE FFTLDE FFTMILE FFTNWSE FFTSLPE FFTSLVE FFTTEVE FFTUVSE FFTZET1 FFTZET2 FFTZET3 FFTZET4 TSFAAVE TSFAGRE TSFBKVPE TSFENWSE TSFEPCLE TSFEV1 TSFEV2 TSFEV3 TSFEV4 TSFHSHE TSFKPE TSFLDE TSFMILE TSFNWSE TSFSLPE TSFSLVE TSFTEVE TSFUVSE TSFZET1 TSFZET2 TSFZET3 TSFZET4 /end DEF_CHARACTERISTIC
 /begin REF_CHARACTERISTIC /end REF_CHARACTERISTIC
 /begin IN_MEASUREMENT /end IN_MEASUREMENT
 /begin OUT_MEASUREMENT B_beaave B_beagre B_bebkvpe B_beenwse B_beepcle B_beev1 B_beev2 B_beev3 B_beev4 B_behshe B_bekpe B_belde B_bemile B_benwse B_beslpe B_beslve B_beteve B_beuvse B_bezet1 B_bezet2 B_bezet3 B_bezet4 B_bkaave B_bkagre B_bkbkvpe B_bkenwse B_bkepcle B_bkev1 B_bkev2 B_bkev3 B_bkev4 B_bkhshe B_bkkpe B_bklde B_bkmile B_bknwse B_bkslpe B_bkslve B_bkteve B_bkuvse B_bkzet1 B_bkzet2 B_bkzet3 B_bkzet4 B_claave B_clagre B_clbkvpe B_clenwse B_clepcle B_clev1 B_clev2 B_clev3 B_clev4 B_clhshe B_clkpe B_cllde B_clmile B_clnwse B_clslpe B_clslve B_clteve B_cluvse B_clzet1 B_clzet2 B_clzet3 B_clzet4 B_ftaave B_ftagre B_ftbkvpe B_ftenwse B_ftepcle B_ftev1 B_ftev2 B_ftev3 B_ftev4 B_fthshe B_ftkpe B_ftlde B_ftmile B_ftnwse B_ftslpe B_ftslve B_ftteve B_ftuvse B_ftzet1 B_ftzet2 B_ftzet3 B_ftzet4 B_mnaave B_mnagre B_mnbkvpe B_mnenwse B_mnepcle B_mnev1 B_mnev2 B_mnev3 B_mnev4 B_mnhshe B_mnkpe B_mnlde B_mnmile B_mnnwse B_mnslpe B_mnslve B_mnteve B_mnuvse B_mnzet1 B_mnzet2 B_mnzet3 B_mnzet4 B_mxaave B_mxagre B_mxbkvpe B_mxenwse B_mxepcle B_mxev1 B_mxev2 B_mxev3 B_mxev4 B_mxhshe B_mxkpe B_mxlde B_mxmile B_mxnwse B_mxslpe B_mxslve B_mxteve B_mxuvse B_mxzet1 B_mxzet2 B_mxzet3 B_mxzet4 B_npaave B_npagre B_npbkvpe B_npenwse B_npepcle B_npev1 B_npev2 B_npev3 B_npev4 B_nphshe B_npkpe B_nplde B_npmile B_npnwse B_npslpe B_npslve B_npteve B_npuvse B_npzet1 B_npzet2 B_npzet3 B_npzet4 B_siaave B_siagre B_sibkvpe B_sienwse B_siepcle B_siev1 B_siev2 B_siev3 B_siev4 B_sihshe B_sikpe B_silde B_simile B_sinwse B_sislpe B_sislve B_siteve B_siuvse B_sizet1 B_sizet2 B_sizet3 B_sizet4 E_aave E_agre E_bkvpe E_enwse E_epcle E_ev1 E_ev2 E_ev3 E_ev4 E_hshe E_kpe E_lde E_mile E_nwse E_slpe E_slve E_teve E_uvse E_zet1 E_zet2 E_zet3 E_zet4 sfpaave sfpagre sfpbkvpe sfpenwse sfpepcle sfpev1 sfpev2 sfpev3 sfpev4 sfphshe sfpkpe sfplde sfpmile sfpnwse sfpslpe sfpslve sfpteve sfpuvse sfpzet1 sfpzet2 sfpzet3 sfpzet4 TYP_aave TYP_agre TYP_bkvpe TYP_enwse TYP_epcle TYP_ev1 TYP_ev2 TYP_ev3 TYP_ev4 TYP_hshe TYP_kpe TYP_lde TYP_mile TYP_nwse TYP_slpe TYP_slve TYP_teve TYP_uvse TYP_zet1 TYP_zet2 TYP_zet3 TYP_zet4 Z_aave Z_agre Z_bkvpe Z_enwse Z_epcle Z_ev1 Z_ev2 Z_ev3 Z_ev4 Z_hshe Z_kpe Z_lde Z_mile Z_nwse Z_slpe Z_slve Z_teve Z_uvse Z_zet1 Z_zet2 Z_zet3 Z_zet4 /end OUT_MEASUREMENT
 /begin LOC_MEASUREMENT /end LOC_MEASUREMENT
 /begin SUB_FUNCTION /end SUB_FUNCTION
/end FUNCTION
/begin FUNCTION DFPM_DENWS "" /begin DEF_CHARACTERISTIC CDCENWS CDKENWS CDTENWS CLAENWS FFTENWS TSFENWS /end DEF_CHARACTERISTIC /begin REF_CHARACTERISTIC /end REF_CHARACTERISTIC /begin IN_MEASUREMENT /end IN_MEASUREMENT
 /begin OUT_MEASUREMENT B_beenws B_bkenws B_clenws B_ftenws B_mnenws B_mxenws B_npenws B_sienws E_enws sfpenws TYP_enws Z_enws /end OUT_MEASUREMENT
 /begin LOC_MEASUREMENT /end LOC_MEASUREMENT
 /begin SUB_FUNCTION /end SUB_FUNCTION
/end FUNCTION
/begin FUNCTION DFPM_DFPM ""
 /begin DEF_CHARACTERISTIC CDCAAA CDCZZZ CDKAAA CDKZZZ CDTAAA CDTZZZ CLAAAA CLAZZZ FFTAAA FFTZZZ TSFAAA TSFZZZ /end DEF_CHARACTERISTIC
 /begin REF_CHARACTERISTIC /end REF_CHARACTERISTIC
 /begin IN_MEASUREMENT /end IN_MEASUREMENT
 /begin OUT_MEASUREMENT E_aaa sfpaaa sfpzzz Z_aaa /end OUT_MEASUREMENT
 /begin LOC_MEASUREMENT /end LOC_MEASUREMENT
 /begin SUB_FUNCTION /end SUB_FUNCTION
/end FUNCTION
/begin FUNCTION DFPM_DHFM "" /begin DEF_CHARACTERISTIC CDCLM CDKLM CDTLM CLALM FFTLM TSFLM /end DEF_CHARACTERISTIC /begin REF_CHARACTERISTIC /end REF_CHARACTERISTIC /begin IN_MEASUREMENT /end IN_MEASUREMENT
 /begin OUT_MEASUREMENT B_belm B_bklm B_cllm B_ftlm B_mnlm B_mxlm B_nplm B_silm E_lm sfplm TYP_lm Z_lm /end OUT_MEASUREMENT
 /begin LOC_MEASUREMENT /end LOC_MEASUREMENT
 /begin SUB_FUNCTION /end SUB_FUNCTION
/end FUNCTION
/begin FUNCTION DFPM_DHLSHK ""
 /begin DEF_CHARACTERISTIC CDCHSH CDCHSH2 CDKHSH CDKHSH2 CDTHSH CDTHSH2 CLAHSH CLAHSH2 FFTHSH FFTHSH2 TSFHSH TSFHSH2 /end DEF_CHARACTERISTIC
 /begin REF_CHARACTERISTIC /end REF_CHARACTERISTIC
 /begin IN_MEASUREMENT /end IN_MEASUREMENT
 /begin OUT_MEASUREMENT B_behsh B_behsh2 B_bkhsh B_bkhsh2 B_clhsh B_clhsh2 B_fthsh B_fthsh2 B_mnhsh B_mnhsh2 B_mxhsh B_mxhsh2 B_nphsh B_nphsh2 B_sihsh B_sihsh2 E_hsh E_hsh2 sfphsh sfphsh2 TYP_hsh TYP_hsh2 Z_hsh Z_hsh2 /end OUT_MEASUREMENT
 /begin LOC_MEASUREMENT /end LOC_MEASUREMENT
 /begin SUB_FUNCTION /end SUB_FUNCTION
/end FUNCTION
/begin FUNCTION DFPM_DHLSU ""
 /begin DEF_CHARACTERISTIC CDCHSV CDCHSV2 CDCHSVSA CDCHSVSA2 CDKHSV CDKHSV2 CDKHSVSA CDKHSVSA2 CDTHSV CDTHSV2 CDTHSVSA CDTHSVSA2 CLAHSV CLAHSV2 CLAHSVSA CLAHSVSA2 FFTHSV FFTHSV2 FFTHSVSA FFTHSVSA2 TSFHSV TSFHSV2 TSFHSVSA TSFHSVSA2 /end DEF_CHARACTERISTIC
 /begin REF_CHARACTERISTIC /end REF_CHARACTERISTIC
 /begin IN_MEASUREMENT /end IN_MEASUREMENT
 /begin OUT_MEASUREMENT B_behsv B_behsv2 B_behsvsa B_behsvsa2 B_bkhsv B_bkhsv2 B_bkhsvsa B_bkhsvsa2 B_clhsv B_clhsv2 B_clhsvsa B_clhsvsa2 B_fthsv B_fthsv2 B_fthsvsa B_fthsvsa2 B_mnhsv B_mnhsv2 B_mnhsvsa B_mnhsvsa2 B_mxhsv B_mxhsv2 B_mxhsvsa B_mxhsvsa2 B_nphsv B_nphsv2 B_nphsvsa B_nphsvsa2 B_sihsv B_sihsv2 B_sihsvsa B_sihsvsa2 E_hsv E_hsv2 E_hsvsa E_hsvsa2 sfphsv sfphsv2 sfphsvsa sfphsvsa2 TYP_hsv TYP_hsv2 TYP_hsvsa TYP_hsvsa2 Z_hsv Z_hsv2 Z_hsvsa Z_hsvsa2 /end OUT_MEASUREMENT
 /begin LOC_MEASUREMENT /end LOC_MEASUREMENT
 /begin SUB_FUNCTION /end SUB_FUNCTION
/end FUNCTION
/begin FUNCTION DFPM_DKAT "" /begin DEF_CHARACTERISTIC CDCKAT CDKKAT CDTKAT CLAKAT FFTKAT TSFKAT /end DEF_CHARACTERISTIC /begin REF_CHARACTERISTIC /end REF_CHARACTERISTIC /begin IN_MEASUREMENT /end IN_MEASUREMENT
 /begin OUT_MEASUREMENT B_bekat B_bkkat B_clkat B_ftkat B_mnkat B_mxkat B_npkat B_sikat E_kat sfpkat TYP_kat Z_kat /end OUT_MEASUREMENT
 /begin LOC_MEASUREMENT /end LOC_MEASUREMENT
 /begin SUB_FUNCTION /end SUB_FUNCTION
/end FUNCTION
/begin FUNCTION DFPM_DKRA ""
 /begin DEF_CHARACTERISTIC CDCKRA01 CDCKRA02 CDCKRA03 CDCKRA04 CDKKRA01 CDKKRA02 CDKKRA03 CDKKRA04 CDTKRA01 CDTKRA02 CDTKRA03 CDTKRA04 CLAKRA01 CLAKRA02 CLAKRA03 CLAKRA04 FFTKRA01 FFTKRA02 FFTKRA03 FFTKRA04 TSFKRA01 TSFKRA02 TSFKRA03 TSFKRA04 /end DEF_CHARACTERISTIC
 /begin REF_CHARACTERISTIC /end REF_CHARACTERISTIC
 /begin IN_MEASUREMENT /end IN_MEASUREMENT
 /begin OUT_MEASUREMENT B_clkra01 B_clkra02 B_clkra03 B_clkra04 B_mxkra01 B_mxkra02 B_mxkra03 B_mxkra04 E_kra01 E_kra02 E_kra03 E_kra04 sfpkra01 sfpkra02 sfpkra03 sfpkra04 TYPkra01 TYPkra02 TYPkra03 TYPkra04 Z_kra01 Z_kra02 Z_kra03 Z_kra04 /end OUT_MEASUREMENT
 /begin LOC_MEASUREMENT /end LOC_MEASUREMENT
 /begin SUB_FUNCTION /end SUB_FUNCTION
/end FUNCTION
/begin FUNCTION DFPM_DKRNT ""
 /begin DEF_CHARACTERISTIC CDCKRNT CDCKROF CDKKRNT CDKKROF CDTKRNT CDTKROF CLAKRNT CLAKROF FFTKRNT FFTKROF TSFKRNT TSFKROF /end DEF_CHARACTERISTIC
 /begin REF_CHARACTERISTIC /end REF_CHARACTERISTIC
 /begin IN_MEASUREMENT /end IN_MEASUREMENT
 /begin OUT_MEASUREMENT B_bekrnt B_bekrof B_bkkrnt B_bkkrof B_clkrnt B_clkrof B_ftkrnt B_ftkrof B_mnkrnt B_mnkrof B_mxkrnt B_mxkrof B_npkrnt B_npkrof B_sikrnt B_sikrof E_krnt E_krof sfpkrnt sfpkrof TYP_krnt TYP_krof Z_krnt Z_krof /end OUT_MEASUREMENT
 /begin LOC_MEASUREMENT /end LOC_MEASUREMENT
 /begin SUB_FUNCTION /end SUB_FUNCTION
/end FUNCTION
/begin FUNCTION DFPM_DKRS ""
 /begin DEF_CHARACTERISTIC CDCKS1 CDCKS2 CDCKS3 CDCKS4 CDKKS1 CDKKS2 CDKKS3 CDKKS4 CDTKS1 CDTKS2 CDTKS3 CDTKS4 CLAKS1 CLAKS2 CLAKS3 CLAKS4 FFTKS1 FFTKS2 FFTKS3 FFTKS4 TSFKS1 TSFKS2 TSFKS3 TSFKS4 /end DEF_CHARACTERISTIC
 /begin REF_CHARACTERISTIC /end REF_CHARACTERISTIC
 /begin IN_MEASUREMENT /end IN_MEASUREMENT
 /begin OUT_MEASUREMENT B_beks1 B_beks2 B_beks3 B_beks4 B_bkks1 B_bkks2 B_bkks3 B_bkks4 B_clks1 B_clks2 B_clks3 B_clks4 B_ftks1 B_ftks2 B_ftks3 B_ftks4 B_mnks1 B_mnks2 B_mnks3 B_mnks4 B_mxks1 B_mxks2 B_mxks3 B_mxks4 B_npks1 B_npks2 B_npks3 B_npks4 B_siks1 B_siks2 B_siks3 B_siks4 E_ks1 E_ks2 E_ks3 E_ks4 sfpks1 sfpks2 sfpks3 sfpks4 TYP_ks1 TYP_ks2 TYP_ks3 TYP_ks4 Z_ks1 Z_ks2 Z_ks3 Z_ks4 /end OUT_MEASUREMENT
 /begin LOC_MEASUREMENT /end LOC_MEASUREMENT
 /begin SUB_FUNCTION /end SUB_FUNCTION
/end FUNCTION
/begin FUNCTION DFPM_DKRTP "" /begin DEF_CHARACTERISTIC CDCKRTP CDKKRTP CDTKRTP CLAKRTP FFTKRTP TSFKRTP /end DEF_CHARACTERISTIC /begin REF_CHARACTERISTIC /end REF_CHARACTERISTIC /begin IN_MEASUREMENT /end IN_MEASUREMENT
 /begin OUT_MEASUREMENT B_bekrtp B_bkkrtp B_clkrtp B_ftkrtp B_mnkrtp B_mxkrtp B_npkrtp B_sikrtp E_krtp sfpkrtp TYP_krtp Z_krtp /end OUT_MEASUREMENT
 /begin LOC_MEASUREMENT /end LOC_MEASUREMENT
 /begin SUB_FUNCTION /end SUB_FUNCTION
/end FUNCTION
/begin COMPU_METHOD B_TRUE "boolsche Zustände, positive Logik" TAB_VERB "%6.3" "" COMPU_TAB_REF B_TRUE /end COMPU_METHOD
/begin COMPU_VTAB B_TRUE "boolsche Zustände, positive Logik" TAB_VERB 2 0 "----" 1 "TRUE" /end COMPU_VTAB
/begin COMPU_METHOD dez "1 : 1 Umrechnug (dez/hex)" RAT_FUNC "%6.2" "" COEFFS 0 1 0 0 0 1 /end COMPU_METHOD
/begin COMPU_METHOD default "" RAT_FUNC "%6.2" "" COEFFS 0 1 0 0 0 1 /end COMPU_METHOD
/begin RECORD_LAYOUT KwbUb FNC_VALUES 1 UBYTE COLUMN_DIR DIRECT /end RECORD_LAYOUT
/begin RECORD_LAYOUT KwbUw FNC_VALUES 1 UWORD COLUMN_DIR DIRECT /end RECORD_LAYOUT
/begin RECORD_LAYOUT KwUb FNC_VALUES 1 UBYTE COLUMN_DIR DIRECT /end RECORD_LAYOUT
/begin RECORD_LAYOUT KwUw FNC_VALUES 1 UWORD COLUMN_DIR DIRECT /end RECORD_LAYOUT
/end MODULE
/end PROJECT
