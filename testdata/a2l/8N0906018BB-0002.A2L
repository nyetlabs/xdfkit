ASAP2_VERSION 1 3
/begin PROJECT X505R_24d1_0 "4019.XX"
/begin HEADER "" VERSION "X505R_24d1_0" PROJECT_NO X505R_24d1_0 /end HEADER
/begin MODULE DIM ""
/begin MOD_COMMON "" BYTE_ORDER MSB_LAST ALIGNMENT_BYTE 1 ALIGNMENT_WORD 2 ALIGNMENT_LONG 2 /end MOD_COMMON
/begin CHARACTERISTIC BTRKHTMS "Kennline zur Freigabe B_trkh" CURVE 0x81959B KlAUbSstUbWUb 255.0 dez 0.00 255.0 FORMAT "%5.1"
 /begin AXIS_DESCR STD_AXIS tmst temp_ub_q0p75_o48 8 -48.00 143.3 FORMAT "%5.1" DEPOSIT ABSOLUTE /end AXIS_DESCR
/end CHARACTERISTIC
/begin CHARACTERISTIC CBGRLP "Codewort Konfiguration Funktion BGRLP" VALUE 0x810DD5 KwUb 255.0 dez 0.00 255.0 FORMAT "%5.1" /end CHARACTERISTIC
/begin CHARACTERISTIC CWBGMIL "Codewort aus BGMIL" VALUE 0x81847F KwUb 255.0 dez 0.00 255.0 FORMAT "%5.1" /end CHARACTERISTIC
/begin CHARACTERISTIC CWBGMSZS "Codewort für die BGMSZS" VALUE 0x810D2F KwUb 255.0 DEZ 0.00 255.0 FORMAT "%5.1" /end CHARACTERISTIC
/begin CHARACTERISTIC CWBGTABST "Codewort für Abstellzeitermittlung" VALUE 0x819259 KwUb 255.0 DEZ 0.00 255.0 FORMAT "%5.1" /end CHARACTERISTIC
/begin CHARACTERISTIC CWBGWPFGR "Codewort für %BGWPFGR" VALUE 0x818A0F KwUb 255.0 dez 0.00 255.0 FORMAT "%5.1" /end CHARACTERISTIC
/begin CHARACTERISTIC CWDVEFO "Codeword öffnende Federprüfung" VALUE 0x810B55 KwUb 255.0 dez 0.00 255.0 FORMAT "%5.1" /end CHARACTERISTIC
/begin CHARACTERISTIC CWFKMSDKA "Codewort für Massenstromadaption aktiv" VALUE 0x810D30 KwUb 255.0 dez 0.00 255.0 FORMAT "%5.1" /end CHARACTERISTIC
/begin CHARACTERISTIC CWKHZ "Codewort für Katheizsteuerung" VALUE 0x8195AC KwUb 255.0 dez 0.00 255.0 FORMAT "%5.1" /end CHARACTERISTIC
/begin CHARACTERISTIC CWNWGE "Codewort Nockenwellensteuerung bei Getriebeeingriff" VALUE 0x81A300 KwUb 255.0 dez 0.00 255.0 FORMAT "%5.1" /end CHARACTERISTIC
/begin CHARACTERISTIC CWNWSA "Codewort Nockenwellensteuerung Auslass" VALUE 0x82844A KwUw 65535.00 dez 0.00 65535.00 FORMAT "%8.2" /end CHARACTERISTIC
/begin CHARACTERISTIC CWNWSE "Codewort Nockenwellensteuerung Einlass" VALUE 0x82844C KwUw 65535.00 dez 0.00 65535.00 FORMAT "%8.2" /end CHARACTERISTIC
/begin CHARACTERISTIC CWNWSG "Codewort Nockenwellensteuerung global" VALUE 0x82844E KwUw 65535.00 dez 0.00 65535.00 FORMAT "%8.2" /end CHARACTERISTIC
/begin CHARACTERISTIC CWPLGU "Codeword für Grundladedruckberechnung %BGPLGU" VALUE 0x819ADD KwUb 255.0 DEZ 0.00 255.0 FORMAT "%5.1" /end CHARACTERISTIC
/begin CHARACTERISTIC CWRBS "Codewort BGRBS" VALUE 0x811EF1 KwUb 255.0 dez 0.00 255.0 FORMAT "%5.1" /end CHARACTERISTIC
/begin CHARACTERISTIC CWSAWE "Codewort Schubabschalten - Wiedereinsetzen" VALUE 0x81124E KwUb 255.0 dez 0.00 255.0 FORMAT "%5.1" /end CHARACTERISTIC
/begin CHARACTERISTIC CWTEMPK "Codeword für Adressierung FWFTBRTA (tans/evtmod)" VALUE 0x818A4C KwUb 255.0 dez 0.00 255.0 FORMAT "%5.1" /end CHARACTERISTIC
/begin CHARACTERISTIC DDFUELSAN "Schwelle für Delta Füllungssensor alpha/n-system" VALUE 0x814A74 KwUw 0.9999847 fak_uw_b1 0.00 0.9999847 FORMAT "%9.7" /end CHARACTERISTIC
/begin CHARACTERISTIC DDRLDKZU "Deltadifferenz zwischen rl aus Haupt- und Nebenlastsignal" VALUE 0x814A76 KwSw 1535.977 rel_sw_q0p0234 -768.0000 767.9766 FORMAT "%8.4" /end CHARACTERISTIC
/begin CHARACTERISTIC DEVTMAGR "Offset für evtmod abhängig von tsges_w bei hoher tans verursacht d. AGR" CURVE 0x81CAFA KlASwSstSwWSw 49151.25 temp_sw_q0p75 -24576.00 24575.25 FORMAT "%8.2"
 /begin AXIS_DESCR STD_AXIS tsges_w temp_sw_q0p75 8 -24576.00 24575.25 FORMAT "%8.2" DEPOSIT ABSOLUTE /end AXIS_DESCR
/end CHARACTERISTIC
/begin CHARACTERISTIC DFGNSOL "Abregelkonstante für Getriebesolldrehzahlbeeinflußung" VALUE 0x81F936 KwUw 99.99847 rel_uw_b100 0.00 99.99847 FORMAT "%8.5" /end CHARACTERISTIC
/begin CHARACTERISTIC DFKMSMN "Delta FKMSDKMN zum Rücksetzen von B_fkmsmn" VALUE 0x814A78 KwUw 3.999939 fak_uw_b4 0.00 3.999939 FORMAT "%8.6" /end CHARACTERISTIC
/begin CHARACTERISTIC DFKMSMX "Delta FKMSDKMX zum Rücksetzen von B_fkmsmx" VALUE 0x814A7A KwUw 3.999939 fak_uw_b4 0.00 3.999939 FORMAT "%8.6" /end CHARACTERISTIC
/begin CHARACTERISTIC DFKPVMN "Delta FKPVDKMN zum Rücksetzen von B_fkpvmn" VALUE 0x81BF1C KwUw 3.999939 fak_uw_b4 0.00 3.999939 FORMAT "%8.6" /end CHARACTERISTIC
/begin CHARACTERISTIC DFKPVMX "Delta FKPVDKMX zum Rücksetzen von B_fkpvmx" VALUE 0x81BF1E KwUw 3.999939 fak_uw_b4 0.00 3.999939 FORMAT "%8.6" /end CHARACTERISTIC
/begin CHARACTERISTIC DFTEDS "Hysteresebreite Beladung für Umschaltung auf Dauertankentlüftung" VALUE 0x81D0C0 KwSw 127.9980 fak_sw_b64 -64.00000 63.99805 FORMAT "%8.5" /end CHARACTERISTIC
/begin CHARACTERISTIC DIFFMAX "max. zulässige Druckänderung während 100ms" VALUE 0x817136 KwUw 2559.961 p_uw_q0p039 0.00 2559.961 FORMAT "%8.3" /end CHARACTERISTIC
/begin CHARACTERISTIC DKPSTGMIN "min. Steigung des DK-Poti zur Umr. abs. auf rel. Winkel im worst case" VALUE 0x8144E4 KwUw 39.99939 rel_uw_b40 0.00 39.99939 FORMAT "%8.5" /end CHARACTERISTIC
/begin CHARACTERISTIC DLRPIDSTMN "min. Schwelle für PWM-Tastverhältnis des DLR bei temp. UMA-Adapt." VALUE 0x8144E6 KwUw 99.99847 rel_uw_b100 0.00 99.99847 FORMAT "%8.5" /end CHARACTERISTIC
/begin CHARACTERISTIC DMRFATE "Hysterese Hochlasterkennung" VALUE 0x818FDD KwUb 99.61 rel_ub_b99p6 0.00 99.61 FORMAT "%5.2" /end CHARACTERISTIC
/begin CHARACTERISTIC DNLLSNW "Delta Leerlaufsolldrehzahl zur Aktivierung der Nockenwellenfunktionalität" VALUE 0x81A301 KwUb 2550. nmot_ub_q10 0.00 2550. FORMAT "%5.0" /end CHARACTERISTIC
/begin CHARACTERISTIC DNSAH "Delta n SA high bezogen auf nWE" VALUE 0x81124F KwUb 5080. nmot_ub_q40 0.00 5080. FORMAT "%5.0" /end CHARACTERISTIC
/begin CHARACTERISTIC DNSAL "Delta n SA low bezogen auf nWE" VALUE 0x811250 KwUb 5080. nmot_ub_q40 0.00 5080. FORMAT "%5.0" /end CHARACTERISTIC
/begin CHARACTERISTIC DNSATIP "Schubabschaltedrehzahlanhebung bei Tipgasse" VALUE 0x811251 KwUb 10200. nmot_ub_q40 0.00 10200. FORMAT "%5.0" /end CHARACTERISTIC
/begin CHARACTERISTIC DNSLL "Schubabschalte-Hysterese bei WE im Leerlauf" VALUE 0x811252 KwUb 10200. nmot_ub_q40 0.00 10200. FORMAT "%5.0" /end CHARACTERISTIC
/begin CHARACTERISTIC DNVSA "Schubabschaltedrehzahlanhebung bei kleiner Geschwindigkeit" VALUE 0x811253 KwUb 10200. nmot_ub_q40 0.00 10200. FORMAT "%5.0" /end CHARACTERISTIC
/begin CHARACTERISTIC DNWEK "Delta n für WE bei Klima (AC)" VALUE 0x811254 KwUb 10200. nmot_ub_q40 0.00 10200. FORMAT "%5.0" /end CHARACTERISTIC
/begin CHARACTERISTIC DRLDYNU "drl-Schwellwert für te-Nachspritzer/Reduktion" VALUE 0x81554E KwSw 767.9531 rel_sw_q0p0234 0.02343750 767.9766 FORMAT "%8.4" /end CHARACTERISTIC
/begin CHARACTERISTIC DRLMIN "Min. Füllungsänderung zur Auslösung eines Nachspritzers" VALUE 0x815550 KwSw 1535.977 rel_sw_q0p0234 -768.0000 767.9766 FORMAT "%8.4" /end CHARACTERISTIC
/begin CHARACTERISTIC DTABOVF "Schwelle delta Abstellzeit für Überlauferkennung" VALUE 0x81D1BA KwUw 65535.00 t1sxs_uw_q1 0.00 65535.00 FORMAT "%8.2" /end CHARACTERISTIC
/begin CHARACTERISTIC DTABUNPL "Schwelle Abstellzeit unplausibel" VALUE 0x81D1BC KwUw 65535.00 DEZ 0.00 65535.00 FORMAT "%8.2" /end CHARACTERISTIC
/begin CHARACTERISTIC DTEPRU "delta-te-Schwelle fuer Nachspritzer-/ti-Reduktion erkannt" VALUE 0x815552 KwUw 174.7600 tinjection_sy 0.00 174.7600 FORMAT "%8.4" /end CHARACTERISTIC
/begin CHARACTERISTIC DTKATMN "Hysterese Katalysatortemperaturregelschwelle für Kat warmhalten" VALUE 0x8195AD KwUb 1275. temp_ub_q5_o50 -50.00 1225. FORMAT "%5.0" /end CHARACTERISTIC
/begin CHARACTERISTIC DTKH "Betrag Differenztemperatur (tans-tmst) für Katheizen" VALUE 0x8195AE KwUb 191.3 temp_ub_b191p25 0.00 191.3 FORMAT "%5.1" /end CHARACTERISTIC
/begin CHARACTERISTIC DTMABKH "Temperaturdifferenz zwischen Abstellen und Neustart für Freigabe Katheizen" VALUE 0x8195AF KwUb 191.3 temp_ub_b191p25 0.00 191.3 FORMAT "%5.1" /end CHARACTERISTIC
/begin CHARACTERISTIC DUBLBZ "Spannungsoffset für Ladebilanzberechnung" VALUE 0x8188C6 KwUb 17.95 spg_ubatt 0.00 17.95 FORMAT "%5.2" /end CHARACTERISTIC
/begin CHARACTERISTIC DUDKNLPO "Toleranzband für NLP nach oben (inkl. Rü)" VALUE 0x8144E8 KwUw 4.998779 spg_q1p221_mV 0.00 4.998779 FORMAT "%8.6" /end CHARACTERISTIC
/begin CHARACTERISTIC DUDKNLPU "Toleranzband für NLP nach unten" VALUE 0x8144EA KwUw 4.998779 spg_q1p221_mV 0.00 4.998779 FORMAT "%8.6" /end CHARACTERISTIC
/begin CHARACTERISTIC DUDKPTMP "Delta eines Rampenschrittes bei der temp. UMA-Adaption" VALUE 0x810B56 KwUb 0.3064 spg_q1p221_mV 0.004883 0.3113 /end CHARACTERISTIC
/begin CHARACTERISTIC DVSA "delta Geschwindigkeitsschwelle für SA-Drehzahlanhebung" VALUE 0x811255 KwUb 318.8 vfzg_ub_q1p25 0.00 318.8 FORMAT "%5.1" /end CHARACTERISTIC
/begin CHARACTERISTIC DWNWADRPE "Max. Abweichung Nockenwellenpos. von Referenzpos. für Adaptionsfreigabe Einlass" VALUE 0x827FE8 KwUw 511.9922 kw_q0p0078 0.00 511.9922 FORMAT "%8.4" /end CHARACTERISTIC
/begin CHARACTERISTIC DWPR "Delta Prädiktionswinkel ohne Nachspritzer/ti-Reduktion" VALUE 0x810DD6 KwSb 1530. kw_q6 -768.0 762.0 FORMAT "%5.1" /end CHARACTERISTIC
/begin CHARACTERISTIC DWPRNSP "Delta Prädiktionswinkel bei Nachspritzerfreigabe" VALUE 0x810DD7 KwSb 1530. kw_q6 -768.0 762.0 FORMAT "%5.1" /end CHARACTERISTIC
/begin CHARACTERISTIC ENSAKHG "Freigabe Schubabschalten bei Katheizen gangabhaengig" VALUE 0x811256 KwUb 255.0 dez 0.00 255.0 FORMAT "%5.1" /end CHARACTERISTIC
/begin CHARACTERISTIC EVTMODO "Offset für evtmod abhängig von gefilterter Motortemperatur" CURVE 0x818A4D KlAUbSstUbWUb 191.3 temp_ub_q0p75_o48 -48.00 143.3 FORMAT "%5.1"
 /begin AXIS_DESCR STD_AXIS tmotfil temp_ub_q0p75_o48 12 -48.00 143.3 FORMAT "%5.1" DEPOSIT ABSOLUTE /end AXIS_DESCR
/end CHARACTERISTIC
/begin CHARACTERISTIC FAKTABGM "Wichtungsfaktor für tabgm (Abgastemperatur)  zur Berechnung der stat. Brennraumt" VALUE 0x818A66 KwUb 1.992 fak_ub_b2 0.00 1.992 FORMAT "%5.3" /end CHARACTERISTIC
/begin CHARACTERISTIC FDVANS "Temperaturfaktor für Drosselventildurchfluß" CURVE 0x818A67 KlAUbSstUbWUb 1.992 fak_ub_b2 0.00 1.992 FORMAT "%5.3"
 /begin AXIS_DESCR STD_AXIS tans temp_ub_q0p75_o48 8 -48.00 143.3 FORMAT "%5.1" DEPOSIT ABSOLUTE /end AXIS_DESCR
/end CHARACTERISTIC
/begin CHARACTERISTIC FHBASAPP "Wert von fho bei Bedatung von KFPLGUB (Basishöhe)" VALUE 0x81F7E6 KwUw 2.000000 fak_uw_b4 0.00 2.000000 FORMAT "%8.6" /end CHARACTERISTIC
/begin CHARACTERISTIC FHOKH "minimaler Höhenfaktor für Katheizen" VALUE 0x81D5F8 KwUw 3.999939 fak_uw_b4 0.00 3.999939 FORMAT "%8.6" /end CHARACTERISTIC
/begin CHARACTERISTIC FKHABMN_0_A "Schwelle Abregelfaktor Katheizen" VALUE 0x81D82C KwUb 0.9961 fak_ub_b1 0.00 0.9961 /end CHARACTERISTIC
/begin CHARACTERISTIC FKHABMN_1_A "Schwelle Abregelfaktor Katheizen" VALUE 0x81D82D KwUb 0.9961 fak_ub_b1 0.00 0.9961 /end CHARACTERISTIC
/begin CHARACTERISTIC FKHLA_0_A "Wichtungsfaktor Lambda-Soll für Katheizen" CURVE 0x81D5FA KlAUwSstUwWUw 0.9999847 fak_uw_b1 0.00 0.9999847 FORMAT "%9.7"
 /begin AXIS_DESCR STD_AXIS imlpr_w fak_uw_b1 8 0.00 0.9999847 FORMAT "%9.7" DEPOSIT ABSOLUTE /end AXIS_DESCR
/end CHARACTERISTIC
/begin CHARACTERISTIC FKHLA_1_A "Wichtungsfaktor Lambda-Soll für Katheizen" CURVE 0x81D61C KlAUwSstUwWUw 0.9999847 fak_uw_b1 0.00 0.9999847 FORMAT "%9.7"
 /begin AXIS_DESCR STD_AXIS imlpr_w fak_uw_b1 8 0.00 0.9999847 FORMAT "%9.7" DEPOSIT ABSOLUTE /end AXIS_DESCR
/end CHARACTERISTIC
/begin CHARACTERISTIC FKHMD_0_A "Wichtungsfaktor Drehmomentreserve für Katheizen" CURVE 0x81D63E KlAUwSstUwWUw 0.9999847 fak_uw_b1 0.00 0.9999847 FORMAT "%9.7"
 /begin AXIS_DESCR STD_AXIS imlpr_w fak_uw_b1 8 0.00 0.9999847 FORMAT "%9.7" DEPOSIT ABSOLUTE /end AXIS_DESCR
/end CHARACTERISTIC
/begin CHARACTERISTIC FKHMD_1_A "Wichtungsfaktor Drehmomentreserve für Katheizen" CURVE 0x81D660 KlAUwSstUwWUw 0.9999847 fak_uw_b1 0.00 0.9999847 FORMAT "%9.7"
 /begin AXIS_DESCR STD_AXIS imlpr_w fak_uw_b1 8 0.00 0.9999847 FORMAT "%9.7" DEPOSIT ABSOLUTE /end AXIS_DESCR
/end CHARACTERISTIC
/begin CHARACTERISTIC FKMSDKMN "min.Korrekturfaktor schneller Massenstromabgleich" VALUE 0x814A7C KwUw 3.999939 fak_uw_b4 0.00 3.999939 FORMAT "%8.6" /end CHARACTERISTIC
/begin CHARACTERISTIC FKMSDKMX "max.Korrekturfaktor schneller Massenstromabgleich" VALUE 0x814A7E KwUw 3.999939 fak_uw_b4 0.00 3.999939 FORMAT "%8.6" /end CHARACTERISTIC
/begin CHARACTERISTIC FKPVDKMN "Minimaler Korrekturfaktor langsamer Massenstomabgleich" VALUE 0x81BF20 KwUw 3.999939 fak_uw_b4 0.00 3.999939 FORMAT "%8.6" /end CHARACTERISTIC
/begin CHARACTERISTIC FKPVDKMX "Maximaler Korrekturfaktor langsamer Massenstomabgleich" VALUE 0x81BF22 KwUw 3.999939 fak_uw_b4 0.00 3.999939 FORMAT "%8.6" /end CHARACTERISTIC
/begin CHARACTERISTIC FLTEFUEL "Faktor Anteil TEV Strom, der direkt ins Saugrohr strömt" CURVE 0x81A2F7 KlAUbSstUbWUb 0.9961 fak_ub_b1 0.00 0.9961 /begin AXIS_DESCR STD_AXIS qltefil fak_ub_b1 4 0.00 0.9961 DEPOSIT ABSOLUTE /end AXIS_DESCR /end CHARACTERISTIC
/begin CHARACTERISTIC FMRFAZTE "Gewichtung der Drehzahl um jetzige Leistung zu berechnen" CURVE 0x818FDE KlAUbSstUbWUb 3.984 fak_ub_b4 0.00 3.984 FORMAT "%5.3"
 /begin AXIS_DESCR STD_AXIS nmot nmot_ub_q40 4 0.00 10200. FORMAT "%5.0" DEPOSIT ABSOLUTE /end AXIS_DESCR
/end CHARACTERISTIC
/begin CHARACTERISTIC FNSKHLL "Faktor für Drehzahlanhebung direkt nach Start" CURVE 0x8195B0 KlAUbSstUbWUb 1.992 fak_ub_b2 0.00 1.992 FORMAT "%5.3" /begin AXIS_DESCR STD_AXIS imlpr fak_ub_b1 5 0.00 0.9961 DEPOSIT ABSOLUTE /end AXIS_DESCR /end CHARACTERISTIC
/begin CHARACTERISTIC FPRAT "Ansauglufttemperaturschwelle für DV-E-Federprüfung" VALUE 0x810B57 KwUb 191.3 temp_ub_q0p75_o48 -48.00 143.3 FORMAT "%5.1" /end CHARACTERISTIC
/begin CHARACTERISTIC FPRMT "Motortemperaturschwelle für DV-E-Federprüfung" VALUE 0x810B58 KwUb 191.3 temp_ub_q0p75_o48 -48.00 143.3 FORMAT "%5.1" /end CHARACTERISTIC
/begin CHARACTERISTIC FPRNMAX "Motordrehzahlschwelle für DV-E-Federprüfung" VALUE 0x810B59 KwUb 2550. nmot_ub_q10 0.00 2550. FORMAT "%5.0" /end CHARACTERISTIC
/begin CHARACTERISTIC FPRTIM1_T "DV-E-Federprüfung, Wartezeit in Prüfschritt 1" VALUE 0x810B5A KwUb 2.540 t10msxs_ub_b2p55 0.01000 2.550 FORMAT "%5.3" /end CHARACTERISTIC
/begin CHARACTERISTIC FPRTIM2_T "DV-E-Federprüfung, Wartezeit in Prüfschritt 2" VALUE 0x810B5B KwUb 2.540 t10msxs_ub_b2p55 0.01000 2.550 FORMAT "%5.3" /end CHARACTERISTIC
/begin CHARACTERISTIC FPRTIM3_T "DV-E-Federprüfung: Wartezeit in Prüfschritt 5" VALUE 0x810B5C KwUb 2.540 t10msxs_ub_b2p55 0.01000 2.550 FORMAT "%5.3" /end CHARACTERISTIC
/begin CHARACTERISTIC FPRTIM4_T "DV-E-Federprüfung: Wartezeit in Prüfschritt 6" VALUE 0x810B5D KwUb 2.540 t10msxs_ub_b2p55 0.01000 2.550 FORMAT "%5.3" /end CHARACTERISTIC
/begin CHARACTERISTIC FPVMXN2 "Faktor maximales Druckverhältnis mit Nebenlastsignal" CURVE 0x81C7C0 KlAUwSstUwWUw 3.999939 fak_uw_b4 0.00 3.999939 FORMAT "%8.6"
 /begin AXIS_DESCR STD_AXIS nmot_w nmot_uw_q0p25 6 0.00 16383.75 FORMAT "%8.2" DEPOSIT ABSOLUTE /end AXIS_DESCR
/end CHARACTERISTIC
/begin CHARACTERISTIC FPVMXP "Faktor maximales Druckverhältnis fuer Lastpraediktion" VALUE 0x815554 KwUw 1.999969 fak_uw_b2 0.00 1.999969 FORMAT "%8.6" /end CHARACTERISTIC
/begin CHARACTERISTIC FTEADZU "Schwelle Beladung für Unterbrechung TE-Phase für Diagnose Funktionen" VALUE 0x81D0C2 KwSw 127.9980 fak_sw_b64 -64.00000 63.99805 FORMAT "%8.5" /end CHARACTERISTIC
/begin CHARACTERISTIC FTEDS "Schwelle Beladung für Umschaltung auf Dauertankentlüftung" VALUE 0x81D0C4 KwSw 127.9980 fak_sw_b64 -64.00000 63.99805 FORMAT "%8.5" /end CHARACTERISTIC
/begin CHARACTERISTIC FTMLAKH "tmot-Korrektur der Lambda-Bewertung bei Katheizen" CURVE 0x8195BB KlAUbSstUbWUb 0.9961 fak_ub_b1 0.00 0.9961
 /begin AXIS_DESCR STD_AXIS tmot temp_ub_q0p75_o48 4 -48.00 143.3 FORMAT "%5.1" DEPOSIT ABSOLUTE /end AXIS_DESCR
/end CHARACTERISTIC
/begin CHARACTERISTIC FUMRMV "Faktor Dichte der Luft" VALUE 0x811F44 KwUb 1.992 dichte_ub_b2 0.00 1.992 FORMAT "%5.3" /end CHARACTERISTIC
/begin CHARACTERISTIC FWFTBRTA "Wichtung ftbr in Abhängigkeit von tans" CURVE 0x818A78 KlAUbSstUbWUb 1.992 fak_ub_b2 0.00 1.992 FORMAT "%5.3"
 /begin AXIS_DESCR STD_AXIS tempin temp_ub_q0p75_o48 14 -48.00 143.3 FORMAT "%5.1" DEPOSIT ABSOLUTE /end AXIS_DESCR
/end CHARACTERISTIC
/begin CHARACTERISTIC FWLKFTBR "Warmlaufkorrektur für Brennraumtemperaturmodell" CURVE 0x818A95 KlAUbSstUbWUb 1.992 fak_ub_b2 0.00 1.992 FORMAT "%5.3"
 /begin AXIS_DESCR STD_AXIS tmotdif temp_ub_q0p75_o48 8 -48.00 143.3 FORMAT "%5.1" DEPOSIT ABSOLUTE /end AXIS_DESCR
/end CHARACTERISTIC
/begin CHARACTERISTIC FWRLDKNM "KL für Wichtung der rel. Luftfüllung aus DK-Signal berechnet in Abh. von nmot" CURVE 0x814A80 KlAUwSstUwWUw 1.999969 fak_uw_b2 0.00 1.999969 FORMAT "%8.6"
 /begin AXIS_DESCR STD_AXIS nmot_w nmot_uw_q0p25 6 0.00 16383.75 FORMAT "%8.2" DEPOSIT ABSOLUTE /end AXIS_DESCR
/end CHARACTERISTIC
/begin CHARACTERISTIC HYNMOTNW "Hysterese für nmot_w zur Adressierung von Kennfeld" VALUE 0x81A31C KwUb 10200. nmot_ub_q40 0.00 10200. FORMAT "%5.0" /end CHARACTERISTIC
/begin CHARACTERISTIC HYRLNW "Hysterese für rlnw zur Adressierung Kennfeld" VALUE 0x827FEA KwUw 1535.977 rel_uw_q0p0234 0.00 1535.977 FORMAT "%8.3" /end CHARACTERISTIC
/begin CHARACTERISTIC IMLATMMXI "max. INI-Wert für aufintegrierte Abgasluftmasse im Nachlauf" VALUE 0x81D682 KwUw 23.30133 m_uw_b23p3 0.00 23.30133 FORMAT "%8.5" /end CHARACTERISTIC
/begin CHARACTERISTIC IMLATMNLMN "Min.-Wert für aufintegrierte Luftmasse im Nachlauf" VALUE 0x81D684 KwUw 23.30133 m_uw_b23p3 0.00 23.30133 FORMAT "%8.5" /end CHARACTERISTIC
/begin CHARACTERISTIC IMLATMNLMX "Max.-Wert für aufintegrierte Luftmasse im Nachlauf" VALUE 0x81D686 KwUw 23.30133 m_uw_b23p3 0.00 23.30133 FORMAT "%8.5" /end CHARACTERISTIC
/begin CHARACTERISTIC IMLATWS "Luftmassen-Schwelle für Kat-Heizen nach Wiederholstart" VALUE 0x81D688 KwUw 23.30133 m_uw_b23p3 0.00 23.30133 FORMAT "%8.5" /end CHARACTERISTIC
/begin CHARACTERISTIC IMLKHMX "max. Verhältnisfaktor psum_w/mlsu für Einschaltung Katheizen" VALUE 0x8195C4 KwUb 0.9961 fak_ub_b1 0.00 0.9961 /end CHARACTERISTIC
/begin CHARACTERISTIC IMLKHTMS "imlpr-Schwelle für Übergang auf Lambda-Katheizen" CURVE 0x8157F2 KlAUbSstUbWUb 0.9961 fak_ub_b1 0.00 0.9961
 /begin AXIS_DESCR STD_AXIS tmst temp_ub_q0p75_o48 8 -48.00 143.3 FORMAT "%5.1" DEPOSIT ABSOLUTE /end AXIS_DESCR
/end CHARACTERISTIC
/begin CHARACTERISTIC IMTUMTA "Schwelle integrierte Luftmasse für Bestimmung Umgebungstemperatur" VALUE 0x81BFF0 KwUw 23.30133 m_uw_b23p3 0.00 23.30133 FORMAT "%8.5" /end CHARACTERISTIC
/begin CHARACTERISTIC KAFLTESG "Ausfußkonstante Leitung TEV-Saugrohr" VALUE 0x82840C KwUw 28.79956 fak1_q4p3945Em4 0.00 28.79956 FORMAT "%8.5" /end CHARACTERISTIC
/begin CHARACTERISTIC KFDFBTMN "Faktor Dynamikanteil Brennraumtemperaturmodell für negative Gradienten" MAP 0x81CB1C KfAxUbAyUbSstxUwSstyUbWUb 1.992 fak_ub_b2 0.00 1.992 FORMAT "%5.3"
 /begin AXIS_DESCR STD_AXIS tabgm_w temp_uw_q0p0195_o50 6 -50.00000 1229.980 FORMAT "%8.3" DEPOSIT ABSOLUTE /end AXIS_DESCR
 /begin AXIS_DESCR STD_AXIS nmot nmot_ub_q40 8 0.00 10200. FORMAT "%5.0" DEPOSIT ABSOLUTE /end AXIS_DESCR
/end CHARACTERISTIC
/begin CHARACTERISTIC KFDFBTMP "Faktor Dynamikanteil Brennraumtemperaturmodell für positive Gradienten" MAP 0x81CB62 KfAxUbAyUbSstxUwSstyUbWUb 1.992 fak_ub_b2 0.00 1.992 FORMAT "%5.3"
 /begin AXIS_DESCR STD_AXIS tabgm_w temp_uw_q0p0195_o50 6 -50.00000 1229.980 FORMAT "%8.3" DEPOSIT ABSOLUTE /end AXIS_DESCR
 /begin AXIS_DESCR STD_AXIS nmot nmot_ub_q40 8 0.00 10200. FORMAT "%5.0" DEPOSIT ABSOLUTE /end AXIS_DESCR
/end CHARACTERISTIC
/begin CHARACTERISTIC KFDPLGU "Deltadruckabweichung Grundladedruck  für Höhe" MAP 0x81F7E8 KfAxUbAyUbSstxUwSstyUwWUw 2559.961 p_uw_q0p039 0.00 2559.961 FORMAT "%8.3"
 /begin AXIS_DESCR STD_AXIS nmot_w nmot_uw_q0p25 8 0.00 10500.00 FORMAT "%8.2" DEPOSIT ABSOLUTE /end AXIS_DESCR
 /begin AXIS_DESCR STD_AXIS ps_w p_uw_q0p039 8 0.00 2559.961 FORMAT "%8.3" DEPOSIT ABSOLUTE /end AXIS_DESCR
/end CHARACTERISTIC
/begin CHARACTERISTIC KFDPVL "Druckabfall am Luftfilter zur Berechnung Massestrom Tankentlüftung hinter Lader" MAP 0x82840E KfAxUwAyUwSstxUwSstyUwWUw 2559.961 p_uw_q0p039 0.00 2559.961 FORMAT "%8.3"
 /begin AXIS_DESCR STD_AXIS vfzg_w vfzg_uw_b512 3 0.00 511.9922 FORMAT "%8.4" DEPOSIT ABSOLUTE /end AXIS_DESCR
 /begin AXIS_DESCR STD_AXIS mshfm_w m_uw_b6553p5 6 0.00 6553.500 FORMAT "%8.3" DEPOSIT ABSOLUTE /end AXIS_DESCR
/end CHARACTERISTIC
/begin CHARACTERISTIC KFFWTBR "Wichtungsfaktor Tans/Tmot für Brennraumtemperaturmodell" MAP 0x818AA6 KfAxUbAyUbSstxUbSstyUbWUb 1.992 fak_ub_b2 0.00 1.992 FORMAT "%5.3"
 /begin AXIS_DESCR STD_AXIS rl rel_ub_q0p75 10 0.00 191.3 FORMAT "%5.1" DEPOSIT ABSOLUTE /end AXIS_DESCR
 /begin AXIS_DESCR STD_AXIS nmot nmot_ub_q40 8 0.00 10200. FORMAT "%5.0" DEPOSIT ABSOLUTE /end AXIS_DESCR
/end CHARACTERISTIC
/begin CHARACTERISTIC KFGNSOL "Kennfeld für Abregelinitialisierungswert fgnsol" MAP 0x81F938 KfAxUbAyUbSstxUwSstyUbWUb 99.61 rel_ub_b99p6 0.00 99.61 FORMAT "%5.2"
 /begin AXIS_DESCR STD_AXIS imlatmw_w m_uw_b23p3 6 0.00 23.30133 FORMAT "%8.5" DEPOSIT ABSOLUTE /end AXIS_DESCR
 /begin AXIS_DESCR STD_AXIS tmst temp_ub_q0p75_o48 6 -48.00 143.3 FORMAT "%5.1" DEPOSIT ABSOLUTE /end AXIS_DESCR
/end CHARACTERISTIC
/begin CHARACTERISTIC KFMSNWDK "Kennfeld normierter Massenstrom über DK" MAP 0x814A9A KfAxUwAyUwSstxUwSstyUwWUw 6553.500 m_uw_b6553p5 0.00 6553.500 FORMAT "%8.3"
 /begin AXIS_DESCR STD_AXIS wdkbab_w rel_uw_b100 16 0.00 99.99847 FORMAT "%8.5" DEPOSIT ABSOLUTE /end AXIS_DESCR
 /begin AXIS_DESCR STD_AXIS nmot_w nmot_uw_q0p25 6 0.00 16383.75 FORMAT "%8.2" DEPOSIT ABSOLUTE /end AXIS_DESCR
/end CHARACTERISTIC
/begin CHARACTERISTIC KFNFSKHM "Leerlaufsolldrehzahl bei Katheizen mit eingelegter Fahrstufe" MAP 0x81D68A KfAxUbAyUbSstxUbSstyUwWUb 2550. nmot_ub_q10 0.00 2550. FORMAT "%5.0"
 /begin AXIS_DESCR STD_AXIS tmot temp_ub_q0p75_o48 8 -48.00 143.3 FORMAT "%5.1" DEPOSIT ABSOLUTE /end AXIS_DESCR
 /begin AXIS_DESCR STD_AXIS frhokor_w fak_uw_b4 4 0.00 3.999939 FORMAT "%8.6" DEPOSIT ABSOLUTE /end AXIS_DESCR
/end CHARACTERISTIC
/begin CHARACTERISTIC KFNLLKHM "Leerlaufsolldrehzahl bei Kat.-Heizung" MAP 0x81D6BC KfAxUbAyUbSstxUbSstyUwWUb 2550. nmot_ub_q10 0.00 2550. FORMAT "%5.0"
 /begin AXIS_DESCR STD_AXIS tmot temp_ub_q0p75_o48 8 -48.00 143.3 FORMAT "%5.1" DEPOSIT ABSOLUTE /end AXIS_DESCR
 /begin AXIS_DESCR STD_AXIS frhokor_w fak_uw_b4 4 0.00 3.999939 FORMAT "%8.6" DEPOSIT ABSOLUTE /end AXIS_DESCR
/end CHARACTERISTIC
/begin CHARACTERISTIC KFNWADE "Festlegung des Adaptionsbereichs für Flankenadaption Phasensensor Einlass" MAP 0x81A31D KfAxUbAyUbSstxUbSstyUbWUb 255.0 dez 0.00 255.0 FORMAT "%5.1"
 /begin AXIS_DESCR STD_AXIS nmotkf nmot_ub_q40 4 0.00 10200. FORMAT "%5.0" DEPOSIT ABSOLUTE /end AXIS_DESCR
 /begin AXIS_DESCR STD_AXIS rlnwkf rel_ub_q0p75 4 0.00 191.3 FORMAT "%5.1" DEPOSIT ABSOLUTE /end AXIS_DESCR
/end CHARACTERISTIC
/begin CHARACTERISTIC KFNWEGM "Wiedereinsetzdrehzahlkennfeld" MAP 0x819B1F GkfWUb 10200. nmot_ub_q40 0.00 10200. FORMAT "%5.0"
 /begin AXIS_DESCR COM_AXIS tmot temp_ub_q0p75_o48 5 -48.00 143.3 AXIS_PTS_REF STM05SAUB /end AXIS_DESCR
 /begin AXIS_DESCR COM_AXIS gangi dez 8 0.00 255.0 AXIS_PTS_REF SGA08MDUB /end AXIS_DESCR
/end CHARACTERISTIC
/begin CHARACTERISTIC KFPBRK "Korrekturfaktor für Brennraumdruck" MAP 0x81C7DA KfAxUwAyUwSstxUwSstyUwWUw 1.999969 fak_uw_b2 0.00 1.999969 FORMAT "%8.6"
 /begin AXIS_DESCR STD_AXIS nmot_w nmot_uw_q0p25 10 0.00 16383.75 FORMAT "%8.2" DEPOSIT ABSOLUTE /end AXIS_DESCR
 /begin AXIS_DESCR STD_AXIS rl_w rel_uw_q0p0234 10 0.00 1535.977 FORMAT "%8.3" DEPOSIT ABSOLUTE /end AXIS_DESCR
/end CHARACTERISTIC
/begin CHARACTERISTIC KFPBRKNW "Korrekturfaktor für Brennraumdruck bei aktiver NWS" MAP 0x81C8CE KfAxUwAyUwSstxUwSstyUwWUw 1.999969 fak_uw_b2 0.00 1.999969 FORMAT "%8.6"
 /begin AXIS_DESCR STD_AXIS nmot_w nmot_uw_q0p25 10 0.00 16383.75 FORMAT "%8.2" DEPOSIT ABSOLUTE /end AXIS_DESCR
 /begin AXIS_DESCR STD_AXIS rl_w rel_uw_q0p0234 10 0.00 1535.977 FORMAT "%8.3" DEPOSIT ABSOLUTE /end AXIS_DESCR
/end CHARACTERISTIC
/begin CHARACTERISTIC KFPLGUB "Grundladedruck  für Basishöhe (Umgebungsdruck)" MAP 0x81F88C KfAxUbAyUbSstxUwSstyUwWUw 2559.961 p_uw_q0p039 0.00 2559.961 FORMAT "%8.3"
 /begin AXIS_DESCR STD_AXIS nmot_w nmot_uw_q0p25 8 0.00 10500.00 FORMAT "%8.2" DEPOSIT ABSOLUTE /end AXIS_DESCR
 /begin AXIS_DESCR STD_AXIS ps_w p_uw_q0p039 8 0.00 2559.961 FORMAT "%8.3" DEPOSIT ABSOLUTE /end AXIS_DESCR
/end CHARACTERISTIC
/begin CHARACTERISTIC KFPRG "interner Abgaspartialdruck abhängig von NW-Verstellung bei sumode=0" MAP 0x81C9C2 KfAxUwAyUwSstxUwSstyUwWUw 2559.961 p_uw_q0p039 0.00 2559.961 FORMAT "%8.3"
 /begin AXIS_DESCR STD_AXIS wnwsrm_w kw_q0p0019 6 0.00 127.9980 FORMAT "%8.4" DEPOSIT ABSOLUTE /end AXIS_DESCR
 /begin AXIS_DESCR STD_AXIS nmot_w nmot_uw_q0p25 10 0.00 16383.75 FORMAT "%8.2" DEPOSIT ABSOLUTE /end AXIS_DESCR
/end CHARACTERISTIC
/begin CHARACTERISTIC KFTVSA "Verzögerungszeit für Schubabschalten" MAP 0x819B47 GkfWUb 2.550 t10msxs_ub_b2p55 0.00 2.550 FORMAT "%5.3"
 /begin AXIS_DESCR COM_AXIS tmot temp_ub_q0p75_o48 5 -48.00 143.3 AXIS_PTS_REF STM05SAUB /end AXIS_DESCR
 /begin AXIS_DESCR COM_AXIS nmot nmot_ub_q40 8 0.00 10200. AXIS_PTS_REF SNM08__UB /end AXIS_DESCR
/end CHARACTERISTIC
/begin CHARACTERISTIC KFTVSAKAT "Verzögerungszeit Schubabschalten bei hohen Drehzahlen und hohen KAT-Temperatur" MAP 0x819B6F GkfWUb 10200.0 t40ms_ub_b10200 0.00 10200.0 FORMAT "%7.1"
 /begin AXIS_DESCR COM_AXIS nmot nmot_ub_q40 8 0.00 10200. AXIS_PTS_REF SNM08__UB /end AXIS_DESCR
 /begin AXIS_DESCR COM_AXIS tkatm temp_ub_q5_o50 4 -50.00 1225. AXIS_PTS_REF STK04SAUB /end AXIS_DESCR
/end CHARACTERISTIC
/begin CHARACTERISTIC KFURL "Umrechnungsfaktor von ps->rl abhängig von NW-Verstellung bei sumode=0" MAP 0x81CA5E KfAxUwAyUwSstxUwSstyUwWUw 0.2999954 rel_uw_b0p3 0.00 0.2999954 FORMAT "%9.7"
 /begin AXIS_DESCR STD_AXIS wnwsrm_w kw_q0p0019 6 0.00 127.9980 FORMAT "%8.4" DEPOSIT ABSOLUTE /end AXIS_DESCR
 /begin AXIS_DESCR STD_AXIS nmot_w nmot_uw_q0p25 10 0.00 16383.75 FORMAT "%8.2" DEPOSIT ABSOLUTE /end AXIS_DESCR
/end CHARACTERISTIC
/begin CHARACTERISTIC KFWNWWKA "Wichtungskennfeld für NW-Sollwinkel  Auslaßseitig" MAP 0x81D6EE KfAxUbAyUbSstxUwSstyUbWUb 1.992 fak_ub_b2 0.00 1.992 FORMAT "%5.3"
 /begin AXIS_DESCR STD_AXIS imlpr_w fak_uw_b1 8 0.00 0.9999847 FORMAT "%9.7" DEPOSIT ABSOLUTE /end AXIS_DESCR
 /begin AXIS_DESCR STD_AXIS tmst temp_ub_q0p75_o48 8 -48.00 143.3 FORMAT "%5.1" DEPOSIT ABSOLUTE /end AXIS_DESCR
/end CHARACTERISTIC
/begin CHARACTERISTIC KFWNWWKE_0_A "Wichtungskennfeld für NW-Sollwinkel  Einlaßseitig" MAP 0x81D748 KfAxUbAyUbSstxUwSstyUbWUb 1.992 fak_ub_b2 0.00 1.992 FORMAT "%5.3"
 /begin AXIS_DESCR STD_AXIS imlpr_w fak_uw_b1 8 0.00 0.9999847 FORMAT "%9.7" DEPOSIT ABSOLUTE /end AXIS_DESCR
 /begin AXIS_DESCR STD_AXIS tmst temp_ub_q0p75_o48 8 -48.00 143.3 FORMAT "%5.1" DEPOSIT ABSOLUTE /end AXIS_DESCR
/end CHARACTERISTIC
/begin CHARACTERISTIC KFWNWWKE_1_A "Wichtungskennfeld für NW-Sollwinkel  Einlaßseitig" MAP 0x81D7A2 KfAxUbAyUbSstxUwSstyUbWUb 1.992 fak_ub_b2 0.00 1.992 FORMAT "%5.3"
 /begin AXIS_DESCR STD_AXIS imlpr_w fak_uw_b1 8 0.00 0.9999847 FORMAT "%9.7" DEPOSIT ABSOLUTE /end AXIS_DESCR
 /begin AXIS_DESCR STD_AXIS tmst temp_ub_q0p75_o48 8 -48.00 143.3 FORMAT "%5.1" DEPOSIT ABSOLUTE /end AXIS_DESCR
/end CHARACTERISTIC
/begin CHARACTERISTIC KFWPFGR "Inverses Pedalkennfeld für FGR-Betrieb" MAP 0x81C46C KfAxUwAyUwSstxUwSstyUwWUw 99.99847 rel_uw_b100 0.00 99.99847 FORMAT "%8.5"
 /begin AXIS_DESCR STD_AXIS mrfgr_w rel_uw_b200 16 0.00 199.9969 FORMAT "%8.4" DEPOSIT ABSOLUTE /end AXIS_DESCR
 /begin AXIS_DESCR STD_AXIS nmot_w nmot_uw_q0p25 12 0.00 16383.75 FORMAT "%8.2" DEPOSIT ABSOLUTE /end AXIS_DESCR
/end CHARACTERISTIC
/begin CHARACTERISTIC KFWPLGTA "Kennfeld für Wichtungsfaktor Grundladedruck als f(tans)" MAP 0x819ADE GkfWUb 1.992 fak_ub_b2 0.00 1.992 FORMAT "%5.3"
 /begin AXIS_DESCR COM_AXIS nmot_w nmot_uw_q0p25 8 0.00 16383.75 AXIS_PTS_REF SNM08LDUW /end AXIS_DESCR
 /begin AXIS_DESCR COM_AXIS tsel temp_ub_q0p75_o48 8 -48.00 143.3 AXIS_PTS_REF STS08LDUB /end AXIS_DESCR
/end CHARACTERISTIC
/begin CHARACTERISTIC KIMLATMNL "Integratorsteigung für das Abintegrieren der durchgesetzten Luft" CURVE 0x81D7FC KlAUwSstUwWUw 65534.000000 zk1sxs_uw_b65535 1.0000000000 65535.000000 FORMAT "%12.6"
 /begin AXIS_DESCR STD_AXIS dtkaannl temp_ub_q5_o50 6 -50.00000 327625.0 FORMAT "%8.1" DEPOSIT ABSOLUTE /end AXIS_DESCR
/end CHARACTERISTIC
/begin CHARACTERISTIC KIMSALL "Beiwert für Leerlaufluftmassenintegrator für E-Gas" VALUE 0x81BF24 KwUw 2559.0000000 mk1sxs_b2560 1.0000000000 2560.0000000 FORMAT "%12.7" /end CHARACTERISTIC
/begin CHARACTERISTIC KISRM "Integratorbeiwert für Saugrohrmodell (Dynamik)" VALUE 0x814A72 KwUw 0.9999847 fak_uw_b1 0.00 0.9999847 FORMAT "%9.7" /end CHARACTERISTIC
/begin CHARACTERISTIC KLAF "Ausflußkennlinie" CURVE 0x814B8A FklWUw 0.9999847 fak_uw_b1 0.00 0.9999847 FORMAT "%9.7"
 /begin AXIS_DESCR FIX_AXIS klaf_kge fak_uw_q0p001 501 0.5000000 1.000000 FORMAT "%8.6" FIX_AXIS_PAR 500 0 501 /end AXIS_DESCR
/end CHARACTERISTIC
/begin CHARACTERISTIC KLAFTE "Ausflußkennlinie für TEV incl. Leitung AKF-TEV" CURVE 0x81713C KlAUwSstUwWUw 1.999969 fak_uw_b2 0.00 1.999969 FORMAT "%8.6"
 /begin AXIS_DESCR STD_AXIS phtevpu_w fak_uw_b2 14 0.00 1.999969 FORMAT "%8.6" DEPOSIT ABSOLUTE /end AXIS_DESCR
/end CHARACTERISTIC
/begin CHARACTERISTIC KLDTUMTA "Offset Ansauglufttemperatur -> Umgebungstemperatur" CURVE 0x81BFF2 KlAUbSstUbWSb 191.3 temp_sw_q0p75 -96.00 95.25 FORMAT "%5.2"
 /begin AXIS_DESCR STD_AXIS tans temp_ub_q0p75_o48 4 -48.00 143.3 FORMAT "%5.1" DEPOSIT ABSOLUTE /end AXIS_DESCR
/end CHARACTERISTIC
/begin CHARACTERISTIC KMLTESG "Konstante für Regeneriermasse in Leitung TEV-Saugrohr bei Normdruck + Normtemp." VALUE 0x828448 KwUw 1.066650 fak1_q1p63Em5 0.00 1.066650 FORMAT "%8.6" /end CHARACTERISTIC
/begin CHARACTERISTIC KTNDMRKH "Int.-Konstante für Anforderung Drehmomentenreserve Katheizen" VALUE 0x81D816 KwUw 0.9999847 fak_uw_b1 0.00 0.9999847 FORMAT "%9.7" /end CHARACTERISTIC
/begin CHARACTERISTIC KUMSRL "Umrechnungskonstante von Massenstrom in relative Luftfüllung" VALUE 0x810D31 KwUb 0.00199218750 kumsrl_ub_b0p002 0.00 0.00199218750 FORMAT "%13.11" /end CHARACTERISTIC
/begin CHARACTERISTIC KVLAD "Konstante für Umrechnung von Ladedruck in Luftmasse" VALUE 0x810D32 KwUb 1.992 rel_ub_b2p0 0.00 1.992 FORMAT "%5.3" /end CHARACTERISTIC
/begin CHARACTERISTIC LADFIL "Ladedruckfilterung" VALUE 0x814F74 KwUw 0.9999847 fak_uw_b1 0.00 0.9999847 FORMAT "%9.7" /end CHARACTERISTIC
/begin CHARACTERISTIC LNXQTM "Natürlicher Logarithmus aus Temperaturquotient" CURVE 0x81D1BE KlAUbSstUwWUw 3.999939 fak_uw_b4 0.00 3.999939 FORMAT "%8.6"
 /begin AXIS_DESCR STD_AXIS xqtm_w fak_uw_b16 12 0.00 15.99976 FORMAT "%8.5" DEPOSIT ABSOLUTE /end AXIS_DESCR
/end CHARACTERISTIC
/begin CHARACTERISTIC LRNST1_T "Wartezeit in Lernschritt 1" VALUE 0x810B5E KwUb 5.080 t20msxs_ub_b5p1 0.02000 5.100 FORMAT "%5.3" /end CHARACTERISTIC
/begin CHARACTERISTIC LRNST3_T "Wartezeit in Lernschritt 3" VALUE 0x810B5F KwUb 5.080 t20msxs_ub_b5p1 0.02000 5.100 FORMAT "%5.3" /end CHARACTERISTIC
/begin CHARACTERISTIC LRNST7_T "Wartezeit in Lernschritt 7" VALUE 0x810B60 KwUb 5.080 t20msxs_ub_b5p1 0.02000 5.100 FORMAT "%5.3" /end CHARACTERISTIC
/begin CHARACTERISTIC LRNST9_T "Wartezeit in Lernschritt 9" VALUE 0x810B61 KwUb 5.080 t20msxs_ub_b5p1 0.02000 5.100 FORMAT "%5.3" /end CHARACTERISTIC
/begin CHARACTERISTIC LRNVB_T "Lernverbotszeit für 'normales Lernen'" VALUE 0x8144EC KwUw 1310.700 t20msxs_uw_q0p02 0.00 1310.700 FORMAT "%8.3" /end CHARACTERISTIC
/begin CHARACTERISTIC MLFKMSDK "Luftmassenstromschwelle für multipl. Abgleich von HFM- und DK-Massenstrom" VALUE 0x814F76 KwUw 6553.500 m_uw_b6553p5 0.00 6553.500 FORMAT "%8.3" /end CHARACTERISTIC
/begin CHARACTERISTIC MLKHMX "max. Luftmasse für Katheizen" VALUE 0x8195C5 KwUb 1020. m_ub_b1020 0.00 1020. FORMAT "%5.0" /end CHARACTERISTIC
/begin CHARACTERISTIC MLSUS_0_A "Sollwert Luftmassen-Integral für motorisches Katheizen" CURVE 0x8195C6 KlAUbSstUbWUb 5.803 m_ub_b5p8 0.00 5.803 FORMAT "%5.3"
 /begin AXIS_DESCR STD_AXIS tmst temp_ub_q0p75_o48 12 -48.00 143.3 FORMAT "%5.1" DEPOSIT ABSOLUTE /end AXIS_DESCR
/end CHARACTERISTIC
/begin CHARACTERISTIC MLSUS_1_A "Sollwert Luftmassen-Integral für motorisches Katheizen" CURVE 0x8195DF KlAUbSstUbWUb 5.803 m_ub_b5p8 0.00 5.803 FORMAT "%5.3"
 /begin AXIS_DESCR STD_AXIS tmst temp_ub_q0p75_o48 12 -48.00 143.3 FORMAT "%5.1" DEPOSIT ABSOLUTE /end AXIS_DESCR
/end CHARACTERISTIC
/begin CHARACTERISTIC MRFABNTE "Schwelle zur Erkennung von Dauer-Hochlastfahrt" VALUE 0x818FE7 KwUb 99.61 rel_ub_b99p6 0.00 99.61 FORMAT "%5.2" /end CHARACTERISTIC
/begin CHARACTERISTIC MSALLMN "Minimale Leerlaufluftmassenadaption für E-Gas" VALUE 0x81BF26 KwUw 6553.500 m_uw_b6553p5 0.00 6553.500 FORMAT "%8.3" /end CHARACTERISTIC
/begin CHARACTERISTIC MSALLMX "Maximale Leerlaufluftmassenadaption für E-Gas" VALUE 0x81BF28 KwUw 6553.500 m_uw_b6553p5 0.00 6553.500 FORMAT "%8.3" /end CHARACTERISTIC
/begin CHARACTERISTIC MSLG "Massenstrom Leckluft gesamt" VALUE 0x81BF2A KwUw 6553.500 m_uw_b6553p5 0.00 6553.500 FORMAT "%8.3" /end CHARACTERISTIC
/begin CHARACTERISTIC MSNTATE "Kennlinie normierter Massenstrom durch TEV" CURVE 0x817176 KlAUwSstUwWUw 25.59961 m_uw_b25p6 0.00 25.59961 FORMAT "%8.5"
 /begin AXIS_DESCR STD_AXIS msntate_kge rel_uw_b100 10 0.00 99.99847 FORMAT "%8.5" DEPOSIT ABSOLUTE /end AXIS_DESCR
/end CHARACTERISTIC
/begin CHARACTERISTIC MXFLAD "Max. Anzahl Flankenadaptionen Nockenwellen Phasensensor" VALUE 0x81A337 KwUb 255.0 dez 0.00 255.0 FORMAT "%5.1" /end CHARACTERISTIC
/begin CHARACTERISTIC NGDNSA "Drehzahlgradient beim Absteuern der Schubabschalthysterese" VALUE 0x815F64 KwSw 10239.84 nmotg_sw_q0p15625 -5120.000 5119.844 FORMAT "%8.3" /end CHARACTERISTIC
/begin CHARACTERISTIC NLLAD "Leerlaufsolldrehzahl bei Aktivdiagnose-Sekundärluft" VALUE 0x8195F8 KwUb 2550. nmot_ub_q10 0.00 2550. FORMAT "%5.0" /end CHARACTERISTIC
/begin CHARACTERISTIC NLLKT "Leerlaufsolldrehzahl bei Kurztest Sekundärluftdiagnose" VALUE 0x8195F9 KwUb 2550. nmot_ub_q10 0.00 2550. FORMAT "%5.0" /end CHARACTERISTIC
/begin CHARACTERISTIC NLPST1T "Wartezeit 1 im NLP-Lernen" VALUE 0x810B62 KwUb 2.540 t10msxs_ub_b2p55 0.01000 2.550 FORMAT "%5.3" /end CHARACTERISTIC
/begin CHARACTERISTIC NLPST2T "Wartezeit 2 im NLP-Lernen" VALUE 0x810B63 KwUb 2.540 t10msxs_ub_b2p55 0.01000 2.550 FORMAT "%5.3" /end CHARACTERISTIC
/begin CHARACTERISTIC NMNWSTMN "Minimale Drehzahl für Freigabe der Nockenwellenverstellung im Start" VALUE 0x81A302 KwUb 10200. nmot_ub_q40 0.00 10200. FORMAT "%5.0" /end CHARACTERISTIC
/begin CHARACTERISTIC NNSTA "Drehzahlübergang Normal -> Start" CURVE 0x81A02A KlAUbSstUbWUb 10200. nmot_ub_q40 0.00 10200. FORMAT "%5.0"
 /begin AXIS_DESCR STD_AXIS tans temp_ub_q0p75_o48 3 -48.00 143.3 FORMAT "%5.1" DEPOSIT ABSOLUTE /end AXIS_DESCR
/end CHARACTERISTIC
/begin CHARACTERISTIC NNWMX "maximale Drehzahlschwelle für Abschaltung der NW-Verstellung" VALUE 0x81A303 KwUb 10200. nmot_ub_q40 0.00 10200. FORMAT "%5.0" /end CHARACTERISTIC
/begin CHARACTERISTIC NNWTMN "Minimaldrehzahlschwelle für Freigabe der Nockenwellenverstellung" CURVE 0x828450 KlAUbSstUwWUb 10200. nmot_ub_q40 0.00 10200. FORMAT "%5.0"
 /begin AXIS_DESCR STD_AXIS toelk_w temp_q0p0234_o273 4 -273.1500 1262.827 FORMAT "%8.3" DEPOSIT ABSOLUTE /end AXIS_DESCR
/end CHARACTERISTIC
/begin CHARACTERISTIC NRUBMX "Maximale Drehzahl für Batteriespannungsregelung" VALUE 0x8188C7 KwUb 2550. nmot_ub_q10 0.00 2550. FORMAT "%5.0" /end CHARACTERISTIC
/begin CHARACTERISTIC NSAFAN "Schubabschaltedrehzahl bei Testereingriff" VALUE 0x811257 KwUb 10200. nmot_ub_q40 0.00 10200. FORMAT "%5.0" /end CHARACTERISTIC
/begin CHARACTERISTIC NSTNM "Übergang Start -> Normal" CURVE 0x81A031 KlAUbSstUbWUb 10200. nmot_ub_q40 0.00 10200. FORMAT "%5.0"
 /begin AXIS_DESCR STD_AXIS tmot temp_ub_q0p75_o48 3 -48.00 143.3 FORMAT "%5.1" DEPOSIT ABSOLUTE /end AXIS_DESCR
/end CHARACTERISTIC
/begin CHARACTERISTIC NTUMTA "Schwelle Drehzahl für Bestimmung Umgebungstemperatur" VALUE 0x819256 KwUb 10200. nmot_ub_q40 0.00 10200. FORMAT "%5.0" /end CHARACTERISTIC
/begin CHARACTERISTIC NWECVTM "Wiedereinsetzdrehzahl bei CVT-Getriebe" CURVE 0x819B8F GklWUb 10200. nmot_ub_q40 0.00 10200. FORMAT "%5.0"
 /begin AXIS_DESCR COM_AXIS tmot temp_ub_q0p75_o48 5 -48.00 143.3 AXIS_PTS_REF STM05SAUB /end AXIS_DESCR
/end CHARACTERISTIC
/begin CHARACTERISTIC NWENG "Wiedereinsetzdrehzahl" CURVE 0x815F66 KlAUbSstSbWUb 10200. nmot_ub_q40 0.00 10200. FORMAT "%5.0"
 /begin AXIS_DESCR STD_AXIS ngfil nmotg_sb_q100 5 -12800. 12700. FORMAT "%5.0" DEPOSIT ABSOLUTE /end AXIS_DESCR
/end CHARACTERISTIC
/begin CHARACTERISTIC NWENGFS "Delta Wiedereinsetzdrehzahl bei Fahrstufe" CURVE 0x815F72 KlAUbSstSbWUb 10200. nmot_ub_q40 0.00 10200. FORMAT "%5.0"
 /begin AXIS_DESCR STD_AXIS ngfil nmotg_sb_q100 5 -12800. 12700. FORMAT "%5.0" DEPOSIT ABSOLUTE /end AXIS_DESCR
/end CHARACTERISTIC
/begin CHARACTERISTIC NZMSE "Drehzahlgrenze für sicheres Verlassen der ZMS-Resonanz" VALUE 0x827FF4 KwUw 16383.75 nmot_uw_q0p25 0.00 16383.75 FORMAT "%8.2" /end CHARACTERISTIC
/begin CHARACTERISTIC NZMSMN "untere Drehzahlgrenze für ZMS-Schutz" VALUE 0x827FF6 KwUw 16383.75 nmot_uw_q0p25 0.00 16383.75 FORMAT "%8.2" /end CHARACTERISTIC
/begin CHARACTERISTIC NZMSMX "obere Drehzahlgrenze für ZMS-Schutz" VALUE 0x827FF8 KwUw 16383.75 nmot_uw_q0p25 0.00 16383.75 FORMAT "%8.2" /end CHARACTERISTIC
/begin CHARACTERISTIC PSPVDKUG "Verhältnis pspvdk ungedrosselt" VALUE 0x814F78 KwUw 1.999969 fak_uw_b2 0.00 1.999969 FORMAT "%8.6" /end CHARACTERISTIC
/begin CHARACTERISTIC PSSOLNGRD "Schwelle negativer pssol-Gradient" VALUE 0x814F7A KwSw 51199.22 grd_sw_q0p78 -25600.00 25599.22 FORMAT "%8.2" /end CHARACTERISTIC
/begin CHARACTERISTIC PSSOLPF "Schwelle positiver gefilteter pssol-Gradient" VALUE 0x814F7C KwSw 51199.22 grd_sw_q0p78 -25600.00 25599.22 FORMAT "%8.2" /end CHARACTERISTIC
/begin CHARACTERISTIC PSSOLPGRD "Schwelle positiver pssol-Gradient" VALUE 0x814F7E KwSw 51199.22 grd_sw_q0p78 -25600.00 25599.22 FORMAT "%8.2" /end CHARACTERISTIC
/begin CHARACTERISTIC PUKORRV "Umgebungsdruckkorrektur abhängig von Fahrzeuggeschwindigkeit" CURVE 0x8283EA KlAUwSstUwWUw 2559.961 p_uw_q0p039 0.00 2559.961 FORMAT "%8.3"
 /begin AXIS_DESCR STD_AXIS vfzg_w vfzg_uw_b512 8 0.00 511.9922 FORMAT "%8.4" DEPOSIT ABSOLUTE /end AXIS_DESCR
/end CHARACTERISTIC
/begin CHARACTERISTIC PUSMAX "maximal plausible Umgebungsdruckschwelle" VALUE 0x817138 KwUw 2559.961 p_uw_q0p039 0.00 2559.961 FORMAT "%8.3" /end CHARACTERISTIC
/begin CHARACTERISTIC PUSMIN "minimal plausible Umgebungsdruckschwelle" VALUE 0x81713A KwUw 2559.961 p_uw_q0p039 0.00 2559.961 FORMAT "%8.3" /end CHARACTERISTIC
/begin CHARACTERISTIC RLMXLDO "Maximalfuellung LDR bei E_ldo (Überladefehler)" CURVE 0x81BFA8 KlAUbSstUwWUw 1535.977 rel_uw_q0p0234 0.00 1535.977 FORMAT "%8.3"
 /begin AXIS_DESCR STD_AXIS nmot_w nmot_uw_q0p25 3 0.00 16383.75 FORMAT "%8.2" DEPOSIT ABSOLUTE /end AXIS_DESCR
/end CHARACTERISTIC
/begin CHARACTERISTIC RLNOT "Notlauf rl bei E_DK und E_LM" CURVE 0x81BF2C KlAUbSstUbWUw 1535.977 rel_uw_q0p0234 0.00 1535.977 FORMAT "%8.3"
 /begin AXIS_DESCR STD_AXIS nmot nmot_ub_q40 6 0.00 10200. FORMAT "%5.0" DEPOSIT ABSOLUTE /end AXIS_DESCR
/end CHARACTERISTIC
/begin AXIS_PTS SGA08MDUB "Stützstellenverteilung Ist Gang 8 Sst." 0x810060 gangi SstAUbSstUb 255.0 dez 8 0.00 255.0 FORMAT "%5.1" DEPOSIT ABSOLUTE /end AXIS_PTS
/begin AXIS_PTS SNM08LDUW "Stützstellenverteilung für Ladedruckregelung" 0x81307E nmot_w SstAUwSstUw 16383.75 nmot_uw_q0p25 8 0.00 16383.75 FORMAT "%8.2" DEPOSIT ABSOLUTE /end AXIS_PTS
/begin AXIS_PTS SNM08__UB "Stützstellenverteilung Drehzahl, 8 Sst." 0x818236 nmot SstAUbSstUb 10200. nmot_ub_q40 8 0.00 10200. FORMAT "%5.0" DEPOSIT ABSOLUTE /end AXIS_PTS
/begin AXIS_PTS SNM12FEUB "Stützstellen für WDKSMX, WDKUGDN" 0x8100AF nmot SstAUbSstUb 10200. nmot_ub_q40 12 0.00 10200. FORMAT "%5.0" DEPOSIT ABSOLUTE /end AXIS_PTS
/begin AXIS_PTS STK04SAUB "SST-Verteilung Kattemperatur für Funktion SAWE" 0x8182B4 tkatm SstAUbSstUb 1275. temp_ub_q5_o50 4 -50.00 1225. FORMAT "%5.0" DEPOSIT ABSOLUTE /end AXIS_PTS
/begin AXIS_PTS STM05SAUB "Stützstellenverteilung" 0x8182B9 tmot SstAUbSstUb 191.3 temp_ub_q0p75_o48 5 -48.00 143.3 FORMAT "%5.1" DEPOSIT ABSOLUTE /end AXIS_PTS
/begin AXIS_PTS STS08LDUB "Stützstellenverteilung tsel für Ladedruckregelung" 0x810143 tsel SstAUbSstUb 191.3 temp_ub_q0p75_o48 8 -48.00 143.3 FORMAT "%5.1" DEPOSIT ABSOLUTE /end AXIS_PTS
/begin CHARACTERISTIC TABSTKH "Mindestabstellzeit für Freigabe Kat-Heizen" VALUE 0x81D818 KwUw 65535.00 t1sxs_uw_b65535 0.00 65535.00 FORMAT "%8.2" /end CHARACTERISTIC
/begin CHARACTERISTIC TANW "Ansauglufttemperaturschwelle für Nockenwellenverstellung" VALUE 0x81A304 KwUb 191.3 temp_ub_q0p75_o48 -48.00 143.3 FORMAT "%5.1" /end CHARACTERISTIC
/begin CHARACTERISTIC TATELL "tans- Schwelle für Tankentlüfung bei B_ll = 1" VALUE 0x818FE8 KwUb 191.3 temp_ub_q0p75_o48 -48.00 143.3 FORMAT "%5.1" /end CHARACTERISTIC
/begin CHARACTERISTIC TAVHKSAO "Obergrenze Abgastemperatur vor Hauptkat für SA" VALUE 0x81F930 KwUw 1535.977 temp_q0p0234_o273 -273.1500 1262.827 FORMAT "%8.3" /end CHARACTERISTIC
/begin CHARACTERISTIC TAVVKSAO "Obergrenze Abgastemperatur vor Vorkat für SA" VALUE 0x81F932 KwUw 1535.977 temp_q0p0234_o273 -273.1500 1262.827 FORMAT "%8.3" /end CHARACTERISTIC
/begin CHARACTERISTIC TDABGLST "Zeitverzögerung Freigabe Abgleich nach Startende" VALUE 0x814F80 KwUw 655.3500 t10msxs_uw_b655p35 0.00 655.3500 FORMAT "%8.4" /end CHARACTERISTIC
/begin CHARACTERISTIC TDDFUELSAN "Zeitverzögerung nach unterschreiten einer Schwelle durch dfuelsan" VALUE 0x810D33 KwUb 2.550 t10msxs_ub_b2p55 0.00 2.550 FORMAT "%5.3" /end CHARACTERISTIC
/begin CHARACTERISTIC TDFGABGLGD "Zeitverzug für die Berücksichtigung von B_fgabglgd" VALUE 0x810D34 KwUb 2.550 t10msxs_ub_b2p55 0.00 2.550 FORMAT "%5.3" /end CHARACTERISTIC
/begin CHARACTERISTIC TDKNACH "Zeit im Nachlauf bis stromlose DK im NLP einschwingt" VALUE 0x8144EE KwUw 655.3500 t10msxs_uw_b655p35 0.00 655.3500 FORMAT "%8.4" /end CHARACTERISTIC
/begin CHARACTERISTIC TDLRPIDMX "max. Zeit für PWM-Tastverhältnis des DLR bei temp. UMA-Adapt." VALUE 0x810B64 KwUb 12.75 t50msxs_q0p05 0.00 12.75 FORMAT "%5.2" /end CHARACTERISTIC
/begin CHARACTERISTIC TDMSDKS "Zeitverzögerung bis das Bit B_fkmsdks wirksam wird" VALUE 0x810D35 KwUb 2.550 t10msxs_ub_b2p55 0.00 2.550 FORMAT "%5.3" /end CHARACTERISTIC
/begin CHARACTERISTIC TDPSSOL "Zeitverzögerung der Bedingung B_pssol für die Freigabe des schnellen Abgleichs" VALUE 0x814F82 KwUw 655.3500 t10msxs_uw_b655p35 0.00 655.3500 FORMAT "%8.4" /end CHARACTERISTIC
/begin CHARACTERISTIC TDRLMXLAM "Zeitverzögerung für Rücksetzen der max.Auswahl rl über Lambda-Soll" VALUE 0x810D36 KwUb 2.550 t10msxs_ub_b2p55 0.00 2.550 FORMAT "%5.3" /end CHARACTERISTIC
/begin CHARACTERISTIC TDSRLMX "Zeitverzögerung für Umschalten von Haupt- auf Nebenlastsignal" VALUE 0x810D37 KwUb 2.550 t10msxs_ub_b2p55 0.00 2.550 FORMAT "%5.3" /end CHARACTERISTIC
/begin CHARACTERISTIC TFWPFGR "Filterzeitkonstante für Berechnung wpfgr_w" VALUE 0x81C628 KwUw 3276.7499992 zk50msxs_uw_b3276p8 0.050000762951 3276.8000000 FORMAT "%12.7" /end CHARACTERISTIC
/begin CHARACTERISTIC THYNWMN "Temperaturhysteriese zur Vermeidung von tmot und toelk-Schwankungen" VALUE 0x82845E KwUw 1535.977 temp_q0p0234 0.00 1535.977 FORMAT "%8.3" /end CHARACTERISTIC
/begin CHARACTERISTIC TKATMN "Katalysatortemperaturregelschwelle für Kat warmhalten" VALUE 0x8195FA KwUb 1275. temp_ub_q5_o50 -50.00 1225. FORMAT "%5.0" /end CHARACTERISTIC
/begin CHARACTERISTIC TKATSA "Katalysator-Temperaturschwelle für Schubabschalten" VALUE 0x819B94 KwUb 1275. temp_ub_q5_o50 -50.00 1225. FORMAT "%5.0" /end CHARACTERISTIC
/begin CHARACTERISTIC TKATW "Katalysatortemperaturschwelle für Kat warmhalten" VALUE 0x8195FB KwUb 1275. temp_ub_q5_o50 -50.00 1225. FORMAT "%5.0" /end CHARACTERISTIC
/begin CHARACTERISTIC TKHABB "Entprellzeit für Abbruchbedingungen der Funktion Katheizen" VALUE 0x8195FC KwUb 25.50 t100msxs_ub_b25p5 0.00 25.50 FORMAT "%5.2" /end CHARACTERISTIC
/begin CHARACTERISTIC TKHFSAB "Entprellzeit für Umschaltung auf Katheizdrehzahl bei Fahrstufe" VALUE 0x81D81A KwUw 6553.500 t100msxs_uw_b6553p5 0.00 6553.500 FORMAT "%8.3" /end CHARACTERISTIC
/begin CHARACTERISTIC TKHLL_0_A "Abbruchzeit Katheizen Leerlauf" VALUE 0x81D820 KwUw 6553.500 t100msxs_uw_b6553p5 0.00 6553.500 FORMAT "%8.3" /end CHARACTERISTIC
/begin CHARACTERISTIC TKHLL_1_A "Abbruchzeit Katheizen Leerlauf" VALUE 0x81D822 KwUw 6553.500 t100msxs_uw_b6553p5 0.00 6553.500 FORMAT "%8.3" /end CHARACTERISTIC
/begin CHARACTERISTIC TKHLLAB "Entprellzeit für Ende Katheizdrehzahl im LL" VALUE 0x8195FD KwUb 25.50 t100msxs_ub_b25p5 0.00 25.50 FORMAT "%5.2" /end CHARACTERISTIC
/begin CHARACTERISTIC TKHLLMX_0_A "Maximale Zeit für angehobene Katheiz-Drehzahl" VALUE 0x81D824 KwUw 655.3500 t10msxs_uw_b655p35 0.00 655.3500 FORMAT "%8.4" /end CHARACTERISTIC
/begin CHARACTERISTIC TKHLLMX_1_A "Maximale Zeit für angehobene Katheiz-Drehzahl" VALUE 0x81D826 KwUw 655.3500 t10msxs_uw_b655p35 0.00 655.3500 FORMAT "%8.4" /end CHARACTERISTIC
/begin CHARACTERISTIC TKHMX_0_A "Maximale Einschaltdauer der Funktion Katheizen" VALUE 0x81D828 KwUw 655.3500 t10msxs_uw_b655p35 0.00 655.3500 FORMAT "%8.4" /end CHARACTERISTIC
/begin CHARACTERISTIC TKHMX_1_A "Maximale Einschaltdauer der Funktion Katheizen" VALUE 0x81D82A KwUw 655.3500 t10msxs_uw_b655p35 0.00 655.3500 FORMAT "%8.4" /end CHARACTERISTIC
/begin CHARACTERISTIC TKHNAB "Zeitdauer Absteuern Katheizdrehzahl" VALUE 0x81D81C KwUw 6553.500 t100msxs_uw_b6553p5 0.00 6553.500 FORMAT "%8.3" /end CHARACTERISTIC
/begin CHARACTERISTIC TKIHKSAO "Obergrenze Kattemperatur im Hauptkat für SA" VALUE 0x81F934 KwUw 1535.977 temp_q0p0234_o273 -273.1500 1262.827 FORMAT "%8.3" /end CHARACTERISTIC
/begin CHARACTERISTIC TMILAS "Dauer der MIL-Aktivierung nach Start zur Sichtbarkeitsprüfung" VALUE 0x818480 KwUb 255.0 t1sxs_ub_b255 0.00 255.0 FORMAT "%5.1" /end CHARACTERISTIC
/begin CHARACTERISTIC TMILRB "Dauer der MIL-Aktivierung bei ready-blinken" VALUE 0x818481 KwUb 255.0 t1sxs_ub_b255 0.00 255.0 FORMAT "%5.1" /end CHARACTERISTIC
/begin CHARACTERISTIC TMILVT "Dauer der MIL-Aktivierung nach INI zur Sichtbarkeitsprüfung" VALUE 0x818482 KwUb 255.0 t1sxs_ub_b255 0.00 255.0 FORMAT "%5.1" /end CHARACTERISTIC
/begin CHARACTERISTIC TMNWKH "Temperaturschwelle für Freigabe Nockenwellenkatheizfunktionalität" VALUE 0x81A305 KwUb 191.3 temp_ub_q0p75_o48 -48.00 143.3 FORMAT "%5.1" /end CHARACTERISTIC
/begin CHARACTERISTIC TMNWMN "Minimal Motortemperaturschwelle für Freigabe Nockenwellenverstellung" VALUE 0x81A306 KwUb 191.3 temp_ub_q0p75_o48 -48.00 143.3 FORMAT "%5.1" /end CHARACTERISTIC
/begin CHARACTERISTIC TMNWMX "Maximal Motortemperaturschwelle für Freigabe Nockenwellenverstellung" VALUE 0x81A307 KwUb 191.3 temp_ub_q0p75_o48 -48.00 143.3 FORMAT "%5.1" /end CHARACTERISTIC
/begin CHARACTERISTIC TMNWST "Motortemoeraturschwelle für Nockenwellenfreigabe im Start" VALUE 0x81A308 KwUb 191.3 temp_ub_q0p75_o48 -48.00 143.3 FORMAT "%5.1" /end CHARACTERISTIC
/begin CHARACTERISTIC TMOTWRM "Motortemperatur für warmen Motor" VALUE 0x818B0A KwUb 191.3 temp_ub_q0p75_o48 -48.00 143.3 FORMAT "%5.1" /end CHARACTERISTIC
/begin CHARACTERISTIC TMSKLH "Motortemperaturschwelle für kurze LRA-Anfangsphase bei Heißstart" VALUE 0x818FE9 KwUb 191.3 temp_ub_q0p75_o48 -48.00 143.3 FORMAT "%5.1" /end CHARACTERISTIC
/begin CHARACTERISTIC TMSLOF "Motortemperaturschwelle für Sperre Sekundärluft" VALUE 0x8195FE KwUb 191.3 temp_ub_q0p75_o48 -48.00 143.3 FORMAT "%5.1" /end CHARACTERISTIC
/begin CHARACTERISTIC TMSNOGA "Schwelle tms für Dauerspülen nach Fahrzyklus mit erfolgter Gemischadaption" VALUE 0x818FEA KwUb 191.3 temp_ub_q0p75_o48 -48.00 143.3 FORMAT "%5.1" /end CHARACTERISTIC
/begin CHARACTERISTIC TMSUTMUMA "untere Tmot-Schwelle für temporäre UMA-Adaption" VALUE 0x810B65 KwUb 191.3 temp_ub_q0p75_o48 -48.00 143.3 FORMAT "%5.1" /end CHARACTERISTIC
/begin CHARACTERISTIC TMVDBS "Entprellzeit Beschleunigungssignaldiagnose" VALUE 0x811EF2 KwUb 25.50 t100msxs_ub_b25p5 0.00 25.50 FORMAT "%5.2" /end CHARACTERISTIC
/begin CHARACTERISTIC TMWAFMN "Minimale Motortemperatur für Winkeladaption Nockenwelle" VALUE 0x81A338 KwUb 191.3 temp_ub_q0p75_o48 -48.00 143.3 FORMAT "%5.1" /end CHARACTERISTIC
/begin CHARACTERISTIC TNLSGM "Nachlaufzeit für SG abschalten" CURVE 0x81D1F0 KlAUbSstUbWUw 65535.00 t1sxs_uw_q1 0.00 65535.00 FORMAT "%8.2"
 /begin AXIS_DESCR STD_AXIS tmotab temp_ub_q0p75_o48 6 -48.00 143.3 FORMAT "%5.1" DEPOSIT ABSOLUTE /end AXIS_DESCR
/end CHARACTERISTIC
/begin CHARACTERISTIC TNSDMRKH "Zeit nach Start für Drehmomentenreserve Katheizen" VALUE 0x81D81E KwUw 655.3500 t10msxs_uw_b655p35 0.00 655.3500 FORMAT "%8.4" /end CHARACTERISTIC
/begin CHARACTERISTIC TNSEUHRCMP "Schwelle Abweichung Vergleich Zeit nach Start" VALUE 0x81D204 KwUw 6553.500 t100msxs_uw_b6553p5 0.00 6553.500 FORMAT "%8.3" /end CHARACTERISTIC
/begin CHARACTERISTIC TNSURLP "Zeit rl-Praediktions-Unterdrueckung im Nachstart" VALUE 0x810DD8 KwUb 25.50 t100msxs_ub_b25p5 0.00 25.50 FORMAT "%5.2" /end CHARACTERISTIC
/begin CHARACTERISTIC TNWADAMX "maximale Zeit für eine Flankenadaption des Nockenwellen Phsensensors" VALUE 0x827FEC KwUw 3276.750 t50msxs_uw_b3276p75 0.00 3276.750 FORMAT "%8.3" /end CHARACTERISTIC
/begin CHARACTERISTIC TNWADAMXA "maximale Zeit für Flankenadaption des Nockenwellen Phsensensors (Feinadaption)" VALUE 0x827FEE KwUw 3276.750 t50msxs_uw_b3276p75 0.00 3276.750 FORMAT "%8.3" /end CHARACTERISTIC
/begin CHARACTERISTIC TOELNWEMN "Minimal Öltemperaturschwelle zur Freigabe Nockenwellenverstellung (Sensorfehler)" VALUE 0x828460 KwUw 1535.977 temp_q0p0234_o273 -273.1500 1262.827 FORMAT "%8.3" /end CHARACTERISTIC
/begin CHARACTERISTIC TOELNWEMX "Maximal Öltemperaturschwelle zur Freigabe Nockenwellenverstellung (Sensorfehler)" VALUE 0x828462 KwUw 1535.977 temp_q0p0234_o273 -273.1500 1262.827 FORMAT "%8.3" /end CHARACTERISTIC
/begin CHARACTERISTIC TOELNWMN "Minimal Öltemperaturschwelle zur Freigabe der Nockenwellenverstellung" VALUE 0x828464 KwUw 1535.977 temp_q0p0234_o273 -273.1500 1262.827 FORMAT "%8.3" /end CHARACTERISTIC
/begin CHARACTERISTIC TOELNWMX "Maximal Öltemperaturschwelle zur Freigabe der Nockenwellenverstellung" VALUE 0x828466 KwUw 1535.977 temp_q0p0234_o273 -273.1500 1262.827 FORMAT "%8.3" /end CHARACTERISTIC
/begin CHARACTERISTIC TPUKOR "Filterzeit für PUKORF" VALUE 0x81A2F6 KwUb 25.4996 zk100msxs_ub_b25p5 0.100392 25.6000 FORMAT "%7.4" /end CHARACTERISTIC
/begin CHARACTERISTIC TRSECMX "Max. Wert für relativen Sekundenzähler" VALUE 0x81D1B6 KwUl 4294967295.00 t1sxs_uw_q1 0.00 4294967295.00 FORMAT "%13.2" /end CHARACTERISTIC
/begin CHARACTERISTIC TTE "Zeit für Tankentlüftungsphase" VALUE 0x81D0C6 KwUw 6553.500 t100msxs_uw_b6553p6 0.00 6553.500 FORMAT "%8.3" /end CHARACTERISTIC
/begin CHARACTERISTIC TTEAE "Zeit für Tankentlüftungsphase bei eingeschwungener Gemischadaption" VALUE 0x81D0C8 KwUw 6553.500 t100msxs_uw_b6553p6 0.00 6553.500 FORMAT "%8.3" /end CHARACTERISTIC
/begin CHARACTERISTIC TTEBSTP "Maximal Zeit für TE-Stop im Leerlauf bei nicht gesetzten Zyklusflags" VALUE 0x81D0CA KwUw 6553.500 t100msxs_uw_b6553p6 0.00 6553.500 FORMAT "%8.3" /end CHARACTERISTIC
/begin CHARACTERISTIC TTEGA "Zeit bei der Tankentlüftung für Grundadaption" VALUE 0x81D0CC KwUw 6553.500 t100msxs_uw_b6553p6 0.00 6553.500 FORMAT "%8.3" /end CHARACTERISTIC
/begin CHARACTERISTIC TTEGAI "Zeitdauer der ersten  Gemischadaptionsphase" VALUE 0x81D0CE KwUw 6553.500 t100msxs_uw_b6553p6 0.00 6553.500 FORMAT "%8.3" /end CHARACTERISTIC
/begin CHARACTERISTIC TTEGAIH "Zeitdauer der ersten  Gemischadaptionsphase bei Heißstart" VALUE 0x81D0D0 KwUw 6553.500 t100msxs_uw_b6553p6 0.00 6553.500 FORMAT "%8.3" /end CHARACTERISTIC
/begin CHARACTERISTIC TTEGAZO "Zeit für Tankentlüftungsstop wg. Gemischadaption, obere Schwelle" VALUE 0x81D0D2 KwUw 6553.500 t100msxs_uw_b6553p6 0.00 6553.500 FORMAT "%8.3" /end CHARACTERISTIC
/begin CHARACTERISTIC TTEGAZU "Zeit für Tankentlüftungsstop wg. Gemischadaption, untere Schwelle" VALUE 0x81D0D4 KwUw 6553.500 t100msxs_uw_b6553p6 0.00 6553.500 FORMAT "%8.3" /end CHARACTERISTIC
/begin CHARACTERISTIC TTEINI "Zeit für Tankentlüftung in erster TE-Phase nach Initialisierung (B_ini)" VALUE 0x81D0D6 KwUw 6553.500 t100msxs_uw_b6553p6 0.00 6553.500 FORMAT "%8.3" /end CHARACTERISTIC
/begin CHARACTERISTIC TTEMN "Zeit für Tankentlüftungsphase minimal" VALUE 0x81D0D8 KwUw 6553.500 t100msxs_uw_b6553p6 0.00 6553.500 FORMAT "%8.3" /end CHARACTERISTIC
/begin CHARACTERISTIC TTEPRIO "Zeit ab Start für Umschalten auf Dauertankentlüftung" VALUE 0x81D0DA KwUw 6553.500 t100msxs_uw_b6553p6 0.00 6553.500 FORMAT "%8.3" /end CHARACTERISTIC
/begin CHARACTERISTIC TTEZAO "Zeit für Tankentlüftung Daueraktivierung, obere Schwelle" VALUE 0x81D0DC KwUw 6553.500 t100msxs_uw_b6553p6 0.00 6553.500 FORMAT "%8.3" /end CHARACTERISTIC
/begin CHARACTERISTIC TTEZAU "Zeit für Tankentlüftung Daueraktivierung, untere Schwelle" VALUE 0x81D0DE KwUw 6553.500 t100msxs_uw_b6553p6 0.00 6553.500 FORMAT "%8.3" /end CHARACTERISTIC
/begin CHARACTERISTIC TTMUMASTA "Zeitdauer für Stationärzustand bei temp. UMA-Adaption" VALUE 0x8144F0 KwUw 3276.750 t50msxs_q0p05 0.00 3276.750 FORMAT "%8.3" /end CHARACTERISTIC
/begin CHARACTERISTIC TUMTAI "Initialisierungswert Umgebungstemperatur" VALUE 0x819257 KwUb 191.3 temp_ub_q0p75_o48 -48.00 143.3 FORMAT "%5.1" /end CHARACTERISTIC
/begin CHARACTERISTIC TVABST "Verzugszeit Funktionsabschaltung nach Startende" VALUE 0x81925A KwUb 12.75 t50msxs_ub_b12p75 0.00 12.75 FORMAT "%5.2" /end CHARACTERISTIC
/begin CHARACTERISTIC TVLBZ "Verzögerungszeit zur Freigabe der Ladebilanz" VALUE 0x81BEF4 KwUw 13107.00 t200msxs_uw_q0p2 0.00 13107.00 FORMAT "%8.2" /end CHARACTERISTIC
/begin CHARACTERISTIC TVNWGE "Verzugszeit zur NW-Umschaltfreigabe nach Getriebeeingriff" VALUE 0x81A309 KwUb 12.75 t50msxs_ub_b12p75 0.00 12.75 FORMAT "%5.2" /end CHARACTERISTIC
/begin CHARACTERISTIC TVNWSTNMTM "Zeitverzögerung für Nockenwellenverstellung nach Überschreitung der Solldrehzahl" CURVE 0x828468 KlAUwSstUwWUw 3276.750 t50msxs_uw_b3276p75 0.00 3276.750 FORMAT "%8.3"
 /begin AXIS_DESCR STD_AXIS tmot temp_ub_q0p75_o48 4 -48.00000 49103.25 FORMAT "%8.2" DEPOSIT ABSOLUTE /end AXIS_DESCR
/end CHARACTERISTIC
/begin CHARACTERISTIC TVNWSTTM "Zeitverzögerung im Start ab der die Nockenwelle angesteuert werden kann" CURVE 0x82847A KlAUbSstUbWUw 655.3500 t10msxs_uw_b655p35 0.00 655.3500 FORMAT "%8.4"
 /begin AXIS_DESCR STD_AXIS tmot temp_ub_q0p75_o48 4 -48.00 143.3 FORMAT "%5.1" DEPOSIT ABSOLUTE /end AXIS_DESCR
/end CHARACTERISTIC
/begin CHARACTERISTIC TVNW_S "Verzögerungszeit nach der das Einlaßventil sicher in Spätstellung ist" VALUE 0x81A339 KwUb 12.75 t50msxs_ub_b12p75 0.00 12.75 FORMAT "%5.2" /end CHARACTERISTIC
/begin CHARACTERISTIC TVSABTE "Verzugszeit für TEV Schließen vor Schubabschalten" VALUE 0x815F7E KwUw 655.3500 t10msxs_uw_b655p35 0.00 655.3500 FORMAT "%8.4" /end CHARACTERISTIC
/begin CHARACTERISTIC TVSAG0 "Totzeit Schubabschalten bei Gang 0" VALUE 0x815F80 KwUw 655.3500 t10msxs_uw_b655p35 0.00 655.3500 FORMAT "%8.4" /end CHARACTERISTIC
/begin CHARACTERISTIC TVSATM "Sperrzeit Schubabschalten nach Startende" CURVE 0x819B95 KlAUbSstUbWUb 255.0 t1sxs_ub_b255 0.00 255.0 FORMAT "%5.1"
 /begin AXIS_DESCR STD_AXIS tmst temp_ub_q0p75_o48 6 -48.00 143.3 FORMAT "%5.1" DEPOSIT ABSOLUTE /end AXIS_DESCR
/end CHARACTERISTIC
/begin CHARACTERISTIC TVTUMTA "Verzugszeit Fahrgeschwindigkeitsbedingung für Bestimmung Umgebungstemperatur" VALUE 0x81BFFC KwUw 65535.00 t1sxs_uw_b65535 0.00 65535.00 FORMAT "%8.2" /end CHARACTERISTIC
/begin CHARACTERISTIC TVUHR "Maximale Wartezeit für neue Uhrinformation" VALUE 0x81925B KwUb 255.0 t1sxs_uw_q1 0.00 255.0 FORMAT "%5.1" /end CHARACTERISTIC
/begin CHARACTERISTIC TVUHRDEV "Entprellung Zeitabweichung Uhrinformation" VALUE 0x81925C KwUb 255.0 t1sxs_uw_q1 0.00 255.0 FORMAT "%5.1" /end CHARACTERISTIC
/begin CHARACTERISTIC TVZMSE "Zeitgrenze für Rücksetzen Überwachungszähler ZMS- Resonanz" VALUE 0x827FFA KwUw 655.3500 t10msxs_uw_b655p35 0.00 655.3500 FORMAT "%8.4" /end CHARACTERISTIC
/begin CHARACTERISTIC TWAFMN "Untere Schwelle des Temperaturfensters bei Feinadaption" VALUE 0x81A33A KwUb 191.3 temp_ub_q0p75_o48 -48.00 143.3 FORMAT "%5.1" /end CHARACTERISTIC
/begin CHARACTERISTIC TWAFMX "Obere Schwelle des Temperaturfensters bei Feinadaption" VALUE 0x81A33B KwUb 191.3 temp_ub_q0p75_o48 -48.00 143.3 FORMAT "%5.1" /end CHARACTERISTIC
/begin CHARACTERISTIC TZMSAS "Zeitgrenze für ZMS-Resonanz außerhalb Start" VALUE 0x817462 KwUw 655.3500 t10msxs_uw_b655p35 0.00 655.3500 FORMAT "%8.4" /end CHARACTERISTIC
/begin CHARACTERISTIC TZMSST "Zeitgrenze für ZMS-Resonanz innerhalb Start" VALUE 0x817464 KwUw 655.3500 t10msxs_uw_b655p35 0.00 655.3500 FORMAT "%8.4" /end CHARACTERISTIC
/begin CHARACTERISTIC UANAUFRP "Schrittweite für AUF-Rampe" VALUE 0x8144F2 KwUw 0.9994659 relDK_uw_b100 0.00 0.9994659 FORMAT "%9.7" /end CHARACTERISTIC
/begin CHARACTERISTIC UANNMAX "Motordrehzahlschwelle für Freigabe UMA-Lernen und Verstärkerabgleich" VALUE 0x810B66 KwUb 2550. nmot_ub_q10 0.00 2550. FORMAT "%5.0" /end CHARACTERISTIC
/begin CHARACTERISTIC UANPEDMAX "Pedalschwelle für UMA-Lernen erlaubt" VALUE 0x810B67 KwUb 100.0 relDK_ub_b100 0.00 100.0 FORMAT "%5.1" /end CHARACTERISTIC
/begin CHARACTERISTIC UANPIDMIN "Abbruchschwelle PID-Summe für ZU-Rampe" VALUE 0x8144F4 KwUw 99.99847 rel_uw_b100 0.00 99.99847 FORMAT "%8.5" /end CHARACTERISTIC
/begin CHARACTERISTIC UANPIDMINA "Abbruchschwelle PID-Summe für AUF-Rampe" VALUE 0x8144F6 KwUw 99.99847 rel_uw_b100 0.00 99.99847 FORMAT "%8.5" /end CHARACTERISTIC
/begin CHARACTERISTIC UANUATS "untere Ansauglufttemperaturschwelle für Lernfreigabe" VALUE 0x810B68 KwUb 191.3 temp_ub_q0p75_o48 -48.00 143.3 FORMAT "%5.1" /end CHARACTERISTIC
/begin CHARACTERISTIC UANVFZG "Geschwindigkeitssschelle für DV-E-Prüfung/Lernroutine" VALUE 0x810B69 KwUb 318.8 vfzg_ub_q1p25 0.00 318.8 FORMAT "%5.1" /end CHARACTERISTIC
/begin CHARACTERISTIC UANZURP "Schrittweite für ZU-Rampe" VALUE 0x8144F8 KwUw 0.05004883 spg_q1p221_mV 0.00 0.05004883 FORMAT "%10.8" /end CHARACTERISTIC
/begin CHARACTERISTIC UAN_O_MT "obere Motortemperaturschwelle für Anschlag" VALUE 0x810B6A KwUb 191.3 temp_ub_q0p75_o48 -48.00 143.3 FORMAT "%5.1" /end CHARACTERISTIC
/begin CHARACTERISTIC UAN_STORE "Schwelle für Abspeicherung neuer Lernwerte" VALUE 0x8144FA KwUw 0.05004883 spg_q1p221_mV 0.00 0.05004883 FORMAT "%10.8" /end CHARACTERISTIC
/begin CHARACTERISTIC UAN_U_MT "untere Motortemperaturschwelle für Lernfreigabe" VALUE 0x810B6B KwUb 191.3 temp_ub_q0p75_o48 -48.00 143.3 FORMAT "%5.1" /end CHARACTERISTIC
/begin CHARACTERISTIC UBSOLMN "Minimale Batterie-Sollspannung" VALUE 0x8188C8 KwUb 17.95 spg_ubatt 0.00 17.95 FORMAT "%5.2" /end CHARACTERISTIC
/begin CHARACTERISTIC UBSOLMX "Maximale Batterie-Sollspannung" VALUE 0x8188C9 KwUb 17.95 spg_ubatt 0.00 17.95 FORMAT "%5.2" /end CHARACTERISTIC
/begin CHARACTERISTIC UB_UANL "Batteriespannungsschwelle für Lernfreigabe" VALUE 0x810B6C KwUb 17.95 spg_ubatt 0.00 17.95 FORMAT "%5.2" /end CHARACTERISTIC
/begin CHARACTERISTIC UDKNLP1N "Nennwert-Spannung DK-Poti 1 in NLP-Stellung" VALUE 0x8144FC KwUw 4.998779 spg_q1p221_mV 0.00 4.998779 FORMAT "%8.6" /end CHARACTERISTIC
/begin CHARACTERISTIC UDKNLP2N "Nennwert-Spannung DK-Poti 2 in NLP-Stellung" VALUE 0x8144FE KwUw 4.998779 spg_q1p221_mV 0.00 4.998779 FORMAT "%8.6" /end CHARACTERISTIC
/begin CHARACTERISTIC UDKP1AMAX "max. Spannung DK-Poti 1 am unteren DK-Anschlag" VALUE 0x814500 KwUw 4.998779 spg_q1p221_mV 0.00 4.998779 FORMAT "%8.6" /end CHARACTERISTIC
/begin CHARACTERISTIC UDKP1AMIN "min. Spannung DK-Poti 1 am unteren DK-Anschlag" VALUE 0x814502 KwUw 4.998779 spg_q1p221_mV 0.00 4.998779 FORMAT "%8.6" /end CHARACTERISTIC
/begin CHARACTERISTIC UDKP1AURI "Spannung DK-Poti 1 am unt. DK-Anschlag, Initial. Wert" VALUE 0x814504 KwUw 4.998779 spg_q1p221_mV 0.00 4.998779 FORMAT "%8.6" /end CHARACTERISTIC
/begin CHARACTERISTIC UDKP1DUS "Nennumschaltschwelle zur DK-Poti-1-Umschaltung" VALUE 0x810B6D KwUb 4.9805 spg_ub_q0p019 0.00 4.9805 /end CHARACTERISTIC
/begin CHARACTERISTIC UDKP1NHUB "Nennhub der Drosselklappe im DV-E, (Poti 1)" VALUE 0x814506 KwUw 4.998779 spg_q1p221_mV 0.00 4.998779 FORMAT "%8.6" /end CHARACTERISTIC
/begin CHARACTERISTIC UDKP1VID "Nennverstärkung für DK-Poti 1" VALUE 0x814508 KwUw 7.996094 fak_q0p0039 0.00 7.996094 FORMAT "%8.6" /end CHARACTERISTIC
/begin CHARACTERISTIC UDKP1VOMA "max. Offsetfehler für DK-Poti-1-Verstärker" VALUE 0x81450A KwSw 5.004090 spg_sw_q0p001222 0.00 5.004090 FORMAT "%8.6" /end CHARACTERISTIC
/begin CHARACTERISTIC UDKP1VOMI "min. Offsetfehler für DK-Poti-1-Verstärker" VALUE 0x81450C KwSw 5.004090 spg_sw_q0p001222 -5.004090 0.00 FORMAT "%8.6" /end CHARACTERISTIC
/begin CHARACTERISTIC UDKP1VOSC "unt. Grenze für ob. Abgleichpkt. DK-Poti 1" VALUE 0x81450E KwUw 4.995117 spg_uw_q0p00488 0.00 4.995117 FORMAT "%8.6" /end CHARACTERISTIC
/begin CHARACTERISTIC UDKP1VUSC "ob. Grenze für unt. Abgleichpkt. DK-Poti 1" VALUE 0x814510 KwUw 4.995117 spg_uw_q0p00488 0.00 4.995117 FORMAT "%8.6" /end CHARACTERISTIC
/begin CHARACTERISTIC UDKP1VVMA "ob. Wert Verstärkungsfehler für Verstärker" VALUE 0x814512 KwUw 7.996094 fak_q0p0039 0.00 7.996094 FORMAT "%8.6" /end CHARACTERISTIC
/begin CHARACTERISTIC UDKP1VVMI "unt. Wert Verstärkungsfehler für Verstärker" VALUE 0x814514 KwUw 7.996094 fak_q0p0039 0.00 7.996094 FORMAT "%8.6" /end CHARACTERISTIC
/begin CHARACTERISTIC UDKP2AMAX "max. Spannung DK-Poti 2 am unteren DK-Anschlag" VALUE 0x814516 KwUw 4.998779 spg_q1p221_mV 0.00 4.998779 FORMAT "%8.6" /end CHARACTERISTIC
/begin CHARACTERISTIC UDKP2AMIN "min. Spannung DK-Poti 2 am unteren DK-Anschlag" VALUE 0x814518 KwUw 4.998779 spg_q1p221_mV 0.00 4.998779 FORMAT "%8.6" /end CHARACTERISTIC
/begin CHARACTERISTIC UDKP2AURI "Spannung DK-Poti 2 am unt. DK-Anschlag, Initial. Wert" VALUE 0x81451A KwUw 4.998779 spg_q1p221_mV 0.00 4.998779 FORMAT "%8.6" /end CHARACTERISTIC
/begin CHARACTERISTIC UDKPALOS "Spannungsoffset zur Erkennung des Loslösens" VALUE 0x81451C KwUw 0.4003906 spg_q1p221_mV 0.00 0.4003906 FORMAT "%9.7" /end CHARACTERISTIC
/begin CHARACTERISTIC UDKPAOFF "Spannungsoffset am unteren Anschlag" VALUE 0x81451E KwUw 0.05004883 spg_q1p221_mV 0.00 0.05004883 FORMAT "%10.8" /end CHARACTERISTIC
/begin CHARACTERISTIC UDKPATMX "max. möglicher Offset der temp. UMA-Adaption" VALUE 0x814520 KwUw 4.998779 spg_q1p221_mV 0.00 4.998779 FORMAT "%8.6" /end CHARACTERISTIC
/begin CHARACTERISTIC UHRMNDEV "Schwelle Min. Abweichung Abstellzeit" VALUE 0x81925D KwUb 1.992 fak_ub_b2 0.00 1.992 FORMAT "%5.3" /end CHARACTERISTIC
/begin CHARACTERISTIC UHRMXDEV "Schwelle Max. Abweichung Abstellzeit" VALUE 0x81925E KwUb 1.992 fak_ub_b2 0.00 1.992 FORMAT "%5.3" /end CHARACTERISTIC
/begin CHARACTERISTIC UPVGNENN "Nennwert für DV-E Potiversorgungsspannung" VALUE 0x81BF08 KwUw 1.000000 dez 65534.00 65535.00 FORMAT "%8.2" /end CHARACTERISTIC
/begin CHARACTERISTIC VASRM "Geschwindigkeitsschwelle für Schlechtwegerkennung" VALUE 0x811EF3 KwUb 318.8 vfzg_ub_q1p25 0.00 318.8 FORMAT "%5.1" /end CHARACTERISTIC
/begin CHARACTERISTIC VMAXNB "Maximal zulässige Fahrzeuggeschwindigkeit im Normalbetrieb" VALUE 0x827C80 KwUw 511.9922 vfzg_uw_q0p00781 0.00 511.9922 FORMAT "%8.4" /end CHARACTERISTIC
/begin CHARACTERISTIC VMAXTM "Maximalgeschwindigkeit aus Motortemperatur" CURVE 0x827C82 KlAUwSstUwWUw 511.9922 vfzg_uw_q0p00781 0.00 511.9922 FORMAT "%8.4"
 /begin AXIS_DESCR STD_AXIS tmotrvmx temp_ub_q0p75_o48 5 -48.00000 49103.25 FORMAT "%8.2" DEPOSIT ABSOLUTE /end AXIS_DESCR
/end CHARACTERISTIC
/begin CHARACTERISTIC VMAXTOL "Maximalgeschwindigkeit aus Öltemperatur" CURVE 0x827C98 KlAUwSstUwWUw 511.9922 vfzg_uw_q0p00781 0.00 511.9922 FORMAT "%8.4"
 /begin AXIS_DESCR STD_AXIS tolc temp_ub_q1_o60 5 -60.00000 65475.00 FORMAT "%8.2" DEPOSIT ABSOLUTE /end AXIS_DESCR
/end CHARACTERISTIC
/begin CHARACTERISTIC VRADF "Geschwindigkeitsschwelle für Fehlereintrag" VALUE 0x817036 KwUw 654.9900 vrad_uw_b655 0.00 654.9900 FORMAT "%8.4" /end CHARACTERISTIC
/begin CHARACTERISTIC VSAA "Geschwindigkeitsschwelle für SA-Drehzahlanhebung" VALUE 0x811258 KwUb 318.8 vfzg_ub_q1p25 0.00 318.8 FORMAT "%5.1" /end CHARACTERISTIC
/begin CHARACTERISTIC VTUMTA "Schwelle Fahrzeuggeschwindigkeit für Bestimmung Umgebungstemperatur" VALUE 0x819258 KwUb 318.8 vfzg_ub_q1p25 0.00 318.8 FORMAT "%5.1" /end CHARACTERISTIC
/begin CHARACTERISTIC WDKFPRO1 "Aschaltschwelle DK-Istwert für öffnende DV-E-Federprüfung" VALUE 0x814522 KwSw 1599.976 relDK_q0p02441 -800.0000 799.9756 FORMAT "%8.4" /end CHARACTERISTIC
/begin CHARACTERISTIC WDKFPRO2 "Prüfschwelle DK-Istwert für öffnende DV-E-Federprüfung" VALUE 0x814524 KwSw 1599.976 relDK_q0p02441 -800.0000 799.9756 FORMAT "%8.4" /end CHARACTERISTIC
/begin CHARACTERISTIC WDKFPRZ1 "Abschaltschwelle DK-Istwert für DV-E-Rückstellfederprüfung" VALUE 0x814526 KwUw 100.0000 relDK_uw_b100 0.00 100.0000 FORMAT "%8.4" /end CHARACTERISTIC
/begin CHARACTERISTIC WDKFPRZ2 "Prüfschwelle DK-Istwert für DV-E-Rückstellfederprüfung" VALUE 0x814528 KwUw 100.0000 relDK_uw_b100 0.00 100.0000 FORMAT "%8.4" /end CHARACTERISTIC
/begin CHARACTERISTIC WDKNLPMA "oberer erlaubter Istwert für NLP-Stellung" VALUE 0x81452A KwUw 100.0000 relDK_uw_b100 0.00 100.0000 FORMAT "%8.4" /end CHARACTERISTIC
/begin CHARACTERISTIC WDKNLPMI "unterer erlaubter Istwert für NLP-Stellung" VALUE 0x81452C KwUw 100.0000 relDK_uw_b100 0.00 100.0000 FORMAT "%8.4" /end CHARACTERISTIC
/begin CHARACTERISTIC WDKNSTORE "Schwelle Abspeichern neuer Lernwerte relativer NLP" VALUE 0x81452E KwUw 100.0000 relDK_uw_b100 0.00 100.0000 FORMAT "%8.4" /end CHARACTERISTIC
/begin CHARACTERISTIC WDKSFPR "DK-Sollwert für DV-E-Rückstellfederprüfung" VALUE 0x814530 KwUw 100.0000 relDK_uw_b100 0.00 100.0000 FORMAT "%8.4" /end CHARACTERISTIC
/begin CHARACTERISTIC WDKSFPRO "DK-Sollwert für öffnende DV-E-Federprüfung" VALUE 0x814532 KwUw 100.0000 relDK_uw_b100 0.00 100.0000 FORMAT "%8.4" /end CHARACTERISTIC
/begin CHARACTERISTIC WDKSTMUMA "DK-Winkel-Schwelle für temporäre UMA-Adaption" VALUE 0x814534 KwUw 100.0000 relDK_uw_b100 0.00 100.0000 FORMAT "%8.4" /end CHARACTERISTIC
/begin CHARACTERISTIC WDKUGDN "KL Drosselklappenwinkel, ab der keine Drosselung mehr erfolgt" CURVE 0x814F84 GklWUw 99.99847 rel_uw_b100 0.00 99.99847 FORMAT "%8.5"
 /begin AXIS_DESCR COM_AXIS nmot nmot_ub_q40 12 0.00 10200. AXIS_PTS_REF SNM12FEUB /end AXIS_DESCR
/end CHARACTERISTIC
/begin CHARACTERISTIC WPFGRBMR "Rückgerechneter Pedalwert beim Beschleunigen mit FGR" CURVE 0x81C62A KlAUwSstUwWUw 99.99847 rel_uw_b100 0.00 99.99847 FORMAT "%8.5"
 /begin AXIS_DESCR STD_AXIS mrfgr_w rel_uw_b200 16 0.00 199.9969 FORMAT "%8.4" DEPOSIT ABSOLUTE /end AXIS_DESCR
/end CHARACTERISTIC
/begin CHARACTERISTIC WPRMX "maximaler Prädiktionswinkel" VALUE 0x810DD9 KwUb 1530. kw_q6 0.00 1530. FORMAT "%5.0" /end CHARACTERISTIC
/begin CHARACTERISTIC ZBRT "Zeitkonstante für Brennraumtempmodell" VALUE 0x81CBA8 KwUw 6553.4999985 zk100msxs_uw_b6553 0.10000152590 6553.6000000 FORMAT "%12.7" /end CHARACTERISTIC
/begin CHARACTERISTIC ZDBTMN "Zeitkonstante Dynamikanteil Brennraumtemperaturmodell für negative Gradienten" CURVE 0x81CBAA KlAUwSstUwWUw 6553.4999985 zk100msxs_uw_b6553 0.10000152590 6553.6000000 FORMAT "%12.7"
 /begin AXIS_DESCR STD_AXIS nmot_w nmot_uw_q0p25 8 0.00 16383.75 FORMAT "%8.2" DEPOSIT ABSOLUTE /end AXIS_DESCR
/end CHARACTERISTIC
/begin CHARACTERISTIC ZDBTMP "Zeitkonstante Dynamikanteil Brennraumtemperaturmodell für positive Gradienten" CURVE 0x81CBCC KlAUwSstUwWUw 6553.4999985 zk100msxs_uw_b6553 0.10000152590 6553.6000000 FORMAT "%12.7"
 /begin AXIS_DESCR STD_AXIS nmot_w nmot_uw_q0p25 8 0.00 16383.75 FORMAT "%8.2" DEPOSIT ABSOLUTE /end AXIS_DESCR
/end CHARACTERISTIC
/begin CHARACTERISTIC ZGRDPSSF "Zeitkonstante für Filter pssol-Gradient" VALUE 0x810D38 KwUb 2.54000 zk10msxs_ub_b2p55 0.0100000 2.55000 FORMAT "%7.5" /end CHARACTERISTIC
/begin CHARACTERISTIC ZKFUB "Filterzeitkonstante für Batteriespannung" VALUE 0x8188CA KwUb 50.8000 zk200msxs_ub_b51p2 0.200000 51.0000 FORMAT "%7.4" /end CHARACTERISTIC
/begin CHARACTERISTIC ZKHABB "Zeitkonstante für Abbruch-Tiefpass Katheizen" VALUE 0x8195FF KwUb 25.4996 zk100msxs_ub_b25p5 0.100392 25.6000 FORMAT "%7.4" /end CHARACTERISTIC
/begin CHARACTERISTIC ZKLAMKH "Zeitkonstante Lambda-Motor-Soll bei Katheizen" VALUE 0x815804 KwUw 655.34999985 zk10msxs_uw_b655 0.010000152590 655.36000000 FORMAT "%12.8" /end CHARACTERISTIC
/begin CHARACTERISTIC ZKLBZ "Zeitkonstante des LBZ-Integrators" VALUE 0x81BEF6 KwUw 13106.999997 zk200msxs_uw_b13107 0.20000305180 13107.200000 FORMAT "%12.6" /end CHARACTERISTIC
/begin CHARACTERISTIC ZKMSDKTHFM "Zeitkonstante schnelle Massenstromadaption (bei Abgleich mit HFM-Signal)" CURVE 0x814F9C KlAUwSstUwWUw 655.34999985 zk10msxs_uw_b655 0.010000152590 655.36000000 FORMAT "%12.8"
 /begin AXIS_DESCR STD_AXIS pspvds_w fak_uw_b2 8 0.00 1.999969 FORMAT "%8.6" DEPOSIT ABSOLUTE /end AXIS_DESCR
/end CHARACTERISTIC
/begin CHARACTERISTIC ZKPLGRU "Zeitkonstante  für Istwert Grundladedruck" VALUE 0x819B1E KwUb 12.7498039 zk50msxs_ub_b12p8 0.0501960784 12.8000000 FORMAT "%10.7" /end CHARACTERISTIC
/begin CHARACTERISTIC ZKPVDKT "Zeitkonstante für langsame Massenstromadaption" CURVE 0x81BF40 KlAUwSstUwWUw 65534.000000 zk1sxs_uw_b65535 1.0000000000 65535.000000 FORMAT "%12.6"
 /begin AXIS_DESCR STD_AXIS pspvds_w fak_uw_b2 8 0.00 1.999969 FORMAT "%8.6" DEPOSIT ABSOLUTE /end AXIS_DESCR
/end CHARACTERISTIC
/begin CHARACTERISTIC ZKTABTU "Zeitkonstante für Motorabkühlung" CURVE 0x81D206 KlAUbSstUbWUw 65535.00 t1sxs_uw_b65535 0.00 65535.00 FORMAT "%8.2"
 /begin AXIS_DESCR STD_AXIS tumg temp_ub_q0p75_o48 4 -48.00 143.3 FORMAT "%5.1" DEPOSIT ABSOLUTE /end AXIS_DESCR
/end CHARACTERISTIC
/begin CHARACTERISTIC ZMRFABN "berechnet aktuelle Zeitkonstante des Tiefpaß (Dauerhochlast) mrfabnf_w" CURVE 0x81D0E0 KlAUwSstSwWUw 6553.4999985 zk100msxs_uw_b6553 0.10000152590 6553.6000000 FORMAT "%12.7"
 /begin AXIS_DESCR STD_AXIS dmrfabn_w rel_sw_b100 5 -100.0000 99.99695 FORMAT "%8.4" DEPOSIT ABSOLUTE /end AXIS_DESCR
/end CHARACTERISTIC
/begin CHARACTERISTIC ZNGFIL "Zeitkonstante für Drehzahlgradient-Filter" VALUE 0x813FA8 KwUw 655.34999985 zk10msxs_uw_b655 0.010000152590 655.36000000 FORMAT "%12.8" /end CHARACTERISTIC
/begin CHARACTERISTIC ZRFKMSDK "Zeitkonstante Reset Massenstromabgleich fkmsdk" VALUE 0x810D39 KwUb 2.54000 zk10msxs_ub_b2p55 0.0100000 2.55000 FORMAT "%7.5" /end CHARACTERISTIC
/begin CHARACTERISTIC ZTDAGR "Zeitkonstante Temperaturdynamik bei AGR Auf- Abschaltung" VALUE 0x81CBEE KwUw 6553.4999985 zk100msxs_uw_b6553 0.10000152590 6553.6000000 FORMAT "%12.7" /end CHARACTERISTIC
/begin CHARACTERISTIC ZTMMBR "Zeitkonstante Motortemperatur für Brennraumtempmodell" VALUE 0x81CBF0 KwUw 6553.4999985 zk100msxs_uw_b6553 0.10000152590 6553.6000000 FORMAT "%12.7" /end CHARACTERISTIC
/begin CHARACTERISTIC ZVTPRGSU "Zeitkonstante Tiefpaßfilterung bei Saugrohrklappendynamik" VALUE 0x810D2E KwUb 12.7498039 zk50msxs_ub_b12p8 0.0501960784 12.8000000 FORMAT "%10.7" /end CHARACTERISTIC
/begin CHARACTERISTIC ZWDKM1 "1. Zeitkonstante Dk-Modell" VALUE 0x8156B2 KwUw 2.550000 zk10msxs_uw_b2p55T 0.00 2.550000 FORMAT "%8.6" /end CHARACTERISTIC
/begin CHARACTERISTIC ZWDKM2 "2. Zeitkonstante Dk-Modell" VALUE 0x8156B4 KwUw 2.550000 zk10msxs_uw_b2p55T 0.00 2.550000 FORMAT "%8.6" /end CHARACTERISTIC
/begin MEASUREMENT agrr "Abgasrückführrate" UBYTE rel_ub_b99p6 1 100 0 99.6094 FORMAT "%5.2" ECU_ADDRESS 0x38485F /end MEASUREMENT
/begin MEASUREMENT agrr_w "Abgasrückführrate word" UWORD rel_uw_b100 1 100 0 99.9985 FORMAT "%8.5" ECU_ADDRESS 0x384AA6 /end MEASUREMENT
/begin MEASUREMENT anzumrl_w "Anzahl der Umschaltungen auf rl aus DK-Signal berechnet" UWORD dez 1 100 0 65535 FORMAT "%8.2" ECU_ADDRESS 0x383A66 /end MEASUREMENT
/begin MEASUREMENT BBKHZausbits "" UBYTE dez 1 100 0 255 FORMAT "%5.1" ECU_ADDRESS 0x380A69 /end MEASUREMENT
/begin MEASUREMENT BBKHZlokBits "" UWORD dez 1 100 0 65535 FORMAT "%8.2" ECU_ADDRESS 0x384BBA /end MEASUREMENT
/begin MEASUREMENT BBSAWElokbits "" UBYTE dez 1 100 0 255 FORMAT "%5.1" ECU_ADDRESS 0x380AF4 /end MEASUREMENT
/begin MEASUREMENT BGARNWausbits "" UBYTE dez 1 100 0 255 FORMAT "%5.1" ECU_ADDRESS 0x384922 /end MEASUREMENT
/begin MEASUREMENT BGARNWlokbits "" UBYTE dez 1 100 0 255 FORMAT "%5.1" ECU_ADDRESS 0x384923 /end MEASUREMENT
/begin MEASUREMENT BGBNausbits0 "" UBYTE dez 1 100 0 255 FORMAT "%5.1" ECU_ADDRESS 0x380A1D /end MEASUREMENT
/begin MEASUREMENT bgcvn_bits "" UBYTE dez 1 100 0 255 FORMAT "%5.1" ECU_ADDRESS 0x38482A /end MEASUREMENT
/begin MEASUREMENT BGDVEintbits "" UBYTE dez 1 100 0 255 FORMAT "%5.1" ECU_ADDRESS 0x38312F /end MEASUREMENT
/begin MEASUREMENT BGMSZSbits "" UBYTE dez 1 100 0 255 FORMAT "%5.1" ECU_ADDRESS 0x380A1E /end MEASUREMENT
/begin MEASUREMENT bgtabsaBits_50ms "" UBYTE dez 1 100 0 255 FORMAT "%5.1" ECU_ADDRESS 0x380A59 /end MEASUREMENT
/begin MEASUREMENT bgtabstBits1_50ms "" UBYTE dez 1 100 0 255 FORMAT "%5.1" ECU_ADDRESS 0x380A5A /end MEASUREMENT
/begin MEASUREMENT bgtabstBits2_50ms "" UBYTE dez 1 100 0 255 FORMAT "%5.1" ECU_ADDRESS 0x380A5B /end MEASUREMENT
/begin MEASUREMENT bgtabstBits3_1000ms "" UBYTE dez 1 100 0 255 FORMAT "%5.1" ECU_ADDRESS 0x383136 /end MEASUREMENT
/begin MEASUREMENT bgtumgBits_1000ms "" UBYTE dez 1 100 0 255 FORMAT "%5.1" ECU_ADDRESS 0x384887 /end MEASUREMENT
/begin MEASUREMENT bsc "Radbeschleunigungssignal aus ABS-Sensorsignal berechnet" UBYTE acc_ub_b55p55 1 100 0 55.335 FORMAT "%5.2" ECU_ADDRESS 0x380B87 /end MEASUREMENT
/begin MEASUREMENT B_abgle "Bedingung: Fehler beim Verstärkerabgleich" UWORD B_TRUE 1 100 0 1 BIT_MASK 0x80 FORMAT "%13.11" ECU_ADDRESS 0xFD44 /end MEASUREMENT
/begin MEASUREMENT B_absf "Bit ABS-Fehler Radsignal" UWORD B_TRUE 1 100 0 1 BIT_MASK 0x2 FORMAT "%13.11" ECU_ADDRESS 0xFD9C /end MEASUREMENT
/begin MEASUREMENT B_abstgp "Bedingung Abstellzeitermittlung gültig und plausibel" UBYTE B_TRUE 1 100 0 1 BIT_MASK 0x1 FORMAT "%13.11" ECU_ADDRESS 0x380A5A /end MEASUREMENT
/begin MEASUREMENT B_abstmnpl "Bedingung Abstellzeit aus Motorabkühlung nicht plausibel" UBYTE B_TRUE 1 100 0 1 BIT_MASK 0x1 FORMAT "%13.11" ECU_ADDRESS 0x380A5B /end MEASUREMENT
/begin MEASUREMENT B_abstnlg0 "Abstellzeitermittlung über SG-Nachlauf gültig und plausibel, NV-Hilfsgröße" UBYTE B_TRUE 1 100 0 1 BIT_MASK 0x2 FORMAT "%13.11" ECU_ADDRESS 0x383136 /end MEASUREMENT
/begin MEASUREMENT B_abstnlgp "Bedingung Abstellzeitermittlung über SG-Nachlauf ist gültig und plausibel" UWORD B_TRUE 1 100 0 1 BIT_MASK 0x20 FORMAT "%13.11" ECU_ADDRESS 0xFD64 /end MEASUREMENT
/begin MEASUREMENT B_abstnpl "Bedingung Abstellzeitermittlung nicht plausibel" UBYTE B_TRUE 1 100 0 1 BIT_MASK 0x2 FORMAT "%13.11" ECU_ADDRESS 0x380A5A /end MEASUREMENT
/begin MEASUREMENT B_abstuhrg "Bedingung Abstellzeitermittlung aus Uhr gültig und plausibel" UBYTE B_TRUE 1 100 0 1 BIT_MASK 0x2 FORMAT "%13.11" ECU_ADDRESS 0x380A5B /end MEASUREMENT
/begin MEASUREMENT B_add "Bedingung Plausibilitäts- und Differenzbedingung für aktuelles PUS_W erfüllt" UBYTE B_TRUE 1 100 0 1 BIT_MASK 0x2 FORMAT "%13.11" ECU_ADDRESS 0x380BAF /end MEASUREMENT
/begin MEASUREMENT B_bevab "Bedingung EV-Abschaltung auf Bank/Bank1" UWORD B_TRUE 1 100 0 1 BIT_MASK 0x1000 FORMAT "%13.11" ECU_ADDRESS 0xFD5E /end MEASUREMENT
/begin MEASUREMENT B_bldrff "" UWORD B_TRUE 1 100 0 1 BIT_MASK 0x8000 FORMAT "%13.11" ECU_ADDRESS 0xFD7E /end MEASUREMENT
/begin MEASUREMENT B_bldsff "" UWORD B_TRUE 1 100 0 1 BIT_MASK 0x1 FORMAT "%13.11" ECU_ADDRESS 0xFD80 /end MEASUREMENT
/begin MEASUREMENT B_blduff "" UWORD B_TRUE 1 100 0 1 BIT_MASK 0x2 FORMAT "%13.11" ECU_ADDRESS 0xFD80 /end MEASUREMENT
/begin MEASUREMENT B_blkeb "MIL-Ansteuerung blinkend eigenbestimmt" UBYTE B_TRUE 1 100 0 1 BIT_MASK 0x4 FORMAT "%13.11" ECU_ADDRESS 0x38481C /end MEASUREMENT
/begin MEASUREMENT B_bvhfm "Bedingung: Bordnetzversorgung HFM" UBYTE B_TRUE 1 100 0 1 BIT_MASK 0x1 FORMAT "%13.11" ECU_ADDRESS 0x380A1D /end MEASUREMENT
/begin MEASUREMENT B_bvhls "Bedingung: Bordnetzversorgung Lambdasondenheizung" UBYTE B_TRUE 1 100 0 1 BIT_MASK 0x2 FORMAT "%13.11" ECU_ADDRESS 0x380A1D /end MEASUREMENT
/begin MEASUREMENT B_cksbrdy "Checksummemberechnung ist fertig (ready)" UBYTE B_TRUE 1 100 0 1 BIT_MASK 0x1 FORMAT "%13.11" ECU_ADDRESS 0x38482A /end MEASUREMENT
/begin MEASUREMENT B_dcdisr "Bedingung: DV-E-Endstufenabschaltung wird angefordert" UWORD B_TRUE 1 100 0 1 BIT_MASK 0x100 FORMAT "%13.11" ECU_ADDRESS 0xFD44 /end MEASUREMENT
/begin MEASUREMENT B_dkaden "Bedingung: DK-Sollwert aus DK-Adaption und -Prüfung verwenden" UWORD B_TRUE 1 100 0 1 BIT_MASK 0x200 FORMAT "%13.11" ECU_ADDRESS 0xFD44 /end MEASUREMENT
/begin MEASUREMENT B_dknach "Dauer-RAM, Bedingung: DK im Nachlauf stromlos und in NLP" UBYTE B_TRUE 1 100 0 1 BIT_MASK 0x8 FORMAT "%13.11" ECU_ADDRESS 0x38312F /end MEASUREMENT
/begin MEASUREMENT B_dlrien "Bedingung: keine temp. Begrenzung des I-Anteils im DLR durchführen" UWORD B_TRUE 1 100 0 1 BIT_MASK 0x400 FORMAT "%13.11" ECU_ADDRESS 0xFD44 /end MEASUREMENT
/begin MEASUREMENT B_dnsll "Bedingung SA-Drehzahl-Hysterese DNSLL" UWORD B_TRUE 1 100 0 1 BIT_MASK 0x200 FORMAT "%13.11" ECU_ADDRESS 0xFD82 /end MEASUREMENT
/begin MEASUREMENT B_dnwfozea "Bedingung Freigabe Nockenwellendiagnose ohne Zyklusflag Endstufenprüfung Auslass" UBYTE B_TRUE 1 100 0 1 BIT_MASK 0x1 FORMAT "%13.11" ECU_ADDRESS 0x380BB3 /end MEASUREMENT
/begin MEASUREMENT B_dnwfozee "Bedingung Freigabe Nockenwellendiagnose ohne Zyklusflag Endstufenprüfung Einlass" UBYTE B_TRUE 1 100 0 1 BIT_MASK 0x2 FORMAT "%13.11" ECU_ADDRESS 0x380BB3 /end MEASUREMENT
/begin MEASUREMENT B_dveada "Bedingung: DV-E-Adaption sperrt Einspritzung" UWORD B_TRUE 1 100 0 1 BIT_MASK 0x800 FORMAT "%13.11" ECU_ADDRESS 0xFD44 /end MEASUREMENT
/begin MEASUREMENT B_dvetv "Bedingung: Verriegelungsbit erweiterte Stellertauscherkennung" UWORD B_TRUE 1 100 0 1 BIT_MASK 0x1000 FORMAT "%13.11" ECU_ADDRESS 0xFD44 /end MEASUREMENT
/begin MEASUREMENT B_edsli "Bedingung Error Drucksensor Ladedruck" UWORD B_TRUE 1 100 0 1 BIT_MASK 0x1000 FORMAT "%13.11" ECU_ADDRESS 0xFD54 /end MEASUREMENT
/begin MEASUREMENT B_epcl "Bedingung für Ansteuerung EGAS-Fehlerlampe" UWORD B_TRUE 1 100 0 1 BIT_MASK 0x1000 FORMAT "%13.11" ECU_ADDRESS 0xFD26 /end MEASUREMENT
/begin MEASUREMENT B_evakt "Bedingung alle Einspritzventile aktiv/angesteuert" UWORD B_TRUE 1 100 0 1 BIT_MASK 0x2000 FORMAT "%13.11" ECU_ADDRESS 0xFD5E /end MEASUREMENT
/begin MEASUREMENT B_evloc "Status: alle lokalen Einspritzventile werden angesteuert, = B_EVTOT bei einem SG" UWORD B_TRUE 1 100 0 1 BIT_MASK 0x4000 FORMAT "%13.11" ECU_ADDRESS 0xFD5E /end MEASUREMENT
/begin MEASUREMENT B_fgabgl "Bedingung Freigabe des Füllungsabgleichs" UWORD B_TRUE 1 100 0 1 BIT_MASK 0x2000 FORMAT "%13.11" ECU_ADDRESS 0xFD54 /end MEASUREMENT
/begin MEASUREMENT B_fgabglgd "Bedingung Freigabe des Füllungsabgleichs durch Gradient" UWORD B_TRUE 1 100 0 1 BIT_MASK 0x4000 FORMAT "%13.11" ECU_ADDRESS 0xFD54 /end MEASUREMENT
/begin MEASUREMENT B_fkmsmn "schnelle Massenstromadaption fkmsdks im unteren Anschlag" UWORD B_TRUE 1 100 0 1 BIT_MASK 0x8000 FORMAT "%13.11" ECU_ADDRESS 0xFD54 /end MEASUREMENT
/begin MEASUREMENT B_fkmsmx "schnelle Massenstromadaption fkmsdks im oberen Anschlag" UWORD B_TRUE 1 100 0 1 BIT_MASK 0x1 FORMAT "%13.11" ECU_ADDRESS 0xFD56 /end MEASUREMENT
/begin MEASUREMENT B_fkpvdk "Bedingung für die Freigabe des langsamen multiplikativen Füllungsabgleichs" UBYTE B_TRUE 1 100 0 1 BIT_MASK 0x1 FORMAT "%13.11" ECU_ADDRESS 0x380A1E /end MEASUREMENT
/begin MEASUREMENT B_fkpvmn "langsame Massenstromadaption fkpvdk im unteren Anschlag" UBYTE B_TRUE 1 100 0 1 BIT_MASK 0x20 FORMAT "%13.11" ECU_ADDRESS 0x380A1E /end MEASUREMENT
/begin MEASUREMENT B_fkpvmx "langsame Massenstromadaption fkpvdk im oberen Anschlag" UBYTE B_TRUE 1 100 0 1 BIT_MASK 0x10 FORMAT "%13.11" ECU_ADDRESS 0x380A1E /end MEASUREMENT
/begin MEASUREMENT B_fphad "Berechnung Freigabebedingung für Flankenadaption Phasensensor" UBYTE B_TRUE 1 100 0 1 BIT_MASK 0x1 FORMAT "%13.11" ECU_ADDRESS 0x384923 /end MEASUREMENT
/begin MEASUREMENT B_fprakt "DK-Rückstellfeder-Prüfung aktiv" UWORD B_TRUE 1 100 0 1 BIT_MASK 0x2000 FORMAT "%13.11" ECU_ADDRESS 0xFD44 /end MEASUREMENT
/begin MEASUREMENT B_fproab "Bedingung: DV-E-Prüfung öffnende Feder Abbruch, Feder öffnet nicht" UWORD B_TRUE 1 100 0 1 BIT_MASK 0x4000 FORMAT "%13.11" ECU_ADDRESS 0xFD44 /end MEASUREMENT
/begin MEASUREMENT B_fproe "Bedingung: Öffnende Federprüfung Fehler" UWORD B_TRUE 1 100 0 1 BIT_MASK 0x8000 FORMAT "%13.11" ECU_ADDRESS 0xFD44 /end MEASUREMENT
/begin MEASUREMENT B_fprook "Bedingung: öffnende Federprüfung i.O." UWORD B_TRUE 1 100 0 1 BIT_MASK 0x1 FORMAT "%13.11" ECU_ADDRESS 0xFD46 /end MEASUREMENT
/begin MEASUREMENT B_fprordy "Bedingung: Öffnende Federprüfung fertig" UWORD B_TRUE 1 100 0 1 BIT_MASK 0x2 FORMAT "%13.11" ECU_ADDRESS 0xFD46 /end MEASUREMENT
/begin MEASUREMENT B_fprovb "Bedingung: Öffnende Federprüfung verboten" UWORD B_TRUE 1 100 0 1 BIT_MASK 0x4 FORMAT "%13.11" ECU_ADDRESS 0xFD46 /end MEASUREMENT
/begin MEASUREMENT B_fprrdy "DK-Rückstellfeder-Prüfung beendet" UWORD B_TRUE 1 100 0 1 BIT_MASK 0x8 FORMAT "%13.11" ECU_ADDRESS 0xFD46 /end MEASUREMENT
/begin MEASUREMENT B_fprzab "Bedingung: DV-E-Rückstellfederprüfung Abbruch, Feder schließt nicht" UWORD B_TRUE 1 100 0 1 BIT_MASK 0x10 FORMAT "%13.11" ECU_ADDRESS 0xFD46 /end MEASUREMENT
/begin MEASUREMENT B_fprze "Bedingung: Fehler in der DV-E-Rückstellfederprüfung" UWORD B_TRUE 1 100 0 1 BIT_MASK 0x20 FORMAT "%13.11" ECU_ADDRESS 0xFD46 /end MEASUREMENT
/begin MEASUREMENT B_fprzok "Bedingung: DV-E-Rückstellfederprüfung i.O." UWORD B_TRUE 1 100 0 1 BIT_MASK 0x40 FORMAT "%13.11" ECU_ADDRESS 0xFD46 /end MEASUREMENT
/begin MEASUREMENT B_fprzvb "Bedingung: DV-E-Rückstellfederprüfung verboten" UWORD B_TRUE 1 100 0 1 BIT_MASK 0x80 FORMAT "%13.11" ECU_ADDRESS 0xFD46 /end MEASUREMENT
/begin MEASUREMENT B_fraoan "Anforderung TEV schnell schließen zur Aktivierung der Gemischadaption" UWORD B_TRUE 1 100 0 1 BIT_MASK 0x8000 FORMAT "%13.11" ECU_ADDRESS 0xFD5E /end MEASUREMENT
/begin MEASUREMENT B_gap "Bedingung Gemischadaptionsphase aktiv" UWORD B_TRUE 1 100 0 1 BIT_MASK 0x1 FORMAT "%13.11" ECU_ADDRESS 0xFD60 /end MEASUREMENT
/begin MEASUREMENT B_genws "Verstellung der NW bei Getriebeeingriff untersagt" UBYTE B_TRUE 1 100 0 1 BIT_MASK 0x4 FORMAT "%13.11" ECU_ADDRESS 0x380BB3 /end MEASUREMENT
/begin MEASUREMENT B_imlprini "Initialisierung imlpr/imlpr_w" UWORD B_TRUE 1 100 0 1 BIT_MASK 0x200 FORMAT "%13.11" ECU_ADDRESS 0x384BBA /end MEASUREMENT
/begin MEASUREMENT B_inilabgl "Bedingung zur Initialisierung des langsamen Massenstromabgleichs" UBYTE B_TRUE 1 100 0 1 BIT_MASK 0x4 FORMAT "%13.11" ECU_ADDRESS 0x380A1E /end MEASUREMENT
/begin MEASUREMENT B_inimsdko "Bedingung Initialisierung langsamer additiver Massenstromabgleich" UBYTE B_TRUE 1 100 0 1 BIT_MASK 0x8 FORMAT "%13.11" ECU_ADDRESS 0x380A1E /end MEASUREMENT
/begin MEASUREMENT B_inisabgl "Bedingung zur Initialisierung des schnellen Massenstromabgleichs" UWORD B_TRUE 1 100 0 1 BIT_MASK 0x2 FORMAT "%13.11" ECU_ADDRESS 0xFD56 /end MEASUREMENT
/begin MEASUREMENT B_kh "Bedingung Kat-Heizung" UWORD B_TRUE 1 100 0 1 BIT_MASK 0x10 FORMAT "%13.11" ECU_ADDRESS 0xFD6E /end MEASUREMENT
/begin MEASUREMENT B_kha "Anforderung Katheizen" UWORD B_TRUE 1 100 0 1 BIT_MASK 0x20 FORMAT "%13.11" ECU_ADDRESS 0xFD6E /end MEASUREMENT
/begin MEASUREMENT B_khab "Bedingung Katheizen Abbruch" UWORD B_TRUE 1 100 0 1 BIT_MASK 0x40 FORMAT "%13.11" ECU_ADDRESS 0xFD6E /end MEASUREMENT
/begin MEASUREMENT B_khares "Bedingung Rücksetzen von Bit B_kha" UWORD B_TRUE 1 100 0 1 BIT_MASK 0x40 FORMAT "%13.11" ECU_ADDRESS 0x384BBA /end MEASUREMENT
/begin MEASUREMENT B_khaset "Bedingung Setzen von Bit B_kha" UWORD B_TRUE 1 100 0 1 BIT_MASK 0x20 FORMAT "%13.11" ECU_ADDRESS 0x384BBA /end MEASUREMENT
/begin MEASUREMENT B_kherr "Fehler bedingte Sperrbedingung für Bit B_kh" UWORD B_TRUE 1 100 0 1 BIT_MASK 0x100 FORMAT "%13.11" ECU_ADDRESS 0x384BBA /end MEASUREMENT
/begin MEASUREMENT B_khll "Bedingung Katheizen Leerlauf (Abbruchbedingung)" UWORD B_TRUE 1 100 0 1 BIT_MASK 0x4 FORMAT "%13.11" ECU_ADDRESS 0x384BBA /end MEASUREMENT
/begin MEASUREMENT B_khlle "Bedingung Leerlauf während Katheizen verlassen" UWORD B_TRUE 1 100 0 1 BIT_MASK 0x1 FORMAT "%13.11" ECU_ADDRESS 0x384BBA /end MEASUREMENT
/begin MEASUREMENT B_khllmx "Bedingung max. Katheitzeit im Leerlauf erreicht" UWORD B_TRUE 1 100 0 1 BIT_MASK 0x2 FORMAT "%13.11" ECU_ADDRESS 0x384BBA /end MEASUREMENT
/begin MEASUREMENT B_khn "Bedingung Katheiz-Drehzahl" UWORD B_TRUE 1 100 0 1 BIT_MASK 0x80 FORMAT "%13.11" ECU_ADDRESS 0xFD6E /end MEASUREMENT
/begin MEASUREMENT B_khno "" UWORD B_TRUE 1 100 0 1 BIT_MASK 0x100 FORMAT "%13.11" ECU_ADDRESS 0xFD6E /end MEASUREMENT
/begin MEASUREMENT B_khnwt "Bedingung: Umschaltung Motortemperaturschwelle für KAT-Heizen" UBYTE B_TRUE 1 100 0 1 BIT_MASK 0x1 FORMAT "%13.11" ECU_ADDRESS 0x380BB7 /end MEASUREMENT
/begin MEASUREMENT B_khnwte "Bedingung: Umschaltung Motortemperaturschwelle für KAT-Heizen Einlass" UBYTE B_TRUE 1 100 0 1 BIT_MASK 0x4 FORMAT "%13.11" ECU_ADDRESS 0x380BB7 /end MEASUREMENT
/begin MEASUREMENT B_khoab "Bedingung Katheizen ohne Abbruchkriterium durchgeführt" UBYTE B_TRUE 1 100 0 1 BIT_MASK 0x1 FORMAT "%13.11" ECU_ADDRESS 0x380A69 /end MEASUREMENT
/begin MEASUREMENT B_khres "Bedingung Rücksetzen von Bit B_kh" UWORD B_TRUE 1 100 0 1 BIT_MASK 0x10 FORMAT "%13.11" ECU_ADDRESS 0x384BBA /end MEASUREMENT
/begin MEASUREMENT B_khset "Bedingung Setzen von Bit B_kh" UWORD B_TRUE 1 100 0 1 BIT_MASK 0x8 FORMAT "%13.11" ECU_ADDRESS 0x384BBA /end MEASUREMENT
/begin MEASUREMENT B_khstc "von Temperaturen oder Abstellzeit abhängige Freigabe Kat-Heizen" UWORD B_TRUE 1 100 0 1 BIT_MASK 0x400 FORMAT "%13.11" ECU_ADDRESS 0x384BBA /end MEASUREMENT
/begin MEASUREMENT B_kmmil "MIL-Ansteuerung mit Relevanz zu Kilometererfassung" UBYTE B_TRUE 1 100 0 1 BIT_MASK 0x10 FORMAT "%13.11" ECU_ADDRESS 0x384003 /end MEASUREMENT
/begin MEASUREMENT B_kw "Bedingung Kat warmhalten" UWORD B_TRUE 1 100 0 1 BIT_MASK 0x200 FORMAT "%13.11" ECU_ADDRESS 0xFD6E /end MEASUREMENT
/begin MEASUREMENT B_ldb "Bedingung für Ladedruckregelbereitschaft" UWORD B_TRUE 1 100 0 1 BIT_MASK 0x4 FORMAT "%13.11" ECU_ADDRESS 0xFD80 /end MEASUREMENT
/begin MEASUREMENT B_ldr "Flag für Bedingung LDR aktiv" UWORD B_TRUE 1 100 0 1 BIT_MASK 0x8 FORMAT "%13.11" ECU_ADDRESS 0xFD80 /end MEASUREMENT
/begin MEASUREMENT B_ldrbu "Flag für Bedingung LDR backup Regler aktiv" UWORD B_TRUE 1 100 0 1 BIT_MASK 0x10 FORMAT "%13.11" ECU_ADDRESS 0xFD80 /end MEASUREMENT
/begin MEASUREMENT B_lds "Flag für Bedingung LDR Steuerung" UWORD B_TRUE 1 100 0 1 BIT_MASK 0x20 FORMAT "%13.11" ECU_ADDRESS 0xFD80 /end MEASUREMENT
/begin MEASUREMENT B_lrnakt "Lernaktiv Bit" UWORD B_TRUE 1 100 0 1 BIT_MASK 0x100 FORMAT "%13.11" ECU_ADDRESS 0xFD46 /end MEASUREMENT
/begin MEASUREMENT B_lrnerf "Lernerfolg Bit" UBYTE B_TRUE 1 100 0 1 BIT_MASK 0x2 FORMAT "%13.11" ECU_ADDRESS 0x38312F /end MEASUREMENT
/begin MEASUREMENT B_lrnfg "Lernfreigabe Bit" UWORD B_TRUE 1 100 0 1 BIT_MASK 0x200 FORMAT "%13.11" ECU_ADDRESS 0xFD46 /end MEASUREMENT
/begin MEASUREMENT B_lrnrdy "Lernen ist beendet" UWORD B_TRUE 1 100 0 1 BIT_MASK 0x400 FORMAT "%13.11" ECU_ADDRESS 0xFD46 /end MEASUREMENT
/begin MEASUREMENT B_lrntesa "Bedingung: UMA-Lernen u. Verst.abgl wegen Tester-Anford. aktiviert" UWORD B_TRUE 1 100 0 1 BIT_MASK 0x800 FORMAT "%13.11" ECU_ADDRESS 0xFD46 /end MEASUREMENT
/begin MEASUREMENT B_lrnvb "Lernverbot Bit" UWORD B_TRUE 1 100 0 1 BIT_MASK 0x1000 FORMAT "%13.11" ECU_ADDRESS 0xFD46 /end MEASUREMENT
/begin MEASUREMENT B_lrnws "Lernwertspeicherung Bit" UBYTE B_TRUE 1 100 0 1 BIT_MASK 0x1 FORMAT "%13.11" ECU_ADDRESS 0x38312F /end MEASUREMENT
/begin MEASUREMENT B_mil "MIL-Ansteuerung" UWORD B_TRUE 1 100 0 1 BIT_MASK 0x2000 FORMAT "%13.11" ECU_ADDRESS 0xFD26 /end MEASUREMENT
/begin MEASUREMENT B_milact "MIL-Ansteuerung aktiv" UWORD B_TRUE 1 100 0 1 BIT_MASK 0x4000 FORMAT "%13.11" ECU_ADDRESS 0xFD26 /end MEASUREMENT
/begin MEASUREMENT B_milas "Bedingung: MIL-Ansteuerung zu Sichtbarkeitstest kurz nach Start" UWORD B_TRUE 1 100 0 1 BIT_MASK 0x8000 FORMAT "%13.11" ECU_ADDRESS 0xFD26 /end MEASUREMENT
/begin MEASUREMENT B_milblk "MIL-Ansteuerung blinkend" UBYTE B_TRUE 1 100 0 1 BIT_MASK 0x8 FORMAT "%13.11" ECU_ADDRESS 0x38481C /end MEASUREMENT
/begin MEASUREMENT B_milclr "MIL-Reset durch Fehlerspeicher-Löschbefehl" UWORD B_TRUE 1 100 0 1 BIT_MASK 0x1 FORMAT "%13.11" ECU_ADDRESS 0xFD28 /end MEASUREMENT
/begin MEASUREMENT B_mileb "MIL-Ansteuerung eigenbestimmt" UBYTE B_TRUE 1 100 0 1 BIT_MASK 0x2 FORMAT "%13.11" ECU_ADDRESS 0x38481C /end MEASUREMENT
/begin MEASUREMENT B_milfd "Bedingung: MIL-Ansteuerung entsprechend Fehlerdetektion" UWORD B_TRUE 1 100 0 1 BIT_MASK 0x2 FORMAT "%13.11" ECU_ADDRESS 0xFD28 /end MEASUREMENT
/begin MEASUREMENT B_milfon "Bedingung: MIL on eingefroren bis Fahrtende" UWORD B_TRUE 1 100 0 1 BIT_MASK 0x4 FORMAT "%13.11" ECU_ADDRESS 0xFD28 /end MEASUREMENT
/begin MEASUREMENT B_milkm "Bedingung: MIL-Ansteuerung mit Relevanz zu Kilometererfassung" UBYTE B_TRUE 1 100 0 1 BIT_MASK 0x1 FORMAT "%13.11" ECU_ADDRESS 0x384003 /end MEASUREMENT
/begin MEASUREMENT B_milrb "Bedingung: MIL-Ansteuerung entsprechend Ready-blinken" UWORD B_TRUE 1 100 0 1 BIT_MASK 0x8 FORMAT "%13.11" ECU_ADDRESS 0xFD28 /end MEASUREMENT
/begin MEASUREMENT B_milsf "Bedingung: MIL-Ansteuerung entsprechend Sonderfunktion" UWORD B_TRUE 1 100 0 1 BIT_MASK 0x10 FORMAT "%13.11" ECU_ADDRESS 0xFD28 /end MEASUREMENT
/begin MEASUREMENT B_milsfint "" UWORD B_TRUE 1 100 0 1 BIT_MASK 0x20 FORMAT "%13.11" ECU_ADDRESS 0xFD28 /end MEASUREMENT
/begin MEASUREMENT B_milsfr "Bedingung: Request für MIL-Ansteuerung entsprechend Sonderfunktion" UWORD B_TRUE 1 100 0 1 BIT_MASK 0x800 FORMAT "%13.11" ECU_ADDRESS 0xFD26 /end MEASUREMENT
/begin MEASUREMENT B_milstat "MIL - Status für Scan Tool Mode $01 PID $01" UBYTE B_TRUE 1 100 0 1 BIT_MASK 0x40 FORMAT "%13.11" ECU_ADDRESS 0x38481C /end MEASUREMENT
/begin MEASUREMENT B_milste "MIL-Ansteuerlogik nach Startende" UWORD B_TRUE 1 100 0 1 BIT_MASK 0x40 FORMAT "%13.11" ECU_ADDRESS 0xFD28 /end MEASUREMENT
/begin MEASUREMENT B_milvt "Bedingung: MIL-Ansteuerung ist im Sichtbarkeitstest (visuability test)" UWORD B_TRUE 1 100 0 1 BIT_MASK 0x80 FORMAT "%13.11" ECU_ADDRESS 0xFD28 /end MEASUREMENT
/begin MEASUREMENT B_mlsu "Bedingung mslu nicht größer 0" UWORD B_TRUE 1 100 0 1 BIT_MASK 0x80 FORMAT "%13.11" ECU_ADDRESS 0x384BBA /end MEASUREMENT
/begin MEASUREMENT B_msndko "Freigabebedingung für langsamen additiven Massenstromabgleich" UBYTE B_TRUE 1 100 0 1 BIT_MASK 0x2 FORMAT "%13.11" ECU_ADDRESS 0x380A1E /end MEASUREMENT
/begin MEASUREMENT B_mszsdkb "Berechnung Massenstrom zum Saugrohr DK basiert" UWORD B_TRUE 1 100 0 1 BIT_MASK 0x4 FORMAT "%13.11" ECU_ADDRESS 0xFD56 /end MEASUREMENT
/begin MEASUREMENT B_mxrlroh "Bedingung maximal Auswahl für rlroh ist erfüllt" UWORD B_TRUE 1 100 0 1 BIT_MASK 0x8 FORMAT "%13.11" ECU_ADDRESS 0xFD56 /end MEASUREMENT
/begin MEASUREMENT B_neglgrd "Bedingung neg. Lastgradient beim Turbo" UWORD B_TRUE 1 100 0 1 BIT_MASK 0x10 FORMAT "%13.11" ECU_ADDRESS 0xFD56 /end MEASUREMENT
/begin MEASUREMENT B_ngasok "Bedingung Ringspeicher für ngas-Berechnung ok" UWORD B_TRUE 1 100 0 1 BIT_MASK 0x1000 FORMAT "%13.11" ECU_ADDRESS 0xFD28 /end MEASUREMENT
/begin MEASUREMENT B_nlpe "Bedingung: Fehler in NLP-Prüfung u. -Lernen" UWORD B_TRUE 1 100 0 1 BIT_MASK 0x2000 FORMAT "%13.11" ECU_ADDRESS 0xFD46 /end MEASUREMENT
/begin MEASUREMENT B_nlperf "Dauer-RAM, Bedingung: NLP-Erfassung erfolgreich" UBYTE B_TRUE 1 100 0 1 BIT_MASK 0x4 FORMAT "%13.11" ECU_ADDRESS 0x38312F /end MEASUREMENT
/begin MEASUREMENT B_nlpnew "Bedingung: NLP-Position ist noch nicht bekannt" UWORD B_TRUE 1 100 0 1 BIT_MASK 0x4000 FORMAT "%13.11" ECU_ADDRESS 0xFD46 /end MEASUREMENT
/begin MEASUREMENT B_nlpreq "Bedingung: NLP-Lernen anfordern" UWORD B_TRUE 1 100 0 1 BIT_MASK 0x8000 FORMAT "%13.11" ECU_ADDRESS 0xFD46 /end MEASUREMENT
/begin MEASUREMENT B_nnwmx "Drehzahlschwelle für NW-Regelung überschritten" UBYTE B_TRUE 1 100 0 1 BIT_MASK 0x8 FORMAT "%13.11" ECU_ADDRESS 0x380BB3 /end MEASUREMENT
/begin MEASUREMENT B_nomil "MIL-Ansteuerung verriegelt" UBYTE B_TRUE 1 100 0 1 BIT_MASK 0x10 FORMAT "%13.11" ECU_ADDRESS 0x38481C /end MEASUREMENT
/begin MEASUREMENT B_nsp "Bedingung Nachspritzer" UWORD B_TRUE 1 100 0 1 BIT_MASK 0x1 FORMAT "%13.11" ECU_ADDRESS 0xFD5A /end MEASUREMENT
/begin MEASUREMENT B_nwadae "Anforderung Flankenadaption NW-Phasensensor durch Betriebsbereich Einlass" UBYTE B_TRUE 1 100 0 1 BIT_MASK 0x8 FORMAT "%13.11" ECU_ADDRESS 0x384923 /end MEASUREMENT
/begin MEASUREMENT B_nwdfonws "Bed.: Nockenwellen-Diagnosefreigabe ohne freigegebene Nockenwellenverstellung" UBYTE B_TRUE 1 100 0 1 BIT_MASK 0x10 FORMAT "%13.11" ECU_ADDRESS 0x380BB6 /end MEASUREMENT
/begin MEASUREMENT B_nwflade "Bedingung Flankenadaption Nockenwelle Einlaß angefordert" UBYTE B_TRUE 1 100 0 1 BIT_MASK 0x8 FORMAT "%13.11" ECU_ADDRESS 0x384922 /end MEASUREMENT
/begin MEASUREMENT B_nwkwaosw "Bedingung: Phasenadaption ohne Vorgabe von Sollwinkeln" UBYTE B_TRUE 1 100 0 1 BIT_MASK 0x10 FORMAT "%13.11" ECU_ADDRESS 0x380BB3 /end MEASUREMENT
/begin MEASUREMENT B_nwmd " Nokenwellensteuerung mit Berücksichtigung von Zündaussetzer" UBYTE B_TRUE 1 100 0 1 BIT_MASK 0x8 FORMAT "%13.11" ECU_ADDRESS 0x380BB7 /end MEASUREMENT
/begin MEASUREMENT B_nwnmot "Bedingung: Nockenwellenverstellung über Drehzahlschwelle freigegeben" UBYTE B_TRUE 1 100 0 1 BIT_MASK 0x10 FORMAT "%13.11" ECU_ADDRESS 0x380BB7 /end MEASUREMENT
/begin MEASUREMENT B_nwpnrpe "Position Einlassnockenwelle(n) nahe Referenzposition" UBYTE B_TRUE 1 100 0 1 BIT_MASK 0x10 FORMAT "%13.11" ECU_ADDRESS 0x384923 /end MEASUREMENT
/begin MEASUREMENT B_nwrpose "Bedingung: Ansteuerung der Nockenwellen-Referenzposition durch Steller (Einlass)" UBYTE B_TRUE 1 100 0 1 BIT_MASK 0x4 FORMAT "%13.11" ECU_ADDRESS 0x384922 /end MEASUREMENT
/begin MEASUREMENT B_nws "Bedingung Nockenwellensteuerung" UWORD B_TRUE 1 100 0 1 BIT_MASK 0x2000 FORMAT "%13.11" ECU_ADDRESS 0xFDA2 /end MEASUREMENT
/begin MEASUREMENT B_nwsapkfa "Bedingung: Applikationswinkel für Nockenwellenverstellung aus Kennfeld (Auslass)" UBYTE B_TRUE 1 100 0 1 BIT_MASK 0x20 FORMAT "%13.11" ECU_ADDRESS 0x380BB3 /end MEASUREMENT
/begin MEASUREMENT B_nwsapkfe "Bedingung: Applikationswinkel für Nockenwellenverstellung aus Kennfeld (Einlass)" UBYTE B_TRUE 1 100 0 1 BIT_MASK 0x40 FORMAT "%13.11" ECU_ADDRESS 0x380BB3 /end MEASUREMENT
/begin MEASUREMENT B_nwsappa "Bed. zur Sollwertvorgabe (Auslaß) über Applikationscodewort WNWSAAPP" UBYTE B_TRUE 1 100 0 1 BIT_MASK 0x80 FORMAT "%13.11" ECU_ADDRESS 0x380BB3 /end MEASUREMENT
/begin MEASUREMENT B_nwsappe "Bed. zur Sollwertvorgabe (Einlaß) über Applikationscodewort WNWSEAPP" UBYTE B_TRUE 1 100 0 1 BIT_MASK 0x1 FORMAT "%13.11" ECU_ADDRESS 0x380BB4 /end MEASUREMENT
/begin MEASUREMENT B_nwsguda "Bed. Sollwinkelvorgabe für geringe Überschneidung Diagnose im Abgasstrang Auslaß" UBYTE B_TRUE 1 100 0 1 BIT_MASK 0x2 FORMAT "%13.11" ECU_ADDRESS 0x380BB4 /end MEASUREMENT
/begin MEASUREMENT B_nwsgude "Bed. Sollwinkelvorgabe für geringe Überschneidung Diagnose im Abgasstrang Einlaß" UBYTE B_TRUE 1 100 0 1 BIT_MASK 0x4 FORMAT "%13.11" ECU_ADDRESS 0x380BB4 /end MEASUREMENT
/begin MEASUREMENT B_nwsinva "Bed.zur Multiplik. von gemessen NW-Istwert mit (-1) vor Umspeich. in %NWSYVAR" UBYTE B_TRUE 1 100 0 1 BIT_MASK 0x8 FORMAT "%13.11" ECU_ADDRESS 0x380BB4 /end MEASUREMENT
/begin MEASUREMENT B_nwsinve "Bed.zur Multiplik. von gemessen NW-Istwert mit (-1) vor Umspeich. in %NWSYVAR" UBYTE B_TRUE 1 100 0 1 BIT_MASK 0x10 FORMAT "%13.11" ECU_ADDRESS 0x380BB4 /end MEASUREMENT
/begin MEASUREMENT B_nwskflla "Bedingung: B_ll -> unterschiedliche Sollwinkelkennfelder bei Nockenwelle Auslass" UBYTE B_TRUE 1 100 0 1 BIT_MASK 0x20 FORMAT "%13.11" ECU_ADDRESS 0x380BB4 /end MEASUREMENT
/begin MEASUREMENT B_nwskflle "Bedingung: B_ll -> unterschiedliche Sollwinkelkennfelder bei Nockenwelle Einlass" UBYTE B_TRUE 1 100 0 1 BIT_MASK 0x40 FORMAT "%13.11" ECU_ADDRESS 0x380BB4 /end MEASUREMENT
/begin MEASUREMENT B_nwskha "Bed. das bei B_kh auf seperates KF zur Sollwertvorgabe(Auslaß) umgesch. wird" UBYTE B_TRUE 1 100 0 1 BIT_MASK 0x80 FORMAT "%13.11" ECU_ADDRESS 0x380BB4 /end MEASUREMENT
/begin MEASUREMENT B_nwskhe "Bed. das bei B_kh auf seperates KF zur Sollwertvorgabe(Einlaß) umgesch. wird" UBYTE B_TRUE 1 100 0 1 BIT_MASK 0x1 FORMAT "%13.11" ECU_ADDRESS 0x380BB5 /end MEASUREMENT
/begin MEASUREMENT B_nwsoada "Freigabe Nockenwellenverstellung ohne Phasenflankenadaption" UBYTE B_TRUE 1 100 0 1 BIT_MASK 0x20 FORMAT "%13.11" ECU_ADDRESS 0x380BB7 /end MEASUREMENT
/begin MEASUREMENT B_nwsoedk "Nockenwellenfreigabe ohne Berücksichtigung von Drosselklappenfehler" UBYTE B_TRUE 1 100 0 1 BIT_MASK 0x40 FORMAT "%13.11" ECU_ADDRESS 0x380BB7 /end MEASUREMENT
/begin MEASUREMENT B_nwsrl "Bed. in NW-Steuerung zur Auswahl zwischen rlsol u. rlshk zur KF-Adressierung" UBYTE B_TRUE 1 100 0 1 BIT_MASK 0x80 FORMAT "%13.11" ECU_ADDRESS 0x380BB7 /end MEASUREMENT
/begin MEASUREMENT B_nwssprga "Bed. Freigabe Sollwertsprünge zu Applikationszwecken Auslaßnockenwelle" UBYTE B_TRUE 1 100 0 1 BIT_MASK 0x2 FORMAT "%13.11" ECU_ADDRESS 0x380BB5 /end MEASUREMENT
/begin MEASUREMENT B_nwssprge "Bed. Freigabe Sollwertsprünge zu Applikationszwecken Einlaßnockenwelle" UBYTE B_TRUE 1 100 0 1 BIT_MASK 0x4 FORMAT "%13.11" ECU_ADDRESS 0x380BB5 /end MEASUREMENT
/begin MEASUREMENT B_nwsst "Bedingung Freigabe der Nockenwellensteuerung während Start" UBYTE B_TRUE 1 100 0 1 BIT_MASK 0x8 FORMAT "%13.11" ECU_ADDRESS 0x380BB5 /end MEASUREMENT
/begin MEASUREMENT B_nwssta "Bedingung Freigabe der Auslass Nockenwellensteuerung während Start" UBYTE B_TRUE 1 100 0 1 BIT_MASK 0x10 FORMAT "%13.11" ECU_ADDRESS 0x380BB5 /end MEASUREMENT
/begin MEASUREMENT B_nwsste "Bedingung Freigabe der Einlass Nockenwellensteuerung während Start" UBYTE B_TRUE 1 100 0 1 BIT_MASK 0x20 FORMAT "%13.11" ECU_ADDRESS 0x380BB5 /end MEASUREMENT
/begin MEASUREMENT B_nwsstend "Bedingung:  Ende Sperrzeit für  Nockenwellensteuerung  nach Startende" UBYTE B_TRUE 1 100 0 1 BIT_MASK 0x1 FORMAT "%13.11" ECU_ADDRESS 0x380BB8 /end MEASUREMENT
/begin MEASUREMENT B_nwstvakt "Bedingung: Nockenwellenverstellung im Start aktiv" UBYTE B_TRUE 1 100 0 1 BIT_MASK 0x2 FORMAT "%13.11" ECU_ADDRESS 0x380BB8 /end MEASUREMENT
/begin MEASUREMENT B_nwta "Bedingung: Auslass Nockenwellensteuerung über Temperatur freigegeben" UBYTE B_TRUE 1 100 0 1 BIT_MASK 0x4 FORMAT "%13.11" ECU_ADDRESS 0x380BB8 /end MEASUREMENT
/begin MEASUREMENT B_nwte "Bedingung: Einlass Nockenwellensteuerung über Temperatur freigegeben" UBYTE B_TRUE 1 100 0 1 BIT_MASK 0x8 FORMAT "%13.11" ECU_ADDRESS 0x380BB8 /end MEASUREMENT
/begin MEASUREMENT B_nwurledk "Nockenwellen Umschaltung relative Luftfüllung bei Drosselklappenfehler" UBYTE B_TRUE 1 100 0 1 BIT_MASK 0x40 FORMAT "%13.11" ECU_ADDRESS 0x380BB5 /end MEASUREMENT
/begin MEASUREMENT B_nwvfa "Bedingung Auslass Nockenwellensteuerung freigegeben" UBYTE B_TRUE 1 100 0 1 BIT_MASK 0x80 FORMAT "%13.11" ECU_ADDRESS 0x380BB5 /end MEASUREMENT
/begin MEASUREMENT B_nwvfe "Bedingung Einlass Nockenwellensteuerung freigegeben" UBYTE B_TRUE 1 100 0 1 BIT_MASK 0x1 FORMAT "%13.11" ECU_ADDRESS 0x380BB6 /end MEASUREMENT
/begin MEASUREMENT B_nwvfg "Bedingung Nockenwellensteuerung gemeinsamer Teil freigegeben" UBYTE B_TRUE 1 100 0 1 BIT_MASK 0x2 FORMAT "%13.11" ECU_ADDRESS 0x380BB6 /end MEASUREMENT
/begin MEASUREMENT B_pltab "Bedingung Plausibilitätsprüfung Abstellzeit möglich" UBYTE B_TRUE 1 100 0 1 BIT_MASK 0x4 FORMAT "%13.11" ECU_ADDRESS 0x380A5B /end MEASUREMENT
/begin MEASUREMENT B_pssngrd "Bedingung negativer Gradient des Soll-Saugrohrdrucks" UWORD B_TRUE 1 100 0 1 BIT_MASK 0x20 FORMAT "%13.11" ECU_ADDRESS 0xFD56 /end MEASUREMENT
/begin MEASUREMENT B_psspgrd "Bedingung positiver Gradient des Soll-Saugrohrdrucks" UWORD B_TRUE 1 100 0 1 BIT_MASK 0x40 FORMAT "%13.11" ECU_ADDRESS 0xFD56 /end MEASUREMENT
/begin MEASUREMENT B_psspgrdf "Bedingung: gefilterter Gradient des Soll-Saugrohrdrucks ist positiv" UWORD B_TRUE 1 100 0 1 BIT_MASK 0x80 FORMAT "%13.11" ECU_ADDRESS 0xFD56 /end MEASUREMENT
/begin MEASUREMENT B_puerr "Bedingung Fehler  korrigiertes Umgebungsdrucksignal für Bergabfahrterkennung" UBYTE B_TRUE 1 100 0 1 BIT_MASK 0x1 FORMAT "%13.11" ECU_ADDRESS 0x380BAF /end MEASUREMENT
/begin MEASUREMENT B_rlp "Bedingung Lastpraediktion aktiv" UWORD B_TRUE 1 100 0 1 BIT_MASK 0x2 FORMAT "%13.11" ECU_ADDRESS 0xFD5A /end MEASUREMENT
/begin MEASUREMENT B_rlpns "Einschaltbedingung Lastpraediktion nach Start" UWORD B_TRUE 1 100 0 1 BIT_MASK 0x4 FORMAT "%13.11" ECU_ADDRESS 0xFD5A /end MEASUREMENT
/begin MEASUREMENT B_sab "Bedingung Schubabschaltebereitschaft" UWORD B_TRUE 1 100 0 1 BIT_MASK 0x400 FORMAT "%13.11" ECU_ADDRESS 0xFD82 /end MEASUREMENT
/begin MEASUREMENT B_sabfg "Bedingung SA-Bereitschaft oder deren Freigabe" UWORD B_TRUE 1 100 0 1 BIT_MASK 0x800 FORMAT "%13.11" ECU_ADDRESS 0xFD82 /end MEASUREMENT
/begin MEASUREMENT B_sabt "Bedingung Schubabschaltebereitschaft" UWORD B_TRUE 1 100 0 1 BIT_MASK 0x1000 FORMAT "%13.11" ECU_ADDRESS 0xFD82 /end MEASUREMENT
/begin MEASUREMENT B_sabte "Bedingung Schubabschaltebereitschaft für Tankentlüftungsventil schließen" UWORD B_TRUE 1 100 0 1 BIT_MASK 0x2000 FORMAT "%13.11" ECU_ADDRESS 0xFD82 /end MEASUREMENT
/begin MEASUREMENT B_sabv "Bedingung Schubabschaltebereitschaft verboten" UWORD B_TRUE 1 100 0 1 BIT_MASK 0x4000 FORMAT "%13.11" ECU_ADDRESS 0xFD82 /end MEASUREMENT
/begin MEASUREMENT B_saen "Bedingung Schubabschalten freigegeben" UWORD B_TRUE 1 100 0 1 BIT_MASK 0x8000 FORMAT "%13.11" ECU_ADDRESS 0xFD82 /end MEASUREMENT
/begin MEASUREMENT B_st "Bedingung Start" UWORD B_TRUE 1 100 0 1 BIT_MASK 0x10 FORMAT "%13.11" ECU_ADDRESS 0xFD9C /end MEASUREMENT
/begin MEASUREMENT B_stend "Bedingung Startende erreicht" UWORD B_TRUE 1 100 0 1 BIT_MASK 0x20 FORMAT "%13.11" ECU_ADDRESS 0xFD9C /end MEASUREMENT
/begin MEASUREMENT B_syn2nd "" UWORD B_TRUE 1 100 0 1 BIT_MASK 0x2000 FORMAT "%13.11" ECU_ADDRESS 0xFD28 /end MEASUREMENT
/begin MEASUREMENT B_tabststp "Bedingung schnelle Prozesse Abgeschaltet" UBYTE B_TRUE 1 100 0 1 BIT_MASK 0x4 FORMAT "%13.11" ECU_ADDRESS 0x380A5A /end MEASUREMENT
/begin MEASUREMENT B_tabuhrof "Bedingung Überlauf der Uhrinformation" UBYTE B_TRUE 1 100 0 1 BIT_MASK 0x8 FORMAT "%13.11" ECU_ADDRESS 0x380A5B /end MEASUREMENT
/begin MEASUREMENT B_tabunpl "Bedingung Abstellzeit unplausibel" UBYTE B_TRUE 1 100 0 1 BIT_MASK 0x10 FORMAT "%13.11" ECU_ADDRESS 0x380A5B /end MEASUREMENT
/begin MEASUREMENT B_tatmsa "Bedingung: Temperaturen aus ATM erlauben SA" UBYTE B_TRUE 1 100 0 1 BIT_MASK 0x8 FORMAT "%13.11" ECU_ADDRESS 0x380AF4 /end MEASUREMENT
/begin MEASUREMENT B_tedtev "Bedingung Tankentlüftung zum Spülen vor TEV-Diagnose" UWORD B_TRUE 1 100 0 1 BIT_MASK 0x2 FORMAT "%13.11" ECU_ADDRESS 0xFD60 /end MEASUREMENT
/begin MEASUREMENT B_tehbxf "Bedingung Beladungsintegrator ftead am Maximalanschlag, gefiltert" UWORD B_TRUE 1 100 0 1 BIT_MASK 0x4 FORMAT "%13.11" ECU_ADDRESS 0xFD60 /end MEASUREMENT
/begin MEASUREMENT B_tep "Bedingung Tankentlüftungsphase" UWORD B_TRUE 1 100 0 1 BIT_MASK 0x8 FORMAT "%13.11" ECU_ADDRESS 0xFD60 /end MEASUREMENT
/begin MEASUREMENT B_tepi "Bedingung TE-Phase intern aktiv" UWORD B_TRUE 1 100 0 1 BIT_MASK 0x10 FORMAT "%13.11" ECU_ADDRESS 0xFD60 /end MEASUREMENT
/begin MEASUREMENT B_tepzhl "Bedingung Tankentlüftungphase zusätzlich wegen Dauerhochlast" UWORD B_TRUE 1 100 0 1 BIT_MASK 0x20 FORMAT "%13.11" ECU_ADDRESS 0xFD60 /end MEASUREMENT
/begin MEASUREMENT B_tepzus "Bedingung zusätzliche Tankentlüftungsphase" UWORD B_TRUE 1 100 0 1 BIT_MASK 0x40 FORMAT "%13.11" ECU_ADDRESS 0xFD60 /end MEASUREMENT
/begin MEASUREMENT B_tesstp "Bedingung Tankentlüftung schnell stoppen" UWORD B_TRUE 1 100 0 1 BIT_MASK 0x80 FORMAT "%13.11" ECU_ADDRESS 0xFD60 /end MEASUREMENT
/begin MEASUREMENT B_testop "Bedingung Tankentlüftung stoppen" UWORD B_TRUE 1 100 0 1 BIT_MASK 0x100 FORMAT "%13.11" ECU_ADDRESS 0xFD60 /end MEASUREMENT
/begin MEASUREMENT B_tezstp "Bedingung Tankentlüftung zwang stoppen" UWORD B_TRUE 1 100 0 1 BIT_MASK 0x200 FORMAT "%13.11" ECU_ADDRESS 0xFD60 /end MEASUREMENT
/begin MEASUREMENT B_tired "Bedingung ti-Reduktion" UWORD B_TRUE 1 100 0 1 BIT_MASK 0x8 FORMAT "%13.11" ECU_ADDRESS 0xFD5A /end MEASUREMENT
/begin MEASUREMENT B_trkh "Bedingung Katheizen, Thermoreaktor wirksam" UWORD B_TRUE 1 100 0 1 BIT_MASK 0x400 FORMAT "%13.11" ECU_ADDRESS 0xFD6E /end MEASUREMENT
/begin MEASUREMENT B_tteae "Bedingung Umschaltung auf lange TE-Phase" UWORD B_TRUE 1 100 0 1 BIT_MASK 0x400 FORMAT "%13.11" ECU_ADDRESS 0xFD60 /end MEASUREMENT
/begin MEASUREMENT B_ttegais "Bedingung erste GA-Phase ist kurz" UWORD B_TRUE 1 100 0 1 BIT_MASK 0x800 FORMAT "%13.11" ECU_ADDRESS 0xFD60 /end MEASUREMENT
/begin MEASUREMENT B_tumnpl "Bedingung Umgebungstemperatur nicht plausibel" UBYTE B_TRUE 1 100 0 1 BIT_MASK 0x1 FORMAT "%13.11" ECU_ADDRESS 0x384887 /end MEASUREMENT
/begin MEASUREMENT B_ugd "Bedingung: DK-Winkel größer als für 95% der max. rel. Füllung erforderlich" UWORD B_TRUE 1 100 0 1 BIT_MASK 0x100 FORMAT "%13.11" ECU_ADDRESS 0xFD56 /end MEASUREMENT
/begin MEASUREMENT B_ugdsp "Bedingung praedizierter DK-Sollwinkel im ungedrosselten Bereich" UWORD B_TRUE 1 100 0 1 BIT_MASK 0x10 FORMAT "%13.11" ECU_ADDRESS 0xFD5A /end MEASUREMENT
/begin MEASUREMENT B_uhrexte "Bedingung Fehler in externer Uhrinformation" UBYTE B_TRUE 1 100 0 1 BIT_MASK 0x1 FORMAT "%13.11" ECU_ADDRESS 0x380A59 /end MEASUREMENT
/begin MEASUREMENT B_uhrextof "Bedingung Überlauf an externer Uhrinformation" UBYTE B_TRUE 1 100 0 1 BIT_MASK 0x2 FORMAT "%13.11" ECU_ADDRESS 0x380A59 /end MEASUREMENT
/begin MEASUREMENT B_uhrnpl "Bedingung Uhrinformation nicht plausibel" UBYTE B_TRUE 1 100 0 1 BIT_MASK 0x20 FORMAT "%13.11" ECU_ADDRESS 0x380A5B /end MEASUREMENT
/begin MEASUREMENT B_uhrnpl0 "Bedingung Uhrinformation nicht plausibel" UBYTE B_TRUE 1 100 0 1 BIT_MASK 0x4 FORMAT "%13.11" ECU_ADDRESS 0x383136 /end MEASUREMENT
/begin MEASUREMENT B_uhrnpl1 "Bedingung Uhrinformation nicht plausibel" UBYTE B_TRUE 1 100 0 1 BIT_MASK 0x40 FORMAT "%13.11" ECU_ADDRESS 0x380A5B /end MEASUREMENT
/begin MEASUREMENT B_umae "Bedingung: Fehler beim UMA-Lernen" UWORD B_TRUE 1 100 0 1 BIT_MASK 0x1 FORMAT "%13.11" ECU_ADDRESS 0xFD48 /end MEASUREMENT
/begin MEASUREMENT B_umauab "Bedingung: UMA-Lernen während Urinitialisierung abgebrochen (SKA)" UWORD B_TRUE 1 100 0 1 BIT_MASK 0x2 FORMAT "%13.11" ECU_ADDRESS 0xFD48 /end MEASUREMENT
/begin MEASUREMENT B_utzms "Bedingung Umschaltung Zeitgrenze ZMS-Resonanz" UWORD B_TRUE 1 100 0 1 BIT_MASK 0x10 FORMAT "%13.11" ECU_ADDRESS 0xFDB0 /end MEASUREMENT
/begin MEASUREMENT B_wnwsmxfa "Maximaler Sollwinkel durch feste Grenze WNWEMAX definiert (Auslass)" UBYTE B_TRUE 1 100 0 1 BIT_MASK 0x4 FORMAT "%13.11" ECU_ADDRESS 0x380BB6 /end MEASUREMENT
/begin MEASUREMENT B_wnwsmxfe "Maximaler Sollwinkel durch feste Grenze WNWEMAX definiert (Einlass)" UBYTE B_TRUE 1 100 0 1 BIT_MASK 0x8 FORMAT "%13.11" ECU_ADDRESS 0x380BB6 /end MEASUREMENT
/begin MEASUREMENT B_zms "Bedingung Motordrehzahl im ZMS-Resonanzbereich" UWORD B_TRUE 1 100 0 1 BIT_MASK 0x20 FORMAT "%13.11" ECU_ADDRESS 0xFDB0 /end MEASUREMENT
/begin MEASUREMENT B_zmse "Bedingung Motordrehzahl sicher außerhalb der ZMS-Resonanz" UWORD B_TRUE 1 100 0 1 BIT_MASK 0x40 FORMAT "%13.11" ECU_ADDRESS 0xFDB0 /end MEASUREMENT
/begin MEASUREMENT B_zmsoff "Bedingung Motorabstellen wegen ZMS-Resonanz" UWORD B_TRUE 1 100 0 1 BIT_MASK 0x80 FORMAT "%13.11" ECU_ADDRESS 0xFDB0 /end MEASUREMENT
/begin MEASUREMENT ctr_phade "Zähler Adaptionen Nockenwellenposition zu Kurbelwellenposition Einlass-NW" UBYTE dez 1 100 0 255 FORMAT "%5.1" ECU_ADDRESS 0x384924 /end MEASUREMENT
/begin MEASUREMENT cvnh_w "High-Word der CVN entsprechend SAE J1979 Mode $09 VIT $06" UWORD dez 1 100 0 65535 FORMAT "%8.2" ECU_ADDRESS 0x384A2E /end MEASUREMENT
/begin MEASUREMENT cvnl_w "Low-Word der CVN entsprechend SAE J1979 Mode $09 VIT $06" UWORD dez 1 100 0 65535 FORMAT "%8.2" ECU_ADDRESS 0x384A30 /end MEASUREMENT
/begin MEASUREMENT dfuelsan_w "Delta Füllungssensor zu Alpha/n-System" SWORD fak_sw_b1 1 100 -1 0.999969 FORMAT "%8.6" ECU_ADDRESS 0x381E7E /end MEASUREMENT
/begin MEASUREMENT dkpstg_w "Steigung DK-Poti (% DK / V)" UWORD rel_uw_b40 1 100 0 39.9994 FORMAT "%8.5" ECU_ADDRESS 0x381D08 /end MEASUREMENT
/begin MEASUREMENT dlrmxt "timer für DLR im UMA in der Begrenzung" UBYTE t50msxs_q0p05 1 100 0 12.75 FORMAT "%5.2" ECU_ADDRESS 0x3809D5 /end MEASUREMENT
/begin MEASUREMENT dmrfabn_w "Aktuelle gewichtete Leistung um Schwelle MRFABNTE verschoben" SWORD rel_sw_b100 1 100 -100 99.9969 FORMAT "%8.4" ECU_ADDRESS 0x384B20 /end MEASUREMENT
/begin MEASUREMENT dnmotas_w "Differenzdrehzahl über ein Arbeitsspiel" SWORD nmot_sw_q0p25 1 100 -8192 8191.75 FORMAT "%8.3" ECU_ADDRESS 0x381A34 /end MEASUREMENT
/begin MEASUREMENT dnmot_w "Differenzdrehzahl zwischen zwei folgenden Segmenten" SWORD nmot_sw_q0p25 1 100 -8192 8191.75 FORMAT "%8.3" ECU_ADDRESS 0x381A36 /end MEASUREMENT
/begin MEASUREMENT dnsa "Zeitabhängige Schubhysterese" UBYTE nmot_ub_q40 1 100 0 10200 FORMAT "%5.0" ECU_ADDRESS 0x380AF5 /end MEASUREMENT
/begin MEASUREMENT dpsdvs_w "delta Saugrohrdruck aus Drosselventilen (Word)" SWORD p_sw_q0p039 1 100 -1280 1279.96 FORMAT "%8.3" ECU_ADDRESS 0x382044 /end MEASUREMENT
/begin MEASUREMENT dpsfg_w "delta-Frischgaspartialdruck im Saugrohr" SWORD p_sw_q0p039 1 100 -1280 1279.96 FORMAT "%8.3" ECU_ADDRESS 0x381E66 /end MEASUREMENT
/begin MEASUREMENT dpsmp_w "delta extrapolierter Saugrohrdruck (Word)" SWORD p_sw_q0p039 1 100 -1280 1279.96 FORMAT "%8.3" ECU_ADDRESS 0x382046 /end MEASUREMENT
/begin MEASUREMENT dpvl_w "Druckabfall am Luftfilter" UWORD p_uw_q0p039 1 100 0 2559.96 FORMAT "%8.3" ECU_ADDRESS 0x382BA8 /end MEASUREMENT
/begin MEASUREMENT drlas_w "Füllungsänderung pro Arbeitsspiel" SWORD relNWU_q0p0234 1 100 -768 767.977 FORMAT "%8.4" ECU_ADDRESS 0x381F34 /end MEASUREMENT
/begin MEASUREMENT drldkzu_w "Differenz zwischen rl aus Hauptlastsignal zu Nebenlastsignal" SWORD rel_sw_q0p0234 1 100 -768 767.977 FORMAT "%8.4" ECU_ADDRESS 0x381E80 /end MEASUREMENT
/begin MEASUREMENT drllad_w "Dynamikanteil der relativen Füllung rl bei Laderdynamik" SWORD rel_sw_q0p0234 1 100 -768 767.977 FORMAT "%8.4" ECU_ADDRESS 0x381E82 /end MEASUREMENT
/begin MEASUREMENT drlp_w "delta-Einspritzberechnungs-Last aus Praediktion (Word)" SWORD rel_sw_q0p0234 1 100 -768 767.977 FORMAT "%8.4" ECU_ADDRESS 0xF9D0 /end MEASUREMENT
/begin MEASUREMENT drl_w "Füllungsänderung (Word)" SWORD rel_sw_q0p0234 1 100 -768 767.977 FORMAT "%8.4" ECU_ADDRESS 0x381E68 /end MEASUREMENT
/begin MEASUREMENT dtbrt_w "Brennraumtemperatur Dynamikanteil" SWORD temp_sw_q0p75 1 100 -24576 24575.3 FORMAT "%8.2" ECU_ADDRESS 0x384ACE /end MEASUREMENT
/begin MEASUREMENT dtkaannl "Differenz zwischen Katalysator- und Ansauglufttemperatur bei Beginn d. Nachlaufs" UBYTE temp_ub_q5_o50 1 100 -50 1225 FORMAT "%5.0" ECU_ADDRESS 0x3848B3 /end MEASUREMENT
/begin MEASUREMENT dub "Batteriespannungsabweichung für Batteriespannungsregelung" SBYTE spg_ubatt 1 100 -9.0112 8.9408 FORMAT "%5.3" ECU_ADDRESS 0x384853 /end MEASUREMENT
/begin MEASUREMENT dveadchst "DV-E-Adaption: Status Prüfbedingungen" UBYTE dez 1 100 0 255 FORMAT "%5.1" ECU_ADDRESS 0x3809D6 /end MEASUREMENT
/begin MEASUREMENT dv_hl "Radgeschwindigkeitsdifferenz hinten links" SWORD vrad_uw_b655 1 100 -327.5 327.49 FORMAT "%8.4" ECU_ADDRESS 0x382A50 /end MEASUREMENT
/begin MEASUREMENT dv_hr "Radgeschwindigkeitsdifferenz hinten rechts" SWORD vrad_uw_b655 1 100 -327.5 327.49 FORMAT "%8.4" ECU_ADDRESS 0x382A52 /end MEASUREMENT
/begin MEASUREMENT dv_vl "Radgeschwindigkeitsdifferenz vorne links" SWORD vrad_uw_b655 1 100 -327.5 327.49 FORMAT "%8.4" ECU_ADDRESS 0x382A54 /end MEASUREMENT
/begin MEASUREMENT dv_vr "Radgeschwindigkeitsdifferenz vorne rechts" SWORD vrad_uw_b655 1 100 -327.5 327.49 FORMAT "%8.4" ECU_ADDRESS 0x382A56 /end MEASUREMENT
/begin MEASUREMENT dv_w "maximale Radgeschwindigkeitsdifferenz" SWORD vrad_uw_b655 1 100 -327.5 327.49 FORMAT "%8.4" ECU_ADDRESS 0x382A58 /end MEASUREMENT
/begin MEASUREMENT evtmod "Einlaßventiltemperatur modelliert (Temperaturmodell)" UBYTE temp_ub_q0p75_o48 1 100 -48 143.25 FORMAT "%5.1" ECU_ADDRESS 0x384863 /end MEASUREMENT
/begin MEASUREMENT fafte_w "Faktor Ausfluß Tankentlüftungsventil" UWORD fak_uw_b2 1 100 0 1.99997 FORMAT "%8.6" ECU_ADDRESS 0x382BAA /end MEASUREMENT
/begin MEASUREMENT fgnsol "Faktor zur Beeinflussung der Getriebesolldrehzahl" UBYTE rel_ub_b99p6 1 100 0 99.6094 FORMAT "%5.2" ECU_ADDRESS 0x380AFA /end MEASUREMENT
/begin MEASUREMENT fhost_w "Korrekturfaktor Höhe bei Start(word)" UWORD fak_uw_b4 1 100 0 3.99994 FORMAT "%8.6" ECU_ADDRESS 0x384BBC /end MEASUREMENT
/begin MEASUREMENT fkhab "Faktor Katheizen zur Abregelung" UBYTE fak_ub_b1 1 100 0 0.996094 ECU_ADDRESS 0x380A6A /end MEASUREMENT
/begin MEASUREMENT fkhnab "Leerlaufdrehzahl-Absteuerfaktor" UBYTE fak_ub_b1 1 100 0 0.996094 ECU_ADDRESS 0x380A6B /end MEASUREMENT
/begin MEASUREMENT fklaf_w "Faktor Ausfluß (KLAF)" UWORD fak_uw_b1 1 100 0 0.999985 FORMAT "%9.7" ECU_ADDRESS 0x381E84 /end MEASUREMENT
/begin MEASUREMENT fkmsdkg_w "Korrekturfaktor Massenstrom Nebenfüllungssignal(auch bei Fehler HFM o. DK aktiv)" UWORD fak_uw_b4 1 100 0 3.99994 FORMAT "%8.6" ECU_ADDRESS 0x381E86 /end MEASUREMENT
/begin MEASUREMENT fkmsdksg_w "Korrekturfaktor schneller Massenstromabgleich (auch bei HFM o. DK Fehler aktiv)" UWORD fak_uw_b4 1 100 0 3.99994 FORMAT "%8.6" ECU_ADDRESS 0x381E88 /end MEASUREMENT
/begin MEASUREMENT fkmsdks_w "Korrekturfaktor schneller Massenstromabgleich" UWORD fak_uw_b4 1 100 0 3.99994 FORMAT "%8.6" ECU_ADDRESS 0x381E8A /end MEASUREMENT
/begin MEASUREMENT fkmsdk_w "Korrekturfaktor Massenstrom Nebenfüllungssignal" UWORD fak_uw_b4 1 100 0 3.99994 FORMAT "%8.6" ECU_ADDRESS 0x381E8C /end MEASUREMENT
/begin MEASUREMENT fkpvdkg_w "Korrekturfaktor langsamer Massenstromabgleich (auch im Fehlerfall in Betrieb)" UWORD fak_uw_b4 1 100 0 3.99994 FORMAT "%8.6" ECU_ADDRESS 0x383A68 /end MEASUREMENT
/begin MEASUREMENT fkpvdk_w "Korrekturfaktor langsamer Massenstromabgleich" UWORD fak_uw_b4 1 100 0 3.99994 FORMAT "%8.6" ECU_ADDRESS 0x384030 /end MEASUREMENT
/begin MEASUREMENT flakh "Faktor Lambda-Steuerung bei Katheizen" UBYTE fak_ub_b1 1 100 0 0.996094 ECU_ADDRESS 0x380A6C /end MEASUREMENT
/begin MEASUREMENT flamkh "Faktor Aufregelung Lambda-Motor-Soll bei Katheizen" UBYTE fak_ub_b1 1 100 0 0.996094 ECU_ADDRESS 0x380A6D /end MEASUREMENT
/begin MEASUREMENT fmdkh "Faktor Steuerung Drehmomentreserve für Katheizen" UBYTE fak_ub_b1 1 100 0 0.996094 ECU_ADDRESS 0x380A6E /end MEASUREMENT
/begin MEASUREMENT fmdkhtns_w "Zeitsteuerung Drehmomentenreserve für Katheizen nach Start" UWORD fak_uw_b1 1 100 0 0.999985 FORMAT "%9.7" ECU_ADDRESS 0x38229A /end MEASUREMENT
/begin MEASUREMENT fnwkha "Wichtungsfaktor für Nockenwellensollwinkel bei Katheizen (Auslaß)" UBYTE fak_ub_b2 1 100 0 1.99219 FORMAT "%5.3" ECU_ADDRESS 0x3848B4 /end MEASUREMENT
/begin MEASUREMENT fnwkhe "Wichtungsfaktor für Nockenwellensollwinkel bei Katheizen (Einlaß)" UBYTE fak_ub_b2 1 100 0 1.99219 FORMAT "%5.3" ECU_ADDRESS 0x3848B5 /end MEASUREMENT
/begin MEASUREMENT fpbrkds_w "Faktor zur Bestimmung des Brennraumdrucks" UWORD fak_uw_b2 1 100 0 1.99997 FORMAT "%8.6" ECU_ADDRESS 0x384AA8 /end MEASUREMENT
/begin MEASUREMENT fprstep_c "Schrittzähler DK-Rückstellfeder-Prüfung" UBYTE dez 1 100 0 255 FORMAT "%5.1" ECU_ADDRESS 0x3809D7 /end MEASUREMENT
/begin MEASUREMENT fprtim_c "Zeitzähler DK-Rückstellfeder-Prüfung" UBYTE t10msxs_ub_b2p55 1 100 0 2.55 FORMAT "%5.3" ECU_ADDRESS 0x3809D8 /end MEASUREMENT
/begin MEASUREMENT fpvdk "Korrekturfaktor Druck vor Drosselklappe" UBYTE fak_ub_b4 1 100 0 3.98438 FORMAT "%5.3" ECU_ADDRESS 0x380A1F /end MEASUREMENT
/begin MEASUREMENT fpvdk_w "Korrekturfaktor Druck vor Drosselklappe 16-Bit" UWORD fak_uw_b4 1 100 0 3.99994 FORMAT "%8.6" ECU_ADDRESS 0x381E8E /end MEASUREMENT
/begin MEASUREMENT frhodk_w "Faktor Luftdichtekorrektur für DK-Durchfluß f(Ansauglufttemp.,Höhe) 16 Bit" UWORD fak_uw_b2 1 100 0 1.99997 FORMAT "%8.6" ECU_ADDRESS 0x381E90 /end MEASUREMENT
/begin MEASUREMENT frhokor_w "Faktor zur Adressierung der Dichtekorrektur bei der Sekundärluft" UWORD fak_uw_b4 1 100 0 3.99994 FORMAT "%8.6" ECU_ADDRESS 0x384BBE /end MEASUREMENT
/begin MEASUREMENT ftbr "Faktor Temperaturkorrektur im Brennraum" UBYTE fak_ub_b2 1 100 0 1.99219 FORMAT "%5.3" ECU_ADDRESS 0x384864 /end MEASUREMENT
/begin MEASUREMENT ftbr_w "Faktor Temperaturkorrektur im Brennraum" UWORD fak_uw_b2 1 100 0 1.99997 FORMAT "%8.6" ECU_ADDRESS 0x384AD0 /end MEASUREMENT
/begin MEASUREMENT ftho_w "Faktor Korrektur Höhe und Temperatur" UWORD fak_uw_b2 1 100 0 1.99997 FORMAT "%8.6" ECU_ADDRESS 0x3853AE /end MEASUREMENT
/begin MEASUREMENT ftsr "Korrekturfaktor Lufttemperatur im Saugrohr" UBYTE fak_ub_b2 1 100 0 1.99219 FORMAT "%5.3" ECU_ADDRESS 0x384865 /end MEASUREMENT
/begin MEASUREMENT ftu "Faktor Temperatur Umgebung" UBYTE fak_ub_b2 1 100 0 1.99219 FORMAT "%5.3" ECU_ADDRESS 0x384866 /end MEASUREMENT
/begin MEASUREMENT ftvdk "Korrekturfaktor Temperatur vor Drosselklappe" UBYTE fak_ub_b2 1 100 0 1.99219 FORMAT "%5.3" ECU_ADDRESS 0x380A23 /end MEASUREMENT
/begin MEASUREMENT ftw "Faktor Temperaturgewichtung tmot, tans" UBYTE fak_ub_b2 1 100 0 1.99219 FORMAT "%5.3" ECU_ADDRESS 0x384867 /end MEASUREMENT
/begin MEASUREMENT fupsrl_w "Faktor systembezogene Umrechnung Druck auf Füllung (16-Bit)" UWORD rel_uw_b0p3 1 100 0 0.299995 FORMAT "%9.7" ECU_ADDRESS 0x384AAA /end MEASUREMENT
/begin MEASUREMENT fvisrm_w "Faktor Verstärkung Integrator Saugrohrmodell" UWORD p_uw_b32 1 100 0 31.9995 FORMAT "%8.5" ECU_ADDRESS 0x384AAC /end MEASUREMENT
/begin MEASUREMENT fwprs_w "Faktor Preadiktionswinkel bezogen auf Segment" UWORD fak_uw_b32 1 100 0 31.9995 FORMAT "%8.5" ECU_ADDRESS 0x382048 /end MEASUREMENT
/begin MEASUREMENT fwrldk_w "Faktor Wichtung relative Luftfüllung aus Dk-Signal" UWORD fak_uw_b2 1 100 0 1.99997 FORMAT "%8.6" ECU_ADDRESS 0x381E92 /end MEASUREMENT
/begin MEASUREMENT grdpssf_w "Gefilterter Gradient des Soll-Saugrohrdrucks" SWORD grd_sw_q0p78 1 100 -25600 25599.2 FORMAT "%8.2" ECU_ADDRESS 0x381E94 /end MEASUREMENT
/begin MEASUREMENT grdpssol_w "Gradient des Soll-Saugrohrdrucks (Word)" SWORD grd_sw_q0p78 1 100 -25600 25599.2 FORMAT "%8.2" ECU_ADDRESS 0x381E96 /end MEASUREMENT
/begin MEASUREMENT imlatmnl_w "abintegr. Luftmasse im Nachstart" UWORD m_uw_b23p3 1 100 0 23.3013 FORMAT "%8.5" ECU_ADDRESS 0x38403E /end MEASUREMENT
/begin MEASUREMENT imlatmw_w "Dauer-RAM integr. Luftmassenfluss bei Abstellen" UWORD m_uw_b23p3 1 100 0 23.3013 FORMAT "%8.5" ECU_ADDRESS 0x384BC0 /end MEASUREMENT
/begin MEASUREMENT imlpr "Relatives Luftmassenintegral bei Katheizung" UBYTE fak_ub_b1 1 100 0 0.996094 ECU_ADDRESS 0x380A6F /end MEASUREMENT
/begin MEASUREMENT imlpr_w "Relatives Luftmassenintegral bei Katheizung (word)" UWORD fak_uw_b1 1 100 0 0.999985 FORMAT "%9.7" ECU_ADDRESS 0x38229C /end MEASUREMENT
/begin MEASUREMENT irspsyn "Index für Ringspeicheradressierung tsegrsp_w, nmotrsp_w, rlrsp_w" UBYTE dez 1 100 0 255 FORMAT "%5.1" ECU_ADDRESS 0x380964 /end MEASUREMENT
/begin MEASUREMENT klaf_kge "Kenngrößensource für KLAF" UWORD fak_uw_q0p001 1 100 0 65.535 FORMAT "%8.5" ECU_ADDRESS 0x381E98 /end MEASUREMENT
/begin MEASUREMENT kmdp1km_w "Zurückgelegte Fahrstrecke seit Fehlerspeicher Löschen oder Powerfail (1km/Ink.)" UWORD s_q1_km 1 100 0 65535 FORMAT "%8.2" ECU_ADDRESS 0x384028 /end MEASUREMENT
/begin MEASUREMENT kmp6km_w "Zurückgelegte Fahrstrecke seit powerfail  (6km/Ink.)" UWORD s_q6_km 1 100 0 393210 FORMAT "%8.1" ECU_ADDRESS 0x38402A /end MEASUREMENT
/begin MEASUREMENT kmstmil_w "Zurückgelegte Fahrstrecke mit MIL on" UWORD s_q1_km 1 100 0 65535 FORMAT "%8.2" ECU_ADDRESS 0x38402C /end MEASUREMENT
/begin MEASUREMENT kmst_w "Zurückgelegte Fahrstrecke seit Powerfail" UWORD s_q6_km 1 100 0 393210 FORMAT "%8.1" ECU_ADDRESS 0x38402E /end MEASUREMENT
/begin MEASUREMENT lbz "Ladebilanz der Batterie" UBYTE rel_ub_b99p6 1 100 0 99.6094 FORMAT "%5.2" ECU_ADDRESS 0x384854 /end MEASUREMENT
/begin MEASUREMENT lrnstat "Statusbyte DV-E-Adaption für Testerkommunikation" UBYTE dez 1 100 0 255 FORMAT "%5.1" ECU_ADDRESS 0x3809D9 /end MEASUREMENT
/begin MEASUREMENT lrnstep_c "Zähler für Lerndauer eines Lernsteps" UBYTE dez 1 100 0 255 FORMAT "%5.1" ECU_ADDRESS 0x3809DA /end MEASUREMENT
/begin MEASUREMENT lrntim_c "Zeitzähler für Wartezeit in den Lernschritten" UBYTE t20msxs_ub_b5p1 1 100 0 5.1 FORMAT "%5.3" ECU_ADDRESS 0x3809DB /end MEASUREMENT
/begin MEASUREMENT lrnvb_c "Lernverbotszähler (Wartezeit)" UWORD t20msxs_uw_q0p02 1 100 0 1310.7 FORMAT "%8.3" ECU_ADDRESS 0x381D0A /end MEASUREMENT
/begin MEASUREMENT milactsfc "Anzahl words im Word-/bit-Array zur Ansteuerung der MIL aus Sonderfunktion" UBYTE dez 1 100 0 255 FORMAT "%5.1" ECU_ADDRESS 0x38481B /end MEASUREMENT
/begin MEASUREMENT milactsf_w "Word-/bit-Array zur Ansteuerung der MIL aus Sonderfunktion" UWORD dez 1 100 0 65535 FORMAT "%8.2" ARRAY_SIZE 12 ECU_ADDRESS 0x3849CC /end MEASUREMENT
/begin MEASUREMENT milstat "" UBYTE dez 1 100 0 255 FORMAT "%5.1" ECU_ADDRESS 0x38481C /end MEASUREMENT
/begin MEASUREMENT milstate_w "" UWORD dez 1 100 0 65535 FORMAT "%8.2" ECU_ADDRESS 0x3849E4 /end MEASUREMENT
/begin MEASUREMENT milstatnov "" UBYTE dez 1 100 0 255 FORMAT "%5.1" ECU_ADDRESS 0x384003 /end MEASUREMENT
/begin MEASUREMENT ml "Luftmassenfluß" UBYTE m_ub_b1020 1 100 0 1020 FORMAT "%5.0" ECU_ADDRESS 0xF9B8 /end MEASUREMENT
/begin MEASUREMENT mlbb "Luftmassenfluß gefiltert (Byte), Bank1 bezogen" UBYTE m_ub_b1020 1 100 0 1020 FORMAT "%5.0" ECU_ADDRESS 0xF92A /end MEASUREMENT
/begin MEASUREMENT mlbb_w "Luftmassenfluß gefiltert (Word), Bank1 bezogen" UWORD m_uw_b6553p5 1 100 0 6553.5 FORMAT "%8.3" ECU_ADDRESS 0xF92C /end MEASUREMENT
/begin MEASUREMENT mleitmx_w "Maximale Regeneriergasmasse in Leitung TEV Saugrohr" UWORD m_q2p71Em5_g 1 100 0 1.77775 FORMAT "%8.6" ECU_ADDRESS 0x382BAC /end MEASUREMENT
/begin MEASUREMENT mleit_w "Aktuelle Regeneriergasmasse in Leitung TEV Saugrohr" UWORD m_q2p71Em5_g 1 100 0 1.77775 FORMAT "%8.6" ECU_ADDRESS 0x382BAE /end MEASUREMENT
/begin MEASUREMENT mlsu "Soll-Luftmasse für Katheizen" UBYTE m_ub_b5p8 1 100 0 5.80267 FORMAT "%5.3" ECU_ADDRESS 0x3848B6 /end MEASUREMENT
/begin MEASUREMENT ml_w "Luftmassenfluß gefiltert (Word)" UWORD m_uw_b6553p5 1 100 0 6553.5 FORMAT "%8.3" ECU_ADDRESS 0xF9BA /end MEASUREMENT
/begin MEASUREMENT mrfabn "aktuelle gewichtete Leistung (für Dauer-Hochlasterkennung)" UBYTE rel_ub_b100 1 100 0 99.6094 FORMAT "%5.2" ECU_ADDRESS 0x38487C /end MEASUREMENT
/begin MEASUREMENT mrfabnf "Tiefpaß-gefilterte gewichtete Leistung - DauerHochlasterkenung" UBYTE rel_ub_b100 1 100 0 99.6094 FORMAT "%5.2" ECU_ADDRESS 0x38487D /end MEASUREMENT
/begin MEASUREMENT msabg "Abgasmassenfluß gefiltert, Bank 1" UBYTE m_ub_b1020 1 100 0 1020 FORMAT "%5.0" ECU_ADDRESS 0xF92B /end MEASUREMENT
/begin MEASUREMENT msabg_w "Abgasmassenstrom gefiltert (Word), Bank 1" UWORD m_uw_b6553p5 1 100 0 6553.5 FORMAT "%8.3" ECU_ADDRESS 0xF92E /end MEASUREMENT
/begin MEASUREMENT msdkalm_w "Massenstrom über Drosselklappe (abgeglichen mit HFM Signal)" UWORD m_uw_b6553p5 1 100 0 6553.5 FORMAT "%8.3" ECU_ADDRESS 0x381E9A /end MEASUREMENT
/begin MEASUREMENT msdkf_w "Massenstrom über Drosselklappe bei Fehler HFM" UWORD m_uw_b6553p5 1 100 0 6553.5 FORMAT "%8.3" ECU_ADDRESS 0x381E9C /end MEASUREMENT
/begin MEASUREMENT msdkue_w "Massenstrom über Drosselklappe überkritisch (word)" UWORD m_uw_b6553p5 1 100 0 6553.5 FORMAT "%8.3" ECU_ADDRESS 0x381E9E /end MEASUREMENT
/begin MEASUREMENT msdk_w "Massenstrom über Drosselklappe (word)" UWORD m_uw_b6553p5 1 100 0 6553.5 FORMAT "%8.3" ECU_ADDRESS 0x381EA0 /end MEASUREMENT
/begin MEASUREMENT msndkoo_w "normierter Massenstrom Drosselklappe ohne offset (word)" UWORD m_uw_b6553p5 1 100 0 6553.5 FORMAT "%8.3" ECU_ADDRESS 0x381EA2 /end MEASUREMENT
/begin MEASUREMENT msndko_w "normierter Leckluftmassenstrom über Drosselklappe (word)" UWORD m_uw_b6553p5 1 100 0 6553.5 FORMAT "%8.3" ECU_ADDRESS 0x383A6A /end MEASUREMENT
/begin MEASUREMENT msndkpk_w "normierter praedizierter korrig. Massenstrom ueber Drosselklappe (word)" UWORD m_uw_b6553p5 1 100 0 6553.5 FORMAT "%8.3" ECU_ADDRESS 0x38204A /end MEASUREMENT
/begin MEASUREMENT msndk_w "normierter Massenstrom über Drosselklappe (word)" UWORD m_uw_b6553p5 1 100 0 6553.5 FORMAT "%8.3" ECU_ADDRESS 0x381EA4 /end MEASUREMENT
/begin MEASUREMENT msnsaug_w "normierter Massenstrom durch Saugrohr (word)" UWORD m_uw_b6553p5 1 100 0 6553.5 FORMAT "%8.3" ECU_ADDRESS 0x381EA6 /end MEASUREMENT
/begin MEASUREMENT msntate_kge "" UWORD rel_uw_b100 1 100 0 99.9985 FORMAT "%8.5" ECU_ADDRESS 0x382BB0 /end MEASUREMENT
/begin MEASUREMENT msntetev_w "normierter, überkritischer Massenstrom durch das TEV" UWORD m_uw_b25p6 1 100 0 25.5996 FORMAT "%8.5" ECU_ADDRESS 0x382BB2 /end MEASUREMENT
/begin MEASUREMENT msntevo_w "normierter, überkritischer Massenstrom durch das 100% offene TEV" UWORD m_uw_b25p6 1 100 0 25.5996 FORMAT "%8.5" ECU_ADDRESS 0x3853B0 /end MEASUREMENT
/begin MEASUREMENT mssaug_w "Massenstrom durch Saugrohr (word)" UWORD m_uw_b6553p5 1 100 0 6553.5 FORMAT "%8.3" ECU_ADDRESS 0x381EA8 /end MEASUREMENT
/begin MEASUREMENT mste "Massenstrom Tankentlüftung ins Saugrohr" UBYTE m_ub_b25p6 1 100 0 25.5 FORMAT "%5.2" ECU_ADDRESS 0xFA26 /end MEASUREMENT
/begin MEASUREMENT mstedte "Massenstrom TEV für DTEV" UBYTE m_ub_b25p6 1 100 0 25.5 FORMAT "%5.2" ECU_ADDRESS 0x380BB0 /end MEASUREMENT
/begin MEASUREMENT mstedte_w "Massenstrom TEV für DTEV (Word)" UWORD m_uw_b25p6 1 100 0 25.5996 FORMAT "%8.5" ECU_ADDRESS 0x382BB4 /end MEASUREMENT
/begin MEASUREMENT msteo_w "Massenstom durch das 100% offene TEV" UWORD m_uw_b25p6 1 100 0 25.5996 FORMAT "%8.5" ECU_ADDRESS 0x382BB6 /end MEASUREMENT
/begin MEASUREMENT mstesg_w "Massenstrom Tankentlüftung ins Saugrohr (Anteil Einleitung auf Unterdruckseite)" UWORD m_uw_b25p6 1 100 0 25.5996 FORMAT "%8.5" ECU_ADDRESS 0x382BB8 /end MEASUREMENT
/begin MEASUREMENT mstetev_w "Massenstrom durch das TEV" UWORD m_uw_b25p6 1 100 0 25.5996 FORMAT "%8.5" ECU_ADDRESS 0x382BBA /end MEASUREMENT
/begin MEASUREMENT mstevl_w "Anteil Massenstrom durch das TEV der Einleitung vor Lader" UWORD m_uw_b25p6 1 100 0 25.5996 FORMAT "%8.5" ECU_ADDRESS 0x382BBC /end MEASUREMENT
/begin MEASUREMENT mste_w "Massenstrom Tankentlüftung in das Saugrohr" UWORD m_uw_b25p6 1 100 0 25.5996 FORMAT "%8.5" ECU_ADDRESS 0x382BBE /end MEASUREMENT
/begin MEASUREMENT nfskh "Leerlaufdrehzahl Fahrstufe bei Katheizen" UBYTE nmot_ub_q10 1 100 0 2550 FORMAT "%5.0" ECU_ADDRESS 0x380A70 /end MEASUREMENT
/begin MEASUREMENT ngas_w "Drehzahlgradient über ein Arbeitsspiel" SWORD nmotg_sw_q0p39 1 100 -12800.2 12799.8 FORMAT "%8.2" ECU_ADDRESS 0x381A38 /end MEASUREMENT
/begin MEASUREMENT ngfil "gefilterter Drehzahlgradient" SBYTE nmotg_sb_q100 1 100 -12800 12700 FORMAT "%5.0" ECU_ADDRESS 0x380965 /end MEASUREMENT
/begin MEASUREMENT ngfil_w "gefilterter Drehzahlgradient" SWORD nmotg_sw_q0p39 1 100 -12800.2 12799.8 FORMAT "%8.2" ECU_ADDRESS 0x381A3A /end MEASUREMENT
/begin MEASUREMENT nllkh "Leerlaufdrehzahl bei Katheizen" UBYTE nmot_ub_q10 1 100 0 2550 FORMAT "%5.0" ECU_ADDRESS 0x380A71 /end MEASUREMENT
/begin MEASUREMENT nlp1tim "Zeitzähler für Wartezeit 1 im NLP-Lernen" UBYTE t10msxs_ub_b2p55 1 100 0 2.55 FORMAT "%5.3" ECU_ADDRESS 0x3809DC /end MEASUREMENT
/begin MEASUREMENT nmot "Motordrehzahl" UBYTE nmot_ub_q40 1 100 0 10200 FORMAT "%5.0" ECU_ADDRESS 0xF8A2 /end MEASUREMENT
/begin MEASUREMENT nmotas_w "Motordrehzahl von 2 Umdrehungen (1 Arbeitsspiel) zuvor" UWORD nmot_uw_q0p25 1 100 0 16383.8 FORMAT "%8.2" ECU_ADDRESS 0x381A3C /end MEASUREMENT
/begin MEASUREMENT nmotkf "nmot mit Hysterese zur Kennfeldadressierung" UBYTE nmot_ub_q40 1 100 0 10200 FORMAT "%5.0" ECU_ADDRESS 0x384925 /end MEASUREMENT
/begin MEASUREMENT nmotll "Motordrehzahl im Leerlaufbereich" UBYTE nmot_ub_q10 1 100 0 2550 FORMAT "%5.0" ECU_ADDRESS 0x380962 /end MEASUREMENT
/begin MEASUREMENT nmotllfil "Gefilterte Drehzahl nmotll" UBYTE nmot_ub_q10 1 100 0 2550 FORMAT "%5.0" ECU_ADDRESS 0x380963 /end MEASUREMENT
/begin MEASUREMENT nmotrsp_w "Beginn Ringspeicher für Drehzahl" UWORD nmot_uw_q0p25 1 100 0 16383.8 FORMAT "%8.2" ARRAY_SIZE 6 ECU_ADDRESS 0xF8A8 /end MEASUREMENT
/begin MEASUREMENT nmot_w "Motordrehzahl" UWORD nmot_uw_q0p25 1 100 0 16383.8 FORMAT "%8.2" ECU_ADDRESS 0xF8A4 /end MEASUREMENT
/begin MEASUREMENT nnwtoelmn "minimale Drehzahlschwelle zur Freigabe der Nockenwellenverstellung" UBYTE nmot_ub_q40 1 100 0 10200 FORMAT "%5.0" ECU_ADDRESS 0x38491C /end MEASUREMENT
/begin MEASUREMENT nsa "Drehzahl Schub" UBYTE nmot_ub_q40 1 100 0 10200 FORMAT "%5.0" ECU_ADDRESS 0x380AF6 /end MEASUREMENT
/begin MEASUREMENT nwe "Wiedereinsetzdrehzahl" UBYTE nmot_ub_q40 1 100 0 10200 FORMAT "%5.0" ECU_ADDRESS 0x380AF7 /end MEASUREMENT
/begin MEASUREMENT nwecvt "Drehzahl Wiedereinsetzen bei CVT-Getriebe" UBYTE nmot_ub_q40 1 100 0 10200 FORMAT "%5.0" ECU_ADDRESS 0x3848E0 /end MEASUREMENT
/begin MEASUREMENT nwema "Drehzahl Wiedereinsetzen" UBYTE nmot_ub_q40 1 100 0 10200 FORMAT "%5.0" ECU_ADDRESS 0x380AF8 /end MEASUREMENT
/begin MEASUREMENT nwenga "Drehzahl Wiedereinsetzen" UBYTE nmot_ub_q40 1 100 0 10200 FORMAT "%5.0" ECU_ADDRESS 0x380AF9 /end MEASUREMENT
/begin MEASUREMENT pbr_w "Berechneter Brennraumdruck" UWORD p_uw_q0p039 1 100 0 2559.96 FORMAT "%8.3" ECU_ADDRESS 0x381E6A /end MEASUREMENT
/begin MEASUREMENT phtevpu_w "Quotient Druck hinter TEV / Umgebungsdruck" UWORD fak_uw_b2 1 100 0 1.99997 FORMAT "%8.6" ECU_ADDRESS 0x382BC0 /end MEASUREMENT
/begin MEASUREMENT pirgro_w "Rohwert Partialdruck Restgas internes AGR" UWORD p_uw_q0p039 1 100 0 2559.96 FORMAT "%8.3" ECU_ADDRESS 0x384AAE /end MEASUREMENT
/begin MEASUREMENT pirg_w "Partialdruck Restgas interne AGR (16-Bit)" UWORD p_uw_q0p039 1 100 0 2559.96 FORMAT "%8.3" ECU_ADDRESS 0x384AB0 /end MEASUREMENT
/begin MEASUREMENT plgruo_w "Grundladedruck Istwert ohne Temperaturkorrektur" UWORD p_uw_q0p039 1 100 0 2559.96 FORMAT "%8.3" ECU_ADDRESS 0x3824D8 /end MEASUREMENT
/begin MEASUREMENT plgruso_w "Grundladedruck Sollwert ohne Temperaturkorrektur" UWORD p_uw_q0p039 1 100 0 2559.96 FORMAT "%8.3" ECU_ADDRESS 0x3824DA /end MEASUREMENT
/begin MEASUREMENT plgrus_w "Grundladedruck Sollwert" UWORD p_uw_q0p039 1 100 0 2559.96 FORMAT "%8.3" ECU_ADDRESS 0x3824DC /end MEASUREMENT
/begin MEASUREMENT plgru_w "Grundladedruck" UWORD p_uw_q0p039 1 100 0 2559.96 FORMAT "%8.3" ECU_ADDRESS 0x3824DE /end MEASUREMENT
/begin MEASUREMENT psfg_w "Frischgaspartialdruck im Saugrohr (word)" UWORD p_uw_q0p039 1 100 0 2559.96 FORMAT "%8.3" ECU_ADDRESS 0x381E6C /end MEASUREMENT
/begin MEASUREMENT psmppvdk_w "praed. ps/Druck vor Drosselklappe (word)" UWORD fak_uw_q0p001 1 100 0 65.535 FORMAT "%8.5" ECU_ADDRESS 0x38204C /end MEASUREMENT
/begin MEASUREMENT psmp_w "extrapolierter Saugrohrdruck (Word)" UWORD p_uw_q0p039 1 100 0 2559.96 FORMAT "%8.3" ECU_ADDRESS 0x38204E /end MEASUREMENT
/begin MEASUREMENT psmx_w "Saugrohrmaximaldruckbegrenzung für modellierten Saugrohrdruck" UWORD p_uw_q0p039 1 100 0 2559.96 FORMAT "%8.3" ECU_ADDRESS 0x381E6E /end MEASUREMENT
/begin MEASUREMENT pspmx_w "max. praedizierter Saugrohrdruck" UWORD p_uw_q0p039 1 100 0 2559.96 FORMAT "%8.3" ECU_ADDRESS 0x382050 /end MEASUREMENT
/begin MEASUREMENT pspvdb_w "Quotient Saugrohrduck/Druck vor DK begrenzt (word)" UWORD fak_uw_b2 1 100 0 1.99997 FORMAT "%8.6" ECU_ADDRESS 0x381EAA /end MEASUREMENT
/begin MEASUREMENT pspvdkf_w "Quotient Saugrohrdruck/Druck vor Drosselklappe (word) bei Fehler HFM o. DK" UWORD fak_uw_b2 1 100 0 1.99997 FORMAT "%8.6" ECU_ADDRESS 0x381EAC /end MEASUREMENT
/begin MEASUREMENT pspvdk_w "Quotient Saugrohrdruck/Druck vor Drosselklappe (word)" UWORD fak_uw_b2 1 100 0 1.99997 FORMAT "%8.6" ECU_ADDRESS 0x381EAE /end MEASUREMENT
/begin MEASUREMENT pspvds_w "Quotient Saugrohrdruck/Druck vor DK" UWORD fak_uw_b2 1 100 0 1.99997 FORMAT "%8.6" ECU_ADDRESS 0x381EB0 /end MEASUREMENT
/begin MEASUREMENT psp_w "praedizierter Saugrohrdruck (Word)" UWORD p_uw_q0p039 1 100 0 2559.96 FORMAT "%8.3" ECU_ADDRESS 0x382052 /end MEASUREMENT
/begin MEASUREMENT psrlro_w "Rohwert für Faktor systembezogene Umrechnung Druck auf Füllung" UWORD rel_uw_b0p3 1 100 0 0.299995 FORMAT "%9.7" ECU_ADDRESS 0x384AB2 /end MEASUREMENT
/begin MEASUREMENT ps_w "Saugrohr-Absolutdruck (Word)" UWORD p_uw_q0p039 1 100 0 2559.96 FORMAT "%8.3" ECU_ADDRESS 0xF9BC /end MEASUREMENT
/begin MEASUREMENT pukBits "" UBYTE dez 1 100 0 255 FORMAT "%5.1" ECU_ADDRESS 0x380BAF /end MEASUREMENT
/begin MEASUREMENT pukorf_w "Umgebungsdruckwerte nach additiver Staudruckkorrektur gefiltert" UWORD p_uw_q0p039 1 100 0 2559.96 FORMAT "%8.3" ECU_ADDRESS 0x3853A8 /end MEASUREMENT
/begin MEASUREMENT pukor_w "Umgebungsdruckwerte nach additiver Staudruckkorrektur" UWORD p_uw_q0p039 1 100 0 2559.96 FORMAT "%8.3" ECU_ADDRESS 0x3853AA /end MEASUREMENT
/begin MEASUREMENT pumean_w "Umgebungsdruckmittelwert der plausiblen Umgebungsdruckwerte (Ausreiserfilter)" UWORD p_uw_q0p039 1 100 0 2559.96 FORMAT "%8.3" ECU_ADDRESS 0x3853AC /end MEASUREMENT
/begin MEASUREMENT pvdk "Druck vor Drosselklappe" UBYTE p_ub_q10 1 100 0 2550 FORMAT "%5.0" ECU_ADDRESS 0x380A20 /end MEASUREMENT
/begin MEASUREMENT pvdk_w "Druck vor Drosselklappe 16-Bit" UWORD p_uw_q0p039 1 100 0 2559.96 FORMAT "%8.3" ECU_ADDRESS 0x381EB2 /end MEASUREMENT
/begin MEASUREMENT pvl_w "Druck vor Lader" UWORD p_uw_q0p039 1 100 0 2559.96 FORMAT "%8.3" ECU_ADDRESS 0x382BC2 /end MEASUREMENT
/begin MEASUREMENT qltefil "Füllungsgrad mit Regeneriergas der leitung TEV-Saugrohr" UBYTE fak_ub_b1 1 100 0 0.996094 ECU_ADDRESS 0x380BB1 /end MEASUREMENT
/begin MEASUREMENT redbas "Basis-Reduzierstufe" UBYTE dez 1 100 0 255 FORMAT "%5.1" ECU_ADDRESS 0x380A51 /end MEASUREMENT
/begin MEASUREMENT redist "Ist-Reduzierstufe" UBYTE dez 1 100 0 255 FORMAT "%5.1" ECU_ADDRESS 0x380A52 /end MEASUREMENT
/begin MEASUREMENT rfagr_w "relative Füllung AGR (word)" UWORD rel_uw_q0p0234 1 100 0 1535.98 FORMAT "%8.3" ECU_ADDRESS 0x381E70 /end MEASUREMENT
/begin MEASUREMENT rfges_w "gesamte relative Füllung (inclusive AGR) 16-Bit" UWORD rel_uw_q0p0234 1 100 0 1535.98 FORMAT "%8.3" ECU_ADDRESS 0x384AB4 /end MEASUREMENT
/begin MEASUREMENT rl "relative Luftfüllung" UBYTE rel_ub_q0p75 1 100 0 191.25 FORMAT "%5.1" ECU_ADDRESS 0xF9B9 /end MEASUREMENT
/begin MEASUREMENT rldkofkb_w "gewichtete relative Luftfüllung aus DK-Signal berechnet ohne Einrechnung fkmsdk" UWORD rel_uw_q0p0234 1 100 0 1535.98 FORMAT "%8.3" ECU_ADDRESS 0x381EB4 /end MEASUREMENT
/begin MEASUREMENT rldkofk_w "relative Luftfüllung aus DK-Signal berechnet ohne Einrechnung von fkmsdk" UWORD rel_uw_q0p0234 1 100 0 1535.98 FORMAT "%8.3" ECU_ADDRESS 0x381EB6 /end MEASUREMENT
/begin MEASUREMENT rldvs_w "relative Luftfüllung durch Drosselventile am Saugrohr 16-Bit" UWORD rel_uw_q0p0234 1 100 0 1535.98 FORMAT "%8.3" ECU_ADDRESS 0x381EB8 /end MEASUREMENT
/begin MEASUREMENT rlfdkrof_w "relative Frischluft über DK bei Fehler HFM" UWORD rel_uw_q0p0234 1 100 0 1535.98 FORMAT "%8.3" ECU_ADDRESS 0x381EBA /end MEASUREMENT
/begin MEASUREMENT rlfdkroh_w "relative Frischluft über Dk vor Saugrohrmodell (ungefiltert) mit DK gemessen" UWORD rel_uw_q0p0234 1 100 0 1535.98 FORMAT "%8.3" ECU_ADDRESS 0x381EBC /end MEASUREMENT
/begin MEASUREMENT rlfgroh_w "relative Frischluft über Drosselklappe vor Saugrohrmodell (ungefiltert)" UWORD rel_uw_q0p0234 1 100 0 1535.98 FORMAT "%8.3" ECU_ADDRESS 0x381EBE /end MEASUREMENT
/begin MEASUREMENT rlflmroh_w "relative Frischluft über Dk vor Saugrohrmodell (ungefiltert) mit HFM gemessen" UWORD rel_uw_q0p0234 1 100 0 1535.98 FORMAT "%8.3" ECU_ADDRESS 0x381EC0 /end MEASUREMENT
/begin MEASUREMENT rlgas_w "Füllungsgradient über ein Arbeitsspiel bestimmt" SWORD relNWU_q0p0234 1 100 -768 767.977 FORMAT "%8.4" ECU_ADDRESS 0x381F36 /end MEASUREMENT
/begin MEASUREMENT rlmax_w "maximal erreichbare Füllung bei Turbo" UWORD rel_uw_q0p0234 1 100 0 1535.98 FORMAT "%8.3" ECU_ADDRESS 0x384ADC /end MEASUREMENT
/begin MEASUREMENT rlmp_w "rel. extrapolierte Luftfuellung (Word)" UWORD rel_uw_q0p0234 1 100 0 1535.98 FORMAT "%8.3" ECU_ADDRESS 0x382054 /end MEASUREMENT
/begin MEASUREMENT rlmxs_w "maximal erreichbare Füllung" UWORD rel_uw_q0p0234 1 100 0 1535.98 FORMAT "%8.3" ECU_ADDRESS 0x384ADE /end MEASUREMENT
/begin MEASUREMENT rlnotn_w "rel.Luftfüllung bei Haupt- und Nebenlastfehler in Abhängigkeit von nmot (word)" UWORD rel_uw_q0p0234 1 100 0 1535.98 FORMAT "%8.3" ECU_ADDRESS 0x381EC2 /end MEASUREMENT
/begin MEASUREMENT rlnwkf "rlnw mit Hysterese für Kennfeldadressierung" UBYTE rel_ub_q0p75 1 100 0 191.25 FORMAT "%5.1" ECU_ADDRESS 0x384926 /end MEASUREMENT
/begin MEASUREMENT rlnwkf_w "rlnw_w mit Hysterese für Kennfeldadressierung" UWORD rel_uw_q0p0234 1 100 0 1535.98 FORMAT "%8.3" ECU_ADDRESS 0x3853CE /end MEASUREMENT
/begin MEASUREMENT rlnw_w "Auswahl zwischen rl und rlsnw" UWORD rel_uw_q0p0234 1 100 0 1535.98 FORMAT "%8.3" ECU_ADDRESS 0x3853CA /end MEASUREMENT
/begin MEASUREMENT rlp "rel. Luftfüllung praediziert für Einspritzberechnung" UBYTE rel_ub_q0p75 1 100 0 191.25 FORMAT "%5.1" ECU_ADDRESS 0x380A39 /end MEASUREMENT
/begin MEASUREMENT rlp_w "rel. Luftfüllung praediziert für Einspritzberechnung (Word)" UWORD rel_uw_q0p0234 1 100 0 1535.98 FORMAT "%8.3" ECU_ADDRESS 0x382056 /end MEASUREMENT
/begin MEASUREMENT rlrohmp_w "rel. Luftfüllung Saugrohrzufluss bei Saugrohrdruck psmp_w (Word)" UWORD rel_uw_q0p0234 1 100 0 1535.98 FORMAT "%8.3" ECU_ADDRESS 0x382058 /end MEASUREMENT
/begin MEASUREMENT rlroh_w "relative Luftfüllung: Rohwert vom Lastsensor (word)" UWORD rel_uw_q0p0234 1 100 0 1535.98 FORMAT "%8.3" ECU_ADDRESS 0x381EC4 /end MEASUREMENT
/begin MEASUREMENT rlrsp_w "Beginn Ringspeicher relative Füllung" UWORD rel_uw_q0p0234 1 100 0 1535.98 FORMAT "%8.3" ARRAY_SIZE 6 ECU_ADDRESS 0x381F38 /end MEASUREMENT
/begin MEASUREMENT rlzuhfs_w "relative Luftfüllung (zufließend) mit Hauptfüllungssensor bestimmt" UWORD rel_uw_q0p0234 1 100 0 1535.98 FORMAT "%8.3" ECU_ADDRESS 0x381EC6 /end MEASUREMENT
/begin MEASUREMENT rlzunfs_w "relative Luftfüllung (zufließend) mit Nebenfüllungssensor bestimmt" UWORD rel_uw_q0p0234 1 100 0 1535.98 FORMAT "%8.3" ECU_ADDRESS 0x381EC8 /end MEASUREMENT
/begin MEASUREMENT rl_w "relative Luftfüllung (Word)" UWORD rel_uw_q0p0234 1 100 0 1535.98 FORMAT "%8.3" ECU_ADDRESS 0xF9BE /end MEASUREMENT
/begin MEASUREMENT rml "relative Luftmasse (calc. load value) nach SAE J1979" UBYTE rel_ub_b99p6 1 100 0 99.6094 FORMAT "%5.2" ECU_ADDRESS 0x38486B /end MEASUREMENT
/begin MEASUREMENT StateActionID "" UBYTE dez 1 100 0 255 FORMAT "%5.1" ECU_ADDRESS 0x38481D /end MEASUREMENT
/begin MEASUREMENT StateID "" UBYTE dez 1 100 0 255 FORMAT "%5.1" ECU_ADDRESS 0x38481E /end MEASUREMENT
/begin MEASUREMENT tabgsant_w "stationäre Brennraumtemperatur durch Restgasanteil" SWORD temp_sw_q0p75 1 100 -24576 24575.3 FORMAT "%8.2" ECU_ADDRESS 0x384AD2 /end MEASUREMENT
/begin MEASUREMENT tabsnl0_w "Abstellzeit aus SG-Nachlauf" UWORD t1sxs_uw_q1 1 100 0 65535 FORMAT "%8.2" ECU_ADDRESS 0x384036 /end MEASUREMENT
/begin MEASUREMENT tabsnl_w "Abstellzeit aus SG-Nachlauf" UWORD t1sxs_uw_b65535 1 100 0 65535 FORMAT "%8.2" ECU_ADDRESS 0x384B52 /end MEASUREMENT
/begin MEASUREMENT tabstm_w "Abstellzeit aus Abkühlung des Motors" UWORD t1sxs_uw_q1 1 100 0 65535 FORMAT "%8.2" ECU_ADDRESS 0x384B54 /end MEASUREMENT
/begin MEASUREMENT tabststp "Zeitzähler für Funktionsabschaltung" UBYTE t50msxs_ub_b12p75 1 100 0 12.75 FORMAT "%5.2" ECU_ADDRESS 0x38488A /end MEASUREMENT
/begin MEASUREMENT tabst_w "Abstellzeit" UWORD t1sxs_uw_q1 1 100 0 65535 FORMAT "%8.2" ECU_ADDRESS 0x384B56 /end MEASUREMENT
/begin MEASUREMENT tabsuhr0_w "Abstellzeit aus Uhrinformation vor Überlaufkorrektur" UWORD t1sxs_uw_q1 1 100 0 65535 FORMAT "%8.2" ECU_ADDRESS 0x3820F8 /end MEASUREMENT
/begin MEASUREMENT tabsuhr_w "Abstellzeit aus Uhrinformation" UWORD t1sxs_uw_q1 1 100 0 65535 FORMAT "%8.2" ECU_ADDRESS 0x384B58 /end MEASUREMENT
/begin MEASUREMENT tanskhst "Ansaugluft - Temperatur bei start" UBYTE temp_ub_q0p75_o48 1 100 -48 143.25 FORMAT "%5.1" ECU_ADDRESS 0x3848B7 /end MEASUREMENT
/begin MEASUREMENT tansnl "Ansaugluft - Temperatur im Nachlauf" UBYTE temp_ub_q0p75_o48 1 100 -48 143.25 FORMAT "%5.1" ECU_ADDRESS 0x3848B8 /end MEASUREMENT
/begin MEASUREMENT tas_w "Zeit über ein Arbeitsspiel für rlgas_w" UWORD t_q16us 1 100 0 1.04856e+006 FORMAT "%8.0" ECU_ADDRESS 0x381F44 /end MEASUREMENT
/begin MEASUREMENT tbrraum_w "gesamte Brennraumtemperatur stationär- und Dynamikanteil" SWORD temp_sw_q0p75 1 100 -24576 24575.3 FORMAT "%8.2" ECU_ADDRESS 0x384AD4 /end MEASUREMENT
/begin MEASUREMENT tcmilas "" UBYTE dez 1 100 0 255 FORMAT "%5.1" ECU_ADDRESS 0x38481F /end MEASUREMENT
/begin MEASUREMENT tcmilrb "" UBYTE dez 1 100 0 255 FORMAT "%5.1" ECU_ADDRESS 0x384820 /end MEASUREMENT
/begin MEASUREMENT tcmilvt "" UBYTE dez 1 100 0 255 FORMAT "%5.1" ECU_ADDRESS 0x384821 /end MEASUREMENT
/begin MEASUREMENT tdknach_w "Zeitzähler im Nachlauf bis stromlose DK in NLP einschwingt" UWORD t10msxs_uw_b655p35 1 100 0 655.35 FORMAT "%8.4" ECU_ADDRESS 0x381D0C /end MEASUREMENT
/begin MEASUREMENT tempin "Temperatur Eingang (Adressierung von FWFTBRTA)" UBYTE temp_ub_q0p75_o48 1 100 -48 143.25 FORMAT "%5.1" ECU_ADDRESS 0x384868 /end MEASUREMENT
/begin MEASUREMENT tengoff0_l "Zeitpunkt des Motorausschaltens" ULONG t1sxs_uw_q1 1 100 0 4.29497e+009 FORMAT "%13.2" ECU_ADDRESS 0x384032 /end MEASUREMENT
/begin MEASUREMENT tengoff_l "Zeitpunkt des Motorausschaltens" ULONG t1sxs_uw_q1 1 100 0 4.29497e+009 FORMAT "%13.2" ECU_ADDRESS 0x384B46 /end MEASUREMENT
/begin MEASUREMENT tengon_l "Zeitpunkt des Motorstarts" ULONG t1sxs_uw_q1 1 100 0 4.29497e+009 FORMAT "%13.2" ECU_ADDRESS 0x384B4A /end MEASUREMENT
/begin MEASUREMENT tephc "Phasenzähler Grundadaption / Tankentlüftung" UWORD t100msxs_uw_b6553p6 1 100 0 6553.5 FORMAT "%8.3" ECU_ADDRESS 0x384B22 /end MEASUREMENT
/begin MEASUREMENT tfrgsant_w "stationäre Brennraumtemperatur durch Frischgasanteil" SWORD temp_sw_q0p75 1 100 -24576 24575.3 FORMAT "%8.2" ECU_ADDRESS 0x384AD6 /end MEASUREMENT
/begin MEASUREMENT tikatmnl "Abgastemperatur im Katalysator aus Modell bei Beginn des Nachlaufs" UBYTE temp_ub_q5_o50 1 100 -50 1225 FORMAT "%5.0" ECU_ADDRESS 0x3848B9 /end MEASUREMENT
/begin MEASUREMENT tkhnab_ctr "" UWORD t100msxs_uw_b6553p5 1 100 0 6553.5 FORMAT "%8.3" ECU_ADDRESS 0x38229E /end MEASUREMENT
/begin MEASUREMENT tloop_w "" UWORD t50msxs_q0p05 1 100 0 3276.75 FORMAT "%8.3" ECU_ADDRESS 0x381D0E /end MEASUREMENT
/begin MEASUREMENT tmischbr_w "stationäre Brennraummischtemperatur" SWORD temp_sw_q0p75 1 100 -24576 24575.3 FORMAT "%8.2" ECU_ADDRESS 0x384AD8 /end MEASUREMENT
/begin MEASUREMENT tmotdif "Differenz aktuelle Motortemperatur zur Motor warm Temperatur" UBYTE temp_ub_q0p75_o48 1 100 -48 143.25 FORMAT "%5.1" ECU_ADDRESS 0x384869 /end MEASUREMENT
/begin MEASUREMENT tmotfil "gefilterte Motortemperatur" UBYTE temp_ub_q0p75_o48 1 100 -48 143.25 FORMAT "%5.1" ECU_ADDRESS 0x384006 /end MEASUREMENT
/begin MEASUREMENT tmotrvmx "Resultierende Motortemperatur für Berechnung Maximalgeschwindigkeit" UBYTE temp_ub_q0p75_o48 1 100 -48 143.25 FORMAT "%5.1" ECU_ADDRESS 0x3848F0 /end MEASUREMENT
/begin MEASUREMENT tmpumast "Status für temporäre UMA-Adaption" UBYTE dez 1 100 0 255 FORMAT "%5.1" ECU_ADDRESS 0x3809DD /end MEASUREMENT
/begin MEASUREMENT tnseuhr_w "Zeitzähler ab Startende aus Uhrinformation" UWORD t100msxs_uw_b6553p5 1 100 0 6553.5 FORMAT "%8.3" ECU_ADDRESS 0x384B5A /end MEASUREMENT
/begin MEASUREMENT tnse_w "Zeitzähler ab Startende (16bit)" UWORD t100msxs_uw_b6553p5 1 100 0 6553.5 FORMAT "%8.3" ECU_ADDRESS 0x385370 /end MEASUREMENT
/begin MEASUREMENT tnst_w "Zeit nach Startende" UWORD t10msxs_uw_b655p35 1 100 0 655.35 FORMAT "%8.4" ECU_ADDRESS 0x382A76 /end MEASUREMENT
/begin MEASUREMENT trsectmp_l "" ULONG t1sxs_uw_q1 1 100 0 4.29497e+009 FORMAT "%13.2" ECU_ADDRESS 0x384B4E /end MEASUREMENT
/begin MEASUREMENT trsec_l "Echtzeit in Sekunden" ULONG t1sxs_uw_q1 1 100 0 4.29497e+009 FORMAT "%13.2" ECU_ADDRESS 0x384B3E /end MEASUREMENT
/begin MEASUREMENT tsas_w "Zeit über ein Arbeitsspiel für ngas_w" UWORD tsquantl 1 100 0 859819 FORMAT "%8.1" ECU_ADDRESS 0x381A3E /end MEASUREMENT
/begin MEASUREMENT tseghi "Winkel-Segmentzeit, high, low byte des high word" UBYTE dez 1 100 0 255 FORMAT "%5.1" ECU_ADDRESS 0xF8A3 /end MEASUREMENT
/begin MEASUREMENT tsegrsp_w "Beginn Ringspeicher für Segmentzeit" UWORD tsquant 1 100 0 53738.7 FORMAT "%8.2" ARRAY_SIZE 6 ECU_ADDRESS 0xF8B4 /end MEASUREMENT
/begin MEASUREMENT tseg_w "Winkel-Segmentzeit" UWORD tsegment_sy 1 100 0 43.69 FORMAT "%8.5" ECU_ADDRESS 0xF8A6 /end MEASUREMENT
/begin MEASUREMENT tsges_w "Saugrohrgesamttemperatur (nach AGR-Einleitung) (word)" SWORD temp_sw_q0p75 1 100 -24576 24575.3 FORMAT "%8.2" ECU_ADDRESS 0x384ADA /end MEASUREMENT
/begin MEASUREMENT ttmumad_w "" UWORD t50msxs_q0p05 1 100 0 3276.75 FORMAT "%8.3" ECU_ADDRESS 0x381D10 /end MEASUREMENT
/begin MEASUREMENT tum "Umgebungstemperatur" UBYTE temp_ub_q0p75_o48 1 100 -48 143.25 FORMAT "%5.1" ECU_ADDRESS 0x384009 /end MEASUREMENT
/begin MEASUREMENT tumg "Umgebungstemperatur" UBYTE temp_ub_q0p75_o48 1 100 -48 143.25 FORMAT "%5.1" ECU_ADDRESS 0x384888 /end MEASUREMENT
/begin MEASUREMENT tumgk_w "Umgebungstemperatur in Kelvin, Ausgabe in Grad C, intern in Kelvin" UWORD temp_q0p0234_o273 1 100 -273.15 1262.83 FORMAT "%8.3" ECU_ADDRESS 0x384B3C /end MEASUREMENT
/begin MEASUREMENT tumtmp "Hilfsgröße Umgebungstemperatur" UBYTE temp_ub_q0p75_o48 1 100 -48 143.25 FORMAT "%5.1" ECU_ADDRESS 0x384889 /end MEASUREMENT
/begin MEASUREMENT tvnwsttm_w "Zeitverzögerung im Start ab der die Nockenwelle angesteuert werden kann" UWORD t10msxs_uw_b655p35 1 100 0 655.35 FORMAT "%8.4" ECU_ADDRESS 0x3853CC /end MEASUREMENT
/begin MEASUREMENT tvsaa "Totzeit Schubabschneiden" UWORD t10msxs_uw_b655p35 1 100 0 655.35 FORMAT "%8.4" ECU_ADDRESS 0x3824E4 /end MEASUREMENT
/begin MEASUREMENT tvsakat "Verzögerungszeit Schubabschneiden bei hohen Drehzahlen und hoher KAT-Temperatur" UWORD t10msxs_uw_b655p35 1 100 0 655.35 FORMAT "%8.4" ECU_ADDRESS 0x3824E6 /end MEASUREMENT
/begin MEASUREMENT tvsans "Totzeit Schubabschneiden im Nachstart" UBYTE t1sxs_ub_b255 1 100 0 255 FORMAT "%5.1" ECU_ADDRESS 0x3848E1 /end MEASUREMENT
/begin MEASUREMENT tzms_w "Zeitdauer ZMS-Resonanz" UWORD t10msxs_uw_b655p35 1 100 0 655.35 FORMAT "%8.4" ECU_ADDRESS 0x3853FC /end MEASUREMENT
/begin MEASUREMENT ubf "gefilterte Batteriespannung für Batteriespannungsregelung" UBYTE spg_ubatt 1 100 0 17.952 FORMAT "%5.2" ECU_ADDRESS 0x384855 /end MEASUREMENT
/begin MEASUREMENT ubsol "Soll-Batteriespannung" UBYTE spg_ubatt 1 100 0 17.952 FORMAT "%5.2" ECU_ADDRESS 0x384856 /end MEASUREMENT
/begin MEASUREMENT ubuanlr "Spannungsschwelle für UMA-Learning in Quantisierung von ubrsq" UBYTE spg_q0p1 1 100 0 25.5 FORMAT "%5.2" ECU_ADDRESS 0x3809DE /end MEASUREMENT
/begin MEASUREMENT udknlp1 "Spannung DK-Poti 1 im NLP" UWORD spg_q1p221_mV 1 100 0 79.9988 FORMAT "%8.5" ECU_ADDRESS 0x381D12 /end MEASUREMENT
/begin MEASUREMENT udknlp1r "Dauer-RAM: Spannung DK-Poti 1 im NLP" UWORD spg_q1p221_mV 1 100 0 79.9988 FORMAT "%8.5" ECU_ADDRESS 0x383A56 /end MEASUREMENT
/begin MEASUREMENT udknlp2 "Spannung DK-Poti 2 im NLP" UWORD spg_q1p221_mV 1 100 0 79.9988 FORMAT "%8.5" ECU_ADDRESS 0x381D14 /end MEASUREMENT
/begin MEASUREMENT udknlp2r "Dauer-RAM: Spannung DK-Poti 2 im NLP" UWORD spg_q1p221_mV 1 100 0 79.9988 FORMAT "%8.5" ECU_ADDRESS 0x383A58 /end MEASUREMENT
/begin MEASUREMENT udkp1a "Spannung Drosselklappen-Poti 1 am (unteren) Anschlag" UBYTE spg_ub_q0p019 1 100 0 4.98047 ECU_ADDRESS 0x3809DF /end MEASUREMENT
/begin MEASUREMENT udkp1aalt "temp. Spannung DK-Poti 1 am unteren DK-Anschlag" UWORD spg_q1p221_mV 1 100 0 79.9988 FORMAT "%8.5" ECU_ADDRESS 0x381D16 /end MEASUREMENT
/begin MEASUREMENT udkp1asr_w "Dauer-RAM: Spannung DK-Poti 1 am unteren DK-Anschlag, stationärer Anteil" UWORD spg_q1p221_mV 1 100 0 79.9988 FORMAT "%8.5" ECU_ADDRESS 0x383A5A /end MEASUREMENT
/begin MEASUREMENT udkp1as_w "Spannung DK-Poti 1 am unteren Anschlag, stationärer Anteil" UWORD spg_q1p221_mV 1 100 0 79.9988 FORMAT "%8.5" ECU_ADDRESS 0x381D18 /end MEASUREMENT
/begin MEASUREMENT udkp1a_w "Spannung DK-Poti 1 am unteren Anschlag" UWORD spg_q1p221_mV 1 100 0 79.9988 FORMAT "%8.5" ECU_ADDRESS 0x381D1A /end MEASUREMENT
/begin MEASUREMENT udkp1rob "realer DK-Poti-1-Wert am ob. Abgleichpkt." UWORD spg_uw_q0p00488 1 100 0 319.995 FORMAT "%8.4" ECU_ADDRESS 0x381D1C /end MEASUREMENT
/begin MEASUREMENT udkp1run "realer DK-Poti-1-Wert am unt. Abgleichpkt." UWORD spg_uw_q0p00488 1 100 0 319.995 FORMAT "%8.4" ECU_ADDRESS 0x381D1E /end MEASUREMENT
/begin MEASUREMENT udkp1sv "Maximalwert DK-Poti 1 für Verwendung des verstärkten Signals" UBYTE spg_ub_q0p019 1 100 0 4.98047 ECU_ADDRESS 0x3809E0 /end MEASUREMENT
/begin MEASUREMENT udkp1vor "Dauer-RAM: Spannungsoffset bei DK-Poti-1-Verstärkung" SWORD spg_sw_q0p001222 1 100 -40.0425 40.0413 FORMAT "%8.5" ECU_ADDRESS 0x383A5C /end MEASUREMENT
/begin MEASUREMENT udkp1vou "Diagnose: 8 Bit Kopie von udkp1vo_w als Umweltgröße" SBYTE spg_q0p00977 1 100 -1.25 1.24023 FORMAT "%5.3" ECU_ADDRESS 0x384858 /end MEASUREMENT
/begin MEASUREMENT udkp1vo_w "Spannungsoffset Verstärker DK-Poti 1" SWORD spg_sw_q0p001222 1 100 -40.0425 40.0413 FORMAT "%8.5" ECU_ADDRESS 0x381D20 /end MEASUREMENT
/begin MEASUREMENT udkp1vrob "realer verstärkter DK-Poti-1-Wert am ob. Abgleichpkt." UWORD spg_uw_q0p00488 1 100 0 319.995 FORMAT "%8.4" ECU_ADDRESS 0x381D22 /end MEASUREMENT
/begin MEASUREMENT udkp1vrun "realer verstärkter DK-Poti-1-Wert am unt. Abgleichpkt." UWORD spg_uw_q0p00488 1 100 0 319.995 FORMAT "%8.4" ECU_ADDRESS 0x381D24 /end MEASUREMENT
/begin MEASUREMENT udkp1vv "Diagnose: 8 Bit Kopie von udkp1vv_w als Umweltgröße" UBYTE spg_q0p03125 1 100 0 7.96875 FORMAT "%5.3" ECU_ADDRESS 0x384859 /end MEASUREMENT
/begin MEASUREMENT udkp1vvr "Dauer-RAM: Verstärkung bei DK-Poti-1-Verstärkung" UWORD fak_q0p0039 1 100 0 255.996 FORMAT "%8.4" ECU_ADDRESS 0x383A5E /end MEASUREMENT
/begin MEASUREMENT udkp1vv_w "Verstärkung DK-Poti 1" UWORD fak_q0p0039 1 100 0 255.996 FORMAT "%8.4" ECU_ADDRESS 0x381D26 /end MEASUREMENT
/begin MEASUREMENT udkp2a "Spannung Drosselklappen-Poti 2 am (unteren) Anschlag" UBYTE spg_ub_q0p019 1 100 0 4.98047 ECU_ADDRESS 0x3809E1 /end MEASUREMENT
/begin MEASUREMENT udkp2aalt "temp. Spannung DK-Poti 2 am unteren DK-Anschlag" UWORD spg_q1p221_mV 1 100 0 79.9988 FORMAT "%8.5" ECU_ADDRESS 0x381D28 /end MEASUREMENT
/begin MEASUREMENT udkp2asr_w "Dauer-RAM: Spannung DK-Poti 2 am unteren DK-Anschlag, stationärer Anteil" UWORD spg_q1p221_mV 1 100 0 79.9988 FORMAT "%8.5" ECU_ADDRESS 0x383A60 /end MEASUREMENT
/begin MEASUREMENT udkp2as_w "Spannung DK-Poti 2 am unteren Anschlag, stationärer Anteil" UWORD spg_q1p221_mV 1 100 0 79.9988 FORMAT "%8.5" ECU_ADDRESS 0x383A62 /end MEASUREMENT
/begin MEASUREMENT udkp2a_w "Spannung DK-Poti 2 am unteren Anschlag" UWORD spg_q1p221_mV 1 100 0 79.9988 FORMAT "%8.5" ECU_ADDRESS 0x381D2A /end MEASUREMENT
/begin MEASUREMENT udkpat_w "temporärer UEA-Offset des DK-Poti" UWORD spg_q1p221_mV 1 100 0 79.9988 FORMAT "%8.5" ECU_ADDRESS 0x381D2C /end MEASUREMENT
/begin MEASUREMENT uhrdev "Abweichung Zeit nach Start aus Uhrinformation" UBYTE fak_ub_b2 1 100 0 1.99219 FORMAT "%5.3" ECU_ADDRESS 0x38488B /end MEASUREMENT
/begin MEASUREMENT umsrln_w "Umrechnungsfaktor Füllung in Massenstrom" UWORD m_uw_q0p0005 1 100 0 32.7675 FORMAT "%8.5" ECU_ADDRESS 0x381ECA /end MEASUREMENT
/begin MEASUREMENT verhmsb_w "durch Anz. der Zylinder bestimmter Aufteilungsfaktor der Massenströme für Bank 1" UWORD fak_uw_b2 1 100 0 1.99997 FORMAT "%8.6" ECU_ADDRESS 0xF930 /end MEASUREMENT
/begin MEASUREMENT vmaxtm_w "Maximalgeschwindigkeit aus Motortemperatur" UWORD vfzg_uw_q0p00781 1 100 0 511.992 FORMAT "%8.4" ECU_ADDRESS 0x384C72 /end MEASUREMENT
/begin MEASUREMENT vmaxtol_w "Maximalgeschwindigkeit aus Öltemperatur" UWORD vfzg_uw_q0p00781 1 100 0 511.992 FORMAT "%8.4" ECU_ADDRESS 0x384C74 /end MEASUREMENT
/begin MEASUREMENT vmax_w "Maximalgeschwindigkeit für VMAX-Regelung" UWORD vfzg_uw_q0p00781 1 100 0 511.992 FORMAT "%8.4" ECU_ADDRESS 0x384C76 /end MEASUREMENT
/begin MEASUREMENT vplspu "Druckverhältnis Solladedruck zu Umgebungsdruck (8 Bit)" UBYTE fak_ub_b4 1 100 0 3.98438 FORMAT "%5.3" ECU_ADDRESS 0x380AEE /end MEASUREMENT
/begin MEASUREMENT vplspu_w "Druckverhältnis Solladedruck zu Umgebungsdruck" UWORD fak_uw_b4 1 100 0 3.99994 FORMAT "%8.6" ECU_ADDRESS 0x38244C /end MEASUREMENT
/begin MEASUREMENT vregdia_w "Volumenstrom Tankentlüftungsventil: Wert für Diagnose Tankdichtheit" UWORD vs_uw_b25p6 1 100 0 25.5996 FORMAT "%8.5" ECU_ADDRESS 0x382BC4 /end MEASUREMENT
/begin MEASUREMENT vwkw "KW-Winkelgeschwindigkeit" UBYTE rel_ub_q0p1875 1 100 0 47.8125 FORMAT "%5.2" ECU_ADDRESS 0x380A3A /end MEASUREMENT
/begin MEASUREMENT wdkada_w "Sollwert DK-Winkel, aus DV-E Adaption- und Prüffunktion" UWORD relDK_uw_b100 1 100 0 100 FORMAT "%8.4" ECU_ADDRESS 0x381D2E /end MEASUREMENT
/begin MEASUREMENT wdkbab_w "wdkba_w begrenzt (Minimalauswahl zwischen wdkba_w und wdkugd_w)" UWORD rel_uw_b100 1 100 0 99.9985 FORMAT "%8.5" ECU_ADDRESS 0x381ECC /end MEASUREMENT
/begin MEASUREMENT wdkbapb_w "fuer Einspritzung praediz. begr. Drosselklappenwinkel (Word)" UWORD rel_uw_b100 1 100 0 99.9985 FORMAT "%8.5" ECU_ADDRESS 0x38205A /end MEASUREMENT
/begin MEASUREMENT wdkbap_w "fuer Einspritzung praedizierter Drosselklappenwinkel (Word)" UWORD rel_uw_b100 1 100 0 99.9985 FORMAT "%8.5" ECU_ADDRESS 0x3820A6 /end MEASUREMENT
/begin MEASUREMENT wdknlp "Diagnose: 8 Bit Kopie von wdknlp_w als Umweltgröße" UBYTE relDK_q0p3922 1 100 0 100 FORMAT "%5.1" ECU_ADDRESS 0x38485A /end MEASUREMENT
/begin MEASUREMENT wdknlpr "Diagnose: 8 Bit Kopie von wdknlpr_w als Umweltgröße" UBYTE relDK_q0p3922 1 100 0 100 FORMAT "%5.1" ECU_ADDRESS 0x38485B /end MEASUREMENT
/begin MEASUREMENT wdknlpr_w "Dauer-RAM: Sollwert DK-Winkel in NLP-Stellung, bez. auf UMA" UWORD relDK_uw_b100 1 100 0 100 FORMAT "%8.4" ECU_ADDRESS 0x383A64 /end MEASUREMENT
/begin MEASUREMENT wdknlp_w "DK-Winkel der Notluftposition" UWORD relDK_uw_b100 1 100 0 100 FORMAT "%8.4" ECU_ADDRESS 0x381D30 /end MEASUREMENT
/begin MEASUREMENT wdkugd_w "Drosselklappenwinkel, bei dem 95% Füllung erreicht wird" UWORD rel_uw_b100 1 100 0 99.9985 FORMAT "%8.5" ECU_ADDRESS 0x381ECE /end MEASUREMENT
/begin MEASUREMENT wdkvabob "DK-Sollwert für oberen Abgleichpunkt" UWORD relDK_uw_b100 1 100 0 100 FORMAT "%8.4" ECU_ADDRESS 0x381D32 /end MEASUREMENT
/begin MEASUREMENT wdkvabub "DK-Sollwert für unteren Abgleichpunkt" UWORD relDK_uw_b100 1 100 0 100 FORMAT "%8.4" ECU_ADDRESS 0x381D34 /end MEASUREMENT
/begin MEASUREMENT wnwsrm_w "Auswahl zwischen wnwue und wnwisa zur Adressierung der KF für pirg und fupsrl" UWORD kw_q0p0019 1 100 0 127.998 FORMAT "%8.4" ECU_ADDRESS 0x384AB6 /end MEASUREMENT
/begin MEASUREMENT wpfgr_w "Rückgerechneter Pedalwert bei FGR-Betrieb" UWORD rel_uw_b100 1 100 0 99.9985 FORMAT "%8.5" ECU_ADDRESS 0x384A9E /end MEASUREMENT
/begin MEASUREMENT wpr "Einspritzberechnungs-Praediktions-Winkel" UBYTE zw_ub_q6 1 100 0 1530 FORMAT "%5.0" ECU_ADDRESS 0x380A3B /end MEASUREMENT
/begin MEASUREMENT wprnsp "Einspritzberechnungs-Praediktions-Winkel bei Nachspritzer" UBYTE zw_ub_q6 1 100 0 1530 FORMAT "%5.0" ECU_ADDRESS 0x380A3C /end MEASUREMENT
/begin MEASUREMENT xqtm_w "Temperaturquotient" UWORD fak_uw_b16 1 100 0 15.9998 FORMAT "%8.5" ECU_ADDRESS 0x384B5C /end MEASUREMENT
/begin FUNCTION BBKHZ "18.220    Betriebsbereich motorisches Katheizen"
 /begin DEF_CHARACTERISTIC BTRKHTMS CWKHZ DTKATMN DTKH DTMABKH FHOKH FKHABMN_0_A FKHABMN_1_A FKHLA_0_A FKHLA_1_A FKHMD_0_A FKHMD_1_A FNSKHLL FTMLAKH IMLATMMXI IMLATMNLMN IMLATMNLMX IMLATWS IMLKHMX IMLKHTMS KFNFSKHM KFNLLKHM KFWNWWKA KFWNWWKE_0_A KFWNWWKE_1_A KIMLATMNL KTNDMRKH MLKHMX MLSUS_0_A MLSUS_1_A NLLAD NLLKT TABSTKH TKATMN TKATW TKHABB TKHFSAB TKHLL_0_A TKHLL_1_A TKHLLAB TKHLLMX_0_A TKHLLMX_1_A TKHMX_0_A TKHMX_1_A TKHNAB TMSLOF TNSDMRKH ZKHABB ZKLAMKH /end DEF_CHARACTERISTIC
 /begin REF_CHARACTERISTIC /end REF_CHARACTERISTIC
 /begin IN_MEASUREMENT B_bkvleer B_dsl4 B_dsla B_fa B_fasla B_fs B_hag B_katfz B_ll B_lmsslof B_msloff B_nachl B_nachlstp B_nmot B_pwf B_slkhof B_slpoff B_slsfz B_st B_stend B_wst fho_w frhol_w imlatm_w ml tabst_w tans tikatm tkatm tmot tmotab tmst tnst_w /end IN_MEASUREMENT
 /begin OUT_MEASUREMENT BBKHZausbits B_kh B_kha B_khab B_khn B_khno B_khoab B_kw B_trkh dtkaannl fhost_w fkhab fkhnab flakh flamkh fmdkh fnwkha fnwkhe frhokor_w imlatmnl_w imlatmw_w imlpr imlpr_w nfskh nllkh tansnl tikatmnl /end OUT_MEASUREMENT
 /begin LOC_MEASUREMENT BBKHZlokBits B_imlprini B_khares B_khaset B_kherr B_khll B_khlle B_khllmx B_khres B_khset B_khstc B_mlsu fmdkhtns_w mlsu tanskhst tkhnab_ctr /end LOC_MEASUREMENT
 /begin SUB_FUNCTION /end SUB_FUNCTION
/end FUNCTION
/begin FUNCTION BBLDR "Betriebsbedingungen LDR" /begin DEF_CHARACTERISTIC /end DEF_CHARACTERISTIC /begin REF_CHARACTERISTIC /end REF_CHARACTERISTIC
 /begin IN_MEASUREMENT B_dknolu B_dkpu B_ldra B_ll B_mdarv B_stend flgtiab plsol_w pu_w /end IN_MEASUREMENT
 /begin OUT_MEASUREMENT B_ldb B_ldr B_ldrbu B_lds vplspu vplspu_w /end OUT_MEASUREMENT
 /begin LOC_MEASUREMENT B_bldrff B_bldsff B_blduff /end LOC_MEASUREMENT
 /begin SUB_FUNCTION /end SUB_FUNCTION
/end FUNCTION
/begin FUNCTION BBNWS "4.80      Betriebsbedingungen zur Freigabe der NWS"
 /begin DEF_CHARACTERISTIC CWNWGE CWNWSA CWNWSE CWNWSG DNLLSNW NMNWSTMN NNWMX NNWTMN TANW THYNWMN TMNWKH TMNWMN TMNWMX TMNWST TOELNWEMN TOELNWEMX TOELNWMN TOELNWMX TVNWGE TVNWSTNMTM TVNWSTTM /end DEF_CHARACTERISTIC
 /begin REF_CHARACTERISTIC CWMDAPP /end REF_CHARACTERISTIC
 /begin IN_MEASUREMENT B_dknolu B_dkpu B_fanwsa B_fanwse B_gsch B_nldg B_nmin B_nwkv B_phade B_pwofnwe fnwkha fnwkhe nmot nsol rlshk_w rlsol_w rl_w tans tmot tnst_w toelk_w /end IN_MEASUREMENT
 /begin OUT_MEASUREMENT B_dnwfozea B_dnwfozee B_genws B_nnwmx B_nwdfonws B_nwkwaosw B_nws B_nwsapkfa B_nwsapkfe B_nwsappa B_nwsappe B_nwsguda B_nwsgude B_nwsinva B_nwsinve B_nwskflla B_nwskflle B_nwskha B_nwskhe B_nwssprga B_nwssprge B_nwsst B_nwssta B_nwsste B_nwurledk B_nwvfa B_nwvfe B_nwvfg B_wnwsmxfa B_wnwsmxfe rlnw_w /end OUT_MEASUREMENT
 /begin LOC_MEASUREMENT B_khnwt B_khnwte B_nwmd B_nwnmot B_nwsoada B_nwsoedk B_nwsrl B_nwsstend B_nwstvakt B_nwta B_nwte nnwtoelmn tvnwsttm_w /end LOC_MEASUREMENT
 /begin SUB_FUNCTION /end SUB_FUNCTION
/end FUNCTION
/begin FUNCTION BBSAWE "18.150    Betriebsbereich Schubabschalten/Wiedereinsetzen"
 /begin DEF_CHARACTERISTIC CWSAWE DNSAH DNSAL DNSATIP DNSLL DNVSA DNWEK DVSA ENSAKHG KFNWEGM KFTVSA KFTVSAKAT NGDNSA NSAFAN NWECVTM NWENG NWENGFS TAVHKSAO TAVVKSAO TKATSA TKIHKSAO TVSABTE TVSAG0 TVSATM VSAA /end DEF_CHARACTERISTIC
 /begin REF_CHARACTERISTIC SGA08MDUB SNM08__UB STK04SAUB STM05SAUB /end REF_CHARACTERISTIC
 /begin IN_MEASUREMENT B_cvt B_dash B_dsls B_fan B_fs B_kh B_koe B_kuppl B_ll B_sacvt B_savfgr B_savmd B_savmsr B_stend B_te B_tippg B_vllr esst_sga08mdub esst_snm08__ub esst_stk04saub esst_stm05saub gangi ngfil nmot tavhkm_w tavvkm_w tkatm tkihkm_w tmot tmst vfzg /end IN_MEASUREMENT
 /begin OUT_MEASUREMENT B_sab B_sabfg B_sabte tvsans /end OUT_MEASUREMENT
 /begin LOC_MEASUREMENT BBSAWElokbits B_dnsll B_sabt B_sabv B_saen B_tatmsa dnsa nsa nwe nwecvt nwema nwenga tvsaa tvsakat /end LOC_MEASUREMENT
 /begin SUB_FUNCTION /end SUB_FUNCTION
/end FUNCTION
/begin FUNCTION BBSTT "11.20     Betriebsbereich: Start" /begin DEF_CHARACTERISTIC NNSTA NSTNM /end DEF_CHARACTERISTIC /begin REF_CHARACTERISTIC /end REF_CHARACTERISTIC /begin IN_MEASUREMENT B_nmot nmot tans tmot /end IN_MEASUREMENT /begin OUT_MEASUREMENT B_st B_stend tnse_w tnst_w /end OUT_MEASUREMENT /begin LOC_MEASUREMENT /end LOC_MEASUREMENT /begin SUB_FUNCTION /end SUB_FUNCTION /end FUNCTION
/begin FUNCTION BBTEGA "3.110     Phasensteuerung für Tankentlüftung und Gemischadaption"
 /begin DEF_CHARACTERISTIC DFTEDS DMRFATE FMRFAZTE FTEADZU FTEDS MRFABNTE TATELL TMSKLH TMSNOGA TTE TTEAE TTEBSTP TTEGA TTEGAI TTEGAIH TTEGAZO TTEGAZU TTEINI TTEMN TTEPRIO TTEZAO TTEZAU ZMRFABN /end DEF_CHARACTERISTIC
 /begin REF_CHARACTERISTIC /end REF_CHARACTERISTIC
 /begin IN_MEASUREMENT B_dktb B_dldpte B_dmmtev B_dmtltz B_dtes B_edkvs B_frao B_gae B_gaefra B_gasp B_grdst B_ll B_lr B_nmot B_te B_teabb B_tehbx B_teza ftead_w mrfa_w nmot tans tmst tnse_w /end IN_MEASUREMENT
 /begin OUT_MEASUREMENT B_fraoan B_gap B_tep /end OUT_MEASUREMENT
 /begin LOC_MEASUREMENT B_tedtev B_tehbxf B_tepi B_tepzhl B_tepzus B_tesstp B_testop B_tezstp B_tteae B_ttegais dmrfabn_w mrfabn mrfabnf tephc /end LOC_MEASUREMENT
 /begin SUB_FUNCTION /end SUB_FUNCTION
/end FUNCTION
/begin FUNCTION BBZMS "1.40      Betriebsbereich ZMS-Schutz" /begin DEF_CHARACTERISTIC NZMSE NZMSMN NZMSMX TVZMSE TZMSAS TZMSST /end DEF_CHARACTERISTIC /begin REF_CHARACTERISTIC /end REF_CHARACTERISTIC /begin IN_MEASUREMENT B_stend nmot_w /end IN_MEASUREMENT /begin OUT_MEASUREMENT B_utzms B_zms B_zmse B_zmsoff /end OUT_MEASUREMENT /begin LOC_MEASUREMENT tzms_w /end LOC_MEASUREMENT /begin SUB_FUNCTION /end SUB_FUNCTION /end FUNCTION
/begin FUNCTION BGARNW "2.20      Berechnete Größe Anforderung Nockenwellenadaption"
 /begin DEF_CHARACTERISTIC DWNWADRPE HYNMOTNW HYRLNW KFNWADE MXFLAD TMWAFMN TNWADAMX TNWADAMXA TVNW_S TWAFMN TWAFMX /end DEF_CHARACTERISTIC
 /begin REF_CHARACTERISTIC WNWREO /end REF_CHARACTERISTIC
 /begin IN_MEASUREMENT B_enwsve B_nwkwaosw B_phade B_stend B_wnws0e nmot rlnw_w tmot wnwe_w /end IN_MEASUREMENT
 /begin OUT_MEASUREMENT BGARNWausbits B_nwflade B_nwrpose /end OUT_MEASUREMENT
 /begin LOC_MEASUREMENT BGARNWlokbits B_fphad B_nwadae B_nwpnrpe ctr_phade nmotkf rlnwkf rlnwkf_w /end LOC_MEASUREMENT
 /begin SUB_FUNCTION /end SUB_FUNCTION
/end FUNCTION
/begin FUNCTION BGBN "1.10      Berechnete Größe Bordnetzversorgung" /begin DEF_CHARACTERISTIC /end DEF_CHARACTERISTIC /begin REF_CHARACTERISTIC /end REF_CHARACTERISTIC /begin IN_MEASUREMENT B_airbag /end IN_MEASUREMENT /begin OUT_MEASUREMENT BGBNausbits0 B_bvhfm B_bvhls /end OUT_MEASUREMENT /begin LOC_MEASUREMENT /end LOC_MEASUREMENT /begin SUB_FUNCTION /end SUB_FUNCTION /end FUNCTION
/begin FUNCTION BGCVN "6.10      Berechnete Größe Calibration Verification Number CVN" /begin DEF_CHARACTERISTIC /end DEF_CHARACTERISTIC /begin REF_CHARACTERISTIC /end REF_CHARACTERISTIC /begin IN_MEASUREMENT B_m9cvn B_m9cvnclr /end IN_MEASUREMENT /begin OUT_MEASUREMENT bgcvn_bits B_cksbrdy cvnh_w cvnl_w /end OUT_MEASUREMENT /begin LOC_MEASUREMENT /end LOC_MEASUREMENT /begin SUB_FUNCTION /end SUB_FUNCTION /end FUNCTION
/begin FUNCTION BGDVE "3.110     Größen für DV-E-Ansteuerung aus Lern- und Prüfroutinen"
 /begin DEF_CHARACTERISTIC CWDVEFO DKPSTGMIN DLRPIDSTMN DUDKNLPO DUDKNLPU DUDKPTMP FPRAT FPRMT FPRNMAX FPRTIM1_T FPRTIM2_T FPRTIM3_T FPRTIM4_T LRNST1_T LRNST3_T LRNST7_T LRNST9_T LRNVB_T NLPST1T NLPST2T TDKNACH TDLRPIDMX TMSUTMUMA TTMUMASTA UANAUFRP UANNMAX UANPEDMAX UANPIDMIN UANPIDMINA UANUATS UANVFZG UANZURP UAN_O_MT UAN_STORE UAN_U_MT UB_UANL UDKNLP1N UDKNLP2N UDKP1AMAX UDKP1AMIN UDKP1AURI UDKP1DUS UDKP1NHUB UDKP1VID UDKP1VOMA UDKP1VOMI UDKP1VOSC UDKP1VUSC UDKP1VVMA UDKP1VVMI UDKP2AMAX UDKP2AMIN UDKP2AURI UDKPALOS UDKPAOFF UDKPATMX UPVGNENN WDKFPRO1 WDKFPRO2 WDKFPRZ1 WDKFPRZ2 WDKNLPMA WDKNLPMI WDKNSTORE WDKSFPR WDKSFPRO WDKSTMUMA /end DEF_CHARACTERISTIC
 /begin REF_CHARACTERISTIC DUDKP1HY /end REF_CHARACTERISTIC
 /begin IN_MEASUREMENT B_dcdisfr B_dknolu B_dknot B_dkp1e B_dkp2e B_dkpiu B_dlrspid B_dvete B_i_ska_um B_lrndia B_pwf B_stend B_ubdve B_wdk2sel dlrspid_w nmotll tans tmot ub ubrsq udkp1v_w udkp1_w udkp2_w vfzg wdkba_w wdks_w wped /end IN_MEASUREMENT
 /begin OUT_MEASUREMENT B_dcdisr B_dkaden B_dlrien B_dveada B_dvetv B_fprovb B_fprzab B_fprzok B_fprzvb B_lrnakt B_lrnfg B_umauab dkpstg_w dlrmxt tloop_w tmpumast ttmumad_w udkp1a udkp1asr_w udkp1as_w udkp1a_w udkp1sv udkp1vou udkp1vo_w udkp1vv udkp1vv_w udkp2a udkp2asr_w udkp2as_w udkp2a_w udkpat_w wdkada_w wdknlp wdknlpr wdknlp_w /end OUT_MEASUREMENT
 /begin LOC_MEASUREMENT BGDVEintbits B_abgle B_dknach B_fprakt B_fproab B_fproe B_fprook B_fprordy B_fprrdy B_fprze B_lrnerf B_lrnrdy B_lrntesa B_lrnvb B_lrnws B_nlpe B_nlperf B_nlpnew B_nlpreq B_umae dveadchst fprstep_c fprtim_c lrnstat lrnstep_c lrntim_c lrnvb_c nlp1tim tdknach_w ubuanlr udknlp1 udknlp1r udknlp2 udknlp2r udkp1aalt udkp1rob udkp1run udkp1vor udkp1vrob udkp1vrun udkp1vvr udkp2aalt wdknlpr_w wdkvabob wdkvabub /end LOC_MEASUREMENT
 /begin SUB_FUNCTION /end SUB_FUNCTION
/end FUNCTION
/begin FUNCTION BGEVAB "1.40      Berechnung der tatsächlichen Reduzierstufe durch EV-Abschaltung" /begin DEF_CHARACTERISTIC /end DEF_CHARACTERISTIC /begin REF_CHARACTERISTIC /end REF_CHARACTERISTIC
 /begin IN_MEASUREMENT abmf B_faevz devoff eevx evz_austot flgtiab redsol stateaevab zzbank /end IN_MEASUREMENT
 /begin OUT_MEASUREMENT B_bevab B_evakt B_evloc redbas redist /end OUT_MEASUREMENT
 /begin LOC_MEASUREMENT /end LOC_MEASUREMENT
 /begin SUB_FUNCTION /end SUB_FUNCTION
/end FUNCTION
/begin FUNCTION BGGNSOL "1.30      Berechnete Größe Getriebesolldrehzahlbeeinflussung" /begin DEF_CHARACTERISTIC DFGNSOL KFGNSOL /end DEF_CHARACTERISTIC /begin REF_CHARACTERISTIC /end REF_CHARACTERISTIC /begin IN_MEASUREMENT B_kh imlatmw_w tmst tnst_w /end IN_MEASUREMENT /begin OUT_MEASUREMENT fgnsol /end OUT_MEASUREMENT /begin LOC_MEASUREMENT /end LOC_MEASUREMENT /begin SUB_FUNCTION /end SUB_FUNCTION /end FUNCTION
/begin FUNCTION BGKMST "2.30      Berechnete Größe: Kilometerstand" /begin DEF_CHARACTERISTIC /end DEF_CHARACTERISTIC /begin REF_CHARACTERISTIC /end REF_CHARACTERISTIC /begin IN_MEASUREMENT B_kmmil fcmEnd FCMTab vfzg_u /end IN_MEASUREMENT /begin OUT_MEASUREMENT kmdp1km_w kmp6km_w kmstmil_w kmst_w /end OUT_MEASUREMENT /begin LOC_MEASUREMENT /end LOC_MEASUREMENT /begin SUB_FUNCTION /end SUB_FUNCTION /end FUNCTION
/begin FUNCTION BGLBZ "6.20      Berechnete Größe Ladebilanz der Batterie" /begin DEF_CHARACTERISTIC DUBLBZ NRUBMX TVLBZ UBSOLMN UBSOLMX ZKFUB ZKLBZ /end DEF_CHARACTERISTIC /begin REF_CHARACTERISTIC /end REF_CHARACTERISTIC /begin IN_MEASUREMENT B_stend nmotll ub /end IN_MEASUREMENT /begin OUT_MEASUREMENT lbz /end OUT_MEASUREMENT /begin LOC_MEASUREMENT dub ubf ubsol /end LOC_MEASUREMENT /begin SUB_FUNCTION /end SUB_FUNCTION /end FUNCTION
/begin FUNCTION BGMIL "2.40      Berechnete Grösse; Ansteuerung MIL ( Malfunction Indication Lamp)" /begin DEF_CHARACTERISTIC CWBGMIL TMILAS TMILRB TMILVT /end DEF_CHARACTERISTIC /begin REF_CHARACTERISTIC /end REF_CHARACTERISTIC
 /begin IN_MEASUREMENT B_blkfb B_blkmd B_milfb B_milmd B_milsfr B_nmot B_stend dfpmEpclState dfpmMilState milactsfc milactsf_w ready /end IN_MEASUREMENT
 /begin OUT_MEASUREMENT B_blkeb B_epcl B_kmmil B_mil B_milact B_milas B_milblk B_milclr B_mileb B_milfd B_milfon B_milkm B_milrb B_milsf B_milsfint B_milstat B_milste B_milvt B_nomil milstat milstate_w milstatnov StateActionID StateID tcmilas tcmilrb tcmilvt /end OUT_MEASUREMENT
 /begin LOC_MEASUREMENT /end LOC_MEASUREMENT
 /begin SUB_FUNCTION /end SUB_FUNCTION
/end FUNCTION
/begin FUNCTION BGMILSF "1.10      Berechnete Grösse; Malfunction Indication Lamp (MIL) Sonderfunktion" /begin DEF_CHARACTERISTIC /end DEF_CHARACTERISTIC /begin REF_CHARACTERISTIC /end REF_CHARACTERISTIC /begin IN_MEASUREMENT /end IN_MEASUREMENT /begin OUT_MEASUREMENT B_milsfr milactsfc milactsf_w /end OUT_MEASUREMENT /begin LOC_MEASUREMENT /end LOC_MEASUREMENT /begin SUB_FUNCTION /end SUB_FUNCTION /end FUNCTION
/begin FUNCTION BGMSABG "2.30      Berechnung Abgasmassenstrom - bankabhängig" /begin DEF_CHARACTERISTIC /end DEF_CHARACTERISTIC /begin REF_CHARACTERISTIC /end REF_CHARACTERISTIC /begin IN_MEASUREMENT ml_w msl_w /end IN_MEASUREMENT /begin OUT_MEASUREMENT mlbb mlbb_w msabg msabg_w verhmsb_w /end OUT_MEASUREMENT /begin LOC_MEASUREMENT /end LOC_MEASUREMENT /begin SUB_FUNCTION /end SUB_FUNCTION /end FUNCTION
/begin FUNCTION BGMSZS "25.60     Berechnungsgröße Massenströme zum Saugrohr"
 /begin DEF_CHARACTERISTIC CWBGMSZS CWFKMSDKA DDFUELSAN DDRLDKZU DFKMSMN DFKMSMX DFKPVMN DFKPVMX FKMSDKMN FKMSDKMX FKPVDKMN FKPVDKMX FWRLDKNM KFMSNWDK KIMSALL KLAF KUMSRL KVLAD LADFIL MLFKMSDK MSALLMN MSALLMX MSLG PSPVDKUG PSSOLNGRD PSSOLPF PSSOLPGRD RLNOT TDABGLST TDDFUELSAN TDFGABGLGD TDMSDKS TDPSSOL TDRLMXLAM TDSRLMX WDKUGDN ZGRDPSSF ZKMSDKTHFM ZKPVDKT ZRFKMSDK /end DEF_CHARACTERISTIC
 /begin REF_CHARACTERISTIC SNM12FEUB /end REF_CHARACTERISTIC
 /begin IN_MEASUREMENT B_dteaam B_dtest B_edks B_edsl B_ehfm B_fkmsdks B_hfm B_pwf B_stend dmsnte_w esst_snm12feub fpvdkds_w ftvdk lambts_w ml_w mshfms_w mste nmot nmot_w pssol_w ps_w pvdkds_w rl_w wdkba_w /end IN_MEASUREMENT
 /begin OUT_MEASUREMENT BGMSZSbits B_fgabgl B_fkmsmn B_fkmsmx B_fkpvdk B_fkpvmn B_fkpvmx B_inilabgl B_inimsdko B_inisabgl B_msndko B_mszsdkb B_mxrlroh B_pssngrd B_psspgrd B_ugd dfuelsan_w fklaf_w fkmsdkg_w fkmsdksg_w fkmsdks_w fkmsdk_w fkpvdkg_w fkpvdk_w fpvdk fpvdk_w frhodk_w grdpssol_w msdkalm_w msdk_w msndkoo_w msndko_w msndk_w msnsaug_w mssaug_w pspvdb_w pspvdkf_w pspvdk_w pspvds_w pvdk pvdk_w rldkofk_w rldvs_w rlfdkroh_w rlfgroh_w rlflmroh_w rlroh_w rlzuhfs_w rlzunfs_w umsrln_w wdkugd_w /end OUT_MEASUREMENT
 /begin LOC_MEASUREMENT anzumrl_w B_edsli B_fgabglgd B_neglgrd B_psspgrdf drldkzu_w drllad_w fwrldk_w grdpssf_w klaf_kge msdkf_w msdkue_w rldkofkb_w rlfdkrof_w rlnotn_w wdkbab_w /end LOC_MEASUREMENT
 /begin SUB_FUNCTION /end SUB_FUNCTION
/end FUNCTION
/begin FUNCTION BGNG "5.20      Berechnete Größe Drehzahlgradient" /begin DEF_CHARACTERISTIC ZNGFIL /end DEF_CHARACTERISTIC /begin REF_CHARACTERISTIC /end REF_CHARACTERISTIC /begin IN_MEASUREMENT nmot_w tseghi tseg_w /end IN_MEASUREMENT
 /begin OUT_MEASUREMENT B_ngasok B_syn2nd dnmotas_w dnmot_w irspsyn ngas_w ngfil ngfil_w nmotas_w nmotrsp_w tsas_w tsegrsp_w /end OUT_MEASUREMENT
 /begin LOC_MEASUREMENT /end LOC_MEASUREMENT
 /begin SUB_FUNCTION /end SUB_FUNCTION
/end FUNCTION
/begin FUNCTION BGNMOT "5.60      Berechnete Größe Drehzahl" /begin DEF_CHARACTERISTIC /end DEF_CHARACTERISTIC /begin REF_CHARACTERISTIC /end REF_CHARACTERISTIC /begin IN_MEASUREMENT B_bm B_nmin tnbm1_w tnbm_w tr_zeit tr_zeit_msb zztab /end IN_MEASUREMENT /begin OUT_MEASUREMENT nmot nmotll nmotllfil nmot_w tseghi tseg_w /end OUT_MEASUREMENT /begin LOC_MEASUREMENT /end LOC_MEASUREMENT /begin SUB_FUNCTION /end SUB_FUNCTION /end FUNCTION
/begin FUNCTION BGPLGU "1.10      Berechnung Grundladedruck beim Turbomotor" /begin DEF_CHARACTERISTIC CWPLGU FHBASAPP KFDPLGU KFPLGUB KFWPLGTA ZKPLGRU /end DEF_CHARACTERISTIC /begin REF_CHARACTERISTIC SNM08LDUW STS08LDUB /end REF_CHARACTERISTIC
 /begin IN_MEASUREMENT esst_snm08lduw esst_sts08ldub fho_w nmot_w pssol_w ps_w pu_w tsel /end IN_MEASUREMENT
 /begin OUT_MEASUREMENT plgrus_w plgru_w /end OUT_MEASUREMENT
 /begin LOC_MEASUREMENT plgruo_w plgruso_w /end LOC_MEASUREMENT
 /begin SUB_FUNCTION /end SUB_FUNCTION
/end FUNCTION
/begin FUNCTION BGPUK "1.20      Berechnungsgröße Umgebungsdruck korrigiert (Bergabfahrterkennung)" /begin DEF_CHARACTERISTIC DIFFMAX PUKORRV PUSMAX PUSMIN TPUKOR /end DEF_CHARACTERISTIC /begin REF_CHARACTERISTIC /end REF_CHARACTERISTIC /begin IN_MEASUREMENT pus_w vfzg_w /end IN_MEASUREMENT /begin OUT_MEASUREMENT B_add B_puerr pukBits pukorf_w pukor_w /end OUT_MEASUREMENT /begin LOC_MEASUREMENT pumean_w /end LOC_MEASUREMENT /begin SUB_FUNCTION /end SUB_FUNCTION /end FUNCTION
/begin FUNCTION BGRBS "5.30      Berechnete Größe Radbeschleunigung aus Raddrehzahl" /begin DEF_CHARACTERISTIC CWRBS TMVDBS VASRM VRADF /end DEF_CHARACTERISTIC /begin REF_CHARACTERISTIC /end REF_CHARACTERISTIC /begin IN_MEASUREMENT B_cdswe vfzg vrad_hl_w vrad_hr_w vrad_vl_w vrad_vr_w /end IN_MEASUREMENT /begin OUT_MEASUREMENT bsc /end OUT_MEASUREMENT /begin LOC_MEASUREMENT B_absf dv_hl dv_hr dv_vl dv_vr dv_w /end LOC_MEASUREMENT /begin SUB_FUNCTION /end SUB_FUNCTION /end FUNCTION
/begin FUNCTION BGRLG "1.10      Berechnete Größe RL-GRADIENT" /begin DEF_CHARACTERISTIC /end DEF_CHARACTERISTIC /begin REF_CHARACTERISTIC /end REF_CHARACTERISTIC /begin IN_MEASUREMENT B_ngasok irspsyn rl_w tsegrsp_w /end IN_MEASUREMENT /begin OUT_MEASUREMENT drlas_w rlgas_w /end OUT_MEASUREMENT /begin LOC_MEASUREMENT rlrsp_w tas_w /end LOC_MEASUREMENT /begin SUB_FUNCTION /end SUB_FUNCTION /end FUNCTION
/begin FUNCTION BGRLMXS "1.20      Berechnung der Maximalen Sollfüllung" /begin DEF_CHARACTERISTIC RLMXLDO /end DEF_CHARACTERISTIC /begin REF_CHARACTERISTIC /end REF_CHARACTERISTIC /begin IN_MEASUREMENT B_ll fupsrl_w nmot_w pbrint_w plxs_w rl_w /end IN_MEASUREMENT /begin OUT_MEASUREMENT rlmax_w rlmxs_w rml /end OUT_MEASUREMENT /begin LOC_MEASUREMENT /end LOC_MEASUREMENT /begin SUB_FUNCTION /end SUB_FUNCTION /end FUNCTION
/begin FUNCTION BGRLP "4.50      Berechnungsgröße rlp prädizierte Luftfüllung"
 /begin DEF_CHARACTERISTIC CBGRLP DRLDYNU DRLMIN DTEPRU DWPR DWPRNSP FPVMXP TNSURLP WPRMX /end DEF_CHARACTERISTIC
 /begin REF_CHARACTERISTIC KFMSNWDK KLAF PSPVDKUG /end REF_CHARACTERISTIC
 /begin IN_MEASUREMENT B_dknolu B_ll B_nswo2 B_st B_stend dpsfg_w drl_w fpbrkds_w frhodk_w fupsrl_w fvisrm_w grundwert klaf_kge msndko_w mste nmot_w pirg_w pspvds_w ps_w pvdk_w rldvs_w rl_w te_w tvu_w umsrln_w wdkbap_w wdksp_w wdkugd_w wea wee wessbm /end IN_MEASUREMENT
 /begin OUT_MEASUREMENT B_nsp B_tired dpsmp_w drlp_w rlp rlp_w /end OUT_MEASUREMENT
 /begin LOC_MEASUREMENT B_rlp B_rlpns B_ugdsp dpsdvs_w fwprs_w msndkpk_w psmppvdk_w psmp_w pspmx_w psp_w rlmp_w rlrohmp_w vwkw wdkbapb_w wpr wprnsp /end LOC_MEASUREMENT
 /begin SUB_FUNCTION /end SUB_FUNCTION
/end FUNCTION
/begin FUNCTION BGSRM "17.10     Füllungserfassung Saugrohrmodell" /begin DEF_CHARACTERISTIC FPVMXN2 KFPBRK KFPBRKNW KFPRG KFURL KISRM ZVTPRGSU /end DEF_CHARACTERISTIC /begin REF_CHARACTERISTIC /end REF_CHARACTERISTIC
 /begin IN_MEASUREMENT B_hfm B_mxrlroh fho_w fnwue ftbr_w ftsr nmot_w pu_w pvdkds_w rlroh_w umsrln_w wnwue_w /end IN_MEASUREMENT
 /begin OUT_MEASUREMENT agrr agrr_w dpsfg_w drl_w fpbrkds_w fupsrl_w fvisrm_w ml ml_w pbr_w pirg_w psfg_w psmx_w ps_w rfagr_w rfges_w rl rl_w wnwsrm_w /end OUT_MEASUREMENT
 /begin LOC_MEASUREMENT pirgro_w psrlro_w /end LOC_MEASUREMENT
 /begin SUB_FUNCTION /end SUB_FUNCTION
/end FUNCTION
/begin FUNCTION BGTABSA "1.30      Adapter für Abstellzeitberechnung" /begin DEF_CHARACTERISTIC /end DEF_CHARACTERISTIC /begin REF_CHARACTERISTIC /end REF_CHARACTERISTIC /begin IN_MEASUREMENT B_pwf B_tabcan B_tabststp tabcan_w /end IN_MEASUREMENT /begin OUT_MEASUREMENT bgtabsaBits_50ms B_uhrexte B_uhrextof trsec_l /end OUT_MEASUREMENT /begin LOC_MEASUREMENT /end LOC_MEASUREMENT /begin SUB_FUNCTION /end SUB_FUNCTION /end FUNCTION
/begin FUNCTION BGTABST "11.50     Berechnete Größe Abstellzeit"
 /begin DEF_CHARACTERISTIC CWBGTABST DTABOVF DTABUNPL LNXQTM TNLSGM TNSEUHRCMP TRSECMX TVABST TVUHR TVUHRDEV UHRMNDEV UHRMXDEV ZKTABTU /end DEF_CHARACTERISTIC
 /begin REF_CHARACTERISTIC /end REF_CHARACTERISTIC
 /begin IN_MEASUREMENT B_nachlstp B_nlwst B_nmin B_pwf B_stend B_uhrexte B_uhrextof tmotab tmst tnse_w trsec_l tumg /end IN_MEASUREMENT
 /begin OUT_MEASUREMENT bgtabstBits1_50ms bgtabstBits2_50ms bgtabstBits3_1000ms B_abstgp B_abstnlgp B_abstnpl B_tabststp tabsnl0_w tabsnl_w tabstm_w tabst_w tabsuhr_w tengoff_l /end OUT_MEASUREMENT
 /begin LOC_MEASUREMENT B_abstmnpl B_abstnlg0 B_abstuhrg B_pltab B_tabuhrof B_tabunpl B_uhrnpl B_uhrnpl0 B_uhrnpl1 tabststp tabsuhr0_w tengoff0_l tengon_l tnseuhr_w trsectmp_l uhrdev xqtm_w /end LOC_MEASUREMENT
 /begin SUB_FUNCTION /end SUB_FUNCTION
/end FUNCTION
/begin FUNCTION BGTEMPK "10.40     Füllungserfassung Berechnung Temperaturkompensation"
 /begin DEF_CHARACTERISTIC CWTEMPK DEVTMAGR EVTMODO FAKTABGM FDVANS FWFTBRTA FWLKFTBR KFDFBTMN KFDFBTMP KFFWTBR TMOTWRM ZBRT ZDBTMN ZDBTMP ZTDAGR ZTMMBR /end DEF_CHARACTERISTIC
 /begin REF_CHARACTERISTIC /end REF_CHARACTERISTIC
 /begin IN_MEASUREMENT agrr_w nmot nmot_w pirg_w ps_w rl tabgm_w tans tmot /end IN_MEASUREMENT
 /begin OUT_MEASUREMENT evtmod ftbr ftbr_w ftsr ftu ftvdk /end OUT_MEASUREMENT
 /begin LOC_MEASUREMENT dtbrt_w ftw tabgsant_w tbrraum_w tempin tfrgsant_w tmischbr_w tmotdif tmotfil tsges_w /end LOC_MEASUREMENT
 /begin SUB_FUNCTION /end SUB_FUNCTION
/end FUNCTION
/begin FUNCTION BGTEV "2.70      Berechnungsgröße Massenstrom TEV" /begin DEF_CHARACTERISTIC FLTEFUEL FUMRMV KAFLTESG KFDPVL KLAFTE KMLTESG MSNTATE /end DEF_CHARACTERISTIC /begin REF_CHARACTERISTIC /end REF_CHARACTERISTIC
 /begin IN_MEASUREMENT B_dteaa fho_w ftvdk mshfm_w ps_w pu_w tans tateist_w vfzg_w /end IN_MEASUREMENT
 /begin OUT_MEASUREMENT msntevo_w mste mstedte mstedte_w msteo_w mste_w vregdia_w /end OUT_MEASUREMENT
 /begin LOC_MEASUREMENT dpvl_w fafte_w ftho_w mleitmx_w mleit_w msntate_kge msntetev_w mstesg_w mstetev_w mstevl_w phtevpu_w pvl_w qltefil /end LOC_MEASUREMENT
 /begin SUB_FUNCTION /end SUB_FUNCTION
/end FUNCTION
/begin FUNCTION BGTUMG "6.10      Berechnete Größe Umgebungstemperatur" /begin DEF_CHARACTERISTIC IMTUMTA KLDTUMTA NTUMTA TUMTAI TVTUMTA VTUMTA /end DEF_CHARACTERISTIC /begin REF_CHARACTERISTIC /end REF_CHARACTERISTIC /begin IN_MEASUREMENT B_pwf imlatm_w nmot tans vfzg /end IN_MEASUREMENT /begin OUT_MEASUREMENT bgtumgBits_1000ms B_tumnpl tum tumg tumgk_w /end OUT_MEASUREMENT /begin LOC_MEASUREMENT tumtmp /end LOC_MEASUREMENT /begin SUB_FUNCTION /end SUB_FUNCTION /end FUNCTION
/begin FUNCTION BGVMAX "1.30      Berechnungsgröße Maximalgeschwindigkeit für VMAX-Regelung" /begin DEF_CHARACTERISTIC VMAXNB VMAXTM VMAXTOL /end DEF_CHARACTERISTIC /begin REF_CHARACTERISTIC /end REF_CHARACTERISTIC /begin IN_MEASUREMENT tmkic tmot tolc vstvvr /end IN_MEASUREMENT /begin OUT_MEASUREMENT vmax_w /end OUT_MEASUREMENT /begin LOC_MEASUREMENT tmotrvmx vmaxtm_w vmaxtol_w /end LOC_MEASUREMENT /begin SUB_FUNCTION /end SUB_FUNCTION /end FUNCTION
/begin FUNCTION BGWDKM "1.11      Berechnung Dk-Winkel Modell" /begin DEF_CHARACTERISTIC ZWDKM1 ZWDKM2 /end DEF_CHARACTERISTIC /begin REF_CHARACTERISTIC /end REF_CHARACTERISTIC /begin IN_MEASUREMENT wdksp_w /end IN_MEASUREMENT /begin OUT_MEASUREMENT wdkbap_w /end OUT_MEASUREMENT /begin LOC_MEASUREMENT /end LOC_MEASUREMENT /begin SUB_FUNCTION /end SUB_FUNCTION /end FUNCTION
/begin FUNCTION BGWPFGR "2.10      Berechnungsgröße rückgerechneter Pedalwert bei FGR" /begin DEF_CHARACTERISTIC CWBGWPFGR KFWPFGR TFWPFGR WPFGRBMR /end DEF_CHARACTERISTIC /begin REF_CHARACTERISTIC /end REF_CHARACTERISTIC /begin IN_MEASUREMENT mrfgr_w nmot_w zstfgr /end IN_MEASUREMENT /begin OUT_MEASUREMENT wpfgr_w /end OUT_MEASUREMENT /begin LOC_MEASUREMENT /end LOC_MEASUREMENT /begin SUB_FUNCTION /end SUB_FUNCTION /end FUNCTION
/begin COMPU_METHOD acc_ub_b55p55 "" RAT_FUNC "%6.3" "m/(s^2)" COEFFS 0 1 0 0 0 0.217 /end COMPU_METHOD
/begin COMPU_METHOD B_TRUE "boolsche Zustände, positive Logik" TAB_VERB "%6.3" "" COMPU_TAB_REF B_TRUE /end COMPU_METHOD
/begin COMPU_VTAB B_TRUE "boolsche Zustände, positive Logik" TAB_VERB 2 0 "----" 1 "TRUE" /end COMPU_VTAB
/begin COMPU_METHOD DEZ "1 : 1 Umrechnug (dez/hex)" RAT_FUNC "%6.2" "" COEFFS 0 1 0 0 0 1 /end COMPU_METHOD
/begin COMPU_METHOD dez "1 : 1 Umrechnug (dez/hex)" RAT_FUNC "%6.2" "" COEFFS 0 1 0 0 0 1 /end COMPU_METHOD
/begin COMPU_METHOD dichte_ub_b2 "" RAT_FUNC "%6.4" "kg/m^3" COEFFS 0 256 0 0 0 2 /end COMPU_METHOD
/begin COMPU_METHOD fak1_q1p63Em5 "" RAT_FUNC "%7.6" "[g*K]/hPa" COEFFS 0 61440 0 0 0 1 /end COMPU_METHOD
/begin COMPU_METHOD fak1_q4p3945Em4 "" RAT_FUNC "%6.5" "[kg/h]/g" COEFFS 0 65536 0 0 0 28.8 /end COMPU_METHOD
/begin COMPU_METHOD fak_q0p0039 "" RAT_FUNC "%6.4" "-" COEFFS 0 256 0 0 0 1 /end COMPU_METHOD
/begin COMPU_METHOD fak_sw_b1 "" RAT_FUNC "%7.6" "-" COEFFS 0 65536 0 0 0 2 /end COMPU_METHOD
/begin COMPU_METHOD fak_sw_b64 "" RAT_FUNC "%6.4" "-" COEFFS 0 65536 0 0 0 128 /end COMPU_METHOD
/begin COMPU_METHOD fak_ub_b1 "" RAT_FUNC "%6.4" "-" COEFFS 0 256 0 0 0 1 /end COMPU_METHOD
/begin COMPU_METHOD fak_ub_b2 "" RAT_FUNC "%6.4" "-" COEFFS 0 256 0 0 0 2 /end COMPU_METHOD
/begin COMPU_METHOD fak_ub_b4 "" RAT_FUNC "%6.4" "-" COEFFS 0 256 0 0 0 4 /end COMPU_METHOD
/begin COMPU_METHOD fak_uw_b1 "" RAT_FUNC "%7.6" "-" COEFFS 0 65536 0 0 0 1 /end COMPU_METHOD
/begin COMPU_METHOD fak_uw_b16 "" RAT_FUNC "%6.5" "-" COEFFS 0 65536 0 0 0 16 /end COMPU_METHOD
/begin COMPU_METHOD fak_uw_b2 "" RAT_FUNC "%7.6" "-" COEFFS 0 65536 0 0 0 2 /end COMPU_METHOD
/begin COMPU_METHOD fak_uw_b32 "" RAT_FUNC "%6.5" "-" COEFFS 0 65536 0 0 0 32 /end COMPU_METHOD
/begin COMPU_METHOD fak_uw_b4 "" RAT_FUNC "%7.6" "-" COEFFS 0 65536 0 0 0 4 /end COMPU_METHOD
/begin COMPU_METHOD fak_uw_q0p001 "" RAT_FUNC "%6.5" "" COEFFS 0 65536 0 0 0 65.536 /end COMPU_METHOD
/begin COMPU_METHOD grd_sw_q0p78 "" RAT_FUNC "%6.3" "hPa/s" COEFFS 0 65536 0 0 0 51200 /end COMPU_METHOD
/begin COMPU_METHOD kumsrl_ub_b0p002 "" RAT_FUNC "%10.9" "(kg/h)/(1/min)(%)" COEFFS 0 128000 0 0 0 1 /end COMPU_METHOD
/begin COMPU_METHOD kw_q0p0019 "" RAT_FUNC "%6.4" "°KW" COEFFS 0 512 0 0 0 1 /end COMPU_METHOD
/begin COMPU_METHOD kw_q0p0078 "" RAT_FUNC "%6.4" "°KW" COEFFS 0 256 0 0 0 2 /end COMPU_METHOD
/begin COMPU_METHOD kw_q6 "" RAT_FUNC "%6.2" "°KW" COEFFS 0 1 0 0 0 6 /end COMPU_METHOD
/begin COMPU_METHOD mk1sxs_b2560 "" RAT_FUNC "%6.1" "s/(kg/h)" COEFFS 0 0 2560 0 1 0 /end COMPU_METHOD
/begin COMPU_METHOD m_q2p71Em5_g "" RAT_FUNC "%7.6" "g" COEFFS 0 65536 0 0 0 1.77778 /end COMPU_METHOD
/begin COMPU_METHOD m_ub_b1020 "" RAT_FUNC "%6.2" "kg/h" COEFFS 0 1 0 0 0 4 /end COMPU_METHOD
/begin COMPU_METHOD m_ub_b25p6 "" RAT_FUNC "%6.3" "kg/h" COEFFS 0 256 0 0 0 25.6 /end COMPU_METHOD
/begin COMPU_METHOD m_ub_b5p8 "" RAT_FUNC "%6.4" "kg" COEFFS 0 5625 0 0 0 128 /end COMPU_METHOD
/begin COMPU_METHOD m_uw_b23p3 "" RAT_FUNC "%6.5" "kg" COEFFS 0 2812.5 0 0 0 1 /end COMPU_METHOD
/begin COMPU_METHOD m_uw_b25p6 "" RAT_FUNC "%6.5" "kg/h" COEFFS 0 65536 0 0 0 25.6 /end COMPU_METHOD
/begin COMPU_METHOD m_uw_b6553p5 "" RAT_FUNC "%6.3" "kg/h" COEFFS 0 1 0 0 0 0.1 /end COMPU_METHOD
/begin COMPU_METHOD m_uw_q0p0005 "" RAT_FUNC "%6.5" "kg/h" COEFFS 0 1 0 0 0 0.0005 /end COMPU_METHOD
/begin COMPU_METHOD nmotg_sb_q100 "" RAT_FUNC "%6.0" "U/min/s" COEFFS 0 1 0 0 0 100 /end COMPU_METHOD
/begin COMPU_METHOD nmotg_sw_q0p15625 "" RAT_FUNC "%6.3" "U/min/s" COEFFS 0 1 0 0 0 0.15625 /end COMPU_METHOD
/begin COMPU_METHOD nmotg_sw_q0p39 "" RAT_FUNC "%6.3" "U/min/s" COEFFS 0 1 0 0 0 0.39063 /end COMPU_METHOD
/begin COMPU_METHOD nmot_sw_q0p25 "" RAT_FUNC "%6.3" "U/min" COEFFS 0 1 0 0 0 0.25 /end COMPU_METHOD
/begin COMPU_METHOD nmot_ub_q10 "" RAT_FUNC "%6.1" "U/min" COEFFS 0 1 0 0 0 10 /end COMPU_METHOD
/begin COMPU_METHOD nmot_ub_q40 "" RAT_FUNC "%6.1" "Upm" COEFFS 0 1 0 0 0 40 /end COMPU_METHOD
/begin COMPU_METHOD nmot_uw_q0p25 "" RAT_FUNC "%6.3" "U/min" COEFFS 0 1 0 0 0 0.25 /end COMPU_METHOD
/begin COMPU_METHOD p_sw_q0p039 "" RAT_FUNC "%6.4" "hPa" COEFFS 0 256 0 0 0 10 /end COMPU_METHOD
/begin COMPU_METHOD p_ub_q10 "" RAT_FUNC "%6.1" "hPa" COEFFS 0 1 0 0 0 10 /end COMPU_METHOD
/begin COMPU_METHOD p_uw_b32 "" RAT_FUNC "%6.5" "hPa/%" COEFFS 0 65536 0 0 0 32 /end COMPU_METHOD
/begin COMPU_METHOD p_uw_q0p039 "" RAT_FUNC "%6.4" "hPa" COEFFS 0 256 0 0 0 10 /end COMPU_METHOD
/begin COMPU_METHOD relDK_q0p02441 "" RAT_FUNC "%6.4" "% DK" COEFFS 0 65536 0 0 0 1600 /end COMPU_METHOD
/begin COMPU_METHOD relDK_q0p3922 "" RAT_FUNC "%6.3" "% DK" COEFFS 0 255 0 0 0 100 /end COMPU_METHOD
/begin COMPU_METHOD relDK_ub_b100 "" RAT_FUNC "%6.3" "% DK" COEFFS 0 255 0 0 0 100 /end COMPU_METHOD
/begin COMPU_METHOD relDK_uw_b100 "" RAT_FUNC "%6.4" "% DK" COEFFS 0 65535 0 0 0 100 /end COMPU_METHOD
/begin COMPU_METHOD relNWU_q0p0234 "" RAT_FUNC "%6.4" "%/NWU" COEFFS 0 32 0 0 0 0.75 /end COMPU_METHOD
/begin COMPU_METHOD rel_sw_b100 "" RAT_FUNC "%6.4" "%" COEFFS 0 32768 0 0 0 100 /end COMPU_METHOD
/begin COMPU_METHOD rel_sw_q0p0234 "" RAT_FUNC "%6.4" "%/seg" COEFFS 0 32 0 0 0 0.75 /end COMPU_METHOD
/begin COMPU_METHOD rel_ub_b100 "" RAT_FUNC "%6.3" "%" COEFFS 0 256 0 0 0 100 /end COMPU_METHOD
/begin COMPU_METHOD rel_ub_b2p0 "" RAT_FUNC "%6.4" "%" COEFFS 0 256 0 0 0 2 /end COMPU_METHOD
/begin COMPU_METHOD rel_ub_b99p6 "" RAT_FUNC "%6.3" "%" COEFFS 0 256 0 0 0 100 /end COMPU_METHOD
/begin COMPU_METHOD rel_ub_q0p1875 "" RAT_FUNC "%6.3" "Grad KW/ms" COEFFS 0 256 0 0 0 48 /end COMPU_METHOD
/begin COMPU_METHOD rel_ub_q0p75 "" RAT_FUNC "%6.3" "%" COEFFS 0 1 0 0 0 0.75 /end COMPU_METHOD
/begin COMPU_METHOD rel_uw_b0p3 "" RAT_FUNC "%8.7" "%/hPa" COEFFS 0 65536 0 0 0 0.3 /end COMPU_METHOD
/begin COMPU_METHOD rel_uw_b100 "" RAT_FUNC "%6.4" "%" COEFFS 0 65536 0 0 0 100 /end COMPU_METHOD
/begin COMPU_METHOD rel_uw_b200 "" RAT_FUNC "%6.4" "%" COEFFS 0 65536 0 0 0 200 /end COMPU_METHOD
/begin COMPU_METHOD rel_uw_b40 "" RAT_FUNC "%6.5" "%" COEFFS 0 65536 0 0 0 40 /end COMPU_METHOD
/begin COMPU_METHOD rel_uw_q0p0234 "" RAT_FUNC "%6.4" "%" COEFFS 0 32 0 0 0 0.75 /end COMPU_METHOD
/begin COMPU_METHOD spg_q0p00977 "" RAT_FUNC "%6.4" "V" COEFFS 0 256 0 0 0 2.5 /end COMPU_METHOD
/begin COMPU_METHOD spg_q0p03125 "" RAT_FUNC "%6.4" "V" COEFFS 0 256 0 0 0 8 /end COMPU_METHOD
/begin COMPU_METHOD spg_q0p1 "" RAT_FUNC "%6.3" "V" COEFFS 0 1 0 0 0 0.1 /end COMPU_METHOD
/begin COMPU_METHOD spg_q1p221_mV "" RAT_FUNC "%6.4" "V" COEFFS 0 65536 0 0 0 80 /end COMPU_METHOD
/begin COMPU_METHOD spg_sw_q0p001222 "" RAT_FUNC "%6.4" "V" COEFFS 0 1 0 0 0 0.001222 /end COMPU_METHOD
/begin COMPU_METHOD spg_ubatt "" RAT_FUNC "%6.4" "V" COEFFS 0 1 0 0 0 0.0704 /end COMPU_METHOD
/begin COMPU_METHOD spg_ub_q0p019 "" RAT_FUNC "%6.4" "V" COEFFS 0 256 0 0 0 5 /end COMPU_METHOD
/begin COMPU_METHOD spg_uw_q0p00488 "" RAT_FUNC "%6.4" "V" COEFFS 0 1024 0 0 0 5 /end COMPU_METHOD
/begin COMPU_METHOD s_q1_km "" RAT_FUNC "%6.2" "km" COEFFS 0 1 0 0 0 1 /end COMPU_METHOD
/begin COMPU_METHOD s_q6_km "" RAT_FUNC "%6.2" "km" COEFFS 0 1 0 0 0 6 /end COMPU_METHOD
/begin COMPU_METHOD t100msxs_ub_b25p5 "" RAT_FUNC "%6.3" "s" COEFFS 0 1 0 0 0 0.1 /end COMPU_METHOD
/begin COMPU_METHOD t100msxs_uw_b6553p5 "" RAT_FUNC "%6.3" "s" COEFFS 0 1 0 0 0 0.1 /end COMPU_METHOD
/begin COMPU_METHOD t100msxs_uw_b6553p6 "" RAT_FUNC "%6.3" "s" COEFFS 0 10 0 0 0 1 /end COMPU_METHOD
/begin COMPU_METHOD t10msxs_ub_b2p55 "" RAT_FUNC "%6.4" "s" COEFFS 0 1 0 0 0 0.01 /end COMPU_METHOD
/begin COMPU_METHOD t10msxs_uw_b655p35 "" RAT_FUNC "%6.4" "s" COEFFS 0 1 0 0 0 0.01 /end COMPU_METHOD
/begin COMPU_METHOD t1sxs_ub_b255 "" RAT_FUNC "%6.2" "s" COEFFS 0 1 0 0 0 1 /end COMPU_METHOD
/begin COMPU_METHOD t1sxs_uw_b65535 "" RAT_FUNC "%6.2" "s" COEFFS 0 1 0 0 0 1 /end COMPU_METHOD
/begin COMPU_METHOD t1sxs_uw_q1 "" RAT_FUNC "%6.2" "s" COEFFS 0 1 0 0 0 1 /end COMPU_METHOD
/begin COMPU_METHOD t200msxs_uw_q0p2 "" RAT_FUNC "%6.3" "s" COEFFS 0 1 0 0 0 0.2 /end COMPU_METHOD
/begin COMPU_METHOD t20msxs_ub_b5p1 "" RAT_FUNC "%6.4" "s" COEFFS 0 1 0 0 0 0.02 /end COMPU_METHOD
/begin COMPU_METHOD t20msxs_uw_q0p02 "" RAT_FUNC "%6.4" "s" COEFFS 0 1 0 0 0 0.02 /end COMPU_METHOD
/begin COMPU_METHOD t40ms_ub_b10200 "" RAT_FUNC "%7.2" "ms" COEFFS 0 1 0 0 0 40 /end COMPU_METHOD
/begin COMPU_METHOD t50msxs_q0p05 "" RAT_FUNC "%6.4" "s" COEFFS 0 1 0 0 0 0.05 /end COMPU_METHOD
/begin COMPU_METHOD t50msxs_ub_b12p75 "" RAT_FUNC "%6.4" "s" COEFFS 0 1 0 0 0 0.05 /end COMPU_METHOD
/begin COMPU_METHOD t50msxs_uw_b3276p75 "" RAT_FUNC "%6.4" "s" COEFFS 0 1 0 0 0 0.05 /end COMPU_METHOD
/begin COMPU_METHOD temp_q0p0234 "" RAT_FUNC "%6.4" "K" COEFFS 0 256 0 0 0 6 /end COMPU_METHOD
/begin COMPU_METHOD temp_q0p0234_o273 "" RAT_FUNC "%6.1" "Grad C" COEFFS 0 1 273.15 0 0 0.0234375 /end COMPU_METHOD
/begin COMPU_METHOD temp_sw_q0p75 "" RAT_FUNC "%6.3" "Grad C" COEFFS 0 4 0 0 0 3 /end COMPU_METHOD
/begin COMPU_METHOD temp_ub_b191p25 "" RAT_FUNC "%6.3" "Grad C" COEFFS 0 1 0 0 0 0.75 /end COMPU_METHOD
/begin COMPU_METHOD temp_ub_q0p75_o48 "" RAT_FUNC "%6.2" "Grad C" COEFFS 0 1 48 0 0 0.75 /end COMPU_METHOD
/begin COMPU_METHOD temp_ub_q1_o60 "" RAT_FUNC "%6.2" "Grad C" COEFFS 0 1 60 0 0 1 /end COMPU_METHOD
/begin COMPU_METHOD temp_ub_q5_o50 "" RAT_FUNC "%6.2" "Grad C" COEFFS 0 1 50 0 0 5 /end COMPU_METHOD
/begin COMPU_METHOD temp_uw_q0p0195_o50 "" RAT_FUNC "%6.2" "Grad C" COEFFS 0 256 12800 0 0 5 /end COMPU_METHOD
/begin COMPU_METHOD tinjection_sy "" RAT_FUNC "%6.4" "ms" COEFFS 0 375 0 0 0 1 /end COMPU_METHOD
/begin COMPU_METHOD tsegment_sy "" RAT_FUNC "%6.5" "ms" COEFFS 0 1500 0 0 0 1 /end COMPU_METHOD
/begin COMPU_METHOD tsquant "Umrechnung Segmentzeit in DMD" RAT_FUNC "%6.2" "us" COEFFS 0 1.21951 0 0 0 1 /end COMPU_METHOD
/begin COMPU_METHOD tsquantl "" RAT_FUNC "%6.1" "us" COEFFS 0 0.0762195 0 0 0 1 /end COMPU_METHOD
/begin COMPU_METHOD t_q16us "" RAT_FUNC "%6.1" "us" COEFFS 0 1 0 0 0 16 /end COMPU_METHOD
/begin COMPU_METHOD vfzg_ub_q1p25 "" RAT_FUNC "%6.2" "km/h" COEFFS 0 1 0 0 0 1.25 /end COMPU_METHOD
/begin COMPU_METHOD vfzg_uw_b512 "" RAT_FUNC "%6.4" "km/h" COEFFS 0 65536 0 0 0 512 /end COMPU_METHOD
/begin COMPU_METHOD vfzg_uw_q0p00781 "" RAT_FUNC "%6.4" "km/h" COEFFS 0 1 0 0 0 0.0078125 /end COMPU_METHOD
/begin COMPU_METHOD vrad_uw_b655 "" RAT_FUNC "%6.4" "km/h" COEFFS 0 65536 0 0 0 655 /end COMPU_METHOD
/begin COMPU_METHOD vs_uw_b25p6 "" RAT_FUNC "%6.5" "m^3/h" COEFFS 0 65536 0 0 0 25.6 /end COMPU_METHOD
/begin COMPU_METHOD zk100msxs_ub_b25p5 "" RAT_FUNC "%6.3" "s" COEFFS 0 0 256 0 10 0 /end COMPU_METHOD
/begin COMPU_METHOD zk100msxs_uw_b6553 "" RAT_FUNC "%12.4" "s" COEFFS 0 0 65536 0 10 0 /end COMPU_METHOD
/begin COMPU_METHOD zk10msxs_ub_b2p55 "" RAT_FUNC "%6.4" "s" COEFFS 0 0 255 0 100 0 /end COMPU_METHOD
/begin COMPU_METHOD zk10msxs_uw_b2p55T "" TAB_INTP "%6.3" "s" COMPU_TAB_REF zk10msxs_uw_b2p55T /end COMPU_METHOD
/begin COMPU_TAB zk10msxs_uw_b2p55T "" TAB_INTP 35 128 2.55 145 2.25 163 2 186 1.75 217 1.5 251 1.3 283 1.15 326 1 362 0.9 407 0.8 465 0.7 541 0.6 649 0.5 720 0.45 809 0.4 923 0.35 1074 0.3 1285 0.25 1524 0.21 1872 0.17 2259 0.14 2426 0.13 2620 0.12 2847 0.11 3118 0.1 3446 0.09 3850 0.08 4362 0.07 5030 0.06 5939 0.05 7248 0.04 9288 0.03 12893 0.02 20713 0.01 32767 0 /end COMPU_TAB
/begin COMPU_METHOD zk10msxs_uw_b655 "" RAT_FUNC "%12.5" "s" COEFFS 0 0 65536 0 100 0 /end COMPU_METHOD
/begin COMPU_METHOD zk1sxs_uw_b65535 "" RAT_FUNC "%6.0" "s" COEFFS 0 0 65535 0 1 0 /end COMPU_METHOD
/begin COMPU_METHOD zk200msxs_ub_b51p2 "" RAT_FUNC "%6.3" "s" COEFFS 0 0 255 0 5 0 /end COMPU_METHOD
/begin COMPU_METHOD zk200msxs_uw_b13107 "" RAT_FUNC "%12.3" "s" COEFFS 0 0 13107.2 0 1 0 /end COMPU_METHOD
/begin COMPU_METHOD zk50msxs_ub_b12p8 "" RAT_FUNC "%10.5" "s" COEFFS 0 0 128 0 10 0 /end COMPU_METHOD
/begin COMPU_METHOD zk50msxs_uw_b3276p8 "" RAT_FUNC "%12.4" "s" COEFFS 0 0 65536 0 20 0 /end COMPU_METHOD
/begin COMPU_METHOD zw_ub_q6 "" RAT_FUNC "%6.2" "Grad KW" COEFFS 0 255 0 0 0 1530 /end COMPU_METHOD
/begin RECORD_LAYOUT FklWUw FNC_VALUES 1 UWORD COLUMN_DIR DIRECT /end RECORD_LAYOUT
/begin RECORD_LAYOUT GkfWUb FNC_VALUES 1 UBYTE COLUMN_DIR DIRECT /end RECORD_LAYOUT
/begin RECORD_LAYOUT GklWUb FNC_VALUES 1 UBYTE COLUMN_DIR DIRECT /end RECORD_LAYOUT
/begin RECORD_LAYOUT GklWUw FNC_VALUES 1 UWORD COLUMN_DIR DIRECT /end RECORD_LAYOUT
/begin RECORD_LAYOUT KfAxUbAyUbSstxUbSstyUbWUb NO_AXIS_PTS_X 1 UBYTE NO_AXIS_PTS_Y 2 UBYTE AXIS_PTS_X 3 UBYTE INDEX_INCR DIRECT AXIS_PTS_Y 4 UBYTE INDEX_INCR DIRECT FNC_VALUES 5 UBYTE COLUMN_DIR DIRECT /end RECORD_LAYOUT
/begin RECORD_LAYOUT KfAxUbAyUbSstxUbSstyUwWUb NO_AXIS_PTS_X 1 UBYTE NO_AXIS_PTS_Y 2 UBYTE AXIS_PTS_X 3 UBYTE INDEX_INCR DIRECT AXIS_PTS_Y 4 UWORD INDEX_INCR DIRECT FNC_VALUES 5 UBYTE COLUMN_DIR DIRECT /end RECORD_LAYOUT
/begin RECORD_LAYOUT KfAxUbAyUbSstxUwSstyUbWUb NO_AXIS_PTS_X 1 UBYTE NO_AXIS_PTS_Y 2 UBYTE AXIS_PTS_X 3 UWORD INDEX_INCR DIRECT AXIS_PTS_Y 4 UBYTE INDEX_INCR DIRECT FNC_VALUES 5 UBYTE COLUMN_DIR DIRECT /end RECORD_LAYOUT
/begin RECORD_LAYOUT KfAxUbAyUbSstxUwSstyUwWUw NO_AXIS_PTS_X 1 UWORD NO_AXIS_PTS_Y 2 UWORD AXIS_PTS_X 3 UWORD INDEX_INCR DIRECT AXIS_PTS_Y 4 UWORD INDEX_INCR DIRECT FNC_VALUES 5 UWORD COLUMN_DIR DIRECT /end RECORD_LAYOUT
/begin RECORD_LAYOUT KfAxUwAyUwSstxUwSstyUwWUw NO_AXIS_PTS_X 1 UWORD NO_AXIS_PTS_Y 2 UWORD AXIS_PTS_X 3 UWORD INDEX_INCR DIRECT AXIS_PTS_Y 4 UWORD INDEX_INCR DIRECT FNC_VALUES 5 UWORD COLUMN_DIR DIRECT /end RECORD_LAYOUT
/begin RECORD_LAYOUT KlASwSstSwWSw NO_AXIS_PTS_X 1 SWORD AXIS_PTS_X 2 SWORD INDEX_INCR DIRECT FNC_VALUES 3 SWORD COLUMN_DIR DIRECT /end RECORD_LAYOUT
/begin RECORD_LAYOUT KlAUbSstSbWUb NO_AXIS_PTS_X 1 UBYTE AXIS_PTS_X 2 SBYTE INDEX_INCR DIRECT FNC_VALUES 3 UBYTE COLUMN_DIR DIRECT /end RECORD_LAYOUT
/begin RECORD_LAYOUT KlAUbSstUbWSb NO_AXIS_PTS_X 1 UBYTE AXIS_PTS_X 2 UBYTE INDEX_INCR DIRECT FNC_VALUES 3 SBYTE COLUMN_DIR DIRECT /end RECORD_LAYOUT
/begin RECORD_LAYOUT KlAUbSstUbWUb NO_AXIS_PTS_X 1 UBYTE AXIS_PTS_X 2 UBYTE INDEX_INCR DIRECT FNC_VALUES 3 UBYTE COLUMN_DIR DIRECT /end RECORD_LAYOUT
/begin RECORD_LAYOUT KlAUbSstUbWUw NO_AXIS_PTS_X 1 UBYTE AXIS_PTS_X 2 UBYTE INDEX_INCR DIRECT FNC_VALUES 3 UWORD COLUMN_DIR DIRECT /end RECORD_LAYOUT
/begin RECORD_LAYOUT KlAUbSstUwWUb NO_AXIS_PTS_X 1 UWORD AXIS_PTS_X 2 UWORD INDEX_INCR DIRECT FNC_VALUES 3 UBYTE COLUMN_DIR DIRECT /end RECORD_LAYOUT
/begin RECORD_LAYOUT KlAUbSstUwWUw NO_AXIS_PTS_X 1 UWORD AXIS_PTS_X 2 UWORD INDEX_INCR DIRECT FNC_VALUES 3 UWORD COLUMN_DIR DIRECT /end RECORD_LAYOUT
/begin RECORD_LAYOUT KlAUwSstSwWUw NO_AXIS_PTS_X 1 UWORD AXIS_PTS_X 2 SWORD INDEX_INCR DIRECT FNC_VALUES 3 UWORD COLUMN_DIR DIRECT /end RECORD_LAYOUT
/begin RECORD_LAYOUT KlAUwSstUwWUw NO_AXIS_PTS_X 1 UWORD AXIS_PTS_X 2 UWORD INDEX_INCR DIRECT FNC_VALUES 3 UWORD COLUMN_DIR DIRECT /end RECORD_LAYOUT
/begin RECORD_LAYOUT KwSb FNC_VALUES 1 SBYTE COLUMN_DIR DIRECT /end RECORD_LAYOUT
/begin RECORD_LAYOUT KwSw FNC_VALUES 1 SWORD COLUMN_DIR DIRECT /end RECORD_LAYOUT
/begin RECORD_LAYOUT KwUb FNC_VALUES 1 UBYTE COLUMN_DIR DIRECT /end RECORD_LAYOUT
/begin RECORD_LAYOUT KwUl FNC_VALUES 1 ULONG COLUMN_DIR DIRECT /end RECORD_LAYOUT
/begin RECORD_LAYOUT KwUw FNC_VALUES 1 UWORD COLUMN_DIR DIRECT /end RECORD_LAYOUT
/begin RECORD_LAYOUT SstAUbSstUb NO_AXIS_PTS_X 1 UBYTE AXIS_PTS_X 2 UBYTE INDEX_INCR DIRECT /end RECORD_LAYOUT
/begin RECORD_LAYOUT SstAUwSstUw NO_AXIS_PTS_X 1 UWORD AXIS_PTS_X 2 UWORD INDEX_INCR DIRECT /end RECORD_LAYOUT
/end MODULE
/end PROJECT
