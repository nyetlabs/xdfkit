ASAP2_VERSION 1 3
/begin PROJECT S1103A_25G5_0 "S1103A"
/begin HEADER "" VERSION "S1103A_25G5_0" PROJECT_NO S1103A_25G5_0 /end HEADER
/begin MODULE DIM ""
/begin MOD_COMMON "" BYTE_ORDER MSB_LAST ALIGNMENT_BYTE 1 ALIGNMENT_WORD 2 ALIGNMENT_LONG 2 /end MOD_COMMON
/begin CHARACTERISTIC ASGMDMX "" VALUE 0x8EBFF8 KwUw 10239.84 mdt_q0p15625_Nms 0.00 10239.84 FORMAT "%8.2" /end CHARACTERISTIC
/begin CHARACTERISTIC ASGPHNPLC0 "" VALUE 0x8E34FD KwUb 255.0 dez 0.00 255.0 FORMAT "%5.1" /end CHARACTERISTIC
/begin CHARACTERISTIC ASGPHNPLC1 "" VALUE 0x8E34FE KwUb 255.0 dez 0.00 255.0 FORMAT "%5.1" /end CHARACTERISTIC
/begin CHARACTERISTIC CDASG "" VALUE 0x8E34F2 KwUb 255.0 dez 0.00 255.0 FORMAT "%5.1" /end CHARACTERISTIC
/begin CHARACTERISTIC CDASG1 "" VALUE 0x8E34F3 KwUb 255.0 dez 0.00 255.0 FORMAT "%5.1" /end CHARACTERISTIC
/begin CHARACTERISTIC CLRS "" VALUE 0x8FD269 KwUb 255.0 dez 0.00 255.0 FORMAT "%5.1" /end CHARACTERISTIC
/begin CHARACTERISTIC CLRSHK "" VALUE 0x8E361E KwUb 255.0 dez 0.00 255.0 FORMAT "%5.1" /end CHARACTERISTIC
/begin CHARACTERISTIC CLRSHKA "" VALUE 0x8E361F KwUb 255.0 dez 0.00 255.0 FORMAT "%5.1" /end CHARACTERISTIC
/begin CHARACTERISTIC CLRSHKC "" VALUE 0x8E3620 KwUb 255.0 dez 0.00 255.0 FORMAT "%5.1" /end CHARACTERISTIC
/begin CHARACTERISTIC CLRSHKEB "" VALUE 0x8E3621 KwUb 255.0 dez 0.00 255.0 FORMAT "%5.1" /end CHARACTERISTIC
/begin CHARACTERISTIC CLRSHKEBB "" VALUE 0x8E3622 KwUb 255.0 dez 0.00 255.0 FORMAT "%5.1" /end CHARACTERISTIC
/begin CHARACTERISTIC CLRSKA "" VALUE 0x8E36EF KwUb 255.0 dez 0.00 255.0 FORMAT "%5.1" /end CHARACTERISTIC
/begin CHARACTERISTIC CNFMDVER "" VALUE 0x8E32A1 KwUb 255.0 dez 0.00 255.0 FORMAT "%5.1" /end CHARACTERISTIC
/begin CHARACTERISTIC CNFMDWAN "" VALUE 0x8FD19F KwUb 255.0 dez 0.00 255.0 FORMAT "%5.1" /end CHARACTERISTIC
/begin CHARACTERISTIC CNFSL "" VALUE 0x8E2D8F KwUb 255.0 dez 0.00 255.0 FORMAT "%5.1" /end CHARACTERISTIC
/begin CHARACTERISTIC CREDSTU "" VALUE 0x8FD24D KwUb 255.0 dez 0.00 255.0 FORMAT "%5.1" /end CHARACTERISTIC
/begin CHARACTERISTIC CWASGCAN "" VALUE 0x8E34F4 KwUb 255.0 dez 0.00 255.0 FORMAT "%5.1" /end CHARACTERISTIC
/begin CHARACTERISTIC CWDMFAB "" VALUE 0x8FD1BF KwUb 255.0 DEZ 0.00 255.0 FORMAT "%5.1" /end CHARACTERISTIC
/begin CHARACTERISTIC CWGALSV "" VALUE 0x8E1B99 KwUb 255.0 dez 0.00 255.0 FORMAT "%5.1" /end CHARACTERISTIC
/begin CHARACTERISTIC CWLRMS "" VALUE 0x8E3561 KwUb 255.0 dez 0.00 255.0 FORMAT "%5.1" /end CHARACTERISTIC
/begin CHARACTERISTIC CWLSUMRS "" VALUE 0x8E350B KwUb 255.0 dez 0.00 255.0 FORMAT "%5.1" /end CHARACTERISTIC
/begin CHARACTERISTIC CWMBAS "" VALUE 0x8FD1CB KwUb 255.0 dez 0.00 255.0 FORMAT "%5.1" /end CHARACTERISTIC
/begin CHARACTERISTIC CWMDASG "" VALUE 0x8FD25C KwUb 255.0 dez 0.00 255.0 FORMAT "%5.1" /end CHARACTERISTIC
/begin CHARACTERISTIC CWMDBGRG "" VALUE 0x8E349E KwUb 255.0 dez 0.00 255.0 FORMAT "%5.1" /end CHARACTERISTIC
/begin CHARACTERISTIC CWMDFAW "" VALUE 0x8FEB60 KwUw 65535.00 DEZ 0.00 65535.00 FORMAT "%8.2" /end CHARACTERISTIC
/begin CHARACTERISTIC CWMDFUE "" VALUE 0x8E147A KwUb 255.0 dez 0.00 255.0 FORMAT "%5.1" /end CHARACTERISTIC
/begin CHARACTERISTIC CWMDKOG "" VALUE 0x8FD1C6 KwUb 255.0 dez 0.00 255.0 FORMAT "%5.1" /end CHARACTERISTIC
/begin CHARACTERISTIC CWMDKOL "" VALUE 0x8E3112 KwUb 255.0 dez 0.00 255.0 FORMAT "%5.1" /end CHARACTERISTIC
/begin CHARACTERISTIC CWMDMIN "" VALUE 0x8FD1B3 KwUb 255.0 dez 0.00 255.0 FORMAT "%5.1" /end CHARACTERISTIC
/begin CHARACTERISTIC CWMDRED "" VALUE 0x8FD24E KwUb 255.0 dez 0.00 255.0 FORMAT "%5.1" /end CHARACTERISTIC
/begin CHARACTERISTIC CWMDRLKO "" VALUE 0x8E2D90 KwUb 255.0 dez 0.00 255.0 FORMAT "%5.1" /end CHARACTERISTIC
/begin CHARACTERISTIC CWRLAPPL "" VALUE 0x8FCFD0 KwUb 255.0 dez 0.00 255.0 FORMAT "%5.1" /end CHARACTERISTIC
/begin CHARACTERISTIC CWSBBVK "" VALUE 0x8E36F0 KwUb 255.0 dez 0.00 255.0 FORMAT "%5.1" /end CHARACTERISTIC
/begin CHARACTERISTIC CWSELV "" VALUE 0x8E2D91 KwUb 255.0 dez 0.00 255.0 FORMAT "%5.1" /end CHARACTERISTIC
/begin CHARACTERISTIC CWTEZW "" VALUE 0x8FD1C7 KwUb 255.0 dez 0.00 255.0 FORMAT "%5.1" /end CHARACTERISTIC
/begin CHARACTERISTIC CWTUM "" VALUE 0x8E2D92 KwUb 255.0 dez 0.00 255.0 FORMAT "%5.1" /end CHARACTERISTIC
/begin CHARACTERISTIC CWZWVMX "" VALUE 0x8FD1C8 KwUb 255.0 dez 0.00 255.0 FORMAT "%5.1" /end CHARACTERISTIC
/begin CHARACTERISTIC DASGRED "" VALUE 0x8E34F5 KwUb 1.992 fak_ub_b2 0.00 1.992 FORMAT "%5.3" /end CHARACTERISTIC
/begin CHARACTERISTIC DBZ_MX_ASG "" VALUE 0x8FD25D KwUb 255.0 dez 0.00 255.0 FORMAT "%5.1" /end CHARACTERISTIC
/begin CHARACTERISTIC DEGS "" VALUE 0x8E34FF KwUb 255.0 dez 0.00 255.0 FORMAT "%5.1" /end CHARACTERISTIC
/begin CHARACTERISTIC DELRL "" VALUE 0x8FD1C9 KwUb 5.977 rel_uw_q0p0234 0.00 5.977 FORMAT "%5.3" /end CHARACTERISTIC
/begin CHARACTERISTIC DFRMAX "" VALUE 0x8FECF4 KwSw 1.999969 fak_sw_b1 -1.000000 0.9999695 FORMAT "%8.6" /end CHARACTERISTIC
/begin CHARACTERISTIC DLAHIFAMX "" VALUE 0x8EE614 KwSw 1.999969 fak_sw_b1 -1.000000 0.9999695 FORMAT "%8.6" /end CHARACTERISTIC
/begin CHARACTERISTIC DLAHINI "" VALUE 0x8EE616 KwSw 1.999969 fak_sw_b1 -1.000000 0.9999695 FORMAT "%8.6" /end CHARACTERISTIC
/begin CHARACTERISTIC DLAHINI2 "" VALUE 0x8EE618 KwSw 1.999969 fak_sw_b1 -1.000000 0.9999695 FORMAT "%8.6" /end CHARACTERISTIC
/begin CHARACTERISTIC DLAHPFAMX "" VALUE 0x8EE61A KwSw 1.999969 fak_sw_b1 -1.000000 0.9999695 FORMAT "%8.6" /end CHARACTERISTIC
/begin CHARACTERISTIC DLAMXSA "" VALUE 0x8FED04 KwUw 15.99976 fak_uw_b16 0.00 15.99976 FORMAT "%8.5" /end CHARACTERISTIC
/begin CHARACTERISTIC DMADFK "" VALUE 0x8E2C57 KwUb 24.90 rel_ub_b24p9 0.00 24.90 FORMAT "%5.2" /end CHARACTERISTIC
/begin CHARACTERISTIC DMADFS "" VALUE 0x8E2C58 KwUb 24.90 rel_ub_b24p9 0.00 24.90 FORMAT "%5.2" /end CHARACTERISTIC
/begin CHARACTERISTIC DMADKO "" VALUE 0x8E2C59 KwUb 24.90 rel_ub_b24p9 0.00 24.90 FORMAT "%5.2" /end CHARACTERISTIC
/begin CHARACTERISTIC DMADLL "" VALUE 0x8E2C5A KwUb 24.90 rel_ub_b24p9 0.00 24.90 FORMAT "%5.2" /end CHARACTERISTIC
/begin CHARACTERISTIC DMADMNFK "" VALUE 0x8E2C5B KwUb 24.90 rel_ub_bn24p9 -24.90 0.00 FORMAT "%5.2" /end CHARACTERISTIC
/begin CHARACTERISTIC DMADMNFS "" VALUE 0x8E2C5C KwUb 24.90 rel_ub_bn24p9 -24.90 0.00 FORMAT "%5.2" /end CHARACTERISTIC
/begin CHARACTERISTIC DMADMNKO "" VALUE 0x8E2C5D KwUb 24.90 rel_ub_bn24p9 -24.90 0.00 FORMAT "%5.2" /end CHARACTERISTIC
/begin CHARACTERISTIC DMADMNLL "" VALUE 0x8E2C5E KwUb 24.90 rel_ub_bn24p9 -24.90 0.00 FORMAT "%5.2" /end CHARACTERISTIC
/begin CHARACTERISTIC DMADMXFK "" VALUE 0x8E2C5F KwUb 24.90 rel_ub_b24p9 0.00 24.90 FORMAT "%5.2" /end CHARACTERISTIC
/begin CHARACTERISTIC DMADMXFS "" VALUE 0x8E2C60 KwUb 24.90 rel_ub_b24p9 0.00 24.90 FORMAT "%5.2" /end CHARACTERISTIC
/begin CHARACTERISTIC DMADMXKO "" VALUE 0x8E2C61 KwUb 24.90 rel_ub_b24p9 0.00 24.90 FORMAT "%5.2" /end CHARACTERISTIC
/begin CHARACTERISTIC DMADMXLL "" VALUE 0x8E2C62 KwUb 24.90 rel_ub_b24p9 0.00 24.90 FORMAT "%5.2" /end CHARACTERISTIC
/begin CHARACTERISTIC DMASGNG "" CURVE 0x8EDB08 KlASwSstSwWSw 7.999878 relnmot_q0p000122 -4.000000 3.999878 FORMAT "%8.6"
 /begin AXIS_DESCR STD_AXIS dnabsak_w nmot_uw_q0p25 5 -8192.000 8191.750 FORMAT "%8.3" DEPOSIT ABSOLUTE /end AXIS_DESCR
/end CHARACTERISTIC
/begin CHARACTERISTIC DMDGENAB "" VALUE 0x8E2D93 KwSb 1.000 fak_sb_b1 -1.000 0.00 FORMAT "%5.3" /end CHARACTERISTIC
/begin CHARACTERISTIC DMDHFS "" VALUE 0x8E2D94 KwUb 4.980 rel_q0p0195 0.00 4.980 FORMAT "%5.3" /end CHARACTERISTIC
/begin CHARACTERISTIC DMDLWS "" CURVE 0x8EBDBE KlAUwSstSwWUw 49.99924 rel_q0p7629Em3 0.00 49.99924 FORMAT "%8.5"
 /begin AXIS_DESCR STD_AXIS lws_w lw_sw_q0p04375 6 -1434.044 1434.000 FORMAT "%8.3" DEPOSIT ABSOLUTE /end AXIS_DESCR
/end CHARACTERISTIC
/begin CHARACTERISTIC DMDNSM "" CURVE 0x8E32A2 KlAUbSstUbWUb 99.61 rel_ub_b99p6 0.00 99.61 FORMAT "%5.2"
 /begin AXIS_DESCR STD_AXIS tmot temp_ub_q0p75_o48 8 -48.00 143.3 FORMAT "%5.1" DEPOSIT ABSOLUTE /end AXIS_DESCR
/end CHARACTERISTIC
/begin CHARACTERISTIC DMDPOZ "" VALUE 0x8FEB62 KwUw 99.99847 rel_uw_b100 0.00 99.99847 FORMAT "%8.5" /end CHARACTERISTIC
/begin CHARACTERISTIC DMDPUG "" CURVE 0x8ECEC2 KlAUwSstSwWUw 99.99847 rel_uw_b100 0.00 99.99847 FORMAT "%8.5"
 /begin AXIS_DESCR STD_AXIS mkfanb_w rel_sw_b100 8 -100.0000 99.99695 FORMAT "%8.4" DEPOSIT ABSOLUTE /end AXIS_DESCR
/end CHARACTERISTIC
/begin CHARACTERISTIC DMDRKO "" VALUE 0x8E2D95 KwUb 99.61 rel_ub_b99p6 0.00 99.61 FORMAT "%5.2" /end CHARACTERISTIC
/begin CHARACTERISTIC DMDWANMX "" VALUE 0x8FD1A0 KwUb 100.0 rel_q0p392 0.00 100.0 FORMAT "%5.1" /end CHARACTERISTIC
/begin CHARACTERISTIC DMDWHYS "" VALUE 0x8FD1A1 KwUb 99.61 rel_ub_b99p6 0.00 99.61 FORMAT "%5.2" /end CHARACTERISTIC
/begin CHARACTERISTIC DMDWM "" CURVE 0x8E2C65 GklWUb 99.61 rel_ub_b99p6 0.00 99.61 FORMAT "%5.2"
 /begin AXIS_DESCR COM_AXIS twnd temp_ub_q0p75_o48 8 -48.00 143.3 FORMAT "%5.1" AXIS_PTS_REF STW08MDUB /end AXIS_DESCR
/end CHARACTERISTIC
/begin CHARACTERISTIC DMGN "" VALUE 0x8E2D96 KwUb 99.61 rel_ub_b100 0.00 99.61 FORMAT "%5.2" /end CHARACTERISTIC
/begin CHARACTERISTIC DMIASGE "" VALUE 0x8FEB8A KwUw 99.99847 rel_uw_b100 0.00 99.99847 FORMAT "%8.5" /end CHARACTERISTIC
/begin CHARACTERISTIC DMIASGV "" VALUE 0x8EDA5E KwUw 99.99847 rel_uw_b100 0.00 99.99847 FORMAT "%8.5" /end CHARACTERISTIC
/begin CHARACTERISTIC DMIFLSD "" VALUE 0x8FEB64 KwUw 99.99847 rel_uw_b100 0.00 99.99847 FORMAT "%8.5" /end CHARACTERISTIC
/begin CHARACTERISTIC DMIOWLSD "" CURVE 0x8ECC3A FklWSw 99.99847 rel_sw_b50 -50.00000 49.99847 FORMAT "%8.5"
 /begin AXIS_DESCR FIX_AXIS gangist dez 8 0.00 7.000 FORMAT "%5.3" FIX_AXIS_PAR 0 0 8 /end AXIS_DESCR
/end CHARACTERISTIC
/begin CHARACTERISTIC DMIZWMN "" VALUE 0x8FD24F KwUb 99.61 rel_ub_b99p6 0.00 99.61 FORMAT "%5.2" /end CHARACTERISTIC
/begin CHARACTERISTIC DMKO "" VALUE 0x8E2D97 KwUb 99.61 rel_ub_b100 0.00 99.61 FORMAT "%5.2" /end CHARACTERISTIC
/begin CHARACTERISTIC DMLFS "" VALUE 0x8E2D98 KwUb 99.61 rel_ub_b100 0.00 99.61 FORMAT "%5.2" /end CHARACTERISTIC
/begin CHARACTERISTIC DMLSDUG "" CURVE 0x8ECEE4 KlAUwSstSwWUw 99.99847 rel_uw_b100 0.00 99.99847 FORMAT "%8.5"
 /begin AXIS_DESCR STD_AXIS mkfanb_w rel_sw_b100 8 -100.0000 99.99695 FORMAT "%8.4" DEPOSIT ABSOLUTE /end AXIS_DESCR
/end CHARACTERISTIC
/begin CHARACTERISTIC DMRAA "" VALUE 0x8EDA50 KwUw 99.99847 rel_uw_b100 0.00 99.99847 FORMAT "%8.5" /end CHARACTERISTIC
/begin CHARACTERISTIC DMRFAWEN "" CURVE 0x8ECC4A KlAUwSstUwWUw 199.9969 rel_uw_b200 0.00 199.9969 FORMAT "%8.4"
 /begin AXIS_DESCR STD_AXIS nmot_w nmot_uw_q0p25 4 0.00 16383.75 FORMAT "%8.2" DEPOSIT ABSOLUTE /end AXIS_DESCR
/end CHARACTERISTIC
/begin CHARACTERISTIC DMRTMKI "" VALUE 0x8E349F KwUb 1.992 fak_ub_b2 0.00 1.992 FORMAT "%5.3" /end CHARACTERISTIC
/begin CHARACTERISTIC DMSERVL "" VALUE 0x8E2D99 KwUb 99.61 rel_ub_b100 0.00 99.61 FORMAT "%5.2" /end CHARACTERISTIC
/begin CHARACTERISTIC DMSLP "" VALUE 0x8E2D9A KwUb 99.61 rel_ub_b100 0.00 99.61 FORMAT "%5.2" /end CHARACTERISTIC
/begin CHARACTERISTIC DMVERLMN "" VALUE 0x8ED89C KwUw 99.99847 rel_uw_b100 0.00 99.99847 FORMAT "%8.5" /end CHARACTERISTIC
/begin CHARACTERISTIC DNASNOT "" VALUE 0x8FD25E KwUb 10200. nmot_ub_q40 0.00 10200. FORMAT "%5.0" /end CHARACTERISTIC
/begin CHARACTERISTIC DNSYWMN "" VALUE 0x8EDA60 KwSw 16383.75 nmot_uw_q0p25 -8192.000 8191.750 FORMAT "%8.3" /end CHARACTERISTIC
/begin CHARACTERISTIC DPUMDS "" VALUE 0x8ED89E KwUw 2559.961 p_uw_q0p039 0.00 2559.961 FORMAT "%8.3" /end CHARACTERISTIC
/begin CHARACTERISTIC DRLMINDP "" VALUE 0x8FEB66 KwSw 1535.977 rel_sw_q0p0234 -768.0000 767.9766 FORMAT "%8.4" /end CHARACTERISTIC
/begin CHARACTERISTIC DTMIBG "" VALUE 0x8E34A0 KwUb 191.3 temp_ub_q0p75_o48 -48.00 143.3 FORMAT "%5.1" /end CHARACTERISTIC
/begin CHARACTERISTIC DTMR "" VALUE 0x8FD26A KwUb 191.3 temp_ub_b191p25 0.00 191.3 FORMAT "%5.1" /end CHARACTERISTIC
/begin CHARACTERISTIC DZWLB "" CURVE 0x8E3113 GklWSb 191.3 zw_sb_q0p75 -96.00 95.25 FORMAT "%5.2"
 /begin AXIS_DESCR COM_AXIS wnwe_w kw_q0p0078 7 -256.0000 255.9922 FORMAT "%8.4" AXIS_PTS_REF SWE07OPSW /end AXIS_DESCR
/end CHARACTERISTIC
/begin CHARACTERISTIC DZWOLA "" CURVE 0x8E311A GklWSb 191.3 zw_sb_q0p75 -96.00 95.25 FORMAT "%5.2"
 /begin AXIS_DESCR COM_AXIS lambas_w fak_uw_b16 9 0.00 15.99976 FORMAT "%8.5" AXIS_PTS_REF SLA09OPUW /end AXIS_DESCR
/end CHARACTERISTIC
/begin CHARACTERISTIC DZWRRI "" CURVE 0x8E3123 GklWSb 95.63 zw_sb_q0p3735 -48.00 47.63 FORMAT "%5.2"
 /begin AXIS_DESCR COM_AXIS rri_w rel_uw_b100 7 0.00 99.99847 FORMAT "%8.5" AXIS_PTS_REF SRR07OPUW /end AXIS_DESCR
/end CHARACTERISTIC
/begin CHARACTERISTIC EGSTDEC "" VALUE 0x8E3500 KwSb 255.0 dez -128.0 127.0 FORMAT "%5.1" /end CHARACTERISTIC
/begin CHARACTERISTIC ETADZW "" CURVE 0x8FD1CC FklWUb 127.5 rel_ub_b127p5 0.00 127.5 FORMAT "%5.1"
 /begin AXIS_DESCR FIX_AXIS dzwb zw_ub_q0p75 128 0.00 95.25 FORMAT "%5.2" FIX_AXIS_PAR 0 0 128 /end AXIS_DESCR
/end CHARACTERISTIC
/begin CHARACTERISTIC ETALAM "" CURVE 0x8E312A GklWUb 127.5 rel_ub_b127p5 0.00 127.5 FORMAT "%5.1"
 /begin AXIS_DESCR COM_AXIS lambas_w fak_uw_b16 9 0.00 15.99976 FORMAT "%8.5" AXIS_PTS_REF SLA09OPUW /end AXIS_DESCR
/end CHARACTERISTIC
/begin CHARACTERISTIC ETALB "" CURVE 0x8E3133 GklWUb 127.5 rel_ub_b127p5 0.00 127.5 FORMAT "%5.1"
 /begin AXIS_DESCR COM_AXIS wnwe_w kw_q0p0078 7 -256.0000 255.9922 FORMAT "%8.4" AXIS_PTS_REF SWE07OPSW /end AXIS_DESCR
/end CHARACTERISTIC
/begin CHARACTERISTIC ETARRI "" CURVE 0x8E313A GklWUb 127.5 rel_ub_b127p5 0.00 127.5 FORMAT "%5.1"
 /begin AXIS_DESCR COM_AXIS rri_w rel_uw_b100 7 0.00 99.99847 FORMAT "%8.5" AXIS_PTS_REF SRR07OPUW /end AXIS_DESCR
/end CHARACTERISTIC
/begin CHARACTERISTIC FABMDWA "" CURVE 0x8E2C9E KlAUbSstUbWUb 0.9961 fak_ub_b1 0.00 0.9961
 /begin AXIS_DESCR STD_AXIS qntns fak_ub_b8 6 0.00 7.969 FORMAT "%5.3" DEPOSIT ABSOLUTE /end AXIS_DESCR
/end CHARACTERISTIC
/begin CHARACTERISTIC FBZFRAT "" CURVE 0x8E1B9A KlAUbSstUbWUb 0.9961 fak_ub_b1 0.00 0.9961
 /begin AXIS_DESCR STD_AXIS abo dez 5 0.00 255.0 FORMAT "%5.1" DEPOSIT ABSOLUTE /end AXIS_DESCR
/end CHARACTERISTIC
/begin CHARACTERISTIC FDMDWAN "" VALUE 0x8FD1A2 KwUb 0.9961 fak_ub_b1 0.00 0.9961 /end CHARACTERISTIC
/begin CHARACTERISTIC FGMIFABG "" CURVE 0x8E3092 FklWUb 1.992 fak_ub_b2 0.00 1.992 FORMAT "%5.3"
 /begin AXIS_DESCR FIX_AXIS gangi dez 8 0.00 7.000 FORMAT "%5.3" FIX_AXIS_PAR 0 0 8 /end AXIS_DESCR
/end CHARACTERISTIC
/begin CHARACTERISTIC FGMIFAL "" CURVE 0x8E309A FklWUb 1.992 fak_ub_b2 0.00 1.992 FORMAT "%5.3"
 /begin AXIS_DESCR FIX_AXIS gangi dez 8 0.00 7.000 FORMAT "%5.3" FIX_AXIS_PAR 0 0 8 /end AXIS_DESCR
/end CHARACTERISTIC
/begin CHARACTERISTIC FGZLSD "" CURVE 0x8E30A2 FklWUb 1.992 fak_ub_b2 0.00 1.992 FORMAT "%5.3"
 /begin AXIS_DESCR FIX_AXIS gangi dez 8 0.00 7.000 FORMAT "%5.3" FIX_AXIS_PAR 0 0 8 /end AXIS_DESCR
/end CHARACTERISTIC
/begin CHARACTERISTIC FKAXFOSC "" CURVE 0x8EE71C KlAUbSstUbWUb 0.9961 fak_ub_b1 0.00 0.9961
 /begin AXIS_DESCR STD_AXIS fcoschk fak_ub_b2 3 0.00 1.992 FORMAT "%5.3" DEPOSIT ABSOLUTE /end AXIS_DESCR
/end CHARACTERISTIC
/begin CHARACTERISTIC FKAXFOSC2 "" CURVE 0x8EE723 KlAUbSstUbWUb 0.9961 fak_ub_b1 0.00 0.9961
 /begin AXIS_DESCR STD_AXIS fcoschk2 fak_ub_b2 3 0.00 1.992 FORMAT "%5.3" DEPOSIT ABSOLUTE /end AXIS_DESCR
/end CHARACTERISTIC
/begin CHARACTERISTIC FKFPEDV "" CURVE 0x8E3062 KlAUbSstUbWUb 1.000 fak_ub_b2 0.00 1.000 FORMAT "%5.3"
 /begin AXIS_DESCR STD_AXIS vfzg vfzg_ub_q1p25 2 0.00 318.8 FORMAT "%5.1" DEPOSIT ABSOLUTE /end AXIS_DESCR
/end CHARACTERISTIC
/begin CHARACTERISTIC FKZDPTM "" CURVE 0x8E3067 KlAUbSstUbWUb 1.49804 rfak_q0p5 0.501961 2.00000 FORMAT "%7.5"
 /begin AXIS_DESCR STD_AXIS tmot temp_ub_q0p75_o48 6 -48.00 143.3 FORMAT "%5.1" DEPOSIT ABSOLUTE /end AXIS_DESCR
/end CHARACTERISTIC
/begin CHARACTERISTIC FLMLKAMA "" VALUE 0x8E36F1 KwUb 7.969 fak_ub_b8 0.00 7.969 FORMAT "%5.3" /end CHARACTERISTIC
/begin CHARACTERISTIC FLMLKAMA2 "" VALUE 0x8E36F2 KwUb 7.969 fak_ub_b8 0.00 7.969 FORMAT "%5.3" /end CHARACTERISTIC
/begin CHARACTERISTIC FLRMIFABG "" VALUE 0x8FD1C0 KwUb 3.984 fak_ub_b4 0.00 3.984 FORMAT "%5.3" /end CHARACTERISTIC
/begin CHARACTERISTIC FLRMIFAL "" VALUE 0x8FD1C1 KwUb 3.984 fak_ub_b4 0.00 3.984 FORMAT "%5.3" /end CHARACTERISTIC
/begin CHARACTERISTIC FLRZDASH "" VALUE 0x8FD1C2 KwUb 3.49804 rfak_q0p5 0.501961 4.00000 FORMAT "%7.5" /end CHARACTERISTIC
/begin CHARACTERISTIC FLRZLSD "" VALUE 0x8E3074 KwUb 3.984 fak_ub_b4 0.00 3.984 FORMAT "%5.3" /end CHARACTERISTIC
/begin CHARACTERISTIC FMDGEN "" VALUE 0x8E2D9B KwUb 6.969 fak_ub_b8 1.000 7.969 FORMAT "%5.3" /end CHARACTERISTIC
/begin CHARACTERISTIC FMDGENTA "" CURVE 0x8E2D9C KlAUbSstUbWUb 1.992 rel_ub_b2p0 0.00 1.992 FORMAT "%5.3"
 /begin AXIS_DESCR STD_AXIS tans temp_ub_q0p75_o48 6 -48.00 143.3 FORMAT "%5.1" DEPOSIT ABSOLUTE /end AXIS_DESCR
/end CHARACTERISTIC
/begin CHARACTERISTIC FMDWAT "" CURVE 0x8E2C6D GklWUb 0.000119850000 fak_ub_q4p7Em7 0.00 0.000119850000 FORMAT "%14.12"
 /begin AXIS_DESCR COM_AXIS twnd temp_ub_q0p75_o48 8 -48.00 143.3 FORMAT "%5.1" AXIS_PTS_REF STW08MDUB /end AXIS_DESCR
/end CHARACTERISTIC
/begin CHARACTERISTIC FMIMXKVL "" CURVE 0x8E30F8 KlAUbSstUbWUb 1.992 fak_ub_b2 0.00 1.992 FORMAT "%5.3"
 /begin AXIS_DESCR STD_AXIS nmot nmot_ub_q40 8 0.00 10200. FORMAT "%5.0" DEPOSIT ABSOLUTE /end AXIS_DESCR
/end CHARACTERISTIC
/begin CHARACTERISTIC FNRAD "" VALUE 0x8FD1A3 KwUb 15.94 fak_ub_b16 0.00 15.94 FORMAT "%5.2" /end CHARACTERISTIC
/begin CHARACTERISTIC FNSTABNV "" CURVE 0x8EBCB8 KlAUwSstUwWUw 7.999878 fak_uw_b8 0.00 7.999878 FORMAT "%8.6"
 /begin AXIS_DESCR STD_AXIS nver_w fak_uw_b8 6 0.00 7.999878 FORMAT "%8.6" DEPOSIT ABSOLUTE /end AXIS_DESCR
/end CHARACTERISTIC
/begin CHARACTERISTIC FRAOMN "" VALUE 0x8E1BA5 KwUb 1.992 fak_ub_b2 0.00 1.992 FORMAT "%5.3" /end CHARACTERISTIC
/begin CHARACTERISTIC FRAOMX "" VALUE 0x8E1BA6 KwUb 1.992 fak_ub_b2 0.00 1.992 FORMAT "%5.3" /end CHARACTERISTIC
/begin CHARACTERISTIC FRAORN "" VALUE 0x8E1BA7 KwUb 1.992 fak_ub_b2 0.00 1.992 FORMAT "%5.3" /end CHARACTERISTIC
/begin CHARACTERISTIC FRAORX "" VALUE 0x8E1BA8 KwUb 1.992 fak_ub_b2 0.00 1.992 FORMAT "%5.3" /end CHARACTERISTIC
/begin CHARACTERISTIC FRATMN "" VALUE 0x8E1BA9 KwUb 1.992 fak_ub_b2 0.00 1.992 FORMAT "%5.3" /end CHARACTERISTIC
/begin CHARACTERISTIC FRATMX "" VALUE 0x8E1BAA KwUb 1.992 fak_ub_b2 0.00 1.992 FORMAT "%5.3" /end CHARACTERISTIC
/begin CHARACTERISTIC FRAUMN "" VALUE 0x8E1BAB KwUb 1.992 fak_ub_b2 0.00 1.992 FORMAT "%5.3" /end CHARACTERISTIC
/begin CHARACTERISTIC FRAUMX "" VALUE 0x8E1BAC KwUb 1.992 fak_ub_b2 0.00 1.992 FORMAT "%5.3" /end CHARACTERISTIC
/begin CHARACTERISTIC FRAURN "" VALUE 0x8E1BAD KwUb 1.992 fak_ub_b2 0.00 1.992 FORMAT "%5.3" /end CHARACTERISTIC
/begin CHARACTERISTIC FRAURX "" VALUE 0x8E1BAE KwUb 1.992 fak_ub_b2 0.00 1.992 FORMAT "%5.3" /end CHARACTERISTIC
/begin CHARACTERISTIC FRLMNHO "" CURVE 0x8E147B KlAUbSstUbWUb 1.992 fak_ub_b2 0.00 1.992 FORMAT "%5.3"
 /begin AXIS_DESCR STD_AXIS fho fak_ub_b4 5 0.00 3.984 FORMAT "%5.3" DEPOSIT ABSOLUTE /end AXIS_DESCR
/end CHARACTERISTIC
/begin CHARACTERISTIC FRMINKH "" VALUE 0x8EDF42 KwUw 1.999969 fak_uw_b2 0.00 1.999969 FORMAT "%8.6" /end CHARACTERISTIC
/begin CHARACTERISTIC FVDMDWAN "" VALUE 0x8FD1A4 KwUb 7.969 fak_ub_b8 0.00 7.969 FORMAT "%5.3" /end CHARACTERISTIC
/begin CHARACTERISTIC FWDMVAD "" CURVE 0x8EBCD2 KlAUwSstUwWUw 0.9999847 fak_uw_b1 0.00 0.9999847 FORMAT "%9.7"
 /begin AXIS_DESCR STD_AXIS nver_w fak_uw_b8 8 0.00 7.999878 FORMAT "%8.6" DEPOSIT ABSOLUTE /end AXIS_DESCR
/end CHARACTERISTIC
/begin CHARACTERISTIC FWPEDRLS "" VALUE 0x8FE682 KwUw 3.999939 fak_uw_b4 0.00 3.999939 FORMAT "%8.6" /end CHARACTERISTIC
/begin CHARACTERISTIC ILMLKAXTK "" CURVE 0x8EE72A KlAUbSstUwWUw 291.2667 m_uw_b291p25 0.00 291.2667 FORMAT "%8.4"
 /begin AXIS_DESCR STD_AXIS xtkikm_w temp_q0p0234_o273 5 -273.1500 1262.827 FORMAT "%8.3" DEPOSIT ABSOLUTE /end AXIS_DESCR
/end CHARACTERISTIC
/begin CHARACTERISTIC ILMLKAXTK2 "" CURVE 0x8EE740 KlAUbSstUwWUw 291.2667 m_uw_b291p25 0.00 291.2667 FORMAT "%8.4"
 /begin AXIS_DESCR STD_AXIS xtkikm2_w temp_q0p0234_o273 5 -273.1500 1262.827 FORMAT "%8.3" DEPOSIT ABSOLUTE /end AXIS_DESCR
/end CHARACTERISTIC
/begin CHARACTERISTIC IMLEVABS "" VALUE 0x8FED06 KwUw 4660.267 m_uw_b4660 0.00 4660.267 FORMAT "%8.3" /end CHARACTERISTIC
/begin CHARACTERISTIC IMLEVABS2 "" VALUE 0x8FED08 KwUw 4660.267 m_uw_b4660 0.00 4660.267 FORMAT "%8.3" /end CHARACTERISTIC
/begin CHARACTERISTIC IMLKAMN "" VALUE 0x8EE756 KwUw 291.2622 m_uw_b291p25 0.00 291.2622 FORMAT "%8.4" /end CHARACTERISTIC
/begin CHARACTERISTIC IMLKAMN2 "" VALUE 0x8EE758 KwUw 291.2622 m_uw_b291p25 0.00 291.2622 FORMAT "%8.4" /end CHARACTERISTIC
/begin CHARACTERISTIC IMLSALR "" VALUE 0x8FED0A KwUw 4660.267 m_uw_b4660 0.00 4660.267 FORMAT "%8.3" /end CHARACTERISTIC
/begin CHARACTERISTIC KASGMD "" VALUE 0x8E3501 KwUb 1.992 fak_ub_b2 0.00 1.992 FORMAT "%5.3" /end CHARACTERISTIC
/begin CHARACTERISTIC KASGRED "" VALUE 0x8EDA62 KwUw 3.999939 fak_uw_b4 0.00 3.999939 FORMAT "%8.6" /end CHARACTERISTIC
/begin CHARACTERISTIC KDLASHKI "" CURVE 0x8EE61C GklWSw 1.999969 fak_sw_b1 -1.000000 0.9999695 FORMAT "%8.6"
 /begin AXIS_DESCR COM_AXIS dlashkm_w fak_sw_b1 8 -1.000000 0.9999695 FORMAT "%8.6" AXIS_PTS_REF SM108LHSW /end AXIS_DESCR
/end CHARACTERISTIC
/begin CHARACTERISTIC KDLASHKI2 "" CURVE 0x8EE62C GklWSw 1.999969 fak_sw_b1 -1.000000 0.9999695 FORMAT "%8.6"
 /begin AXIS_DESCR COM_AXIS dlashkm2_w fak_sw_b1 8 -1.000000 0.9999695 FORMAT "%8.6" AXIS_PTS_REF SM208LHSW /end AXIS_DESCR
/end CHARACTERISTIC
/begin CHARACTERISTIC KDLASHKP "" CURVE 0x8EE63C GklWSw 1.999969 fak_sw_b1 -1.000000 0.9999695 FORMAT "%8.6"
 /begin AXIS_DESCR COM_AXIS dlashkm_w fak_sw_b1 8 -1.000000 0.9999695 FORMAT "%8.6" AXIS_PTS_REF SM108LHSW /end AXIS_DESCR
/end CHARACTERISTIC
/begin CHARACTERISTIC KDLASHKP2 "" CURVE 0x8EE64C GklWSw 1.999969 fak_sw_b1 -1.000000 0.9999695 FORMAT "%8.6"
 /begin AXIS_DESCR COM_AXIS dlashkm2_w fak_sw_b1 8 -1.000000 0.9999695 FORMAT "%8.6" AXIS_PTS_REF SM208LHSW /end AXIS_DESCR
/end CHARACTERISTIC
/begin CHARACTERISTIC KFASGVF "" MAP 0x8EDA64 KfAxUwAyUwSstxSwSstyUwWUw 1.999969 fak_uw_b2 0.00 1.999969 FORMAT "%8.6"
 /begin AXIS_DESCR STD_AXIS dnasgl_w nmot_uw_q0p25 5 -8192.000 8191.750 FORMAT "%8.3" DEPOSIT ABSOLUTE /end AXIS_DESCR
 /begin AXIS_DESCR STD_AXIS ngasoff_w nmotg_sw_q0p39 6 0.00 25599.94 FORMAT "%8.2" DEPOSIT ABSOLUTE /end AXIS_DESCR
/end CHARACTERISTIC
/begin CHARACTERISTIC KFDLASO "" MAP 0x8E3562 GkfWSb 0.06226 fak_sb_b0p03125 -0.03125 0.03101 FORMAT "%7.5"
 /begin AXIS_DESCR COM_AXIS nmot nmot_ub_q40 8 0.00 10200. FORMAT "%5.0" AXIS_PTS_REF SNM08LSUB /end AXIS_DESCR
 /begin AXIS_DESCR COM_AXIS rl rel_ub_q0p75 8 0.00 191.3 FORMAT "%5.1" AXIS_PTS_REF SRL08LSUB /end AXIS_DESCR
/end CHARACTERISTIC
/begin CHARACTERISTIC KFDLASO2 "" MAP 0x8E35A2 GkfWSb 0.06226 fak_sb_b0p03125 -0.03125 0.03101 FORMAT "%7.5"
 /begin AXIS_DESCR COM_AXIS nmot nmot_ub_q40 8 0.00 10200. FORMAT "%5.0" AXIS_PTS_REF SNM08LSUB /end AXIS_DESCR
 /begin AXIS_DESCR COM_AXIS rl rel_ub_q0p75 8 0.00 191.3 FORMAT "%5.1" AXIS_PTS_REF SRL08LSUB /end AXIS_DESCR
/end CHARACTERISTIC
/begin CHARACTERISTIC KFDLSD "" MAP 0x8ECC5C GkfWUw 1.999969 fak_uw_b2 0.00 1.999969 FORMAT "%8.6"
 /begin AXIS_DESCR COM_AXIS gangi dez 8 0.00 255.0 FORMAT "%5.1" AXIS_PTS_REF SGA08MDUB /end AXIS_DESCR
 /begin AXIS_DESCR COM_AXIS nmot_w nmot_uw_q0p25 6 0.00 16383.75 FORMAT "%8.2" AXIS_PTS_REF SNM06MDUW /end AXIS_DESCR
/end CHARACTERISTIC
/begin CHARACTERISTIC KFDMDKOE "" MAP 0x8E2DA9 GkfWSb 99.60 rel_sb_q0p39 -50.00 49.61 FORMAT "%5.2"
 /begin AXIS_DESCR COM_AXIS nmot nmot_ub_q40 6 0.00 10200. FORMAT "%5.0" AXIS_PTS_REF SNM06KOUB /end AXIS_DESCR
 /begin AXIS_DESCR COM_AXIS tlok temp_ub_q0p75_o48 6 -48.00 143.3 FORMAT "%5.1" AXIS_PTS_REF STA06LLUB /end AXIS_DESCR
/end CHARACTERISTIC
/begin CHARACTERISTIC KFDMDPO "" MAP 0x8ECF06 KfAxUbAyUbSstxSwSstyUbWUw 99.99847 rel_uw_b100 0.00 99.99847 FORMAT "%8.5"
 /begin AXIS_DESCR STD_AXIS mkfanb_w rel_sw_b100 6 -100.0000 99.99695 FORMAT "%8.4" DEPOSIT ABSOLUTE /end AXIS_DESCR
 /begin AXIS_DESCR STD_AXIS gangi dez 8 0.00 255.0 FORMAT "%5.1" DEPOSIT ABSOLUTE /end AXIS_DESCR
/end CHARACTERISTIC
/begin CHARACTERISTIC KFDMLSDO "" MAP 0x8ECF7C KfAxUwAyUwSstxSwSstyUwWUw 99.99847 rel_uw_b100 0.00 99.99847 FORMAT "%8.5"
 /begin AXIS_DESCR STD_AXIS mkfanb_w rel_sw_b100 8 -100.0000 99.99695 FORMAT "%8.4" DEPOSIT ABSOLUTE /end AXIS_DESCR
 /begin AXIS_DESCR STD_AXIS nmot_w nmot_uw_q0p25 6 0.00 16383.75 FORMAT "%8.2" DEPOSIT ABSOLUTE /end AXIS_DESCR
/end CHARACTERISTIC
/begin CHARACTERISTIC KFDMLSDS "" MAP 0x8ECCBC GkfWUw 99.99847 rel_uw_b100 0.00 99.99847 FORMAT "%8.5"
 /begin AXIS_DESCR COM_AXIS gangi dez 8 0.00 255.0 FORMAT "%5.1" AXIS_PTS_REF SGA08MDUB /end AXIS_DESCR
 /begin AXIS_DESCR COM_AXIS nmot_w nmot_uw_q0p25 6 0.00 16383.75 FORMAT "%8.2" AXIS_PTS_REF SNM06MDUW /end AXIS_DESCR
/end CHARACTERISTIC
/begin CHARACTERISTIC KFDZWTBR "" MAP 0x8ED716 KfAxUbAyUbSstxUbSstyUbWSb 191.3 zw_sb_q0p75 -96.00 95.25 FORMAT "%5.2"
 /begin AXIS_DESCR STD_AXIS tmot temp_ub_q0p75_o48 5 -48.00 143.3 FORMAT "%5.1" DEPOSIT ABSOLUTE /end AXIS_DESCR
 /begin AXIS_DESCR STD_AXIS rl rel_ub_q0p75 5 0.00 191.3 FORMAT "%5.1" DEPOSIT ABSOLUTE /end AXIS_DESCR
/end CHARACTERISTIC
/begin CHARACTERISTIC KFFRIDZW "" MAP 0x8E3141 GkfWUb 1.992 fak_q0p0078 0.00 1.992 FORMAT "%5.3"
 /begin AXIS_DESCR COM_AXIS nmot_w nmot_uw_q0p25 16 0.00 16383.75 FORMAT "%8.2" AXIS_PTS_REF SNM16OPUW /end AXIS_DESCR
 /begin AXIS_DESCR COM_AXIS rl_w rel_uw_q0p0234 11 0.00 1535.977 FORMAT "%8.3" AXIS_PTS_REF SRL11OPUW /end AXIS_DESCR
/end CHARACTERISTIC
/begin CHARACTERISTIC KFFRMIN "" MAP 0x8EDF44 KfAxUbAyUbSstxUbSstyUwWUw 1.999969 fak_uw_b2 0.00 1.999969 FORMAT "%8.6"
 /begin AXIS_DESCR STD_AXIS tmot temp_ub_q0p75_o48 5 -48.00 143.3 FORMAT "%5.1" DEPOSIT ABSOLUTE /end AXIS_DESCR
 /begin AXIS_DESCR STD_AXIS tnst_w t10msxs_uw_b655p35 4 0.00 655.3500 FORMAT "%8.4" DEPOSIT ABSOLUTE /end AXIS_DESCR
/end CHARACTERISTIC
/begin CHARACTERISTIC KFFRTMKI "" MAP 0x8E34A1 KfAxUbAyUbSstxUbSstyUbWUb 1.992 fak_ub_b2 0.00 1.992 FORMAT "%5.3"
 /begin AXIS_DESCR STD_AXIS nmot nmot_ub_q40 6 0.00 10200. FORMAT "%5.0" DEPOSIT ABSOLUTE /end AXIS_DESCR
 /begin AXIS_DESCR STD_AXIS gangi dez 8 0.00 255.0 FORMAT "%5.1" DEPOSIT ABSOLUTE /end AXIS_DESCR
/end CHARACTERISTIC
/begin CHARACTERISTIC KFLRSG1 "" MAP 0x8EDF7C GkfWSw 63.99902 fak_sw_b32 -32.00000 31.99902 FORMAT "%8.5"
 /begin AXIS_DESCR COM_AXIS nmot_w nmot_uw_q0p25 7 0.00 16383.75 FORMAT "%8.2" AXIS_PTS_REF SNM07LSUW /end AXIS_DESCR
 /begin AXIS_DESCR COM_AXIS rl_w rel_uw_q0p0234 8 0.00 1535.977 FORMAT "%8.3" AXIS_PTS_REF SRL08LSUW /end AXIS_DESCR
/end CHARACTERISTIC
/begin CHARACTERISTIC KFLRSG12 "" MAP 0x8EDFEC GkfWSw 63.99902 fak_sw_b32 -32.00000 31.99902 FORMAT "%8.5"
 /begin AXIS_DESCR COM_AXIS nmot_w nmot_uw_q0p25 7 0.00 16383.75 FORMAT "%8.2" AXIS_PTS_REF SNM07LSUW /end AXIS_DESCR
 /begin AXIS_DESCR COM_AXIS rl_w rel_uw_q0p0234 8 0.00 1535.977 FORMAT "%8.3" AXIS_PTS_REF SRL08LSUW /end AXIS_DESCR
/end CHARACTERISTIC
/begin CHARACTERISTIC KFLRSG2 "" MAP 0x8EE05C GkfWUw 63.99902 fak_uw_b64_1 0.00 63.99902 FORMAT "%8.5"
 /begin AXIS_DESCR COM_AXIS nmot_w nmot_uw_q0p25 7 0.00 16383.75 FORMAT "%8.2" AXIS_PTS_REF SNM07LSUW /end AXIS_DESCR
 /begin AXIS_DESCR COM_AXIS rl_w rel_uw_q0p0234 8 0.00 1535.977 FORMAT "%8.3" AXIS_PTS_REF SRL08LSUW /end AXIS_DESCR
/end CHARACTERISTIC
/begin CHARACTERISTIC KFLRSG22 "" MAP 0x8EE0CC GkfWUw 63.99902 fak_uw_b64_1 0.00 63.99902 FORMAT "%8.5"
 /begin AXIS_DESCR COM_AXIS nmot_w nmot_uw_q0p25 7 0.00 16383.75 FORMAT "%8.2" AXIS_PTS_REF SNM07LSUW /end AXIS_DESCR
 /begin AXIS_DESCR COM_AXIS rl_w rel_uw_q0p0234 8 0.00 1535.977 FORMAT "%8.3" AXIS_PTS_REF SRL08LSUW /end AXIS_DESCR
/end CHARACTERISTIC
/begin CHARACTERISTIC KFLRSG4 "" MAP 0x8EE13C GkfWSw 3.999939 fak_sw_b2_1 -2.000000 1.999939 FORMAT "%8.6"
 /begin AXIS_DESCR COM_AXIS nmot_w nmot_uw_q0p25 7 0.00 16383.75 FORMAT "%8.2" AXIS_PTS_REF SNM07LSUW /end AXIS_DESCR
 /begin AXIS_DESCR COM_AXIS rl_w rel_uw_q0p0234 8 0.00 1535.977 FORMAT "%8.3" AXIS_PTS_REF SRL08LSUW /end AXIS_DESCR
/end CHARACTERISTIC
/begin CHARACTERISTIC KFLRSG42 "" MAP 0x8EE1AC GkfWSw 3.999939 fak_sw_b2_1 -2.000000 1.999939 FORMAT "%8.6"
 /begin AXIS_DESCR COM_AXIS nmot_w nmot_uw_q0p25 7 0.00 16383.75 FORMAT "%8.2" AXIS_PTS_REF SNM07LSUW /end AXIS_DESCR
 /begin AXIS_DESCR COM_AXIS rl_w rel_uw_q0p0234 8 0.00 1535.977 FORMAT "%8.3" AXIS_PTS_REF SRL08LSUW /end AXIS_DESCR
/end CHARACTERISTIC
/begin CHARACTERISTIC KFLRSP1 "" MAP 0x8EE21C GkfWUw 127.9980 fak_uw_b128 0.00 127.9980 FORMAT "%8.4"
 /begin AXIS_DESCR COM_AXIS nmot_w nmot_uw_q0p25 7 0.00 16383.75 FORMAT "%8.2" AXIS_PTS_REF SNM07LSUW /end AXIS_DESCR
 /begin AXIS_DESCR COM_AXIS rl_w rel_uw_q0p0234 8 0.00 1535.977 FORMAT "%8.3" AXIS_PTS_REF SRL08LSUW /end AXIS_DESCR
/end CHARACTERISTIC
/begin CHARACTERISTIC KFLRSP12 "" MAP 0x8EE28C GkfWUw 127.9980 fak_uw_b128 0.00 127.9980 FORMAT "%8.4"
 /begin AXIS_DESCR COM_AXIS nmot_w nmot_uw_q0p25 7 0.00 16383.75 FORMAT "%8.2" AXIS_PTS_REF SNM07LSUW /end AXIS_DESCR
 /begin AXIS_DESCR COM_AXIS rl_w rel_uw_q0p0234 8 0.00 1535.977 FORMAT "%8.3" AXIS_PTS_REF SRL08LSUW /end AXIS_DESCR
/end CHARACTERISTIC
/begin CHARACTERISTIC KFLRSP2 "" MAP 0x8EE2FC GkfWUw 127.9980 fak_uw_b128 0.00 127.9980 FORMAT "%8.4"
 /begin AXIS_DESCR COM_AXIS nmot_w nmot_uw_q0p25 7 0.00 16383.75 FORMAT "%8.2" AXIS_PTS_REF SNM07LSUW /end AXIS_DESCR
 /begin AXIS_DESCR COM_AXIS rl_w rel_uw_q0p0234 8 0.00 1535.977 FORMAT "%8.3" AXIS_PTS_REF SRL08LSUW /end AXIS_DESCR
/end CHARACTERISTIC
/begin CHARACTERISTIC KFLRSP22 "" MAP 0x8EE36C GkfWUw 127.9980 fak_uw_b128 0.00 127.9980 FORMAT "%8.4"
 /begin AXIS_DESCR COM_AXIS nmot_w nmot_uw_q0p25 7 0.00 16383.75 FORMAT "%8.2" AXIS_PTS_REF SNM07LSUW /end AXIS_DESCR
 /begin AXIS_DESCR COM_AXIS rl_w rel_uw_q0p0234 8 0.00 1535.977 FORMAT "%8.3" AXIS_PTS_REF SRL08LSUW /end AXIS_DESCR
/end CHARACTERISTIC
/begin CHARACTERISTIC KFLRSP3 "" MAP 0x8EE3DC GkfWUw 127.9980 fak_uw_b128 0.00 127.9980 FORMAT "%8.4"
 /begin AXIS_DESCR COM_AXIS nmot_w nmot_uw_q0p25 7 0.00 16383.75 FORMAT "%8.2" AXIS_PTS_REF SNM07LSUW /end AXIS_DESCR
 /begin AXIS_DESCR COM_AXIS rl_w rel_uw_q0p0234 8 0.00 1535.977 FORMAT "%8.3" AXIS_PTS_REF SRL08LSUW /end AXIS_DESCR
/end CHARACTERISTIC
/begin CHARACTERISTIC KFLRSP32 "" MAP 0x8EE44C GkfWUw 127.9980 fak_uw_b128 0.00 127.9980 FORMAT "%8.4"
 /begin AXIS_DESCR COM_AXIS nmot_w nmot_uw_q0p25 7 0.00 16383.75 FORMAT "%8.2" AXIS_PTS_REF SNM07LSUW /end AXIS_DESCR
 /begin AXIS_DESCR COM_AXIS rl_w rel_uw_q0p0234 8 0.00 1535.977 FORMAT "%8.3" AXIS_PTS_REF SRL08LSUW /end AXIS_DESCR
/end CHARACTERISTIC
/begin CHARACTERISTIC KFLRSP4 "" MAP 0x8EE4BC GkfWSw 127.9980 fak_sw_b64 -64.00000 63.99805 FORMAT "%8.5"
 /begin AXIS_DESCR COM_AXIS nmot_w nmot_uw_q0p25 7 0.00 16383.75 FORMAT "%8.2" AXIS_PTS_REF SNM07LSUW /end AXIS_DESCR
 /begin AXIS_DESCR COM_AXIS rl_w rel_uw_q0p0234 8 0.00 1535.977 FORMAT "%8.3" AXIS_PTS_REF SRL08LSUW /end AXIS_DESCR
/end CHARACTERISTIC
/begin CHARACTERISTIC KFLRSP42 "" MAP 0x8EE52C GkfWSw 127.9980 fak_sw_b64 -64.00000 63.99805 FORMAT "%8.5"
 /begin AXIS_DESCR COM_AXIS nmot_w nmot_uw_q0p25 7 0.00 16383.75 FORMAT "%8.2" AXIS_PTS_REF SNM07LSUW /end AXIS_DESCR
 /begin AXIS_DESCR COM_AXIS rl_w rel_uw_q0p0234 8 0.00 1535.977 FORMAT "%8.3" AXIS_PTS_REF SRL08LSUW /end AXIS_DESCR
/end CHARACTERISTIC
/begin CHARACTERISTIC KFLSDWA "" MAP 0x8ECD1C KfAxUbAyUbSstxSwSstyUbWUw 99.99847 rel_uw_b100 0.00 99.99847 FORMAT "%8.5"
 /begin AXIS_DESCR STD_AXIS dnitu_w nmotd_sw_q0p25 8 -8192.000 8191.750 FORMAT "%8.3" DEPOSIT ABSOLUTE /end AXIS_DESCR
 /begin AXIS_DESCR STD_AXIS gangist dez 3 0.00 255.0 FORMAT "%5.1" DEPOSIT ABSOLUTE /end AXIS_DESCR
/end CHARACTERISTIC
/begin CHARACTERISTIC KFMDBGRG "" MAP 0x8EBF50 KfAxUwAyUwSstxUwSstyUwWUw 99.99847 rel_uw_b100 0.00 99.99847 FORMAT "%8.5"
 /begin AXIS_DESCR STD_AXIS nmot nmot_ub_q40 4 0.00 10200. FORMAT "%5.0" DEPOSIT ABSOLUTE /end AXIS_DESCR
 /begin AXIS_DESCR STD_AXIS gangi dez 7 0.00 255.0 FORMAT "%5.1" DEPOSIT ABSOLUTE /end AXIS_DESCR
/end CHARACTERISTIC
/begin CHARACTERISTIC KFMDDLWS "" MAP 0x8EBDD8 KfAxSwAySwSstxSwSstySwWSw 99.99847 rel_uw_b100 -50.00000 49.99847 FORMAT "%8.5"
 /begin AXIS_DESCR STD_AXIS dlwsu_w dlw_sw_q0p04375 6 -1434.044 1434.000 FORMAT "%8.3" DEPOSIT ABSOLUTE /end AXIS_DESCR
 /begin AXIS_DESCR STD_AXIS lws_w lw_sw_q0p04375 6 -1434.044 1434.000 FORMAT "%8.3" DEPOSIT ABSOLUTE /end AXIS_DESCR
/end CHARACTERISTIC
/begin CHARACTERISTIC KFMDELMX "" MAP 0x8EBE3C KfAxUbAyUbSstxUwSstyUwWUw 99.99847 rel_uw_b100 0.00 99.99847 FORMAT "%8.5"
 /begin AXIS_DESCR STD_AXIS nmot nmot_ub_q40 6 0.00 10200. FORMAT "%5.0" DEPOSIT ABSOLUTE /end AXIS_DESCR
 /begin AXIS_DESCR STD_AXIS tans temp_ub_q0p75_o48 3 -48.00 143.3 FORMAT "%5.1" DEPOSIT ABSOLUTE /end AXIS_DESCR
/end CHARACTERISTIC
/begin CHARACTERISTIC KFMDGEN "" MAP 0x8E2DCD KfAxUbAyUbSstxUbSstyUbWUb 49.80 rel_q0p1953 0.00 49.80 FORMAT "%5.2"
 /begin AXIS_DESCR STD_AXIS nmot nmot_ub_q40 5 0.00 10200. FORMAT "%5.0" DEPOSIT ABSOLUTE /end AXIS_DESCR
 /begin AXIS_DESCR STD_AXIS kldfpwm rel_ub_b99p6 6 0.00 99.61 FORMAT "%5.2" DEPOSIT ABSOLUTE /end AXIS_DESCR
/end CHARACTERISTIC
/begin CHARACTERISTIC KFMDKO "" MAP 0x8E2DF8 GkfWUb 49.80 rel_q0p1953 0.00 49.80 FORMAT "%5.2"
 /begin AXIS_DESCR COM_AXIS nmot nmot_ub_q40 6 0.00 10200. FORMAT "%5.0" AXIS_PTS_REF SNM06KOUB /end AXIS_DESCR
 /begin AXIS_DESCR COM_AXIS tlok temp_ub_q0p75_o48 6 -48.00 143.3 FORMAT "%5.1" AXIS_PTS_REF STA06LLUB /end AXIS_DESCR
/end CHARACTERISTIC
/begin CHARACTERISTIC KFMDPKO "" MAP 0x8E2E1C GkfWUb 49.80 rel_q0p1953 0.00 49.80 FORMAT "%5.2"
 /begin AXIS_DESCR COM_AXIS nmot nmot_ub_q40 6 0.00 10200. FORMAT "%5.0" AXIS_PTS_REF SNM06KOUB /end AXIS_DESCR
 /begin AXIS_DESCR COM_AXIS pkodrc p_q0p2 6 0.00 51.00 FORMAT "%5.2" AXIS_PTS_REF SKO06PKO /end AXIS_DESCR
/end CHARACTERISTIC
/begin CHARACTERISTIC KFMDPKOME "" MAP 0x8E2E40 GkfWSb 99.60 rel_sb_q0p39 -50.00 49.61 FORMAT "%5.2"
 /begin AXIS_DESCR COM_AXIS nmot nmot_ub_q40 6 0.00 10200. FORMAT "%5.0" AXIS_PTS_REF SNM06KOUB /end AXIS_DESCR
 /begin AXIS_DESCR COM_AXIS pkodrc p_q0p2 6 0.00 51.00 FORMAT "%5.2" AXIS_PTS_REF SKO06PKO /end AXIS_DESCR
/end CHARACTERISTIC
/begin CHARACTERISTIC KFMDPWM "" MAP 0x8E2E64 GkfWUb 49.80 rel_q0p1953 0.00 49.80 FORMAT "%5.2"
 /begin AXIS_DESCR COM_AXIS nmot nmot_ub_q40 6 0.00 10200. FORMAT "%5.0" AXIS_PTS_REF SNM06KOUB /end AXIS_DESCR
 /begin AXIS_DESCR COM_AXIS takols dez 6 0.00 255.0 FORMAT "%5.1" AXIS_PTS_REF SKO06KOUB /end AXIS_DESCR
/end CHARACTERISTIC
/begin CHARACTERISTIC KFMDPWME "" MAP 0x8E2E88 GkfWSb 99.60 rel_sb_q0p39 -50.00 49.61 FORMAT "%5.2"
 /begin AXIS_DESCR COM_AXIS nmot nmot_ub_q40 6 0.00 10200. FORMAT "%5.0" AXIS_PTS_REF SNM06KOUB /end AXIS_DESCR
 /begin AXIS_DESCR COM_AXIS takols dez 6 0.00 255.0 FORMAT "%5.1" AXIS_PTS_REF SKO06KOUB /end AXIS_DESCR
/end CHARACTERISTIC
/begin CHARACTERISTIC KFMDRKO "" MAP 0x8E2EAC GkfWUb 49.80 rel_q0p1953 0.00 49.80 FORMAT "%5.2"
 /begin AXIS_DESCR COM_AXIS nmot nmot_ub_q40 6 0.00 10200. FORMAT "%5.0" AXIS_PTS_REF SNM06KOUB /end AXIS_DESCR
 /begin AXIS_DESCR COM_AXIS rl rel_ub_q0p75 6 0.00 191.3 FORMAT "%5.1" AXIS_PTS_REF SRL06KOUB /end AXIS_DESCR
/end CHARACTERISTIC
/begin CHARACTERISTIC KFMDRKOE "" MAP 0x8E2ED0 GkfWSb 99.60 rel_sb_q0p39 -50.00 49.61 FORMAT "%5.2"
 /begin AXIS_DESCR COM_AXIS nmot nmot_ub_q40 6 0.00 10200. FORMAT "%5.0" AXIS_PTS_REF SNM06KOUB /end AXIS_DESCR
 /begin AXIS_DESCR COM_AXIS rl rel_ub_q0p75 6 0.00 191.3 FORMAT "%5.1" AXIS_PTS_REF SRL06KOUB /end AXIS_DESCR
/end CHARACTERISTIC
/begin CHARACTERISTIC KFMDS "" MAP 0x8ED8A0 GkfWUw 99.99847 rel_uw_b100 0.00 99.99847 FORMAT "%8.5"
 /begin AXIS_DESCR COM_AXIS nmot_w nmot_uw_q0p25 16 0.00 16383.75 FORMAT "%8.2" AXIS_PTS_REF SNM16__UW /end AXIS_DESCR
 /begin AXIS_DESCR COM_AXIS dpsu_w p_uw_q0p039 11 0.00 2559.961 FORMAT "%8.3" AXIS_PTS_REF SPS11MDUW /end AXIS_DESCR
/end CHARACTERISTIC
/begin CHARACTERISTIC KFMDWMX "" MAP 0x8E2CAB KfAxUbAyUbSstxUbSstyUbWUb 99.61 rel_ub_b99p6 0.00 99.61 FORMAT "%5.2"
 /begin AXIS_DESCR STD_AXIS vfzg vfzg_ub_q1p25 6 0.00 318.8 FORMAT "%5.1" DEPOSIT ABSOLUTE /end AXIS_DESCR
 /begin AXIS_DESCR STD_AXIS tmot temp_ub_q0p75_o48 8 -48.00 143.3 FORMAT "%5.1" DEPOSIT ABSOLUTE /end AXIS_DESCR
/end CHARACTERISTIC
/begin CHARACTERISTIC KFMIFABG "" MAP 0x8ECFFC KfAxUwAyUwSstxSwSstyUwWUw 99.99847 rel_uw_b100 0.00 99.99847 FORMAT "%8.5"
 /begin AXIS_DESCR STD_AXIS mkfa_w rel_sw_b50 8 -50.00000 49.99847 FORMAT "%8.5" DEPOSIT ABSOLUTE /end AXIS_DESCR
 /begin AXIS_DESCR STD_AXIS nmot_w nmot_uw_q0p25 8 0.00 16383.75 FORMAT "%8.2" DEPOSIT ABSOLUTE /end AXIS_DESCR
/end CHARACTERISTIC
/begin CHARACTERISTIC KFMIFABGWK "" MAP 0x8ED0A0 KfAxUwAyUwSstxSwSstyUwWUw 99.99847 rel_uw_b100 0.00 99.99847 FORMAT "%8.5"
 /begin AXIS_DESCR STD_AXIS mkfa_w rel_sw_b50 8 -50.00000 49.99847 FORMAT "%8.5" DEPOSIT ABSOLUTE /end AXIS_DESCR
 /begin AXIS_DESCR STD_AXIS nmot_w nmot_uw_q0p25 4 0.00 16383.75 FORMAT "%8.2" DEPOSIT ABSOLUTE /end AXIS_DESCR
/end CHARACTERISTIC
/begin CHARACTERISTIC KFMIFALS "" MAP 0x8ED0FC KfAxUbAyUbSstxUbSstyUwWUw 99.99847 rel_uw_b100 0.00 99.99847 FORMAT "%8.5"
 /begin AXIS_DESCR STD_AXIS gangi dez 8 0.00 255.0 FORMAT "%5.1" DEPOSIT ABSOLUTE /end AXIS_DESCR
 /begin AXIS_DESCR STD_AXIS mifak_w rel_uw_b100 8 0.00 99.99847 FORMAT "%8.5" DEPOSIT ABSOLUTE /end AXIS_DESCR
/end CHARACTERISTIC
/begin CHARACTERISTIC KFMILSD "" MAP 0x8ED196 KfAxUwAyUwSstxUwSstyUwWUw 99.99847 rel_uw_b100 0.00 99.99847 FORMAT "%8.5"
 /begin AXIS_DESCR STD_AXIS mivbeb_w rel_uw_b100 6 0.00 99.99847 FORMAT "%8.5" DEPOSIT ABSOLUTE /end AXIS_DESCR
 /begin AXIS_DESCR STD_AXIS nmot_w nmot_uw_q0p25 8 0.00 16383.75 FORMAT "%8.2" DEPOSIT ABSOLUTE /end AXIS_DESCR
/end CHARACTERISTIC
/begin CHARACTERISTIC KFMIMN "" MAP 0x8EBCF4 KfAxUbAyUbSstxUbSstyUwWUw 99.99847 rel_uw_b100 0.00 99.99847 FORMAT "%8.5"
 /begin AXIS_DESCR STD_AXIS gangi dez 8 0.00 255.0 FORMAT "%5.1" DEPOSIT ABSOLUTE /end AXIS_DESCR
 /begin AXIS_DESCR STD_AXIS nmot_w nmot_uw_q0p25 8 0.00 16383.75 FORMAT "%8.2" DEPOSIT ABSOLUTE /end AXIS_DESCR
/end CHARACTERISTIC
/begin CHARACTERISTIC KFMIOP "" MAP 0x8ED73C GkfWUw 99.99847 rel_uw_b100 0.00 99.99847 FORMAT "%8.5"
 /begin AXIS_DESCR COM_AXIS nmot_w nmot_uw_q0p25 16 0.00 16383.75 FORMAT "%8.2" AXIS_PTS_REF SNM16OPUW /end AXIS_DESCR
 /begin AXIS_DESCR COM_AXIS rl_w rel_uw_q0p0234 11 0.00 1535.977 FORMAT "%8.3" AXIS_PTS_REF SRL11OPUW /end AXIS_DESCR
/end CHARACTERISTIC
/begin CHARACTERISTIC KFMIRL "" MAP 0x8E9FE4 GkfWUw 1535.977 rel_uw_q0p0234 0.00 1535.977 FORMAT "%8.3"
 /begin AXIS_DESCR COM_AXIS nmot_w nmot_uw_q0p25 16 0.00 16383.75 FORMAT "%8.2" AXIS_PTS_REF SNM16OPUW /end AXIS_DESCR
 /begin AXIS_DESCR COM_AXIS misopl1n_w rel_uw_b100 12 0.00 99.99847 FORMAT "%8.5" AXIS_PTS_REF SMI12OPUW /end AXIS_DESCR
/end CHARACTERISTIC
/begin CHARACTERISTIC KFPED "" MAP 0x8ED216 GkfWUw 199.9969 rel_uw_b200 0.00 199.9969 FORMAT "%8.4"
 /begin AXIS_DESCR COM_AXIS wped_w relPED_q0p00153 16 0.00 100.0000 FORMAT "%8.4" AXIS_PTS_REF SWP16MDUW /end AXIS_DESCR
 /begin AXIS_DESCR COM_AXIS nmot_w nmot_uw_q0p25 12 0.00 16383.75 FORMAT "%8.2" AXIS_PTS_REF SNM12MDUW /end AXIS_DESCR
/end CHARACTERISTIC
/begin CHARACTERISTIC KFPEDL "" MAP 0x8ED396 GkfWUw 199.9969 rel_uw_b200 0.00 199.9969 FORMAT "%8.4"
 /begin AXIS_DESCR COM_AXIS wped_w relPED_q0p00153 16 0.00 100.0000 FORMAT "%8.4" AXIS_PTS_REF SWP16MDUW /end AXIS_DESCR
 /begin AXIS_DESCR COM_AXIS nmot_w nmot_uw_q0p25 12 0.00 16383.75 FORMAT "%8.2" AXIS_PTS_REF SNM12MDUW /end AXIS_DESCR
/end CHARACTERISTIC
/begin CHARACTERISTIC KFPEDR "" MAP 0x8ED516 GkfWUw 199.9969 rel_uw_b200 0.00 199.9969 FORMAT "%8.4"
 /begin AXIS_DESCR COM_AXIS wped_w relPED_q0p00153 16 0.00 100.0000 FORMAT "%8.4" AXIS_PTS_REF SWP16MDUW /end AXIS_DESCR
 /begin AXIS_DESCR COM_AXIS nmot_w nmot_uw_q0p25 12 0.00 16383.75 FORMAT "%8.2" AXIS_PTS_REF SNM12MDUW /end AXIS_DESCR
/end CHARACTERISTIC
/begin CHARACTERISTIC KFRAT "" CURVE 0x8EA7BC KlAUbSstUbWUw 0.1999664 fak_uw_b5 0.00 0.1999664 FORMAT "%9.7"
 /begin AXIS_DESCR STD_AXIS dlrfrat fak_q0p0625 5 0.00 15.94 FORMAT "%5.2" DEPOSIT ABSOLUTE /end AXIS_DESCR
/end CHARACTERISTIC
/begin CHARACTERISTIC KFRLMN "" MAP 0x8E1486 GkfWUb 191.3 rel_ub_q0p75 0.00 191.3 FORMAT "%5.1"
 /begin AXIS_DESCR COM_AXIS nmot nmot_ub_q40 12 0.00 10200. FORMAT "%5.0" AXIS_PTS_REF SNM12FEUB /end AXIS_DESCR
 /begin AXIS_DESCR COM_AXIS tmot temp_ub_q0p75_o48 6 -48.00 143.3 FORMAT "%5.1" AXIS_PTS_REF STM06__UB /end AXIS_DESCR
/end CHARACTERISTIC
/begin CHARACTERISTIC KFRLMNSA "" MAP 0x8E14CE GkfWUb 191.3 rel_ub_q0p75 0.00 191.3 FORMAT "%5.1"
 /begin AXIS_DESCR COM_AXIS nmot nmot_ub_q40 12 0.00 10200. FORMAT "%5.0" AXIS_PTS_REF SNM12FEUB /end AXIS_DESCR
 /begin AXIS_DESCR COM_AXIS tmot temp_ub_q0p75_o48 6 -48.00 143.3 FORMAT "%5.1" AXIS_PTS_REF STM06__UB /end AXIS_DESCR
/end CHARACTERISTIC
/begin CHARACTERISTIC KFRLMNST "" MAP 0x8E9F80 KfAxUwAyUwSstxUwSstyUwWUw 1535.977 rel_uw_q0p0234 0.00 1535.977 FORMAT "%8.3"
 /begin AXIS_DESCR STD_AXIS anztib_w dez 6 0.00 65535.00 FORMAT "%8.2" DEPOSIT ABSOLUTE /end AXIS_DESCR
 /begin AXIS_DESCR STD_AXIS tmst_w temp_uw_q0p75_o48 6 -48.00000 49103.25 FORMAT "%8.2" DEPOSIT ABSOLUTE /end AXIS_DESCR
/end CHARACTERISTIC
/begin CHARACTERISTIC KFUSHK "" MAP 0x8E3623 KfAxUbAyUbSstxUbSstyUbWUb 1.330 spg_ub_q0p0052_o0p2 -0.2000 1.130 FORMAT "%5.3"
 /begin AXIS_DESCR STD_AXIS nmot nmot_ub_q40 10 0.00 10200. FORMAT "%5.0" DEPOSIT ABSOLUTE /end AXIS_DESCR
 /begin AXIS_DESCR STD_AXIS rl rel_ub_q0p75 10 0.00 191.3 FORMAT "%5.1" DEPOSIT ABSOLUTE /end AXIS_DESCR
/end CHARACTERISTIC
/begin CHARACTERISTIC KFVERST "" MAP 0x8EBD8E KfAxUwAyUwSstxUwSstyUwWUw 7.999878 fak_uw_b8 0.00 7.999878 FORMAT "%8.6"
 /begin AXIS_DESCR STD_AXIS wped_w relPED_q0p00153 3 0.00 100.0000 FORMAT "%8.4" DEPOSIT ABSOLUTE /end AXIS_DESCR
 /begin AXIS_DESCR STD_AXIS nmot_w nmot_uw_q0p25 3 0.00 16383.75 FORMAT "%8.2" DEPOSIT ABSOLUTE /end AXIS_DESCR
/end CHARACTERISTIC
/begin CHARACTERISTIC KFWMIFABG "" MAP 0x8E30AA KfAxUbAyUbSstxUbSstyUbWUb 2.984 fak_ub_b4 1.000 3.984 FORMAT "%5.3"
 /begin AXIS_DESCR STD_AXIS wped relPED_ub_b100 4 0.00 100.0 FORMAT "%5.1" DEPOSIT ABSOLUTE /end AXIS_DESCR
 /begin AXIS_DESCR STD_AXIS nmot nmot_ub_q40 4 0.00 10200. FORMAT "%5.0" DEPOSIT ABSOLUTE /end AXIS_DESCR
/end CHARACTERISTIC
/begin CHARACTERISTIC KFWMIFAL "" MAP 0x8E30C4 KfAxUbAyUbSstxUbSstyUbWUb 2.984 fak_ub_b4 1.000 3.984 FORMAT "%5.3"
 /begin AXIS_DESCR STD_AXIS wped relPED_ub_b100 4 0.00 100.0 FORMAT "%5.1" DEPOSIT ABSOLUTE /end AXIS_DESCR
 /begin AXIS_DESCR STD_AXIS nmot nmot_ub_q40 4 0.00 10200. FORMAT "%5.0" DEPOSIT ABSOLUTE /end AXIS_DESCR
/end CHARACTERISTIC
/begin CHARACTERISTIC KFWZLSD "" MAP 0x8E30DE KfAxUbAyUbSstxUbSstyUbWUb 0.9961 fak_ub_b1 0.00 0.9961
 /begin AXIS_DESCR STD_AXIS wped relPED_ub_b100 4 0.00 100.0 FORMAT "%5.1" DEPOSIT ABSOLUTE /end AXIS_DESCR
 /begin AXIS_DESCR STD_AXIS nmot nmot_ub_q40 4 0.00 10200. FORMAT "%5.0" DEPOSIT ABSOLUTE /end AXIS_DESCR
/end CHARACTERISTIC
/begin CHARACTERISTIC KFZDASH "" MAP 0x8ECD62 GkfWUw 81.880000000 zk10msxs_uw_b655 0.040000000000 81.920000000 FORMAT "%12.9"
 /begin AXIS_DESCR COM_AXIS gangi dez 8 0.00 255.0 FORMAT "%5.1" AXIS_PTS_REF SGA08MDUB /end AXIS_DESCR
 /begin AXIS_DESCR COM_AXIS nmot_w nmot_uw_q0p25 6 0.00 16383.75 FORMAT "%8.2" AXIS_PTS_REF SNM06MDUW /end AXIS_DESCR
/end CHARACTERISTIC
/begin CHARACTERISTIC KFZDASH2 "" MAP 0x8ECDC2 GkfWUw 81.880000000 zk10msxs_uw_b655 0.040000000000 81.920000000 FORMAT "%12.9"
 /begin AXIS_DESCR COM_AXIS gangi dez 8 0.00 255.0 FORMAT "%5.1" AXIS_PTS_REF SGA08MDUB /end AXIS_DESCR
 /begin AXIS_DESCR COM_AXIS nmot_w nmot_uw_q0p25 6 0.00 16383.75 FORMAT "%8.2" AXIS_PTS_REF SNM06MDUW /end AXIS_DESCR
/end CHARACTERISTIC
/begin CHARACTERISTIC KFZLSD "" MAP 0x8ECE22 GkfWUw 655.34999985 zk10msxs_uw_b655 0.010000152590 655.36000000 FORMAT "%12.8"
 /begin AXIS_DESCR COM_AXIS gangi dez 8 0.00 255.0 FORMAT "%5.1" AXIS_PTS_REF SGA08MDUB /end AXIS_DESCR
 /begin AXIS_DESCR COM_AXIS nmot_w nmot_uw_q0p25 6 0.00 16383.75 FORMAT "%8.2" AXIS_PTS_REF SNM06MDUW /end AXIS_DESCR
/end CHARACTERISTIC
/begin CHARACTERISTIC KFZWOP "" MAP 0x8E31F1 GkfWSb 191.3 zw_sb_q0p75 -96.00 95.25 FORMAT "%5.2"
 /begin AXIS_DESCR COM_AXIS nmot_w nmot_uw_q0p25 16 0.00 16383.75 FORMAT "%8.2" AXIS_PTS_REF SNM16OPUW /end AXIS_DESCR
 /begin AXIS_DESCR COM_AXIS rl_w rel_uw_q0p0234 11 0.00 1535.977 FORMAT "%8.3" AXIS_PTS_REF SRL11OPUW /end AXIS_DESCR
/end CHARACTERISTIC
/begin CHARACTERISTIC KILRHML "" CURVE 0x8E369D GklWUb 0.04980 freq_ub_b0p05 0.00 0.04980 FORMAT "%7.5"
 /begin AXIS_DESCR COM_AXIS ml m_ub_b1020 8 0.00 1020. FORMAT "%5.0" AXIS_PTS_REF SML08LHUB /end AXIS_DESCR
/end CHARACTERISTIC
/begin CHARACTERISTIC KLASGP "" CURVE 0x8EDABA KlAUwSstSwWUw 3.124952 relnmot_q0p477Em4 0.00 3.124952 FORMAT "%8.6"
 /begin AXIS_DESCR STD_AXIS dnasg_w nmot_uw_q0p25 7 -8192.000 8191.750 FORMAT "%8.3" DEPOSIT ABSOLUTE /end AXIS_DESCR
/end CHARACTERISTIC
/begin CHARACTERISTIC KLASGPL "" CURVE 0x8EDAD8 KlAUwSstSwWUw 3.124952 relnmot_q0p477Em4 0.00 3.124952 FORMAT "%8.6"
 /begin AXIS_DESCR STD_AXIS dnasgl_w nmot_uw_q0p25 7 -8192.000 8191.750 FORMAT "%8.3" DEPOSIT ABSOLUTE /end AXIS_DESCR
/end CHARACTERISTIC
/begin CHARACTERISTIC KLFMKNM "" CURVE 0x8EBE76 KlAUwSstUwWUw 6.999878 fak_uw_b8 1.000000 7.999878 FORMAT "%8.6"
 /begin AXIS_DESCR STD_AXIS nmot nmot_ub_q40 4 0.00 10200. FORMAT "%5.0" DEPOSIT ABSOLUTE /end AXIS_DESCR
/end CHARACTERISTIC
/begin CHARACTERISTIC KLFRTMKI "" CURVE 0x8E34E1 KlAUbSstUbWUb 1.992 fak_ub_b2 0.00 1.992 FORMAT "%5.3"
 /begin AXIS_DESCR STD_AXIS tmotmdb temp_ub_q0p75_o48 4 -48.00 143.3 FORMAT "%5.1" DEPOSIT ABSOLUTE /end AXIS_DESCR
/end CHARACTERISTIC
/begin CHARACTERISTIC KLMDLFTV "" CURVE 0x8E2F23 KlAUbSstUbWUb 24.91 rel_q0p0977 0.00 24.91 FORMAT "%5.2"
 /begin AXIS_DESCR STD_AXIS tvlues1 tv_ub_b100 4 0.00 99.61 FORMAT "%5.2" DEPOSIT ABSOLUTE /end AXIS_DESCR
/end CHARACTERISTIC
/begin CHARACTERISTIC KLMIMNH "" CURVE 0x8EBDB0 KlAUbSstUbWSb 49.80 rel_sb_b25 -25.00 24.80 FORMAT "%5.2"
 /begin AXIS_DESCR STD_AXIS fho fak_ub_b4 6 0.00 3.984 FORMAT "%5.3" DEPOSIT ABSOLUTE /end AXIS_DESCR
/end CHARACTERISTIC
/begin CHARACTERISTIC KLMRKFHO "" CURVE 0x8EDA52 KlAUwSstUwWUb 15.94 fak_ub_b16 0.00 15.94 FORMAT "%5.2"
 /begin AXIS_DESCR STD_AXIS fho_w fak_uw_b4 3 0.00 3.999939 FORMAT "%8.6" DEPOSIT ABSOLUTE /end AXIS_DESCR
/end CHARACTERISTIC
/begin CHARACTERISTIC KLTMIVOR "" CURVE 0x8EDB1E KlAUwSstUwWUw 655.34999985 zk10msxs_uw_b655 0.010000152590 655.36000000 FORMAT "%12.8"
 /begin AXIS_DESCR STD_AXIS tmot temp_ub_q0p75_o48 4 -48.00 143.3 FORMAT "%5.1" DEPOSIT ABSOLUTE /end AXIS_DESCR
/end CHARACTERISTIC
/begin CHARACTERISTIC KPLRHML "" CURVE 0x8E36A5 GklWUb 3.984 fak_ub_b4 0.00 3.984 FORMAT "%5.3"
 /begin AXIS_DESCR COM_AXIS ml m_ub_b1020 8 0.00 1020. FORMAT "%5.0" AXIS_PTS_REF SML08LHUB /end AXIS_DESCR
/end CHARACTERISTIC
/begin CHARACTERISTIC LADIFFTHR "" VALUE 0x8FECF6 KwSw 1.999969 fak_sw_b1 -1.000000 0.9999695 FORMAT "%8.6" /end CHARACTERISTIC
/begin CHARACTERISTIC LAKAMSAIML "" MAP 0x8EE75A KfAxUbAyUbSstxUwSstyUwWUw 1.000000 fak_uw_b16 0.00 1.000000 FORMAT "%8.6"
 /begin AXIS_DESCR STD_AXIS msabvhk_w m_uw_b6553p5 5 0.00 6553.500 FORMAT "%8.3" DEPOSIT ABSOLUTE /end AXIS_DESCR
 /begin AXIS_DESCR STD_AXIS imslaka_w m_uw_b291p25 5 0.00 291.2667 FORMAT "%8.4" DEPOSIT ABSOLUTE /end AXIS_DESCR
/end CHARACTERISTIC
/begin CHARACTERISTIC LALIUSH "" CURVE 0x8EE666 KlAUwSstUwWUw 15.99976 fak_uw_b16 0.00 15.99976 FORMAT "%8.5"
 /begin AXIS_DESCR STD_AXIS ushk_w spg_uw_q0p00488_o1 10 -1.000000 318.9951 FORMAT "%8.4" DEPOSIT ABSOLUTE /end AXIS_DESCR
/end CHARACTERISTIC
/begin CHARACTERISTIC LALIUSH2 "" CURVE 0x8EE690 KlAUwSstUwWUw 15.99976 fak_uw_b16 0.00 15.99976 FORMAT "%8.5"
 /begin AXIS_DESCR STD_AXIS ushk2_w spg_uw_q0p00488_o1 10 -1.000000 318.9951 FORMAT "%8.4" DEPOSIT ABSOLUTE /end AXIS_DESCR
/end CHARACTERISTIC
/begin CHARACTERISTIC LALIUSMN "" VALUE 0x8FECF8 KwUw 15.99951 fak_uw_b16 0.0002441406 15.99976 FORMAT "%8.5" /end CHARACTERISTIC
/begin CHARACTERISTIC LALIUSRH "" CURVE 0x8EE6BA KlAUbSstUbWUw 15.99976 fak_uw_b16 0.00 15.99976 FORMAT "%8.5"
 /begin AXIS_DESCR STD_AXIS usrhk spg_ub_q0p0052_o0p2 10 -0.2000 1.130 FORMAT "%5.3" DEPOSIT ABSOLUTE /end AXIS_DESCR
/end CHARACTERISTIC
/begin CHARACTERISTIC LALIUSRH2 "" CURVE 0x8EE6DA KlAUbSstUbWUw 15.99976 fak_uw_b16 0.00 15.99976 FORMAT "%8.5"
 /begin AXIS_DESCR STD_AXIS usrhk2 spg_ub_q0p0052_o0p2 10 -0.2000 1.130 FORMAT "%5.3" DEPOSIT ABSOLUTE /end AXIS_DESCR
/end CHARACTERISTIC
/begin CHARACTERISTIC LAMKADEF "" VALUE 0x8EE7A4 KwUw 15.99976 fak_uw_b16 0.00 15.99976 FORMAT "%8.5" /end CHARACTERISTIC
/begin CHARACTERISTIC LAMLRAMN "" VALUE 0x8EAB76 KwUw 15.99976 fak_uw_b16 0.00 15.99976 FORMAT "%8.5" /end CHARACTERISTIC
/begin CHARACTERISTIC LAMLRAMX "" VALUE 0x8EAB78 KwUw 15.99976 fak_uw_b16 0.00 15.99976 FORMAT "%8.5" /end CHARACTERISTIC
/begin CHARACTERISTIC LAMSKAMX "" VALUE 0x8EE7A6 KwUw 15.99976 fak_uw_b16 0.00 15.99976 FORMAT "%8.5" /end CHARACTERISTIC
/begin CHARACTERISTIC LAMSKAMX2 "" VALUE 0x8EE7A8 KwUw 15.99976 fak_uw_b16 0.00 15.99976 FORMAT "%8.5" /end CHARACTERISTIC
/begin CHARACTERISTIC LAMSONMN "" VALUE 0x8EE65C KwUw 15.99976 fak_uw_b16 0.00 15.99976 FORMAT "%8.5" /end CHARACTERISTIC
/begin CHARACTERISTIC LAMSONMX "" VALUE 0x8EE65E KwUw 15.99976 fak_uw_b16 0.00 15.99976 FORMAT "%8.5" /end CHARACTERISTIC
/begin CHARACTERISTIC LASHKAB "" VALUE 0x8FED0C KwSw 1.099976 fak_sw_b1 -0.1000061 0.9999695 FORMAT "%9.7" /end CHARACTERISTIC
/begin CHARACTERISTIC LRHIMN "" VALUE 0x8EE660 KwSw 1.999969 fak_sw_b1 -1.000000 0.9999695 FORMAT "%8.6" /end CHARACTERISTIC
/begin CHARACTERISTIC LRHIMX "" VALUE 0x8EE662 KwSw 1.999969 fak_sw_b1 -1.000000 0.9999695 FORMAT "%8.6" /end CHARACTERISTIC
/begin CHARACTERISTIC LRSGKTM "" CURVE 0x8E35E2 KlAUbSstUbWUb 1.992 fak_ub_b2 0.00 1.992 FORMAT "%5.3"
 /begin AXIS_DESCR STD_AXIS tmot temp_ub_q0p75_o48 6 -48.00 143.3 FORMAT "%5.1" DEPOSIT ABSOLUTE /end AXIS_DESCR
/end CHARACTERISTIC
/begin CHARACTERISTIC LWSER "" VALUE 0x8E2EF4 KwUb 49.80 rel_q0p1953 0.00 49.80 FORMAT "%5.2" /end CHARACTERISTIC
/begin CHARACTERISTIC MDATNM "" CURVE 0x8EBC98 GklWSw 99.99695 rel_sw_b100 0.00 99.99695 FORMAT "%8.5"
 /begin AXIS_DESCR COM_AXIS twnd temp_ub_q0p75_o48 8 -48.00 143.3 FORMAT "%5.1" AXIS_PTS_REF STW08MDUB /end AXIS_DESCR
/end CHARACTERISTIC
/begin CHARACTERISTIC MDATRM "" CURVE 0x8EBCA8 GklWSw 99.99695 rel_sw_b100 0.00 99.99695 FORMAT "%8.5"
 /begin AXIS_DESCR COM_AXIS twnd temp_ub_q0p75_o48 8 -48.00 143.3 FORMAT "%5.1" AXIS_PTS_REF STW08MDUB /end AXIS_DESCR
/end CHARACTERISTIC
/begin CHARACTERISTIC MDGAT "" CURVE 0x8EBFA2 KlAUwSstUwWUw 99.99847 rel_uw_b100 0.00 99.99847 FORMAT "%8.5"
 /begin AXIS_DESCR STD_AXIS nmot nmot_ub_q40 6 0.00 10200. FORMAT "%5.0" DEPOSIT ABSOLUTE /end AXIS_DESCR
/end CHARACTERISTIC
/begin CHARACTERISTIC MDGENOT "" CURVE 0x8EBFBC KlAUwSstUwWUw 99.99847 rel_uw_b100 0.00 99.99847 FORMAT "%8.5"
 /begin AXIS_DESCR STD_AXIS nmot nmot_ub_q40 6 0.00 10200. FORMAT "%5.0" DEPOSIT ABSOLUTE /end AXIS_DESCR
/end CHARACTERISTIC
/begin CHARACTERISTIC MDHFS "" VALUE 0x8E2EF5 KwUb 49.80 rel_q0p1953 0.00 49.80 FORMAT "%5.2" /end CHARACTERISTIC
/begin CHARACTERISTIC MDHHS "" VALUE 0x8E2EF6 KwUb 49.80 rel_q0p1953 0.00 49.80 FORMAT "%5.2" /end CHARACTERISTIC
/begin CHARACTERISTIC MDHYASG "" VALUE 0x8EDAF6 KwUw 10.00061 rel_uw_b100 0.00 10.00061 FORMAT "%8.5" /end CHARACTERISTIC
/begin CHARACTERISTIC MDHYEZ "" VALUE 0x8FD250 KwUb 99.61 rel_ub_b99p6 0.00 99.61 FORMAT "%5.2" /end CHARACTERISTIC
/begin CHARACTERISTIC MDSH "" CURVE 0x8EDA00 KlAUbSstUbWSb 49.90 rel_q0p1957 -25.05 24.85 FORMAT "%5.2"
 /begin AXIS_DESCR STD_AXIS fho fak_ub_b4 6 0.00 3.984 FORMAT "%5.3" DEPOSIT ABSOLUTE /end AXIS_DESCR
/end CHARACTERISTIC
/begin CHARACTERISTIC MDSL "" VALUE 0x8E2EF7 KwUb 49.80 rel_q0p1953 0.00 49.80 FORMAT "%5.2" /end CHARACTERISTIC
/begin CHARACTERISTIC MDSLP "" VALUE 0x8E2EF8 KwUb 99.61 rel_ub_b100 0.00 99.61 FORMAT "%5.2" /end CHARACTERISTIC
/begin CHARACTERISTIC MDSLPE "" VALUE 0x8E2EF9 KwSb 99.60 rel_sb_q0p39 -50.00 49.61 FORMAT "%5.2" /end CHARACTERISTIC
/begin CHARACTERISTIC MDSM "" CURVE 0x8EDA0E GklWUw 99.99847 rel_uw_b100 0.00 99.99847 FORMAT "%8.5"
 /begin AXIS_DESCR COM_AXIS tmot temp_ub_q0p75_o48 8 -48.00 143.3 FORMAT "%5.1" AXIS_PTS_REF STM08__UB /end AXIS_DESCR
/end CHARACTERISTIC
/begin CHARACTERISTIC MDWANER "" VALUE 0x8FD1A5 KwUb 99.61 rel_ub_b99p6 0.00 99.61 FORMAT "%5.2" /end CHARACTERISTIC
/begin CHARACTERISTIC MIADT1MX "" VALUE 0x8EDAF8 KwSw 199.9969 rel_sw_b100 -100.0000 99.99695 FORMAT "%8.4" /end CHARACTERISTIC
/begin CHARACTERISTIC MIASGLMX "" VALUE 0x8EDAFA KwUw 99.99847 rel_uw_b100 0.00 99.99847 FORMAT "%8.5" /end CHARACTERISTIC
/begin CHARACTERISTIC MIFAAPP "" VALUE 0x8FEB68 KwUw 99.99847 rel_uw_b100 0.00 99.99847 FORMAT "%8.5" /end CHARACTERISTIC
/begin CHARACTERISTIC MIFABGMX "" VALUE 0x8FEB6A KwUw 99.99847 rel_uw_b100 0.00 99.99847 FORMAT "%8.5" /end CHARACTERISTIC
/begin CHARACTERISTIC MIFALAPP "" VALUE 0x8FEB6C KwUw 99.99847 rel_uw_b100 0.00 99.99847 FORMAT "%8.5" /end CHARACTERISTIC
/begin CHARACTERISTIC MIFALMF "" CURVE 0x8ED696 KlAUwSstUwWUw 99.99847 rel_uw_b100 0.00 99.99847 FORMAT "%8.5"
 /begin AXIS_DESCR STD_AXIS mifa_w rel_uw_b100 8 0.00 99.99847 FORMAT "%8.5" DEPOSIT ABSOLUTE /end AXIS_DESCR
/end CHARACTERISTIC
/begin CHARACTERISTIC MKBRMXWP "" CURVE 0x8EBFD6 KlAUwSstUwWUw 99.99847 rel_uw_b100 0.00 99.99847 FORMAT "%8.5"
 /begin AXIS_DESCR STD_AXIS wped_w relPED_q0p00153 8 0.00 100.0000 FORMAT "%8.4" DEPOSIT ABSOLUTE /end AXIS_DESCR
/end CHARACTERISTIC
/begin CHARACTERISTIC MKFADPN "" CURVE 0x8E3075 GklWSb 99.60 rel_sb_q0p39 -50.00 49.61 FORMAT "%5.2"
 /begin AXIS_DESCR COM_AXIS nmot_w nmot_uw_q0p25 6 0.00 16383.75 FORMAT "%8.2" AXIS_PTS_REF SNM06MDUW /end AXIS_DESCR
/end CHARACTERISTIC
/begin CHARACTERISTIC MKFADPN1 "" CURVE 0x8E307B GklWSb 99.60 rel_sb_q0p39 -50.00 49.61 FORMAT "%5.2"
 /begin AXIS_DESCR COM_AXIS nmot_w nmot_uw_q0p25 6 0.00 16383.75 FORMAT "%8.2" AXIS_PTS_REF SNM06MDUW /end AXIS_DESCR
/end CHARACTERISTIC
/begin CHARACTERISTIC MKLLS "" CURVE 0x8EBE88 KlAUwSstUwWUw 99.99847 rel_uw_b100 0.00 99.99847 FORMAT "%8.5"
 /begin AXIS_DESCR STD_AXIS mkllsc rel_q0p39 6 0.00 99.61 FORMAT "%5.2" DEPOSIT ABSOLUTE /end AXIS_DESCR
/end CHARACTERISTIC
/begin CHARACTERISTIC MKMIFABG "" VALUE 0x8FEB6E KwSw 199.9969 rel_sw_b100 -100.0000 99.99695 FORMAT "%8.4" /end CHARACTERISTIC
/begin CHARACTERISTIC MLNKAX "" VALUE 0x8EE664 KwUw 7281.667 m_uw_b7281 0.00 7281.667 FORMAT "%8.3" /end CHARACTERISTIC
/begin CHARACTERISTIC MLO1 "" VALUE 0x8EA7CC KwUw 6553.500 m_uw_b6553p5 0.00 6553.500 FORMAT "%8.3" /end CHARACTERISTIC
/begin CHARACTERISTIC MLO1AC "" VALUE 0x8EA7CE KwUw 6553.500 m_uw_b6553p5 0.00 6553.500 FORMAT "%8.3" /end CHARACTERISTIC
/begin CHARACTERISTIC MLO2 "" VALUE 0x8FE6B2 KwUw 6553.500 m_uw_b6553p5 0.00 6553.500 FORMAT "%8.3" /end CHARACTERISTIC
/begin CHARACTERISTIC MLO3 "" VALUE 0x8EA7D0 KwUw 6553.500 m_uw_b6553p5 0.00 6553.500 FORMAT "%8.3" /end CHARACTERISTIC
/begin CHARACTERISTIC MLO3AC "" VALUE 0x8EA7D2 KwUw 6553.500 m_uw_b6553p5 0.00 6553.500 FORMAT "%8.3" /end CHARACTERISTIC
/begin CHARACTERISTIC MLU2 "" VALUE 0x8EA7D4 KwUw 6553.500 m_uw_b6553p5 0.00 6553.500 FORMAT "%8.3" /end CHARACTERISTIC
/begin CHARACTERISTIC MLU2AC "" VALUE 0x8EA7D6 KwUw 6553.500 m_uw_b6553p5 0.00 6553.500 FORMAT "%8.3" /end CHARACTERISTIC
/begin CHARACTERISTIC MLU2FA "" VALUE 0x8EA7D8 KwUw 6553.500 m_uw_b6553p5 0.00 6553.500 FORMAT "%8.3" /end CHARACTERISTIC
/begin CHARACTERISTIC MLU4 "" VALUE 0x8FE6B4 KwUw 6553.500 m_uw_b6553p5 0.00 6553.500 FORMAT "%8.3" /end CHARACTERISTIC
/begin CHARACTERISTIC MLU4AC "" VALUE 0x8FE6B6 KwUw 6553.500 m_uw_b6553p5 0.00 6553.500 FORMAT "%8.3" /end CHARACTERISTIC
/begin CHARACTERISTIC MRFALLO "" VALUE 0x8FEB70 KwUw 199.9969 rel_uw_b200 0.00 199.9969 FORMAT "%8.4" /end CHARACTERISTIC
/begin CHARACTERISTIC MRFALLU "" VALUE 0x8FEB72 KwUw 199.9969 rel_uw_b200 0.00 199.9969 FORMAT "%8.4" /end CHARACTERISTIC
/begin CHARACTERISTIC MRFAVLN "" CURVE 0x8ECE82 KlAUwSstUwWUw 199.9969 rel_uw_b200 0.00 199.9969 FORMAT "%8.4"
 /begin AXIS_DESCR STD_AXIS nmot_w nmot_uw_q0p25 14 0.00 16383.75 FORMAT "%8.2" DEPOSIT ABSOLUTE /end AXIS_DESCR
/end CHARACTERISTIC
/begin CHARACTERISTIC N0 "" VALUE 0x8FD00E KwUb 10200. nmot_ub_q40 0.00 10200. FORMAT "%5.0" /end CHARACTERISTIC
/begin CHARACTERISTIC NASNOTKL "" CURVE 0x8E3109 KlAUbSstUbWUb 10200. nmot_ub_q40 0.00 10200. FORMAT "%5.0"
 /begin AXIS_DESCR STD_AXIS tmot temp_ub_q0p75_o48 4 -48.00 143.3 FORMAT "%5.1" DEPOSIT ABSOLUTE /end AXIS_DESCR
/end CHARACTERISTIC
/begin CHARACTERISTIC NGFSAWE "" VALUE 0x8FEB74 KwSw 25599.94 nmotg_sw_q0p39 -12800.16 12799.77 FORMAT "%8.2" /end CHARACTERISTIC
/begin CHARACTERISTIC NLRHDIFAO "" VALUE 0x8E36AD KwUb 10200. nmot_ub_q40 0.00 10200. FORMAT "%5.0" /end CHARACTERISTIC
/begin CHARACTERISTIC NLRHDIFAU "" VALUE 0x8E36AE KwUb 10200. nmot_ub_q40 0.00 10200. FORMAT "%5.0" /end CHARACTERISTIC
/begin CHARACTERISTIC NLRHO "" VALUE 0x8E36AF KwUb 10200. nmot_ub_q40 0.00 10200. FORMAT "%5.0" /end CHARACTERISTIC
/begin CHARACTERISTIC NLRHU "" VALUE 0x8FD273 KwUb 10200. nmot_ub_q40 0.00 10200. FORMAT "%5.0" /end CHARACTERISTIC
/begin CHARACTERISTIC NLRKA "" VALUE 0x8E36F3 KwUb 10200. nmot_ub_q40 0.00 10200. FORMAT "%5.0" /end CHARACTERISTIC
/begin CHARACTERISTIC NLRSHB "" VALUE 0x8FD26B KwUb 10200. nmot_ub_q40 0.00 10200. FORMAT "%5.0" /end CHARACTERISTIC
/begin CHARACTERISTIC NMGALSDO "" CURVE 0x8E3081 FklWUb 10200. nmot_ub_q40 0.00 10200. FORMAT "%5.0"
 /begin AXIS_DESCR FIX_AXIS gangist dez 8 0.00 7.000 FORMAT "%5.3" FIX_AXIS_PAR 0 0 8 /end AXIS_DESCR
/end CHARACTERISTIC
/begin CHARACTERISTIC NMGALSDU "" CURVE 0x8E3089 FklWUb 10200. nmot_ub_q40 0.00 10200. FORMAT "%5.0"
 /begin AXIS_DESCR FIX_AXIS gangist dez 8 0.00 7.000 FORMAT "%5.3" FIX_AXIS_PAR 0 0 8 /end AXIS_DESCR
/end CHARACTERISTIC
/begin CHARACTERISTIC NO1 "" VALUE 0x8E1BAF KwUb 10200. nmot_ub_q40 0.00 10200. FORMAT "%5.0" /end CHARACTERISTIC
/begin CHARACTERISTIC NO2 "" VALUE 0x8E1BB0 KwUb 10200. nmot_ub_q40 0.00 10200. FORMAT "%5.0" /end CHARACTERISTIC
/begin CHARACTERISTIC NOLRA "" VALUE 0x8E1BB1 KwUb 255.0 dez 0.00 255.0 FORMAT "%5.1" /end CHARACTERISTIC
/begin CHARACTERISTIC NRKAB "" VALUE 0x8FD00F KwUb 10200. nmot_ub_q40 0.00 10200. FORMAT "%5.0" /end CHARACTERISTIC
/begin CHARACTERISTIC NSYWMN "" VALUE 0x8E34F6 KwUb 6375. nmot_ub_q25 0.00 6375. FORMAT "%5.0" /end CHARACTERISTIC
/begin CHARACTERISTIC NSYWMX "" VALUE 0x8E34F7 KwUb 6375. nmot_ub_q25 0.00 6375. FORMAT "%5.0" /end CHARACTERISTIC
/begin CHARACTERISTIC NU2 "" VALUE 0x8E1BB2 KwUb 10200. nmot_ub_q40 0.00 10200. FORMAT "%5.0" /end CHARACTERISTIC
/begin CHARACTERISTIC NU3 "" VALUE 0x8E1BB3 KwUb 10200. nmot_ub_q40 0.00 10200. FORMAT "%5.0" /end CHARACTERISTIC
/begin CHARACTERISTIC NVLSUMRSMX "" VALUE 0x8E350C KwUb 255.0 dez 0.00 255.0 FORMAT "%5.1" /end CHARACTERISTIC
/begin CHARACTERISTIC PEDLRMX "" VALUE 0x8ECEBC KwUw 199.9969 rel_uw_b200 0.00 199.9969 FORMAT "%8.4" /end CHARACTERISTIC
/begin CHARACTERISTIC PEDMX "" VALUE 0x8ECEBE KwUw 199.9969 rel_uw_b200 0.00 199.9969 FORMAT "%8.4" /end CHARACTERISTIC
/begin CHARACTERISTIC PEDRMX "" VALUE 0x8ECEC0 KwUw 199.9969 rel_uw_b200 0.00 199.9969 FORMAT "%8.4" /end CHARACTERISTIC
/begin CHARACTERISTIC PLRHAV "" CURVE 0x8E36B0 KlAUbSstUbWUb 0.9961 fak_ub_b1 0.00 0.9961 /begin AXIS_DESCR STD_AXIS avkatf fak_ub_b1 8 0.00 0.9961 DEPOSIT ABSOLUTE /end AXIS_DESCR /end CHARACTERISTIC
/begin CHARACTERISTIC PLRHAV2 "" CURVE 0x8E36C1 KlAUbSstUbWUb 0.9961 fak_ub_b1 0.00 0.9961 /begin AXIS_DESCR STD_AXIS avkatf2 fak_ub_b1 8 0.00 0.9961 DEPOSIT ABSOLUTE /end AXIS_DESCR /end CHARACTERISTIC
/begin CHARACTERISTIC PLRHFA "" VALUE 0x8E36D2 KwUb 3.984 fak_ub_b4 0.00 3.984 FORMAT "%5.3" /end CHARACTERISTIC
/begin CHARACTERISTIC PLRHFA2 "" VALUE 0x8E36D3 KwUb 3.984 fak_ub_b4 0.00 3.984 FORMAT "%5.3" /end CHARACTERISTIC
/begin CHARACTERISTIC PLRHSHAB "" VALUE 0x8E36D4 KwUb 0.9961 fak_ub_b1 0.00 0.9961 /end CHARACTERISTIC
/begin CHARACTERISTIC REDHYOC "" VALUE 0x8FD251 KwSb 5.100 rel_sb_q0p02 -2.560 2.540 FORMAT "%5.3" /end CHARACTERISTIC
/begin CHARACTERISTIC REDHYUC "" VALUE 0x8FD252 KwSb 5.100 rel_sb_q0p02 -2.560 2.540 FORMAT "%5.3" /end CHARACTERISTIC
/begin CHARACTERISTIC REDMXSA "" VALUE 0x8FD253 KwUb 255.0 dez 0.00 255.0 FORMAT "%5.1" /end CHARACTERISTIC
/begin CHARACTERISTIC REDZEM "" CURVE 0x8E333F KlAUbSstUbWUb 255.0 dez 0.00 255.0 FORMAT "%5.1"
 /begin AXIS_DESCR STD_AXIS tmot temp_ub_q0p75_o48 5 -48.00 143.3 FORMAT "%5.1" DEPOSIT ABSOLUTE /end AXIS_DESCR
/end CHARACTERISTIC
/begin CHARACTERISTIC RKATMN "" VALUE 0x8EA7DA KwSw 383.9941 rel_sw_b192 -192.0000 191.9941 FORMAT "%8.4" /end CHARACTERISTIC
/begin CHARACTERISTIC RKATMX "" VALUE 0x8EA7DC KwSw 383.9941 rel_sw_b192 -192.0000 191.9941 FORMAT "%8.4" /end CHARACTERISTIC
/begin CHARACTERISTIC RKATRN "" VALUE 0x8EA7DE KwSw 383.9941 rel_sw_b192 -192.0000 191.9941 FORMAT "%8.4" /end CHARACTERISTIC
/begin CHARACTERISTIC RKATRX "" VALUE 0x8EA7E0 KwSw 383.9941 rel_sw_b192 -192.0000 191.9941 FORMAT "%8.4" /end CHARACTERISTIC
/begin CHARACTERISTIC RKAZMN "" VALUE 0x8EA7E2 KwSw 383.9941 rel_sw_b192 -192.0000 191.9941 FORMAT "%8.4" /end CHARACTERISTIC
/begin CHARACTERISTIC RKAZMX "" VALUE 0x8EA7E4 KwSw 383.9941 rel_sw_b192 -192.0000 191.9941 FORMAT "%8.4" /end CHARACTERISTIC
/begin CHARACTERISTIC RKAZRN "" VALUE 0x8EA7E6 KwSw 383.9941 rel_sw_b192 -192.0000 191.9941 FORMAT "%8.4" /end CHARACTERISTIC
/begin CHARACTERISTIC RKAZRX "" VALUE 0x8EA7E8 KwSw 383.9941 rel_sw_b192 -192.0000 191.9941 FORMAT "%8.4" /end CHARACTERISTIC
/begin CHARACTERISTIC RLLRHDIFAU "" VALUE 0x8E36D5 KwUb 191.3 rel_ub_q0p75 0.00 191.3 FORMAT "%5.1" /end CHARACTERISTIC
/begin CHARACTERISTIC RLLRHON "" CURVE 0x8E36D6 GklWUb 191.3 rel_ub_q0p75 0.00 191.3 FORMAT "%5.1"
 /begin AXIS_DESCR COM_AXIS nmot nmot_ub_q40 8 0.00 10200. FORMAT "%5.0" AXIS_PTS_REF SNM08LHUB /end AXIS_DESCR
/end CHARACTERISTIC
/begin CHARACTERISTIC RLLRHUFA "" VALUE 0x8E36DE KwUb 191.3 rel_ub_q0p75 0.00 191.3 FORMAT "%5.1" /end CHARACTERISTIC
/begin CHARACTERISTIC RLLRHUN "" CURVE 0x8E36DF GklWUb 191.3 rel_ub_q0p75 0.00 191.3 FORMAT "%5.1"
 /begin AXIS_DESCR COM_AXIS nmot nmot_ub_q40 8 0.00 10200. FORMAT "%5.0" AXIS_PTS_REF SNM08LHUB /end AXIS_DESCR
/end CHARACTERISTIC
/begin CHARACTERISTIC RLLRSHB "" VALUE 0x8FD26C KwUb 191.3 rel_ub_q0p75 0.00 191.3 FORMAT "%5.1" /end CHARACTERISTIC
/begin CHARACTERISTIC RLLRUN "" CURVE 0x8E3604 KlAUbSstUbWUb 191.3 rel_ub_q0p75 0.00 191.3 FORMAT "%5.1"
 /begin AXIS_DESCR STD_AXIS nmot nmot_ub_q40 8 0.00 10200. FORMAT "%5.0" DEPOSIT ABSOLUTE /end AXIS_DESCR
/end CHARACTERISTIC
/begin CHARACTERISTIC RLO2 "" VALUE 0x8E1BB4 KwUb 191.3 rel_ub_q0p75 0.00 191.3 FORMAT "%5.1" /end CHARACTERISTIC
/begin CHARACTERISTIC RLO3 "" VALUE 0x8E1BB5 KwUb 191.3 rel_ub_q0p75 0.00 191.3 FORMAT "%5.1" /end CHARACTERISTIC
/begin CHARACTERISTIC RLO3AC "" VALUE 0x8E1BB6 KwUb 191.3 rel_ub_q0p75 0.00 191.3 FORMAT "%5.1" /end CHARACTERISTIC
/begin CHARACTERISTIC RLSLSMN "" CURVE 0x8E3615 KlAUbSstUbWUb 191.3 rel_ub_q0p75 0.00 191.3 FORMAT "%5.1"
 /begin AXIS_DESCR STD_AXIS nmot nmot_ub_q40 4 0.00 10200. FORMAT "%5.0" DEPOSIT ABSOLUTE /end AXIS_DESCR
/end CHARACTERISTIC
/begin CHARACTERISTIC RLSOLAP "" VALUE 0x8FE684 KwUw 1535.977 rel_uw_q0p0234 0.00 1535.977 FORMAT "%8.3" /end CHARACTERISTIC
/begin CHARACTERISTIC RLU2 "" VALUE 0x8E1BB7 KwUb 191.3 rel_ub_q0p75 0.00 191.3 FORMAT "%5.1" /end CHARACTERISTIC
/begin CHARACTERISTIC RLU2AC "" VALUE 0x8E1BB8 KwUb 191.3 rel_ub_q0p75 0.00 191.3 FORMAT "%5.1" /end CHARACTERISTIC
/begin CHARACTERISTIC RLU2FA "" VALUE 0x8E1BB9 KwUb 191.3 rel_ub_q0p75 0.00 191.3 FORMAT "%5.1" /end CHARACTERISTIC
/begin CHARACTERISTIC RLU3 "" VALUE 0x8E1BBA KwUb 191.3 rel_ub_q0p75 0.00 191.3 FORMAT "%5.1" /end CHARACTERISTIC
/begin CHARACTERISTIC RLU4 "" VALUE 0x8E1BBB KwUb 191.3 rel_ub_q0p75 0.00 191.3 FORMAT "%5.1" /end CHARACTERISTIC
/begin CHARACTERISTIC RLU4AC "" VALUE 0x8E1BBC KwUb 191.3 rel_ub_q0p75 0.00 191.3 FORMAT "%5.1" /end CHARACTERISTIC
/begin AXIS_PTS SGA08MDUB "" 0x8E01C9 gangi SstAUbSstUb 255.0 dez 8 0.00 255.0 FORMAT "%5.1" DEPOSIT ABSOLUTE /end AXIS_PTS
/begin AXIS_PTS SKO06KOUB "" 0x8E2EFA takols SstAUbSstUb 255.0 dez 6 0.00 255.0 FORMAT "%5.1" DEPOSIT ABSOLUTE /end AXIS_PTS
/begin AXIS_PTS SKO06PKO "" 0x8E2F01 pkodrc SstAUbSstUb 51.00 p_q0p2 6 0.00 51.00 FORMAT "%5.2" DEPOSIT ABSOLUTE /end AXIS_PTS
/begin AXIS_PTS SLA09OPUW "" 0x8E5BAE lambas_w SstAUwSstUw 15.99976 fak_uw_b16 9 0.00 15.99976 FORMAT "%8.5" DEPOSIT ABSOLUTE /end AXIS_PTS
/begin AXIS_PTS SM108LHSW "" 0x8E59A6 dlashkm_w SstASwSstSw 1.999969 fak_sw_b1 8 -1.000000 0.9999695 FORMAT "%8.6" DEPOSIT ABSOLUTE /end AXIS_PTS
/begin AXIS_PTS SM208LHSW "" 0x8E59B8 dlashkm2_w SstASwSstSw 1.999969 fak_sw_b1 8 -1.000000 0.9999695 FORMAT "%8.6" DEPOSIT ABSOLUTE /end AXIS_PTS
/begin AXIS_PTS SMI12OPUW "" 0x8EA164 misopl1n_w SstAUwSstUw 99.99847 rel_uw_b100 12 0.00 99.99847 FORMAT "%8.5" DEPOSIT ABSOLUTE /end AXIS_PTS
/begin AXIS_PTS SML08LHUB "" 0x8E00AE ml SstAUbSstUb 1020. m_ub_b1020 8 0.00 1020. FORMAT "%5.0" DEPOSIT ABSOLUTE /end AXIS_PTS
/begin AXIS_PTS SNM06KOUB "" 0x8E2F08 nmot SstAUbSstUb 10200. nmot_ub_q40 6 0.00 10200. FORMAT "%5.0" DEPOSIT ABSOLUTE /end AXIS_PTS
/begin AXIS_PTS SNM06MDUW "" 0x8E59F6 nmot_w SstAUwSstUw 16383.75 nmot_uw_q0p25 6 0.00 16383.75 FORMAT "%8.2" DEPOSIT ABSOLUTE /end AXIS_PTS
/begin AXIS_PTS SNM07LSUW "" 0x8EE59C nmot_w SstAUwSstUw 16383.75 nmot_uw_q0p25 7 0.00 16383.75 FORMAT "%8.2" DEPOSIT ABSOLUTE /end AXIS_PTS
/begin AXIS_PTS SNM08LHUB "" 0x8E00DC nmot SstAUbSstUb 10200. nmot_ub_q40 8 0.00 10200. FORMAT "%5.0" DEPOSIT ABSOLUTE /end AXIS_PTS
/begin AXIS_PTS SNM08LSUB "" 0x8E35EF nmot SstAUbSstUb 10200. nmot_ub_q40 8 0.00 10200. FORMAT "%5.0" DEPOSIT ABSOLUTE /end AXIS_PTS
/begin AXIS_PTS SNM12FEUB "" 0x8E0201 nmot SstAUbSstUb 10200. nmot_ub_q40 12 0.00 10200. FORMAT "%5.0" DEPOSIT ABSOLUTE /end AXIS_PTS
/begin AXIS_PTS SNM12MDUW "" 0x8ED6B8 nmot_w SstAUwSstUw 16383.75 nmot_uw_q0p25 12 0.00 16383.75 FORMAT "%8.2" DEPOSIT ABSOLUTE /end AXIS_PTS
/begin AXIS_PTS SNM16OPUW "" 0x8E5A42 nmot_w SstAUwSstUw 16383.75 nmot_uw_q0p25 16 0.00 16383.75 FORMAT "%8.2" DEPOSIT ABSOLUTE /end AXIS_PTS
/begin AXIS_PTS SNM16__UW "" 0x8E5BC2 nmot_w SstAUwSstUw 16383.75 nmot_uw_q0p25 16 0.00 16383.75 FORMAT "%8.2" DEPOSIT ABSOLUTE /end AXIS_PTS
/begin AXIS_PTS SPS11MDUW "" 0x8EDA1E dpsu_w SstAUwSstUw 2559.961 p_uw_q0p039 11 0.00 2559.961 FORMAT "%8.3" DEPOSIT ABSOLUTE /end AXIS_PTS
/begin AXIS_PTS SRL06KOUB "" 0x8E2F0F rl SstAUbSstUb 191.3 rel_ub_q0p75 6 0.00 191.3 FORMAT "%5.1" DEPOSIT ABSOLUTE /end AXIS_PTS
/begin AXIS_PTS SRL08LSUB "" 0x8E35F8 rl SstAUbSstUb 191.3 rel_ub_q0p75 8 0.00 191.3 FORMAT "%5.1" DEPOSIT ABSOLUTE /end AXIS_PTS
/begin AXIS_PTS SRL08LSUW "" 0x8EE5AC rl_w SstAUwSstUw 1535.977 rel_uw_q0p0234 8 0.00 1535.977 FORMAT "%8.3" DEPOSIT ABSOLUTE /end AXIS_PTS
/begin AXIS_PTS SRL11OPUW "" 0x8E5BE4 rl_w SstAUwSstUw 1535.977 rel_uw_q0p0234 11 0.00 1535.977 FORMAT "%8.3" DEPOSIT ABSOLUTE /end AXIS_PTS
/begin AXIS_PTS SRR07OPUW "" 0x8E5BFC rri_w SstAUwSstUw 99.99847 rel_uw_b100 7 0.00 99.99847 FORMAT "%8.5" DEPOSIT ABSOLUTE /end AXIS_PTS
/begin AXIS_PTS STA06LLUB "" 0x8E2F16 tlok SstAUbSstUb 191.3 temp_ub_q0p75_o48 6 -48.00 143.3 FORMAT "%5.1" DEPOSIT ABSOLUTE /end AXIS_PTS
/begin AXIS_PTS STM06__UB "" 0x8E0190 tmot SstAUbSstUb 191.3 temp_ub_q0p75_o48 6 -48.00 143.3 FORMAT "%5.1" DEPOSIT ABSOLUTE /end AXIS_PTS
/begin AXIS_PTS STM08__UB "" 0x8E02BA tmot SstAUbSstUb 191.3 temp_ub_q0p75_o48 8 -48.00 143.3 FORMAT "%5.1" DEPOSIT ABSOLUTE /end AXIS_PTS
/begin AXIS_PTS STW08MDUB "" 0x8E2C75 twnd SstAUbSstUb 191.3 temp_ub_q0p75_o48 8 -48.00 143.3 FORMAT "%5.1" DEPOSIT ABSOLUTE /end AXIS_PTS
/begin AXIS_PTS SWE07OPSW "" 0x8E5C0C wnwe_w SstASwSstSw 511.9922 kw_q0p0078 7 -256.0000 255.9922 FORMAT "%8.4" DEPOSIT ABSOLUTE /end AXIS_PTS
/begin AXIS_PTS SWP16MDUW "" 0x8ED6D2 wped_w SstAUwSstUw 100.0000 relPED_q0p00153 16 0.00 100.0000 FORMAT "%8.4" DEPOSIT ABSOLUTE /end AXIS_PTS
/begin CHARACTERISTIC TAGAT "" VALUE 0x8E34EA KwUb 25.4996 zk100msxs_ub_b25p5 0.100392 25.6000 FORMAT "%7.4" /end CHARACTERISTIC
/begin CHARACTERISTIC TARA "" VALUE 0x8FD067 KwUb 191.3 temp_ub_q0p75_o48 -48.00 143.3 FORMAT "%5.1" /end CHARACTERISTIC
/begin CHARACTERISTIC TARAU "" VALUE 0x8FD26D KwUb 191.3 temp_ub_q0p75_o48 -48.00 143.3 FORMAT "%5.1" /end CHARACTERISTIC
/begin CHARACTERISTIC TASGCERR "" VALUE 0x8E34F8 KwUb 5100. t_q20_ms 0.00 5100. FORMAT "%5.0" /end CHARACTERISTIC
/begin CHARACTERISTIC TASGCNO "" VALUE 0x8E34F9 KwUb 5100. t_q20_ms 0.00 5100. FORMAT "%5.0" /end CHARACTERISTIC
/begin CHARACTERISTIC TASGCNU "" VALUE 0x8E34FA KwUb 5100. t_q20_ms 0.00 5100. FORMAT "%5.0" /end CHARACTERISTIC
/begin CHARACTERISTIC TASGRED "" VALUE 0x8EDAFC KwUw 1310.6999997 zk20msxs_uw_b1310 0.020000305180 1310.7200000 FORMAT "%12.7" /end CHARACTERISTIC
/begin CHARACTERISTIC TASHS "" VALUE 0x8FD26E KwUb 191.3 temp_ub_q0p75_o48 -48.00 143.3 FORMAT "%5.1" /end CHARACTERISTIC
/begin CHARACTERISTIC TAUIDEC "" VALUE 0x8FECFA KwUw 655.34999985 zk10msxs_uw_b655 0.010000152590 655.36000000 FORMAT "%12.8" /end CHARACTERISTIC
/begin CHARACTERISTIC TBLRH "" VALUE 0x8E36E7 KwUb 25.50 t100msxs_ub_b25p5 0.00 25.50 FORMAT "%5.2" /end CHARACTERISTIC
/begin CHARACTERISTIC TBZCAN_R "" VALUE 0x8EDAFE KwUw 32000.00 t_q20_ms 0.00 32000.00 FORMAT "%8.2" /end CHARACTERISTIC
/begin CHARACTERISTIC TBZCAN_S "" VALUE 0x8EDB00 KwUw 32000.00 t_q20_ms 0.00 32000.00 FORMAT "%8.2" /end CHARACTERISTIC
/begin CHARACTERISTIC TDLAHFAMX "" VALUE 0x8E36E8 KwUb 25.50 t100msxs_ub_b25p5 0.00 25.50 FORMAT "%5.2" /end CHARACTERISTIC
/begin CHARACTERISTIC TDLAKAD "" VALUE 0x8EE7AA KwUw 1310.7000107 zk20msxs_uw_b1310 0.019989324549 1310.7200000 FORMAT "%12.7" /end CHARACTERISTIC
/begin CHARACTERISTIC TDLAKAU "" VALUE 0x8EE7AC KwUw 1310.7000107 zk20msxs_uw_b1310 0.019989324549 1310.7200000 FORMAT "%12.7" /end CHARACTERISTIC
/begin CHARACTERISTIC TDMFBSA "" VALUE 0x8FEB76 KwUw 655.34999985 zk10msxs_uw_b655 0.010000152590 655.36000000 FORMAT "%12.8" /end CHARACTERISTIC
/begin CHARACTERISTIC TDMFBWE "" VALUE 0x8FEB78 KwUw 655.34999985 zk10msxs_uw_b655 0.010000152590 655.36000000 FORMAT "%12.8" /end CHARACTERISTIC
/begin CHARACTERISTIC TDMFNSG "" VALUE 0x8FEB7A KwUw 655.34999985 zk10msxs_uw_b655 0.010000152590 655.36000000 FORMAT "%12.8" /end CHARACTERISTIC
/begin CHARACTERISTIC TDMFWEMI "" CURVE 0x8ED6F4 KlAUwSstUwWUw 655.34999908 zk10msxs_uw_b655 0.010000915611 655.36000000 FORMAT "%12.8"
 /begin AXIS_DESCR STD_AXIS mivbeb_w rel_uw_b100 8 0.00 99.99847 FORMAT "%8.5" DEPOSIT ABSOLUTE /end AXIS_DESCR
/end CHARACTERISTIC
/begin CHARACTERISTIC TDMKOW "" VALUE 0x8EBEA2 KwUw 1310.700 t20msxs_uw_q0p02 0.00 1310.700 FORMAT "%8.3" /end CHARACTERISTIC
/begin CHARACTERISTIC TDMLSDS "" VALUE 0x8FD1C3 KwUb 5.100 t20msxs_ub_b5p1 0.00 5.100 FORMAT "%5.3" /end CHARACTERISTIC
/begin CHARACTERISTIC TFKU_R "" VALUE 0x8EBFFA KwUw 30.00000 t20msxs_uw_b1310 0.00 30.00000 FORMAT "%8.5" /end CHARACTERISTIC
/begin CHARACTERISTIC TFKU_S "" VALUE 0x8EBFFC KwUw 30.00000 t20msxs_uw_b1310 0.00 30.00000 FORMAT "%8.5" /end CHARACTERISTIC
/begin CHARACTERISTIC TGAALTWR "" VALUE 0x8EA7EA KwUw 4.999924 zk200msxs_uw_b5 0.00 4.999924 FORMAT "%8.6" /end CHARACTERISTIC
/begin CHARACTERISTIC THDMB "" VALUE 0x8EBEBE KwUw 65535.00 t1sxs_uw_b65535 0.00 65535.00 FORMAT "%8.2" /end CHARACTERISTIC
/begin CHARACTERISTIC TKATMLRH "" VALUE 0x8EE612 KwUw 1535.977 temp_q0p0234_o273 -273.1500 1262.827 FORMAT "%8.3" /end CHARACTERISTIC
/begin CHARACTERISTIC TLAKAMN "" VALUE 0x8E36F4 KwUb 5.100 t20msxs_ub_b5p1 0.00 5.100 FORMAT "%5.3" /end CHARACTERISTIC
/begin CHARACTERISTIC TLAKAMN2 "" VALUE 0x8E36F5 KwUb 5.100 t20msxs_ub_b5p1 0.00 5.100 FORMAT "%5.3" /end CHARACTERISTIC
/begin CHARACTERISTIC TLRBAM "" CURVE 0x8EE5DE KlAUbSstUbWUw 655.3500 t10msxs_uw_b655p35 0.00 655.3500 FORMAT "%8.4"
 /begin AXIS_DESCR STD_AXIS tmot temp_ub_q0p75_o48 8 -48.00 143.3 FORMAT "%5.1" DEPOSIT ABSOLUTE /end AXIS_DESCR
/end CHARACTERISTIC
/begin CHARACTERISTIC TLRHFRXMOF "" VALUE 0x8E36E9 KwUb 25.50 t100msxs_ub_b25p5 0.00 25.50 FORMAT "%5.2" /end CHARACTERISTIC
/begin CHARACTERISTIC TLRHFRXMON "" VALUE 0x8E36EA KwUb 25.50 t100msxs_ub_b25p5 0.00 25.50 FORMAT "%5.2" /end CHARACTERISTIC
/begin CHARACTERISTIC TLRHS "" VALUE 0x8E3601 KwUb 25.50 t100msxs_ub_b25p5 0.00 25.50 FORMAT "%5.2" /end CHARACTERISTIC
/begin CHARACTERISTIC TLRSZWSA "" VALUE 0x8EE5BE KwUw 6553.500 t100msxs_uw_b6553p5 0.00 6553.500 FORMAT "%8.3" /end CHARACTERISTIC
/begin CHARACTERISTIC TLRTMS "" CURVE 0x8EE5C0 KlAUbSstUbWUw 6553.500 t100msxs_uw_b6553p5 0.00 6553.500 FORMAT "%8.3"
 /begin AXIS_DESCR STD_AXIS tmst temp_ub_q0p75_o48 5 -48.00 143.3 FORMAT "%5.1" DEPOSIT ABSOLUTE /end AXIS_DESCR
/end CHARACTERISTIC
/begin CHARACTERISTIC TLRVAM "" CURVE 0x8EE5F8 KlAUbSstUbWUw 655.3500 t10msxs_uw_b655p35 0.00 655.3500 FORMAT "%8.4"
 /begin AXIS_DESCR STD_AXIS tmot temp_ub_q0p75_o48 8 -48.00 143.3 FORMAT "%5.1" DEPOSIT ABSOLUTE /end AXIS_DESCR
/end CHARACTERISTIC
/begin CHARACTERISTIC TLRZWTMS "" CURVE 0x8EE5D0 KlAUbSstUbWUw 6553.500 t100msxs_uw_b6553p5 0.00 6553.500 FORMAT "%8.3"
 /begin AXIS_DESCR STD_AXIS tmst temp_ub_q0p75_o48 4 -48.00 143.3 FORMAT "%5.1" DEPOSIT ABSOLUTE /end AXIS_DESCR
/end CHARACTERISTIC
/begin CHARACTERISTIC TMDMAD "" VALUE 0x8E2C63 KwUb 191.3 temp_ub_q0p75_o48 -48.00 143.3 FORMAT "%5.1" /end CHARACTERISTIC
/begin CHARACTERISTIC TMEWRAA "" VALUE 0x8E1EBC KwUb 191.3 temp_ub_q0p75_o48 -48.00 143.3 FORMAT "%5.1" /end CHARACTERISTIC
/begin CHARACTERISTIC TMFRATMN "" VALUE 0x8E1BBD KwUb 191.3 temp_ub_q0p75_o48 -48.00 143.3 FORMAT "%5.1" /end CHARACTERISTIC
/begin CHARACTERISTIC TMFRATUB "" VALUE 0x8E1BBE KwUb 191.3 temp_ub_q0p75_o48 -48.00 143.3 FORMAT "%5.1" /end CHARACTERISTIC
/begin CHARACTERISTIC TMLLAMN "" VALUE 0x8E36EB KwUb 25.50 t100msxs_ub_b25p5 0.00 25.50 FORMAT "%5.2" /end CHARACTERISTIC
/begin CHARACTERISTIC TMLLAMN2 "" VALUE 0x8E36EC KwUb 25.50 t100msxs_ub_b25p5 0.00 25.50 FORMAT "%5.2" /end CHARACTERISTIC
/begin CHARACTERISTIC TMMIBGR "" VALUE 0x8E34EB KwUb 191.3 temp_ub_q0p75_o48 -48.00 143.3 FORMAT "%5.1" /end CHARACTERISTIC
/begin CHARACTERISTIC TMOTMRSMX "" VALUE 0x8E350D KwUb 191.3 temp_ub_q0p75_o48 -48.00 143.3 FORMAT "%5.1" /end CHARACTERISTIC
/begin CHARACTERISTIC TMRA1 "" VALUE 0x8FD26F KwUb 191.3 temp_ub_q0p75_o48 -48.00 143.3 FORMAT "%5.1" /end CHARACTERISTIC
/begin CHARACTERISTIC TMRA2 "" VALUE 0x8FD270 KwUb 191.3 temp_ub_q0p75_o48 -48.00 143.3 FORMAT "%5.1" /end CHARACTERISTIC
/begin CHARACTERISTIC TMRAA "" VALUE 0x8E1EBD KwUb 191.3 temp_ub_q0p75_o48 -48.00 143.3 FORMAT "%5.1" /end CHARACTERISTIC
/begin CHARACTERISTIC TMRAK "" VALUE 0x8FD271 KwUb 191.3 temp_ub_q0p75_o48 -48.00 143.3 FORMAT "%5.1" /end CHARACTERISTIC
/begin CHARACTERISTIC TMSHS "" VALUE 0x8FD272 KwUb 191.3 temp_ub_q0p75_o48 -48.00 143.3 FORMAT "%5.1" /end CHARACTERISTIC
/begin CHARACTERISTIC TMTMRW "" VALUE 0x8E3602 KwUb 191.3 temp_ub_q0p75_o48 -48.00 143.3 FORMAT "%5.1" /end CHARACTERISTIC
/begin CHARACTERISTIC TMVER "" VALUE 0x8EBEC0 KwUw 65535.00 t1sxs_uw_b65535 0.00 65535.00 FORMAT "%8.2" /end CHARACTERISTIC
/begin CHARACTERISTIC TMXMIBG "" VALUE 0x8E34EC KwUb 191.3 temp_ub_q0p75_o48 -48.00 143.3 FORMAT "%5.1" /end CHARACTERISTIC
/begin CHARACTERISTIC TNGAT "" VALUE 0x8E34ED KwUb 25.4996 zk100msxs_ub_b25p5 0.100392 25.6000 FORMAT "%7.4" /end CHARACTERISTIC
/begin CHARACTERISTIC TNSYWS "" VALUE 0x8FEB8C KwUw 32000.00 t_q20_ms 0.00 32000.00 FORMAT "%8.2" /end CHARACTERISTIC
/begin CHARACTERISTIC TNSYW_R "" VALUE 0x8EDB02 KwUw 32000.00 t_q20_ms 0.00 32000.00 FORMAT "%8.2" /end CHARACTERISTIC
/begin CHARACTERISTIC TOFFDSHAB "" VALUE 0x8E36ED KwUb 25.50 t100msxs_ub_b25p5 0.00 25.50 FORMAT "%5.2" /end CHARACTERISTIC
/begin CHARACTERISTIC TRAU "" VALUE 0x8E3603 KwUb 25.50 t100msxs_ub_b25p5 0.00 25.50 FORMAT "%5.2" /end CHARACTERISTIC
/begin CHARACTERISTIC TSAKAMN "" VALUE 0x8E36F6 KwUb 5.100 t20msxs_ub_b5p1 0.00 5.100 FORMAT "%5.3" /end CHARACTERISTIC
/begin CHARACTERISTIC TSAKAMN2 "" VALUE 0x8E36F7 KwUb 5.100 t20msxs_ub_b5p1 0.00 5.100 FORMAT "%5.3" /end CHARACTERISTIC
/begin CHARACTERISTIC TSYNMX "" VALUE 0x8E34FB KwUb 5080. t_q20_ms 0.00 5080. FORMAT "%5.0" /end CHARACTERISTIC
/begin CHARACTERISTIC TVBRMX "" VALUE 0x8E34EE KwUb 25.50 t_q0p1 0.00 25.50 FORMAT "%5.2" /end CHARACTERISTIC
/begin CHARACTERISTIC TVFSAM "" CURVE 0x8E2C7E GklWUb 5.100 t20msxs_ub_b5p1 0.00 5.100 FORMAT "%5.3"
 /begin AXIS_DESCR COM_AXIS twnd temp_ub_q0p75_o48 8 -48.00 143.3 FORMAT "%5.1" AXIS_PTS_REF STW08MDUB /end AXIS_DESCR
/end CHARACTERISTIC
/begin CHARACTERISTIC TVFSAWE "" VALUE 0x8FEB7C KwUw 655.3500 t10msxs_uw_b655p35 0.00 655.3500 FORMAT "%8.4" /end CHARACTERISTIC
/begin CHARACTERISTIC TVFSEM "" CURVE 0x8E2C86 GklWUb 5.100 t20msxs_ub_b5p1 0.00 5.100 FORMAT "%5.3"
 /begin AXIS_DESCR COM_AXIS twnd temp_ub_q0p75_o48 8 -48.00 143.3 FORMAT "%5.1" AXIS_PTS_REF STW08MDUB /end AXIS_DESCR
/end CHARACTERISTIC
/begin CHARACTERISTIC TVFSRAM "" CURVE 0x8E2C8E GklWUb 5.100 t20msxs_ub_b5p1 0.00 5.100 FORMAT "%5.3"
 /begin AXIS_DESCR COM_AXIS twnd temp_ub_q0p75_o48 8 -48.00 143.3 FORMAT "%5.1" AXIS_PTS_REF STW08MDUB /end AXIS_DESCR
/end CHARACTERISTIC
/begin CHARACTERISTIC TVFSREM "" CURVE 0x8E2C96 GklWUb 5.100 t20msxs_ub_b5p1 0.00 5.100 FORMAT "%5.3"
 /begin AXIS_DESCR COM_AXIS twnd temp_ub_q0p75_o48 8 -48.00 143.3 FORMAT "%5.1" AXIS_PTS_REF STW08MDUB /end AXIS_DESCR
/end CHARACTERISTIC
/begin CHARACTERISTIC TVFUE "" VALUE 0x8FD1A6 KwUb 5.100 t20msxs_ub_b5p1 0.00 5.100 FORMAT "%5.3" /end CHARACTERISTIC
/begin CHARACTERISTIC TVGAT "" VALUE 0x8E34EF KwUb 25.50 t100msxs_ub_b25p5 0.00 25.50 FORMAT "%5.2" /end CHARACTERISTIC
/begin CHARACTERISTIC TVGSCH "" VALUE 0x8E3091 KwUb 5.100 t20msxs_ub_b5p1 0.00 5.100 FORMAT "%5.3" /end CHARACTERISTIC
/begin CHARACTERISTIC TVLRA "" VALUE 0x8E1EBE KwUb 25.40 t100msxs_ub_b25p5 0.1000 25.50 FORMAT "%5.2" /end CHARACTERISTIC
/begin CHARACTERISTIC TVMIBEG "" VALUE 0x8FD1CA KwUb 2.550 t10msxs_ub_b2p55 0.00 2.550 FORMAT "%5.3" /end CHARACTERISTIC
/begin CHARACTERISTIC TWDMAD "" VALUE 0x8E2C64 KwUb 51.00 t200msxs_ub_b51 0.00 51.00 FORMAT "%5.2" /end CHARACTERISTIC
/begin CHARACTERISTIC UEVERG "" CURVE 0x8E2CEB FklWUb 31.88 fak_ub_b32 0.00 31.88 FORMAT "%5.2"
 /begin AXIS_DESCR FIX_AXIS gangi dez 8 0.00 7.000 FORMAT "%5.3" FIX_AXIS_PAR 0 0 8 /end AXIS_DESCR
/end CHARACTERISTIC
/begin CHARACTERISTIC USHKAMXW "" VALUE 0x8EE7AE KwUw 319.9951 spg_uw_q0p00488_o1 -1.000000 318.9951 FORMAT "%8.4" /end CHARACTERISTIC
/begin CHARACTERISTIC USHKAMXW2 "" VALUE 0x8EE7B0 KwUw 319.9951 spg_uw_q0p00488_o1 -1.000000 318.9951 FORMAT "%8.4" /end CHARACTERISTIC
/begin CHARACTERISTIC USRHKFA "" VALUE 0x8FD274 KwUb 1.330 spg_ub_q0p0052_o0p2 -0.2000 1.130 FORMAT "%5.3" /end CHARACTERISTIC
/begin CHARACTERISTIC VASNOT "" VALUE 0x8EDB04 KwUw 511.9922 vfzg_uw_b512 0.00 511.9922 FORMAT "%8.4" /end CHARACTERISTIC
/begin CHARACTERISTIC VDASH "" VALUE 0x8FD1C4 KwUb 318.8 vfzg_ub_q1p25 0.00 318.8 FORMAT "%5.1" /end CHARACTERISTIC
/begin CHARACTERISTIC VFSM "" VALUE 0x8EDB06 KwUw 3.124952 relnmot_q0p477Em4 0.00 3.124952 FORMAT "%8.6" /end CHARACTERISTIC
/begin CHARACTERISTIC VLSD "" VALUE 0x8FD1C5 KwUb 318.8 vfzg_ub_q1p25 0.00 318.8 FORMAT "%5.1" /end CHARACTERISTIC
/begin CHARACTERISTIC VMIBGR "" VALUE 0x8E34F0 KwUb 318.8 vfzg_ub_q1p25 0.00 318.8 FORMAT "%5.1" /end CHARACTERISTIC
/begin CHARACTERISTIC VMKBRMX "" VALUE 0x8E34F1 KwUb 318.8 vfzg_ub_q1p25 0.00 318.8 FORMAT "%5.1" /end CHARACTERISTIC
/begin CHARACTERISTIC WDKARN "" CURVE 0x8E1EBF KlAUbSstUbWUb 100.0 relDK_ub_b100 0.00 100.0 FORMAT "%5.1"
 /begin AXIS_DESCR STD_AXIS nmot nmot_ub_q40 10 0.00 10200. FORMAT "%5.0" DEPOSIT ABSOLUTE /end AXIS_DESCR
/end CHARACTERISTIC
/begin CHARACTERISTIC WIMAX "" VALUE 0x8FECFC KwSw 7.999878 fak_sw_b4_1 -4.000000 3.999878 FORMAT "%8.6" /end CHARACTERISTIC
/begin CHARACTERISTIC WIMIN "" VALUE 0x8FECFE KwSw 7.999878 fak_sw_b4_1 -4.000000 3.999878 FORMAT "%8.6" /end CHARACTERISTIC
/begin CHARACTERISTIC XIMAX "" VALUE 0x8FED00 KwSw 1.999969 fak_sw_b1 -1.000000 0.9999695 FORMAT "%8.6" /end CHARACTERISTIC
/begin CHARACTERISTIC XIMIN "" VALUE 0x8FED02 KwSw 1.999969 fak_sw_b1 -1.000000 0.9999695 FORMAT "%8.6" /end CHARACTERISTIC
/begin CHARACTERISTIC ZFMDVERL "" VALUE 0x8E32B3 KwUb 5.09992 zk20msxs_ub_b5p12 0.0200784 5.12000 FORMAT "%7.5" /end CHARACTERISTIC
/begin CHARACTERISTIC ZILRHFA "" VALUE 0x8E36EE KwUb 0.04980 freq_ub_b0p05 0.00 0.04980 FORMAT "%7.5" /end CHARACTERISTIC
/begin CHARACTERISTIC ZKDMADFK "" VALUE 0x8EBC90 KwUw 816.00000000 zk200msxs_uw_b13107 3.2000000000 819.20000000 FORMAT "%12.8" /end CHARACTERISTIC
/begin CHARACTERISTIC ZKDMADFS "" VALUE 0x8EBC92 KwUw 816.00000000 zk200msxs_uw_b13107 3.2000000000 819.20000000 FORMAT "%12.8" /end CHARACTERISTIC
/begin CHARACTERISTIC ZKDMADKO "" VALUE 0x8EBC94 KwUw 816.00000000 zk200msxs_uw_b13107 3.2000000000 819.20000000 FORMAT "%12.8" /end CHARACTERISTIC
/begin CHARACTERISTIC ZKDMADLL "" VALUE 0x8EBC96 KwUw 816.00000000 zk200msxs_uw_b13107 3.2000000000 819.20000000 FORMAT "%12.8" /end CHARACTERISTIC
/begin CHARACTERISTIC ZKDMDW "" VALUE 0x8FD1A7 KwUb 5.08000 zk20msxs_ub_b5p1 0.0200000 5.10000 FORMAT "%7.5" /end CHARACTERISTIC
/begin CHARACTERISTIC ZKDRLSOL "" VALUE 0x8FE686 KwUw 655.34999985 zk10msxs_uw_b655 0.010000152590 655.36000000 FORMAT "%12.8" /end CHARACTERISTIC
/begin CHARACTERISTIC ZKFRAOA "" CURVE 0x8EA7EC KlAUwSstUwWUw 4.999924 zk200msxs_uw_b5 0.00 4.999924 FORMAT "%8.6"
 /begin AXIS_DESCR STD_AXIS abo dez 3 0.00 255.0 FORMAT "%5.1" DEPOSIT ABSOLUTE /end AXIS_DESCR
/end CHARACTERISTIC
/begin CHARACTERISTIC ZKFRAUA "" CURVE 0x8EA7FA KlAUwSstUwWUw 4.999924 zk200msxs_uw_b5 0.00 4.999924 FORMAT "%8.6"
 /begin AXIS_DESCR STD_AXIS abo dez 3 0.00 255.0 FORMAT "%5.1" DEPOSIT ABSOLUTE /end AXIS_DESCR
/end CHARACTERISTIC
/begin CHARACTERISTIC ZKMDELL "" VALUE 0x8E2F1D KwUb 25.4996 zk100msxs_ub_b25p5 0.100392 25.6000 FORMAT "%7.4" /end CHARACTERISTIC
/begin CHARACTERISTIC ZKMDGEN "" VALUE 0x8E2F1E KwUb 5.09992 zk20msxs_ub_b5p12 0.0200784 5.12000 FORMAT "%7.5" /end CHARACTERISTIC
/begin CHARACTERISTIC ZKMDKO "" VALUE 0x8E2F1F KwUb 5.09992 zk20msxs_ub_b5p12 0.0200784 5.12000 FORMAT "%7.5" /end CHARACTERISTIC
/begin CHARACTERISTIC ZKMDSEV "" VALUE 0x8E2F20 KwUb 25.4996 zk100msxs_ub_b25p5 0.100392 25.6000 FORMAT "%7.4" /end CHARACTERISTIC
/begin CHARACTERISTIC ZKMDSLP "" VALUE 0x8E2F21 KwUb 5.09992 zk20msxs_ub_b5p12 0.0200784 5.12000 FORMAT "%7.5" /end CHARACTERISTIC
/begin CHARACTERISTIC ZKMDWAB "" VALUE 0x8FD1A8 KwUb 5.08000 zk20msxs_ub_b5p1 0.0200000 5.10000 FORMAT "%7.5" /end CHARACTERISTIC
/begin CHARACTERISTIC ZKMDWAUF "" VALUE 0x8FD1A9 KwUb 5.08000 zk20msxs_ub_b5p1 0.0200000 5.10000 FORMAT "%7.5" /end CHARACTERISTIC
/begin CHARACTERISTIC ZKMDWF "" VALUE 0x8FD1AA KwUb 5.08000 zk20msxs_ub_b5p1 0.0200000 5.10000 FORMAT "%7.5" /end CHARACTERISTIC
/begin CHARACTERISTIC ZKRKATA "" CURVE 0x8EA808 KlAUwSstUwWUw 959.9854 zk200msxs_uw_b960 0.00 959.9854 FORMAT "%8.4"
 /begin AXIS_DESCR STD_AXIS abo dez 3 0.00 255.0 FORMAT "%5.1" DEPOSIT ABSOLUTE /end AXIS_DESCR
/end CHARACTERISTIC
/begin CHARACTERISTIC ZKRKAZA "" CURVE 0x8EA816 KlAUwSstUwWUw 959.9854 zk200msxs_uw_b960 0.00 959.9854 FORMAT "%8.4"
 /begin AXIS_DESCR STD_AXIS abo dez 3 0.00 255.0 FORMAT "%5.1" DEPOSIT ABSOLUTE /end AXIS_DESCR
/end CHARACTERISTIC
/begin CHARACTERISTIC ZKSM "" VALUE 0x8E34FC KwUb 5.08000 zk20msxs_ub_b5p1 0.0200000 5.10000 FORMAT "%7.5" /end CHARACTERISTIC
/begin CHARACTERISTIC ZKUEVERG "" VALUE 0x8FD1AB KwUb 5.08000 zk20msxs_ub_b5p1 0.0200000 5.10000 FORMAT "%7.5" /end CHARACTERISTIC
/begin CHARACTERISTIC ZLASHKAB "" VALUE 0x8FED0E KwUw 655.34999985 zk10msxs_uw_b655 0.010000152590 655.36000000 FORMAT "%12.8" /end CHARACTERISTIC
/begin CHARACTERISTIC ZLASOHML "" CURVE 0x8EE6FA KlAUwSstUwWUw 655.34999985 zk10msxs_uw_b655 0.010000152590 655.36000000 FORMAT "%12.8"
 /begin AXIS_DESCR STD_AXIS ml_w m_uw_b6553p5 8 0.00 6553.500 FORMAT "%8.3" DEPOSIT ABSOLUTE /end AXIS_DESCR
/end CHARACTERISTIC
/begin CHARACTERISTIC ZMDDLWS "" VALUE 0x8E2F22 KwUb 5.09992 zk20msxs_ub_b5p12 0.0200784 5.12000 FORMAT "%7.5" /end CHARACTERISTIC
/begin CHARACTERISTIC ZMDNSM "" CURVE 0x8EDA36 KlAUbSstUbWUw 3276.7499992 zk50msxs_uw_b3276p8 0.050000762951 3276.8000000 FORMAT "%12.7"
 /begin AXIS_DESCR STD_AXIS tmot temp_ub_q0p75_o48 8 -48.00 143.3 FORMAT "%5.1" DEPOSIT ABSOLUTE /end AXIS_DESCR
/end CHARACTERISTIC
/begin CHARACTERISTIC ZRLFRAT "" VALUE 0x8E1BBF KwUb 3.72308 zk200msxs_ub_b51p2 0.200000 3.92308 FORMAT "%7.5" /end CHARACTERISTIC
/begin MEASUREMENT asgphnpl "" UBYTE dez 1 100 0.00 255.0 FORMAT "%5.1" ECU_ADDRESS 0xF0B57 /end MEASUREMENT
/begin MEASUREMENT B_aakupst "" UWORD B_TRUE 1 100 0.00 1.00000000000 BIT_MASK 0x400 FORMAT "%13.11" ECU_ADDRESS 0xFDAC /end MEASUREMENT
/begin MEASUREMENT B_abws "" UWORD B_TRUE 1 100 0.00 1.00000000000 BIT_MASK 0x20 FORMAT "%13.11" ECU_ADDRESS 0xFDA8 /end MEASUREMENT
/begin MEASUREMENT B_adwfk "" UBYTE B_TRUE 1 100 0.00 1.00000000000 BIT_MASK 0x10 FORMAT "%13.11" ECU_ADDRESS 0xF0B0E /end MEASUREMENT
/begin MEASUREMENT B_adwfs "" UBYTE B_TRUE 1 100 0.00 1.00000000000 BIT_MASK 0x20 FORMAT "%13.11" ECU_ADDRESS 0xF0B0E /end MEASUREMENT
/begin MEASUREMENT B_adwko "" UBYTE B_TRUE 1 100 0.00 1.00000000000 BIT_MASK 0x40 FORMAT "%13.11" ECU_ADDRESS 0xF0B0E /end MEASUREMENT
/begin MEASUREMENT B_asg20ms "" UWORD B_TRUE 1 100 0.00 1.00000000000 BIT_MASK 0x800 FORMAT "%13.11" ECU_ADDRESS 0xFDAC /end MEASUREMENT
/begin MEASUREMENT B_asgab "" UWORD B_TRUE 1 100 0.00 1.00000000000 BIT_MASK 0x1000 FORMAT "%13.11" ECU_ADDRESS 0xFDAC /end MEASUREMENT
/begin MEASUREMENT B_asginpl "" UWORD B_TRUE 1 100 0.00 1.00000000000 BIT_MASK 0x2000 FORMAT "%13.11" ECU_ADDRESS 0xFDAC /end MEASUREMENT
/begin MEASUREMENT B_asgknpl "" UWORD B_TRUE 1 100 0.00 1.00000000000 BIT_MASK 0x4000 FORMAT "%13.11" ECU_ADDRESS 0xFDAC /end MEASUREMENT
/begin MEASUREMENT B_asgneut "" UWORD B_TRUE 1 100 0.00 1.00000000000 BIT_MASK 0x8000 FORMAT "%13.11" ECU_ADDRESS 0xFDAC /end MEASUREMENT
/begin MEASUREMENT B_asgnpl_R "" UBYTE B_TRUE 1 100 0.00 1.00000000000 BIT_MASK 0x8 FORMAT "%13.11" ECU_ADDRESS 0xF0B58 /end MEASUREMENT
/begin MEASUREMENT B_asgnpl_S "" UBYTE B_TRUE 1 100 0.00 1.00000000000 BIT_MASK 0x4 FORMAT "%13.11" ECU_ADDRESS 0xF0B58 /end MEASUREMENT
/begin MEASUREMENT B_asgphnpl "" UBYTE B_TRUE 1 100 0.00 1.00000000000 BIT_MASK 0x1 FORMAT "%13.11" ECU_ADDRESS 0xF0B58 /end MEASUREMENT
/begin MEASUREMENT B_asgpl "" UWORD B_TRUE 1 100 0.00 1.00000000000 BIT_MASK 0x1 FORMAT "%13.11" ECU_ADDRESS 0xFDAE /end MEASUREMENT
/begin MEASUREMENT B_asgpli "" UWORD B_TRUE 1 100 0.00 1.00000000000 BIT_MASK 0x2 FORMAT "%13.11" ECU_ADDRESS 0xFDAE /end MEASUREMENT
/begin MEASUREMENT B_asr "" UWORD B_TRUE 1 100 0.00 1.00000000000 BIT_MASK 0x40 FORMAT "%13.11" ECU_ADDRESS 0xFDA8 /end MEASUREMENT
/begin MEASUREMENT B_blrka "" UBYTE B_TRUE 1 100 0.00 1.00000000000 BIT_MASK 0x2 FORMAT "%13.11" ECU_ADDRESS 0xF0BA2 /end MEASUREMENT
/begin MEASUREMENT B_blrka2 "" UBYTE B_TRUE 1 100 0.00 1.00000000000 BIT_MASK 0x10 FORMAT "%13.11" ECU_ADDRESS 0xF0BA2 /end MEASUREMENT
/begin MEASUREMENT B_brvfp "" UBYTE B_TRUE 1 100 0.00 1.00000000000 BIT_MASK 0x1 FORMAT "%13.11" ECU_ADDRESS 0xF0B4A /end MEASUREMENT
/begin MEASUREMENT B_clrs5 "" UWORD B_TRUE 1 100 0.00 1.00000000000 BIT_MASK 0x2000 FORMAT "%13.11" ECU_ADDRESS 0xFDB2 /end MEASUREMENT
/begin MEASUREMENT B_cnfwan "" UWORD B_TRUE 1 100 0.00 1.00000000000 BIT_MASK 0x800 FORMAT "%13.11" ECU_ADDRESS 0xFDA0 /end MEASUREMENT
/begin MEASUREMENT B_cwlrms0 "" UWORD B_TRUE 1 100 0.00 1.00000000000 BIT_MASK 0x4000 FORMAT "%13.11" ECU_ADDRESS 0xFDB2 /end MEASUREMENT
/begin MEASUREMENT B_cwlrms1 "" UWORD B_TRUE 1 100 0.00 1.00000000000 BIT_MASK 0x8000 FORMAT "%13.11" ECU_ADDRESS 0xFDB2 /end MEASUREMENT
/begin MEASUREMENT B_cwlrms4 "" UWORD B_TRUE 1 100 0.00 1.00000000000 BIT_MASK 0x1 FORMAT "%13.11" ECU_ADDRESS 0xFDB4 /end MEASUREMENT
/begin MEASUREMENT B_cwlrms5 "" UWORD B_TRUE 1 100 0.00 1.00000000000 BIT_MASK 0x2 FORMAT "%13.11" ECU_ADDRESS 0xFDB4 /end MEASUREMENT
/begin MEASUREMENT B_dash "" UWORD B_TRUE 1 100 0.00 1.00000000000 BIT_MASK 0x800 FORMAT "%13.11" ECU_ADDRESS 0xFDA4 /end MEASUREMENT
/begin MEASUREMENT B_dashv "" UWORD B_TRUE 1 100 0.00 1.00000000000 BIT_MASK 0x1000 FORMAT "%13.11" ECU_ADDRESS 0xFDA4 /end MEASUREMENT
/begin MEASUREMENT B_dashvz "" UWORD B_TRUE 1 100 0.00 1.00000000000 BIT_MASK 0x2000 FORMAT "%13.11" ECU_ADDRESS 0xFDA4 /end MEASUREMENT
/begin MEASUREMENT B_dashz "" UWORD B_TRUE 1 100 0.00 1.00000000000 BIT_MASK 0x8000 FORMAT "%13.11" ECU_ADDRESS 0xFDA4 /end MEASUREMENT
/begin MEASUREMENT B_dlahieg "" UBYTE B_TRUE 1 100 0.00 1.00000000000 BIT_MASK 0x10 FORMAT "%13.11" ECU_ADDRESS 0xF0B89 /end MEASUREMENT
/begin MEASUREMENT B_dlahieg2 "" UBYTE B_TRUE 1 100 0.00 1.00000000000 BIT_MASK 0x4 FORMAT "%13.11" ECU_ADDRESS 0xF0B8A /end MEASUREMENT
/begin MEASUREMENT B_dlahini "" UBYTE B_TRUE 1 100 0.00 1.00000000000 BIT_MASK 0x1 FORMAT "%13.11" ECU_ADDRESS 0xF0B8B /end MEASUREMENT
/begin MEASUREMENT B_dlahini2 "" UBYTE B_TRUE 1 100 0.00 1.00000000000 BIT_MASK 0x1 FORMAT "%13.11" ECU_ADDRESS 0xF0B8D /end MEASUREMENT
/begin MEASUREMENT B_dlahix "" UBYTE B_TRUE 1 100 0.00 1.00000000000 BIT_MASK 0x8 FORMAT "%13.11" ECU_ADDRESS 0xF0B8B /end MEASUREMENT
/begin MEASUREMENT B_dlahix2 "" UBYTE B_TRUE 1 100 0.00 1.00000000000 BIT_MASK 0x40 FORMAT "%13.11" ECU_ADDRESS 0xF0B8D /end MEASUREMENT
/begin MEASUREMENT B_dlahpix "" UBYTE B_TRUE 1 100 0.00 1.00000000000 BIT_MASK 0x2 FORMAT "%13.11" ECU_ADDRESS 0xF0B8E /end MEASUREMENT
/begin MEASUREMENT B_dlahpix2 "" UBYTE B_TRUE 1 100 0.00 1.00000000000 BIT_MASK 0x4 FORMAT "%13.11" ECU_ADDRESS 0xF0B8D /end MEASUREMENT
/begin MEASUREMENT B_dlahpx "" UBYTE B_TRUE 1 100 0.00 1.00000000000 BIT_MASK 0x1 FORMAT "%13.11" ECU_ADDRESS 0xF0B8E /end MEASUREMENT
/begin MEASUREMENT B_dlahpx2 "" UBYTE B_TRUE 1 100 0.00 1.00000000000 BIT_MASK 0x80 FORMAT "%13.11" ECU_ADDRESS 0xF0B8D /end MEASUREMENT
/begin MEASUREMENT B_dmrwan "" UWORD B_TRUE 1 100 0.00 1.00000000000 BIT_MASK 0x1000 FORMAT "%13.11" ECU_ADDRESS 0xFDA0 /end MEASUREMENT
/begin MEASUREMENT B_dmverlin "" UWORD B_TRUE 1 100 0.00 1.00000000000 BIT_MASK 0x200 FORMAT "%13.11" ECU_ADDRESS 0xFDAA /end MEASUREMENT
/begin MEASUREMENT B_dp "" UWORD B_TRUE 1 100 0.00 1.00000000000 BIT_MASK 0x2 FORMAT "%13.11" ECU_ADDRESS 0xFDA6 /end MEASUREMENT
/begin MEASUREMENT B_edp "" UWORD B_TRUE 1 100 0.00 1.00000000000 BIT_MASK 0x4 FORMAT "%13.11" ECU_ADDRESS 0xFDA6 /end MEASUREMENT
/begin MEASUREMENT B_elsd "" UWORD B_TRUE 1 100 0.00 1.00000000000 BIT_MASK 0x8 FORMAT "%13.11" ECU_ADDRESS 0xFDA6 /end MEASUREMENT
/begin MEASUREMENT B_eobdlr "" UWORD B_TRUE 1 100 0.00 1.00000000000 BIT_MASK 0x1 FORMAT "%13.11" ECU_ADDRESS 0xFDB6 /end MEASUREMENT
/begin MEASUREMENT B_eobdlr2 "" UWORD B_TRUE 1 100 0.00 1.00000000000 BIT_MASK 0x2 FORMAT "%13.11" ECU_ADDRESS 0xFDB6 /end MEASUREMENT
/begin MEASUREMENT B_falrhki "" UBYTE B_TRUE 1 100 0.00 1.00000000000 BIT_MASK 0x4 FORMAT "%13.11" ECU_ADDRESS 0xF0B8E /end MEASUREMENT
/begin MEASUREMENT B_falrhki2 "" UBYTE B_TRUE 1 100 0.00 1.00000000000 BIT_MASK 0x1 FORMAT "%13.11" ECU_ADDRESS 0xF0B8F /end MEASUREMENT
/begin MEASUREMENT B_falrhkrq "" UBYTE B_TRUE 1 100 0.00 1.00000000000 BIT_MASK 0x80 FORMAT "%13.11" ECU_ADDRESS 0xF0B8B /end MEASUREMENT
/begin MEASUREMENT B_fgr "" UWORD B_TRUE 1 100 0.00 1.00000000000 BIT_MASK 0x10 FORMAT "%13.11" ECU_ADDRESS 0xFDA6 /end MEASUREMENT
/begin MEASUREMENT B_fil "" UWORD B_TRUE 1 100 0.00 1.00000000000 BIT_MASK 0x20 FORMAT "%13.11" ECU_ADDRESS 0xFDA6 /end MEASUREMENT
/begin MEASUREMENT B_frao "" UWORD B_TRUE 1 100 0.00 1.00000000000 BIT_MASK 0x1 FORMAT "%13.11" ECU_ADDRESS 0xFD74 /end MEASUREMENT
/begin MEASUREMENT B_fraor "" UWORD B_TRUE 1 100 0.00 1.00000000000 BIT_MASK 0x2 FORMAT "%13.11" ECU_ADDRESS 0xFD74 /end MEASUREMENT
/begin MEASUREMENT B_fraor2 "" UWORD B_TRUE 1 100 0.00 1.00000000000 BIT_MASK 0x4 FORMAT "%13.11" ECU_ADDRESS 0xFD74 /end MEASUREMENT
/begin MEASUREMENT B_frat "" UWORD B_TRUE 1 100 0.00 1.00000000000 BIT_MASK 0x8 FORMAT "%13.11" ECU_ADDRESS 0xFD74 /end MEASUREMENT
/begin MEASUREMENT B_frau "" UWORD B_TRUE 1 100 0.00 1.00000000000 BIT_MASK 0x10 FORMAT "%13.11" ECU_ADDRESS 0xFD74 /end MEASUREMENT
/begin MEASUREMENT B_fraur "" UWORD B_TRUE 1 100 0.00 1.00000000000 BIT_MASK 0x20 FORMAT "%13.11" ECU_ADDRESS 0xFD74 /end MEASUREMENT
/begin MEASUREMENT B_fraur2 "" UWORD B_TRUE 1 100 0.00 1.00000000000 BIT_MASK 0x40 FORMAT "%13.11" ECU_ADDRESS 0xFD74 /end MEASUREMENT
/begin MEASUREMENT B_frini "" UBYTE B_TRUE 1 100 0.00 1.00000000000 BIT_MASK 0x1 FORMAT "%13.11" ECU_ADDRESS 0xF0B80 /end MEASUREMENT
/begin MEASUREMENT B_frmax "" UBYTE B_TRUE 1 100 0.00 1.00000000000 BIT_MASK 0x2 FORMAT "%13.11" ECU_ADDRESS 0xF0B7E /end MEASUREMENT
/begin MEASUREMENT B_frmax2 "" UBYTE B_TRUE 1 100 0.00 1.00000000000 BIT_MASK 0x2 FORMAT "%13.11" ECU_ADDRESS 0xF0B7F /end MEASUREMENT
/begin MEASUREMENT B_frmin "" UBYTE B_TRUE 1 100 0.00 1.00000000000 BIT_MASK 0x2 FORMAT "%13.11" ECU_ADDRESS 0xF0B80 /end MEASUREMENT
/begin MEASUREMENT B_frmin2 "" UBYTE B_TRUE 1 100 0.00 1.00000000000 BIT_MASK 0x20 FORMAT "%13.11" ECU_ADDRESS 0xF0B80 /end MEASUREMENT
/begin MEASUREMENT B_frmn "" UBYTE B_TRUE 1 100 0.00 1.00000000000 BIT_MASK 0x8 FORMAT "%13.11" ECU_ADDRESS 0xF0B7E /end MEASUREMENT
/begin MEASUREMENT B_frmn2 "" UBYTE B_TRUE 1 100 0.00 1.00000000000 BIT_MASK 0x8 FORMAT "%13.11" ECU_ADDRESS 0xF0B7F /end MEASUREMENT
/begin MEASUREMENT B_fsu "" UWORD B_TRUE 1 100 0.00 1.00000000000 BIT_MASK 0x2000 FORMAT "%13.11" ECU_ADDRESS 0xFDA0 /end MEASUREMENT
/begin MEASUREMENT B_gasp "" UWORD B_TRUE 1 100 0.00 1.00000000000 BIT_MASK 0x400 FORMAT "%13.11" ECU_ADDRESS 0xFD7A /end MEASUREMENT
/begin MEASUREMENT B_gschwka "" UWORD B_TRUE 1 100 0.00 1.00000000000 BIT_MASK 0x40 FORMAT "%13.11" ECU_ADDRESS 0xFDA6 /end MEASUREMENT
/begin MEASUREMENT B_idecay "" UWORD B_TRUE 1 100 0.00 1.00000000000 BIT_MASK 0x4 FORMAT "%13.11" ECU_ADDRESS 0xFDB4 /end MEASUREMENT
/begin MEASUREMENT B_idecay2 "" UWORD B_TRUE 1 100 0.00 1.00000000000 BIT_MASK 0x8 FORMAT "%13.11" ECU_ADDRESS 0xFDB4 /end MEASUREMENT
/begin MEASUREMENT B_iflsd "" UWORD B_TRUE 1 100 0.00 1.00000000000 BIT_MASK 0x80 FORMAT "%13.11" ECU_ADDRESS 0xFDA6 /end MEASUREMENT
/begin MEASUREMENT B_lalimi "" UWORD B_TRUE 1 100 0.00 1.00000000000 BIT_MASK 0x10 FORMAT "%13.11" ECU_ADDRESS 0xFDB4 /end MEASUREMENT
/begin MEASUREMENT B_lalimi2 "" UWORD B_TRUE 1 100 0.00 1.00000000000 BIT_MASK 0x20 FORMAT "%13.11" ECU_ADDRESS 0xFDB4 /end MEASUREMENT
/begin MEASUREMENT B_lalims "" UWORD B_TRUE 1 100 0.00 1.00000000000 BIT_MASK 0x40 FORMAT "%13.11" ECU_ADDRESS 0xFDB4 /end MEASUREMENT
/begin MEASUREMENT B_lalims2 "" UWORD B_TRUE 1 100 0.00 1.00000000000 BIT_MASK 0x80 FORMAT "%13.11" ECU_ADDRESS 0xFDB4 /end MEASUREMENT
/begin MEASUREMENT B_lamka "" UBYTE B_TRUE 1 100 0.00 1.00000000000 BIT_MASK 0x2 FORMAT "%13.11" ECU_ADDRESS 0xF0BA1 /end MEASUREMENT
/begin MEASUREMENT B_lamka2 "" UBYTE B_TRUE 1 100 0.00 1.00000000000 BIT_MASK 0x8 FORMAT "%13.11" ECU_ADDRESS 0xF0BA1 /end MEASUREMENT
/begin MEASUREMENT B_ll "" UWORD B_TRUE 1 100 0.00 1.00000000000 BIT_MASK 0x200 FORMAT "%13.11" ECU_ADDRESS 0xFDA6 /end MEASUREMENT
/begin MEASUREMENT B_lr "" UWORD B_TRUE 1 100 0.00 1.00000000000 BIT_MASK 0x4 FORMAT "%13.11" ECU_ADDRESS 0xFDB6 /end MEASUREMENT
/begin MEASUREMENT B_lr2 "" UWORD B_TRUE 1 100 0.00 1.00000000000 BIT_MASK 0x8 FORMAT "%13.11" ECU_ADDRESS 0xFDB6 /end MEASUREMENT
/begin MEASUREMENT B_lra "" UWORD B_TRUE 1 100 0.00 1.00000000000 BIT_MASK 0x800 FORMAT "%13.11" ECU_ADDRESS 0xFD7A /end MEASUREMENT
/begin MEASUREMENT B_lra2 "" UWORD B_TRUE 1 100 0.00 1.00000000000 BIT_MASK 0x1000 FORMAT "%13.11" ECU_ADDRESS 0xFD7A /end MEASUREMENT
/begin MEASUREMENT B_lraen "" UWORD B_TRUE 1 100 0.00 1.00000000000 BIT_MASK 0x2000 FORMAT "%13.11" ECU_ADDRESS 0xFD7A /end MEASUREMENT
/begin MEASUREMENT B_lrare "" UWORD B_TRUE 1 100 0.00 1.00000000000 BIT_MASK 0x80 FORMAT "%13.11" ECU_ADDRESS 0xFD74 /end MEASUREMENT
/begin MEASUREMENT B_lrare2 "" UWORD B_TRUE 1 100 0.00 1.00000000000 BIT_MASK 0x100 FORMAT "%13.11" ECU_ADDRESS 0xFD74 /end MEASUREMENT
/begin MEASUREMENT B_lrareb "" UWORD B_TRUE 1 100 0.00 1.00000000000 BIT_MASK 0x200 FORMAT "%13.11" ECU_ADDRESS 0xFD74 /end MEASUREMENT
/begin MEASUREMENT B_lrat "" UWORD B_TRUE 1 100 0.00 1.00000000000 BIT_MASK 0x4000 FORMAT "%13.11" ECU_ADDRESS 0xFD7A /end MEASUREMENT
/begin MEASUREMENT B_lreberi "" UBYTE B_TRUE 1 100 0.00 1.00000000000 BIT_MASK 0x1 FORMAT "%13.11" ECU_ADDRESS 0xF0B90 /end MEASUREMENT
/begin MEASUREMENT B_lreberi2 "" UBYTE B_TRUE 1 100 0.00 1.00000000000 BIT_MASK 0x2 FORMAT "%13.11" ECU_ADDRESS 0xF0B8F /end MEASUREMENT
/begin MEASUREMENT B_lrhbb "" UBYTE B_TRUE 1 100 0.00 1.00000000000 BIT_MASK 0x8 FORMAT "%13.11" ECU_ADDRESS 0xF0B8E /end MEASUREMENT
/begin MEASUREMENT B_lrheini "" UBYTE B_TRUE 1 100 0.00 1.00000000000 BIT_MASK 0x40 FORMAT "%13.11" ECU_ADDRESS 0xF0B8B /end MEASUREMENT
/begin MEASUREMENT B_lrheini2 "" UBYTE B_TRUE 1 100 0.00 1.00000000000 BIT_MASK 0x20 FORMAT "%13.11" ECU_ADDRESS 0xF0B8D /end MEASUREMENT
/begin MEASUREMENT B_lrhk "" UBYTE B_TRUE 1 100 0.00 1.00000000000 BIT_MASK 0x1 FORMAT "%13.11" ECU_ADDRESS 0xF0B89 /end MEASUREMENT
/begin MEASUREMENT B_lrhk2 "" UBYTE B_TRUE 1 100 0.00 1.00000000000 BIT_MASK 0x1 FORMAT "%13.11" ECU_ADDRESS 0xF0B8A /end MEASUREMENT
/begin MEASUREMENT B_lrhkb "" UBYTE B_TRUE 1 100 0.00 1.00000000000 BIT_MASK 0x2 FORMAT "%13.11" ECU_ADDRESS 0xF0B8B /end MEASUREMENT
/begin MEASUREMENT B_lrhkb2 "" UBYTE B_TRUE 1 100 0.00 1.00000000000 BIT_MASK 0x2 FORMAT "%13.11" ECU_ADDRESS 0xF0B8D /end MEASUREMENT
/begin MEASUREMENT B_lrhkg "" UBYTE B_TRUE 1 100 0.00 1.00000000000 BIT_MASK 0x4 FORMAT "%13.11" ECU_ADDRESS 0xF0B8B /end MEASUREMENT
/begin MEASUREMENT B_lrhkgi "" UBYTE B_TRUE 1 100 0.00 1.00000000000 BIT_MASK 0x80 FORMAT "%13.11" ECU_ADDRESS 0xF0B8E /end MEASUREMENT
/begin MEASUREMENT B_lrhkgnw "" UBYTE B_TRUE 1 100 0.00 1.00000000000 BIT_MASK 0x10 FORMAT "%13.11" ECU_ADDRESS 0xF0B8E /end MEASUREMENT
/begin MEASUREMENT B_lrhkgnwa "" UBYTE B_TRUE 1 100 0.00 1.00000000000 BIT_MASK 0x20 FORMAT "%13.11" ECU_ADDRESS 0xF0B8E /end MEASUREMENT
/begin MEASUREMENT B_lrhkgnwe "" UBYTE B_TRUE 1 100 0.00 1.00000000000 BIT_MASK 0x40 FORMAT "%13.11" ECU_ADDRESS 0xF0B8E /end MEASUREMENT
/begin MEASUREMENT B_lrhkp "" UBYTE B_TRUE 1 100 0.00 1.00000000000 BIT_MASK 0x20 FORMAT "%13.11" ECU_ADDRESS 0xF0B89 /end MEASUREMENT
/begin MEASUREMENT B_lrhkp2 "" UBYTE B_TRUE 1 100 0.00 1.00000000000 BIT_MASK 0x2 FORMAT "%13.11" ECU_ADDRESS 0xF0B8A /end MEASUREMENT
/begin MEASUREMENT B_lrka "" UBYTE B_TRUE 1 100 0.00 1.00000000000 BIT_MASK 0x1 FORMAT "%13.11" ECU_ADDRESS 0xF0BA1 /end MEASUREMENT
/begin MEASUREMENT B_lrka2 "" UBYTE B_TRUE 1 100 0.00 1.00000000000 BIT_MASK 0x4 FORMAT "%13.11" ECU_ADDRESS 0xF0BA1 /end MEASUREMENT
/begin MEASUREMENT B_lrkaa "" UBYTE B_TRUE 1 100 0.00 1.00000000000 BIT_MASK 0x4 FORMAT "%13.11" ECU_ADDRESS 0xF0BA2 /end MEASUREMENT
/begin MEASUREMENT B_lrkaa2 "" UBYTE B_TRUE 1 100 0.00 1.00000000000 BIT_MASK 0x20 FORMAT "%13.11" ECU_ADDRESS 0xF0BA2 /end MEASUREMENT
/begin MEASUREMENT B_lrkae "" UBYTE B_TRUE 1 100 0.00 1.00000000000 BIT_MASK 0x1 FORMAT "%13.11" ECU_ADDRESS 0xF0BA2 /end MEASUREMENT
/begin MEASUREMENT B_lrkae2 "" UBYTE B_TRUE 1 100 0.00 1.00000000000 BIT_MASK 0x8 FORMAT "%13.11" ECU_ADDRESS 0xF0BA2 /end MEASUREMENT
/begin MEASUREMENT B_lrmsbrc "" UWORD B_TRUE 1 100 0.00 1.00000000000 BIT_MASK 0x100 FORMAT "%13.11" ECU_ADDRESS 0xFDB4 /end MEASUREMENT
/begin MEASUREMENT B_lrmsbrc2 "" UWORD B_TRUE 1 100 0.00 1.00000000000 BIT_MASK 0x200 FORMAT "%13.11" ECU_ADDRESS 0xFDB4 /end MEASUREMENT
/begin MEASUREMENT B_lrmsbs "" UWORD B_TRUE 1 100 0.00 1.00000000000 BIT_MASK 0x10 FORMAT "%13.11" ECU_ADDRESS 0xFDB6 /end MEASUREMENT
/begin MEASUREMENT B_lrmsbs2 "" UWORD B_TRUE 1 100 0.00 1.00000000000 BIT_MASK 0x20 FORMAT "%13.11" ECU_ADDRESS 0xFDB6 /end MEASUREMENT
/begin MEASUREMENT B_lrnbsnc "" UWORD B_TRUE 1 100 0.00 1.00000000000 BIT_MASK 0x40 FORMAT "%13.11" ECU_ADDRESS 0xFDB6 /end MEASUREMENT
/begin MEASUREMENT B_lrnda "" UBYTE B_TRUE 1 100 0.00 1.00000000000 BIT_MASK 0x4 FORMAT "%13.11" ECU_ADDRESS 0xF0B7E /end MEASUREMENT
/begin MEASUREMENT B_lrnda2 "" UBYTE B_TRUE 1 100 0.00 1.00000000000 BIT_MASK 0x4 FORMAT "%13.11" ECU_ADDRESS 0xF0B7F /end MEASUREMENT
/begin MEASUREMENT B_lrrl "" UWORD B_TRUE 1 100 0.00 1.00000000000 BIT_MASK 0x80 FORMAT "%13.11" ECU_ADDRESS 0xFDB6 /end MEASUREMENT
/begin MEASUREMENT B_lrs "" UWORD B_TRUE 1 100 0.00 1.00000000000 BIT_MASK 0x100 FORMAT "%13.11" ECU_ADDRESS 0xFDB6 /end MEASUREMENT
/begin MEASUREMENT B_lrs2 "" UWORD B_TRUE 1 100 0.00 1.00000000000 BIT_MASK 0x200 FORMAT "%13.11" ECU_ADDRESS 0xFDB6 /end MEASUREMENT
/begin MEASUREMENT B_lrsin "" UWORD B_TRUE 1 100 0.00 1.00000000000 BIT_MASK 0x400 FORMAT "%13.11" ECU_ADDRESS 0xFDB4 /end MEASUREMENT
/begin MEASUREMENT B_lrsin2 "" UWORD B_TRUE 1 100 0.00 1.00000000000 BIT_MASK 0x800 FORMAT "%13.11" ECU_ADDRESS 0xFDB4 /end MEASUREMENT
/begin MEASUREMENT B_lrsrems "" UWORD B_TRUE 1 100 0.00 1.00000000000 BIT_MASK 0x1000 FORMAT "%13.11" ECU_ADDRESS 0xFDB4 /end MEASUREMENT
/begin MEASUREMENT B_lrsrems2 "" UWORD B_TRUE 1 100 0.00 1.00000000000 BIT_MASK 0x2000 FORMAT "%13.11" ECU_ADDRESS 0xFDB4 /end MEASUREMENT
/begin MEASUREMENT B_lrssa "" UWORD B_TRUE 1 100 0.00 1.00000000000 BIT_MASK 0x400 FORMAT "%13.11" ECU_ADDRESS 0xFDB6 /end MEASUREMENT
/begin MEASUREMENT B_lrssa2 "" UWORD B_TRUE 1 100 0.00 1.00000000000 BIT_MASK 0x800 FORMAT "%13.11" ECU_ADDRESS 0xFDB6 /end MEASUREMENT
/begin MEASUREMENT B_ls "" UWORD B_TRUE 1 100 0.00 1.00000000000 BIT_MASK 0x1000 FORMAT "%13.11" ECU_ADDRESS 0xFDA6 /end MEASUREMENT
/begin MEASUREMENT B_lsd "" UWORD B_TRUE 1 100 0.00 1.00000000000 BIT_MASK 0x2000 FORMAT "%13.11" ECU_ADDRESS 0xFDA6 /end MEASUREMENT
/begin MEASUREMENT B_madakt "" UBYTE B_TRUE 1 100 0.00 1.00000000000 BIT_MASK 0x1 FORMAT "%13.11" ECU_ADDRESS 0xF0B0F /end MEASUREMENT
/begin MEASUREMENT B_madfk "" UBYTE B_TRUE 1 100 0.00 1.00000000000 BIT_MASK 0x1 FORMAT "%13.11" ECU_ADDRESS 0xF0B0E /end MEASUREMENT
/begin MEASUREMENT B_madfs "" UBYTE B_TRUE 1 100 0.00 1.00000000000 BIT_MASK 0x2 FORMAT "%13.11" ECU_ADDRESS 0xF0B0E /end MEASUREMENT
/begin MEASUREMENT B_madko "" UBYTE B_TRUE 1 100 0.00 1.00000000000 BIT_MASK 0x4 FORMAT "%13.11" ECU_ADDRESS 0xF0B0E /end MEASUREMENT
/begin MEASUREMENT B_madll "" UBYTE B_TRUE 1 100 0.00 1.00000000000 BIT_MASK 0x8 FORMAT "%13.11" ECU_ADDRESS 0xF0B0E /end MEASUREMENT
/begin MEASUREMENT B_mdee "" UWORD B_TRUE 1 100 0.00 1.00000000000 BIT_MASK 0x1000 FORMAT "%13.11" ECU_ADDRESS 0xFDAA /end MEASUREMENT
/begin MEASUREMENT B_mdein "" UWORD B_TRUE 1 100 0.00 1.00000000000 BIT_MASK 0x80 FORMAT "%13.11" ECU_ADDRESS 0xFDA8 /end MEASUREMENT
/begin MEASUREMENT B_mdmin "" UWORD B_TRUE 1 100 0.00 1.00000000000 BIT_MASK 0x40 FORMAT "%13.11" ECU_ADDRESS 0xFD6E /end MEASUREMENT
/begin MEASUREMENT B_mdnstab "" UWORD B_TRUE 1 100 0.00 1.00000000000 BIT_MASK 0x2 FORMAT "%13.11" ECU_ADDRESS 0xFDA2 /end MEASUREMENT
/begin MEASUREMENT B_mdredhyein "" UWORD B_TRUE 1 100 0.00 1.00000000000 BIT_MASK 0x2000 FORMAT "%13.11" ECU_ADDRESS 0xFDAA /end MEASUREMENT
/begin MEASUREMENT B_mgbgakt "" UWORD B_TRUE 1 100 0.00 1.00000000000 BIT_MASK 0x8000 FORMAT "%13.11" ECU_ADDRESS 0xFDA6 /end MEASUREMENT
/begin MEASUREMENT B_mibeg "" UWORD B_TRUE 1 100 0.00 1.00000000000 BIT_MASK 0x100 FORMAT "%13.11" ECU_ADDRESS 0xFDA8 /end MEASUREMENT
/begin MEASUREMENT B_mibegl "" UWORD B_TRUE 1 100 0.00 1.00000000000 BIT_MASK 0x80 FORMAT "%13.11" ECU_ADDRESS 0xFDAA /end MEASUREMENT
/begin MEASUREMENT B_mifabg "" UWORD B_TRUE 1 100 0.00 1.00000000000 BIT_MASK 0x1 FORMAT "%13.11" ECU_ADDRESS 0xFDA8 /end MEASUREMENT
/begin MEASUREMENT B_misgsen "" UWORD B_TRUE 1 100 0.00 1.00000000000 BIT_MASK 0x4 FORMAT "%13.11" ECU_ADDRESS 0xFDAE /end MEASUREMENT
/begin MEASUREMENT B_mkbrmx "" UBYTE B_TRUE 1 100 0.00 1.00000000000 BIT_MASK 0x2 FORMAT "%13.11" ECU_ADDRESS 0xF0B4A /end MEASUREMENT
/begin MEASUREMENT B_mlevab "" UWORD B_TRUE 1 100 0.00 1.00000000000 BIT_MASK 0x1000 FORMAT "%13.11" ECU_ADDRESS 0xFDB6 /end MEASUREMENT
/begin MEASUREMENT B_mlevab2 "" UWORD B_TRUE 1 100 0.00 1.00000000000 BIT_MASK 0x2000 FORMAT "%13.11" ECU_ADDRESS 0xFDB6 /end MEASUREMENT
/begin MEASUREMENT B_mlnka "" UBYTE B_TRUE 1 100 0.00 1.00000000000 BIT_MASK 0x20 FORMAT "%13.11" ECU_ADDRESS 0xF0B8B /end MEASUREMENT
/begin MEASUREMENT B_mlnka2 "" UBYTE B_TRUE 1 100 0.00 1.00000000000 BIT_MASK 0x10 FORMAT "%13.11" ECU_ADDRESS 0xF0B8D /end MEASUREMENT
/begin MEASUREMENT B_mlrsa "" UWORD B_TRUE 1 100 0.00 1.00000000000 BIT_MASK 0x4000 FORMAT "%13.11" ECU_ADDRESS 0xFDB6 /end MEASUREMENT
/begin MEASUREMENT B_mrakt "" UWORD B_TRUE 1 100 0.00 1.00000000000 BIT_MASK 0x100 FORMAT "%13.11" ECU_ADDRESS 0xFDAA /end MEASUREMENT
/begin MEASUREMENT B_mrpfa "" UBYTE B_TRUE 1 100 0.00 1.00000000000 BIT_MASK 0x1 FORMAT "%13.11" ECU_ADDRESS 0xF0B26 /end MEASUREMENT
/begin MEASUREMENT B_msr "" UWORD B_TRUE 1 100 0.00 1.00000000000 BIT_MASK 0x200 FORMAT "%13.11" ECU_ADDRESS 0xFDA8 /end MEASUREMENT
/begin MEASUREMENT B_nekati "" UBYTE B_TRUE 1 100 0.00 1.00000000000 BIT_MASK 0x10 FORMAT "%13.11" ECU_ADDRESS 0xF0B8B /end MEASUREMENT
/begin MEASUREMENT B_nekati2 "" UBYTE B_TRUE 1 100 0.00 1.00000000000 BIT_MASK 0x8 FORMAT "%13.11" ECU_ADDRESS 0xF0B8D /end MEASUREMENT
/begin MEASUREMENT B_nofra "" UWORD B_TRUE 1 100 0.00 1.00000000000 BIT_MASK 0x400 FORMAT "%13.11" ECU_ADDRESS 0xFD74 /end MEASUREMENT
/begin MEASUREMENT B_nofrat "" UWORD B_TRUE 1 100 0.00 1.00000000000 BIT_MASK 0x800 FORMAT "%13.11" ECU_ADDRESS 0xFD74 /end MEASUREMENT
/begin MEASUREMENT B_norkat "" UWORD B_TRUE 1 100 0.00 1.00000000000 BIT_MASK 0x1000 FORMAT "%13.11" ECU_ADDRESS 0xFD74 /end MEASUREMENT
/begin MEASUREMENT B_norkaz "" UWORD B_TRUE 1 100 0.00 1.00000000000 BIT_MASK 0x2000 FORMAT "%13.11" ECU_ADDRESS 0xFD74 /end MEASUREMENT
/begin MEASUREMENT B_pspaus "" UWORD B_TRUE 1 100 0.00 1.00000000000 BIT_MASK 0x8000 FORMAT "%13.11" ECU_ADDRESS 0xFDB6 /end MEASUREMENT
/begin MEASUREMENT B_pspwl "" UWORD B_TRUE 1 100 0.00 1.00000000000 BIT_MASK 0x1 FORMAT "%13.11" ECU_ADDRESS 0xFDB8 /end MEASUREMENT
/begin MEASUREMENT B_range "" UWORD B_TRUE 1 100 0.00 1.00000000000 BIT_MASK 0x4000 FORMAT "%13.11" ECU_ADDRESS 0xFD74 /end MEASUREMENT
/begin MEASUREMENT B_range2 "" UWORD B_TRUE 1 100 0.00 1.00000000000 BIT_MASK 0x8000 FORMAT "%13.11" ECU_ADDRESS 0xFD74 /end MEASUREMENT
/begin MEASUREMENT B_rgang "" UWORD B_TRUE 1 100 0.00 1.00000000000 BIT_MASK 0x4000 FORMAT "%13.11" ECU_ADDRESS 0xFDA0 /end MEASUREMENT
/begin MEASUREMENT B_rkat "" UWORD B_TRUE 1 100 0.00 1.00000000000 BIT_MASK 0x1 FORMAT "%13.11" ECU_ADDRESS 0xFD76 /end MEASUREMENT
/begin MEASUREMENT B_rkatr "" UWORD B_TRUE 1 100 0.00 1.00000000000 BIT_MASK 0x2 FORMAT "%13.11" ECU_ADDRESS 0xFD76 /end MEASUREMENT
/begin MEASUREMENT B_rkatr2 "" UWORD B_TRUE 1 100 0.00 1.00000000000 BIT_MASK 0x4 FORMAT "%13.11" ECU_ADDRESS 0xFD76 /end MEASUREMENT
/begin MEASUREMENT B_rkaz "" UWORD B_TRUE 1 100 0.00 1.00000000000 BIT_MASK 0x8 FORMAT "%13.11" ECU_ADDRESS 0xFD76 /end MEASUREMENT
/begin MEASUREMENT B_rkazr "" UWORD B_TRUE 1 100 0.00 1.00000000000 BIT_MASK 0x10 FORMAT "%13.11" ECU_ADDRESS 0xFD76 /end MEASUREMENT
/begin MEASUREMENT B_rkazr2 "" UWORD B_TRUE 1 100 0.00 1.00000000000 BIT_MASK 0x20 FORMAT "%13.11" ECU_ADDRESS 0xFD76 /end MEASUREMENT
/begin MEASUREMENT B_sa "" UWORD B_TRUE 1 100 0.00 1.00000000000 BIT_MASK 0x4000 FORMAT "%13.11" ECU_ADDRESS 0xFDAA /end MEASUREMENT
/begin MEASUREMENT B_savmd "" UWORD B_TRUE 1 100 0.00 1.00000000000 BIT_MASK 0x400 FORMAT "%13.11" ECU_ADDRESS 0xFDA8 /end MEASUREMENT
/begin MEASUREMENT B_sgs "" UWORD B_TRUE 1 100 0.00 1.00000000000 BIT_MASK 0x800 FORMAT "%13.11" ECU_ADDRESS 0xFDA8 /end MEASUREMENT
/begin MEASUREMENT B_sgs0 "" UWORD B_TRUE 1 100 0.00 1.00000000000 BIT_MASK 0x1000 FORMAT "%13.11" ECU_ADDRESS 0xFDA8 /end MEASUREMENT
/begin MEASUREMENT B_sgspl "" UWORD B_TRUE 1 100 0.00 1.00000000000 BIT_MASK 0x8 FORMAT "%13.11" ECU_ADDRESS 0xFDAE /end MEASUREMENT
/begin MEASUREMENT B_sgsred "" UWORD B_TRUE 1 100 0.00 1.00000000000 BIT_MASK 0x10 FORMAT "%13.11" ECU_ADDRESS 0xFDAE /end MEASUREMENT
/begin MEASUREMENT B_slspaus "" UWORD B_TRUE 1 100 0.00 1.00000000000 BIT_MASK 0x2 FORMAT "%13.11" ECU_ADDRESS 0xFDB8 /end MEASUREMENT
/begin MEASUREMENT B_tarau "" UWORD B_TRUE 1 100 0.00 1.00000000000 BIT_MASK 0x4 FORMAT "%13.11" ECU_ADDRESS 0xFDB8 /end MEASUREMENT
/begin MEASUREMENT B_tdmlsds "" UWORD B_TRUE 1 100 0.00 1.00000000000 BIT_MASK 0x8 FORMAT "%13.11" ECU_ADDRESS 0xFDA8 /end MEASUREMENT
/begin MEASUREMENT B_tmlr "" UWORD B_TRUE 1 100 0.00 1.00000000000 BIT_MASK 0x8 FORMAT "%13.11" ECU_ADDRESS 0xFDB8 /end MEASUREMENT
/begin MEASUREMENT B_update "" UWORD B_TRUE 1 100 0.00 1.00000000000 BIT_MASK 0x4000 FORMAT "%13.11" ECU_ADDRESS 0xFDB4 /end MEASUREMENT
/begin MEASUREMENT B_update2 "" UWORD B_TRUE 1 100 0.00 1.00000000000 BIT_MASK 0x8000 FORMAT "%13.11" ECU_ADDRESS 0xFDB4 /end MEASUREMENT
/begin MEASUREMENT B_vl "" UWORD B_TRUE 1 100 0.00 1.00000000000 BIT_MASK 0x10 FORMAT "%13.11" ECU_ADDRESS 0xFDA8 /end MEASUREMENT
/begin MEASUREMENT B_vlsumrs "" UBYTE B_TRUE 1 100 0.00 1.00000000000 BIT_MASK 0x1 FORMAT "%13.11" ECU_ADDRESS 0xF0B70 /end MEASUREMENT
/begin MEASUREMENT B_vlsumrs2 "" UBYTE B_TRUE 1 100 0.00 1.00000000000 BIT_MASK 0x2 FORMAT "%13.11" ECU_ADDRESS 0xF0B70 /end MEASUREMENT
/begin MEASUREMENT B_vspt2 "" UWORD B_TRUE 1 100 0.00 1.00000000000 BIT_MASK 0x20 FORMAT "%13.11" ECU_ADDRESS 0xFDAE /end MEASUREMENT
/begin MEASUREMENT B_zwdmr "" UWORD B_TRUE 1 100 0.00 1.00000000000 BIT_MASK 0x2000 FORMAT "%13.11" ECU_ADDRESS 0xFDA8 /end MEASUREMENT
/begin MEASUREMENT B_zwfa "" UWORD B_TRUE 1 100 0.00 1.00000000000 BIT_MASK 0x4000 FORMAT "%13.11" ECU_ADDRESS 0xFDA8 /end MEASUREMENT
/begin MEASUREMENT B_zwfe "" UWORD B_TRUE 1 100 0.00 1.00000000000 BIT_MASK 0x8000 FORMAT "%13.11" ECU_ADDRESS 0xFDA8 /end MEASUREMENT
/begin MEASUREMENT B_zwget "" UWORD B_TRUE 1 100 0.00 1.00000000000 BIT_MASK 0x1 FORMAT "%13.11" ECU_ADDRESS 0xFDAA /end MEASUREMENT
/begin MEASUREMENT B_zwnget "" UWORD B_TRUE 1 100 0.00 1.00000000000 BIT_MASK 0x2 FORMAT "%13.11" ECU_ADDRESS 0xFDAA /end MEASUREMENT
/begin MEASUREMENT B_zwpp "" UWORD B_TRUE 1 100 0.00 1.00000000000 BIT_MASK 0x4 FORMAT "%13.11" ECU_ADDRESS 0xFDAA /end MEASUREMENT
/begin MEASUREMENT B_zwvs "" UWORD B_TRUE 1 100 0.00 1.00000000000 BIT_MASK 0x8 FORMAT "%13.11" ECU_ADDRESS 0xFDAA /end MEASUREMENT
/begin MEASUREMENT B_zwvz "" UWORD B_TRUE 1 100 0.00 1.00000000000 BIT_MASK 0x10 FORMAT "%13.11" ECU_ADDRESS 0xFDAA /end MEASUREMENT
/begin MEASUREMENT B_zwvzsy "" UWORD B_TRUE 1 100 0.00 1.00000000000 BIT_MASK 0x200 FORMAT "%13.11" ECU_ADDRESS 0xFDAC /end MEASUREMENT
/begin MEASUREMENT B_zwvzvb "" UWORD B_TRUE 1 100 0.00 1.00000000000 BIT_MASK 0x20 FORMAT "%13.11" ECU_ADDRESS 0xFDAA /end MEASUREMENT
/begin MEASUREMENT cmibeg_w "" UWORD dez 1 100 0.00 65535.00 FORMAT "%8.2" ECU_ADDRESS 0x382F36 /end MEASUREMENT
/begin MEASUREMENT dfr2_w "" SWORD fak_sw_b1 1 100 -1.000000 0.9999695 FORMAT "%8.6" ECU_ADDRESS 0xF2892 /end MEASUREMENT
/begin MEASUREMENT dfrm2_w "" SWORD fak_sw_b1 1 100 -1.000000 0.9999695 FORMAT "%8.6" ECU_ADDRESS 0xF4634 /end MEASUREMENT
/begin MEASUREMENT dfrmin2_w "" SWORD fak_sw_b1 1 100 -1.000000 0.9999695 FORMAT "%8.6" ECU_ADDRESS 0xF2894 /end MEASUREMENT
/begin MEASUREMENT dfrmin_w "" SWORD fak_sw_b1 1 100 -1.000000 0.9999695 FORMAT "%8.6" ECU_ADDRESS 0xF2896 /end MEASUREMENT
/begin MEASUREMENT dfrmnms2_w "" SWORD fak_sw_b1 1 100 -1.000000 0.9999695 FORMAT "%8.6" ECU_ADDRESS 0xF2898 /end MEASUREMENT
/begin MEASUREMENT dfrmnms_w "" SWORD fak_sw_b1 1 100 -1.000000 0.9999695 FORMAT "%8.6" ECU_ADDRESS 0xF289A /end MEASUREMENT
/begin MEASUREMENT dfrmn_w "" SWORD fak_sw_b1 1 100 -1.000000 0.9999695 FORMAT "%8.6" ECU_ADDRESS 0xF4EA4 /end MEASUREMENT
/begin MEASUREMENT dfrm_w "" SWORD fak_sw_b1 1 100 -1.000000 0.9999695 FORMAT "%8.6" ECU_ADDRESS 0xF4636 /end MEASUREMENT
/begin MEASUREMENT dfrpr2_w "" SWORD fak_sw_b1 1 100 -1.000000 0.9999695 FORMAT "%8.6" ECU_ADDRESS 0xF289C /end MEASUREMENT
/begin MEASUREMENT dfrpr_w "" SWORD fak_sw_b1 1 100 -1.000000 0.9999695 FORMAT "%8.6" ECU_ADDRESS 0xF289E /end MEASUREMENT
/begin MEASUREMENT dfr_w "" SWORD fak_sw_b1 1 100 -1.000000 0.9999695 FORMAT "%8.6" ECU_ADDRESS 0xF28A0 /end MEASUREMENT
/begin MEASUREMENT dlahi2_w "" SWORD fak_sw_b1 1 100 -1.000000 0.9999695 FORMAT "%8.6" ECU_ADDRESS 0x382F4E /end MEASUREMENT
/begin MEASUREMENT dlahini2_w "" SWORD fak_sw_b1 1 100 -1.000000 0.9999695 FORMAT "%8.6" ECU_ADDRESS 0xF4ED4 /end MEASUREMENT
/begin MEASUREMENT dlahini_w "" SWORD fak_sw_b1 1 100 -1.000000 0.9999695 FORMAT "%8.6" ECU_ADDRESS 0xF4ED6 /end MEASUREMENT
/begin MEASUREMENT dlahist2_w "" SWORD fak_sw_b1 1 100 -1.000000 0.9999695 FORMAT "%8.6" ECU_ADDRESS 0xF4ED8 /end MEASUREMENT
/begin MEASUREMENT dlahist_w "" SWORD fak_sw_b1 1 100 -1.000000 0.9999695 FORMAT "%8.6" ECU_ADDRESS 0xF4EDA /end MEASUREMENT
/begin MEASUREMENT dlahi_w "" SWORD fak_sw_b1 1 100 -1.000000 0.9999695 FORMAT "%8.6" ECU_ADDRESS 0x382F50 /end MEASUREMENT
/begin MEASUREMENT dlahkab2_w "" SWORD fak_sw_b1 1 100 -1.000000 0.9999695 FORMAT "%8.6" ECU_ADDRESS 0xF2924 /end MEASUREMENT
/begin MEASUREMENT dlahkab_w "" SWORD fak_sw_b1 1 100 -1.000000 0.9999695 FORMAT "%8.6" ECU_ADDRESS 0xF2926 /end MEASUREMENT
/begin MEASUREMENT dlahp2_w "" SWORD fak_sw_b1 1 100 -1.000000 0.9999695 FORMAT "%8.6" ECU_ADDRESS 0xF4EDC /end MEASUREMENT
/begin MEASUREMENT dlahp_w "" SWORD fak_sw_b1 1 100 -1.000000 0.9999695 FORMAT "%8.6" ECU_ADDRESS 0xF4EDE /end MEASUREMENT
/begin MEASUREMENT dlamka2_w "" SWORD fak_sw_b8 1 100 -1.000000 1.000000 FORMAT "%8.6" ECU_ADDRESS 0xF295A /end MEASUREMENT
/begin MEASUREMENT dlamka_w "" SWORD fak_sw_b8 1 100 -1.000000 1.000000 FORMAT "%8.6" ECU_ADDRESS 0xF295C /end MEASUREMENT
/begin MEASUREMENT dlashki2_w "" SWORD fak_sw_b1 1 100 -1.000000 0.9999695 FORMAT "%8.6" ECU_ADDRESS 0xF4EE0 /end MEASUREMENT
/begin MEASUREMENT dlashki_w "" SWORD fak_sw_b1 1 100 -1.000000 0.9999695 FORMAT "%8.6" ECU_ADDRESS 0xF4EE2 /end MEASUREMENT
/begin MEASUREMENT dlashkm2_w "" SWORD fak_sw_b1 1 100 -1.000000 0.9999695 FORMAT "%8.6" ECU_ADDRESS 0xF4EE4 /end MEASUREMENT
/begin MEASUREMENT dlashkm_w "" SWORD fak_sw_b1 1 100 -1.000000 0.9999695 FORMAT "%8.6" ECU_ADDRESS 0xF4EE6 /end MEASUREMENT
/begin MEASUREMENT dlashkp2_w "" SWORD fak_sw_b1 1 100 -1.000000 0.9999695 FORMAT "%8.6" ECU_ADDRESS 0xF4EE8 /end MEASUREMENT
/begin MEASUREMENT dlashkp_w "" SWORD fak_sw_b1 1 100 -1.000000 0.9999695 FORMAT "%8.6" ECU_ADDRESS 0xF4EEA /end MEASUREMENT
/begin MEASUREMENT dlaso "" SBYTE fak_sb_b0p03125 1 100 -0.03125 0.03101 FORMAT "%7.5" ECU_ADDRESS 0xF0B7C /end MEASUREMENT
/begin MEASUREMENT dlaso2 "" SBYTE fak_sb_b0p03125 1 100 -0.03125 0.03101 FORMAT "%7.5" ECU_ADDRESS 0xF0B7D /end MEASUREMENT
/begin MEASUREMENT dlrfrat "" UBYTE fak_q0p0625 1 100 0.00 15.94 FORMAT "%5.2" ECU_ADDRESS 0xF40EA /end MEASUREMENT
/begin MEASUREMENT dlsd_w "" UWORD fak_uw_b2 1 100 0.00 1.999969 FORMAT "%8.6" ECU_ADDRESS 0xF24E6 /end MEASUREMENT
/begin MEASUREMENT dlwsu_w "" SWORD dlw_sw_q0p04375 1 100 -1434.044 1434.000 FORMAT "%8.3" ECU_ADDRESS 0xF244E /end MEASUREMENT
/begin MEASUREMENT dmbebl_w "" UWORD rel_uw_b100 1 100 0.00 99.99847 FORMAT "%8.5" ECU_ADDRESS 0xF24E8 /end MEASUREMENT
/begin MEASUREMENT dmdpo_w "" UWORD rel_uw_b100 1 100 0.00 99.99847 FORMAT "%8.5" ECU_ADDRESS 0xF24EA /end MEASUREMENT
/begin MEASUREMENT dmdpu_w "" UWORD rel_uw_b100 1 100 0.00 99.99847 FORMAT "%8.5" ECU_ADDRESS 0xF24EC /end MEASUREMENT
/begin MEASUREMENT dmdwan_w "" UWORD rel_uw_b200 1 100 0.00 199.9969 FORMAT "%8.4" ECU_ADDRESS 0xF2406 /end MEASUREMENT
/begin MEASUREMENT dmgbeg_w "" UWORD rel_uw_b100 1 100 0.00 99.99847 FORMAT "%8.5" ECU_ADDRESS 0xF24EE /end MEASUREMENT
/begin MEASUREMENT dmlms_w "" SWORD rel_sw_b100 1 100 -100.0000 99.99695 FORMAT "%8.4" ECU_ADDRESS 0xF2564 /end MEASUREMENT
/begin MEASUREMENT dmlsdo_w "" UWORD rel_uw_b100 1 100 0.00 99.99847 FORMAT "%8.5" ECU_ADDRESS 0xF24F0 /end MEASUREMENT
/begin MEASUREMENT dmlsdu_w "" UWORD rel_uw_b100 1 100 0.00 99.99847 FORMAT "%8.5" ECU_ADDRESS 0xF24F2 /end MEASUREMENT
/begin MEASUREMENT dmr3lf_w "" UWORD rel_uw_b100 1 100 0.00 99.99847 FORMAT "%8.5" ECU_ADDRESS 0xF2450 /end MEASUREMENT
/begin MEASUREMENT dmrac "" UBYTE rel_ub_b99p6 1 100 0.00 99.61 FORMAT "%5.2" ECU_ADDRESS 0xF0B12 /end MEASUREMENT
/begin MEASUREMENT dmrfawe_w "" UWORD rel_uw_b200 1 100 0.00 199.9969 FORMAT "%8.4" ECU_ADDRESS 0xF24F4 /end MEASUREMENT
/begin MEASUREMENT dmrkt_w "" UWORD rel_uw_b100 1 100 0.00 99.99847 FORMAT "%8.5" ECU_ADDRESS 0xF479E /end MEASUREMENT
/begin MEASUREMENT dmrlf "" UBYTE rel_ub_b99p6 1 100 0.00 99.61 FORMAT "%5.2" ECU_ADDRESS 0xF0B13 /end MEASUREMENT
/begin MEASUREMENT dmrmx_w "" UWORD rel_uw_b100 1 100 0.00 99.99847 FORMAT "%8.5" ECU_ADDRESS 0xF2566 /end MEASUREMENT
/begin MEASUREMENT dmrwan "" UBYTE rel_ub_b99p6 1 100 0.00 99.61 FORMAT "%5.2" ECU_ADDRESS 0xF0B10 /end MEASUREMENT
/begin MEASUREMENT dmvadfk_w "" SWORD rel_sw_b100 1 100 -100.0000 99.99695 FORMAT "%8.4" ECU_ADDRESS 0x38407E /end MEASUREMENT
/begin MEASUREMENT dmvadfs_w "" SWORD rel_sw_b100 1 100 -100.0000 99.99695 FORMAT "%8.4" ECU_ADDRESS 0x384080 /end MEASUREMENT
/begin MEASUREMENT dmvadko_w "" SWORD rel_sw_b100 1 100 -100.0000 99.99695 FORMAT "%8.4" ECU_ADDRESS 0x384082 /end MEASUREMENT
/begin MEASUREMENT dmvadll_w "" SWORD rel_sw_b100 1 100 -100.0000 99.99695 FORMAT "%8.4" ECU_ADDRESS 0x384084 /end MEASUREMENT
/begin MEASUREMENT dmvad_w "" SWORD rel_sw_b100 1 100 -100.0000 99.99695 FORMAT "%8.4" ECU_ADDRESS 0xF474A /end MEASUREMENT
/begin MEASUREMENT dmvamnfk_w "" SWORD rel_sw_b100 1 100 -100.0000 99.99695 FORMAT "%8.4" ECU_ADDRESS 0xF474C /end MEASUREMENT
/begin MEASUREMENT dmvamnfs_w "" SWORD rel_sw_b100 1 100 -100.0000 99.99695 FORMAT "%8.4" ECU_ADDRESS 0xF474E /end MEASUREMENT
/begin MEASUREMENT dmvamnko_w "" SWORD rel_sw_b100 1 100 -100.0000 99.99695 FORMAT "%8.4" ECU_ADDRESS 0xF4750 /end MEASUREMENT
/begin MEASUREMENT dmvamnll_w "" SWORD rel_sw_b100 1 100 -100.0000 99.99695 FORMAT "%8.4" ECU_ADDRESS 0xF4752 /end MEASUREMENT
/begin MEASUREMENT dmvamxfk_w "" SWORD rel_sw_b100 1 100 -100.0000 99.99695 FORMAT "%8.4" ECU_ADDRESS 0xF4754 /end MEASUREMENT
/begin MEASUREMENT dmvamxfs_w "" SWORD rel_sw_b100 1 100 -100.0000 99.99695 FORMAT "%8.4" ECU_ADDRESS 0xF4756 /end MEASUREMENT
/begin MEASUREMENT dmvamxko_w "" SWORD rel_sw_b100 1 100 -100.0000 99.99695 FORMAT "%8.4" ECU_ADDRESS 0xF4758 /end MEASUREMENT
/begin MEASUREMENT dmvamxll_w "" SWORD rel_sw_b100 1 100 -100.0000 99.99695 FORMAT "%8.4" ECU_ADDRESS 0xF475A /end MEASUREMENT
/begin MEASUREMENT dmverl_w "" SWORD rel_sw_b100 1 100 -100.0000 99.99695 FORMAT "%8.4" ECU_ADDRESS 0xF2582 /end MEASUREMENT
/begin MEASUREMENT dmzms_w "" SWORD rel_sw_b100 1 100 -100.0000 99.99695 FORMAT "%8.4" ECU_ADDRESS 0xF254A /end MEASUREMENT
/begin MEASUREMENT dnabsak_w "" SWORD nmot_uw_q0p25 1 100 -8192.000 8191.750 FORMAT "%8.3" ECU_ADDRESS 0xF2602 /end MEASUREMENT
/begin MEASUREMENT dnasgabs_w "" SWORD nmot_uw_q0p25 1 100 -8192.000 8191.750 FORMAT "%8.3" ECU_ADDRESS 0xF2604 /end MEASUREMENT
/begin MEASUREMENT dnasgl_w "" SWORD nmot_uw_q0p25 1 100 -8192.000 8191.750 FORMAT "%8.3" ECU_ADDRESS 0xF2606 /end MEASUREMENT
/begin MEASUREMENT dnasg_w "" SWORD nmot_uw_q0p25 1 100 -8192.000 8191.750 FORMAT "%8.3" ECU_ADDRESS 0xF2608 /end MEASUREMENT
/begin MEASUREMENT dnitu_w "" SWORD nmotd_sw_q0p25 1 100 -8192.000 8191.750 FORMAT "%8.3" ECU_ADDRESS 0xF24F6 /end MEASUREMENT
/begin MEASUREMENT dnsolasg_w "" SWORD nmot_uw_q0p25 1 100 -8192.000 8191.750 FORMAT "%8.3" ECU_ADDRESS 0xF260A /end MEASUREMENT
/begin MEASUREMENT dnturb_w "" SWORD nmot_q0p1453421 1 100 -4762.570 4762.425 FORMAT "%8.3" ECU_ADDRESS 0xF2408 /end MEASUREMENT
/begin MEASUREMENT dpsu_w "" UWORD p_uw_q0p039 1 100 0.00 2559.961 FORMAT "%8.3" ECU_ADDRESS 0xF2584 /end MEASUREMENT
/begin MEASUREMENT drlsolf_w "" SWORD rel_sw_q0p0234 1 100 -768.0000 767.9766 FORMAT "%8.4" ECU_ADDRESS 0xF1DBC /end MEASUREMENT
/begin MEASUREMENT drlsol_w "" SWORD rel_sw_q0p0234 1 100 -768.0000 767.9766 FORMAT "%8.4" ECU_ADDRESS 0xF1DBE /end MEASUREMENT
/begin MEASUREMENT dzwb "" UBYTE zw_ub_q0p75 1 100 0.00 191.3 FORMAT "%5.1" ECU_ADDRESS 0xF0B2E /end MEASUREMENT
/begin MEASUREMENT dzwi "" SBYTE zw_sb_q0p75 1 100 -96.00 95.25 FORMAT "%5.2" ECU_ADDRESS 0xF0B3B /end MEASUREMENT
/begin MEASUREMENT dzwol "" SBYTE zw_sb_q0p75 1 100 -96.00 95.25 FORMAT "%5.2" ECU_ADDRESS 0xF0B2F /end MEASUREMENT
/begin MEASUREMENT dzwolb "" SBYTE zw_sb_q0p75 1 100 -96.00 95.25 FORMAT "%5.2" ECU_ADDRESS 0xF0B30 /end MEASUREMENT
/begin MEASUREMENT dzworri "" SBYTE zw_sb_q0p75 1 100 -96.00 95.25 FORMAT "%5.2" ECU_ADDRESS 0xF0B31 /end MEASUREMENT
/begin MEASUREMENT esst_sko06koub "" UWORD dez 1 100 0.00 65535.00 FORMAT "%8.2" ECU_ADDRESS 0xF4762 /end MEASUREMENT
/begin MEASUREMENT esst_sko06pko "" UWORD dez 1 100 0.00 65535.00 FORMAT "%8.2" ECU_ADDRESS 0xF4764 /end MEASUREMENT
/begin MEASUREMENT esst_smi12opuw "" UWORD dez 1 100 0.00 65535.00 FORMAT "%8.2" ECU_ADDRESS 0xF1DC0 /end MEASUREMENT
/begin MEASUREMENT esst_snm06koub "" UWORD dez 1 100 0.00 65535.00 FORMAT "%8.2" ECU_ADDRESS 0xF4766 /end MEASUREMENT
/begin MEASUREMENT esst_snm07lsuw "" UWORD dez 1 100 0.00 65535.00 FORMAT "%8.2" ECU_ADDRESS 0xF4EA6 /end MEASUREMENT
/begin MEASUREMENT esst_snm08lsub "" UWORD dez 1 100 0.00 65535.00 FORMAT "%8.2" ECU_ADDRESS 0xF4EA8 /end MEASUREMENT
/begin MEASUREMENT esst_snm12mduw "" UWORD dez 1 100 0.00 65535.00 FORMAT "%8.2" ECU_ADDRESS 0xF24F8 /end MEASUREMENT
/begin MEASUREMENT esst_sps11mduw "" UWORD dez 1 100 0.00 65535.00 FORMAT "%8.2" ECU_ADDRESS 0xF2586 /end MEASUREMENT
/begin MEASUREMENT esst_srl06koub "" UWORD dez 1 100 0.00 65535.00 FORMAT "%8.2" ECU_ADDRESS 0xF4768 /end MEASUREMENT
/begin MEASUREMENT esst_srl08lsub "" UWORD dez 1 100 0.00 65535.00 FORMAT "%8.2" ECU_ADDRESS 0xF4EAA /end MEASUREMENT
/begin MEASUREMENT esst_srl08lsuw "" UWORD dez 1 100 0.00 65535.00 FORMAT "%8.2" ECU_ADDRESS 0xF4EAC /end MEASUREMENT
/begin MEASUREMENT esst_sta06llub "" UWORD dez 1 100 0.00 65535.00 FORMAT "%8.2" ECU_ADDRESS 0xF476A /end MEASUREMENT
/begin MEASUREMENT esst_stw08mdub "" UWORD dez 1 100 0.00 65535.00 FORMAT "%8.2" ECU_ADDRESS 0xF475C /end MEASUREMENT
/begin MEASUREMENT esst_swp16mduw "" UWORD dez 1 100 0.00 65535.00 FORMAT "%8.2" ECU_ADDRESS 0xF24FA /end MEASUREMENT
/begin MEASUREMENT etalab "" UBYTE rel_ub_b127p5 1 100 0.00 127.5 FORMAT "%5.1" ECU_ADDRESS 0xF0B32 /end MEASUREMENT
/begin MEASUREMENT etalbb "" UBYTE rel_ub_b127p5 1 100 0.00 127.5 FORMAT "%5.1" ECU_ADDRESS 0xF0B33 /end MEASUREMENT
/begin MEASUREMENT etarrib "" UBYTE rel_ub_b127p5 1 100 0.00 127.5 FORMAT "%5.1" ECU_ADDRESS 0xF0B34 /end MEASUREMENT
/begin MEASUREMENT etazaist "" UBYTE rel_ub_b127p5 1 100 0.00 127.5 FORMAT "%5.1" ECU_ADDRESS 0xF0B3C /end MEASUREMENT
/begin MEASUREMENT etazwb "" UBYTE rel_ub_b127p5 1 100 0.00 127.5 FORMAT "%5.1" ECU_ADDRESS 0xF0B35 /end MEASUREMENT
/begin MEASUREMENT etazwbm "" UBYTE rel_ub_b127p5 1 100 0.00 127.5 FORMAT "%5.1" ECU_ADDRESS 0xF0B36 /end MEASUREMENT
/begin MEASUREMENT etazwist "" UBYTE rel_ub_b127p5 1 100 0.00 127.5 FORMAT "%5.1" ECU_ADDRESS 0xF0B3D /end MEASUREMENT
/begin MEASUREMENT fasgp_w "" UWORD relnmot_q0p477Em4 1 100 0.00 3.124952 FORMAT "%8.6" ECU_ADDRESS 0xF260C /end MEASUREMENT
/begin MEASUREMENT ffcoscmx "" UBYTE fak_ub_b1 1 100 0.00 0.9961 ECU_ADDRESS 0xF4168 /end MEASUREMENT
/begin MEASUREMENT ffcoscmx2 "" UBYTE fak_ub_b1 1 100 0.00 0.9961 ECU_ADDRESS 0xF4169 /end MEASUREMENT
/begin MEASUREMENT fkfped "" UBYTE fak_ub_b2 1 100 0.00 1.992 FORMAT "%5.3" ECU_ADDRESS 0xF0B23 /end MEASUREMENT
/begin MEASUREMENT fnstab_w "" UWORD fak_uw_b8 1 100 0.00 7.999878 FORMAT "%8.6" ECU_ADDRESS 0xF475E /end MEASUREMENT
/begin MEASUREMENT fr2_w "" UWORD fak_uw_b2 1 100 0.00 1.999969 FORMAT "%8.6" ECU_ADDRESS 0xF28A2 /end MEASUREMENT
/begin MEASUREMENT fra2_w "" UWORD fak_uw_b2 1 100 0.00 1.999969 FORMAT "%8.6" ECU_ADDRESS 0xF1FA2 /end MEASUREMENT
/begin MEASUREMENT frao2_w "" UWORD fak_uw_b2 1 100 0.00 1.999969 FORMAT "%8.6" ECU_ADDRESS 0xF4638 /end MEASUREMENT
/begin MEASUREMENT fraolt2_w "" UWORD fak_uw_b2 1 100 0.00 1.999969 FORMAT "%8.6" ECU_ADDRESS 0xF463A /end MEASUREMENT
/begin MEASUREMENT fraolt_w "" UWORD fak_uw_b2 1 100 0.00 1.999969 FORMAT "%8.6" ECU_ADDRESS 0xF463C /end MEASUREMENT
/begin MEASUREMENT frao_w "" UWORD fak_uw_b2 1 100 0.00 1.999969 FORMAT "%8.6" ECU_ADDRESS 0xF463E /end MEASUREMENT
/begin MEASUREMENT frat2_w "" UWORD fak_uw_b2 1 100 0.00 1.999969 FORMAT "%8.6" ECU_ADDRESS 0xF4640 /end MEASUREMENT
/begin MEASUREMENT frati2_w "" UWORD fak_uw_b2 1 100 0.00 1.999969 FORMAT "%8.6" ECU_ADDRESS 0xF1FA4 /end MEASUREMENT
/begin MEASUREMENT frati_w "" UWORD fak_uw_b2 1 100 0.00 1.999969 FORMAT "%8.6" ECU_ADDRESS 0xF4642 /end MEASUREMENT
/begin MEASUREMENT frat_w "" UWORD fak_uw_b2 1 100 0.00 1.999969 FORMAT "%8.6" ECU_ADDRESS 0xF4644 /end MEASUREMENT
/begin MEASUREMENT frau2_w "" UWORD fak_uw_b2 1 100 0.00 1.999969 FORMAT "%8.6" ECU_ADDRESS 0xF4646 /end MEASUREMENT
/begin MEASUREMENT frault2_w "" UWORD fak_uw_b2 1 100 0.00 1.999969 FORMAT "%8.6" ECU_ADDRESS 0xF4648 /end MEASUREMENT
/begin MEASUREMENT frault_w "" UWORD fak_uw_b2 1 100 0.00 1.999969 FORMAT "%8.6" ECU_ADDRESS 0xF464A /end MEASUREMENT
/begin MEASUREMENT frau_w "" UWORD fak_uw_b2 1 100 0.00 1.999969 FORMAT "%8.6" ECU_ADDRESS 0xF464C /end MEASUREMENT
/begin MEASUREMENT fra_w "" UWORD fak_uw_b2 1 100 0.00 1.999969 FORMAT "%8.6" ECU_ADDRESS 0xF1FA6 /end MEASUREMENT
/begin MEASUREMENT frini_w "" UWORD fak_uw_b2 1 100 0.00 1.999969 FORMAT "%8.6" ECU_ADDRESS 0xF28A4 /end MEASUREMENT
/begin MEASUREMENT frm2_w "" UWORD fak_uw_b2 1 100 0.00 1.999969 FORMAT "%8.6" ECU_ADDRESS 0xF28A6 /end MEASUREMENT
/begin MEASUREMENT frmn_w "" UWORD fak_uw_b2 1 100 0.00 1.999969 FORMAT "%8.6" ECU_ADDRESS 0xF4EAE /end MEASUREMENT
/begin MEASUREMENT frmx_w "" UWORD fak_uw_b2 1 100 0.00 1.999969 FORMAT "%8.6" ECU_ADDRESS 0xF4EB0 /end MEASUREMENT
/begin MEASUREMENT frm_w "" UWORD fak_uw_b2 1 100 0.00 1.999969 FORMAT "%8.6" ECU_ADDRESS 0xF28A8 /end MEASUREMENT
/begin MEASUREMENT frridzw "" UBYTE fak_q0p0078 1 100 0.00 1.992 FORMAT "%5.3" ECU_ADDRESS 0xF0B37 /end MEASUREMENT
/begin MEASUREMENT frtmki "" UBYTE fak_ub_b2 1 100 0.00 1.992 FORMAT "%5.3" ECU_ADDRESS 0xF4161 /end MEASUREMENT
/begin MEASUREMENT fr_w "" UWORD fak_uw_b2 1 100 0.00 1.999969 FORMAT "%8.6" ECU_ADDRESS 0xF28AA /end MEASUREMENT
/begin MEASUREMENT ftklra_w "" UWORD fak_uw_b2 1 100 0.00 1.999969 FORMAT "%8.6" ECU_ADDRESS 0xF464E /end MEASUREMENT
/begin MEASUREMENT fwmifabg "" UBYTE fak_ub_b4 1 100 0.00 3.984 FORMAT "%5.3" ECU_ADDRESS 0xF0B24 /end MEASUREMENT
/begin MEASUREMENT fwmifal "" UBYTE fak_ub_b4 1 100 0.00 3.984 FORMAT "%5.3" ECU_ADDRESS 0xF0B25 /end MEASUREMENT
/begin MEASUREMENT fwzlsd "" UBYTE fak_ub_b4 1 100 0.00 3.984 FORMAT "%5.3" ECU_ADDRESS 0xF415E /end MEASUREMENT
/begin MEASUREMENT fzdash "" UBYTE rfak_q0p5 1 100 0.501961 128.000 FORMAT "%7.3" ECU_ADDRESS 0xF415F /end MEASUREMENT
/begin MEASUREMENT g1korr "" UBYTE fak_ub_b2 1 100 0.00 1.992 FORMAT "%5.3" ECU_ADDRESS 0xF4165 /end MEASUREMENT
/begin MEASUREMENT iftkavx2_w "" UWORD m_uw_b291p25 1 100 0.00 291.2667 FORMAT "%8.4" ECU_ADDRESS 0xF4EF4 /end MEASUREMENT
/begin MEASUREMENT iftkavx_w "" UWORD m_uw_b291p25 1 100 0.00 291.2667 FORMAT "%8.4" ECU_ADDRESS 0xF4EF6 /end MEASUREMENT
/begin MEASUREMENT ilmltkx2_w "" UWORD m_uw_b291p25 1 100 0.00 291.2667 FORMAT "%8.4" ECU_ADDRESS 0xF4EF8 /end MEASUREMENT
/begin MEASUREMENT ilmltkx_w "" UWORD m_uw_b291p25 1 100 0.00 291.2667 FORMAT "%8.4" ECU_ADDRESS 0xF4EFA /end MEASUREMENT
/begin MEASUREMENT imlevab2_w "" UWORD m_uw_b4660 1 100 0.00 4660.267 FORMAT "%8.3" ECU_ADDRESS 0xF2908 /end MEASUREMENT
/begin MEASUREMENT imlevab_w "" UWORD m_uw_b4660 1 100 0.00 4660.267 FORMAT "%8.3" ECU_ADDRESS 0xF290A /end MEASUREMENT
/begin MEASUREMENT imlka2_w "" UWORD m_uw_b291p25 1 100 0.00 291.2667 FORMAT "%8.4" ECU_ADDRESS 0xF295E /end MEASUREMENT
/begin MEASUREMENT imlka_w "" UWORD m_uw_b291p25 1 100 0.00 291.2667 FORMAT "%8.4" ECU_ADDRESS 0xF2960 /end MEASUREMENT
/begin MEASUREMENT imllaka2_w "" UWORD m_uw_b291p25 1 100 0.00 30.00000 FORMAT "%8.5" ECU_ADDRESS 0xF2962 /end MEASUREMENT
/begin MEASUREMENT imllaka_w "" UWORD m_uw_b291p25 1 100 0.00 30.00000 FORMAT "%8.5" ECU_ADDRESS 0xF2964 /end MEASUREMENT
/begin MEASUREMENT imlrsa_w "" UWORD m_uw_b4660 1 100 0.00 4660.267 FORMAT "%8.3" ECU_ADDRESS 0xF290C /end MEASUREMENT
/begin MEASUREMENT imslaka2_w "" UWORD m_uw_b291p25 1 100 0.00 30.00000 FORMAT "%8.5" ECU_ADDRESS 0xF2966 /end MEASUREMENT
/begin MEASUREMENT imslaka_w "" UWORD m_uw_b291p25 1 100 0.00 30.00000 FORMAT "%8.5" ECU_ADDRESS 0xF2968 /end MEASUREMENT
/begin MEASUREMENT kfmdsmn_w "" UWORD rel_uw_b100 1 100 0.00 99.99847 FORMAT "%8.5" ECU_ADDRESS 0xF2588 /end MEASUREMENT
/begin MEASUREMENT kfmds_w "" UWORD rel_uw_b100 1 100 0.00 99.99847 FORMAT "%8.5" ECU_ADDRESS 0xF258A /end MEASUREMENT
/begin MEASUREMENT ladiff2_w "" SWORD fak_sw_b1 1 100 -1.000000 0.9999695 FORMAT "%8.6" ECU_ADDRESS 0xF28AC /end MEASUREMENT
/begin MEASUREMENT ladiff_w "" SWORD fak_sw_b1 1 100 -1.000000 0.9999695 FORMAT "%8.6" ECU_ADDRESS 0xF28AE /end MEASUREMENT
/begin MEASUREMENT lahkmz "" UBYTE dez 1 100 0.00 255.0 FORMAT "%5.1" ECU_ADDRESS 0xF0B87 /end MEASUREMENT
/begin MEASUREMENT lahkmz2 "" UBYTE dez 1 100 0.00 255.0 FORMAT "%5.1" ECU_ADDRESS 0xF0B88 /end MEASUREMENT
/begin MEASUREMENT lamhf2_w "" UWORD fak_uw_b16 1 100 0.00 15.99976 FORMAT "%8.5" ECU_ADDRESS 0xF2928 /end MEASUREMENT
/begin MEASUREMENT lamhf_w "" UWORD fak_uw_b16 1 100 0.00 15.99976 FORMAT "%8.5" ECU_ADDRESS 0xF292A /end MEASUREMENT
/begin MEASUREMENT lamhm2_w "" UWORD fak_uw_b16 1 100 0.00 15.99976 FORMAT "%8.5" ECU_ADDRESS 0xF292C /end MEASUREMENT
/begin MEASUREMENT lamhm_w "" UWORD fak_uw_b16 1 100 0.00 15.99976 FORMAT "%8.5" ECU_ADDRESS 0xF292E /end MEASUREMENT
/begin MEASUREMENT lamka2_w "" UWORD fak_uw_b16 1 100 0.00 15.99976 FORMAT "%8.5" ECU_ADDRESS 0xF296A /end MEASUREMENT
/begin MEASUREMENT lamka_w "" UWORD fak_uw_b16 1 100 0.00 15.99976 FORMAT "%8.5" ECU_ADDRESS 0xF296C /end MEASUREMENT
/begin MEASUREMENT lamsoka2_w "" UWORD fak_uw_b16 1 100 0.00 15.99976 FORMAT "%8.5" ECU_ADDRESS 0xF296E /end MEASUREMENT
/begin MEASUREMENT lamsoka_w "" UWORD fak_uw_b16 1 100 0.00 15.99976 FORMAT "%8.5" ECU_ADDRESS 0xF2970 /end MEASUREMENT
/begin MEASUREMENT lamsolh2_w "" UWORD fak_uw_b16 1 100 0.00 15.99976 FORMAT "%8.5" ECU_ADDRESS 0xF2930 /end MEASUREMENT
/begin MEASUREMENT lamsolh_w "" UWORD fak_uw_b16 1 100 0.00 15.99976 FORMAT "%8.5" ECU_ADDRESS 0xF2932 /end MEASUREMENT
/begin MEASUREMENT lamsonh2_w "" UWORD fak_uw_b16 1 100 0.00 15.99976 FORMAT "%8.5" ECU_ADDRESS 0xF2934 /end MEASUREMENT
/begin MEASUREMENT lamsonh_w "" UWORD fak_uw_b16 1 100 0.00 15.99976 FORMAT "%8.5" ECU_ADDRESS 0xF2936 /end MEASUREMENT
/begin MEASUREMENT lamssok2_w "" UWORD fak_uw_b16 1 100 0.00 15.99976 FORMAT "%8.5" ECU_ADDRESS 0xF28B0 /end MEASUREMENT
/begin MEASUREMENT lamssok_w "" UWORD fak_uw_b16 1 100 0.00 15.99976 FORMAT "%8.5" ECU_ADDRESS 0xF28B2 /end MEASUREMENT
/begin MEASUREMENT lamzak2_w "" UWORD fak_uw_b16 1 100 0.00 15.99976 FORMAT "%8.5" ECU_ADDRESS 0xF28B4 /end MEASUREMENT
/begin MEASUREMENT lamzak_w "" UWORD fak_uw_b16 1 100 0.00 15.99976 FORMAT "%8.5" ECU_ADDRESS 0xF28B6 /end MEASUREMENT
/begin MEASUREMENT lrdtwl_w "" UWORD t100msxs_uw_b6553p5 1 100 0.00 6553.500 FORMAT "%8.3" ECU_ADDRESS 0xF4ECE /end MEASUREMENT
/begin MEASUREMENT lrkaz "" UBYTE dez 1 100 0.00 255.0 FORMAT "%5.1" ECU_ADDRESS 0xF0B9F /end MEASUREMENT
/begin MEASUREMENT lrkaz2 "" UBYTE dez 1 100 0.00 255.0 FORMAT "%5.1" ECU_ADDRESS 0xF0BA0 /end MEASUREMENT
/begin MEASUREMENT lrsg12_w "" SWORD fak_sw_b32 1 100 -32.00000 31.99902 FORMAT "%8.5" ECU_ADDRESS 0xF4EB2 /end MEASUREMENT
/begin MEASUREMENT lrsg1_w "" SWORD fak_sw_b32 1 100 -32.00000 31.99902 FORMAT "%8.5" ECU_ADDRESS 0xF4EB4 /end MEASUREMENT
/begin MEASUREMENT lrsg22_w "" UWORD fak_uw_b64_1 1 100 0.00 63.99902 FORMAT "%8.5" ECU_ADDRESS 0xF4EB6 /end MEASUREMENT
/begin MEASUREMENT lrsg2_w "" UWORD fak_uw_b64_1 1 100 0.00 63.99902 FORMAT "%8.5" ECU_ADDRESS 0xF4EB8 /end MEASUREMENT
/begin MEASUREMENT lrsg42_w "" SWORD fak_sw_b2_1 1 100 -2.000000 1.999939 FORMAT "%8.6" ECU_ADDRESS 0xF4EBA /end MEASUREMENT
/begin MEASUREMENT lrsg4_w "" SWORD fak_sw_b2_1 1 100 -2.000000 1.999939 FORMAT "%8.6" ECU_ADDRESS 0xF4EBC /end MEASUREMENT
/begin MEASUREMENT LRSHKlokbits1_2 "" UBYTE dez 1 100 0.00 255.0 FORMAT "%5.1" ECU_ADDRESS 0xF0B8D /end MEASUREMENT
/begin MEASUREMENT LRSHKlokbits2_2 "" UBYTE dez 1 100 0.00 255.0 FORMAT "%5.1" ECU_ADDRESS 0xF0B8F /end MEASUREMENT
/begin MEASUREMENT lrsinte2_w "" SWORD fak_sw_b1_1 1 100 -1.000000 0.9999695 FORMAT "%8.6" ECU_ADDRESS 0xF28B8 /end MEASUREMENT
/begin MEASUREMENT lrsinte_w "" SWORD fak_sw_b1_1 1 100 -1.000000 0.9999695 FORMAT "%8.6" ECU_ADDRESS 0xF28BA /end MEASUREMENT
/begin MEASUREMENT lrskaAusBits20ms "" UBYTE dez 1 100 0.00 255.0 FORMAT "%5.1" ECU_ADDRESS 0xF0BA1 /end MEASUREMENT
/begin MEASUREMENT lrskaLokBits20ms "" UBYTE dez 1 100 0.00 255.0 FORMAT "%5.1" ECU_ADDRESS 0xF0BA2 /end MEASUREMENT
/begin MEASUREMENT lrsp12_w "" UWORD fak_uw_b128_1 1 100 0.00 127.9980 FORMAT "%8.4" ECU_ADDRESS 0xF4EBE /end MEASUREMENT
/begin MEASUREMENT lrsp1_w "" UWORD fak_uw_b128_1 1 100 0.00 127.9980 FORMAT "%8.4" ECU_ADDRESS 0xF4EC0 /end MEASUREMENT
/begin MEASUREMENT lrsp22_w "" UWORD fak_uw_b128_1 1 100 0.00 127.9980 FORMAT "%8.4" ECU_ADDRESS 0xF4EC2 /end MEASUREMENT
/begin MEASUREMENT lrsp2_w "" UWORD fak_uw_b128_1 1 100 0.00 127.9980 FORMAT "%8.4" ECU_ADDRESS 0xF4EC4 /end MEASUREMENT
/begin MEASUREMENT lrsp32_w "" UWORD fak_uw_b128_1 1 100 0.00 127.9980 FORMAT "%8.4" ECU_ADDRESS 0xF4EC6 /end MEASUREMENT
/begin MEASUREMENT lrsp3_w "" UWORD fak_uw_b128_1 1 100 0.00 127.9980 FORMAT "%8.4" ECU_ADDRESS 0xF4EC8 /end MEASUREMENT
/begin MEASUREMENT lrsp42_w "" SWORD fak_sw_b64 1 100 -64.00000 63.99805 FORMAT "%8.5" ECU_ADDRESS 0xF4ECA /end MEASUREMENT
/begin MEASUREMENT lrsp4_w "" SWORD fak_sw_b64 1 100 -64.00000 63.99805 FORMAT "%8.5" ECU_ADDRESS 0xF4ECC /end MEASUREMENT
/begin MEASUREMENT lrsw12_w "" SWORD fak_sw_b4_1 1 100 -4.000000 3.999878 FORMAT "%8.6" ECU_ADDRESS 0xF28BC /end MEASUREMENT
/begin MEASUREMENT lrsw1_w "" SWORD fak_sw_b4_1 1 100 -4.000000 3.999878 FORMAT "%8.6" ECU_ADDRESS 0xF28BE /end MEASUREMENT
/begin MEASUREMENT lrsw22_w "" SWORD fak_sw_b4_1 1 100 -4.000000 3.999878 FORMAT "%8.6" ECU_ADDRESS 0xF28C0 /end MEASUREMENT
/begin MEASUREMENT lrsw2_w "" SWORD fak_sw_b4_1 1 100 -4.000000 3.999878 FORMAT "%8.6" ECU_ADDRESS 0xF28C2 /end MEASUREMENT
/begin MEASUREMENT lrsxk32_w "" SWORD fak_sw_b1 1 100 -1.000000 0.9999695 FORMAT "%8.6" ECU_ADDRESS 0xF28C4 /end MEASUREMENT
/begin MEASUREMENT lrsxk3_w "" SWORD fak_sw_b1 1 100 -1.000000 0.9999695 FORMAT "%8.6" ECU_ADDRESS 0xF28C6 /end MEASUREMENT
/begin MEASUREMENT lrsxk42_w "" SWORD fak_sw_b1 1 100 -1.000000 0.9999695 FORMAT "%8.6" ECU_ADDRESS 0xF28C8 /end MEASUREMENT
/begin MEASUREMENT lrsxk4_w "" SWORD fak_sw_b1 1 100 -1.000000 0.9999695 FORMAT "%8.6" ECU_ADDRESS 0xF28CA /end MEASUREMENT
/begin MEASUREMENT lrsy22_w "" SWORD fak_sw_b1 1 100 -1.000000 0.9999695 FORMAT "%8.6" ECU_ADDRESS 0xF28CC /end MEASUREMENT
/begin MEASUREMENT lrsy2_w "" SWORD fak_sw_b1 1 100 -1.000000 0.9999695 FORMAT "%8.6" ECU_ADDRESS 0xF28CE /end MEASUREMENT
/begin MEASUREMENT lrsy32_w "" SWORD fak_sw_b1 1 100 -1.000000 0.9999695 FORMAT "%8.6" ECU_ADDRESS 0xF28D0 /end MEASUREMENT
/begin MEASUREMENT lrsy3_w "" SWORD fak_sw_b1 1 100 -1.000000 0.9999695 FORMAT "%8.6" ECU_ADDRESS 0xF28D2 /end MEASUREMENT
/begin MEASUREMENT lrsy42_w "" SWORD fak_sw_b8 1 100 -8.000000 7.999756 FORMAT "%8.6" ECU_ADDRESS 0xF28D4 /end MEASUREMENT
/begin MEASUREMENT lrsy4_w "" SWORD fak_sw_b8 1 100 -8.000000 7.999756 FORMAT "%8.6" ECU_ADDRESS 0xF28D6 /end MEASUREMENT
/begin MEASUREMENT lrsyd2_w "" SWORD fak_sw_b1 1 100 -1.000000 0.9999695 FORMAT "%8.6" ECU_ADDRESS 0xF28D8 /end MEASUREMENT
/begin MEASUREMENT lrsyd_w "" SWORD fak_sw_b1 1 100 -1.000000 0.9999695 FORMAT "%8.6" ECU_ADDRESS 0xF28DA /end MEASUREMENT
/begin MEASUREMENT lrsyi2_w "" SWORD fak_sw_b1 1 100 -1.000000 0.9999695 FORMAT "%8.6" ECU_ADDRESS 0xF28DC /end MEASUREMENT
/begin MEASUREMENT lrsyi_w "" SWORD fak_sw_b1 1 100 -1.000000 0.9999695 FORMAT "%8.6" ECU_ADDRESS 0xF28DE /end MEASUREMENT
/begin MEASUREMENT lrsyp2_w "" SWORD fak_sw_b1 1 100 -1.000000 0.9999695 FORMAT "%8.6" ECU_ADDRESS 0xF28E0 /end MEASUREMENT
/begin MEASUREMENT lrsyp_w "" SWORD fak_sw_b1 1 100 -1.000000 0.9999695 FORMAT "%8.6" ECU_ADDRESS 0xF28E2 /end MEASUREMENT
/begin MEASUREMENT md3lf_w "" UWORD rel_uw_b100 1 100 0.00 99.99847 FORMAT "%8.5" ECU_ADDRESS 0xF2452 /end MEASUREMENT
/begin MEASUREMENT mdatxm_w "" UWORD rel_uw_b200 1 100 0.00 199.9969 FORMAT "%8.4" ECU_ADDRESS 0xF240A /end MEASUREMENT
/begin MEASUREMENT MDBGRGlokbits "" UBYTE dez 1 100 0.00 255.0 FORMAT "%5.1" ECU_ADDRESS 0xF0B4A /end MEASUREMENT
/begin MEASUREMENT mddlws_w "" SWORD rel_sw_b50 1 100 -50.00000 49.99847 FORMAT "%8.5" ECU_ADDRESS 0xF2454 /end MEASUREMENT
/begin MEASUREMENT mdel_w "" UWORD rel_uw_b100 1 100 0.00 99.99847 FORMAT "%8.5" ECU_ADDRESS 0xF476C /end MEASUREMENT
/begin MEASUREMENT MDFAWlokbits "" UBYTE dez 1 100 0.00 255.0 FORMAT "%5.1" ECU_ADDRESS 0xF0B26 /end MEASUREMENT
/begin MEASUREMENT mdfaw_bits "" UBYTE dez 1 100 0.00 255.0 FORMAT "%5.1" ECU_ADDRESS 0xF0B27 /end MEASUREMENT
/begin MEASUREMENT mdgen_w "" UWORD rel_uw_b100 1 100 0.00 99.99847 FORMAT "%8.5" ECU_ADDRESS 0xF2456 /end MEASUREMENT
/begin MEASUREMENT mdindg_w "" UWORD rel_uw_b100 1 100 0.00 99.99847 FORMAT "%8.5" ECU_ADDRESS 0xF25A2 /end MEASUREMENT
/begin MEASUREMENT mdkoini "" UBYTE rel_ub_b99p6 1 100 0.00 99.61 FORMAT "%5.2" ECU_ADDRESS 0xF415B /end MEASUREMENT
/begin MEASUREMENT mdko_w "" UWORD rel_uw_b100 1 100 0.00 99.99847 FORMAT "%8.5" ECU_ADDRESS 0xF2458 /end MEASUREMENT
/begin MEASUREMENT mdlfs_w "" UWORD rel_uw_b100 1 100 0.00 99.99847 FORMAT "%8.5" ECU_ADDRESS 0xF245A /end MEASUREMENT
/begin MEASUREMENT mdlws_w "" UWORD rel_uw_b100 1 100 0.00 99.99847 FORMAT "%8.5" ECU_ADDRESS 0xF245C /end MEASUREMENT
/begin MEASUREMENT mdsasg_w "" UWORD rel_uw_b100 1 100 0.00 99.99847 FORMAT "%8.5" ECU_ADDRESS 0xF260E /end MEASUREMENT
/begin MEASUREMENT mdsh_w "" SWORD rel_sw_b50 1 100 -50.00000 49.99847 FORMAT "%8.5" ECU_ADDRESS 0xF4776 /end MEASUREMENT
/begin MEASUREMENT mdslpf_w "" UWORD rel_uw_b100 1 100 0.00 99.99847 FORMAT "%8.5" ECU_ADDRESS 0xF245E /end MEASUREMENT
/begin MEASUREMENT mdslw_w "" UWORD rel_uw_b100 1 100 0.00 99.99847 FORMAT "%8.5" ECU_ADDRESS 0xF258C /end MEASUREMENT
/begin MEASUREMENT mdsmn_w "" UWORD rel_uw_b100 1 100 0.00 99.99847 FORMAT "%8.5" ECU_ADDRESS 0xF258E /end MEASUREMENT
/begin MEASUREMENT mdsm_w "" UWORD rel_uw_b100 1 100 0.00 99.99847 FORMAT "%8.5" ECU_ADDRESS 0xF4778 /end MEASUREMENT
/begin MEASUREMENT mdssta_w "" UWORD rel_uw_b100 1 100 0.00 99.99847 FORMAT "%8.5" ECU_ADDRESS 0xF477A /end MEASUREMENT
/begin MEASUREMENT mdswl_w "" UWORD rel_uw_b100 1 100 0.00 99.99847 FORMAT "%8.5" ECU_ADDRESS 0xF2460 /end MEASUREMENT
/begin MEASUREMENT mds_w "" UWORD rel_uw_b100 1 100 0.00 99.99847 FORMAT "%8.5" ECU_ADDRESS 0xF2590 /end MEASUREMENT
/begin MEASUREMENT MDVERADlokbits "" UBYTE dez 1 100 0.00 255.0 FORMAT "%5.1" ECU_ADDRESS 0xF0B0E /end MEASUREMENT
/begin MEASUREMENT MDVERADlokbits1 "" UBYTE dez 1 100 0.00 255.0 FORMAT "%5.1" ECU_ADDRESS 0xF0B0F /end MEASUREMENT
/begin MEASUREMENT mdverb "" UBYTE rel_ub_b100 1 100 0.00 99.61 FORMAT "%5.2" ECU_ADDRESS 0xF0B14 /end MEASUREMENT
/begin MEASUREMENT mdverb_w "" UWORD rel_uw_b100 1 100 0.00 99.99847 FORMAT "%8.5" ECU_ADDRESS 0xF2462 /end MEASUREMENT
/begin MEASUREMENT mdverf_w "" UWORD rel_uw_b100 1 100 0.00 99.99847 FORMAT "%8.5" ECU_ADDRESS 0xF2592 /end MEASUREMENT
/begin MEASUREMENT mdverlp_w "" UWORD rel_uw_b100 1 100 0.00 99.99847 FORMAT "%8.5" ECU_ADDRESS 0xF2610 /end MEASUREMENT
/begin MEASUREMENT mdverl_w "" UWORD rel_uw_b100 1 100 0.00 99.99847 FORMAT "%8.5" ECU_ADDRESS 0xF2594 /end MEASUREMENT
/begin MEASUREMENT mdvervf_w "" SWORD rel_sw_b100 1 100 -100.0000 99.99695 FORMAT "%8.4" ECU_ADDRESS 0xF2596 /end MEASUREMENT
/begin MEASUREMENT mdwancb_w "" UWORD rel_uw_b200 1 100 0.00 199.9969 FORMAT "%8.4" ECU_ADDRESS 0xF240C /end MEASUREMENT
/begin MEASUREMENT mdwanvf_w "" UWORD rel_uw_b200 1 100 0.00 199.9969 FORMAT "%8.4" ECU_ADDRESS 0xF240E /end MEASUREMENT
/begin MEASUREMENT mdwan_w "" UWORD rel_uw_b200 1 100 0.00 199.9969 FORMAT "%8.4" ECU_ADDRESS 0xF2410 /end MEASUREMENT
/begin MEASUREMENT miasgdt1_w "" SWORD rel_sw_b100 1 100 -100.0000 99.99695 FORMAT "%8.4" ECU_ADDRESS 0xF2612 /end MEASUREMENT
/begin MEASUREMENT miasgpl_w "" SWORD rel_sw_b100 1 100 -100.0000 99.99695 FORMAT "%8.4" ECU_ADDRESS 0xF2614 /end MEASUREMENT
/begin MEASUREMENT miasgp_w "" SWORD rel_sw_b100 1 100 -100.0000 99.99695 FORMAT "%8.4" ECU_ADDRESS 0xF2616 /end MEASUREMENT
/begin MEASUREMENT miasgvor_w "" UWORD rel_uw_b100 1 100 0.00 99.99847 FORMAT "%8.5" ECU_ADDRESS 0xF2618 /end MEASUREMENT
/begin MEASUREMENT miatbgr_w "" UWORD rel_uw_b100 1 100 0.00 99.99847 FORMAT "%8.5" ECU_ADDRESS 0xF4790 /end MEASUREMENT
/begin MEASUREMENT miautget_w "" UWORD rel_uw_b100 1 100 0.00 99.99847 FORMAT "%8.5" ECU_ADDRESS 0xF25F8 /end MEASUREMENT
/begin MEASUREMENT miautgs_w "" UWORD rel_uw_b100 1 100 0.00 99.99847 FORMAT "%8.5" ECU_ADDRESS 0xF25FA /end MEASUREMENT
/begin MEASUREMENT mibas_w "" UWORD rel_uw_b100 1 100 0.00 99.99847 FORMAT "%8.5" ECU_ADDRESS 0xF2570 /end MEASUREMENT
/begin MEASUREMENT mibdp_w "" UWORD rel_uw_b100 1 100 0.00 99.99847 FORMAT "%8.5" ECU_ADDRESS 0xF24FC /end MEASUREMENT
/begin MEASUREMENT mibeg_w "" UWORD rel_uw_b100 1 100 0.00 99.99847 FORMAT "%8.5" ECU_ADDRESS 0xF254C /end MEASUREMENT
/begin MEASUREMENT mibgrg_w "" UWORD rel_uw_b100 1 100 0.00 99.99847 FORMAT "%8.5" ECU_ADDRESS 0xF4792 /end MEASUREMENT
/begin MEASUREMENT mibgrl_w "" UWORD rel_uw_b100 1 100 0.00 99.99847 FORMAT "%8.5" ECU_ADDRESS 0xF4794 /end MEASUREMENT
/begin MEASUREMENT mibgr_w "" UWORD rel_uw_b100 1 100 0.00 99.99847 FORMAT "%8.5" ECU_ADDRESS 0xF4796 /end MEASUREMENT
/begin MEASUREMENT miblsd_w "" UWORD rel_uw_b100 1 100 0.00 99.99847 FORMAT "%8.5" ECU_ADDRESS 0xF24FE /end MEASUREMENT
/begin MEASUREMENT mibrmx_w "" UWORD rel_uw_b100 1 100 0.00 99.99847 FORMAT "%8.5" ECU_ADDRESS 0xF4798 /end MEASUREMENT
/begin MEASUREMENT miekpbgr_w "" UWORD rel_uw_b100 1 100 0.00 99.99847 FORMAT "%8.5" ECU_ADDRESS 0xF479A /end MEASUREMENT
/begin MEASUREMENT miext_w "" UWORD rel_uw_b100 1 100 0.00 99.99847 FORMAT "%8.5" ECU_ADDRESS 0xF254E /end MEASUREMENT
/begin MEASUREMENT mifa "" UBYTE rel_ub_b99p6 1 100 0.00 99.61 FORMAT "%5.2" ECU_ADDRESS 0xF0B28 /end MEASUREMENT
/begin MEASUREMENT mifabg_w "" UWORD rel_uw_b100 1 100 0.00 99.99847 FORMAT "%8.5" ECU_ADDRESS 0xF2500 /end MEASUREMENT
/begin MEASUREMENT mifab_w "" UWORD rel_uw_b100 1 100 0.00 99.99847 FORMAT "%8.5" ECU_ADDRESS 0xF2550 /end MEASUREMENT
/begin MEASUREMENT mifafu_w "" UWORD rel_uw_b100 1 100 0.00 99.99847 FORMAT "%8.5" ECU_ADDRESS 0xF2568 /end MEASUREMENT
/begin MEASUREMENT mifak_w "" UWORD rel_uw_b100 1 100 0.00 99.99847 FORMAT "%8.5" ECU_ADDRESS 0xF2502 /end MEASUREMENT
/begin MEASUREMENT mifali_w "" UWORD rel_uw_b100 1 100 0.00 99.99847 FORMAT "%8.5" ECU_ADDRESS 0xF2504 /end MEASUREMENT
/begin MEASUREMENT mifal_w "" UWORD rel_uw_b100 1 100 0.00 99.99847 FORMAT "%8.5" ECU_ADDRESS 0xF2506 /end MEASUREMENT
/begin MEASUREMENT mifa_w "" UWORD rel_uw_b100 1 100 0.00 99.99847 FORMAT "%8.5" ECU_ADDRESS 0xF2508 /end MEASUREMENT
/begin MEASUREMENT migef_w "" UWORD rel_uw_b100 1 100 0.00 99.99847 FORMAT "%8.5" ECU_ADDRESS 0xF250A /end MEASUREMENT
/begin MEASUREMENT migsl_w "" UWORD rel_uw_b100 1 100 0.00 99.99847 FORMAT "%8.5" ECU_ADDRESS 0xF261A /end MEASUREMENT
/begin MEASUREMENT miistoar_w "" UWORD rel_uw_b100 1 100 0.00 99.99847 FORMAT "%8.5" ECU_ADDRESS 0xF25FC /end MEASUREMENT
/begin MEASUREMENT miist_w "" UWORD rel_uw_b100 1 100 0.00 99.99847 FORMAT "%8.5" ECU_ADDRESS 0xF25A4 /end MEASUREMENT
/begin MEASUREMENT mill_w "" UWORD rel_uw_b100 1 100 0.00 99.99847 FORMAT "%8.5" ECU_ADDRESS 0xF2446 /end MEASUREMENT
/begin MEASUREMENT milres_w "" UWORD rel_uw_b100 1 100 0.00 99.99847 FORMAT "%8.5" ECU_ADDRESS 0xF256A /end MEASUREMENT
/begin MEASUREMENT milsol_w "" UWORD rel_uw_b100 1 100 0.00 99.99847 FORMAT "%8.5" ECU_ADDRESS 0xF256C /end MEASUREMENT
/begin MEASUREMENT mimax_w "" UWORD rel_uw_b100 1 100 0.00 99.99847 FORMAT "%8.5" ECU_ADDRESS 0xF4772 /end MEASUREMENT
/begin MEASUREMENT miminds_w "" UWORD rel_uw_b100 1 100 0.00 99.99847 FORMAT "%8.5" ECU_ADDRESS 0xF2448 /end MEASUREMENT
/begin MEASUREMENT mimins_w "" UWORD rel_uw_b100 1 100 0.00 99.99847 FORMAT "%8.5" ECU_ADDRESS 0xF244A /end MEASUREMENT
/begin MEASUREMENT mimin_w "" UWORD rel_uw_b100 1 100 0.00 99.99847 FORMAT "%8.5" ECU_ADDRESS 0xF244C /end MEASUREMENT
/begin MEASUREMENT mimnl_w "" UWORD rel_uw_b100 1 100 0.00 99.99847 FORMAT "%8.5" ECU_ADDRESS 0xF256E /end MEASUREMENT
/begin MEASUREMENT mimn_w "" UWORD rel_uw_b100 1 100 0.00 99.99847 FORMAT "%8.5" ECU_ADDRESS 0xF25FE /end MEASUREMENT
/begin MEASUREMENT mimxl1_w "" UWORD rel_uw_b100 1 100 0.00 99.99847 FORMAT "%8.5" ECU_ADDRESS 0xF4774 /end MEASUREMENT
/begin MEASUREMENT mimx_w "" UWORD rel_uw_b100 1 100 0.00 99.99847 FORMAT "%8.5" ECU_ADDRESS 0xF2600 /end MEASUREMENT
/begin MEASUREMENT minbeg_w "" UWORD rel_uw_b100 1 100 0.00 99.99847 FORMAT "%8.5" ECU_ADDRESS 0xF250C /end MEASUREMENT
/begin MEASUREMENT mioptl1n_w "" UWORD rel_uw_b100 1 100 0.00 99.99847 FORMAT "%8.5" ECU_ADDRESS 0xF2572 /end MEASUREMENT
/begin MEASUREMENT mioptl1_w "" UWORD rel_uw_b100 1 100 0.00 99.99847 FORMAT "%8.5" ECU_ADDRESS 0xF2574 /end MEASUREMENT
/begin MEASUREMENT miopt_w "" UWORD rel_uw_b100 1 100 0.00 99.99847 FORMAT "%8.5" ECU_ADDRESS 0xF2576 /end MEASUREMENT
/begin MEASUREMENT misgscpl_w "" UWORD dez 1 100 0.00 65535.00 FORMAT "%8.2" ECU_ADDRESS 0xF261C /end MEASUREMENT
/begin MEASUREMENT misgslm_w "" UWORD rel_uw_b100 1 100 0.00 99.99847 FORMAT "%8.5" ECU_ADDRESS 0xF261E /end MEASUREMENT
/begin MEASUREMENT misgsl_w "" UWORD rel_uw_b100 1 100 0.00 99.99847 FORMAT "%8.5" ECU_ADDRESS 0xF2620 /end MEASUREMENT
/begin MEASUREMENT misgsoa_w "" UWORD rel_uw_b100 1 100 0.00 99.99847 FORMAT "%8.5" ECU_ADDRESS 0xF2622 /end MEASUREMENT
/begin MEASUREMENT misgs_w "" UWORD rel_uw_b100 1 100 0.00 99.99847 FORMAT "%8.5" ECU_ADDRESS 0xF2624 /end MEASUREMENT
/begin MEASUREMENT misolbv_w "" UWORD rel_uw_b100 1 100 0.00 99.99847 FORMAT "%8.5" ECU_ADDRESS 0xF2554 /end MEASUREMENT
/begin MEASUREMENT misolp_w "" UWORD rel_uw_b100 1 100 0.00 99.99847 FORMAT "%8.5" ECU_ADDRESS 0xF2556 /end MEASUREMENT
/begin MEASUREMENT misolv_w "" UWORD rel_uw_b100 1 100 0.00 99.99847 FORMAT "%8.5" ECU_ADDRESS 0xF2558 /end MEASUREMENT
/begin MEASUREMENT misol_w "" UWORD rel_uw_b100 1 100 0.00 99.99847 FORMAT "%8.5" ECU_ADDRESS 0xF255A /end MEASUREMENT
/begin MEASUREMENT misopl1n_w "" UWORD rel_uw_b100 1 100 0.00 99.99847 FORMAT "%8.5" ECU_ADDRESS 0xF1DC2 /end MEASUREMENT
/begin MEASUREMENT mitmbgr_w "" UWORD rel_uw_b100 1 100 0.00 99.99847 FORMAT "%8.5" ECU_ADDRESS 0xF479C /end MEASUREMENT
/begin MEASUREMENT mivbeb_w "" UWORD rel_uw_b100 1 100 0.00 99.99847 FORMAT "%8.5" ECU_ADDRESS 0xF250E /end MEASUREMENT
/begin MEASUREMENT mivbegv_w "" UWORD rel_uw_b100 1 100 0.00 99.99847 FORMAT "%8.5" ECU_ADDRESS 0xF2510 /end MEASUREMENT
/begin MEASUREMENT mivbeg_w "" UWORD rel_uw_b100 1 100 0.00 99.99847 FORMAT "%8.5" ECU_ADDRESS 0xF2512 /end MEASUREMENT
/begin MEASUREMENT mizsolv_w "" UWORD rel_uw_b100 1 100 0.00 99.99847 FORMAT "%8.5" ECU_ADDRESS 0xF255C /end MEASUREMENT
/begin MEASUREMENT mizsol_w "" UWORD rel_uw_b100 1 100 0.00 99.99847 FORMAT "%8.5" ECU_ADDRESS 0xF255E /end MEASUREMENT
/begin MEASUREMENT mizwmn_w "" UWORD rel_uw_b100 1 100 0.00 99.99847 FORMAT "%8.5" ECU_ADDRESS 0xF25BC /end MEASUREMENT
/begin MEASUREMENT mkfadpn_w "" SWORD rel_sw_b100 1 100 -100.0000 99.99695 FORMAT "%8.4" ECU_ADDRESS 0xF2514 /end MEASUREMENT
/begin MEASUREMENT mkfanb_w "" SWORD rel_sw_b100 1 100 -100.0000 99.99695 FORMAT "%8.4" ECU_ADDRESS 0xF2516 /end MEASUREMENT
/begin MEASUREMENT mkfa_w "" SWORD rel_sw_b50 1 100 -50.00000 49.99847 FORMAT "%8.5" ECU_ADDRESS 0xF2518 /end MEASUREMENT
/begin MEASUREMENT mlnka2_w "" UWORD m_uw_b7281 1 100 0.00 7281.667 FORMAT "%8.3" ECU_ADDRESS 0xF4EEC /end MEASUREMENT
/begin MEASUREMENT mlnka_w "" UWORD m_uw_b7281 1 100 0.00 7281.667 FORMAT "%8.3" ECU_ADDRESS 0xF4EEE /end MEASUREMENT
/begin MEASUREMENT momintrest "" UBYTE fak_ub_b1 1 100 0.00 0.9961 ECU_ADDRESS 0xF0B59 /end MEASUREMENT
/begin MEASUREMENT momint_w "" UWORD mdt_q0p15625_Nms 1 100 0.00 10239.84 FORMAT "%8.2" ECU_ADDRESS 0xF264E /end MEASUREMENT
/begin MEASUREMENT mrfamx_w "" UWORD rel_uw_b200 1 100 0.00 199.9969 FORMAT "%8.4" ECU_ADDRESS 0xF4770 /end MEASUREMENT
/begin MEASUREMENT mrfa_w "" UWORD rel_uw_b200 1 100 0.00 199.9969 FORMAT "%8.4" ECU_ADDRESS 0xF251A /end MEASUREMENT
/begin MEASUREMENT mrpedl_w "" UWORD rel_uw_b200 1 100 0.00 199.9969 FORMAT "%8.4" ECU_ADDRESS 0xF251C /end MEASUREMENT
/begin MEASUREMENT mrpeds_w "" UWORD rel_uw_b200 1 100 0.00 199.9969 FORMAT "%8.4" ECU_ADDRESS 0xF251E /end MEASUREMENT
/begin MEASUREMENT mrped_w "" UWORD rel_uw_b200 1 100 0.00 199.9969 FORMAT "%8.4" ECU_ADDRESS 0xF2520 /end MEASUREMENT
/begin MEASUREMENT nasnottm "" UBYTE nmot_ub_q40 1 100 0.00 10200. FORMAT "%5.0" ECU_ADDRESS 0xF0B2C /end MEASUREMENT
/begin MEASUREMENT ngasoff_w "" UWORD nmotg_sw_q0p39 1 100 0.00 25599.94 FORMAT "%8.2" ECU_ADDRESS 0xF2626 /end MEASUREMENT
/begin MEASUREMENT nsolasak_w "" UWORD nmot_uw_q0p25 1 100 0.00 16383.75 FORMAT "%8.2" ECU_ADDRESS 0xF2628 /end MEASUREMENT
/begin MEASUREMENT nsolasg_w "" UWORD nmot_uw_q0p25 1 100 0.00 16383.75 FORMAT "%8.2" ECU_ADDRESS 0xF262A /end MEASUREMENT
/begin MEASUREMENT nsyw_w "" UWORD nmot_uw_q0p25 1 100 0.00 16383.75 FORMAT "%8.2" ECU_ADDRESS 0xF262C /end MEASUREMENT
/begin MEASUREMENT nturbv_w "" UWORD nmot_q0p1453421 1 100 0.00 9524.995 FORMAT "%8.3" ECU_ADDRESS 0xF2412 /end MEASUREMENT
/begin MEASUREMENT nturb_w "" UWORD nmot_q0p1453421 1 100 0.00 9524.995 FORMAT "%8.3" ECU_ADDRESS 0xF2414 /end MEASUREMENT
/begin MEASUREMENT nver_w "" UWORD fak_uw_b8 1 100 0.00 7.999878 FORMAT "%8.6" ECU_ADDRESS 0xF4760 /end MEASUREMENT
/begin MEASUREMENT nvlsumrs "" UBYTE dez 1 100 0.00 255.0 FORMAT "%5.1" ECU_ADDRESS 0x384027 /end MEASUREMENT
/begin MEASUREMENT nvlsumrs2 "" UBYTE dez 1 100 0.00 255.0 FORMAT "%5.1" ECU_ADDRESS 0x384028 /end MEASUREMENT
/begin MEASUREMENT percnt2_w "" UWORD dez 1 100 0.00 65535.00 FORMAT "%8.2" ECU_ADDRESS 0xF2938 /end MEASUREMENT
/begin MEASUREMENT percnt_w "" UWORD dez 1 100 0.00 65535.00 FORMAT "%8.2" ECU_ADDRESS 0xF293A /end MEASUREMENT
/begin MEASUREMENT pt2gsl1_w "" SWORD relmom_q0p0122 1 100 -400.0000 399.9878 FORMAT "%8.4" ECU_ADDRESS 0xF262E /end MEASUREMENT
/begin MEASUREMENT pt2gsl2_w "" SWORD relmom_q0p0122 1 100 -400.0000 399.9878 FORMAT "%8.4" ECU_ADDRESS 0xF2630 /end MEASUREMENT
/begin MEASUREMENT qntns "" UBYTE fak_ub_b8 1 100 0.00 7.969 FORMAT "%5.3" ECU_ADDRESS 0xF0B11 /end MEASUREMENT
/begin MEASUREMENT redhyst "" SBYTE rel_sb_q0p02 1 100 -2.560 2.540 FORMAT "%5.3" ECU_ADDRESS 0xF0B41 /end MEASUREMENT
/begin MEASUREMENT redneu "" UBYTE dez 1 100 0.00 255.0 FORMAT "%5.1" ECU_ADDRESS 0xF0B42 /end MEASUREMENT
/begin MEASUREMENT redsol "" UBYTE dez 1 100 0.00 255.0 FORMAT "%5.1" ECU_ADDRESS 0xF0B43 /end MEASUREMENT
/begin MEASUREMENT redze "" UBYTE dez 1 100 0.00 255.0 FORMAT "%5.1" ECU_ADDRESS 0xF0B44 /end MEASUREMENT
/begin MEASUREMENT redzst_w "" UWORD rel_uw_q0p001 1 100 0.00 65.53500 FORMAT "%8.5" ECU_ADDRESS 0xF25BE /end MEASUREMENT
/begin MEASUREMENT rka2_w "" SWORD rel_sw_b1536 1 100 -1536.000 1535.953 FORMAT "%8.3" ECU_ADDRESS 0xF1FA8 /end MEASUREMENT
/begin MEASUREMENT rkat2_w "" SWORD rel_sw_b1536 1 100 -1536.000 1535.953 FORMAT "%8.3" ECU_ADDRESS 0xF4650 /end MEASUREMENT
/begin MEASUREMENT rkatlt2_w "" SWORD rel_sw_b1536 1 100 -1536.000 1535.953 FORMAT "%8.3" ECU_ADDRESS 0xF4652 /end MEASUREMENT
/begin MEASUREMENT rkatlt_w "" SWORD rel_sw_b1536 1 100 -1536.000 1535.953 FORMAT "%8.3" ECU_ADDRESS 0xF4654 /end MEASUREMENT
/begin MEASUREMENT rkat_w "" SWORD rel_sw_b1536 1 100 -1536.000 1535.953 FORMAT "%8.3" ECU_ADDRESS 0xF4656 /end MEASUREMENT
/begin MEASUREMENT rkaz2_w "" SWORD rel_sw_b1536 1 100 -1536.000 1535.953 FORMAT "%8.3" ECU_ADDRESS 0xF4658 /end MEASUREMENT
/begin MEASUREMENT rkazlt2_w "" SWORD rel_sw_b1536 1 100 -1536.000 1535.953 FORMAT "%8.3" ECU_ADDRESS 0xF465A /end MEASUREMENT
/begin MEASUREMENT rkazlt_w "" SWORD rel_sw_b1536 1 100 -1536.000 1535.953 FORMAT "%8.3" ECU_ADDRESS 0xF465C /end MEASUREMENT
/begin MEASUREMENT rkaz_w "" SWORD rel_sw_b1536 1 100 -1536.000 1535.953 FORMAT "%8.3" ECU_ADDRESS 0xF465E /end MEASUREMENT
/begin MEASUREMENT rka_w "" SWORD rel_sw_b1536 1 100 -1536.000 1535.953 FORMAT "%8.3" ECU_ADDRESS 0xF1FAA /end MEASUREMENT
/begin MEASUREMENT rlmindp_w "" UWORD rel_uw_q0p0234 1 100 0.00 1535.977 FORMAT "%8.3" ECU_ADDRESS 0xF2522 /end MEASUREMENT
/begin MEASUREMENT rlmin_w "" UWORD rel_uw_q0p0234 1 100 0.00 1535.977 FORMAT "%8.3" ECU_ADDRESS 0xF1DC4 /end MEASUREMENT
/begin MEASUREMENT rlshk "" UBYTE rel_ub_q0p75 1 100 0.00 191.3 FORMAT "%5.1" ECU_ADDRESS 0xF08C3 /end MEASUREMENT
/begin MEASUREMENT rlshk_w "" UWORD rel_uw_q0p0234 1 100 0.00 1535.977 FORMAT "%8.3" ECU_ADDRESS 0xF1DC6 /end MEASUREMENT
/begin MEASUREMENT rlsolv_w "" UWORD rel_uw_q0p0234 1 100 0.00 1535.977 FORMAT "%8.3" ECU_ADDRESS 0xF1DC8 /end MEASUREMENT
/begin MEASUREMENT rlsol_w "" UWORD rel_uw_q0p0234 1 100 0.00 1535.977 FORMAT "%8.3" ECU_ADDRESS 0xF1DCA /end MEASUREMENT
/begin MEASUREMENT tansst "" UBYTE temp_ub_q0p75_o48 1 100 -48.00 143.3 FORMAT "%5.1" ECU_ADDRESS 0xF0B82 /end MEASUREMENT
/begin MEASUREMENT tlok "" UBYTE temp_ub_q0p75_o48 1 100 -48.00 143.3 FORMAT "%5.1" ECU_ADDRESS 0xF415C /end MEASUREMENT
/begin MEASUREMENT tlrbamo_w "" UWORD t10msxs_uw_b655p35 1 100 0.00 655.3500 FORMAT "%8.4" ECU_ADDRESS 0xF4ED0 /end MEASUREMENT
/begin MEASUREMENT tlrvamo_w "" UWORD t10msxs_uw_b655p35 1 100 0.00 655.3500 FORMAT "%8.4" ECU_ADDRESS 0xF4ED2 /end MEASUREMENT
/begin MEASUREMENT tmotmdb "" UBYTE temp_ub_q0p75_o48 1 100 -48.00 143.3 FORMAT "%5.1" ECU_ADDRESS 0xF4162 /end MEASUREMENT
/begin MEASUREMENT tsaka "" UBYTE t20msxs_ub_b5p1 1 100 0.00 5.100 FORMAT "%5.3" ECU_ADDRESS 0xF0BA3 /end MEASUREMENT
/begin MEASUREMENT tsaka2 "" UBYTE t20msxs_ub_b5p1 1 100 0.00 5.100 FORMAT "%5.3" ECU_ADDRESS 0xF0BA4 /end MEASUREMENT
/begin MEASUREMENT twnd "" UBYTE temp_ub_q0p75_o48 1 100 -48.00 143.3 FORMAT "%5.1" ECU_ADDRESS 0xF415A /end MEASUREMENT
/begin MEASUREMENT usrhk "" UBYTE spg_ub_q0p0052_o0p2 1 100 -0.2000 1.130 FORMAT "%5.3" ECU_ADDRESS 0xF4166 /end MEASUREMENT
/begin MEASUREMENT usrhk2 "" UBYTE spg_ub_q0p0052_o0p2 1 100 -0.2000 1.130 FORMAT "%5.3" ECU_ADDRESS 0xF4167 /end MEASUREMENT
/begin MEASUREMENT usrhk2_w "" UWORD spg_uw_q0p00488_o1 1 100 -1.000000 318.9951 FORMAT "%8.4" ECU_ADDRESS 0xF4EF0 /end MEASUREMENT
/begin MEASUREMENT usrhk_w "" UWORD spg_uw_q0p00488_o1 1 100 -1.000000 318.9951 FORMAT "%8.4" ECU_ADDRESS 0xF4EF2 /end MEASUREMENT
/begin MEASUREMENT wdmdkoe "" SBYTE rel_sb_q0p39 1 100 -50.00 49.61 FORMAT "%5.2" ECU_ADDRESS 0xF415D /end MEASUREMENT
/begin MEASUREMENT wkfmdko_w "" UWORD rel_uw_b100 1 100 0.00 99.99847 FORMAT "%8.5" ECU_ADDRESS 0xF2464 /end MEASUREMENT
/begin MEASUREMENT xtkikm2_w "" UWORD temp_q0p0234_o273 1 100 -273.1500 1262.827 FORMAT "%8.3" ECU_ADDRESS 0xF4EFC /end MEASUREMENT
/begin MEASUREMENT xtkikm_w "" UWORD temp_q0p0234_o273 1 100 -273.1500 1262.827 FORMAT "%8.3" ECU_ADDRESS 0xF4EFE /end MEASUREMENT
/begin MEASUREMENT zdash1_w "" UWORD zk10msxs_uw_b655 1 100 0.010000152590 655.36000000 FORMAT "%12.8" ECU_ADDRESS 0xF2524 /end MEASUREMENT
/begin MEASUREMENT zdash2_w "" UWORD zk10msxs_uw_b655 1 100 0.010000152590 655.36000000 FORMAT "%12.8" ECU_ADDRESS 0xF2526 /end MEASUREMENT
/begin MEASUREMENT zdash_w "" UWORD zk10msxs_uw_b655 1 100 0.010000152590 655.36000000 FORMAT "%12.8" ECU_ADDRESS 0xF2528 /end MEASUREMENT
/begin MEASUREMENT zkfrat_w "" UWORD fak_uw_b5 1 100 0.00 4.999924 FORMAT "%8.6" ECU_ADDRESS 0xF4660 /end MEASUREMENT
/begin MEASUREMENT zlsdv_w "" UWORD zk10msxs_uw_b655 1 100 0.010000152590 655.36000000 FORMAT "%12.8" ECU_ADDRESS 0xF252A /end MEASUREMENT
/begin MEASUREMENT zlsd_w "" UWORD zk10msxs_uw_b655 1 100 0.010000152590 655.36000000 FORMAT "%12.8" ECU_ADDRESS 0xF252C /end MEASUREMENT
/begin MEASUREMENT zwopt "" SBYTE zw_sb_q0p75 1 100 -96.00 95.25 FORMAT "%5.2" ECU_ADDRESS 0xF0B38 /end MEASUREMENT
/begin MEASUREMENT zwoptl1 "" SBYTE zw_sb_q0p75 1 100 -96.00 95.25 FORMAT "%5.2" ECU_ADDRESS 0xF0B39 /end MEASUREMENT
/begin MEASUREMENT zwoptl1n "" SBYTE zw_sb_q0p75 1 100 -96.00 95.25 FORMAT "%5.2" ECU_ADDRESS 0xF0B3A /end MEASUREMENT
/begin FUNCTION LRA "93.150"
 /begin DEF_CHARACTERISTIC CWGALSV FBZFRAT FRAOMN FRAOMX FRAORN FRAORX FRATMN FRATMX FRAUMN FRAUMX FRAURN FRAURX KFRAT MLO1 MLO1AC MLO2 MLO3 MLO3AC MLU2 MLU2AC MLU2FA MLU4 MLU4AC N0 NO1 NO2 NOLRA NRKAB NU2 NU3 RKATMN RKATMX RKATRN RKATRX RKAZMN RKAZMX RKAZRN RKAZRX RLO2 RLO3 RLO3AC RLU2 RLU2AC RLU2FA RLU3 RLU4 RLU4AC TGAALTWR TMFRATMN TMFRATUB ZKFRAOA ZKFRAUA ZKRKATA ZKRKAZA ZRLFRAT /end DEF_CHARACTERISTIC
 /begin REF_CHARACTERISTIC TMRAA /end REF_CHARACTERISTIC
 /begin IN_MEASUREMENT abo B_abor B_edkvs B_edkvs2 B_elsuv B_elsv B_elsv2 B_fa B_faan B_fakvs B_koe B_lr B_lr2 B_lra B_lra2 B_lrat B_lsvvsp B_pwf B_stend frm2_w frm_w ml_w nmot rl tmot /end IN_MEASUREMENT
 /begin OUT_MEASUREMENT B_frao B_fraor B_fraor2 B_frat B_frau B_fraur B_fraur2 B_lrare B_lrare2 B_nofra B_nofrat B_norkat B_norkaz B_rkat B_rkatr B_rkatr2 B_rkaz B_rkazr B_rkazr2 fra2_w frao2_w frao_w frat2_w frati2_w frati_w frat_w frau2_w frau_w fra_w ftklra_w rka2_w rkat2_w rkat_w rkaz2_w rkaz_w rka_w /end OUT_MEASUREMENT
 /begin LOC_MEASUREMENT B_lrareb B_range B_range2 dfrm2_w dfrm_w dlrfrat fraolt2_w fraolt_w frault2_w frault_w rkatlt2_w rkatlt_w rkazlt2_w rkazlt_w zkfrat_w /end LOC_MEASUREMENT
/end FUNCTION
/begin FUNCTION LRAEB "4.130" /begin DEF_CHARACTERISTIC LAMLRAMN LAMLRAMX TARA TMEWRAA TMRAA TVLRA WDKARN /end DEF_CHARACTERISTIC
 /begin IN_MEASUREMENT B_agrlrasp B_auakt B_brems B_dsls B_dteaa B_dtest B_enws B_fa B_falra B_fates B_gap B_lr B_lr2 B_lrasp B_lrasp2 B_mdarv B_nldg B_sls B_te B_ukg B_vl lamsons_w nmot tans tmew tmot wdkba /end IN_MEASUREMENT
 /begin OUT_MEASUREMENT B_gasp B_lra B_lra2 B_lrat /end OUT_MEASUREMENT
 /begin LOC_MEASUREMENT B_lraen /end LOC_MEASUREMENT
/end FUNCTION
/begin FUNCTION LRS "21.31"
 /begin DEF_CHARACTERISTIC CLRS CWLRMS DFRMAX FRMINKH KFDLASO KFDLASO2 KFFRMIN KFLRSG1 KFLRSG12 KFLRSG2 KFLRSG22 KFLRSG4 KFLRSG42 KFLRSP1 KFLRSP12 KFLRSP2 KFLRSP22 KFLRSP3 KFLRSP32 KFLRSP4 KFLRSP42 LADIFFTHR LALIUSMN LRSGKTM SNM07LSUW SNM08LSUB SRL08LSUB SRL08LSUW TAUIDEC WIMAX WIMIN XIMAX XIMIN /end DEF_CHARACTERISTIC
 /begin IN_MEASUREMENT B_dtefrr B_gaeing B_gaeing2 B_kh B_lrmsbs B_lrmsbs2 B_lrs B_lrs2 B_nswo1 B_sls B_temin B_temin2 dfrza2_w dfrzaf2_w dfrzaf_w dfrza_w dlatrmi2_w dlatrmi_w dlatrmp2_w dlatrmp_w frdter_w lamsoni2_w lamsoni_w lamsons2_w lamsons_w nmot nmot_w rl rl_w tmot tnst_w /end IN_MEASUREMENT
 /begin OUT_MEASUREMENT B_frini B_frmax B_frmax2 B_frmin B_frmin2 B_frmn B_frmn2 B_lrnda B_lrnda2 dfrmn_w dlaso dlaso2 esst_snm07lsuw esst_snm08lsub esst_srl08lsub esst_srl08lsuw fr2_w frm2_w frmn_w frmx_w frm_w fr_w g1korr ladiff2_w ladiff_w lamzak2_w lamzak_w /end OUT_MEASUREMENT
 /begin LOC_MEASUREMENT B_clrs5 B_cwlrms0 B_cwlrms1 B_cwlrms4 B_cwlrms5 B_idecay B_idecay2 B_lalimi B_lalimi2 B_lalims B_lalims2 B_lrmsbrc B_lrmsbrc2 B_lrsin B_lrsin2 B_lrsrems B_lrsrems2 B_update B_update2 dfr2_w dfrmin2_w dfrmin_w dfrmnms2_w dfrmnms_w dfrpr2_w dfrpr_w dfr_w frini_w lamssok2_w lamssok_w lrsg12_w lrsg1_w lrsg22_w lrsg2_w lrsg42_w lrsg4_w lrsinte2_w lrsinte_w lrsp12_w lrsp1_w lrsp22_w lrsp2_w lrsp32_w lrsp3_w lrsp42_w lrsp4_w lrsw12_w lrsw1_w lrsw22_w lrsw2_w lrsxk32_w lrsxk3_w lrsxk42_w lrsxk4_w lrsy22_w lrsy2_w lrsy32_w lrsy3_w lrsy42_w lrsy4_w lrsyd2_w lrsyd_w lrsyi2_w lrsyi_w lrsyp2_w lrsyp_w /end LOC_MEASUREMENT
/end FUNCTION
/begin FUNCTION LRSEB "20.60"
 /begin DEF_CHARACTERISTIC DLAMXSA DTMR IMLEVABS IMLEVABS2 IMLSALR NLRSHB RLLRSHB RLLRUN RLSLSMN TARAU TASHS TLRBAM TLRHS TLRSZWSA TLRTMS TLRVAM TLRZWTMS TMRA1 TMRA2 TMRAK TMSHS TMTMRW TRAU /end DEF_CHARACTERISTIC
 /begin REF_CHARACTERISTIC CLRS LALIUSMN /end REF_CHARACTERISTIC
 /begin IN_MEASUREMENT B_bag B_bevab B_bevab2 B_craus B_dsla B_eev B_esls B_falr B_ll B_mdarv B_mdkat B_sa B_sbblsu B_sbblsu2 B_slsoff B_st B_stend B_temin B_temin2 B_vag B_vlsuftb B_vlsuftb2 lamsoni2_w lamsoni_w lamsons2_w lamsons_w ml_w nmot rl tans tmot tmrw tmst /end IN_MEASUREMENT
 /begin OUT_MEASUREMENT B_eobdlr B_eobdlr2 B_lr B_lr2 B_lrmsbs B_lrmsbs2 B_lrs B_lrs2 B_lrssa B_lrssa2 B_mlevab B_mlevab2 B_mlrsa B_tmlr /end OUT_MEASUREMENT
 /begin LOC_MEASUREMENT B_lrnbsnc B_lrrl B_pspaus B_pspwl B_slspaus B_tarau imlevab2_w imlevab_w imlrsa_w lrdtwl_w tansst tlrbamo_w tlrvamo_w /end LOC_MEASUREMENT
/end FUNCTION
/begin FUNCTION LRSHK "9.240"
 /begin DEF_CHARACTERISTIC CLRSHK CLRSHKA CLRSHKC CLRSHKEB CLRSHKEBB DLAHIFAMX DLAHINI DLAHINI2 DLAHPFAMX KDLASHKI KDLASHKI2 KDLASHKP KDLASHKP2 KFUSHK KILRHML KPLRHML LALIUSH LALIUSH2 LALIUSRH LALIUSRH2 LAMSONMN LAMSONMX LASHKAB LRHIMN LRHIMX MLNKAX NLRHDIFAO NLRHDIFAU NLRHO NLRHU PLRHAV PLRHAV2 PLRHFA PLRHFA2 PLRHSHAB RLLRHDIFAU RLLRHON RLLRHUFA RLLRHUN TBLRH TDLAHFAMX TKATMLRH TLRHFRXMOF TLRHFRXMON TMLLAMN TMLLAMN2 TOFFDSHAB USRHKFA ZILRHFA ZLASHKAB ZLASOHML /end DEF_CHARACTERISTIC
 /begin REF_CHARACTERISTIC SM108LHSW SM208LHSW SML08LHUB SNM08LHUB /end REF_CHARACTERISTIC
 /begin IN_MEASUREMENT ahkat ahkat2 avkatf avkatf2 B_dslo B_edkvs B_edkvs2 B_enlash B_enlash2 B_enws B_enwsva B_enwsve B_esls B_fakat B_falrshk B_falsh B_falsh2 B_frmax B_frmax2 B_frmin B_frmin2 B_lr B_lr2 B_lrka B_lrka2 B_lrssp B_mdarv B_pwf B_sbbhk B_sbbhk2 B_shab B_shab2 B_st B_tehb B_vlsuftb B_vlsuftb2 B_vlsumrb B_vlsumrb2 esst_sm108lhsw esst_sm208lhsw esst_sml08lhub esst_snm08lhub lamsons2_w lamsons_w ml ml_w nmot rl tahsom2_w tahsom_w ushk2_w ushk_w /end IN_MEASUREMENT
 /begin OUT_MEASUREMENT B_dlahieg B_dlahieg2 B_lrhk B_lrhk2 B_lrhkp B_lrhkp2 dlahi2_w dlahi_w dlahp2_w dlahp_w lamsolh2_w lamsolh_w lamsonh2_w lamsonh_w usrhk usrhk2 usrhk2_w usrhk_w /end OUT_MEASUREMENT
 /begin LOC_MEASUREMENT B_dlahini B_dlahini2 B_dlahix B_dlahix2 B_dlahpix B_dlahpix2 B_dlahpx B_dlahpx2 B_falrhki B_falrhki2 B_falrhkrq B_lreberi B_lreberi2 B_lrhbb B_lrheini B_lrheini2 B_lrhkb B_lrhkb2 B_lrhkg B_lrhkgi B_lrhkgnw B_lrhkgnwa B_lrhkgnwe B_mlnka B_mlnka2 B_nekati B_nekati2 dlahini2_w dlahini_w dlahist2_w dlahist_w dlahkab2_w dlahkab_w dlashki2_w dlashki_w dlashkm2_w dlashkm_w dlashkp2_w dlashkp_w lahkmz lahkmz2 lamhf2_w lamhf_w lamhm2_w lamhm_w LRSHKlokbits1_2 LRSHKlokbits2_2 mlnka2_w mlnka_w percnt2_w percnt_w /end LOC_MEASUREMENT
/end FUNCTION
/begin FUNCTION LRSKA "6.140"
 /begin DEF_CHARACTERISTIC CLRSKA CWSBBVK FKAXFOSC FKAXFOSC2 FLMLKAMA FLMLKAMA2 ILMLKAXTK ILMLKAXTK2 IMLKAMN IMLKAMN2 LAKAMSAIML LAMKADEF LAMSKAMX LAMSKAMX2 NLRKA TDLAKAD TDLAKAU TLAKAMN TLAKAMN2 TSAKAMN TSAKAMN2 USHKAMXW USHKAMXW2 /end DEF_CHARACTERISTIC
 /begin IN_MEASUREMENT B_bevab B_bevab2 B_sbbhk B_sbbhk2 B_sbblsu B_sbblsu2 B_sbbvk B_sbbvk2 fcoschk fcoschk2 lamsbrs2_w lamsbrs_w lamsoni2_w lamsoni_w lamsons2_w lamsons_w msabvhk2_w msabvhk_w nmot tkiuem2_w tkiuem_w ushk2_w ushk_w /end IN_MEASUREMENT
 /begin OUT_MEASUREMENT B_lamka B_lamka2 B_lrka B_lrka2 ilmltkx2_w ilmltkx_w imllaka2_w imllaka_w imslaka2_w imslaka_w lamka2_w lamka_w lrskaAusBits20ms /end OUT_MEASUREMENT
 /begin LOC_MEASUREMENT B_blrka B_blrka2 B_lrkaa B_lrkaa2 B_lrkae B_lrkae2 dlamka2_w dlamka_w ffcoscmx ffcoscmx2 iftkavx2_w iftkavx_w imlka2_w imlka_w lamsoka2_w lamsoka_w lrkaz lrkaz2 lrskaLokBits20ms tsaka tsaka2 xtkikm2_w xtkikm_w /end LOC_MEASUREMENT
/end FUNCTION
/begin FUNCTION LSUMRS "1.30" /begin DEF_CHARACTERISTIC CWLSUMRS NVLSUMRSMX TMOTMRSMX /end DEF_CHARACTERISTIC /begin IN_MEASUREMENT B_pwf B_stend tmst /end IN_MEASUREMENT /begin OUT_MEASUREMENT B_vlsumrs B_vlsumrs2 /end OUT_MEASUREMENT /begin LOC_MEASUREMENT nvlsumrs nvlsumrs2 /end LOC_MEASUREMENT /end FUNCTION
/begin FUNCTION MCMESS_PROT "" /begin REF_CHARACTERISTIC CWVSV /end REF_CHARACTERISTIC /begin IN_MEASUREMENT emf /end IN_MEASUREMENT /end FUNCTION
/begin FUNCTION MDASG "3.120"
 /begin DEF_CHARACTERISTIC CDASG CDASG1 CWASGCAN CWMDASG DASGRED DBZ_MX_ASG DMASGNG DMIASGE DMIASGV DNASNOT DNSYWMN KASGRED KFASGVF KLASGP KLASGPL KLTMIVOR MDHYASG MIADT1MX MIASGLMX NSYWMN NSYWMX TASGCERR TASGCNO TASGCNU TASGRED TBZCAN_R TBZCAN_S TNSYWS TNSYW_R TSYNMX VASNOT VFSM ZKSM /end DEF_CHARACTERISTIC
 /begin REF_CHARACTERISTIC KFMDS MDIMX SNM16__UW SPS11MDUW SRL11OPUW /end REF_CHARACTERISTIC
 /begin IN_MEASUREMENT bz_cange B_asgnpl_R B_asgnpl_S B_asgphnpl B_asr B_ctout B_ge2bot B_ges B_gsaf B_msr B_sgspl_um B_wkauf B_wkr B_zges dmvad_w dpsu_w esst_snm16__uw esst_sps11mduw esst_srl11opuw gangauti mdsh_w mdsm_w mdssta_w mdverb mdverf_w mdwan_w miasrl_w miasrs_w mifafu_w mifa_w migs_w mimax_w minmx_w mizwmn_w ngas_w nmot_w nstat nsyw nsywin tmot tsyn vfzg_w /end IN_MEASUREMENT
 /begin OUT_MEASUREMENT B_aakupst B_asgab B_asgpl B_asgpli B_sgspl B_sgsred migsl_w misgscpl_w misgslm_w misgsl_w misgs_w /end OUT_MEASUREMENT
 /begin LOC_MEASUREMENT B_asg20ms B_asginpl B_asgknpl B_asgneut B_misgsen B_vspt2 dnabsak_w dnasgabs_w dnasgl_w dnasg_w dnsolasg_w fasgp_w mdsasg_w mdverlp_w miasgdt1_w miasgpl_w miasgp_w miasgvor_w misgsoa_w ngasoff_w nsolasak_w nsolasg_w nsyw_w pt2gsl1_w pt2gsl2_w /end LOC_MEASUREMENT
/end FUNCTION
/begin FUNCTION MDASGPH "1.100"
 /begin DEF_CHARACTERISTIC ASGMDMX ASGPHNPLC0 ASGPHNPLC1 DEGS EGSTDEC KASGMD TFKU_R TFKU_S /end DEF_CHARACTERISTIC
 /begin REF_CHARACTERISTIC CDASG MDNORM /end REF_CHARACTERISTIC
 /begin IN_MEASUREMENT B_asgpl B_ctout B_fku B_gsaf B_kl15 B_wkr mdverl_w mifa_w miist_w /end IN_MEASUREMENT
 /begin OUT_MEASUREMENT asgphnpl B_asgnpl_R B_asgnpl_S B_asgphnpl momintrest /end OUT_MEASUREMENT
 /begin LOC_MEASUREMENT momint_w /end LOC_MEASUREMENT
/end FUNCTION
/begin FUNCTION MDAUTG "7.80" /begin REF_CHARACTERISTIC CWZWVMX /end REF_CHARACTERISTIC
 /begin IN_MEASUREMENT B_abws B_evakt B_gess B_mdee B_mibeg B_nmax B_sa B_vagsl B_zwget B_zwnget B_zwvz B_zwvzvb dmaufr_w dmllr_w miasrs_w mibas_w mibgr_w mifa_w miges_w mimsr_w minmx_w miszul_w mivbeb_w mivmx_w mizwmn_w /end IN_MEASUREMENT
 /begin OUT_MEASUREMENT miautget_w miautgs_w miistoar_w mimn_w mimx_w /end OUT_MEASUREMENT
 /begin LOC_MEASUREMENT B_zwvzsy /end LOC_MEASUREMENT
/end FUNCTION
/begin FUNCTION MDBAS "26.20"
 /begin DEF_CHARACTERISTIC CWMBAS DZWLB DZWOLA DZWRRI ETADZW ETALAM ETALB ETARRI KFDZWTBR KFFRIDZW KFMIOP KFZWOP /end DEF_CHARACTERISTIC
 /begin REF_CHARACTERISTIC SLA09OPUW SNM16OPUW SRL11OPUW SRR07OPUW SWE07OPSW /end REF_CHARACTERISTIC
 /begin IN_MEASUREMENT dzwwl esst_sla09opuw esst_snm16opuw esst_srl11opuw esst_srr07opuw esst_swe07opsw lambas_w nmot_w rl rl_w rri_w tmot wnwe_w zwbas zzyl /end IN_MEASUREMENT
 /begin OUT_MEASUREMENT dzwol dzwolb dzworri etalab etalbb etarrib etazwb etazwbm frridzw mibas_w mioptl1_w miopt_w zwopt zwoptl1 zwoptl1n /end OUT_MEASUREMENT
 /begin LOC_MEASUREMENT dzwb mioptl1n_w /end LOC_MEASUREMENT
/end FUNCTION
/begin FUNCTION MDBGRG "4.130"
 /begin DEF_CHARACTERISTIC CWMDBGRG DMRTMKI DTMIBG KFFRTMKI KFMDBGRG KLFRTMKI MDGAT MDGENOT MKBRMXWP TAGAT TMMIBGR TMXMIBG TNGAT TVBRMX TVGAT VMIBGR VMKBRMX /end DEF_CHARACTERISTIC
 /begin IN_MEASUREMENT B_autget B_brems B_krdws B_mdmxge B_pkndnmb gangi mdverl_w mibgrbr_w mibgrtm_w mifafu_w mifamx_w mimax_w mitibgr_w mkbgr_w mkfamx_w nmot tmki tmot vfzg wped_w /end IN_MEASUREMENT
 /begin OUT_MEASUREMENT mibgrl_w mibgr_w miekpbgr_w mitmbgr_w /end OUT_MEASUREMENT
 /begin LOC_MEASUREMENT B_brvfp B_mkbrmx frtmki MDBGRGlokbits miatbgr_w mibgrg_w mibrmx_w tmotmdb /end LOC_MEASUREMENT
/end FUNCTION
/begin FUNCTION MDFAW ""
 /begin DEF_CHARACTERISTIC CWDMFAB CWMDFAW DMDPOZ DMDPUG DMIFLSD DMIOWLSD DMLSDUG DMRFAWEN DRLMINDP FGMIFABG FGMIFAL FGZLSD FKFPEDV FKZDPTM FLRMIFABG FLRMIFAL FLRZDASH FLRZLSD KFDLSD KFDMDPO KFDMLSDO KFDMLSDS KFLSDWA KFMIFABG KFMIFABGWK KFMIFALS KFMILSD KFPED KFPEDL KFPEDR KFWMIFABG KFWMIFAL KFWZLSD KFZDASH KFZDASH2 KFZLSD MIFAAPP MIFABGMX MIFALAPP MIFALMF MKFADPN MKFADPN1 MKMIFABG MRFALLO MRFALLU MRFAVLN NGFSAWE NMGALSDO NMGALSDU PEDLRMX PEDMX PEDRMX SNM12MDUW SWP16MDUW TDMFBSA TDMFBWE TDMFNSG TDMFWEMI TDMLSDS TVFSAWE TVGSCH VDASH VLSD /end DEF_CHARACTERISTIC
 /begin REF_CHARACTERISTIC MDIMX SGA08MDUB SNM06MDUW /end REF_CHARACTERISTIC
 /begin IN_MEASUREMENT B_asr B_cvt B_faa B_faan B_gsch B_gwhs B_ko B_kuppl B_kupplv B_llvfgr B_mgbget B_nmax B_nmot B_nsget B_sa B_sab B_sabfg B_stend B_vmax B_vnull B_wkauf dmllri_w dmverl_w esst_sga08mdub esst_snm06mduw gangi gangist mdgrad_w mdsm_w mdverl_w mdvervf_w miasrs_w mibas_w mifamx_w miistoar_w mimax_w mimin_w mizwmn_w mrfgr_w ngfil_w nmot nmot_w nturb_w rlmin_w rl_w tmot vfzg wped wped_w /end IN_MEASUREMENT
 /begin OUT_MEASUREMENT B_dash B_dashv B_fgr B_fil B_ll B_lsd B_vl esst_snm12mduw esst_swp16mduw mifa mifal_w mifa_w mivbeb_w mkfanb_w mrfamx_w mrfa_w /end OUT_MEASUREMENT
 /begin LOC_MEASUREMENT B_dashvz B_dashz B_dp B_edp B_elsd B_gschwka B_iflsd B_ls B_mgbgakt B_mifabg B_mrpfa B_tdmlsds dlsd_w dmbebl_w dmdpo_w dmdpu_w dmgbeg_w dmlsdo_w dmlsdu_w dmrfawe_w dnitu_w fkfped fwmifabg fwmifal fwzlsd fzdash MDFAWlokbits mdfaw_bits mibdp_w miblsd_w mifabg_w mifak_w mifali_w migef_w minbeg_w mivbegv_w mivbeg_w mkfadpn_w mkfa_w mrpedl_w mrpeds_w mrped_w rlmindp_w zdash1_w zdash2_w zdash_w zlsdv_w zlsd_w /end LOC_MEASUREMENT
/end FUNCTION
/begin FUNCTION MDFUE "20.20"
 /begin DEF_CHARACTERISTIC CWMDFUE CWRLAPPL FRLMNHO FWPEDRLS KFMIRL KFRLMN KFRLMNSA KFRLMNST RLSOLAP SMI12OPUW ZKDRLSOL /end DEF_CHARACTERISTIC
 /begin REF_CHARACTERISTIC SNM12FEUB SNM16OPUW STM06__UB /end REF_CHARACTERISTIC
 /begin IN_MEASUREMENT anztib_w B_sa esst_snm12feub esst_snm16opuw esst_stm06__ub etalab etalbb etarrib etazwbm fho fho_w milsol_w nmot nmot_w rltedte_w tmot tmst_w wped_w /end IN_MEASUREMENT
 /begin OUT_MEASUREMENT B_mdmin drlsolf_w drlsol_w esst_smi12opuw rlmin_w rlshk rlshk_w rlsol_w /end OUT_MEASUREMENT
 /begin LOC_MEASUREMENT misopl1n_w rlsolv_w /end LOC_MEASUREMENT
/end FUNCTION
/begin FUNCTION MDIST "10.21" /begin REF_CHARACTERISTIC ETADZW /end REF_CHARACTERISTIC /begin IN_MEASUREMENT miopt_w redist zwist zwopt /end IN_MEASUREMENT /begin OUT_MEASUREMENT etazaist etazwist miist_w /end OUT_MEASUREMENT /begin LOC_MEASUREMENT dzwi mdindg_w /end LOC_MEASUREMENT /end FUNCTION
/begin FUNCTION MDKOG "1.250" /begin DEF_CHARACTERISTIC CWMDKOG CWTEZW CWZWVMX DELRL NASNOTKL THDMB TMVER TVMIBEG /end DEF_CHARACTERISTIC /begin REF_CHARACTERISTIC MDIMX /end REF_CHARACTERISTIC
 /begin IN_MEASUREMENT B_dash B_evakt B_fil B_gess B_kh B_kupplv B_kw B_ll B_llrein B_lsd B_mdmin B_mgbget B_mibegl B_mifabg B_nmxozwe B_sa B_stend B_zwfsu dmar_w dmllr_w dmrkh dmrkt_w dmrllr_w etazwb miasrl_w miasrs_w mibas_w mibgr_w mifa_w miges_w migs_w milres_w mimax_w mimsr_w minmx_w miopt_w misgs_w miszul_w mitebg_w mivmx_w mizwmn_w nmot_w rlmin_w rlsol_w rl_w tmot wped_w /end IN_MEASUREMENT
 /begin OUT_MEASUREMENT B_abws B_asr B_mdein B_mibeg B_msr B_savmd B_sgs B_zwget B_zwnget B_zwvs B_zwvz B_zwvzvb cmibeg_w miext_w mifab_w misolv_w misol_w mizsolv_w mizsol_w nasnottm /end OUT_MEASUREMENT
 /begin LOC_MEASUREMENT B_sgs0 B_zwdmr B_zwfa B_zwfe B_zwpp dmzms_w mibeg_w misolbv_w misolp_w /end LOC_MEASUREMENT
/end FUNCTION
/begin FUNCTION MDKOL "26.20" /begin DEF_CHARACTERISTIC CWMDKOL /end DEF_CHARACTERISTIC /begin REF_CHARACTERISTIC MDIMX /end REF_CHARACTERISTIC
 /begin IN_MEASUREMENT B_abws B_dashv B_llrein B_lsd B_mibeg B_mifabg dmllrl_w dmrkh dmrkt_w dmrllr_w etazwbm etazwmn miasrl_w mibgrl_w mifal_w mifa_w miges_w migsl_w mimsr_w minmx_w misgsl_w miszull_w mitebg_w mivmx_w vsdmr /end IN_MEASUREMENT
 /begin OUT_MEASUREMENT B_mibegl B_mrakt dmrmx_w mifafu_w milres_w milsol_w mimnl_w /end OUT_MEASUREMENT
 /begin LOC_MEASUREMENT dmlms_w /end LOC_MEASUREMENT
/end FUNCTION
/begin FUNCTION MDMAX "12.10" /begin DEF_CHARACTERISTIC FMIMXKVL /end DEF_CHARACTERISTIC /begin REF_CHARACTERISTIC KFMIOP SRL11OPUW /end REF_CHARACTERISTIC /begin IN_MEASUREMENT esst_snm16opuw nmot rlmxs_w /end IN_MEASUREMENT /begin OUT_MEASUREMENT mimax_w /end OUT_MEASUREMENT /begin LOC_MEASUREMENT mimxl1_w /end LOC_MEASUREMENT /end FUNCTION
/begin FUNCTION MDMIN "10.40" /begin DEF_CHARACTERISTIC CWMDMIN FWDMVAD KFMIMN KFVERST KLMIMNH /end DEF_CHARACTERISTIC
 /begin IN_MEASUREMENT B_kupplv B_sab dmvad_w fho fnstab_w gangi mdverf_w nmot_w nver_w wped_w /end IN_MEASUREMENT
 /begin OUT_MEASUREMENT mill_w miminds_w mimins_w mimin_w /end OUT_MEASUREMENT
/end FUNCTION
/begin FUNCTION MDNSTAB "1.41" /begin DEF_CHARACTERISTIC FNSTABNV /end DEF_CHARACTERISTIC /begin IN_MEASUREMENT nmot_w nstat /end IN_MEASUREMENT /begin OUT_MEASUREMENT fnstab_w nver_w /end OUT_MEASUREMENT /begin LOC_MEASUREMENT B_mdnstab /end LOC_MEASUREMENT /end FUNCTION
/begin FUNCTION MDRED "4.70"
 /begin DEF_CHARACTERISTIC CREDSTU CWMDRED DMIZWMN MDHYEZ REDHYOC REDHYUC REDMXSA REDZEM /end DEF_CHARACTERISTIC
 /begin IN_MEASUREMENT B_asr B_dknolu B_dkpu B_msr B_nmax B_nmaxred B_sab B_stend etazwmn mibas_w minmx_w miopt_w misol_w redist tmot /end IN_MEASUREMENT
 /begin OUT_MEASUREMENT B_sa mizwmn_w redsol /end OUT_MEASUREMENT
 /begin LOC_MEASUREMENT B_mdee B_mdredhyein redhyst redneu redze redzst_w /end LOC_MEASUREMENT
/end FUNCTION
/begin FUNCTION MDTRIP "1.70" /begin DEF_CHARACTERISTIC DMRAA KLMRKFHO /end DEF_CHARACTERISTIC
 /begin IN_MEASUREMENT B_faam dmrdkt_w dmrdsls_w dmrlash_w dmrlsh_w dmrlsv_w fho_w /end IN_MEASUREMENT
 /begin OUT_MEASUREMENT dmrkt_w /end OUT_MEASUREMENT
/end FUNCTION
/begin FUNCTION MDVER "23.20"
 /begin DEF_CHARACTERISTIC CNFMDVER DMDNSM DMVERLMN DPUMDS KFMDS MDSH MDSM SPS11MDUW ZFMDVERL ZMDNSM /end DEF_CHARACTERISTIC
 /begin REF_CHARACTERISTIC SNM16__UW STM08__UB /end REF_CHARACTERISTIC
 /begin IN_MEASUREMENT B_llrein B_sa dmvad_w esst_snm16__uw esst_stm08__ub fho mdverb_w mdwan_w nmot_w ps_w pu_w tmot /end IN_MEASUREMENT
 /begin OUT_MEASUREMENT dmverl_w esst_sps11mduw mdsh_w mdslw_w mdsm_w mdssta_w mds_w mdverf_w mdverl_w /end OUT_MEASUREMENT
 /begin LOC_MEASUREMENT B_dmverlin dpsu_w kfmdsmn_w kfmds_w mdsmn_w mdvervf_w /end LOC_MEASUREMENT
/end FUNCTION
/begin FUNCTION MDVERAD "12.50"
 /begin DEF_CHARACTERISTIC DMADFK DMADFS DMADKO DMADLL DMADMNFK DMADMNFS DMADMNKO DMADMNLL DMADMXFK DMADMXFS DMADMXKO DMADMXLL TMDMAD TWDMAD ZKDMADFK ZKDMADFS ZKDMADKO ZKDMADLL /end DEF_CHARACTERISTIC
 /begin REF_CHARACTERISTIC CDWVERAD /end REF_CHARACTERISTIC
 /begin IN_MEASUREMENT B_adrmdver B_cvtad B_dtes B_evakt B_fs B_koe B_llr B_llrein B_mdarv B_nswo1 B_pwf B_vllr dmllri_w tmot /end IN_MEASUREMENT
 /begin OUT_MEASUREMENT dmvad_w /end OUT_MEASUREMENT
 /begin LOC_MEASUREMENT B_adwfk B_adwfs B_adwko B_madakt B_madfk B_madfs B_madko B_madll dmvadfk_w dmvadfs_w dmvadko_w dmvadll_w dmvamnfk_w dmvamnfs_w dmvamnko_w dmvamnll_w dmvamxfk_w dmvamxfs_w dmvamxko_w dmvamxll_w MDVERADlokbits MDVERADlokbits1 /end LOC_MEASUREMENT
/end FUNCTION
/begin FUNCTION MDVERB "12.290"
 /begin DEF_CHARACTERISTIC CNFSL CWMDRLKO CWSELV CWTUM DMDGENAB DMDHFS DMDLWS DMDRKO DMGN DMKO DMLFS DMSERVL DMSLP FMDGEN FMDGENTA KFDMDKOE KFMDDLWS KFMDELMX KFMDGEN KFMDKO KFMDPKO KFMDPKOME KFMDPWM KFMDPWME KFMDRKO KFMDRKOE KLFMKNM KLMDLFTV LWSER MDHFS MDHHS MDSL MDSLP MDSLPE MKLLS SKO06KOUB SKO06PKO SNM06KOUB SRL06KOUB STA06LLUB TDMKOW ZKMDELL ZKMDGEN ZKMDKO ZKMDSEV ZKMDSLP ZMDDLWS /end DEF_CHARACTERISTIC
 /begin REF_CHARACTERISTIC MDNORM /end REF_CHARACTERISTIC
 /begin IN_MEASUREMENT B_acres B_koe B_llrein B_lwser B_sfsc B_sksc B_sl B_slp B_st B_stend dlws_w kldfpwm lws_w mkllsc mkolsc nmot pkodrc rl takols tans tumg tvlues1 /end IN_MEASUREMENT
 /begin OUT_MEASUREMENT dmrac dmrlf esst_sko06koub esst_sko06pko esst_snm06koub esst_srl06koub esst_sta06llub mdel_w mdgen_w mdko_w mdlfs_w mdslpf_w mdswl_w mdverb mdverb_w /end OUT_MEASUREMENT
 /begin LOC_MEASUREMENT dlwsu_w dmr3lf_w md3lf_w mddlws_w mdkoini mdlws_w tlok wdmdkoe wkfmdko_w /end LOC_MEASUREMENT
/end FUNCTION
/begin FUNCTION MDWAN "6.110"
 /begin DEF_CHARACTERISTIC CNFMDWAN DMDWANMX DMDWHYS DMDWM FABMDWA FDMDWAN FMDWAT FNRAD FVDMDWAN KFMDWMX MDATNM MDATRM MDWANER STW08MDUB TVFSAM TVFSEM TVFSRAM TVFSREM TVFUE UEVERG ZKDMDW ZKMDWAB ZKMDWAUF ZKMDWF ZKUEVERG /end DEF_CHARACTERISTIC
 /begin IN_MEASUREMENT B_autget B_fs B_mdwaner gangi mdwancan nstat nturbc_w tmot vfzg vfzg_w /end IN_MEASUREMENT
 /begin OUT_MEASUREMENT B_dmrwan B_rgang dmdwan_w dmrwan mdwanvf_w mdwan_w /end OUT_MEASUREMENT
 /begin LOC_MEASUREMENT B_cnfwan B_fsu dnturb_w esst_stw08mdub mdatxm_w mdwancb_w nturbv_w nturb_w qntns twnd /end LOC_MEASUREMENT
/end FUNCTION
/begin COMPU_METHOD B_TRUE "" TAB_VERB "%6.3" "" COMPU_TAB_REF B_TRUE /end COMPU_METHOD
/begin COMPU_VTAB B_TRUE "" TAB_VERB 2 0 "----" 1 "TRUE" /end COMPU_VTAB
/begin COMPU_METHOD DEZ "" RAT_FUNC "%6.2" "" COEFFS 0 1 0 0 0 1 /end COMPU_METHOD
/begin COMPU_METHOD dez "" RAT_FUNC "%6.2" "" COEFFS 0 1 0 0 0 1 /end COMPU_METHOD
/begin COMPU_METHOD dlw_sw_q0p04375 "" RAT_FUNC "%6.4" "°/s" COEFFS 0 32767 0 0 0 1434 /end COMPU_METHOD
/begin COMPU_METHOD fak_q0p0078 "" RAT_FUNC "%6.4" "-" COEFFS 0 128 0 0 0 1 /end COMPU_METHOD
/begin COMPU_METHOD fak_q0p0625 "" RAT_FUNC "%6.4" "-" COEFFS 0 16 0 0 0 1 /end COMPU_METHOD
/begin COMPU_METHOD fak_sb_b0p03125 "" RAT_FUNC "%6.5" "-" COEFFS 0 256 0 0 0 0.0625 /end COMPU_METHOD
/begin COMPU_METHOD fak_sb_b1 "" RAT_FUNC "%6.4" "-" COEFFS 0 256 0 0 0 2 /end COMPU_METHOD
/begin COMPU_METHOD fak_sw_b1 "" RAT_FUNC "%7.6" "-" COEFFS 0 65536 0 0 0 2 /end COMPU_METHOD
/begin COMPU_METHOD fak_sw_b1_1 "" RAT_FUNC "%7.6" "1/s" COEFFS 0 65536 0 0 0 2 /end COMPU_METHOD
/begin COMPU_METHOD fak_sw_b2_1 "" RAT_FUNC "%7.6" "s" COEFFS 0 65536 0 0 0 4 /end COMPU_METHOD
/begin COMPU_METHOD fak_sw_b32 "" RAT_FUNC "%6.5" "-" COEFFS 0 65536 0 0 0 64 /end COMPU_METHOD
/begin COMPU_METHOD fak_sw_b4_1 "" RAT_FUNC "%6.5" "1/s" COEFFS 0 65536 0 0 0 8 /end COMPU_METHOD
/begin COMPU_METHOD fak_sw_b64 "" RAT_FUNC "%6.4" "-" COEFFS 0 65536 0 0 0 128 /end COMPU_METHOD
/begin COMPU_METHOD fak_sw_b8 "" RAT_FUNC "%6.5" "-" COEFFS 0 65536 0 0 0 16 /end COMPU_METHOD
/begin COMPU_METHOD fak_ub_b1 "" RAT_FUNC "%6.4" "-" COEFFS 0 256 0 0 0 1 /end COMPU_METHOD
/begin COMPU_METHOD fak_ub_b16 "" RAT_FUNC "%6.4" "-" COEFFS 0 256 0 0 0 16 /end COMPU_METHOD
/begin COMPU_METHOD fak_ub_b2 "" RAT_FUNC "%6.4" "-" COEFFS 0 256 0 0 0 2 /end COMPU_METHOD
/begin COMPU_METHOD fak_ub_b32 "" RAT_FUNC "%6.3" "-" COEFFS 0 256 0 0 0 32 /end COMPU_METHOD
/begin COMPU_METHOD fak_ub_b4 "" RAT_FUNC "%6.4" "-" COEFFS 0 256 0 0 0 4 /end COMPU_METHOD
/begin COMPU_METHOD fak_ub_b8 "" RAT_FUNC "%6.4" "-" COEFFS 0 256 0 0 0 8 /end COMPU_METHOD
/begin COMPU_METHOD fak_ub_q4p7Em7 "" RAT_FUNC "%11.10" "-" COEFFS 0 1 0 0 0 4.7e-007 /end COMPU_METHOD
/begin COMPU_METHOD fak_uw_b1 "" RAT_FUNC "%7.6" "-" COEFFS 0 65536 0 0 0 1 /end COMPU_METHOD
/begin COMPU_METHOD fak_uw_b128 "" RAT_FUNC "%6.4" "-" COEFFS 0 65536 0 0 0 128 /end COMPU_METHOD
/begin COMPU_METHOD fak_uw_b128_1 "" RAT_FUNC "%6.4" "1/s" COEFFS 0 65536 0 0 0 128 /end COMPU_METHOD
/begin COMPU_METHOD fak_uw_b16 "" RAT_FUNC "%6.5" "-" COEFFS 0 65536 0 0 0 16 /end COMPU_METHOD
/begin COMPU_METHOD fak_uw_b2 "" RAT_FUNC "%7.6" "-" COEFFS 0 65536 0 0 0 2 /end COMPU_METHOD
/begin COMPU_METHOD fak_uw_b4 "" RAT_FUNC "%7.6" "-" COEFFS 0 65536 0 0 0 4 /end COMPU_METHOD
/begin COMPU_METHOD fak_uw_b5 "" RAT_FUNC "%7.6" "-" COEFFS 0 65536 0 0 0 5 /end COMPU_METHOD
/begin COMPU_METHOD fak_uw_b64_1 "" RAT_FUNC "%6.5" "1/s" COEFFS 0 65536 0 0 0 64 /end COMPU_METHOD
/begin COMPU_METHOD fak_uw_b8 "" RAT_FUNC "%6.5" "-" COEFFS 0 65536 0 0 0 8 /end COMPU_METHOD
/begin COMPU_METHOD freq_ub_b0p05 "" RAT_FUNC "%6.5" "1/s" COEFFS 0 256 0 0 0 0.05 /end COMPU_METHOD
/begin COMPU_METHOD kw_q0p0078 "" RAT_FUNC "%6.4" "Grad KW" COEFFS 0 128 0 0 0 1 /end COMPU_METHOD
/begin COMPU_METHOD lw_sw_q0p04375 "" RAT_FUNC "%6.4" "°" COEFFS 0 32767 0 0 0 1434 /end COMPU_METHOD
/begin COMPU_METHOD mdt_q0p15625_Nms "" RAT_FUNC "%6.3" "Nms" COEFFS 0 65536 0 0 0 10240 /end COMPU_METHOD
/begin COMPU_METHOD m_ub_b1020 "" RAT_FUNC "%6.2" "kg/h" COEFFS 0 1 0 0 0 4 /end COMPU_METHOD
/begin COMPU_METHOD m_uw_b291p25 "" RAT_FUNC "%6.4" "g" COEFFS 0 225 0 0 0 1 /end COMPU_METHOD
/begin COMPU_METHOD m_uw_b4660 "" RAT_FUNC "%6.4" "g" COEFFS 0 3600 0 0 0 256 /end COMPU_METHOD
/begin COMPU_METHOD m_uw_b6553p5 "" RAT_FUNC "%6.3" "kg/h" COEFFS 0 1 0 0 0 0.1 /end COMPU_METHOD
/begin COMPU_METHOD m_uw_b7281 "" RAT_FUNC "%6.3" "g" COEFFS 0 9 0 0 0 1 /end COMPU_METHOD
/begin COMPU_METHOD nmotd_sw_q0p25 "" RAT_FUNC "%6.3" "1/min" COEFFS 0 1 0 0 0 0.25 /end COMPU_METHOD
/begin COMPU_METHOD nmotg_sw_q0p39 "" RAT_FUNC "%6.3" "1/min/s" COEFFS 0 1 0 0 0 0.39063 /end COMPU_METHOD
/begin COMPU_METHOD nmot_q0p1453421 "" RAT_FUNC "%6.3" "U/min" COEFFS 0 1 0 0 0 0.1453421 /end COMPU_METHOD
/begin COMPU_METHOD nmot_ub_q25 "" RAT_FUNC "%6.1" "Upm" COEFFS 0 1 0 0 0 25 /end COMPU_METHOD
/begin COMPU_METHOD nmot_ub_q40 "" RAT_FUNC "%6.1" "1/min" COEFFS 0 1 0 0 0 40 /end COMPU_METHOD
/begin COMPU_METHOD nmot_uw_q0p25 "" RAT_FUNC "%6.3" "1/min" COEFFS 0 1 0 0 0 0.25 /end COMPU_METHOD
/begin COMPU_METHOD p_q0p2 "" RAT_FUNC "%6.3" "bar" COEFFS 0 5 0 0 0 1 /end COMPU_METHOD
/begin COMPU_METHOD p_uw_q0p039 "" RAT_FUNC "%6.4" "hPa" COEFFS 0 256 0 0 0 10 /end COMPU_METHOD
/begin COMPU_METHOD relDK_ub_b100 "" RAT_FUNC "%6.3" "%DK" COEFFS 0 255 0 0 0 100 /end COMPU_METHOD
/begin COMPU_METHOD relmom_q0p0122 "" RAT_FUNC "%6.4" "%" COEFFS 0 65536 0 0 0 800 /end COMPU_METHOD
/begin COMPU_METHOD relnmot_q0p000122 "" RAT_FUNC "%6.5" "%s/(U/min)" COEFFS 0 65536 0 0 0 8 /end COMPU_METHOD
/begin COMPU_METHOD relnmot_q0p477Em4 "" RAT_FUNC "%7.6" "%/(U/min)" COEFFS 0 65536 0 0 0 3.125 /end COMPU_METHOD
/begin COMPU_METHOD relPED_q0p00153 "" RAT_FUNC "%6.4" "% PED" COEFFS 0 65535 0 0 0 100 /end COMPU_METHOD
/begin COMPU_METHOD relPED_ub_b100 "" RAT_FUNC "%6.3" "%PED" COEFFS 0 255 0 0 0 100 /end COMPU_METHOD
/begin COMPU_METHOD rel_q0p0195 "" RAT_FUNC "%6.4" "%" COEFFS 0 256 0 0 0 5 /end COMPU_METHOD
/begin COMPU_METHOD rel_q0p0977 "" RAT_FUNC "%6.3" "%" COEFFS 0 1 0 0 0 0.0977 /end COMPU_METHOD
/begin COMPU_METHOD rel_q0p1953 "" RAT_FUNC "%6.3" "%" COEFFS 0 256 0 0 0 50 /end COMPU_METHOD
/begin COMPU_METHOD rel_q0p1957 "" RAT_FUNC "%6.3" "%" COEFFS 0 511 0 0 0 100 /end COMPU_METHOD
/begin COMPU_METHOD rel_q0p39 "" RAT_FUNC "%6.3" "%" COEFFS 0 256 0 0 0 100 /end COMPU_METHOD
/begin COMPU_METHOD rel_q0p392 "" RAT_FUNC "%6.3" "%" COEFFS 0 255 0 0 0 100 /end COMPU_METHOD
/begin COMPU_METHOD rel_q0p7629Em3 "" RAT_FUNC "%6.5" "%" COEFFS 0 65536 0 0 0 50 /end COMPU_METHOD
/begin COMPU_METHOD rel_sb_b25 "" RAT_FUNC "%6.3" "%" COEFFS 0 128 0 0 0 25 /end COMPU_METHOD
/begin COMPU_METHOD rel_sb_q0p02 "" RAT_FUNC "%6.4" "%" COEFFS 0 50 0 0 0 1 /end COMPU_METHOD
/begin COMPU_METHOD rel_sb_q0p39 "" RAT_FUNC "%6.3" "%" COEFFS 0 1 0 0 0 0.3906 /end COMPU_METHOD
/begin COMPU_METHOD rel_sw_b100 "" RAT_FUNC "%6.4" "%" COEFFS 0 32768 0 0 0 100 /end COMPU_METHOD
/begin COMPU_METHOD rel_sw_b1536 "" RAT_FUNC "%6.4" "%" COEFFS 0 65536 0 0 0 3072 /end COMPU_METHOD
/begin COMPU_METHOD rel_sw_b192 "" RAT_FUNC "%6.4" "%" COEFFS 0 65536 0 0 0 384 /end COMPU_METHOD
/begin COMPU_METHOD rel_sw_b50 "" RAT_FUNC "%6.4" "%" COEFFS 0 65536 0 0 0 100 /end COMPU_METHOD
/begin COMPU_METHOD rel_sw_q0p0234 "" RAT_FUNC "%6.4" "%/seg" COEFFS 0 32 0 0 0 0.75 /end COMPU_METHOD
/begin COMPU_METHOD rel_ub_b100 "" RAT_FUNC "%6.3" "%" COEFFS 0 256 0 0 0 100 /end COMPU_METHOD
/begin COMPU_METHOD rel_ub_b127p5 "" RAT_FUNC "%6.3" "%" COEFFS 0 2 0 0 0 1 /end COMPU_METHOD
/begin COMPU_METHOD rel_ub_b24p9 "" RAT_FUNC "%6.3" "%" COEFFS 0 255 0 0 0 24.9 /end COMPU_METHOD
/begin COMPU_METHOD rel_ub_b2p0 "" RAT_FUNC "%6.4" "%" COEFFS 0 256 0 0 0 2 /end COMPU_METHOD
/begin COMPU_METHOD rel_ub_b99p6 "" RAT_FUNC "%6.3" "%" COEFFS 0 256 0 0 0 100 /end COMPU_METHOD
/begin COMPU_METHOD rel_ub_bn24p9 "" RAT_FUNC "%6.5" "%" COEFFS 0 -255 0 0 0 24.9 /end COMPU_METHOD
/begin COMPU_METHOD rel_ub_q0p75 "" RAT_FUNC "%6.3" "%" COEFFS 0 1 0 0 0 0.75 /end COMPU_METHOD
/begin COMPU_METHOD rel_uw_b100 "" RAT_FUNC "%6.4" "%" COEFFS 0 65536 0 0 0 100 /end COMPU_METHOD
/begin COMPU_METHOD rel_uw_b200 "" RAT_FUNC "%6.4" "%" COEFFS 0 65536 0 0 0 200 /end COMPU_METHOD
/begin COMPU_METHOD rel_uw_q0p001 "" RAT_FUNC "%6.5" "%" COEFFS 0 1000 0 0 0 1 /end COMPU_METHOD
/begin COMPU_METHOD rel_uw_q0p0234 "" RAT_FUNC "%6.4" "%" COEFFS 0 32 0 0 0 0.75 /end COMPU_METHOD
/begin COMPU_METHOD rfak_q0p5 "" RAT_FUNC "%6.2" "-" COEFFS 0 0 128 0 1 0 /end COMPU_METHOD
/begin COMPU_METHOD spg_ub_q0p0052_o0p2 "" RAT_FUNC "%6.3" "V" COEFFS 0 255 51 0 0 1.33 /end COMPU_METHOD
/begin COMPU_METHOD spg_uw_q0p00488_o1 "" RAT_FUNC "%6.3" "V" COEFFS 0 1024 1024 0 0 5 /end COMPU_METHOD
/begin COMPU_METHOD t100msxs_ub_b25p5 "" RAT_FUNC "%6.3" "s" COEFFS 0 1 0 0 0 0.1 /end COMPU_METHOD
/begin COMPU_METHOD t100msxs_uw_b6553p5 "" RAT_FUNC "%6.3" "s" COEFFS 0 1 0 0 0 0.1 /end COMPU_METHOD
/begin COMPU_METHOD t10msxs_ub_b2p55 "" RAT_FUNC "%6.4" "s" COEFFS 0 1 0 0 0 0.01 /end COMPU_METHOD
/begin COMPU_METHOD t10msxs_uw_b655p35 "" RAT_FUNC "%6.4" "s" COEFFS 0 1 0 0 0 0.01 /end COMPU_METHOD
/begin COMPU_METHOD t1sxs_uw_b65535 "" RAT_FUNC "%6.2" "s" COEFFS 0 1 0 0 0 1 /end COMPU_METHOD
/begin COMPU_METHOD t200msxs_ub_b51 "" RAT_FUNC "%6.3" "s" COEFFS 0 1 0 0 0 0.2 /end COMPU_METHOD
/begin COMPU_METHOD t20msxs_ub_b5p1 "" RAT_FUNC "%6.4" "s" COEFFS 0 1 0 0 0 0.02 /end COMPU_METHOD
/begin COMPU_METHOD t20msxs_uw_b1310 "" RAT_FUNC "%6.4" "s" COEFFS 0 1 0 0 0 0.02 /end COMPU_METHOD
/begin COMPU_METHOD t20msxs_uw_q0p02 "" RAT_FUNC "%6.4" "s" COEFFS 0 1 0 0 0 0.02 /end COMPU_METHOD
/begin COMPU_METHOD temp_q0p0234_o273 "" RAT_FUNC "%6.1" "Grad C" COEFFS 0 1 273.15 0 0 0.0234375 /end COMPU_METHOD
/begin COMPU_METHOD temp_ub_b191p25 "" RAT_FUNC "%6.3" "Grad C" COEFFS 0 1 0 0 0 0.75 /end COMPU_METHOD
/begin COMPU_METHOD temp_ub_q0p75_o48 "" RAT_FUNC "%6.2" "Grad C" COEFFS 0 1 48 0 0 0.75 /end COMPU_METHOD
/begin COMPU_METHOD temp_uw_q0p75_o48 "" RAT_FUNC "%6.2" "Grad C" COEFFS 0 1 48 0 0 0.75 /end COMPU_METHOD
/begin COMPU_METHOD tv_ub_b100 "" RAT_FUNC "%6.3" "%TV" COEFFS 0 256 0 0 0 100 /end COMPU_METHOD
/begin COMPU_METHOD t_q0p1 "" RAT_FUNC "%6.3" "s" COEFFS 0 10 0 0 0 1 /end COMPU_METHOD
/begin COMPU_METHOD t_q20_ms "" RAT_FUNC "%6.1" "ms" COEFFS 0 1 0 0 0 20 /end COMPU_METHOD
/begin COMPU_METHOD vfzg_ub_q1p25 "" RAT_FUNC "%6.2" "km/h" COEFFS 0 1 0 0 0 1.25 /end COMPU_METHOD
/begin COMPU_METHOD vfzg_uw_b512 "" RAT_FUNC "%6.4" "km/h" COEFFS 0 65536 0 0 0 512 /end COMPU_METHOD
/begin COMPU_METHOD zk100msxs_ub_b25p5 "" RAT_FUNC "%6.3" "s" COEFFS 0 0 256 0 10 0 /end COMPU_METHOD
/begin COMPU_METHOD zk10msxs_uw_b655 "" RAT_FUNC "%6.2" "s" COEFFS 0 0 65536 0 100 0 /end COMPU_METHOD
/begin COMPU_METHOD zk200msxs_ub_b51p2 "" RAT_FUNC "%6.3" "s" COEFFS 0 0 255 0 5 0 /end COMPU_METHOD
/begin COMPU_METHOD zk200msxs_uw_b13107 "" RAT_FUNC "%12.3" "s" COEFFS 0 0 13107.2 0 1 0 /end COMPU_METHOD
/begin COMPU_METHOD zk200msxs_uw_b5 "" RAT_FUNC "%7.6" "1/s" COEFFS 0 65536 0 0 0 5 /end COMPU_METHOD
/begin COMPU_METHOD zk200msxs_uw_b960 "" RAT_FUNC "%6.4" "%/s" COEFFS 0 65536 0 0 0 960 /end COMPU_METHOD
/begin COMPU_METHOD zk20msxs_ub_b5p1 "" RAT_FUNC "%6.4" "s" COEFFS 0 0 5.1 0 1 0 /end COMPU_METHOD
/begin COMPU_METHOD zk20msxs_ub_b5p12 "" RAT_FUNC "%6.4" "s" COEFFS 0 0 256 0 50 0 /end COMPU_METHOD
/begin COMPU_METHOD zk20msxs_uw_b1310 "" RAT_FUNC "%12.4" "s" COEFFS 0 0 65536 0 50 0 /end COMPU_METHOD
/begin COMPU_METHOD zk50msxs_uw_b3276p8 "" RAT_FUNC "%6.1" "s" COEFFS 0 0 65536 0 20 0 /end COMPU_METHOD
/begin COMPU_METHOD zw_sb_q0p3735 "" RAT_FUNC "%6.3" "grad KW" COEFFS 0 255 0 0 0 95.625 /end COMPU_METHOD
/begin COMPU_METHOD zw_sb_q0p75 "" RAT_FUNC "%6.3" "Grad KW" COEFFS 0 255 0 0 0 191.25 /end COMPU_METHOD
/begin COMPU_METHOD zw_ub_q0p75 "" RAT_FUNC "%6.3" "Grad KW" COEFFS 0 255 0 0 0 191.25 /end COMPU_METHOD
/begin RECORD_LAYOUT FklWSw FNC_VALUES 1 SWORD COLUMN_DIR DIRECT /end RECORD_LAYOUT
/begin RECORD_LAYOUT FklWUb FNC_VALUES 1 UBYTE COLUMN_DIR DIRECT /end RECORD_LAYOUT
/begin RECORD_LAYOUT GkfWSb FNC_VALUES 1 SBYTE COLUMN_DIR DIRECT /end RECORD_LAYOUT
/begin RECORD_LAYOUT GkfWSw FNC_VALUES 1 SWORD COLUMN_DIR DIRECT /end RECORD_LAYOUT
/begin RECORD_LAYOUT GkfWUb FNC_VALUES 1 UBYTE COLUMN_DIR DIRECT /end RECORD_LAYOUT
/begin RECORD_LAYOUT GkfWUw FNC_VALUES 1 UWORD COLUMN_DIR DIRECT /end RECORD_LAYOUT
/begin RECORD_LAYOUT GklWSb FNC_VALUES 1 SBYTE COLUMN_DIR DIRECT /end RECORD_LAYOUT
/begin RECORD_LAYOUT GklWSw FNC_VALUES 1 SWORD COLUMN_DIR DIRECT /end RECORD_LAYOUT
/begin RECORD_LAYOUT GklWUb FNC_VALUES 1 UBYTE COLUMN_DIR DIRECT /end RECORD_LAYOUT
/begin RECORD_LAYOUT GklWUw FNC_VALUES 1 UWORD COLUMN_DIR DIRECT /end RECORD_LAYOUT
/begin RECORD_LAYOUT KfAxSwAySwSstxSwSstySwWSw NO_AXIS_PTS_X 1 SWORD NO_AXIS_PTS_Y 2 SWORD AXIS_PTS_X 3 SWORD INDEX_INCR DIRECT AXIS_PTS_Y 4 SWORD INDEX_INCR DIRECT FNC_VALUES 5 SWORD COLUMN_DIR DIRECT /end RECORD_LAYOUT
/begin RECORD_LAYOUT KfAxUbAyUbSstxSwSstyUbWUw NO_AXIS_PTS_X 1 UBYTE NO_AXIS_PTS_Y 2 UBYTE AXIS_PTS_X 3 SWORD INDEX_INCR DIRECT AXIS_PTS_Y 4 UBYTE INDEX_INCR DIRECT FNC_VALUES 5 UWORD COLUMN_DIR DIRECT /end RECORD_LAYOUT
/begin RECORD_LAYOUT KfAxUbAyUbSstxUbSstyUbWSb NO_AXIS_PTS_X 1 UBYTE NO_AXIS_PTS_Y 2 UBYTE AXIS_PTS_X 3 UBYTE INDEX_INCR DIRECT AXIS_PTS_Y 4 UBYTE INDEX_INCR DIRECT FNC_VALUES 5 SBYTE COLUMN_DIR DIRECT /end RECORD_LAYOUT
/begin RECORD_LAYOUT KfAxUbAyUbSstxUbSstyUbWUb NO_AXIS_PTS_X 1 UBYTE NO_AXIS_PTS_Y 2 UBYTE AXIS_PTS_X 3 UBYTE INDEX_INCR DIRECT AXIS_PTS_Y 4 UBYTE INDEX_INCR DIRECT FNC_VALUES 5 UBYTE COLUMN_DIR DIRECT /end RECORD_LAYOUT
/begin RECORD_LAYOUT KfAxUbAyUbSstxUbSstyUwWUw NO_AXIS_PTS_X 1 UBYTE NO_AXIS_PTS_Y 2 UBYTE AXIS_PTS_X 3 UBYTE INDEX_INCR DIRECT AXIS_PTS_Y 4 UWORD INDEX_INCR DIRECT FNC_VALUES 5 UWORD COLUMN_DIR DIRECT /end RECORD_LAYOUT
/begin RECORD_LAYOUT KfAxUbAyUbSstxUwSstyUwWUw NO_AXIS_PTS_X 1 UWORD NO_AXIS_PTS_Y 2 UWORD AXIS_PTS_X 3 UWORD INDEX_INCR DIRECT AXIS_PTS_Y 4 UWORD INDEX_INCR DIRECT FNC_VALUES 5 UWORD COLUMN_DIR DIRECT /end RECORD_LAYOUT
/begin RECORD_LAYOUT KfAxUwAyUwSstxSwSstyUwWUw NO_AXIS_PTS_X 1 UWORD NO_AXIS_PTS_Y 2 UWORD AXIS_PTS_X 3 SWORD INDEX_INCR DIRECT AXIS_PTS_Y 4 UWORD INDEX_INCR DIRECT FNC_VALUES 5 UWORD COLUMN_DIR DIRECT /end RECORD_LAYOUT
/begin RECORD_LAYOUT KfAxUwAyUwSstxUwSstyUwWUw NO_AXIS_PTS_X 1 UWORD NO_AXIS_PTS_Y 2 UWORD AXIS_PTS_X 3 UWORD INDEX_INCR DIRECT AXIS_PTS_Y 4 UWORD INDEX_INCR DIRECT FNC_VALUES 5 UWORD COLUMN_DIR DIRECT /end RECORD_LAYOUT
/begin RECORD_LAYOUT KlASwSstSwWSw NO_AXIS_PTS_X 1 SWORD AXIS_PTS_X 2 SWORD INDEX_INCR DIRECT FNC_VALUES 3 SWORD COLUMN_DIR DIRECT /end RECORD_LAYOUT
/begin RECORD_LAYOUT KlAUbSstUbWSb NO_AXIS_PTS_X 1 UBYTE AXIS_PTS_X 2 UBYTE INDEX_INCR DIRECT FNC_VALUES 3 SBYTE COLUMN_DIR DIRECT /end RECORD_LAYOUT
/begin RECORD_LAYOUT KlAUbSstUbWUb NO_AXIS_PTS_X 1 UBYTE AXIS_PTS_X 2 UBYTE INDEX_INCR DIRECT FNC_VALUES 3 UBYTE COLUMN_DIR DIRECT /end RECORD_LAYOUT
/begin RECORD_LAYOUT KlAUbSstUbWUw NO_AXIS_PTS_X 1 UBYTE AXIS_PTS_X 2 UBYTE INDEX_INCR DIRECT FNC_VALUES 3 UWORD COLUMN_DIR DIRECT /end RECORD_LAYOUT
/begin RECORD_LAYOUT KlAUbSstUwWUw NO_AXIS_PTS_X 1 UWORD AXIS_PTS_X 2 UWORD INDEX_INCR DIRECT FNC_VALUES 3 UWORD COLUMN_DIR DIRECT /end RECORD_LAYOUT
/begin RECORD_LAYOUT KlAUwSstSwWUw NO_AXIS_PTS_X 1 UWORD AXIS_PTS_X 2 SWORD INDEX_INCR DIRECT FNC_VALUES 3 UWORD COLUMN_DIR DIRECT /end RECORD_LAYOUT
/begin RECORD_LAYOUT KlAUwSstUwWUb NO_AXIS_PTS_X 1 UWORD AXIS_PTS_X 2 UWORD INDEX_INCR DIRECT FNC_VALUES 3 UBYTE COLUMN_DIR DIRECT /end RECORD_LAYOUT
/begin RECORD_LAYOUT KlAUwSstUwWUw NO_AXIS_PTS_X 1 UWORD AXIS_PTS_X 2 UWORD INDEX_INCR DIRECT FNC_VALUES 3 UWORD COLUMN_DIR DIRECT /end RECORD_LAYOUT
/begin RECORD_LAYOUT KwSb FNC_VALUES 1 SBYTE COLUMN_DIR DIRECT /end RECORD_LAYOUT
/begin RECORD_LAYOUT KwSw FNC_VALUES 1 SWORD COLUMN_DIR DIRECT /end RECORD_LAYOUT
/begin RECORD_LAYOUT KwUb FNC_VALUES 1 UBYTE COLUMN_DIR DIRECT /end RECORD_LAYOUT
/begin RECORD_LAYOUT KwUw FNC_VALUES 1 UWORD COLUMN_DIR DIRECT /end RECORD_LAYOUT
/begin RECORD_LAYOUT SstASwSstSw NO_AXIS_PTS_X 1 SWORD AXIS_PTS_X 2 SWORD INDEX_INCR DIRECT /end RECORD_LAYOUT
/begin RECORD_LAYOUT SstAUbSstUb NO_AXIS_PTS_X 1 UBYTE AXIS_PTS_X 2 UBYTE INDEX_INCR DIRECT /end RECORD_LAYOUT
/begin RECORD_LAYOUT SstAUwSstUw NO_AXIS_PTS_X 1 UWORD AXIS_PTS_X 2 UWORD INDEX_INCR DIRECT /end RECORD_LAYOUT
/end MODULE
/end PROJECT
