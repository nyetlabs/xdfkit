ASAP2_VERSION 1 3
/begin PROJECT S1103A_25G5_0 "S1103A"
/begin HEADER "" VERSION "S1103A_25G5_0" PROJECT_NO S1103A_25G5_0 /end HEADER
/begin MODULE DIM ""
/begin MOD_COMMON "" BYTE_ORDER MSB_LAST ALIGNMENT_BYTE 1 ALIGNMENT_WORD 2 ALIGNMENT_LONG 2 /end MOD_COMMON
/begin CHARACTERISTIC ADCC_T_UM "" VALUE 0x8FC3B6 KwUb 2.550 t10msxs_ub_b2p55 0.00 2.550 FORMAT "%5.3" /end CHARACTERISTIC
/begin CHARACTERISTIC AUSC_A_UM "" VALUE 0x8FD612 KwUw 65530.00 dez 5.000000 65535.00 FORMAT "%8.2" /end CHARACTERISTIC
/begin CHARACTERISTIC AUSGH_T_UM "" VALUE 0x8FC3BA KwUb 10200.0 t40ms_ub_b10200 0.00 10200.0 FORMAT "%7.1" /end CHARACTERISTIC
/begin CHARACTERISTIC AUSG_T_UM "" VALUE 0x8FC3BB KwUb 255.0 dezsub1 1.000 256.0 FORMAT "%5.1" /end CHARACTERISTIC
/begin CHARACTERISTIC AUSZH_T_UM "" VALUE 0x8FC3BC KwUb 10200.0 t40ms_ub_b10200 0.00 10200.0 FORMAT "%7.1" /end CHARACTERISTIC
/begin CHARACTERISTIC AUSZH_T_UR "" VALUE 0x8FC3BD KwUb 10200.0 t40ms_ub_b10200 0.00 10200.0 FORMAT "%7.1" /end CHARACTERISTIC
/begin CHARACTERISTIC AUSZ_T_UM "" VALUE 0x8FC3BE KwUb 255.0 dezsub1 1.000 256.0 FORMAT "%5.1" /end CHARACTERISTIC
/begin CHARACTERISTIC BZMSR_T_UC "" VALUE 0x8FC635 KwUb 10200.0 t40ms_ub_b10200 0.00 10200.0 FORMAT "%7.1" READ_ONLY /end CHARACTERISTIC
/begin CHARACTERISTIC CNOKT "" VALUE 0x8E4000 KwUb 255.0 dez 0.00 255.0 FORMAT "%5.1" /end CHARACTERISTIC
/begin CHARACTERISTIC CWKHZW "" VALUE 0x8FD379 KwUb 255.0 dez 0.00 255.0 FORMAT "%5.1" /end CHARACTERISTIC
/begin CHARACTERISTIC CWNWRA "" VALUE 0x8E3C93 KwUb 255.0 dez 0.00 255.0 FORMAT "%5.1" /end CHARACTERISTIC
/begin CHARACTERISTIC CWNWRE "" VALUE 0x8E3B92 KwUb 255.0 dez 0.00 255.0 FORMAT "%5.1" /end CHARACTERISTIC
/begin CHARACTERISTIC CWVSV "" VALUE 0x8FCCCC KwUb 255.0 dez 0.00 255.0 FORMAT "%5.1" /end CHARACTERISTIC
/begin CHARACTERISTIC CWWFS "" VALUE 0x8E2436 KwUb 255.0 dez 0.00 255.0 FORMAT "%5.1" /end CHARACTERISTIC
/begin CHARACTERISTIC CW_BDE_UC "" VALUE 0x8FC006 KwUb 255.0 dez 0.00 255.0 FORMAT "%5.1" /end CHARACTERISTIC
/begin CHARACTERISTIC CW_BDE_UM "" VALUE 0x8FC002 KwUb 255.0 dez 0.00 255.0 FORMAT "%5.1" /end CHARACTERISTIC
/begin CHARACTERISTIC CW_FUBND "" VALUE 0x8E482B KwUb 255.0 dez 0.00 255.0 FORMAT "%5.1" /end CHARACTERISTIC
/begin CHARACTERISTIC CW_NOROMCHKRESET "" VALUE 0x8FCCC8 KwUb 255.0 dez 0.00 255.0 FORMAT "%5.1" /end CHARACTERISTIC
/begin CHARACTERISTIC DBMSRMX_UC "" VALUE 0x8FC636 KwUb 255.0 dez 0.00 255.0 FORMAT "%5.1" READ_ONLY /end CHARACTERISTIC
/begin CHARACTERISTIC DBMSR_T_UC "" VALUE 0x8FC637 KwUb 10200.0 t40ms_ub_b10200 0.00 10200.0 FORMAT "%7.1" READ_ONLY /end CHARACTERISTIC
/begin CHARACTERISTIC DFDZWS "" VALUE 0x8FD381 KwUb 0.9961 fak_ub_b1 0.00 0.9961 /end CHARACTERISTIC
/begin CHARACTERISTIC DFDZWSU "" VALUE 0x8FD382 KwUb 0.9961 fak_ub_b1 0.00 0.9961 /end CHARACTERISTIC
/begin CHARACTERISTIC DNTIPDYN "" VALUE 0x8FD37A KwSb 25500. nmotg_sb_q100 -12800. 12700. FORMAT "%5.0" /end CHARACTERISTIC
/begin CHARACTERISTIC DNZWMN "" VALUE 0x8FD37B KwUb 10200. nmot_ub_q40 0.00 10200. FORMAT "%5.0" /end CHARACTERISTIC
/begin CHARACTERISTIC DTSDRL "" VALUE 0x8FEFB8 KwSw 1535.977 rel_sw_q0p0234 -768.0000 767.9766 FORMAT "%8.4" /end CHARACTERISTIC
/begin CHARACTERISTIC DUBZS "" VALUE 0x8E482C KwUb 17.95 spg_ubatt 0.00 17.95 FORMAT "%5.2" /end CHARACTERISTIC
/begin CHARACTERISTIC DZWAML "" CURVE 0x8F0F0A KlAUbSstUbWSb 191.3 zw_sb_q0p75 -96.00 95.25 FORMAT "%5.2"
 /begin AXIS_DESCR STD_AXIS ml m_ub_b1020 8 0.00 1020. FORMAT "%5.0" DEPOSIT ABSOLUTE /end AXIS_DESCR
/end CHARACTERISTIC
/begin CHARACTERISTIC DZWDYN "" CURVE 0x8E3D15 GklWSb 191.3 zw_sb_q0p75 -96.00 95.25 FORMAT "%5.2"
 /begin AXIS_DESCR COM_AXIS tmot temp_ub_q0p75_o48 8 -48.00 143.3 FORMAT "%5.1" AXIS_PTS_REF STM08__UB /end AXIS_DESCR
/end CHARACTERISTIC
/begin CHARACTERISTIC DZWSPM "" CURVE 0x8E3D1D GklWSb 191.3 zw_sb_q0p75 -96.00 95.25 FORMAT "%5.2"
 /begin AXIS_DESCR COM_AXIS tmot temp_ub_q0p75_o48 8 -48.00 143.3 FORMAT "%5.1" AXIS_PTS_REF STM08__UB /end AXIS_DESCR
/end CHARACTERISTIC
/begin CHARACTERISTIC DZWSTTA "" CURVE 0x8F101C KlAUbSstUbWSb 191.3 zw_sb_q0p75 -96.00 95.25 FORMAT "%5.2"
 /begin AXIS_DESCR STD_AXIS tans temp_ub_q0p75_o48 6 -48.00 143.3 FORMAT "%5.1" DEPOSIT ABSOLUTE /end AXIS_DESCR
/end CHARACTERISTIC
/begin CHARACTERISTIC EDNWA "" VALUE 0x8FD29E KwUb 15.94 kw_ub_b16 0.00 15.94 FORMAT "%5.2" /end CHARACTERISTIC
/begin CHARACTERISTIC EDNWE "" VALUE 0x8FD28F KwUb 15.94 kw_ub_b16 0.00 15.94 FORMAT "%5.2" /end CHARACTERISTIC
/begin CHARACTERISTIC FFLDZ "" CURVE 0x8F105C KlAUbSstUbWUw 52.42800 tsegment_sy 0.00 52.42800 FORMAT "%8.5"
 /begin AXIS_DESCR STD_AXIS ub spg_ubatt_sy 8 0.00 17.93 FORMAT "%5.2" DEPOSIT ABSOLUTE /end AXIS_DESCR
/end CHARACTERISTIC
/begin CHARACTERISTIC FGRC_BFGR_DAT_UC "" VAL_BLK 0x8FC5F5 KwbUb 255.0 dez 0.00 255.0 FORMAT "%5.1" READ_ONLY NUMBER 16 /end CHARACTERISTIC
/begin CHARACTERISTIC FGRC_MIFA_DAT_UC "" VAL_BLK 0x8FC605 KwbUb 99.61 rel_ub_b99p6 0.00 99.61 FORMAT "%5.2" READ_ONLY NUMBER 16 /end CHARACTERISTIC
/begin CHARACTERISTIC FGRC_SFLAGS_DAT_UC "" VAL_BLK 0x8FC615 KwbUb 255.0 dez 0.00 255.0 FORMAT "%5.1" READ_ONLY NUMBER 16 /end CHARACTERISTIC
/begin CHARACTERISTIC FGRC_TFLAGS_DAT_UC "" VAL_BLK 0x8FC625 KwbUb 255.0 dez 0.00 255.0 FORMAT "%5.1" READ_ONLY NUMBER 16 /end CHARACTERISTIC
/begin CHARACTERISTIC FGRC_VFZG_DAT_UC "" VAL_BLK 0x8FD6B6 KwbUw 511.9922 vfzg_uw_b512 0.00 511.9922 FORMAT "%8.4" READ_ONLY NUMBER 16 /end CHARACTERISTIC
/begin CHARACTERISTIC FNWIVA "" VALUE 0x8FD29F KwUb 1.992 fak_ub_b2 0.00 1.992 FORMAT "%5.3" /end CHARACTERISTIC
/begin CHARACTERISTIC FNWIVE "" VALUE 0x8FD290 KwUb 1.992 fak_ub_b2 0.00 1.992 FORMAT "%5.3" /end CHARACTERISTIC
/begin CHARACTERISTIC FSWTM "" CURVE 0x8E482D KlAUbSstUbWUb 1.992 fak_ub_b2 0.00 1.992 FORMAT "%5.3"
 /begin AXIS_DESCR STD_AXIS tmot temp_ub_q0p75_o48 5 -48.00 143.3 FORMAT "%5.1" DEPOSIT ABSOLUTE /end AXIS_DESCR
/end CHARACTERISTIC
/begin CHARACTERISTIC FSZTM "" CURVE 0x8E4838 KlAUbSstUbWUb 1.992 fak_ub_b2 0.00 1.992 FORMAT "%5.3"
 /begin AXIS_DESCR STD_AXIS tmot temp_ub_q0p75_o48 5 -48.00 143.3 FORMAT "%5.1" DEPOSIT ABSOLUTE /end AXIS_DESCR
/end CHARACTERISTIC
/begin CHARACTERISTIC FTANWUBA "" CURVE 0x8E3C94 KlAUbSstUbWUb 1.992 fak_ub_b2 0.00 1.992 FORMAT "%5.3"
 /begin AXIS_DESCR STD_AXIS ub spg_ubatt_sy 6 0.00 17.93 FORMAT "%5.2" DEPOSIT ABSOLUTE /end AXIS_DESCR
/end CHARACTERISTIC
/begin CHARACTERISTIC FTANWUBE "" CURVE 0x8E3B93 KlAUbSstUbWUb 1.992 fak_ub_b2 0.00 1.992 FORMAT "%5.3"
 /begin AXIS_DESCR STD_AXIS ub spg_ubatt_sy 6 0.00 17.93 FORMAT "%5.2" DEPOSIT ABSOLUTE /end AXIS_DESCR
/end CHARACTERISTIC
/begin CHARACTERISTIC FTOMN "" VALUE 0x8E4843 KwUb 25.50 txms_ub_q0p1 0.00 25.50 FORMAT "%5.2" /end CHARACTERISTIC
/begin CHARACTERISTIC FTSDRLW "" CURVE 0x8F10B8 KlAUwSstSwWUw 7.999878 fak_uw_b8 0.00 7.999878 FORMAT "%8.6"
 /begin AXIS_DESCR STD_AXIS tsdrlmx_w rel_sw_q0p0234 6 -768.0000 767.9766 FORMAT "%8.4" DEPOSIT ABSOLUTE /end AXIS_DESCR
/end CHARACTERISTIC
/begin CHARACTERISTIC FUBAOF "" VALUE 0x8F1076 KwUw 52.42800 tsegment_sy 0.00 52.42800 FORMAT "%8.5" /end CHARACTERISTIC
/begin CHARACTERISTIC FWNMOT "" VALUE 0x8E4844 KwUb 10200. nmot_ub_q40 0.00 10200. FORMAT "%5.0" /end CHARACTERISTIC
/begin CHARACTERISTIC FZWKHMX "" VALUE 0x8FD37C KwUb 0.9961 fak_ub_b1 0.00 0.9961 /end CHARACTERISTIC
/begin CHARACTERISTIC FZWWLRLN "" MAP 0x8E4753 GkfWUb 1.992 fak_ub_b2 0.00 1.992 FORMAT "%5.3"
 /begin AXIS_DESCR COM_AXIS nmot nmot_ub_q40 12 0.00 10200. FORMAT "%5.0" AXIS_PTS_REF SNM12ESUB /end AXIS_DESCR
 /begin AXIS_DESCR COM_AXIS rl rel_ub_q0p75 6 0.00 191.3 FORMAT "%5.1" AXIS_PTS_REF SRL06ESUB /end AXIS_DESCR
/end CHARACTERISTIC
/begin CHARACTERISTIC IP1A_MX_UM "" VALUE 0x8FC01B KwUb 4.980 spg_ub_q0p019 0.00 4.980 FORMAT "%5.3" /end CHARACTERISTIC
/begin CHARACTERISTIC IP2A_MN_UM "" VALUE 0x8FC01C KwUb 4.980 spg_ub_q0p019 0.00 4.980 FORMAT "%5.3" /end CHARACTERISTIC
/begin CHARACTERISTIC IPA_T_UM "" VALUE 0x8FC01D KwUb 10200.0 t40ms_ub_b10200 0.00 10200.0 FORMAT "%7.1" /end CHARACTERISTIC
/begin CHARACTERISTIC ITANWHFMA "" CURVE 0x8E3CA1 GklWUb 99.61 tv_ub_b100 0.00 99.61 FORMAT "%5.2"
 /begin AXIS_DESCR COM_AXIS toelzk_w temp_q0p0234_o273 8 -273.1500 1262.827 FORMAT "%8.3" AXIS_PTS_REF STO08NAUW /end AXIS_DESCR
/end CHARACTERISTIC
/begin CHARACTERISTIC ITANWHFME "" CURVE 0x8E3BA0 GklWUb 99.61 tv_ub_b100 0.00 99.61 FORMAT "%5.2"
 /begin AXIS_DESCR COM_AXIS toelzk_w temp_q0p0234_o273 8 -273.1500 1262.827 FORMAT "%8.3" AXIS_PTS_REF STO08NEUW /end AXIS_DESCR
/end CHARACTERISTIC
/begin CHARACTERISTIC KFDMP_UC_0 "" MAP 0x8FC849 GkfWUb 99.61 rel_ub_q0p3906 0.00 99.61 FORMAT "%5.2"
 /begin AXIS_DESCR COM_AXIS spsn_uc spg_ub_q0p019 8 0.00 4.980 FORMAT "%5.3" AXIS_PTS_REF MZUL_SPSNV08_UC /end AXIS_DESCR
 /begin AXIS_DESCR COM_AXIS nmot_uc nmot_ub_q40 8 0.00 10200. FORMAT "%5.0" AXIS_PTS_REF MZUL_NMV08_UC /end AXIS_DESCR
/end CHARACTERISTIC
/begin CHARACTERISTIC KFDMP_UC_1 "" MAP 0x8FC889 GkfWUb 99.61 rel_ub_q0p3906 0.00 99.61 FORMAT "%5.2"
 /begin AXIS_DESCR COM_AXIS spsn_uc spg_ub_q0p019 8 0.00 4.980 FORMAT "%5.3" AXIS_PTS_REF MZUL_SPSNV08_UC /end AXIS_DESCR
 /begin AXIS_DESCR COM_AXIS nmot_uc nmot_ub_q40 8 0.00 10200. FORMAT "%5.0" AXIS_PTS_REF MZUL_NMV08_UC /end AXIS_DESCR
/end CHARACTERISTIC
/begin CHARACTERISTIC KFDMP_UM_0 "" MAP 0x8FC169 GkfWUb 99.61 rel_ub_q0p3906 0.00 99.61 FORMAT "%5.2"
 /begin AXIS_DESCR COM_AXIS spsn_um spg_ub_q0p019 8 0.00 4.980 FORMAT "%5.3" AXIS_PTS_REF SPSNV08_UM /end AXIS_DESCR
 /begin AXIS_DESCR COM_AXIS nmot_um nmot_ub_q40 8 0.00 10200. FORMAT "%5.0" AXIS_PTS_REF NMV08_UM /end AXIS_DESCR
/end CHARACTERISTIC
/begin CHARACTERISTIC KFDMP_UM_1 "" MAP 0x8FC1A9 GkfWUb 99.61 rel_ub_q0p3906 0.00 99.61 FORMAT "%5.2"
 /begin AXIS_DESCR COM_AXIS spsn_um spg_ub_q0p019 8 0.00 4.980 FORMAT "%5.3" AXIS_PTS_REF SPSNV08_UM /end AXIS_DESCR
 /begin AXIS_DESCR COM_AXIS nmot_um nmot_ub_q40 8 0.00 10200. FORMAT "%5.0" AXIS_PTS_REF NMV08_UM /end AXIS_DESCR
/end CHARACTERISTIC
/begin CHARACTERISTIC KFDMT_UC_0 "" MAP 0x8FC8C9 GkfWUb 99.61 rel_ub_q0p3906 0.00 99.61 FORMAT "%5.2"
 /begin AXIS_DESCR COM_AXIS tmotmn_uc temp_ub_q0p75_o48 8 -48.00 143.3 FORMAT "%5.1" AXIS_PTS_REF TMOV08_UC /end AXIS_DESCR
 /begin AXIS_DESCR COM_AXIS nmot_uc nmot_ub_q40 8 0.00 10200. FORMAT "%5.0" AXIS_PTS_REF MZUL_NMV08_UC /end AXIS_DESCR
/end CHARACTERISTIC
/begin CHARACTERISTIC KFDMT_UC_1 "" MAP 0x8FC909 GkfWUb 99.61 rel_ub_q0p3906 0.00 99.61 FORMAT "%5.2"
 /begin AXIS_DESCR COM_AXIS tmotmn_uc temp_ub_q0p75_o48 8 -48.00 143.3 FORMAT "%5.1" AXIS_PTS_REF TMOV08_UC /end AXIS_DESCR
 /begin AXIS_DESCR COM_AXIS nmot_uc nmot_ub_q40 8 0.00 10200. FORMAT "%5.0" AXIS_PTS_REF MZUL_NMV08_UC /end AXIS_DESCR
/end CHARACTERISTIC
/begin CHARACTERISTIC KFDMT_UM_0 "" MAP 0x8FC1E9 GkfWUb 99.61 rel_ub_q0p3906 0.00 99.61 FORMAT "%5.2"
 /begin AXIS_DESCR COM_AXIS tmotmn_um temp_ub_q0p75_o48 8 -48.00 143.3 FORMAT "%5.1" AXIS_PTS_REF TMOV08_UM /end AXIS_DESCR
 /begin AXIS_DESCR COM_AXIS nmot_um nmot_ub_q40 8 0.00 10200. FORMAT "%5.0" AXIS_PTS_REF NMV08_UM /end AXIS_DESCR
/end CHARACTERISTIC
/begin CHARACTERISTIC KFDMT_UM_1 "" MAP 0x8FC229 GkfWUb 99.61 rel_ub_q0p3906 0.00 99.61 FORMAT "%5.2"
 /begin AXIS_DESCR COM_AXIS tmotmn_um temp_ub_q0p75_o48 8 -48.00 143.3 FORMAT "%5.1" AXIS_PTS_REF TMOV08_UM /end AXIS_DESCR
 /begin AXIS_DESCR COM_AXIS nmot_um nmot_ub_q40 8 0.00 10200. FORMAT "%5.0" AXIS_PTS_REF NMV08_UM /end AXIS_DESCR
/end CHARACTERISTIC
/begin CHARACTERISTIC KFDWSZ "" MAP 0x8E42D3 GkfWSb 191.3 zw_sb_q0p75 -96.00 95.25 FORMAT "%5.2"
 /begin AXIS_DESCR COM_AXIS nmot_w nmot_uw_q0p25 16 0.00 16383.75 FORMAT "%8.2" AXIS_PTS_REF SNM16ZUUW /end AXIS_DESCR
 /begin AXIS_DESCR COM_AXIS rl_w rel_uw_q0p0234 12 0.00 1535.977 FORMAT "%8.3" AXIS_PTS_REF SRL12ZUUW /end AXIS_DESCR
/end CHARACTERISTIC
/begin CHARACTERISTIC KFDWSZU "" MAP 0x8E4393 GkfWSb 191.3 zw_sb_q0p75 -96.00 95.25 FORMAT "%5.2"
 /begin AXIS_DESCR COM_AXIS nmot_w nmot_uw_q0p25 16 0.00 16383.75 FORMAT "%8.2" AXIS_PTS_REF SNM16ZUUW /end AXIS_DESCR
 /begin AXIS_DESCR COM_AXIS rl_w rel_uw_q0p0234 12 0.00 1535.977 FORMAT "%8.3" AXIS_PTS_REF SRL12ZUUW /end AXIS_DESCR
/end CHARACTERISTIC
/begin CHARACTERISTIC KFDZK "" MAP 0x8E4001 GkfWSb 191.3 zw_sb_q0p75 -96.00 95.25 FORMAT "%5.2"
 /begin AXIS_DESCR COM_AXIS nmot_w nmot_uw_q0p25 16 0.00 16383.75 FORMAT "%8.2" AXIS_PTS_REF SNM16ZUUW /end AXIS_DESCR
 /begin AXIS_DESCR COM_AXIS rl_w rel_uw_q0p0234 12 0.00 1535.977 FORMAT "%8.3" AXIS_PTS_REF SRL12ZUUW /end AXIS_DESCR
/end CHARACTERISTIC
/begin CHARACTERISTIC KFDZMNST "" MAP 0x8E3E86 GkfWSb 191.3 zw_sb_q0p75 -96.00 95.25 FORMAT "%5.2"
 /begin AXIS_DESCR COM_AXIS nmot nmot_ub_q40 4 0.00 10200. FORMAT "%5.0" AXIS_PTS_REF SNM04ZUUB /end AXIS_DESCR
 /begin AXIS_DESCR COM_AXIS dns nmotd_sb_q10 4 -1280. 1270. FORMAT "%5.0" AXIS_PTS_REF SNS04ZUSB /end AXIS_DESCR
/end CHARACTERISTIC
/begin CHARACTERISTIC KFDZWKG "" MAP 0x8E40C1 GkfWSb 191.3 zw_sb_q0p75 -96.00 95.25 FORMAT "%5.2"
 /begin AXIS_DESCR COM_AXIS nmot_w nmot_uw_q0p25 16 0.00 16383.75 FORMAT "%8.2" AXIS_PTS_REF SNM16ZUUW /end AXIS_DESCR
 /begin AXIS_DESCR COM_AXIS lambas_w fak_uw_b16 9 0.00 15.99976 FORMAT "%8.5" AXIS_PTS_REF SLA09OPUW /end AXIS_DESCR
/end CHARACTERISTIC
/begin CHARACTERISTIC KFETAMNMS "" MAP 0x8E3E96 GkfWUb 127.5 rel_ub_b127p5 0.00 127.5 FORMAT "%5.1"
 /begin AXIS_DESCR COM_AXIS nmot_w nmot_uw_q0p25 16 0.00 16383.75 FORMAT "%8.2" AXIS_PTS_REF SNM16OPUW /end AXIS_DESCR
 /begin AXIS_DESCR COM_AXIS rl_w rel_uw_q0p0234 11 0.00 1535.977 FORMAT "%8.3" AXIS_PTS_REF SRL11OPUW /end AXIS_DESCR
/end CHARACTERISTIC
/begin CHARACTERISTIC KFETANKH "" MAP 0x8E3D25 GkfWUb 127.5 rel_ub_b127p5 0.00 127.5 FORMAT "%5.1"
 /begin AXIS_DESCR COM_AXIS nmot_w nmot_uw_q0p25 16 0.00 16383.75 FORMAT "%8.2" AXIS_PTS_REF SNM16OPUW /end AXIS_DESCR
 /begin AXIS_DESCR COM_AXIS rl_w rel_uw_q0p0234 11 0.00 1535.977 FORMAT "%8.3" AXIS_PTS_REF SRL11OPUW /end AXIS_DESCR
/end CHARACTERISTIC
/begin CHARACTERISTIC KFETAZN "" MAP 0x8E3DD5 GkfWUb 127.5 rel_ub_b127p5 0.00 127.5 FORMAT "%5.1"
 /begin AXIS_DESCR COM_AXIS nmot_w nmot_uw_q0p25 16 0.00 16383.75 FORMAT "%8.2" AXIS_PTS_REF SNM16OPUW /end AXIS_DESCR
 /begin AXIS_DESCR COM_AXIS rl_w rel_uw_q0p0234 11 0.00 1535.977 FORMAT "%8.3" AXIS_PTS_REF SRL11OPUW /end AXIS_DESCR
/end CHARACTERISTIC
/begin CHARACTERISTIC KFFFANZ "" MAP 0x8E4845 KfAxUbAyUbSstxUbSstyUbWUb 255.0 dez 0.00 255.0 FORMAT "%5.1"
 /begin AXIS_DESCR STD_AXIS tmot temp_ub_q0p75_o48 8 -48.00 143.3 FORMAT "%5.1" DEPOSIT ABSOLUTE /end AXIS_DESCR
 /begin AXIS_DESCR STD_AXIS nmot nmot_ub_q40 5 0.00 10200. FORMAT "%5.0" DEPOSIT ABSOLUTE /end AXIS_DESCR
/end CHARACTERISTIC
/begin CHARACTERISTIC KFIVMXNWA "" MAP 0x8E3CA9 GkfWSb 996.1 kwgrad_q3p9 -500.0 496.1 FORMAT "%5.1"
 /begin AXIS_DESCR COM_AXIS nmot nmot_ub_q40 6 0.00 10200. FORMAT "%5.0" AXIS_PTS_REF SNM06NWUB /end AXIS_DESCR
 /begin AXIS_DESCR COM_AXIS toelzk_w temp_q0p0234_o273 8 -273.1500 1262.827 FORMAT "%8.3" AXIS_PTS_REF STO08NAUW /end AXIS_DESCR
/end CHARACTERISTIC
/begin CHARACTERISTIC KFIVMXNWE "" MAP 0x8E3BA8 GkfWSb 996.1 kwgrad_q3p9 -500.0 496.1 FORMAT "%5.1"
 /begin AXIS_DESCR COM_AXIS nmot nmot_ub_q40 6 0.00 10200. FORMAT "%5.0" AXIS_PTS_REF SNM06NWUB /end AXIS_DESCR
 /begin AXIS_DESCR COM_AXIS toelzk_w temp_q0p0234_o273 8 -273.1500 1262.827 FORMAT "%8.3" AXIS_PTS_REF STO08NEUW /end AXIS_DESCR
/end CHARACTERISTIC
/begin CHARACTERISTIC KFMI_UC "" MAP 0x8FC6EA GkfWUb 99.61 rel_ub_b99p6 0.00 99.61 FORMAT "%5.2"
 /begin AXIS_DESCR COM_AXIS rl_uc rel_ub_q0p75 8 0.00 191.3 FORMAT "%5.1" AXIS_PTS_REF MIST_RLV08_UC /end AXIS_DESCR
 /begin AXIS_DESCR COM_AXIS nmot_uc nmot_ub_q40 8 0.00 10200. FORMAT "%5.0" AXIS_PTS_REF MIST_NMV08_UC /end AXIS_DESCR
/end CHARACTERISTIC
/begin CHARACTERISTIC KFMMKH_UC "" MAP 0x8FC949 GkfWUb 99.61 rel_ub_q0p3906 0.00 99.61 FORMAT "%5.2"
 /begin AXIS_DESCR COM_AXIS tmotmn_uc temp_ub_q0p75_o48 8 -48.00 143.3 FORMAT "%5.1" AXIS_PTS_REF TMOV08_UC /end AXIS_DESCR
 /begin AXIS_DESCR COM_AXIS nmot_uc nmot_ub_q40 8 0.00 10200. FORMAT "%5.0" AXIS_PTS_REF MZUL_NMV08_UC /end AXIS_DESCR
/end CHARACTERISTIC
/begin CHARACTERISTIC KFMMKH_UM "" MAP 0x8FC269 GkfWUb 99.61 rel_ub_q0p3906 0.00 99.61 FORMAT "%5.2"
 /begin AXIS_DESCR COM_AXIS tmotmn_um temp_ub_q0p75_o48 8 -48.00 143.3 FORMAT "%5.1" AXIS_PTS_REF TMOV08_UM /end AXIS_DESCR
 /begin AXIS_DESCR COM_AXIS nmot_um nmot_ub_q40 8 0.00 10200. FORMAT "%5.0" AXIS_PTS_REF NMV08_UM /end AXIS_DESCR
/end CHARACTERISTIC
/begin CHARACTERISTIC KFMOF_UC "" MAP 0x8FC989 GkfWUb 99.61 rel_ub_q0p3906 0.00 99.61 FORMAT "%5.2"
 /begin AXIS_DESCR COM_AXIS mz_uc rel_ub_q0p3906 8 0.00 99.61 FORMAT "%5.2" AXIS_PTS_REF MDV08_UC /end AXIS_DESCR
 /begin AXIS_DESCR COM_AXIS nmot_uc nmot_ub_q40 8 0.00 10200. FORMAT "%5.0" AXIS_PTS_REF MZUL_NMV08_UC /end AXIS_DESCR
/end CHARACTERISTIC
/begin CHARACTERISTIC KFMOF_UM "" MAP 0x8FC2A9 GkfWUb 99.61 rel_ub_q0p3906 0.00 99.61 FORMAT "%5.2"
 /begin AXIS_DESCR COM_AXIS mz_um rel_ub_q0p3906 8 0.00 99.61 FORMAT "%5.2" AXIS_PTS_REF MDV08_UM /end AXIS_DESCR
 /begin AXIS_DESCR COM_AXIS nmot_um nmot_ub_q40 8 0.00 10200. FORMAT "%5.0" AXIS_PTS_REF NMV08_UM /end AXIS_DESCR
/end CHARACTERISTIC
/begin CHARACTERISTIC KFNWDA "" CURVE 0x8EFF0A GklWUw 3.999939 fak_uw_b4 0.00 3.999939 FORMAT "%8.6"
 /begin AXIS_DESCR COM_AXIS toelzk_w temp_q0p0234_o273 8 -273.1500 1262.827 FORMAT "%8.3" AXIS_PTS_REF STO08NAUW /end AXIS_DESCR
/end CHARACTERISTIC
/begin CHARACTERISTIC KFNWDE "" CURVE 0x8EFE20 GklWUw 3.999939 fak_uw_b4 0.00 3.999939 FORMAT "%8.6"
 /begin AXIS_DESCR COM_AXIS toelzk_w temp_q0p0234_o273 8 -273.1500 1262.827 FORMAT "%8.3" AXIS_PTS_REF STO08NEUW /end AXIS_DESCR
/end CHARACTERISTIC
/begin CHARACTERISTIC KFPZU_UC_0 "" MAP 0x8FC9C9 GkfWUb 99.61 rel_ub_q0p3906 0.00 99.61 FORMAT "%5.2"
 /begin AXIS_DESCR COM_AXIS spsn_uc spg_ub_q0p019 8 0.00 4.980 FORMAT "%5.3" AXIS_PTS_REF MZUL_SPSNV08_UC /end AXIS_DESCR
 /begin AXIS_DESCR COM_AXIS nmot_uc nmot_ub_q40 8 0.00 10200. FORMAT "%5.0" AXIS_PTS_REF MZUL_NMV08_UC /end AXIS_DESCR
/end CHARACTERISTIC
/begin CHARACTERISTIC KFPZU_UC_1 "" MAP 0x8FCA09 GkfWUb 99.61 rel_ub_q0p3906 0.00 99.61 FORMAT "%5.2"
 /begin AXIS_DESCR COM_AXIS spsn_uc spg_ub_q0p019 8 0.00 4.980 FORMAT "%5.3" AXIS_PTS_REF MZUL_SPSNV08_UC /end AXIS_DESCR
 /begin AXIS_DESCR COM_AXIS nmot_uc nmot_ub_q40 8 0.00 10200. FORMAT "%5.0" AXIS_PTS_REF MZUL_NMV08_UC /end AXIS_DESCR
/end CHARACTERISTIC
/begin CHARACTERISTIC KFPZU_UM_0 "" MAP 0x8FC2E9 GkfWUb 99.61 rel_ub_q0p3906 0.00 99.61 FORMAT "%5.2"
 /begin AXIS_DESCR COM_AXIS spsn_um spg_ub_q0p019 8 0.00 4.980 FORMAT "%5.3" AXIS_PTS_REF SPSNV08_UM /end AXIS_DESCR
 /begin AXIS_DESCR COM_AXIS nmot_um nmot_ub_q40 8 0.00 10200. FORMAT "%5.0" AXIS_PTS_REF NMV08_UM /end AXIS_DESCR
/end CHARACTERISTIC
/begin CHARACTERISTIC KFPZU_UM_1 "" MAP 0x8FC329 GkfWUb 99.61 rel_ub_q0p3906 0.00 99.61 FORMAT "%5.2"
 /begin AXIS_DESCR COM_AXIS spsn_um spg_ub_q0p019 8 0.00 4.980 FORMAT "%5.3" AXIS_PTS_REF SPSNV08_UM /end AXIS_DESCR
 /begin AXIS_DESCR COM_AXIS nmot_um nmot_ub_q40 8 0.00 10200. FORMAT "%5.0" AXIS_PTS_REF NMV08_UM /end AXIS_DESCR
/end CHARACTERISTIC
/begin CHARACTERISTIC KFRLIP_UM "" MAP 0x8FC01E KfAxUbAyUbSstxUbSstyUbWUb 191.3 rel_ub_q0p75 0.00 191.3 FORMAT "%5.1"
 /begin AXIS_DESCR STD_AXIS ipsn_um spg_ub_q0p019 8 0.00 4.980 FORMAT "%5.3" DEPOSIT ABSOLUTE /end AXIS_DESCR
 /begin AXIS_DESCR STD_AXIS nmot_um nmot_ub_q40 8 0.00 10200. FORMAT "%5.0" DEPOSIT ABSOLUTE /end AXIS_DESCR
/end CHARACTERISTIC
/begin CHARACTERISTIC KFSWKFZK "" MAP 0x8E4151 GkfWUb 191.3 zw_ub_qn0p75 -191.3 0.00 FORMAT "%5.1"
 /begin AXIS_DESCR COM_AXIS nmot_w nmot_uw_q0p25 16 0.00 16383.75 FORMAT "%8.2" AXIS_PTS_REF SNM16ZUUW /end AXIS_DESCR
 /begin AXIS_DESCR COM_AXIS rl_w rel_uw_q0p0234 12 0.00 1535.977 FORMAT "%8.3" AXIS_PTS_REF SRL12ZUUW /end AXIS_DESCR
/end CHARACTERISTIC
/begin CHARACTERISTIC KFSWKFZKR "" MAP 0x8E4211 GkfWUb 191.3 zw_ub_qn0p75 -191.3 0.00 FORMAT "%5.1"
 /begin AXIS_DESCR COM_AXIS nmot_w nmot_uw_q0p25 16 0.00 16383.75 FORMAT "%8.2" AXIS_PTS_REF SNM16ZUUW /end AXIS_DESCR
 /begin AXIS_DESCR COM_AXIS rl_w rel_uw_q0p0234 12 0.00 1535.977 FORMAT "%8.3" AXIS_PTS_REF SRL12ZUUW /end AXIS_DESCR
/end CHARACTERISTIC
/begin CHARACTERISTIC KFSZDUB "" MAP 0x8E487C KfAxUbAyUbSstxUbSstyUbWUb 7.969 fak_ub_b8 0.00 7.969 FORMAT "%5.3"
 /begin AXIS_DESCR STD_AXIS uzue spg_ubatt 7 0.00 17.95 FORMAT "%5.2" DEPOSIT ABSOLUTE /end AXIS_DESCR
 /begin AXIS_DESCR STD_AXIS tsrldyn txms_ub_q0p1 16 0.00 25.50 FORMAT "%5.2" DEPOSIT ABSOLUTE /end AXIS_DESCR
/end CHARACTERISTIC
/begin CHARACTERISTIC KFSZT "" MAP 0x8E4905 KfAxUbAyUbSstxUbSstyUbWUb 25.50 txms_ub_q0p1 0.00 25.50 FORMAT "%5.2"
 /begin AXIS_DESCR STD_AXIS ub spg_ubatt_sy 8 0.00 17.93 FORMAT "%5.2" DEPOSIT ABSOLUTE /end AXIS_DESCR
 /begin AXIS_DESCR STD_AXIS nmot nmot_ub_q40 8 0.00 10200. FORMAT "%5.0" DEPOSIT ABSOLUTE /end AXIS_DESCR
/end CHARACTERISTIC
/begin CHARACTERISTIC KFTSDYN "" MAP 0x8F1078 KfAxUbAyUbSstxSwSstyUbWUw 7.999878 fak_uw_b8 0.00 7.999878 FORMAT "%8.6"
 /begin AXIS_DESCR STD_AXIS ngfil_w nmotg_sw_q0p39 3 -12800.16 12799.77 FORMAT "%8.2" DEPOSIT ABSOLUTE /end AXIS_DESCR
 /begin AXIS_DESCR STD_AXIS nmot nmot_ub_q40 8 0.00 10200. FORMAT "%5.0" DEPOSIT ABSOLUTE /end AXIS_DESCR
/end CHARACTERISTIC
/begin CHARACTERISTIC KFTSRL "" MAP 0x8E4957 KfAxUbAyUbSstxUbSstyUbWUb 25.50 txms_ub_q0p1 0.00 25.50 FORMAT "%5.2"
 /begin AXIS_DESCR STD_AXIS nmot nmot_ub_q40 9 0.00 10200. FORMAT "%5.0" DEPOSIT ABSOLUTE /end AXIS_DESCR
 /begin AXIS_DESCR STD_AXIS rl rel_ub_q0p75 10 0.00 191.3 FORMAT "%5.1" DEPOSIT ABSOLUTE /end AXIS_DESCR
/end CHARACTERISTIC
/begin CHARACTERISTIC KFWDKSST "" MAP 0x8E1632 KfAxUbAyUbSstxUbSstyUbWUb 100.0 relDK_ub_b100 0.00 100.0 FORMAT "%5.1"
 /begin AXIS_DESCR STD_AXIS tmst temp_ub_q0p75_o48 12 -48.00 143.3 FORMAT "%5.1" DEPOSIT ABSOLUTE /end AXIS_DESCR
 /begin AXIS_DESCR STD_AXIS nmot nmot_ub_q40 4 0.00 10200. FORMAT "%5.0" DEPOSIT ABSOLUTE /end AXIS_DESCR
/end CHARACTERISTIC
/begin CHARACTERISTIC KFWDKTHO "" MAP 0x8EA1B6 KfAxUbAyUbSstxUbSstyUwWUw 100.0000 relDK_uw_b100 0.00 100.0000 FORMAT "%8.4"
 /begin AXIS_DESCR STD_AXIS tmst temp_ub_q0p75_o48 12 -48.00 143.3 FORMAT "%5.1" DEPOSIT ABSOLUTE /end AXIS_DESCR
 /begin AXIS_DESCR STD_AXIS fho fak_ub_b4 4 0.00 3.984 FORMAT "%5.3" DEPOSIT ABSOLUTE /end AXIS_DESCR
/end CHARACTERISTIC
/begin CHARACTERISTIC KFZW "" MAP 0x8E4453 GkfWSb 191.3 zw_sb_q0p75 -96.00 95.25 FORMAT "%5.2"
 /begin AXIS_DESCR COM_AXIS nmot_w nmot_uw_q0p25 16 0.00 16383.75 FORMAT "%8.2" AXIS_PTS_REF SNM16ZUUW /end AXIS_DESCR
 /begin AXIS_DESCR COM_AXIS rl_w rel_uw_q0p0234 12 0.00 1535.977 FORMAT "%8.3" AXIS_PTS_REF SRL12ZUUW /end AXIS_DESCR
/end CHARACTERISTIC
/begin CHARACTERISTIC KFZW2 "" MAP 0x8E4513 GkfWSb 191.3 zw_sb_q0p75 -96.00 95.25 FORMAT "%5.2"
 /begin AXIS_DESCR COM_AXIS nmot_w nmot_uw_q0p25 16 0.00 16383.75 FORMAT "%8.2" AXIS_PTS_REF SNM16ZUUW /end AXIS_DESCR
 /begin AXIS_DESCR COM_AXIS rl_w rel_uw_q0p0234 12 0.00 1535.977 FORMAT "%8.3" AXIS_PTS_REF SRL12ZUUW /end AXIS_DESCR
/end CHARACTERISTIC
/begin CHARACTERISTIC KFZWA "" MAP 0x8E45D3 GkfWSb 191.3 zw_sb_q0p75 -96.00 95.25 FORMAT "%5.2"
 /begin AXIS_DESCR COM_AXIS nmot_w nmot_uw_q0p25 16 0.00 16383.75 FORMAT "%8.2" AXIS_PTS_REF SNM16ZUUW /end AXIS_DESCR
 /begin AXIS_DESCR COM_AXIS rl_w rel_uw_q0p0234 12 0.00 1535.977 FORMAT "%8.3" AXIS_PTS_REF SRL12ZUUW /end AXIS_DESCR
/end CHARACTERISTIC
/begin CHARACTERISTIC KFZWA2 "" MAP 0x8E4693 GkfWSb 191.3 zw_sb_q0p75 -96.00 95.25 FORMAT "%5.2"
 /begin AXIS_DESCR COM_AXIS nmot_w nmot_uw_q0p25 16 0.00 16383.75 FORMAT "%8.2" AXIS_PTS_REF SNM16ZUUW /end AXIS_DESCR
 /begin AXIS_DESCR COM_AXIS rl_w rel_uw_q0p0234 12 0.00 1535.977 FORMAT "%8.3" AXIS_PTS_REF SRL12ZUUW /end AXIS_DESCR
/end CHARACTERISTIC
/begin CHARACTERISTIC KFZWSTTM "" MAP 0x8F102A KfAxUbAyUbSstxUbSstyUbWSb 191.3 zw_sb_q0p75 -96.00 95.25 FORMAT "%5.2"
 /begin AXIS_DESCR STD_AXIS nmot nmot_ub_q40 6 0.00 10200. FORMAT "%5.0" DEPOSIT ABSOLUTE /end AXIS_DESCR
 /begin AXIS_DESCR STD_AXIS tmst temp_ub_q0p75_o48 6 -48.00 143.3 FORMAT "%5.1" DEPOSIT ABSOLUTE /end AXIS_DESCR
/end CHARACTERISTIC
/begin CHARACTERISTIC KFZWWLNM "" MAP 0x8E479B GkfWSb 191.3 zw_sb_q0p75 -96.00 95.25 FORMAT "%5.2"
 /begin AXIS_DESCR COM_AXIS nmot nmot_ub_q40 12 0.00 10200. FORMAT "%5.0" AXIS_PTS_REF SNM12ESUB /end AXIS_DESCR
 /begin AXIS_DESCR COM_AXIS tans temp_ub_q0p75_o48 12 -48.00 143.3 FORMAT "%5.1" AXIS_PTS_REF STA12WLUB /end AXIS_DESCR
/end CHARACTERISTIC
/begin CHARACTERISTIC KFZWWLRL "" MAP 0x8F0F4E KfAxUbAyUbSstxUbSstyUbWSb 191.3 zw_sb_q0p75 -96.00 95.25 FORMAT "%5.2"
 /begin AXIS_DESCR STD_AXIS tmot temp_ub_q0p75_o48 16 -48.00 143.3 FORMAT "%5.1" DEPOSIT ABSOLUTE /end AXIS_DESCR
 /begin AXIS_DESCR STD_AXIS rl rel_ub_q0p75 11 0.00 191.3 FORMAT "%5.1" DEPOSIT ABSOLUTE /end AXIS_DESCR
/end CHARACTERISTIC
/begin CHARACTERISTIC KFZW_UC "" MAP 0x8FC72A GkfWSb 191.3 zw_sb_q0p75 -96.00 95.25 FORMAT "%5.2"
 /begin AXIS_DESCR COM_AXIS rl_uc rel_ub_q0p75 8 0.00 191.3 FORMAT "%5.1" AXIS_PTS_REF MIST_RLV08_UC /end AXIS_DESCR
 /begin AXIS_DESCR COM_AXIS nmot_uc nmot_ub_q40 8 0.00 10200. FORMAT "%5.0" AXIS_PTS_REF MIST_NMV08_UC /end AXIS_DESCR
/end CHARACTERISTIC
/begin CHARACTERISTIC KIVMXG "" CURVE 0x8EBF40 FklWUw 499.984741 rel_q0p007629 0.00762939453 499.992371
 /begin AXIS_DESCR FIX_AXIS gangi dez 8 0.00 7.000 FORMAT "%5.3" FIX_AXIS_PAR 0 0 8 /end AXIS_DESCR
/end CHARACTERISTIC
/begin CHARACTERISTIC KLDZWOM_UC "" CURVE 0x8FC76A KlAUbSstUbWUb 191.3 zw_ub_q0p75 0.00 191.3 FORMAT "%5.1"
 /begin AXIS_DESCR STD_AXIS tmnist_uc temp_ub_q0p75_o48 8 -48.00 143.3 FORMAT "%5.1" DEPOSIT ABSOLUTE /end AXIS_DESCR
/end CHARACTERISTIC
/begin CHARACTERISTIC KLETAZW_UC "" CURVE 0x8FC77B KlAUbSstUbWUb 100.0 rel_ub_b127p5 0.00 100.0 FORMAT "%5.1"
 /begin AXIS_DESCR STD_AXIS dzw_uc zw_ub_q0p75 8 0.00 191.3 FORMAT "%5.1" DEPOSIT ABSOLUTE /end AXIS_DESCR
/end CHARACTERISTIC
/begin CHARACTERISTIC KLFAKSP_UC "" CURVE 0x8FC78C GklWUb 100.0 rel_ub_b127p5 0.00 100.0 FORMAT "%5.1"
 /begin AXIS_DESCR COM_AXIS nmot_uc nmot_ub_q40 8 0.00 10200. FORMAT "%5.0" AXIS_PTS_REF MIST_NMV08_UC /end AXIS_DESCR
/end CHARACTERISTIC
/begin CHARACTERISTIC KLFNWPA "" CURVE 0x8E3CD9 GklWSb 49.80 relKW_q0p195 -25.00 24.80 FORMAT "%5.2"
 /begin AXIS_DESCR COM_AXIS toelzk_w temp_q0p0234_o273 8 -273.1500 1262.827 FORMAT "%8.3" AXIS_PTS_REF STO08NAUW /end AXIS_DESCR
/end CHARACTERISTIC
/begin CHARACTERISTIC KLFNWPE "" CURVE 0x8E3BD8 GklWSb 49.80 relKW_q0p195 -25.00 24.80 FORMAT "%5.2"
 /begin AXIS_DESCR COM_AXIS toelzk_w temp_q0p0234_o273 8 -273.1500 1262.827 FORMAT "%8.3" AXIS_PTS_REF STO08NEUW /end AXIS_DESCR
/end CHARACTERISTIC
/begin CHARACTERISTIC KLFZWMNKH "" CURVE 0x8F0F1C GklWUw 655.34999985 zk10msxs_uw_b655 0.010000152590 655.36000000 FORMAT "%12.8"
 /begin AXIS_DESCR COM_AXIS tmot temp_ub_q0p75_o48 8 -48.00 143.3 FORMAT "%5.1" AXIS_PTS_REF STM08__UB /end AXIS_DESCR
/end CHARACTERISTIC
/begin CHARACTERISTIC KLFZWMNST "" CURVE 0x8F0F2C GklWUw 655.34999985 zk10msxs_uw_b655 0.010000152590 655.36000000 FORMAT "%12.8"
 /begin AXIS_DESCR COM_AXIS tmot temp_ub_q0p75_o48 8 -48.00 143.3 FORMAT "%5.1" AXIS_PTS_REF STM08__UB /end AXIS_DESCR
/end CHARACTERISTIC
/begin CHARACTERISTIC KLLLRZU_UC "" CURVE 0x8FCA49 GklWUb 99.61 rel_ub_q0p3906 0.00 99.61 FORMAT "%5.2"
 /begin AXIS_DESCR COM_AXIS nmot_uc nmot_ub_q40 8 0.00 10200. FORMAT "%5.0" AXIS_PTS_REF MZUL_NMV08_UC /end AXIS_DESCR
/end CHARACTERISTIC
/begin CHARACTERISTIC KLLLRZU_UM "" CURVE 0x8FC369 GklWUb 99.61 rel_ub_q0p3906 0.00 99.61 FORMAT "%5.2"
 /begin AXIS_DESCR COM_AXIS nmot_um nmot_ub_q40 8 0.00 10200. FORMAT "%5.0" AXIS_PTS_REF NMV08_UM /end AXIS_DESCR
/end CHARACTERISTIC
/begin CHARACTERISTIC KLMIMAX_UC "" CURVE 0x8FCA51 GklWUb 99.61 rel_ub_q0p3906 0.00 99.61 FORMAT "%5.2"
 /begin AXIS_DESCR COM_AXIS nmot_uc nmot_ub_q40 8 0.00 10200. FORMAT "%5.0" AXIS_PTS_REF MZUL_NMV08_UC /end AXIS_DESCR
/end CHARACTERISTIC
/begin CHARACTERISTIC KLMIMAX_UM "" CURVE 0x8FC371 GklWUb 99.61 rel_ub_q0p3906 0.00 99.61 FORMAT "%5.2"
 /begin AXIS_DESCR COM_AXIS nmot_um nmot_ub_q40 8 0.00 10200. FORMAT "%5.0" AXIS_PTS_REF NMV08_UM /end AXIS_DESCR
/end CHARACTERISTIC
/begin CHARACTERISTIC KLMIMIN_UC "" CURVE 0x8FCA59 GklWUb 99.61 rel_ub_q0p3906 0.00 99.61 FORMAT "%5.2"
 /begin AXIS_DESCR COM_AXIS nmot_uc nmot_ub_q40 8 0.00 10200. FORMAT "%5.0" AXIS_PTS_REF MZUL_NMV08_UC /end AXIS_DESCR
/end CHARACTERISTIC
/begin CHARACTERISTIC KLMIMIN_UM "" CURVE 0x8FC379 GklWUb 99.61 rel_ub_q0p3906 0.00 99.61 FORMAT "%5.2"
 /begin AXIS_DESCR COM_AXIS nmot_um nmot_ub_q40 8 0.00 10200. FORMAT "%5.0" AXIS_PTS_REF NMV08_UM /end AXIS_DESCR
/end CHARACTERISTIC
/begin CHARACTERISTIC KLMZUMN_UC "" CURVE 0x8FCA61 GklWUb 99.61 rel_ub_q0p3906 0.00 99.61 FORMAT "%5.2"
 /begin AXIS_DESCR COM_AXIS nmot_uc nmot_ub_q40 8 0.00 10200. FORMAT "%5.0" AXIS_PTS_REF MZUL_NMV08_UC /end AXIS_DESCR
/end CHARACTERISTIC
/begin CHARACTERISTIC KLMZUMN_UM "" CURVE 0x8FC381 GklWUb 99.61 rel_ub_q0p3906 0.00 99.61 FORMAT "%5.2"
 /begin AXIS_DESCR COM_AXIS nmot_um nmot_ub_q40 8 0.00 10200. FORMAT "%5.0" AXIS_PTS_REF NMV08_UM /end AXIS_DESCR
/end CHARACTERISTIC
/begin CHARACTERISTIC KLNPED_UC "" CURVE 0x8FCC42 KlAUbSstUbWUb 10200. nmot_ub_q40 0.00 10200. FORMAT "%5.0"
 /begin AXIS_DESCR STD_AXIS spsn_uc spg_ub_q0p019 8 0.00 4.980 FORMAT "%5.3" DEPOSIT ABSOLUTE /end AXIS_DESCR
/end CHARACTERISTIC
/begin CHARACTERISTIC KLNPED_UM "" CURVE 0x8FC3A0 KlAUbSstUbWUb 10200. nmot_ub_q40 0.00 10200. FORMAT "%5.0"
 /begin AXIS_DESCR STD_AXIS spsn_um spg_ub_q0p019 8 0.00 4.980 FORMAT "%5.3" DEPOSIT ABSOLUTE /end AXIS_DESCR
/end CHARACTERISTIC
/begin CHARACTERISTIC KLWDKABST "" CURVE 0x8EA22C KlAUwSstUwWUw 1.999969 fak_uw_b2 0.00 1.999969 FORMAT "%8.6"
 /begin AXIS_DESCR STD_AXIS tabst_w t1sxs_uw_q1 4 0.00 65535.00 FORMAT "%8.2" DEPOSIT ABSOLUTE /end AXIS_DESCR
/end CHARACTERISTIC
/begin CHARACTERISTIC KLWDKPED "" CURVE 0x8E1674 KlAUbSstUbWUb 100.0 relDK_ub_b100 0.00 100.0 FORMAT "%5.1"
 /begin AXIS_DESCR STD_AXIS wped relPED_ub_b100 3 0.00 100.0 FORMAT "%5.1" DEPOSIT ABSOLUTE /end AXIS_DESCR
/end CHARACTERISTIC
/begin CHARACTERISTIC KLWDKTAN "" CURVE 0x8E161C KlAUbSstUbWUb 7.969 fak_ub_b8 0.00 7.969 FORMAT "%5.3"
 /begin AXIS_DESCR STD_AXIS tans temp_ub_q0p75_o48 4 -48.00 143.3 FORMAT "%5.1" DEPOSIT ABSOLUTE /end AXIS_DESCR
/end CHARACTERISTIC
/begin CHARACTERISTIC KLWNWSLRA "" CURVE 0x8E3D02 KlAUbSstUbWUb 127.5 kw_ub_q0p5 0.00 127.5 FORMAT "%5.1"
 /begin AXIS_DESCR STD_AXIS wnwass kw_ub_q0p5 6 0.00 127.5 FORMAT "%5.1" DEPOSIT ABSOLUTE /end AXIS_DESCR
/end CHARACTERISTIC
/begin CHARACTERISTIC KLWNWSLRE "" CURVE 0x8E3C01 KlAUbSstUbWUb 127.5 kw_ub_q0p5 0.00 127.5 FORMAT "%5.1"
 /begin AXIS_DESCR STD_AXIS wnweos kw_ub_q0p5 6 0.00 127.5 FORMAT "%5.1" DEPOSIT ABSOLUTE /end AXIS_DESCR
/end CHARACTERISTIC
/begin CHARACTERISTIC KLWSNWA "" CURVE 0x8EFEEA GklWSw 255.9961 kw_q0p0039 -128.0000 127.9961 FORMAT "%8.4"
 /begin AXIS_DESCR COM_AXIS toelzk_w temp_q0p0234_o273 8 -273.1500 1262.827 FORMAT "%8.3" AXIS_PTS_REF STO08NAUW /end AXIS_DESCR
/end CHARACTERISTIC
/begin CHARACTERISTIC KLWSNWE "" CURVE 0x8EFE00 GklWSw 255.9961 kw_sw_b128 -128.0000 127.9961 FORMAT "%8.4"
 /begin AXIS_DESCR COM_AXIS toelzk_w temp_q0p0234_o273 8 -273.1500 1262.827 FORMAT "%8.3" AXIS_PTS_REF STO08NEUW /end AXIS_DESCR
/end CHARACTERISTIC
/begin CHARACTERISTIC KLWSRNWA "" CURVE 0x8EFEFA GklWSw 255.9961 kw_q0p0039 -128.0000 127.9961 FORMAT "%8.4"
 /begin AXIS_DESCR COM_AXIS toelzk_w temp_q0p0234_o273 8 -273.1500 1262.827 FORMAT "%8.3" AXIS_PTS_REF STO08NAUW /end AXIS_DESCR
/end CHARACTERISTIC
/begin CHARACTERISTIC KLWSRNWE "" CURVE 0x8EFE10 GklWSw 255.9961 kw_sw_b128 -128.0000 127.9961 FORMAT "%8.4"
 /begin AXIS_DESCR COM_AXIS toelzk_w temp_q0p0234_o273 8 -273.1500 1262.827 FORMAT "%8.3" AXIS_PTS_REF STO08NEUW /end AXIS_DESCR
/end CHARACTERISTIC
/begin CHARACTERISTIC KLZL1_UC "" CURVE 0x8FC794 KlAUbSstUbWUb 191.3 zw_ub_q0p75 0.00 191.3 FORMAT "%5.1"
 /begin AXIS_DESCR STD_AXIS lamb1_uc rel_ub_q0p03125 8 0.00 7.969 FORMAT "%5.3" DEPOSIT ABSOLUTE /end AXIS_DESCR
/end CHARACTERISTIC
/begin CHARACTERISTIC KLZL2_UC "" CURVE 0x8FC7A5 KlAUbSstUbWUb 191.3 zw_ub_q0p75 0.00 191.3 FORMAT "%5.1"
 /begin AXIS_DESCR STD_AXIS lamb2_uc rel_ub_q0p03125 8 0.00 7.969 FORMAT "%5.3" DEPOSIT ABSOLUTE /end AXIS_DESCR
/end CHARACTERISTIC
/begin CHARACTERISTIC KNWBNA "" VALUE 0x8FD2A0 KwUb 3.984 fak_ub_b4 0.00 3.984 FORMAT "%5.3" /end CHARACTERISTIC
/begin CHARACTERISTIC KNWBNE "" VALUE 0x8FD291 KwUb 3.984 fak_ub_b4 0.00 3.984 FORMAT "%5.3" /end CHARACTERISTIC
/begin CHARACTERISTIC KNWBPA "" VALUE 0x8FD2A1 KwUb 3.984 fak_ub_b4 0.00 3.984 FORMAT "%5.3" /end CHARACTERISTIC
/begin CHARACTERISTIC KNWBPE "" VALUE 0x8FD292 KwUb 3.984 fak_ub_b4 0.00 3.984 FORMAT "%5.3" /end CHARACTERISTIC
/begin CHARACTERISTIC KNWVTKA "" CURVE 0x8E3CE1 KlAUbSstUbWUb 1.992 fak_ub_b2 0.00 1.992 FORMAT "%5.3"
 /begin AXIS_DESCR STD_AXIS tnwvtka temp_ub_q0p75_o48 8 -48.00 143.3 FORMAT "%5.1" DEPOSIT ABSOLUTE /end AXIS_DESCR
/end CHARACTERISTIC
/begin CHARACTERISTIC KNWVTKE "" CURVE 0x8E3BE0 KlAUbSstUbWUb 1.992 fak_ub_b2 0.00 1.992 FORMAT "%5.3"
 /begin AXIS_DESCR STD_AXIS tnwvtke temp_ub_q0p75_o48 8 -48.00 143.3 FORMAT "%5.1" DEPOSIT ABSOLUTE /end AXIS_DESCR
/end CHARACTERISTIC
/begin CHARACTERISTIC KPVMXG "" CURVE 0x8E348E FklWUb 99.70 rel_ub_q0p391 0.00 99.70 FORMAT "%5.2"
 /begin AXIS_DESCR FIX_AXIS gangi dez 8 0.00 7.000 FORMAT "%5.3" FIX_AXIS_PAR 0 0 8 /end AXIS_DESCR
/end CHARACTERISTIC
/begin CHARACTERISTIC KTNWDA "" CURVE 0x8EFF1A GklWUw 0.9999847 fak_uw_b1 0.00 0.9999847 FORMAT "%9.7"
 /begin AXIS_DESCR COM_AXIS toelzk_w temp_q0p0234_o273 8 -273.1500 1262.827 FORMAT "%8.3" AXIS_PTS_REF STO08NAUW /end AXIS_DESCR
/end CHARACTERISTIC
/begin CHARACTERISTIC KTNWDE "" CURVE 0x8EFE30 GklWUw 0.9999847 fak_uw_b1 0.00 0.9999847 FORMAT "%9.7"
 /begin AXIS_DESCR COM_AXIS toelzk_w temp_q0p0234_o273 8 -273.1500 1262.827 FORMAT "%8.3" AXIS_PTS_REF STO08NEUW /end AXIS_DESCR
/end CHARACTERISTIC
/begin CHARACTERISTIC KZNWVNA "" CURVE 0x8E3CF2 GklWUb 1275. t5msxms_q5 0.00 1275. FORMAT "%5.0"
 /begin AXIS_DESCR COM_AXIS toelzk_w temp_q0p0234_o273 8 -273.1500 1262.827 FORMAT "%8.3" AXIS_PTS_REF STO08NAUW /end AXIS_DESCR
/end CHARACTERISTIC
/begin CHARACTERISTIC KZNWVNE "" CURVE 0x8E3BF1 GklWUb 1275. t5msxms_q5 0.00 1275. FORMAT "%5.0"
 /begin AXIS_DESCR COM_AXIS toelzk_w temp_q0p0234_o273 8 -273.1500 1262.827 FORMAT "%8.3" AXIS_PTS_REF STO08NEUW /end AXIS_DESCR
/end CHARACTERISTIC
/begin CHARACTERISTIC KZNWVPA "" CURVE 0x8E3CFA GklWUb 1275. t5msxms_q5 0.00 1275. FORMAT "%5.0"
 /begin AXIS_DESCR COM_AXIS toelzk_w temp_q0p0234_o273 8 -273.1500 1262.827 FORMAT "%8.3" AXIS_PTS_REF STO08NAUW /end AXIS_DESCR
/end CHARACTERISTIC
/begin CHARACTERISTIC KZNWVPE "" CURVE 0x8E3BF9 GklWUb 1275. t5msxms_q5 0.00 1275. FORMAT "%5.0"
 /begin AXIS_DESCR COM_AXIS toelzk_w temp_q0p0234_o273 8 -273.1500 1262.827 FORMAT "%8.3" AXIS_PTS_REF STO08NEUW /end AXIS_DESCR
/end CHARACTERISTIC
/begin AXIS_PTS MDV08_UC "" 0x8FCA69 mz_uc SstAUbSstUb 99.61 rel_ub_q0p3906 8 0.00 99.61 FORMAT "%5.2" DEPOSIT ABSOLUTE /end AXIS_PTS
/begin AXIS_PTS MDV08_UM "" 0x8FC389 mz_um SstAUbSstUb 99.61 rel_ub_q0p3906 8 0.00 99.61 FORMAT "%5.2" DEPOSIT ABSOLUTE /end AXIS_PTS
/begin CHARACTERISTIC MIST_FRKSCH_DAT_UC "" VAL_BLK 0x8FC7B6 KwbUb 0.9961 rel_ub_b1p0 0.00 0.9961 NUMBER 16 /end CHARACTERISTIC
/begin CHARACTERISTIC MIST_LAMB1_DAT_UC "" VAL_BLK 0x8FC7C6 KwbUb 191.3 zw_sb_q0p75 0.00 191.3 FORMAT "%5.1" NUMBER 16 /end CHARACTERISTIC
/begin CHARACTERISTIC MIST_LAMB2_DAT_UC "" VAL_BLK 0x8FC7D6 KwbUb 191.3 zw_sb_q0p75 0.00 191.3 FORMAT "%5.1" NUMBER 16 /end CHARACTERISTIC
/begin CHARACTERISTIC MIST_NMOT_DAT_UC "" VAL_BLK 0x8FC7E6 KwbUb 10200. nmot_ub_q40 0.00 10200. FORMAT "%5.0" NUMBER 16 /end CHARACTERISTIC
/begin AXIS_PTS MIST_NMV08_UC "" 0x8FC7F6 nmot_uc SstAUbSstUb 10200. nmot_ub_q40 8 0.00 10200. FORMAT "%5.0" DEPOSIT ABSOLUTE /end AXIS_PTS
/begin CHARACTERISTIC MIST_NSC_DAT_UC "" VAL_BLK 0x8FD6DA KwbUw 2621.400 t40msxs_uw_q0p04 0.00 2621.400 FORMAT "%8.3" NUMBER 16 /end CHARACTERISTIC
/begin AXIS_PTS MIST_RLV08_UC "" 0x8FC7FF rl_uc SstAUbSstUb 191.3 rel_ub_q0p75 8 0.00 191.3 FORMAT "%5.1" DEPOSIT ABSOLUTE /end AXIS_PTS
/begin CHARACTERISTIC MIST_RL_DAT_UC "" VAL_BLK 0x8FC808 KwbUb 191.3 rel_ub_q0p75 0.00 191.3 FORMAT "%5.1" NUMBER 16 /end CHARACTERISTIC
/begin CHARACTERISTIC MIST_TMOT_DAT_UC "" VAL_BLK 0x8FC818 KwbUb 191.3 temp_ub_q0p75_o48 -48.00 143.3 FORMAT "%5.1" NUMBER 16 /end CHARACTERISTIC
/begin CHARACTERISTIC MIST_ZW1_DAT_UC "" VAL_BLK 0x8FC828 KwbUb 191.3 zw_sb_q0p75 0.00 191.3 FORMAT "%5.1" NUMBER 16 /end CHARACTERISTIC
/begin CHARACTERISTIC MIST_ZW2_DAT_UC "" VAL_BLK 0x8FC838 KwbUb 191.3 zw_sb_q0p75 0.00 191.3 FORMAT "%5.1" NUMBER 16 /end CHARACTERISTIC
/begin CHARACTERISTIC MSGSMX_UC "" VALUE 0x8FD614 KwUw 10239.84 mdt_q0p15625_Nms 0.00 10239.84 FORMAT "%8.2" /end CHARACTERISTIC
/begin CHARACTERISTIC MSGSMX_UM "" VALUE 0x8FC3C6 KwUw 10239.84 mdt_q0p15625_Nms 0.00 10239.84 FORMAT "%8.2" /end CHARACTERISTIC
/begin CHARACTERISTIC MSRC_BMSR_DAT_UC "" VAL_BLK 0x8FC638 KwbUb 255.0 dez 0.00 255.0 FORMAT "%5.1" READ_ONLY NUMBER 16 /end CHARACTERISTIC
/begin CHARACTERISTIC MSRC_BZMSRA_DAT_UC "" VAL_BLK 0x8FC648 KwbUb 255.0 dez 0.00 255.0 FORMAT "%5.1" READ_ONLY NUMBER 16 /end CHARACTERISTIC
/begin CHARACTERISTIC MSRC_BZMSRC_DAT_UC "" VAL_BLK 0x8FC658 KwbUb 10200.0 t40ms_ub_b10200 0.00 10200.0 FORMAT "%7.1" READ_ONLY NUMBER 16 /end CHARACTERISTIC
/begin CHARACTERISTIC MSRC_BZMSR_DAT_UC "" VAL_BLK 0x8FC668 KwbUb 255.0 dez 0.00 255.0 FORMAT "%5.1" READ_ONLY NUMBER 16 /end CHARACTERISTIC
/begin CHARACTERISTIC MSRC_C_DAT_UC "" VAL_BLK 0x8FC678 KwbUb 10200.0 t40ms_ub_b10200 0.00 10200.0 FORMAT "%7.1" READ_ONLY NUMBER 16 /end CHARACTERISTIC
/begin CHARACTERISTIC MSRC_DBMSRC_DAT_UC "" VAL_BLK 0x8FC688 KwbUb 10200.0 t40ms_ub_b10200 0.00 10200.0 FORMAT "%7.1" READ_ONLY NUMBER 16 /end CHARACTERISTIC
/begin CHARACTERISTIC MSRC_MDASRL_DAT_UC "" VAL_BLK 0x8FC698 KwbUb 99.61 rel_ub_q0p3906 0.00 99.61 FORMAT "%5.2" READ_ONLY NUMBER 16 /end CHARACTERISTIC
/begin CHARACTERISTIC MSRC_MDASRS_DAT_UC "" VAL_BLK 0x8FC6A8 KwbUb 99.61 rel_ub_q0p3906 0.00 99.61 FORMAT "%5.2" READ_ONLY NUMBER 16 /end CHARACTERISTIC
/begin CHARACTERISTIC MSRC_MDMSR_DAT_UC "" VAL_BLK 0x8FC6B8 KwbUb 99.61 rel_ub_q0p3906 0.00 99.61 FORMAT "%5.2" READ_ONLY NUMBER 16 /end CHARACTERISTIC
/begin CHARACTERISTIC MSRC_MMSR_DAT_UC "" VAL_BLK 0x8FC6C8 KwbUb 99.61 rel_ub_q0p3906 0.00 99.61 FORMAT "%5.2" READ_ONLY NUMBER 16 /end CHARACTERISTIC
/begin CHARACTERISTIC MSRC_SBIT_DAT_UC "" VAL_BLK 0x8FC6D8 KwbUb 255.0 dez 0.00 255.0 FORMAT "%5.1" READ_ONLY NUMBER 16 /end CHARACTERISTIC
/begin CHARACTERISTIC MSRC_T_UC "" VALUE 0x8FC6E8 KwUb 10200.0 t40ms_ub_b10200 0.00 10200.0 FORMAT "%7.1" READ_ONLY /end CHARACTERISTIC
/begin CHARACTERISTIC MVER_C_DAT_UC "" VAL_BLK 0x8FCBF1 KwbUb 255.0 dez 0.00 255.0 FORMAT "%5.1" NUMBER 16 /end CHARACTERISTIC
/begin CHARACTERISTIC MVER_MI_DAT_UC "" VAL_BLK 0x8FCC01 KwbUb 255.0 dez 0.00 255.0 FORMAT "%5.1" NUMBER 16 /end CHARACTERISTIC
/begin CHARACTERISTIC MVER_MZF_DAT_UC "" VAL_BLK 0x8FCC11 KwbUb 255.0 dez 0.00 255.0 FORMAT "%5.1" NUMBER 16 /end CHARACTERISTIC
/begin CHARACTERISTIC MVER_MZO_DAT_UC "" VAL_BLK 0x8FCC21 KwbUb 255.0 dez 0.00 255.0 FORMAT "%5.1" NUMBER 16 /end CHARACTERISTIC
/begin CHARACTERISTIC MVER_RFLAGS_DAT_UC "" VAL_BLK 0x8FCC31 KwbUb 255.0 dez 0.00 255.0 FORMAT "%5.1" NUMBER 16 /end CHARACTERISTIC
/begin CHARACTERISTIC MVER_T_UC "" VALUE 0x8FCC41 KwUb 10200.0 t40ms_ub_b10200 0.00 10200.0 FORMAT "%7.1" /end CHARACTERISTIC
/begin CHARACTERISTIC MVER_T_UM "" VALUE 0x8FC39F KwUb 10200.0 t40ms_ub_b10200 0.00 10200.0 FORMAT "%7.1" /end CHARACTERISTIC
/begin CHARACTERISTIC MZFFIL_UC "" VALUE 0x8FCB2F KwUb 10159.4 zk40ms_ub_b10200 40.6299 10200.0 FORMAT "%7.1" /end CHARACTERISTIC
/begin CHARACTERISTIC MZFFIL_UM "" VALUE 0x8FC39D KwUb 10159.4 zk40ms_ub_b10200 40.6299 10200.0 FORMAT "%7.1" /end CHARACTERISTIC
/begin CHARACTERISTIC MZFTV_UC "" VALUE 0x8FCB30 KwUb 280.000 t40ms_ub_b10200 40.0000 320.000 FORMAT "%7.3" /end CHARACTERISTIC
/begin CHARACTERISTIC MZFTV_UM "" VALUE 0x8FC39E KwUb 280.000 t40ms_ub_b10200 40.0000 320.000 FORMAT "%7.3" /end CHARACTERISTIC
/begin CHARACTERISTIC MZF_LOW_DAT_UC "" VAL_BLK 0x8FCB31 KwbUb 0.3891 rel_ub_q0p00153 0.00 0.3891 NUMBER 16 /end CHARACTERISTIC
/begin CHARACTERISTIC MZF_MZF_DAT_UC "" VAL_BLK 0x8FCB41 KwbUb 99.61 rel_ub_q0p3906 0.00 99.61 FORMAT "%5.2" NUMBER 16 /end CHARACTERISTIC
/begin CHARACTERISTIC MZF_MZ_DAT_UC "" VAL_BLK 0x8FCB51 KwbUb 99.61 rel_ub_q0p3906 0.00 99.61 FORMAT "%5.2" NUMBER 16 /end CHARACTERISTIC
/begin CHARACTERISTIC MZF_PTR_DAT_UC "" VAL_BLK 0x8FCB61 KwbUb 255.0 dez 0.00 255.0 FORMAT "%5.1" NUMBER 16 /end CHARACTERISTIC
/begin CHARACTERISTIC MZF_REG_DAT_UC "" MAP 0x8FCB71 KfWUb 255.0 dez 0.00 255.0 FORMAT "%5.1"
 /begin AXIS_DESCR FIX_AXIS mzf_x_uc dez 16 0.00 15.00 FORMAT "%5.2" FIX_AXIS_PAR 0 0 16 /end AXIS_DESCR
 /begin AXIS_DESCR FIX_AXIS mzf_y_uc dez 8 0.00 7.000 FORMAT "%5.3" FIX_AXIS_PAR 0 0 8 /end AXIS_DESCR
/end CHARACTERISTIC
/begin CHARACTERISTIC MZUL_MFGR_DAT_UC "" VAL_BLK 0x8FCA72 KwbUb 99.61 rel_ub_q0p3906 0.00 99.61 FORMAT "%5.2" NUMBER 16 /end CHARACTERISTIC
/begin CHARACTERISTIC MZUL_MMSR_DAT_UC "" VAL_BLK 0x8FCA82 KwbUb 99.61 rel_ub_q0p3906 0.00 99.61 FORMAT "%5.2" NUMBER 16 /end CHARACTERISTIC
/begin CHARACTERISTIC MZUL_MRLINI_DAT_UC "" VAL_BLK 0x8FCA92 KwbUb 99.61 rel_ub_b99p6 0.00 99.61 FORMAT "%5.2" NUMBER 16 /end CHARACTERISTIC
/begin CHARACTERISTIC MZUL_MSGS_DAT_UC "" VAL_BLK 0x8FCAA2 KwbUb 99.61 rel_ub_q0p3906 0.00 99.61 FORMAT "%5.2" NUMBER 16 /end CHARACTERISTIC
/begin CHARACTERISTIC MZUL_NFLAGS_DAT_UC "" VAL_BLK 0x8FCAB2 KwbUb 255.0 dez 0.00 255.0 FORMAT "%5.1" NUMBER 16 /end CHARACTERISTIC
/begin CHARACTERISTIC MZUL_NMOT_DAT_UC "" VAL_BLK 0x8FCAC2 KwbUb 10200. nmot_ub_q40 0.00 10200. FORMAT "%5.0" NUMBER 16 /end CHARACTERISTIC
/begin AXIS_PTS MZUL_NMV08_UC "" 0x8FCAD2 nmot_uc SstAUbSstUb 10200. nmot_ub_q40 8 0.00 10200. FORMAT "%5.0" DEPOSIT ABSOLUTE /end AXIS_PTS
/begin CHARACTERISTIC MZUL_NSC_DAT_UC "" VAL_BLK 0x8FD6FC KwbUw 2621.400 t40msxs_uw_q0p04 0.00 2621.400 FORMAT "%8.3" NUMBER 16 /end CHARACTERISTIC
/begin AXIS_PTS MZUL_SPSNV08_UC "" 0x8FCADB spsn_uc SstAUbSstUb 4.980 spg_ub_q0p019 8 0.00 4.980 FORMAT "%5.3" DEPOSIT ABSOLUTE /end AXIS_PTS
/begin CHARACTERISTIC MZUL_SPSN_DAT_UC "" VAL_BLK 0x8FCAE4 KwbUb 4.980 spg_ub_q0p019 0.00 4.980 FORMAT "%5.3" NUMBER 16 /end CHARACTERISTIC
/begin CHARACTERISTIC MZUL_TFLAGS_DAT_UC "" VAL_BLK 0x8FCAF4 KwbUb 255.0 dez 0.00 255.0 FORMAT "%5.1" NUMBER 16 /end CHARACTERISTIC
/begin CHARACTERISTIC MZUL_TMOT_DAT_UC "" VAL_BLK 0x8FCB04 KwbUb 191.3 temp_ub_q0p75_o48 -48.00 143.3 FORMAT "%5.1" NUMBER 16 /end CHARACTERISTIC
/begin CHARACTERISTIC MZUL_VKPEDCH_DAT_UC "" VAL_BLK 0x8FCB14 KwbUb 255.0 dez 0.00 255.0 FORMAT "%5.1" NUMBER 16 /end CHARACTERISTIC
/begin CHARACTERISTIC NACHANZA "" VALUE 0x8FD383 KwUb 255.0 dez 0.00 255.0 FORMAT "%5.1" /end CHARACTERISTIC
/begin CHARACTERISTIC NC_T_UM "" VALUE 0x8FC00F KwUb 10200.0 t40ms_ub_b10200 0.00 10200.0 FORMAT "%7.1" /end CHARACTERISTIC
/begin CHARACTERISTIC NDIF_UM "" VALUE 0x8FC010 KwUb 10200. nmot_ub_q40 0.00 10200. FORMAT "%5.0" /end CHARACTERISTIC
/begin CHARACTERISTIC NMIN_UM "" VALUE 0x8FC011 KwUb 9680. nmot_ub_q40 520.0 10200. FORMAT "%5.0" /end CHARACTERISTIC
/begin CHARACTERISTIC NMNZUESA "" VALUE 0x8E49C6 KwUb 10200. nmot_ub_q40 0.00 10200. FORMAT "%5.0" /end CHARACTERISTIC
/begin AXIS_PTS NMV08_UM "" 0x8FC081 nmot_um SstAUbSstUb 10200. nmot_ub_q40 8 0.00 10200. FORMAT "%5.0" DEPOSIT ABSOLUTE /end AXIS_PTS
/begin CHARACTERISTIC NMXSKA_UC "" VALUE 0x8FCC53 KwUb 10200. nmot_ub_q40 0.00 10200. FORMAT "%5.0" /end CHARACTERISTIC
/begin CHARACTERISTIC NMXSKA_UM "" VALUE 0x8FC3B1 KwUb 10200. nmot_ub_q40 0.00 10200. FORMAT "%5.0" /end CHARACTERISTIC
/begin CHARACTERISTIC NMXZUESA "" VALUE 0x8E49C7 KwUb 10200. nmot_ub_q40 0.00 10200. FORMAT "%5.0" /end CHARACTERISTIC
/begin CHARACTERISTIC NOASR_UC "" VALUE 0x8FC6E9 KwUb 255.0 dez 0.00 255.0 FORMAT "%5.1" READ_ONLY /end CHARACTERISTIC
/begin CHARACTERISTIC NOREA_UC "" VALUE 0x8FCC54 KwUb 255.0 dez 0.00 255.0 FORMAT "%5.1" /end CHARACTERISTIC
/begin CHARACTERISTIC NOREA_UM "" VALUE 0x8FC3B2 KwUb 255.0 dez 0.00 255.0 FORMAT "%5.1" /end CHARACTERISTIC
/begin CHARACTERISTIC NRLIP_UM "" VALUE 0x8FC070 KwUb 10200. nmot_ub_q40 0.00 10200. FORMAT "%5.0" /end CHARACTERISTIC
/begin CHARACTERISTIC NSC_T2_UC "" VALUE 0x8FD6FA KwUw 2621.400 t40msxs_uw_q0p04 0.00 2621.400 FORMAT "%8.3" /end CHARACTERISTIC
/begin CHARACTERISTIC NSC_T_UM "" VALUE 0x8FC3C4 KwUw 2621.400 t40msxs_uw_q0p04 0.00 2621.400 FORMAT "%8.3" /end CHARACTERISTIC
/begin CHARACTERISTIC NSKAZO_UC "" VALUE 0x8FCC55 KwUb 10200. nmot_ub_q40 0.00 10200. FORMAT "%5.0" /end CHARACTERISTIC
/begin CHARACTERISTIC NSKAZO_UM "" VALUE 0x8FC3B3 KwUb 10200. nmot_ub_q40 0.00 10200. FORMAT "%5.0" /end CHARACTERISTIC
/begin CHARACTERISTIC NSOF_T_UM "" VALUE 0x8FC012 KwUb 10200.0 t40ms_ub_b10200 0.00 10200.0 FORMAT "%7.1" /end CHARACTERISTIC
/begin CHARACTERISTIC NWDKSST "" CURVE 0x8E1625 KlAUbSstUbWUb 10200. nmot_ub_q40 0.00 10200. FORMAT "%5.0"
 /begin AXIS_DESCR STD_AXIS tmst temp_ub_q0p75_o48 6 -48.00 143.3 FORMAT "%5.1" DEPOSIT ABSOLUTE /end AXIS_DESCR
/end CHARACTERISTIC
/begin CHARACTERISTIC N_START_UM "" VALUE 0x8FC013 KwUb 10200. nmot_ub_q40 0.00 10200. FORMAT "%5.0" /end CHARACTERISTIC
/begin CHARACTERISTIC N_STEND_UM "" VALUE 0x8FC014 KwUb 10200. nmot_ub_q40 0.00 10200. FORMAT "%5.0" /end CHARACTERISTIC
/begin CHARACTERISTIC REAC_AZOFFM_DAT_UC "" VAL_BLK 0x8FCC56 KwbUb 255.0 dez 0.00 255.0 FORMAT "%5.1" NUMBER 16 /end CHARACTERISTIC
/begin CHARACTERISTIC REAC_C2_DAT_UC "" VAL_BLK 0x8FCC66 KwbUb 10200.0 t40ms_ub_b10200 0.00 10200.0 FORMAT "%7.1" NUMBER 16 /end CHARACTERISTIC
/begin CHARACTERISTIC REAC_C3_DAT_UC "" VAL_BLK 0x8FCC76 KwbUb 10200.0 t40ms_ub_b10200 0.00 10200.0 FORMAT "%7.1" NUMBER 16 /end CHARACTERISTIC
/begin CHARACTERISTIC REAC_EVZAUS_DAT_UC "" VAL_BLK 0x8FCC86 KwbUb 255.0 dez 0.00 255.0 FORMAT "%5.1" NUMBER 16 /end CHARACTERISTIC
/begin CHARACTERISTIC REAC_NMOT_DAT_UC "" VAL_BLK 0x8FCC96 KwbUb 10200. nmot_ub_q40 0.00 10200. FORMAT "%5.0" NUMBER 16 /end CHARACTERISTIC
/begin CHARACTERISTIC REAC_RFLAGS_DAT_UC "" VAL_BLK 0x8FCCA6 KwbUb 255.0 dez 0.00 255.0 FORMAT "%5.1" NUMBER 16 /end CHARACTERISTIC
/begin CHARACTERISTIC REAC_SPSN_DAT_UC "" VAL_BLK 0x8FCCB6 KwbUb 4.980 spg_ub_q0p019 0.00 4.980 FORMAT "%5.3" NUMBER 16 /end CHARACTERISTIC
/begin CHARACTERISTIC REAC_T2_UC "" VALUE 0x8FCCC6 KwUb 10200.0 t40ms_ub_b10200 0.00 10200.0 FORMAT "%7.1" /end CHARACTERISTIC
/begin CHARACTERISTIC REAC_T2_UM "" VALUE 0x8FC3B4 KwUb 10200.0 t40ms_ub_b10200 0.00 10200.0 FORMAT "%7.1" /end CHARACTERISTIC
/begin CHARACTERISTIC REAC_T3_UC "" VALUE 0x8FCCC7 KwUb 10200.0 t40ms_ub_b10200 0.00 10200.0 FORMAT "%7.1" /end CHARACTERISTIC
/begin CHARACTERISTIC REAC_T3_UM "" VALUE 0x8FC3B5 KwUb 10200.0 t40ms_ub_b10200 0.00 10200.0 FORMAT "%7.1" /end CHARACTERISTIC
/begin CHARACTERISTIC RKC_MRLINI_DAT_UC "" VAL_BLK 0x8FC5E5 KwbUb 255.0 dez 0.00 255.0 FORMAT "%5.1" NUMBER 16 /end CHARACTERISTIC
/begin CHARACTERISTIC RLC_T_UM "" VALUE 0x8FC071 KwUb 10200.0 t40ms_ub_b10200 0.00 10200.0 FORMAT "%7.1" /end CHARACTERISTIC
/begin CHARACTERISTIC RLIPFIL_UM "" VALUE 0x8FC072 KwUb 10159.4 zk40ms_ub_b10200 40.6299 10200.0 FORMAT "%7.1" /end CHARACTERISTIC
/begin CHARACTERISTIC RLIPTV_UM "" VALUE 0x8FC073 KwUb 320.000 t40ms_ub_b10200 0.00 320.000 FORMAT "%7.3" /end CHARACTERISTIC
/begin CHARACTERISTIC RLIP_T_UM "" VALUE 0x8FC074 KwUb 10200.0 t40ms_ub_b10200 0.00 10200.0 FORMAT "%7.1" /end CHARACTERISTIC
/begin CHARACTERISTIC RL_BO_UM "" VALUE 0x8FC075 KwUb 191.3 rel_ub_q0p75 0.00 191.3 FORMAT "%5.1" /end CHARACTERISTIC
/begin CHARACTERISTIC RL_MO_UM "" VALUE 0x8FC076 KwUb 255.0 dez 0.00 255.0 FORMAT "%5.1" /end CHARACTERISTIC
/begin CHARACTERISTIC ROMRSTA_UM "" VALUE 0x8FC3BF KwUb 255.0 dez 0.00 255.0 FORMAT "%5.1" /end CHARACTERISTIC
/begin CHARACTERISTIC RST_TV_UM "" VALUE 0x8FC003 KwUb 255.0 dez 0.00 255.0 FORMAT "%5.1" /end CHARACTERISTIC
/begin CHARACTERISTIC SGSC_ASGPUC_DAT_UC "" VAL_BLK 0x8FC503 KwbUb 255.0 dez 0.00 255.0 FORMAT "%5.1" NUMBER 16 /end CHARACTERISTIC
/begin CHARACTERISTIC SGSC_BASGPL_DAT_UC "" VAL_BLK 0x8FC513 KwbUb 255.0 dez 0.00 255.0 FORMAT "%5.1" NUMBER 16 /end CHARACTERISTIC
/begin CHARACTERISTIC SGSC_BASGPU_DAT_UC "" VAL_BLK 0x8FC523 KwbUb 255.0 dez 0.00 255.0 FORMAT "%5.1" NUMBER 16 /end CHARACTERISTIC
/begin CHARACTERISTIC SGSC_BWKRA_DAT_UC "" VAL_BLK 0x8FC533 KwbUb 255.0 dez 0.00 255.0 FORMAT "%5.1" NUMBER 16 /end CHARACTERISTIC
/begin CHARACTERISTIC SGSC_BWKR_DAT_UC "" VAL_BLK 0x8FC543 KwbUb 255.0 dez 0.00 255.0 FORMAT "%5.1" NUMBER 16 /end CHARACTERISTIC
/begin CHARACTERISTIC SGSC_BZGES_DAT_UC "" VAL_BLK 0x8FC553 KwbUb 255.0 dez 0.00 255.0 FORMAT "%5.1" NUMBER 16 /end CHARACTERISTIC
/begin CHARACTERISTIC SGSC_BZ_CANGE_DAT_UC "" VAL_BLK 0x8FC563 KwbUb 255.0 dez 0.00 255.0 FORMAT "%5.1" NUMBER 16 /end CHARACTERISTIC
/begin CHARACTERISTIC SGSC_BZ_SGS_A_DAT_UC "" VAL_BLK 0x8FC573 KwbUb 255.0 dez 0.00 255.0 FORMAT "%5.1" NUMBER 16 /end CHARACTERISTIC
/begin CHARACTERISTIC SGSC_BZ_SGS_DAT_UC "" VAL_BLK 0x8FC583 KwbUb 255.0 dez 0.00 255.0 FORMAT "%5.1" NUMBER 16 /end CHARACTERISTIC
/begin CHARACTERISTIC SGSC_C_DAT_UC "" VAL_BLK 0x8FC593 KwbUb 255.0 dez 0.00 255.0 FORMAT "%5.1" NUMBER 16 /end CHARACTERISTIC
/begin CHARACTERISTIC SGSC_MISGSCPL_DAT_UC "" VAL_BLK 0x8FD616 KwbUw 65535.00 dez 0.00 65535.00 FORMAT "%8.2" NUMBER 16 /end CHARACTERISTIC
/begin CHARACTERISTIC SGSC_MISGS_DAT_UC "" VAL_BLK 0x8FD636 KwbUw 131070.0 md_ub_q2_o100 -100.0000 130970.0 FORMAT "%8.1" NUMBER 16 /end CHARACTERISTIC
/begin CHARACTERISTIC SGSC_MOMIA1_DAT_UC "" VAL_BLK 0x8FD656 KwbUw 10239.84 mdt_q0p15625_Nms 0.00 10239.84 FORMAT "%8.2" NUMBER 16 /end CHARACTERISTIC
/begin CHARACTERISTIC SGSC_MOMIA2_DAT_UC "" VAL_BLK 0x8FD676 KwbUw 10239.84 mdt_q0p15625_Nms 0.00 10239.84 FORMAT "%8.2" NUMBER 16 /end CHARACTERISTIC
/begin CHARACTERISTIC SGSC_MOMINT_DAT_UC "" VAL_BLK 0x8FD696 KwbUw 10239.84 mdt_q0p15625_Nms 0.00 10239.84 FORMAT "%8.2" NUMBER 16 /end CHARACTERISTIC
/begin CHARACTERISTIC SGSC_MSGS_DAT_UC "" VAL_BLK 0x8FC5A3 KwbUb 99.61 rel_ub_q0p3906 0.00 99.61 FORMAT "%5.2" NUMBER 16 /end CHARACTERISTIC
/begin CHARACTERISTIC SGSC_MZ_DAT_UC "" VAL_BLK 0x8FC5B3 KwbUb 99.61 rel_ub_q0p3906 0.00 99.61 FORMAT "%5.2" NUMBER 16 /end CHARACTERISTIC
/begin CHARACTERISTIC SGSC_NSYWIN_DAT_UC "" VAL_BLK 0x8FC5C3 KwbUb 6375. nmot_ub_q25 0.00 6375. FORMAT "%5.0" NUMBER 16 /end CHARACTERISTIC
/begin CHARACTERISTIC SGSC_NSYW_DAT_UC "" VAL_BLK 0x8FC5D3 KwbUb 6375. nmot_ub_q25 0.00 6375. FORMAT "%5.0" NUMBER 16 /end CHARACTERISTIC
/begin CHARACTERISTIC SGSC_T_UC "" VALUE 0x8FC5E3 KwUb 10200.0 t40ms_ub_b10200 0.00 10200.0 FORMAT "%7.1" /end CHARACTERISTIC
/begin CHARACTERISTIC SGSC_T_UM "" VALUE 0x8FC017 KwUb 10200.0 t40ms_ub_b10200 0.00 10200.0 FORMAT "%7.1" /end CHARACTERISTIC
/begin AXIS_PTS SLA09OPUW "" 0x8E5BAE lambas_w SstAUwSstUw 15.99976 fak_uw_b16 9 0.00 15.99976 FORMAT "%8.5" DEPOSIT ABSOLUTE /end AXIS_PTS
/begin AXIS_PTS SNM04ZUUB "" 0x8E02C3 nmot SstAUbSstUb 10200. nmot_ub_q40 4 0.00 10200. FORMAT "%5.0" DEPOSIT ABSOLUTE /end AXIS_PTS
/begin AXIS_PTS SNM06NWUB "" 0x8E00C4 nmot SstAUbSstUb 10200. nmot_ub_q40 6 0.00 10200. FORMAT "%5.0" DEPOSIT ABSOLUTE /end AXIS_PTS
/begin AXIS_PTS SNM12ESUB "" 0x8E01F4 nmot SstAUbSstUb 10200. nmot_ub_q40 12 0.00 10200. FORMAT "%5.0" DEPOSIT ABSOLUTE /end AXIS_PTS
/begin AXIS_PTS SNM16OPUW "" 0x8E5A42 nmot_w SstAUwSstUw 16383.75 nmot_uw_q0p25 16 0.00 16383.75 FORMAT "%8.2" DEPOSIT ABSOLUTE /end AXIS_PTS
/begin AXIS_PTS SNM16ZUUW "" 0x8E5A64 nmot_w SstAUwSstUw 16383.75 nmot_uw_q0p25 16 0.00 16383.75 FORMAT "%8.2" DEPOSIT ABSOLUTE /end AXIS_PTS
/begin AXIS_PTS SNS04ZUSB "" 0x8E02C8 dns SstAUbSstSb 2550. nmotd_sb_q10 4 -1280. 1270. FORMAT "%5.0" DEPOSIT ABSOLUTE /end AXIS_PTS
/begin CHARACTERISTIC SP12LL_UM "" VALUE 0x8FC077 KwUb 4.980 spg_ub_q0p019 0.00 4.980 FORMAT "%5.3" /end CHARACTERISTIC
/begin CHARACTERISTIC SP12VG_UM "" VALUE 0x8FC078 KwUb 4.980 spg_ub_q0p019 0.00 4.980 FORMAT "%5.3" /end CHARACTERISTIC
/begin CHARACTERISTIC SP1ADC_DIF "" VALUE 0x8FC3B7 KwUb 4.980 spg_ub_q0p019 0.00 4.980 FORMAT "%5.3" /end CHARACTERISTIC
/begin CHARACTERISTIC SP1_STAT "" VALUE 0x8FC3B8 KwUb 4.980 spg_ub_q0p019 0.00 4.980 FORMAT "%5.3" /end CHARACTERISTIC
/begin CHARACTERISTIC SP1_STAT_T "" VALUE 0x8FC3B9 KwUb 2.550 t10msxs_ub_b2p55 0.00 2.550 FORMAT "%5.3" /end CHARACTERISTIC
/begin CHARACTERISTIC SPSC_MINUM "" VALUE 0x8FC079 KwUb 4.980 spg_ub_q0p019 0.00 4.980 FORMAT "%5.3" /end CHARACTERISTIC
/begin CHARACTERISTIC SPSC_T_UM "" VALUE 0x8FC07A KwUb 10200.0 t40ms_ub_b10200 0.00 10200.0 FORMAT "%7.1" /end CHARACTERISTIC
/begin CHARACTERISTIC SPSNLL_UC "" VALUE 0x8FCB24 KwUb 4.980 spg_ub_q0p019 0.00 4.980 FORMAT "%5.3" /end CHARACTERISTIC
/begin CHARACTERISTIC SPSNLL_UM "" VALUE 0x8FC392 KwUb 4.980 spg_ub_q0p019 0.00 4.980 FORMAT "%5.3" /end CHARACTERISTIC
/begin AXIS_PTS SPSNV08_UM "" 0x8FC093 spsn_um SstAUbSstUb 4.980 spg_ub_q0p019 8 0.00 4.980 FORMAT "%5.3" DEPOSIT ABSOLUTE /end AXIS_PTS
/begin CHARACTERISTIC SPSVG_UM "" VALUE 0x8FC07B KwUb 4.980 spg_ub_q0p019 0.00 4.980 FORMAT "%5.3" /end CHARACTERISTIC
/begin AXIS_PTS SRL06ESUB "" 0x8E0214 rl SstAUbSstUb 191.3 rel_ub_q0p75 6 0.00 191.3 FORMAT "%5.1" DEPOSIT ABSOLUTE /end AXIS_PTS
/begin AXIS_PTS SRL11OPUW "" 0x8E5BE4 rl_w SstAUwSstUw 1535.977 rel_uw_q0p0234 11 0.00 1535.977 FORMAT "%8.3" DEPOSIT ABSOLUTE /end AXIS_PTS
/begin AXIS_PTS SRL12ZUUW "" 0x8E5A86 rl_w SstAUwSstUw 1535.977 rel_uw_q0p0234 12 0.00 1535.977 FORMAT "%8.3" DEPOSIT ABSOLUTE /end AXIS_PTS
/begin AXIS_PTS STA12WLUB "" 0x8E0250 tans SstAUbSstUb 191.3 temp_ub_q0p75_o48 12 -48.00 143.3 FORMAT "%5.1" DEPOSIT ABSOLUTE /end AXIS_PTS
/begin AXIS_PTS STM08__UB "" 0x8E02BA tmot SstAUbSstUb 191.3 temp_ub_q0p75_o48 8 -48.00 143.3 FORMAT "%5.1" DEPOSIT ABSOLUTE /end AXIS_PTS
/begin AXIS_PTS STO08NAUW "" 0x8EFF2A toelzk_w SstAUwSstUw 1535.977 temp_q0p0234_o273 8 -273.1500 1262.827 FORMAT "%8.3" DEPOSIT ABSOLUTE /end AXIS_PTS
/begin AXIS_PTS STO08NEUW "" 0x8EFE40 toelzk_w SstAUbSstUw 1535.977 temp_q0p0234_o273 8 -273.1500 1262.827 FORMAT "%8.3" DEPOSIT ABSOLUTE /end AXIS_PTS
/begin CHARACTERISTIC TANSMN_UM "" VALUE 0x8FC015 KwUb 191.3 temp_ub_q0p75_o48 -48.00 143.3 FORMAT "%5.1" /end CHARACTERISTIC
/begin CHARACTERISTIC TANWNA "" VALUE 0x8FD2A2 KwUb 99.61 tv_ub_b100 0.00 99.61 FORMAT "%5.2" /end CHARACTERISTIC
/begin CHARACTERISTIC TANWNE "" VALUE 0x8FD293 KwUb 99.61 tv_ub_b100 0.00 99.61 FORMAT "%5.2" /end CHARACTERISTIC
/begin CHARACTERISTIC TANWPSA "" VALUE 0x8FD2A3 KwUb 99.61 tv_ub_b100 0.00 99.61 FORMAT "%5.2" /end CHARACTERISTIC
/begin CHARACTERISTIC TANWPSE "" VALUE 0x8FD294 KwUb 99.61 tv_ub_b100 0.00 99.61 FORMAT "%5.2" /end CHARACTERISTIC
/begin CHARACTERISTIC TANWSDA "" VALUE 0x8FEFAC KwUw 99.99695 rel_sw_b100 0.00 99.99695 FORMAT "%8.5" /end CHARACTERISTIC
/begin CHARACTERISTIC TANWSDE "" VALUE 0x8FEF9C KwUw 99.99695 rel_sw_b100 0.00 99.99695 FORMAT "%8.5" /end CHARACTERISTIC
/begin CHARACTERISTIC TFWDKSOM "" VALUE 0x8EA23E KwUw 655.34999985 zk10msxs_uw_b655 0.010000152590 655.36000000 FORMAT "%12.8" /end CHARACTERISTIC
/begin CHARACTERISTIC THTVAI "" VALUE 0x8FD2A4 KwUb 5.09992 zk10msxs_ub_b51p2 0.0200784 5.12000 FORMAT "%7.5" /end CHARACTERISTIC
/begin CHARACTERISTIC THTVEI "" VALUE 0x8FD295 KwUb 5.09992 zk10msxs_ub_b51p2 0.0200784 5.12000 FORMAT "%7.5" /end CHARACTERISTIC
/begin CHARACTERISTIC TMISTMN_UC "" VALUE 0x8FC848 KwUb 191.3 temp_ub_q0p75_o48 -48.00 143.3 FORMAT "%5.1" /end CHARACTERISTIC
/begin CHARACTERISTIC TMMKH_UC "" VALUE 0x8FD71C KwUw 2621.400 t40msxs_uw_q0p04 0.00 2621.400 FORMAT "%8.3" /end CHARACTERISTIC
/begin CHARACTERISTIC TMMKH_UM "" VALUE 0x8FC3CE KwUw 2621.400 t40msxs_uw_q0p04 0.00 2621.400 FORMAT "%8.3" /end CHARACTERISTIC
/begin CHARACTERISTIC TMNSMN_UM "" VALUE 0x8FC016 KwUb 191.3 temp_ub_q0p75_o48 -48.00 143.3 FORMAT "%5.1" /end CHARACTERISTIC
/begin CHARACTERISTIC TMOMIN_UC "" VALUE 0x8FCB25 KwUb 191.3 temp_ub_q0p75_o48 -48.00 143.3 FORMAT "%5.1" /end CHARACTERISTIC
/begin CHARACTERISTIC TMOMIN_UM "" VALUE 0x8FC393 KwUb 191.3 temp_ub_q0p75_o48 -48.00 143.3 FORMAT "%5.1" /end CHARACTERISTIC
/begin AXIS_PTS TMOV08_UC "" 0x8FCB26 tmotmn_uc SstAUbSstUb 191.3 temp_ub_q0p75_o48 8 -48.00 143.3 FORMAT "%5.1" DEPOSIT ABSOLUTE /end AXIS_PTS
/begin AXIS_PTS TMOV08_UM "" 0x8FC394 tmotmn_um SstAUbSstUb 191.3 temp_ub_q0p75_o48 8 -48.00 143.3 FORMAT "%5.1" DEPOSIT ABSOLUTE /end AXIS_PTS
/begin CHARACTERISTIC TNSZWTIP "" VALUE 0x8FEFB6 KwUw 655.3500 t10msxs_uw_b655p35 0.00 655.3500 FORMAT "%8.4" /end CHARACTERISTIC
/begin CHARACTERISTIC TSGSCNU_UC "" VALUE 0x8FC5E4 KwUb 10200.0 t40ms_ub_b10200 0.00 10200.0 FORMAT "%7.1" /end CHARACTERISTIC
/begin CHARACTERISTIC TSGSCNU_UM "" VALUE 0x8FC018 KwUb 10200.0 t40ms_ub_b10200 0.00 10200.0 FORMAT "%7.1" /end CHARACTERISTIC
/begin CHARACTERISTIC TSMNSA "" VALUE 0x8E49C8 KwUb 25.50 txms_ub_q0p1 0.00 25.50 FORMAT "%5.2" /end CHARACTERISTIC
/begin CHARACTERISTIC TSMX "" VALUE 0x8E49C9 KwUb 25.50 txms_ub_q0p1 0.00 25.50 FORMAT "%5.2" /end CHARACTERISTIC
/begin CHARACTERISTIC TSMXNL "" VALUE 0x8E49CA KwUb 25.50 txms_ub_q0p1 0.00 25.50 FORMAT "%5.2" /end CHARACTERISTIC
/begin CHARACTERISTIC TSWZK "" VALUE 0x8E42D1 KwUb 12.75 t50msxs_q0p05 0.00 12.75 FORMAT "%5.2" /end CHARACTERISTIC
/begin CHARACTERISTIC TSWZKR "" VALUE 0x8E42D2 KwUb 12.75 t50msxs_q0p05 0.00 12.75 FORMAT "%5.2" /end CHARACTERISTIC
/begin CHARACTERISTIC TTIPINEN "" VALUE 0x8FD37D KwUb 2.550 t10msxs_ub_b2p55 0.00 2.550 FORMAT "%5.3" /end CHARACTERISTIC
/begin CHARACTERISTIC TTIPINON "" VALUE 0x8FD37E KwUb 12.75 t50msxs_ub_b12p75 0.00 12.75 FORMAT "%5.2" /end CHARACTERISTIC
/begin CHARACTERISTIC TVINWSA "" VALUE 0x8FD2A5 KwUb 99.61 tv_ub_b100 0.00 99.61 FORMAT "%5.2" /end CHARACTERISTIC
/begin CHARACTERISTIC TVINWSE "" VALUE 0x8FD296 KwUb 99.61 tv_ub_b100 0.00 99.61 FORMAT "%5.2" /end CHARACTERISTIC
/begin CHARACTERISTIC TVMXPRG "" CURVE 0x8E3496 FklWUb 5.100 t20msxs_ub_q0p02 0.00 5.100 FORMAT "%5.3"
 /begin AXIS_DESCR FIX_AXIS gangi dez 8 0.00 7.000 FORMAT "%5.3" FIX_AXIS_PAR 0 0 8 /end AXIS_DESCR
/end CHARACTERISTIC
/begin CHARACTERISTIC TVNWMNA "" VALUE 0x8FD2A6 KwUb 99.61 tv_ub_b100 0.00 99.61 FORMAT "%5.2" /end CHARACTERISTIC
/begin CHARACTERISTIC TVNWMNE "" VALUE 0x8FD297 KwUb 99.61 tv_ub_b100 0.00 99.61 FORMAT "%5.2" /end CHARACTERISTIC
/begin CHARACTERISTIC TVNWMXA "" VALUE 0x8FD2A7 KwUb 99.61 tv_ub_b100 0.00 99.61 FORMAT "%5.2" /end CHARACTERISTIC
/begin CHARACTERISTIC TVNWMXE "" VALUE 0x8FD298 KwUb 99.61 tv_ub_b100 0.00 99.61 FORMAT "%5.2" /end CHARACTERISTIC
/begin CHARACTERISTIC TVZWMSA "" VALUE 0x8FD37F KwUb 2.550 t10msxs_ub_b2p55 0.00 2.550 FORMAT "%5.3" /end CHARACTERISTIC
/begin CHARACTERISTIC TVZWMSE "" VALUE 0x8FD380 KwUb 2.550 t10msxs_ub_b2p55 0.00 2.550 FORMAT "%5.3" /end CHARACTERISTIC
/begin CHARACTERISTIC TWDKRED "" VALUE 0x8FE688 KwUw 655.34999985 zk10msxs_uw_b655 0.010000152590 655.36000000 FORMAT "%12.8" /end CHARACTERISTIC
/begin CHARACTERISTIC TWDKSNST "" CURVE 0x8EA240 KlAUbSstUbWUw 655.3400 t10msxs_uw_b655p35 0.01000000 655.3500 FORMAT "%8.4"
 /begin AXIS_DESCR STD_AXIS tmst temp_ub_q0p75_o48 6 -48.00 143.3 FORMAT "%5.1" DEPOSIT ABSOLUTE /end AXIS_DESCR
/end CHARACTERISTIC
/begin CHARACTERISTIC TWNWSA "" VALUE 0x8FD2A8 KwUb 99.61 tv_ub_b100 0.00 99.61 FORMAT "%5.2" /end CHARACTERISTIC
/begin CHARACTERISTIC TWNWSE "" VALUE 0x8FD299 KwUb 99.61 tv_ub_b100 0.00 99.61 FORMAT "%5.2" /end CHARACTERISTIC
/begin CHARACTERISTIC TWNWSSRNA "" VALUE 0x8FEFAE KwUw 327.67499992 zk5msxs_uw_b327 0.0050000762951 327.68000000 FORMAT "%12.8" /end CHARACTERISTIC
/begin CHARACTERISTIC TWNWSSRNE "" VALUE 0x8FEF9E KwUw 327.67500000 zk5msxs_uw_b327 0.0050000000000 327.68000000 FORMAT "%12.8" /end CHARACTERISTIC
/begin CHARACTERISTIC TWNWSSRPA "" VALUE 0x8FEFB0 KwUw 327.67499992 zk5msxs_uw_b327 0.0050000762951 327.68000000 FORMAT "%12.8" /end CHARACTERISTIC
/begin CHARACTERISTIC TWNWSSRPE "" VALUE 0x8FEFA0 KwUw 327.67500000 zk5msxs_uw_b327 0.0050000000000 327.68000000 FORMAT "%12.8" /end CHARACTERISTIC
/begin CHARACTERISTIC TZSUDYN "" CURVE 0x8E49CB KlAUbSstUbWUb 2.550 t10msxs_ub_b2p55 0.00 2.550 FORMAT "%5.3"
 /begin AXIS_DESCR STD_AXIS nmot nmot_ub_q40 6 0.00 10200. FORMAT "%5.0" DEPOSIT ABSOLUTE /end AXIS_DESCR
/end CHARACTERISTIC
/begin CHARACTERISTIC TZTOL_UM "" VALUE 0x8FC3C2 KwUw 65535.00 dez 0.00 65535.00 FORMAT "%8.2" /end CHARACTERISTIC
/begin CHARACTERISTIC UMECRST_TV_UM "" VALUE 0x8FC004 KwUb 255.0 dez 0.00 255.0 FORMAT "%5.1" /end CHARACTERISTIC
/begin CHARACTERISTIC UMRST_TV_UM "" VALUE 0x8FC005 KwUb 255.0 dez 0.00 255.0 FORMAT "%5.1" /end CHARACTERISTIC
/begin CHARACTERISTIC VARTAB "" VAL_BLK 0x8EFFD4 KwbUw 32767.00 dez 0.00 32767.00 FORMAT "%8.2" NUMBER 16 /end CHARACTERISTIC
/begin CHARACTERISTIC VMINACC_UC "" VALUE 0x8FD6D6 KwUw 511.9922 vfzg_uw_b512 0.00 511.9922 FORMAT "%8.4" READ_ONLY /end CHARACTERISTIC
/begin CHARACTERISTIC VMIN_UC "" VALUE 0x8FD6D8 KwUw 511.9922 vfzg_uw_b512 0.00 511.9922 FORMAT "%8.4" READ_ONLY /end CHARACTERISTIC
/begin CHARACTERISTIC WAIT_T_UM "" VALUE 0x8FC3C0 KwUw 4999.578 t_wdt_high 0.00 4999.578 FORMAT "%8.3" /end CHARACTERISTIC
/begin CHARACTERISTIC WDKSNLN "" CURVE 0x8EA254 KlAUbSstUbWUb 100.0 relDK_ub_b100 0.00 100.0 FORMAT "%5.1"
 /begin AXIS_DESCR STD_AXIS nmot nmot_ub_q40 8 0.00 10200. FORMAT "%5.0" DEPOSIT ABSOLUTE /end AXIS_DESCR
/end CHARACTERISTIC
/begin CHARACTERISTIC WFSKLASSE "" VALUE 0x8E2437 KwUb 255.0 dez 0.00 255.0 FORMAT "%5.1" /end CHARACTERISTIC
/begin CHARACTERISTIC WFSMARKE "" VALUE 0x8E2438 KwUb 255.0 dez 0.00 255.0 FORMAT "%5.1" /end CHARACTERISTIC
/begin CHARACTERISTIC WFSTRETRY "" VALUE 0x8E2439 KwUb 255.0 t_q1 0.00 255.0 FORMAT "%5.1" /end CHARACTERISTIC
/begin CHARACTERISTIC WNWSHMNA "" VALUE 0x8FD2A9 KwUb 127.5 kw_q0p5 0.00 127.5 FORMAT "%5.1" /end CHARACTERISTIC
/begin CHARACTERISTIC WNWSHMNE "" VALUE 0x8FD29A KwUb 127.5 kw_ub_q0p5 0.00 127.5 FORMAT "%5.1" /end CHARACTERISTIC
/begin CHARACTERISTIC WNWSHMXA "" VALUE 0x8FD2AA KwUb 127.5 kw_q0p5 0.00 127.5 FORMAT "%5.1" /end CHARACTERISTIC
/begin CHARACTERISTIC WNWSHMXE "" VALUE 0x8FD29B KwUb 127.5 kw_ub_q0p5 0.00 127.5 FORMAT "%5.1" /end CHARACTERISTIC
/begin CHARACTERISTIC WPHN "" CURVE 0x8F0F3C KlAUbSstUbWSb 191.3 zw_sb_q0p75 -96.00 95.25 FORMAT "%5.2"
 /begin AXIS_DESCR STD_AXIS nmot nmot_ub_q40 8 0.00 10200. FORMAT "%5.0" DEPOSIT ABSOLUTE /end AXIS_DESCR
/end CHARACTERISTIC
/begin CHARACTERISTIC WSNWSA "" VALUE 0x8FD2AB KwUb 63.75 kw_q0p25 0.00 63.75 FORMAT "%5.2" /end CHARACTERISTIC
/begin CHARACTERISTIC WSNWSE "" VALUE 0x8FD29C KwUb 63.75 kw_q0p25 0.00 63.75 FORMAT "%5.2" /end CHARACTERISTIC
/begin CHARACTERISTIC ZNWFILA "" VALUE 0x8FEFB2 KwUw 0.9999847 fak_uw_b1 0.00 0.9999847 FORMAT "%9.7" /end CHARACTERISTIC
/begin CHARACTERISTIC ZNWFILE "" VALUE 0x8FEFA2 KwUw 0.9999847 fak_uw_b1 0.00 0.9999847 FORMAT "%9.7" /end CHARACTERISTIC
/begin CHARACTERISTIC ZNWVHA "" VALUE 0x8FEFB4 KwSw 2559.961 t5msxms_q0p039 -1280.000 1279.961 FORMAT "%8.3" /end CHARACTERISTIC
/begin CHARACTERISTIC ZNWVHE "" VALUE 0x8FEFA4 KwSw 2559.961 t5msxms_q0p039 -1280.000 1279.961 FORMAT "%8.3" /end CHARACTERISTIC
/begin CHARACTERISTIC ZWAPPL "" VALUE 0x8FD384 KwSb 191.3 zw_sb_q0p75 -96.00 95.25 FORMAT "%5.2" /end CHARACTERISTIC
/begin CHARACTERISTIC ZWC_T_UM "" VALUE 0x8FC019 KwUb 255.0 dez 0.00 255.0 FORMAT "%5.1" /end CHARACTERISTIC
/begin CHARACTERISTIC ZWSPAEINI "" VALUE 0x8E3E85 KwSb 191.3 zw_sb_q0p75 -96.00 95.25 FORMAT "%5.2" /end CHARACTERISTIC
/begin CHARACTERISTIC ZYLANZ_UM "" VALUE 0x8FC01A KwUb 255.0 dez 0.00 255.0 FORMAT "%5.1" /end CHARACTERISTIC
/begin MEASUREMENT abfgrc_uc "" UWORD dez 1 100 0.00 65535.00 FORMAT "%8.2" ECU_ADDRESS 0xF10B8 /end MEASUREMENT
/begin MEASUREMENT abmist_uc "" UWORD dez 1 100 0.00 65535.00 FORMAT "%8.2" ECU_ADDRESS 0xF10CC /end MEASUREMENT
/begin MEASUREMENT abmsrc_uc "" UWORD dez 1 100 0.00 65535.00 FORMAT "%8.2" ECU_ADDRESS 0xF10BE /end MEASUREMENT
/begin MEASUREMENT abmver_uc "" UWORD dez 1 100 0.00 65535.00 FORMAT "%8.2" ECU_ADDRESS 0xF10F8 /end MEASUREMENT
/begin MEASUREMENT abmzf_uc "" UWORD dez 1 100 0.00 65535.00 FORMAT "%8.2" ECU_ADDRESS 0xF10E8 /end MEASUREMENT
/begin MEASUREMENT abmzul_uc "" UWORD dez 1 100 0.00 65535.00 FORMAT "%8.2" ECU_ADDRESS 0xF10D6 /end MEASUREMENT
/begin MEASUREMENT abreac_uc "" UWORD dez 1 100 0.00 65535.00 FORMAT "%8.2" ECU_ADDRESS 0xF10FE /end MEASUREMENT
/begin MEASUREMENT abrkc_uc "" UWORD dez 1 100 0.00 65535.00 FORMAT "%8.2" ECU_ADDRESS 0xF10B2 /end MEASUREMENT
/begin MEASUREMENT absgsc_uc "" UWORD dez 1 100 0.00 65535.00 FORMAT "%8.2" ECU_ADDRESS 0xF1086 /end MEASUREMENT
/begin MEASUREMENT adcc_c_um "" UBYTE t10msxs_ub_b2p55 1 100 0.00 2.550 FORMAT "%5.3" ECU_ADDRESS 0x380054 /end MEASUREMENT
/begin MEASUREMENT asgphnpl_bt "" UBYTE dez 1 100 0.00 255.0 FORMAT "%5.1" ECU_ADDRESS 0xF0563 /end MEASUREMENT
/begin MEASUREMENT auscf_c_um "" UWORD dez 1 100 0.00 65535.00 FORMAT "%8.2" ECU_ADDRESS 0x38214E /end MEASUREMENT
/begin MEASUREMENT ausc_c_um "" UWORD dez 1 100 0.00 65535.00 FORMAT "%8.2" ECU_ADDRESS 0x382150 /end MEASUREMENT
/begin MEASUREMENT ausgh_c_um "" UBYTE t40ms_ub_b10200 1 100 0.00 10200.0 FORMAT "%7.1" ECU_ADDRESS 0x380059 /end MEASUREMENT
/begin MEASUREMENT ausg_c_um "" UBYTE dezsub1 1 100 1.000 256.0 FORMAT "%5.1" ECU_ADDRESS 0x38005A /end MEASUREMENT
/begin MEASUREMENT auszh_c_um "" UBYTE t40ms_ub_b10200 1 100 0.00 10200.0 FORMAT "%7.1" ECU_ADDRESS 0x38005B /end MEASUREMENT
/begin MEASUREMENT ausz_c_um "" UBYTE dezsub1 1 100 1.000 256.0 FORMAT "%5.1" ECU_ADDRESS 0x38005C /end MEASUREMENT
/begin MEASUREMENT azoff_w_bt "" UWORD dez 1 100 0.00 65535.00 FORMAT "%8.2" ECU_ADDRESS 0xF1100 /end MEASUREMENT
/begin MEASUREMENT bzmsr_a_uc "" UBYTE dez 1 100 0.00 255.0 FORMAT "%5.1" ECU_ADDRESS 0xF056F /end MEASUREMENT
/begin MEASUREMENT bzmsr_c_uc "" UBYTE t40ms_ub_b10200 1 100 0.00 10200.0 FORMAT "%7.1" ECU_ADDRESS 0xF0570 /end MEASUREMENT
/begin MEASUREMENT bzsgs_c_uc "" UBYTE t40ms_ub_b10200 1 100 0.00 10200.0 FORMAT "%7.1" ECU_ADDRESS 0xF0564 /end MEASUREMENT
/begin MEASUREMENT bzsgs_c_um "" UBYTE t40ms_ub_b10200 1 100 0.00 10200.0 FORMAT "%7.1" ECU_ADDRESS 0x38001A /end MEASUREMENT
/begin MEASUREMENT bz_cange_bt "" UBYTE dez 1 100 0.00 255.0 FORMAT "%5.1" ECU_ADDRESS 0xF0565 /end MEASUREMENT
/begin MEASUREMENT bz_sgsa_uc "" UBYTE t40ms_ub_b10200 1 100 0.00 10200.0 FORMAT "%7.1" ECU_ADDRESS 0xF0566 /end MEASUREMENT
/begin MEASUREMENT bz_sgsa_um "" UBYTE t40ms_ub_b10200 1 100 0.00 10200.0 FORMAT "%7.1" ECU_ADDRESS 0x38001B /end MEASUREMENT
/begin MEASUREMENT B_accak_um "" UBYTE B_TRUE 1 100 0.00 1.00000000000 BIT_MASK 0x10 FORMAT "%13.11" ECU_ADDRESS 0x380004 /end MEASUREMENT
/begin MEASUREMENT B_accen_um "" UBYTE B_TRUE 1 100 0.00 1.00000000000 BIT_MASK 0x80 FORMAT "%13.11" ECU_ADDRESS 0x380009 /end MEASUREMENT
/begin MEASUREMENT B_accmx_um "" UBYTE B_TRUE 1 100 0.00 1.00000000000 BIT_MASK 0x1 FORMAT "%13.11" ECU_ADDRESS 0x380003 /end MEASUREMENT
/begin MEASUREMENT B_accof_um "" UBYTE B_TRUE 1 100 0.00 1.00000000000 BIT_MASK 0x40 FORMAT "%13.11" ECU_ADDRESS 0x380009 /end MEASUREMENT
/begin MEASUREMENT B_accpc_um "" UBYTE B_TRUE 1 100 0.00 1.00000000000 BIT_MASK 0x8 FORMAT "%13.11" ECU_ADDRESS 0x380003 /end MEASUREMENT
/begin MEASUREMENT B_asgphnpl_bt "" UWORD B_TRUE 1 100 0.00 1.00000000000 BIT_MASK 0x4 FORMAT "%13.11" ECU_ADDRESS 0xFD0A /end MEASUREMENT
/begin MEASUREMENT B_asgpli_bt "" UWORD B_TRUE 1 100 0.00 1.00000000000 BIT_MASK 0x8 FORMAT "%13.11" ECU_ADDRESS 0xFD0A /end MEASUREMENT
/begin MEASUREMENT B_bboak_um "" UBYTE B_TRUE 1 100 0.00 1.00000000000 BIT_MASK 0x2 FORMAT "%13.11" ECU_ADDRESS 0x380004 /end MEASUREMENT
/begin MEASUREMENT B_bboe_um "" UBYTE B_TRUE 1 100 0.00 1.00000000000 BIT_MASK 0x8 FORMAT "%13.11" ECU_ADDRESS 0x380004 /end MEASUREMENT
/begin MEASUREMENT B_bbovf_um "" UBYTE B_TRUE 1 100 0.00 1.00000000000 BIT_MASK 0x4 FORMAT "%13.11" ECU_ADDRESS 0x380004 /end MEASUREMENT
/begin MEASUREMENT B_blspc_um "" UBYTE B_TRUE 1 100 0.00 1.00000000000 BIT_MASK 0x40 FORMAT "%13.11" ECU_ADDRESS 0x380003 /end MEASUREMENT
/begin MEASUREMENT B_bls_um "" UBYTE B_TRUE 1 100 0.00 1.00000000000 BIT_MASK 0x8 FORMAT "%13.11" ECU_ADDRESS 0x380009 /end MEASUREMENT
/begin MEASUREMENT B_brems_um "" UBYTE B_TRUE 1 100 0.00 1.00000000000 BIT_MASK 0x1 FORMAT "%13.11" ECU_ADDRESS 0x380008 /end MEASUREMENT
/begin MEASUREMENT B_brfgr_um "" UBYTE B_TRUE 1 100 0.00 1.00000000000 BIT_MASK 0x2 FORMAT "%13.11" ECU_ADDRESS 0x380009 /end MEASUREMENT
/begin MEASUREMENT B_bsl_um "" UBYTE B_TRUE 1 100 0.00 1.00000000000 BIT_MASK 0x10 FORMAT "%13.11" ECU_ADDRESS 0x380008 /end MEASUREMENT
/begin MEASUREMENT B_dcdis_c_um "" UBYTE B_TRUE 1 100 0.00 1.00000000000 BIT_MASK 0x1 FORMAT "%13.11" ECU_ADDRESS 0x38000A /end MEASUREMENT
/begin MEASUREMENT B_dcdis_um "" UBYTE B_TRUE 1 100 0.00 1.00000000000 BIT_MASK 0x1 FORMAT "%13.11" ECU_ADDRESS 0x380007 /end MEASUREMENT
/begin MEASUREMENT B_eculock "" UWORD B_TRUE 1 100 0.00 1.00000000000 BIT_MASK 0x400 FORMAT "%13.11" ECU_ADDRESS 0xFD8C /end MEASUREMENT
/begin MEASUREMENT B_emintmx_uc "" UWORD B_TRUE 1 100 0.00 1.00000000000 BIT_MASK 0x10 FORMAT "%13.11" ECU_ADDRESS 0xFD0A /end MEASUREMENT
/begin MEASUREMENT B_emint_uc "" UWORD B_TRUE 1 100 0.00 1.00000000000 BIT_MASK 0x20 FORMAT "%13.11" ECU_ADDRESS 0xFD0A /end MEASUREMENT
/begin MEASUREMENT B_fabr_um "" UBYTE B_TRUE 1 100 0.00 1.00000000000 BIT_MASK 0x1 FORMAT "%13.11" ECU_ADDRESS 0x380004 /end MEASUREMENT
/begin MEASUREMENT B_ff "" UWORD B_TRUE 1 100 0.00 1.00000000000 BIT_MASK 0x4000 FORMAT "%13.11" ECU_ADDRESS 0xFDC4 /end MEASUREMENT
/begin MEASUREMENT B_fgrca_um "" UBYTE B_TRUE 1 100 0.00 1.00000000000 BIT_MASK 0x1 FORMAT "%13.11" ECU_ADDRESS 0x380005 /end MEASUREMENT
/begin MEASUREMENT B_fgrenold_um "" UBYTE B_TRUE 1 100 0.00 1.00000000000 BIT_MASK 0x80 FORMAT "%13.11" ECU_ADDRESS 0x380008 /end MEASUREMENT
/begin MEASUREMENT B_fgren_um "" UBYTE B_TRUE 1 100 0.00 1.00000000000 BIT_MASK 0x4 FORMAT "%13.11" ECU_ADDRESS 0x380008 /end MEASUREMENT
/begin MEASUREMENT B_fgron_um "" UBYTE B_TRUE 1 100 0.00 1.00000000000 BIT_MASK 0x4 FORMAT "%13.11" ECU_ADDRESS 0x380009 /end MEASUREMENT
/begin MEASUREMENT B_fgrpc_um "" UBYTE B_TRUE 1 100 0.00 1.00000000000 BIT_MASK 0x80 FORMAT "%13.11" ECU_ADDRESS 0x380003 /end MEASUREMENT
/begin MEASUREMENT B_fgr_bt "" UBYTE B_TRUE 1 100 0.00 1.00000000000 BIT_MASK 0x10 FORMAT "%13.11" ECU_ADDRESS 0xFD0C /end MEASUREMENT
/begin MEASUREMENT B_fgr_uc "" UWORD B_TRUE 1 100 0.00 1.00000000000 BIT_MASK 0x20 FORMAT "%13.11" ECU_ADDRESS 0xFD0C /end MEASUREMENT
/begin MEASUREMENT B_fgr_um_c "" UBYTE B_TRUE 1 100 0.00 1.00000000000 BIT_MASK 0x2 FORMAT "%13.11" ECU_ADDRESS 0x38000A /end MEASUREMENT
/begin MEASUREMENT b_flags_uc "" UBYTE dez 1 100 0.00 255.0 FORMAT "%5.1" ECU_ADDRESS 0xF0559 /end MEASUREMENT
/begin MEASUREMENT b_flags_um "" UBYTE dez 1 100 0.00 255.0 FORMAT "%5.1" ECU_ADDRESS 0x380002 /end MEASUREMENT
/begin MEASUREMENT B_i_ska "" UBYTE B_TRUE 1 100 0.00 1.00000000000 BIT_MASK 0x4 FORMAT "%13.11" ECU_ADDRESS 0x380007 /end MEASUREMENT
/begin MEASUREMENT B_i_ska_uc "" UWORD B_TRUE 1 100 0.00 1.00000000000 BIT_MASK 0x200 FORMAT "%13.11" ECU_ADDRESS 0xFD08 /end MEASUREMENT
/begin MEASUREMENT B_i_ska_um "" UWORD B_TRUE 1 100 0.00 1.00000000000 BIT_MASK 0x100 FORMAT "%13.11" ECU_ADDRESS 0xFD08 /end MEASUREMENT
/begin MEASUREMENT B_kfzk "" UBYTE B_TRUE 1 100 0.00 1.00000000000 BIT_MASK 0x1 FORMAT "%13.11" ECU_ADDRESS 0x382149 /end MEASUREMENT
/begin MEASUREMENT B_kkl_um "" UBYTE B_TRUE 1 100 0.00 1.00000000000 BIT_MASK 0x40 FORMAT "%13.11" ECU_ADDRESS 0x380008 /end MEASUREMENT
/begin MEASUREMENT B_klmzu_uc "" UWORD B_TRUE 1 100 0.00 1.00000000000 BIT_MASK 0x4000 FORMAT "%13.11" ECU_ADDRESS 0xFD0C /end MEASUREMENT
/begin MEASUREMENT B_klmzu_um "" UWORD B_TRUE 1 100 0.00 1.00000000000 BIT_MASK 0x2000 FORMAT "%13.11" ECU_ADDRESS 0xFD0C /end MEASUREMENT
/begin MEASUREMENT B_ll_um "" UBYTE B_TRUE 1 100 0.00 1.00000000000 BIT_MASK 0x1 FORMAT "%13.11" ECU_ADDRESS 0x380002 /end MEASUREMENT
/begin MEASUREMENT B_mcacti "" UWORD B_TRUE 1 100 0.00 1.00000000000 BIT_MASK 0x100 FORMAT "%13.11" ECU_ADDRESS 0xFD0E /end MEASUREMENT
/begin MEASUREMENT B_msrmx_um "" UBYTE B_TRUE 1 100 0.00 1.00000000000 BIT_MASK 0x2 FORMAT "%13.11" ECU_ADDRESS 0x380003 /end MEASUREMENT
/begin MEASUREMENT B_msrpc_um "" UBYTE B_TRUE 1 100 0.00 1.00000000000 BIT_MASK 0x10 FORMAT "%13.11" ECU_ADDRESS 0x380003 /end MEASUREMENT
/begin MEASUREMENT B_msthw_um "" UBYTE B_TRUE 1 100 0.00 1.00000000000 BIT_MASK 0x80 FORMAT "%13.11" ECU_ADDRESS 0x38000A /end MEASUREMENT
/begin MEASUREMENT B_munst "" UWORD B_TRUE 1 100 0.00 1.00000000000 BIT_MASK 0x200 FORMAT "%13.11" ECU_ADDRESS 0xFD6E /end MEASUREMENT
/begin MEASUREMENT B_mzns_c_um "" UBYTE B_TRUE 1 100 0.00 1.00000000000 BIT_MASK 0x20 FORMAT "%13.11" ECU_ADDRESS 0x38000A /end MEASUREMENT
/begin MEASUREMENT B_mzns_um "" UWORD B_TRUE 1 100 0.00 1.00000000000 BIT_MASK 0x8000 FORMAT "%13.11" ECU_ADDRESS 0xFD08 /end MEASUREMENT
/begin MEASUREMENT B_nlh_um "" UBYTE B_TRUE 1 100 0.00 1.00000000000 BIT_MASK 0x4 FORMAT "%13.11" ECU_ADDRESS 0x380002 /end MEASUREMENT
/begin MEASUREMENT B_nobrs_um "" UBYTE B_TRUE 1 100 0.00 1.00000000000 BIT_MASK 0x80 FORMAT "%13.11" ECU_ADDRESS 0x380002 /end MEASUREMENT
/begin MEASUREMENT B_nome_c_um "" UBYTE B_TRUE 1 100 0.00 1.00000000000 BIT_MASK 0x8 FORMAT "%13.11" ECU_ADDRESS 0x38000A /end MEASUREMENT
/begin MEASUREMENT B_nomsr_bt "" UWORD B_TRUE 1 100 0.00 1.00000000000 BIT_MASK 0x100 FORMAT "%13.11" ECU_ADDRESS 0xFD0C /end MEASUREMENT
/begin MEASUREMENT B_nomsr_uc "" UWORD B_TRUE 1 100 0.00 1.00000000000 BIT_MASK 0x200 FORMAT "%13.11" ECU_ADDRESS 0xFD0C /end MEASUREMENT
/begin MEASUREMENT B_nosgs_uc "" UWORD B_TRUE 1 100 0.00 1.00000000000 BIT_MASK 0x40 FORMAT "%13.11" ECU_ADDRESS 0xFD0A /end MEASUREMENT
/begin MEASUREMENT B_nosgs_um "" UWORD B_TRUE 1 100 0.00 1.00000000000 BIT_MASK 0x1 FORMAT "%13.11" ECU_ADDRESS 0xFD0A /end MEASUREMENT
/begin MEASUREMENT B_notlu "" UBYTE B_TRUE 1 100 0.00 1.00000000000 BIT_MASK 0x8 FORMAT "%13.11" ECU_ADDRESS 0x380007 /end MEASUREMENT
/begin MEASUREMENT B_notst_um "" UBYTE B_TRUE 1 100 0.00 1.00000000000 BIT_MASK 0x8 FORMAT "%13.11" ECU_ADDRESS 0x380002 /end MEASUREMENT
/begin MEASUREMENT B_npmsr_uc "" UWORD B_TRUE 1 100 0.00 1.00000000000 BIT_MASK 0x400 FORMAT "%13.11" ECU_ADDRESS 0xFD0C /end MEASUREMENT
/begin MEASUREMENT B_nsakt_um "" UBYTE B_TRUE 1 100 0.00 1.00000000000 BIT_MASK 0x4 FORMAT "%13.11" ECU_ADDRESS 0x380006 /end MEASUREMENT
/begin MEASUREMENT B_nsend_um "" UBYTE B_TRUE 1 100 0.00 1.00000000000 BIT_MASK 0x1 FORMAT "%13.11" ECU_ADDRESS 0x380006 /end MEASUREMENT
/begin MEASUREMENT B_nwcoa "" UWORD B_TRUE 1 100 0.00 1.00000000000 BIT_MASK 0x8 FORMAT "%13.11" ECU_ADDRESS 0xFDC2 /end MEASUREMENT
/begin MEASUREMENT B_nwcoe "" UWORD B_TRUE 1 100 0.00 1.00000000000 BIT_MASK 0x100 FORMAT "%13.11" ECU_ADDRESS 0xFDC0 /end MEASUREMENT
/begin MEASUREMENT B_nwha "" UWORD B_TRUE 1 100 0.00 1.00000000000 BIT_MASK 0x10 FORMAT "%13.11" ECU_ADDRESS 0xFDC2 /end MEASUREMENT
/begin MEASUREMENT B_nwhe "" UWORD B_TRUE 1 100 0.00 1.00000000000 BIT_MASK 0x200 FORMAT "%13.11" ECU_ADDRESS 0xFDC0 /end MEASUREMENT
/begin MEASUREMENT B_nwiva "" UWORD B_TRUE 1 100 0.00 1.00000000000 BIT_MASK 0x20 FORMAT "%13.11" ECU_ADDRESS 0xFDC2 /end MEASUREMENT
/begin MEASUREMENT B_nwive "" UWORD B_TRUE 1 100 0.00 1.00000000000 BIT_MASK 0x400 FORMAT "%13.11" ECU_ADDRESS 0xFDC0 /end MEASUREMENT
/begin MEASUREMENT B_nwscoa "" UWORD B_TRUE 1 100 0.00 1.00000000000 BIT_MASK 0x40 FORMAT "%13.11" ECU_ADDRESS 0xFDC2 /end MEASUREMENT
/begin MEASUREMENT B_nwscoe "" UWORD B_TRUE 1 100 0.00 1.00000000000 BIT_MASK 0x800 FORMAT "%13.11" ECU_ADDRESS 0xFDC0 /end MEASUREMENT
/begin MEASUREMENT B_nwvha "" UWORD B_TRUE 1 100 0.00 1.00000000000 BIT_MASK 0x80 FORMAT "%13.11" ECU_ADDRESS 0xFDC2 /end MEASUREMENT
/begin MEASUREMENT B_nwvhe "" UWORD B_TRUE 1 100 0.00 1.00000000000 BIT_MASK 0x1000 FORMAT "%13.11" ECU_ADDRESS 0xFDC0 /end MEASUREMENT
/begin MEASUREMENT B_nwvna "" UWORD B_TRUE 1 100 0.00 1.00000000000 BIT_MASK 0x100 FORMAT "%13.11" ECU_ADDRESS 0xFDC2 /end MEASUREMENT
/begin MEASUREMENT B_nwvne "" UWORD B_TRUE 1 100 0.00 1.00000000000 BIT_MASK 0x2000 FORMAT "%13.11" ECU_ADDRESS 0xFDC0 /end MEASUREMENT
/begin MEASUREMENT B_nwvpa "" UWORD B_TRUE 1 100 0.00 1.00000000000 BIT_MASK 0x200 FORMAT "%13.11" ECU_ADDRESS 0xFDC2 /end MEASUREMENT
/begin MEASUREMENT B_nwvpe "" UWORD B_TRUE 1 100 0.00 1.00000000000 BIT_MASK 0x4000 FORMAT "%13.11" ECU_ADDRESS 0xFDC0 /end MEASUREMENT
/begin MEASUREMENT B_pwgnotum "" UWORD B_TRUE 1 100 0.00 1.00000000000 BIT_MASK 0x2 FORMAT "%13.11" ECU_ADDRESS 0xFD0C /end MEASUREMENT
/begin MEASUREMENT B_res_um "" UBYTE B_TRUE 1 100 0.00 1.00000000000 BIT_MASK 0x2 FORMAT "%13.11" ECU_ADDRESS 0x380008 /end MEASUREMENT
/begin MEASUREMENT B_rlini_um "" UBYTE B_TRUE 1 100 0.00 1.00000000000 BIT_MASK 0x20 FORMAT "%13.11" ECU_ADDRESS 0x380002 /end MEASUREMENT
/begin MEASUREMENT B_rluf_um "" UBYTE B_TRUE 1 100 0.00 1.00000000000 BIT_MASK 0x2 FORMAT "%13.11" ECU_ADDRESS 0x380002 /end MEASUREMENT
/begin MEASUREMENT B_sgsmx_um "" UBYTE B_TRUE 1 100 0.00 1.00000000000 BIT_MASK 0x10 FORMAT "%13.11" ECU_ADDRESS 0x380002 /end MEASUREMENT
/begin MEASUREMENT B_sgspc_um "" UBYTE B_TRUE 1 100 0.00 1.00000000000 BIT_MASK 0x20 FORMAT "%13.11" ECU_ADDRESS 0x380003 /end MEASUREMENT
/begin MEASUREMENT B_sgspl_uc "" UWORD B_TRUE 1 100 0.00 1.00000000000 BIT_MASK 0x80 FORMAT "%13.11" ECU_ADDRESS 0xFD0A /end MEASUREMENT
/begin MEASUREMENT B_sgspl_um "" UWORD B_TRUE 1 100 0.00 1.00000000000 BIT_MASK 0x2 FORMAT "%13.11" ECU_ADDRESS 0xFD0A /end MEASUREMENT
/begin MEASUREMENT B_swdy "" UWORD B_TRUE 1 100 0.00 1.00000000000 BIT_MASK 0x8000 FORMAT "%13.11" ECU_ADDRESS 0xFDC4 /end MEASUREMENT
/begin MEASUREMENT B_tfwdksom "" UWORD B_TRUE 1 100 0.00 1.00000000000 BIT_MASK 0x400 FORMAT "%13.11" ECU_ADDRESS 0xFD6E /end MEASUREMENT
/begin MEASUREMENT B_ubska_c_um "" UBYTE B_TRUE 1 100 0.00 1.00000000000 BIT_MASK 0x10 FORMAT "%13.11" ECU_ADDRESS 0x38000A /end MEASUREMENT
/begin MEASUREMENT B_ub_ska "" UBYTE B_TRUE 1 100 0.00 1.00000000000 BIT_MASK 0x2 FORMAT "%13.11" ECU_ADDRESS 0x380007 /end MEASUREMENT
/begin MEASUREMENT B_ufol_um "" UBYTE B_TRUE 1 100 0.00 1.00000000000 BIT_MASK 0x40 FORMAT "%13.11" ECU_ADDRESS 0x380002 /end MEASUREMENT
/begin MEASUREMENT B_vmax "" UWORD B_TRUE 1 100 0.00 1.00000000000 BIT_MASK 0x100 FORMAT "%13.11" ECU_ADDRESS 0xFDAC /end MEASUREMENT
/begin MEASUREMENT B_vzl_um "" UBYTE B_TRUE 1 100 0.00 1.00000000000 BIT_MASK 0x8 FORMAT "%13.11" ECU_ADDRESS 0x380008 /end MEASUREMENT
/begin MEASUREMENT B_wal_um "" UBYTE B_TRUE 1 100 0.00 1.00000000000 BIT_MASK 0x20 FORMAT "%13.11" ECU_ADDRESS 0x380008 /end MEASUREMENT
/begin MEASUREMENT B_wdksom "" UWORD B_TRUE 1 100 0.00 1.00000000000 BIT_MASK 0x800 FORMAT "%13.11" ECU_ADDRESS 0xFD6E /end MEASUREMENT
/begin MEASUREMENT B_wfs00ur "" UBYTE B_TRUE 1 100 0.00 1.00000000000 BIT_MASK 0x80 FORMAT "%13.11" ECU_ADDRESS 0xE19E /end MEASUREMENT
/begin MEASUREMENT B_wfs58ur "" UBYTE B_TRUE 1 100 0.00 1.00000000000 BIT_MASK 0x40 FORMAT "%13.11" ECU_ADDRESS 0xE19E /end MEASUREMENT
/begin MEASUREMENT B_wfsaudis "" UBYTE B_TRUE 1 100 0.00 1.00000000000 BIT_MASK 0x2 FORMAT "%13.11" ECU_ADDRESS 0xE1A0 /end MEASUREMENT
/begin MEASUREMENT B_wfsautos "" UBYTE B_TRUE 1 100 0.00 1.00000000000 BIT_MASK 0x1 FORMAT "%13.11" ECU_ADDRESS 0xE1A0 /end MEASUREMENT
/begin MEASUREMENT B_wfsch50t "" UBYTE B_TRUE 1 100 0.00 1.00000000000 BIT_MASK 0x80 FORMAT "%13.11" ECU_ADDRESS 0xE19B /end MEASUREMENT
/begin MEASUREMENT B_wfscheck "" UBYTE B_TRUE 1 100 0.00 1.00000000000 BIT_MASK 0x4 FORMAT "%13.11" ECU_ADDRESS 0xE19A /end MEASUREMENT
/begin MEASUREMENT B_wfscrynl "" UBYTE B_TRUE 1 100 0.00 1.00000000000 BIT_MASK 0x2 FORMAT "%13.11" ECU_ADDRESS 0x382073 /end MEASUREMENT
/begin MEASUREMENT B_wfscryva "" UBYTE B_TRUE 1 100 0.00 1.00000000000 BIT_MASK 0x1 FORMAT "%13.11" ECU_ADDRESS 0x382073 /end MEASUREMENT
/begin MEASUREMENT B_wfsdelay "" UBYTE B_TRUE 1 100 0.00 1.00000000000 BIT_MASK 0x4 FORMAT "%13.11" ECU_ADDRESS 0xE1A1 /end MEASUREMENT
/begin MEASUREMENT B_wfsdgrdy "" UBYTE B_TRUE 1 100 0.00 1.00000000000 BIT_MASK 0x1 FORMAT "%13.11" ECU_ADDRESS 0xF411B /end MEASUREMENT
/begin MEASUREMENT B_wfsdisab "" UBYTE B_TRUE 1 100 0.00 1.00000000000 BIT_MASK 0x2 FORMAT "%13.11" ECU_ADDRESS 0xE19B /end MEASUREMENT
/begin MEASUREMENT B_wfsdwndd "" UBYTE B_TRUE 1 100 0.00 1.00000000000 BIT_MASK 0x10 FORMAT "%13.11" ECU_ADDRESS 0xE1A0 /end MEASUREMENT
/begin MEASUREMENT B_wfsdwnst "" UBYTE B_TRUE 1 100 0.00 1.00000000000 BIT_MASK 0x80 FORMAT "%13.11" ECU_ADDRESS 0xE1A0 /end MEASUREMENT
/begin MEASUREMENT B_wfseepnl "" UBYTE B_TRUE 1 100 0.00 1.00000000000 BIT_MASK 0x2 FORMAT "%13.11" ECU_ADDRESS 0xF4119 /end MEASUREMENT
/begin MEASUREMENT B_wfsepast "" UBYTE B_TRUE 1 100 0.00 1.00000000000 BIT_MASK 0x4 FORMAT "%13.11" ECU_ADDRESS 0xE19E /end MEASUREMENT
/begin MEASUREMENT B_wfsepctr "" UBYTE B_TRUE 1 100 0.00 1.00000000000 BIT_MASK 0x10 FORMAT "%13.11" ECU_ADDRESS 0xE19E /end MEASUREMENT
/begin MEASUREMENT B_wfsepn0 "" UBYTE B_TRUE 1 100 0.00 1.00000000000 BIT_MASK 0x1 FORMAT "%13.11" ECU_ADDRESS 0xE19F /end MEASUREMENT
/begin MEASUREMENT B_wfsepn1 "" UBYTE B_TRUE 1 100 0.00 1.00000000000 BIT_MASK 0x2 FORMAT "%13.11" ECU_ADDRESS 0xE19F /end MEASUREMENT
/begin MEASUREMENT B_wfsepn2 "" UBYTE B_TRUE 1 100 0.00 1.00000000000 BIT_MASK 0x4 FORMAT "%13.11" ECU_ADDRESS 0xE19F /end MEASUREMENT
/begin MEASUREMENT B_wfsepn3 "" UBYTE B_TRUE 1 100 0.00 1.00000000000 BIT_MASK 0x8 FORMAT "%13.11" ECU_ADDRESS 0xE19F /end MEASUREMENT
/begin MEASUREMENT B_wfsepn4 "" UBYTE B_TRUE 1 100 0.00 1.00000000000 BIT_MASK 0x10 FORMAT "%13.11" ECU_ADDRESS 0xE19F /end MEASUREMENT
/begin MEASUREMENT B_wfsepn5 "" UBYTE B_TRUE 1 100 0.00 1.00000000000 BIT_MASK 0x20 FORMAT "%13.11" ECU_ADDRESS 0xE19F /end MEASUREMENT
/begin MEASUREMENT B_wfsepn6 "" UBYTE B_TRUE 1 100 0.00 1.00000000000 BIT_MASK 0x40 FORMAT "%13.11" ECU_ADDRESS 0xE19F /end MEASUREMENT
/begin MEASUREMENT B_wfsepn7 "" UBYTE B_TRUE 1 100 0.00 1.00000000000 BIT_MASK 0x80 FORMAT "%13.11" ECU_ADDRESS 0xE19F /end MEASUREMENT
/begin MEASUREMENT B_wfsepnok "" UBYTE B_TRUE 1 100 0.00 1.00000000000 BIT_MASK 0x2 FORMAT "%13.11" ECU_ADDRESS 0xE19E /end MEASUREMENT
/begin MEASUREMENT B_wfsepok "" UBYTE B_TRUE 1 100 0.00 1.00000000000 BIT_MASK 0x1 FORMAT "%13.11" ECU_ADDRESS 0xE19E /end MEASUREMENT
/begin MEASUREMENT B_wfseptst "" UBYTE B_TRUE 1 100 0.00 1.00000000000 BIT_MASK 0x8 FORMAT "%13.11" ECU_ADDRESS 0xE19E /end MEASUREMENT
/begin MEASUREMENT B_wfsflsh "" UBYTE B_TRUE 1 100 0.00 1.00000000000 BIT_MASK 0x8 FORMAT "%13.11" ECU_ADDRESS 0xE1A0 /end MEASUREMENT
/begin MEASUREMENT B_wfsfrest "" UBYTE B_TRUE 1 100 0.00 1.00000000000 BIT_MASK 0x4 FORMAT "%13.11" ECU_ADDRESS 0xE1A0 /end MEASUREMENT
/begin MEASUREMENT B_wfslnact "" UBYTE B_TRUE 1 100 0.00 1.00000000000 BIT_MASK 0x40 FORMAT "%13.11" ECU_ADDRESS 0xE1A0 /end MEASUREMENT
/begin MEASUREMENT B_wfslnnok "" UBYTE B_TRUE 1 100 0.00 1.00000000000 BIT_MASK 0x1 FORMAT "%13.11" ECU_ADDRESS 0xE1A1 /end MEASUREMENT
/begin MEASUREMENT B_wfsload "" UWORD B_TRUE 1 100 0.00 1.00000000000 BIT_MASK 0x200 FORMAT "%13.11" ECU_ADDRESS 0xFD8C /end MEASUREMENT
/begin MEASUREMENT B_wfsnlrq "" UBYTE B_TRUE 1 100 0.00 1.00000000000 BIT_MASK 0x1 FORMAT "%13.11" ECU_ADDRESS 0xF4119 /end MEASUREMENT
/begin MEASUREMENT B_wfsnplau "" UBYTE B_TRUE 1 100 0.00 1.00000000000 BIT_MASK 0x8 FORMAT "%13.11" ECU_ADDRESS 0xE19A /end MEASUREMENT
/begin MEASUREMENT B_wfsp2max "" UBYTE B_TRUE 1 100 0.00 1.00000000000 BIT_MASK 0x4 FORMAT "%13.11" ECU_ADDRESS 0xE19D /end MEASUREMENT
/begin MEASUREMENT B_wfsp2sta "" UBYTE B_TRUE 1 100 0.00 1.00000000000 BIT_MASK 0x1 FORMAT "%13.11" ECU_ADDRESS 0xE19D /end MEASUREMENT
/begin MEASUREMENT B_wfsp2to "" UBYTE B_TRUE 1 100 0.00 1.00000000000 BIT_MASK 0x2 FORMAT "%13.11" ECU_ADDRESS 0xE19D /end MEASUREMENT
/begin MEASUREMENT B_wfsrcnl "" UBYTE B_TRUE 1 100 0.00 1.00000000000 BIT_MASK 0x2 FORMAT "%13.11" ECU_ADDRESS 0xF411B /end MEASUREMENT
/begin MEASUREMENT B_wfsretry "" UBYTE B_TRUE 1 100 0.00 1.00000000000 BIT_MASK 0x8 FORMAT "%13.11" ECU_ADDRESS 0xE19B /end MEASUREMENT
/begin MEASUREMENT B_wfsrpm "" UBYTE B_TRUE 1 100 0.00 1.00000000000 BIT_MASK 0x4 FORMAT "%13.11" ECU_ADDRESS 0xE19B /end MEASUREMENT
/begin MEASUREMENT B_wfsrqdc "" UBYTE B_TRUE 1 100 0.00 1.00000000000 BIT_MASK 0x1 FORMAT "%13.11" ECU_ADDRESS 0xE19C /end MEASUREMENT
/begin MEASUREMENT B_wfsrqdce "" UBYTE B_TRUE 1 100 0.00 1.00000000000 BIT_MASK 0x2 FORMAT "%13.11" ECU_ADDRESS 0xE19C /end MEASUREMENT
/begin MEASUREMENT B_wfsrqdd "" UBYTE B_TRUE 1 100 0.00 1.00000000000 BIT_MASK 0x10 FORMAT "%13.11" ECU_ADDRESS 0xE19C /end MEASUREMENT
/begin MEASUREMENT B_wfsrqdde "" UBYTE B_TRUE 1 100 0.00 1.00000000000 BIT_MASK 0x20 FORMAT "%13.11" ECU_ADDRESS 0xE19C /end MEASUREMENT
/begin MEASUREMENT B_wfsrqtpc "" UBYTE B_TRUE 1 100 0.00 1.00000000000 BIT_MASK 0x40 FORMAT "%13.11" ECU_ADDRESS 0xE19B /end MEASUREMENT
/begin MEASUREMENT B_wfsrqtpo "" UBYTE B_TRUE 1 100 0.00 1.00000000000 BIT_MASK 0x20 FORMAT "%13.11" ECU_ADDRESS 0xE19B /end MEASUREMENT
/begin MEASUREMENT B_wfsrqvc "" UBYTE B_TRUE 1 100 0.00 1.00000000000 BIT_MASK 0x10 FORMAT "%13.11" ECU_ADDRESS 0xE19D /end MEASUREMENT
/begin MEASUREMENT B_wfsrqvce "" UBYTE B_TRUE 1 100 0.00 1.00000000000 BIT_MASK 0x20 FORMAT "%13.11" ECU_ADDRESS 0xE19D /end MEASUREMENT
/begin MEASUREMENT B_wfsrqvd "" UBYTE B_TRUE 1 100 0.00 1.00000000000 BIT_MASK 0x40 FORMAT "%13.11" ECU_ADDRESS 0xE19D /end MEASUREMENT
/begin MEASUREMENT B_wfsrqvde "" UBYTE B_TRUE 1 100 0.00 1.00000000000 BIT_MASK 0x80 FORMAT "%13.11" ECU_ADDRESS 0xE19D /end MEASUREMENT
/begin MEASUREMENT B_wfsrsdc "" UBYTE B_TRUE 1 100 0.00 1.00000000000 BIT_MASK 0x40 FORMAT "%13.11" ECU_ADDRESS 0xE19C /end MEASUREMENT
/begin MEASUREMENT B_wfsrsdce "" UBYTE B_TRUE 1 100 0.00 1.00000000000 BIT_MASK 0x80 FORMAT "%13.11" ECU_ADDRESS 0xE19C /end MEASUREMENT
/begin MEASUREMENT B_wfsrsdd "" UBYTE B_TRUE 1 100 0.00 1.00000000000 BIT_MASK 0x4 FORMAT "%13.11" ECU_ADDRESS 0xE19C /end MEASUREMENT
/begin MEASUREMENT B_wfsrsdde "" UBYTE B_TRUE 1 100 0.00 1.00000000000 BIT_MASK 0x8 FORMAT "%13.11" ECU_ADDRESS 0xE19C /end MEASUREMENT
/begin MEASUREMENT B_wfsrsnet "" UBYTE B_TRUE 1 100 0.00 1.00000000000 BIT_MASK 0x20 FORMAT "%13.11" ECU_ADDRESS 0xE19E /end MEASUREMENT
/begin MEASUREMENT B_wfsstaok "" UBYTE B_TRUE 1 100 0.00 1.00000000000 BIT_MASK 0x80 FORMAT "%13.11" ECU_ADDRESS 0xE19A /end MEASUREMENT
/begin MEASUREMENT B_wfstpco "" UBYTE B_TRUE 1 100 0.00 1.00000000000 BIT_MASK 0x10 FORMAT "%13.11" ECU_ADDRESS 0xE19B /end MEASUREMENT
/begin MEASUREMENT B_wfsulem "" UBYTE B_TRUE 1 100 0.00 1.00000000000 BIT_MASK 0x2 FORMAT "%13.11" ECU_ADDRESS 0xE19A /end MEASUREMENT
/begin MEASUREMENT B_wfsvine "" UBYTE B_TRUE 1 100 0.00 1.00000000000 BIT_MASK 0x8 FORMAT "%13.11" ECU_ADDRESS 0xE19D /end MEASUREMENT
/begin MEASUREMENT B_wfswin1 "" UBYTE B_TRUE 1 100 0.00 1.00000000000 BIT_MASK 0x2 FORMAT "%13.11" ECU_ADDRESS 0xE1A1 /end MEASUREMENT
/begin MEASUREMENT B_wfswin2 "" UBYTE B_TRUE 1 100 0.00 1.00000000000 BIT_MASK 0x10 FORMAT "%13.11" ECU_ADDRESS 0xE19A /end MEASUREMENT
/begin MEASUREMENT B_wkauf_bt "" UWORD B_TRUE 1 100 0.00 1.00000000000 BIT_MASK 0x100 FORMAT "%13.11" ECU_ADDRESS 0xFD0A /end MEASUREMENT
/begin MEASUREMENT B_wkr_bt "" UWORD B_TRUE 1 100 0.00 1.00000000000 BIT_MASK 0x200 FORMAT "%13.11" ECU_ADDRESS 0xFD0A /end MEASUREMENT
/begin MEASUREMENT B_wnwsaii "" UWORD B_TRUE 1 100 0.00 1.00000000000 BIT_MASK 0x400 FORMAT "%13.11" ECU_ADDRESS 0xFDC2 /end MEASUREMENT
/begin MEASUREMENT B_wnwsait "" UWORD B_TRUE 1 100 0.00 1.00000000000 BIT_MASK 0x800 FORMAT "%13.11" ECU_ADDRESS 0xFDC2 /end MEASUREMENT
/begin MEASUREMENT B_wnwseii "" UWORD B_TRUE 1 100 0.00 1.00000000000 BIT_MASK 0x8000 FORMAT "%13.11" ECU_ADDRESS 0xFDC0 /end MEASUREMENT
/begin MEASUREMENT B_wnwseit "" UWORD B_TRUE 1 100 0.00 1.00000000000 BIT_MASK 0x1 FORMAT "%13.11" ECU_ADDRESS 0xFDC2 /end MEASUREMENT
/begin MEASUREMENT B_zb "" UWORD B_TRUE 1 100 0.00 1.00000000000 BIT_MASK 0x1 FORMAT "%13.11" ECU_ADDRESS 0xFDC6 /end MEASUREMENT
/begin MEASUREMENT B_zges_bt "" UWORD B_TRUE 1 100 0.00 1.00000000000 BIT_MASK 0x400 FORMAT "%13.11" ECU_ADDRESS 0xFD0A /end MEASUREMENT
/begin MEASUREMENT B_zuesa "" UWORD B_TRUE 1 100 0.00 1.00000000000 BIT_MASK 0x2 FORMAT "%13.11" ECU_ADDRESS 0xFDC6 /end MEASUREMENT
/begin MEASUREMENT B_zwkra "" UWORD B_TRUE 1 100 0.00 1.00000000000 BIT_MASK 0x2000 FORMAT "%13.11" ECU_ADDRESS 0xFDC4 /end MEASUREMENT
/begin MEASUREMENT B_zwmnpst "" UWORD B_TRUE 1 100 0.00 1.00000000000 BIT_MASK 0x80 FORMAT "%13.11" ECU_ADDRESS 0xFDC4 /end MEASUREMENT
/begin MEASUREMENT B_zwms "" UWORD B_TRUE 1 100 0.00 1.00000000000 BIT_MASK 0x100 FORMAT "%13.11" ECU_ADDRESS 0xFDC4 /end MEASUREMENT
/begin MEASUREMENT cmdError_w "" UWORD dez 1 100 0.00 65535.00 FORMAT "%8.2" ECU_ADDRESS 0xF21C8 /end MEASUREMENT
/begin MEASUREMENT c_flags_uc "" UBYTE dez 1 100 0.00 255.0 FORMAT "%5.1" ECU_ADDRESS 0xF055A /end MEASUREMENT
/begin MEASUREMENT c_flags_um "" UBYTE dez 1 100 0.00 255.0 FORMAT "%5.1" ECU_ADDRESS 0x380003 /end MEASUREMENT
/begin MEASUREMENT dbmsr_c_uc "" UBYTE t40ms_ub_b10200 1 100 0.00 10200.0 FORMAT "%7.1" ECU_ADDRESS 0xF0571 /end MEASUREMENT
/begin MEASUREMENT delayedTime_w "" UWORD t_wdt_high 1 100 0.00 53686.27 FORMAT "%8.2" ECU_ADDRESS 0x382154 /end MEASUREMENT
/begin MEASUREMENT dvsi_w "" SWORD vfzg_sw_q0p00781 1 100 -256.0000 255.9922 FORMAT "%8.4" ECU_ADDRESS 0xF4784 /end MEASUREMENT
/begin MEASUREMENT dwnwa_w "" SWORD kw_sw_b128 1 100 -128.0000 127.9961 FORMAT "%8.4" ECU_ADDRESS 0xF2BEA /end MEASUREMENT
/begin MEASUREMENT dwnwe_w "" SWORD kw_sw_b128 1 100 -128.0000 127.9961 FORMAT "%8.4" ECU_ADDRESS 0xF2B8C /end MEASUREMENT
/begin MEASUREMENT dwnwsa_w "" SWORD kw_sw_b128 1 100 -128.0000 127.9961 FORMAT "%8.4" ECU_ADDRESS 0xF2BEC /end MEASUREMENT
/begin MEASUREMENT dwnwse_w "" SWORD kw_sw_b128 1 100 -128.0000 127.9961 FORMAT "%8.4" ECU_ADDRESS 0xF2B8E /end MEASUREMENT
/begin MEASUREMENT dzw1_uc "" UBYTE zw_ub_q0p75 1 100 0.00 191.3 FORMAT "%5.1" ECU_ADDRESS 0xF057B /end MEASUREMENT
/begin MEASUREMENT dzw2_uc "" UBYTE zw_ub_q0p75 1 100 0.00 191.3 FORMAT "%5.1" ECU_ADDRESS 0xF057C /end MEASUREMENT
/begin MEASUREMENT dzwb2 "" SBYTE zw_sb_q0p75 1 100 -96.00 95.25 FORMAT "%5.2" ECU_ADDRESS 0xF0C48 /end MEASUREMENT
/begin MEASUREMENT dzwbankar "" SBYTE zw_sb_q0p75 1 100 -96.00 95.25 FORMAT "%5.2" ARRAY_SIZE 6 ECU_ADDRESS 0xF0C49 /end MEASUREMENT
/begin MEASUREMENT dzwdyntp "" SBYTE zw_sb_q0p75 1 100 -96.00 95.25 FORMAT "%5.2" ECU_ADDRESS 0xF0C3E /end MEASUREMENT
/begin MEASUREMENT dzwkg "" SBYTE zw_sb_q0p75 1 100 -96.00 95.25 FORMAT "%5.2" ECU_ADDRESS 0xF0C4F /end MEASUREMENT
/begin MEASUREMENT dzwmna "" SBYTE zw_sb_q0p75 1 100 -96.00 95.25 FORMAT "%5.2" ECU_ADDRESS 0xF41A9 /end MEASUREMENT
/begin MEASUREMENT dzwmnms "" SBYTE zw_sb_q0p75 1 100 -96.00 95.25 FORMAT "%5.2" ECU_ADDRESS 0xF41AA /end MEASUREMENT
/begin MEASUREMENT dzwspae "" SBYTE zw_sb_q0p75 1 100 -96.00 95.25 FORMAT "%5.2" ECU_ADDRESS 0xF0C3F /end MEASUREMENT
/begin MEASUREMENT dzwspma "" SBYTE zw_sb_q0p75 1 100 -96.00 95.25 FORMAT "%5.2" ECU_ADDRESS 0xF0C40 /end MEASUREMENT
/begin MEASUREMENT dzwtipin "" SBYTE zw_sb_q0p75 1 100 -96.00 95.25 FORMAT "%5.2" ECU_ADDRESS 0xF0C41 /end MEASUREMENT
/begin MEASUREMENT dzwwl "" SBYTE zw_sb_q0p75 1 100 -96.00 95.25 FORMAT "%5.2" ECU_ADDRESS 0xF0C6D /end MEASUREMENT
/begin MEASUREMENT dzwzk "" SBYTE zw_sb_q0p75 1 100 -96.00 95.25 FORMAT "%5.2" ECU_ADDRESS 0xF0C50 /end MEASUREMENT
/begin MEASUREMENT dzw_uc "" UBYTE zw_ub_q0p75 1 100 0.00 191.3 FORMAT "%5.1" ECU_ADDRESS 0xF057D /end MEASUREMENT
/begin MEASUREMENT d_flags_uc "" UBYTE dez 1 100 0.00 255.0 FORMAT "%5.1" ECU_ADDRESS 0xF055B /end MEASUREMENT
/begin MEASUREMENT d_flags_um "" UBYTE dez 1 100 0.00 255.0 FORMAT "%5.1" ECU_ADDRESS 0x380004 /end MEASUREMENT
/begin MEASUREMENT ei_adcc_um "" UWORD B_TRUE 1 100 0.00 1.00000000000 BIT_MASK 0x4 FORMAT "%13.11" ECU_ADDRESS 0xFD0E /end MEASUREMENT
/begin MEASUREMENT ei_ipa_um "" UWORD B_TRUE 1 100 0.00 1.00000000000 BIT_MASK 0x4000 FORMAT "%13.11" ECU_ADDRESS 0xFD0A /end MEASUREMENT
/begin MEASUREMENT ei_msrc_uc "" UWORD B_TRUE 1 100 0.00 1.00000000000 BIT_MASK 0x800 FORMAT "%13.11" ECU_ADDRESS 0xFD0C /end MEASUREMENT
/begin MEASUREMENT ei_mver_uc "" UWORD B_TRUE 1 100 0.00 1.00000000000 BIT_MASK 0x1 FORMAT "%13.11" ECU_ADDRESS 0xFD0E /end MEASUREMENT
/begin MEASUREMENT ei_mver_um "" UWORD B_TRUE 1 100 0.00 1.00000000000 BIT_MASK 0x8000 FORMAT "%13.11" ECU_ADDRESS 0xFD0C /end MEASUREMENT
/begin MEASUREMENT ei_nc_um "" UWORD B_TRUE 1 100 0.00 1.00000000000 BIT_MASK 0x4000 FORMAT "%13.11" ECU_ADDRESS 0xFD08 /end MEASUREMENT
/begin MEASUREMENT ei_reac_um "" UWORD B_TRUE 1 100 0.00 1.00000000000 BIT_MASK 0x2 FORMAT "%13.11" ECU_ADDRESS 0xFD0E /end MEASUREMENT
/begin MEASUREMENT ei_rlc_um "" UWORD B_TRUE 1 100 0.00 1.00000000000 BIT_MASK 0x8000 FORMAT "%13.11" ECU_ADDRESS 0xFD0A /end MEASUREMENT
/begin MEASUREMENT ei_rlip_um "" UWORD B_TRUE 1 100 0.00 1.00000000000 BIT_MASK 0x1 FORMAT "%13.11" ECU_ADDRESS 0xFD0C /end MEASUREMENT
/begin MEASUREMENT ei_sgsc_uc "" UWORD B_TRUE 1 100 0.00 1.00000000000 BIT_MASK 0x800 FORMAT "%13.11" ECU_ADDRESS 0xFD0A /end MEASUREMENT
/begin MEASUREMENT ei_sgsc_um "" UWORD B_TRUE 1 100 0.00 1.00000000000 BIT_MASK 0x1000 FORMAT "%13.11" ECU_ADDRESS 0xFD0A /end MEASUREMENT
/begin MEASUREMENT ei_sgso_um "" UBYTE B_TRUE 1 100 0.00 1.00000000000 BIT_MASK 0x20 FORMAT "%13.11" ECU_ADDRESS 0x380005 /end MEASUREMENT
/begin MEASUREMENT ei_spsc_um "" UWORD B_TRUE 1 100 0.00 1.00000000000 BIT_MASK 0x4 FORMAT "%13.11" ECU_ADDRESS 0xFD0C /end MEASUREMENT
/begin MEASUREMENT ei_ubr_um "" UWORD B_TRUE 1 100 0.00 1.00000000000 BIT_MASK 0x40 FORMAT "%13.11" ECU_ADDRESS 0xFD08 /end MEASUREMENT
/begin MEASUREMENT ei_varc_um "" UWORD B_TRUE 1 100 0.00 1.00000000000 BIT_MASK 0x80 FORMAT "%13.11" ECU_ADDRESS 0xFD08 /end MEASUREMENT
/begin MEASUREMENT ei_zwc_um "" UWORD B_TRUE 1 100 0.00 1.00000000000 BIT_MASK 0x2000 FORMAT "%13.11" ECU_ADDRESS 0xFD0A /end MEASUREMENT
/begin MEASUREMENT esst_sto08nauw "" UWORD dez 1 100 0.00 65535.00 FORMAT "%8.2" ECU_ADDRESS 0xF2BEE /end MEASUREMENT
/begin MEASUREMENT esst_STO08NEUW "" UWORD dez 1 100 0.00 65535.00 FORMAT "%8.2" ECU_ADDRESS 0xF2B90 /end MEASUREMENT
/begin MEASUREMENT etafrks_uc "" UBYTE rel_ub_b127p5 1 100 0.00 127.5 FORMAT "%5.1" ECU_ADDRESS 0xF057E /end MEASUREMENT
/begin MEASUREMENT etamnms "" UBYTE rel_ub_b127p5 1 100 0.00 127.5 FORMAT "%5.1" ECU_ADDRESS 0xF0C42 /end MEASUREMENT
/begin MEASUREMENT etamns "" UBYTE rel_ub_b127p5 1 100 0.00 127.5 FORMAT "%5.1" ECU_ADDRESS 0xE29A /end MEASUREMENT
/begin MEASUREMENT etazwmn "" UBYTE rel_ub_b127p5 1 100 0.00 127.5 FORMAT "%5.1" ECU_ADDRESS 0xE29B /end MEASUREMENT
/begin MEASUREMENT etazw_uc "" UBYTE rel_ub_b127p5 1 100 0.00 127.5 FORMAT "%5.1" ECU_ADDRESS 0xF057F /end MEASUREMENT
/begin MEASUREMENT evz_aus_bt "" UBYTE dez 1 100 0.00 255.0 FORMAT "%5.1" ECU_ADDRESS 0xF05A5 /end MEASUREMENT
/begin MEASUREMENT fdzwsu "" UBYTE fak_ub_b1 1 100 0.00 0.9961 ECU_ADDRESS 0xF0C51 /end MEASUREMENT
/begin MEASUREMENT fnwda_w "" UWORD fak_uw_b4 1 100 0.00 3.999939 FORMAT "%8.6" ECU_ADDRESS 0xF2BF0 /end MEASUREMENT
/begin MEASUREMENT fnwde_w "" UWORD fak_uw_b4 1 100 0.00 3.999939 FORMAT "%8.6" ECU_ADDRESS 0xF2B92 /end MEASUREMENT
/begin MEASUREMENT fnwpa "" SBYTE relKW_q0p195 1 100 -25.00 24.80 FORMAT "%5.2" ECU_ADDRESS 0xF0C25 /end MEASUREMENT
/begin MEASUREMENT fnwpe "" SBYTE relKW_q0p195 1 100 -25.00 24.80 FORMAT "%5.2" ECU_ADDRESS 0xF0C0C /end MEASUREMENT
/begin MEASUREMENT frksch_uc "" UBYTE rel_ub_b1p0 1 100 0.00 0.9961 ECU_ADDRESS 0xF0580 /end MEASUREMENT
/begin MEASUREMENT frksch_um "" UBYTE rel_ub_b1p0 1 100 0.00 0.9961 ECU_ADDRESS 0x380036 /end MEASUREMENT
/begin MEASUREMENT ftanwubka "" UBYTE fak_ub_b2 1 100 0.00 1.992 FORMAT "%5.3" ECU_ADDRESS 0xF0C26 /end MEASUREMENT
/begin MEASUREMENT ftanwubke "" UBYTE fak_ub_b2 1 100 0.00 1.992 FORMAT "%5.3" ECU_ADDRESS 0xF0C0D /end MEASUREMENT
/begin MEASUREMENT ftnwa "" UBYTE fak_ub_b2 1 100 0.00 1.992 FORMAT "%5.3" ECU_ADDRESS 0xF0C27 /end MEASUREMENT
/begin MEASUREMENT ftnwe "" UBYTE fak_ub_b2 1 100 0.00 1.992 FORMAT "%5.3" ECU_ADDRESS 0xF0C0E /end MEASUREMENT
/begin MEASUREMENT ftsdrl "" UBYTE fak_ub_b8 1 100 0.00 7.969 FORMAT "%5.3" ECU_ADDRESS 0xF0C6F /end MEASUREMENT
/begin MEASUREMENT ftsdyn "" UBYTE fak_ub_b8 1 100 0.00 7.969 FORMAT "%5.3" ECU_ADDRESS 0xF0C70 /end MEASUREMENT
/begin MEASUREMENT ftsub "" UBYTE fak_ub_b8 1 100 0.00 7.969 FORMAT "%5.3" ECU_ADDRESS 0xF0C71 /end MEASUREMENT
/begin MEASUREMENT fubaanz "" UBYTE dez 1 100 0.00 255.0 FORMAT "%5.1" ECU_ADDRESS 0xF0C72 /end MEASUREMENT
/begin MEASUREMENT fzwmn_w "" UWORD fak_uw_b1 1 100 0.00 0.9999847 FORMAT "%9.7" ECU_ADDRESS 0xF2C3C /end MEASUREMENT
/begin MEASUREMENT f_flags_uc "" UBYTE dez 1 100 0.00 255.0 FORMAT "%5.1" ECU_ADDRESS 0xF055C /end MEASUREMENT
/begin MEASUREMENT f_flags_um "" UBYTE dez 1 100 0.00 255.0 FORMAT "%5.1" ECU_ADDRESS 0x380005 /end MEASUREMENT
/begin MEASUREMENT ipa_c_um "" UBYTE t40ms_ub_b10200 1 100 0.00 10200.0 FORMAT "%7.1" ECU_ADDRESS 0x380021 /end MEASUREMENT
/begin MEASUREMENT ipsn_um "" UBYTE spg_ub_q0p019 1 100 0.00 4.980 FORMAT "%5.3" ECU_ADDRESS 0x380022 /end MEASUREMENT
/begin MEASUREMENT ivmxnwa "" SBYTE kwgrad_q3p9 1 100 -500.0 496.1 FORMAT "%5.1" ECU_ADDRESS 0xF0C28 /end MEASUREMENT
/begin MEASUREMENT ivmxnwe "" SBYTE kwgrad_q3p9 1 100 -500.0 496.1 FORMAT "%5.1" ECU_ADDRESS 0xF0C0F /end MEASUREMENT
/begin MEASUREMENT lamb1_uc "" UBYTE rel_ub_q0p03125 1 100 0.00 7.969 FORMAT "%5.3" ECU_ADDRESS 0xF0581 /end MEASUREMENT
/begin MEASUREMENT lamb1_um "" UBYTE rel_ub_q0p03125 1 100 0.00 7.969 FORMAT "%5.3" ECU_ADDRESS 0x380037 /end MEASUREMENT
/begin MEASUREMENT lamb2_uc "" UBYTE rel_ub_q0p03125 1 100 0.00 7.969 FORMAT "%5.3" ECU_ADDRESS 0xF0582 /end MEASUREMENT
/begin MEASUREMENT lamb2_um "" UBYTE rel_ub_q0p03125 1 100 0.00 7.969 FORMAT "%5.3" ECU_ADDRESS 0x380038 /end MEASUREMENT
/begin MEASUREMENT mdif_w_uc "" SWORD rel_ub_q0p3906 1 100 -12800.00 12799.61 FORMAT "%8.2" ECU_ADDRESS 0xF10FA /end MEASUREMENT
/begin MEASUREMENT mdif_w_um "" SWORD rel_ub_q0p3906 1 100 -12800.00 12799.61 FORMAT "%8.2" ECU_ADDRESS 0xF10F6 /end MEASUREMENT
/begin MEASUREMENT mdst08_uc "" UWORD dez 1 100 0.00 65535.00 FORMAT "%8.2" ECU_ADDRESS 0xF10D8 /end MEASUREMENT
/begin MEASUREMENT mdst08_um "" UWORD dez 1 100 0.00 65535.00 FORMAT "%8.2" ECU_ADDRESS 0x380072 /end MEASUREMENT
/begin MEASUREMENT mfgr_uc "" UBYTE rel_ub_q0p3906 1 100 0.00 99.61 FORMAT "%5.2" ECU_ADDRESS 0xF056D /end MEASUREMENT
/begin MEASUREMENT mifa_bt "" UBYTE rel_ub_b99p6 1 100 0.00 99.61 FORMAT "%5.2" ECU_ADDRESS 0xF056E /end MEASUREMENT
/begin MEASUREMENT miopt_uc "" UBYTE rel_ub_b99p6 1 100 0.00 99.61 FORMAT "%5.2" ECU_ADDRESS 0xF0583 /end MEASUREMENT
/begin MEASUREMENT misgscpl_bt "" UWORD dez 1 100 0.00 65535.00 FORMAT "%8.2" ECU_ADDRESS 0xF1088 /end MEASUREMENT
/begin MEASUREMENT misgs_bt "" UWORD rel_uw_b100 1 100 0.00 99.99847 FORMAT "%8.5" ECU_ADDRESS 0xF108A /end MEASUREMENT
/begin MEASUREMENT mivmxi_w "" UWORD rel_uw_b100 1 100 0.00 99.99847 FORMAT "%8.5" ECU_ADDRESS 0xF4786 /end MEASUREMENT
/begin MEASUREMENT mivmxp_w "" SWORD rel_sw_b100 1 100 -100.0000 99.99695 FORMAT "%8.4" ECU_ADDRESS 0xF4788 /end MEASUREMENT
/begin MEASUREMENT mivmx_w "" UWORD rel_uw_b100 1 100 0.00 99.99847 FORMAT "%8.5" ECU_ADDRESS 0xF478A /end MEASUREMENT
/begin MEASUREMENT mi_uc "" UBYTE rel_ub_b99p6 1 100 0.00 99.61 FORMAT "%5.2" ECU_ADDRESS 0xF0584 /end MEASUREMENT
/begin MEASUREMENT mmsr_uc "" UBYTE rel_ub_q0p3906 1 100 0.00 99.61 FORMAT "%5.2" ECU_ADDRESS 0xF0572 /end MEASUREMENT
/begin MEASUREMENT momint_bt "" UWORD mdt_q0p15625_Nms 1 100 0.00 10239.84 FORMAT "%8.2" ECU_ADDRESS 0xF108C /end MEASUREMENT
/begin MEASUREMENT momi_a1_uc "" UWORD mdt_q0p15625_Nms 1 100 0.00 10239.84 FORMAT "%8.2" ECU_ADDRESS 0xF108E /end MEASUREMENT
/begin MEASUREMENT momi_a1_um "" UWORD mdt_q0p15625_Nms 1 100 0.00 10239.84 FORMAT "%8.2" ECU_ADDRESS 0x380068 /end MEASUREMENT
/begin MEASUREMENT momi_a2_uc "" UWORD mdt_q0p15625_Nms 1 100 0.00 10239.84 FORMAT "%8.2" ECU_ADDRESS 0xF1090 /end MEASUREMENT
/begin MEASUREMENT momi_a2_um "" UWORD mdt_q0p15625_Nms 1 100 0.00 10239.84 FORMAT "%8.2" ECU_ADDRESS 0x38006A /end MEASUREMENT
/begin MEASUREMENT mped_uc "" UBYTE rel_ub_q0p3906 1 100 0.00 99.61 FORMAT "%5.2" ECU_ADDRESS 0xF058C /end MEASUREMENT
/begin MEASUREMENT mped_um "" UBYTE rel_ub_q0p3906 1 100 0.00 99.61 FORMAT "%5.2" ECU_ADDRESS 0xF058B /end MEASUREMENT
/begin MEASUREMENT mrlini_uc "" UBYTE rel_ub_b99p6 1 100 0.00 99.61 FORMAT "%5.2" ECU_ADDRESS 0xF056C /end MEASUREMENT
/begin MEASUREMENT mrlini_um "" UBYTE rel_ub_b99p6 1 100 0.00 99.61 FORMAT "%5.2" ECU_ADDRESS 0x380039 /end MEASUREMENT
/begin MEASUREMENT msgs_uc "" UBYTE rel_ub_q0p3906 1 100 0.00 99.61 FORMAT "%5.2" ECU_ADDRESS 0xF0567 /end MEASUREMENT
/begin MEASUREMENT msgs_um "" UBYTE rel_ub_q0p3906 1 100 0.00 99.61 FORMAT "%5.2" ECU_ADDRESS 0x38001C /end MEASUREMENT
/begin MEASUREMENT msrc_c_uc "" UBYTE t40ms_ub_b10200 1 100 0.00 10200.0 FORMAT "%7.1" ECU_ADDRESS 0xF0573 /end MEASUREMENT
/begin MEASUREMENT mver_c_uc "" UBYTE t40ms_ub_b10200 1 100 0.00 10200.0 FORMAT "%7.1" ECU_ADDRESS 0xF05A2 /end MEASUREMENT
/begin MEASUREMENT mver_c_um "" UBYTE t40ms_ub_b10200 1 100 0.00 10200.0 FORMAT "%7.1" ECU_ADDRESS 0x380051 /end MEASUREMENT
/begin MEASUREMENT mzfo_uc "" UBYTE rel_ub_q0p3906 1 100 0.00 99.61 FORMAT "%5.2" ECU_ADDRESS 0xF05A3 /end MEASUREMENT
/begin MEASUREMENT mzfo_um "" UBYTE rel_ub_q0p3906 1 100 0.00 99.61 FORMAT "%5.2" ECU_ADDRESS 0xF05A1 /end MEASUREMENT
/begin MEASUREMENT mzf_low_uc "" UBYTE rel_ub_q0p00153 1 100 0.00 0.3891 ECU_ADDRESS 0xF0594 /end MEASUREMENT
/begin MEASUREMENT mzf_low_um "" UBYTE rel_ub_q0p00153 1 100 0.00 0.3891 ECU_ADDRESS 0x380046 /end MEASUREMENT
/begin MEASUREMENT mzf_ptr_uc "" UBYTE dez 1 100 0.00 255.0 FORMAT "%5.1" ECU_ADDRESS 0xF0595 /end MEASUREMENT
/begin MEASUREMENT mzf_ptr_um "" UBYTE dez 1 100 0.00 255.0 FORMAT "%5.1" ECU_ADDRESS 0x380047 /end MEASUREMENT
/begin MEASUREMENT mzf_reg_uc "" UBYTE rel_ub_q0p3906 1 100 0.00 99.61 FORMAT "%5.2" ARRAY_SIZE 8 ECU_ADDRESS 0xF0596 /end MEASUREMENT
/begin MEASUREMENT mzf_reg_um "" UBYTE rel_ub_q0p3906 1 100 0.00 99.61 FORMAT "%5.2" ARRAY_SIZE 8 ECU_ADDRESS 0x380048 /end MEASUREMENT
/begin MEASUREMENT mzf_uc "" UBYTE rel_ub_q0p3906 1 100 0.00 99.61 FORMAT "%5.2" ECU_ADDRESS 0xF059E /end MEASUREMENT
/begin MEASUREMENT mzf_um "" UBYTE rel_ub_q0p3906 1 100 0.00 99.61 FORMAT "%5.2" ECU_ADDRESS 0x380050 /end MEASUREMENT
/begin MEASUREMENT mzf_x_uc "" UBYTE dez 1 100 0.00 255.0 FORMAT "%5.1" ECU_ADDRESS 0xF059F /end MEASUREMENT
/begin MEASUREMENT mzf_y_uc "" UBYTE dez 1 100 0.00 255.0 FORMAT "%5.1" ECU_ADDRESS 0xF05A0 /end MEASUREMENT
/begin MEASUREMENT mzo_uc "" UBYTE rel_ub_q0p3906 1 100 0.00 99.61 FORMAT "%5.2" ECU_ADDRESS 0xF058D /end MEASUREMENT
/begin MEASUREMENT mzo_um "" UBYTE rel_ub_q0p3906 1 100 0.00 99.61 FORMAT "%5.2" ECU_ADDRESS 0x380043 /end MEASUREMENT
/begin MEASUREMENT mz_uc "" UBYTE rel_ub_q0p3906 1 100 0.00 99.61 FORMAT "%5.2" ECU_ADDRESS 0xF058E /end MEASUREMENT
/begin MEASUREMENT mz_um "" UBYTE rel_ub_q0p3906 1 100 0.00 99.61 FORMAT "%5.2" ECU_ADDRESS 0x380044 /end MEASUREMENT
/begin MEASUREMENT nc_c_um "" UBYTE t40ms_ub_b10200 1 100 0.00 10200.0 FORMAT "%7.1" ECU_ADDRESS 0x380016 /end MEASUREMENT
/begin MEASUREMENT nmot_uc "" UBYTE nmot_ub_q40 1 100 0.00 10200. FORMAT "%5.0" ECU_ADDRESS 0xF058F /end MEASUREMENT
/begin MEASUREMENT nmot_um "" UBYTE nmot_ub_q40 1 100 0.00 10200. FORMAT "%5.0" ECU_ADDRESS 0x380017 /end MEASUREMENT
/begin MEASUREMENT nmst08_uc "" UWORD dez 1 100 0.00 65535.00 FORMAT "%8.2" ECU_ADDRESS 0xF10DA /end MEASUREMENT
/begin MEASUREMENT nsc_c_uc "" UWORD t40msxs_uw_q0p04 1 100 0.00 2621.400 FORMAT "%8.3" ECU_ADDRESS 0xF10CE /end MEASUREMENT
/begin MEASUREMENT nsc_c_um "" UWORD t40msxs_uw_q0p04 1 100 0.00 2621.400 FORMAT "%8.3" ECU_ADDRESS 0x380066 /end MEASUREMENT
/begin MEASUREMENT nska_uc "" UBYTE nmot_ub_q40 1 100 0.00 10200. FORMAT "%5.0" ECU_ADDRESS 0xF05A6 /end MEASUREMENT
/begin MEASUREMENT nska_um "" UBYTE nmot_ub_q40 1 100 0.00 10200. FORMAT "%5.0" ECU_ADDRESS 0xF05A4 /end MEASUREMENT
/begin MEASUREMENT nsof_c_um "" UBYTE t40ms_ub_b10200 1 100 0.00 10200.0 FORMAT "%7.1" ECU_ADDRESS 0x380019 /end MEASUREMENT
/begin MEASUREMENT nsywin_bt "" UBYTE dez 1 100 0.00 255.0 FORMAT "%5.1" ECU_ADDRESS 0xF0568 /end MEASUREMENT
/begin MEASUREMENT nsyw_bt "" UBYTE nmot_ub_q25 1 100 0.00 6375. FORMAT "%5.0" ECU_ADDRESS 0xF0569 /end MEASUREMENT
/begin MEASUREMENT nz_um "" UBYTE nmot_ub_q40 1 100 0.00 10200. FORMAT "%5.0" ECU_ADDRESS 0x380018 /end MEASUREMENT
/begin MEASUREMENT n_flags_uc "" UBYTE dez 1 100 0.00 255.0 FORMAT "%5.1" ECU_ADDRESS 0xF055D /end MEASUREMENT
/begin MEASUREMENT n_flags_um "" UBYTE dez 1 100 0.00 255.0 FORMAT "%5.1" ECU_ADDRESS 0x380006 /end MEASUREMENT
/begin MEASUREMENT offz_w "" UWORD tsegment_sy 1 100 0.00 52.42800 FORMAT "%8.5" ECU_ADDRESS 0xF2C48 /end MEASUREMENT
/begin MEASUREMENT pmcod_w "" UWORD dez 1 100 0.00 65535.00 FORMAT "%8.2" ECU_ADDRESS 0xF4FAA /end MEASUREMENT
/begin MEASUREMENT ram_c_um "" UBYTE dez 1 100 0.00 255.0 FORMAT "%5.1" ECU_ADDRESS 0x382009 /end MEASUREMENT
/begin MEASUREMENT reac_c2_uc "" UBYTE t40ms_ub_b10200 1 100 0.00 10200.0 FORMAT "%7.1" ECU_ADDRESS 0xF05A7 /end MEASUREMENT
/begin MEASUREMENT reac_c2_um "" UBYTE t40ms_ub_b10200 1 100 0.00 10200.0 FORMAT "%7.1" ECU_ADDRESS 0x380052 /end MEASUREMENT
/begin MEASUREMENT reac_c3_uc "" UBYTE t40ms_ub_b10200 1 100 0.00 10200.0 FORMAT "%7.1" ECU_ADDRESS 0xF05A8 /end MEASUREMENT
/begin MEASUREMENT reac_c3_um "" UBYTE t40ms_ub_b10200 1 100 0.00 10200.0 FORMAT "%7.1" ECU_ADDRESS 0x380053 /end MEASUREMENT
/begin MEASUREMENT reac_c_um "" UBYTE dez 1 100 0.00 255.0 FORMAT "%5.1" ECU_ADDRESS 0x38200A /end MEASUREMENT
/begin MEASUREMENT reset_indication_um "" UWORD dez 1 100 0.00 65535.00 FORMAT "%8.2" ECU_ADDRESS 0x382152 /end MEASUREMENT
/begin MEASUREMENT rlc_c_um "" UBYTE t40ms_ub_b10200 1 100 0.00 10200.0 FORMAT "%7.1" ECU_ADDRESS 0x380023 /end MEASUREMENT
/begin MEASUREMENT rlf_ptr_um "" UBYTE dez 1 100 0.00 255.0 FORMAT "%5.1" ECU_ADDRESS 0x380024 /end MEASUREMENT
/begin MEASUREMENT rlf_reg_um "" UBYTE rel_ub_q0p75 1 100 0.00 191.3 FORMAT "%5.1" ARRAY_SIZE 8 ECU_ADDRESS 0x380025 /end MEASUREMENT
/begin MEASUREMENT rlipf_l_um "" UBYTE rel_ub_q0p0029 1 100 0.00 0.7471 ECU_ADDRESS 0x38002D /end MEASUREMENT
/begin MEASUREMENT rlipf_um "" UBYTE rel_ub_q0p75 1 100 0.00 191.3 FORMAT "%5.1" ECU_ADDRESS 0x38002E /end MEASUREMENT
/begin MEASUREMENT rlip_c_um "" UBYTE t40ms_ub_b10200 1 100 0.00 10200.0 FORMAT "%7.1" ECU_ADDRESS 0x38002F /end MEASUREMENT
/begin MEASUREMENT rlip_um "" UBYTE rel_ub_q0p75 1 100 0.00 191.3 FORMAT "%5.1" ECU_ADDRESS 0x380030 /end MEASUREMENT
/begin MEASUREMENT rlst08_uc "" UWORD dez 1 100 0.00 65535.00 FORMAT "%8.2" ECU_ADDRESS 0xF10D0 /end MEASUREMENT
/begin MEASUREMENT rlzo_um "" UBYTE rel_ub_q0p75 1 100 0.00 191.3 FORMAT "%5.1" ECU_ADDRESS 0xF056B /end MEASUREMENT
/begin MEASUREMENT rl_uc "" UBYTE rel_ub_q0p75 1 100 0.00 191.3 FORMAT "%5.1" ECU_ADDRESS 0xF0585 /end MEASUREMENT
/begin MEASUREMENT rl_um "" UBYTE rel_ub_q0p75 1 100 0.00 191.3 FORMAT "%5.1" ECU_ADDRESS 0x380031 /end MEASUREMENT
/begin MEASUREMENT rl_w_um "" UWORD rel_uw_q0p0234 1 100 0.00 1535.977 FORMAT "%8.3" ECU_ADDRESS 0xF109E /end MEASUREMENT
/begin MEASUREMENT romErrPage "" UBYTE dez 1 100 0.00 255.0 FORMAT "%5.1" ECU_ADDRESS 0x38200B /end MEASUREMENT
/begin MEASUREMENT romRstC_um "" UBYTE dez 1 100 0.00 255.0 FORMAT "%5.1" ECU_ADDRESS 0x382012 /end MEASUREMENT
/begin MEASUREMENT romz_c_um "" UBYTE dez 1 100 0.00 255.0 FORMAT "%5.1" ECU_ADDRESS 0x38200C /end MEASUREMENT
/begin MEASUREMENT rst_tv "" UBYTE dez 1 100 0.00 255.0 FORMAT "%5.1" ECU_ADDRESS 0x38200D /end MEASUREMENT
/begin MEASUREMENT rst_tv_active "" UBYTE dez 1 100 0.00 255.0 FORMAT "%5.1" ECU_ADDRESS 0x382011 /end MEASUREMENT
/begin MEASUREMENT r_flags_uc "" UBYTE dez 1 100 0.00 255.0 FORMAT "%5.1" ECU_ADDRESS 0xF055E /end MEASUREMENT
/begin MEASUREMENT r_flags_um "" UBYTE dez 1 100 0.00 255.0 FORMAT "%5.1" ECU_ADDRESS 0x380007 /end MEASUREMENT
/begin MEASUREMENT sdnnwa_w "" SWORD kw_sw_b128 1 100 -128.0000 127.9961 FORMAT "%8.4" ECU_ADDRESS 0xF2BF2 /end MEASUREMENT
/begin MEASUREMENT sdnnwe_w "" SWORD kw_sw_b128 1 100 -128.0000 127.9961 FORMAT "%8.4" ECU_ADDRESS 0xF2B94 /end MEASUREMENT
/begin MEASUREMENT sdtnwa_w "" UWORD t_vanosPre_f4_sy 1 100 0.00 838.8480 FORMAT "%8.4" ECU_ADDRESS 0xF2BF4 /end MEASUREMENT
/begin MEASUREMENT sdtnwe_w "" UWORD t_vanosPre_f4_sy 1 100 0.00 838.8480 FORMAT "%8.4" ECU_ADDRESS 0xF2B96 /end MEASUREMENT
/begin MEASUREMENT sgsc_c_uc "" UBYTE t40ms_ub_b10200 1 100 0.00 10200.0 FORMAT "%7.1" ECU_ADDRESS 0xF056A /end MEASUREMENT
/begin MEASUREMENT sgsc_c_um "" UBYTE t40ms_ub_b10200 1 100 0.00 10200.0 FORMAT "%7.1" ECU_ADDRESS 0x38001D /end MEASUREMENT
/begin MEASUREMENT sp1p_a_um "" UBYTE spg_ub_q0p019 1 100 0.00 4.980 FORMAT "%5.3" ECU_ADDRESS 0x380055 /end MEASUREMENT
/begin MEASUREMENT sp1p_st_um "" UBYTE t10msxs_ub_b2p55 1 100 0.00 2.550 FORMAT "%5.3" ECU_ADDRESS 0x380056 /end MEASUREMENT
/begin MEASUREMENT sp1s_a_um "" UBYTE spg_ub_q0p019 1 100 0.00 4.980 FORMAT "%5.3" ECU_ADDRESS 0x380057 /end MEASUREMENT
/begin MEASUREMENT sp1s_st_um "" UBYTE t10msxs_ub_b2p55 1 100 0.00 2.550 FORMAT "%5.3" ECU_ADDRESS 0x380058 /end MEASUREMENT
/begin MEASUREMENT sp1s_um "" UBYTE spg_ub_q0p019 1 100 0.00 4.980 FORMAT "%5.3" ECU_ADDRESS 0x380032 /end MEASUREMENT
/begin MEASUREMENT sp2ds_um "" UBYTE spg_ub_q0p019 1 100 0.00 4.980 FORMAT "%5.3" ECU_ADDRESS 0x380033 /end MEASUREMENT
/begin MEASUREMENT spnst08_uc "" UWORD dez 1 100 0.00 65535.00 FORMAT "%8.2" ECU_ADDRESS 0xF10DC /end MEASUREMENT
/begin MEASUREMENT spsc_c_um "" UBYTE t40ms_ub_b10200 1 100 0.00 10200.0 FORMAT "%7.1" ECU_ADDRESS 0x380034 /end MEASUREMENT
/begin MEASUREMENT spsn_uc "" UBYTE spg_ub_q0p019 1 100 0.00 4.980 FORMAT "%5.3" ECU_ADDRESS 0xF0590 /end MEASUREMENT
/begin MEASUREMENT spsn_um "" UBYTE spg_ub_q0p019 1 100 0.00 4.980 FORMAT "%5.3" ECU_ADDRESS 0x380035 /end MEASUREMENT
/begin MEASUREMENT srst_c_um "" UBYTE dez 1 100 0.00 255.0 FORMAT "%5.1" ECU_ADDRESS 0x38200E /end MEASUREMENT
/begin MEASUREMENT szfuba_w "" UWORD tsegment_sy 1 100 0.00 52.42800 FORMAT "%8.5" ECU_ADDRESS 0xF2C4A /end MEASUREMENT
/begin MEASUREMENT szout_w "" UWORD txms_uw_q0p1 1 100 0.00 6553.500 FORMAT "%8.3" ECU_ADDRESS 0xF2C4C /end MEASUREMENT
/begin MEASUREMENT szrl_w "" UWORD txms_uw_q0p1 1 100 0.00 6553.500 FORMAT "%8.3" ECU_ADDRESS 0xF2C4E /end MEASUREMENT
/begin MEASUREMENT sztcalc_w "" UWORD DEZL 1 100 0.00 65535.00 FORMAT "%8.2" ECU_ADDRESS 0xF2C50 /end MEASUREMENT
/begin MEASUREMENT s_flags_uc "" UBYTE dez 1 100 0.00 255.0 FORMAT "%5.1" ECU_ADDRESS 0xF055F /end MEASUREMENT
/begin MEASUREMENT s_flags_um "" UBYTE dez 1 100 0.00 255.0 FORMAT "%5.1" ECU_ADDRESS 0x380008 /end MEASUREMENT
/begin MEASUREMENT S_schao_um "" UBYTE B_TRUE 1 100 0.00 1.00000000000 BIT_MASK 0x4 FORMAT "%13.11" ECU_ADDRESS 0x380005 /end MEASUREMENT
/begin MEASUREMENT talt_um "" UWORD dez 1 100 0.00 65535.00 FORMAT "%8.2" ECU_ADDRESS 0x38005E /end MEASUREMENT
/begin MEASUREMENT tanwda_w "" SWORD rel_sw_b100 1 100 -100.0000 99.99695 FORMAT "%8.4" ECU_ADDRESS 0xF2BF6 /end MEASUREMENT
/begin MEASUREMENT tanwde_w "" SWORD rel_sw_b100 1 100 -100.0000 99.99695 FORMAT "%8.4" ECU_ADDRESS 0xF2B98 /end MEASUREMENT
/begin MEASUREMENT tanwdza_w "" SWORD rel_sw_b100 1 100 -100.0000 99.99695 FORMAT "%8.4" ECU_ADDRESS 0xF2BF8 /end MEASUREMENT
/begin MEASUREMENT tanwdze_w "" SWORD rel_sw_b100 1 100 -100.0000 99.99695 FORMAT "%8.4" ECU_ADDRESS 0xF2B9A /end MEASUREMENT
/begin MEASUREMENT tanwoda_w "" UWORD tv_uw_b100 1 100 0.00 99.99847 FORMAT "%8.5" ECU_ADDRESS 0xF2BFA /end MEASUREMENT
/begin MEASUREMENT tanwode_w "" UWORD tv_uw_b100 1 100 0.00 99.99847 FORMAT "%8.5" ECU_ADDRESS 0xF2B9C /end MEASUREMENT
/begin MEASUREMENT tanwpa_w "" SWORD rel_sw_b50 1 100 -50.00000 49.99847 FORMAT "%8.5" ECU_ADDRESS 0xF2BFC /end MEASUREMENT
/begin MEASUREMENT tanwpe_w "" SWORD rel_sw_b50 1 100 -50.00000 49.99847 FORMAT "%8.5" ECU_ADDRESS 0xF2B9E /end MEASUREMENT
/begin MEASUREMENT tanwra "" UBYTE tv_ub_b100 1 100 0.00 99.61 FORMAT "%5.2" ECU_ADDRESS 0xF0C29 /end MEASUREMENT
/begin MEASUREMENT tanwraa "" UBYTE tv_ub_b100 1 100 0.00 99.61 FORMAT "%5.2" ECU_ADDRESS 0xF0C2A /end MEASUREMENT
/begin MEASUREMENT tanwre "" UBYTE tv_ub_b100 1 100 0.00 99.61 FORMAT "%5.2" ECU_ADDRESS 0xF0C10 /end MEASUREMENT
/begin MEASUREMENT tanwrea "" UBYTE tv_ub_b100 1 100 0.00 99.61 FORMAT "%5.2" ECU_ADDRESS 0xF0C11 /end MEASUREMENT
/begin MEASUREMENT tanwrha_w "" UWORD tv_uw_b100 1 100 0.00 99.99847 FORMAT "%8.5" ECU_ADDRESS 0xF2BFE /end MEASUREMENT
/begin MEASUREMENT tanwrhe_w "" UWORD tv_uw_b100 1 100 0.00 99.99847 FORMAT "%8.5" ECU_ADDRESS 0xF2BA0 /end MEASUREMENT
/begin MEASUREMENT tcap_um "" UWORD dez 1 100 0.00 65535.00 FORMAT "%8.2" ECU_ADDRESS 0x380060 /end MEASUREMENT
/begin MEASUREMENT tcclkldf_w "" UWORD t100msxms_uw_b209 1 100 0.00 209.7218 FORMAT "%8.4" ECU_ADDRESS 0xF02EE /end MEASUREMENT
/begin MEASUREMENT tccpkldf_w "" UWORD t100msxms_uw_b209 1 100 0.00 209.7218 FORMAT "%8.4" ECU_ADDRESS 0xF02FC /end MEASUREMENT
/begin MEASUREMENT tfwdksom_w "" UWORD zk10msxs_uw_b655 1 100 0.010000152590 655.36000000 FORMAT "%12.8" ECU_ADDRESS 0xF1E02 /end MEASUREMENT
/begin MEASUREMENT tmnist_uc "" UBYTE temp_ub_q0p75_o48 1 100 -48.00 143.3 FORMAT "%5.1" ECU_ADDRESS 0xF0586 /end MEASUREMENT
/begin MEASUREMENT tmost08_uc "" UWORD dez 1 100 0.00 65535.00 FORMAT "%8.2" ECU_ADDRESS 0xF10DE /end MEASUREMENT
/begin MEASUREMENT tmost08_um "" UWORD dez 1 100 0.00 65535.00 FORMAT "%8.2" ECU_ADDRESS 0x380074 /end MEASUREMENT
/begin MEASUREMENT tmotmn_uc "" UBYTE temp_ub_q0p75_o48 1 100 -48.00 143.3 FORMAT "%5.1" ECU_ADDRESS 0xF0591 /end MEASUREMENT
/begin MEASUREMENT tmotmn_um "" UBYTE temp_ub_q0p75_o48 1 100 -48.00 143.3 FORMAT "%5.1" ECU_ADDRESS 0x380045 /end MEASUREMENT
/begin MEASUREMENT tmot_uc "" UBYTE temp_ub_q0p75_o48 1 100 -48.00 143.3 FORMAT "%5.1" ECU_ADDRESS 0xF0592 /end MEASUREMENT
/begin MEASUREMENT tnwda_w "" UWORD fak_uw_b1 1 100 0.00 0.9999847 FORMAT "%9.7" ECU_ADDRESS 0xF2C00 /end MEASUREMENT
/begin MEASUREMENT tnwde_w "" UWORD fak_uw_b1 1 100 0.00 0.9999847 FORMAT "%9.7" ECU_ADDRESS 0xF2BA2 /end MEASUREMENT
/begin MEASUREMENT tnwdza_w "" UWORD fak_uw_b1 1 100 0.00 0.9999847 FORMAT "%9.7" ECU_ADDRESS 0xF2C02 /end MEASUREMENT
/begin MEASUREMENT tnwdze_w "" UWORD fak_uw_b1 1 100 0.00 0.9999847 FORMAT "%9.7" ECU_ADDRESS 0xF2BA4 /end MEASUREMENT
/begin MEASUREMENT tnwvtka "" UBYTE temp_ub_q0p75_o48 1 100 -48.00 143.3 FORMAT "%5.1" ECU_ADDRESS 0xF0C2B /end MEASUREMENT
/begin MEASUREMENT tnwvtke "" UBYTE temp_ub_q0p75_o48 1 100 -48.00 143.3 FORMAT "%5.1" ECU_ADDRESS 0xF41A2 /end MEASUREMENT
/begin MEASUREMENT toelnwr "" UBYTE temp_ub_q0p75_o48 1 100 -48.00 143.3 FORMAT "%5.1" ECU_ADDRESS 0xF41A3 /end MEASUREMENT
/begin MEASUREMENT tsdrlmx_w "" SWORD rel_sw_q0p0234 1 100 -768.0000 767.9766 FORMAT "%8.4" ECU_ADDRESS 0xF2C52 /end MEASUREMENT
/begin MEASUREMENT tsrl "" UBYTE txms_ub_q0p1 1 100 0.00 25.50 FORMAT "%5.2" ECU_ADDRESS 0xF0C73 /end MEASUREMENT
/begin MEASUREMENT tsrldyn "" UBYTE txms_ub_q0p1 1 100 0.00 25.50 FORMAT "%5.2" ECU_ADDRESS 0xF0C74 /end MEASUREMENT
/begin MEASUREMENT tvnwsai_w "" SWORD tv_uw_b100 1 100 -50.00000 49.99847 FORMAT "%8.5" ECU_ADDRESS 0xF2C04 /end MEASUREMENT
/begin MEASUREMENT tvnwsei_w "" SWORD fak_q0p00153 1 100 -50.00000 49.99847 FORMAT "%8.5" ECU_ADDRESS 0xF2BA6 /end MEASUREMENT
/begin MEASUREMENT tvsta "" UBYTE tv_ub_b100 1 100 0.00 99.61 FORMAT "%5.2" ECU_ADDRESS 0xF0C2C /end MEASUREMENT
/begin MEASUREMENT tvste "" UBYTE tv_ub_b100 1 100 0.00 99.61 FORMAT "%5.2" ECU_ADDRESS 0xF0C12 /end MEASUREMENT
/begin MEASUREMENT tzsCtr "" UBYTE dez 1 100 0.00 255.0 FORMAT "%5.1" ECU_ADDRESS 0xF0C75 /end MEASUREMENT
/begin MEASUREMENT tzwmnnst_w "" UWORD zk10msxs_uw_b655 1 100 0.010000152590 655.36000000 FORMAT "%12.8" ECU_ADDRESS 0xF2C3E /end MEASUREMENT
/begin MEASUREMENT t_flags_uc "" UBYTE dez 1 100 0.00 255.0 FORMAT "%5.1" ECU_ADDRESS 0xF0560 /end MEASUREMENT
/begin MEASUREMENT t_flags_um "" UBYTE dez 1 100 0.00 255.0 FORMAT "%5.1" ECU_ADDRESS 0x380009 /end MEASUREMENT
/begin MEASUREMENT ubn "" UWORD B_TRUE 1 100 0.00 1.00000000000 BIT_MASK 0x4 FORMAT "%13.11" ECU_ADDRESS 0xFDC6 /end MEASUREMENT
/begin MEASUREMENT uma2_res "" SWORD dez 1 100 -32768.00 32767.00 FORMAT "%8.2" ECU_ADDRESS 0xF1010 /end MEASUREMENT
/begin MEASUREMENT umErrorCtrFr "" UBYTE dez 1 100 0.00 255.0 FORMAT "%5.1" ECU_ADDRESS 0x382008 /end MEASUREMENT
/begin MEASUREMENT umrst_c_um "" UBYTE dez 1 100 0.00 255.0 FORMAT "%5.1" ECU_ADDRESS 0x38200F /end MEASUREMENT
/begin MEASUREMENT urmcksc1 "" UWORD dez 1 100 0.00 65535.00 FORMAT "%8.2" ARRAY_SIZE 2 ECU_ADDRESS 0x382156 /end MEASUREMENT
/begin MEASUREMENT urmcksc2 "" UWORD dez 1 100 0.00 65535.00 FORMAT "%8.2" ARRAY_SIZE 2 ECU_ADDRESS 0x38215A /end MEASUREMENT
/begin MEASUREMENT urmcksda "" UWORD dez 1 100 0.00 65535.00 FORMAT "%8.2" ARRAY_SIZE 2 ECU_ADDRESS 0x38215E /end MEASUREMENT
/begin MEASUREMENT urmpatco "" UWORD dez 1 100 0.00 65535.00 FORMAT "%8.2" ARRAY_SIZE 2 ECU_ADDRESS 0xF110E /end MEASUREMENT
/begin MEASUREMENT uzue "" UBYTE spg_ubatt 1 100 0.00 17.95 FORMAT "%5.2" ECU_ADDRESS 0xF0C76 /end MEASUREMENT
/begin MEASUREMENT varc_c_um "" UBYTE t40ms_ub_b10200 1 100 0.00 10200.0 FORMAT "%7.1" ECU_ADDRESS 0x380000 /end MEASUREMENT
/begin MEASUREMENT vfzg_bt "" UWORD vfzg_uw_b512 1 100 0.00 511.9922 FORMAT "%8.4" ECU_ADDRESS 0xF10BA /end MEASUREMENT
/begin MEASUREMENT vivmx_w "" UWORD vfzg_uw_q0p00781 1 100 0.00 511.9922 FORMAT "%8.4" ECU_ADDRESS 0xF478C /end MEASUREMENT
/begin MEASUREMENT vkAirbag "" UBYTE dez 1 100 0.00 255.0 FORMAT "%5.1" ECU_ADDRESS 0xE294 /end MEASUREMENT
/begin MEASUREMENT vkCAN "" UBYTE dez 1 100 0.00 255.0 FORMAT "%5.1" ECU_ADDRESS 0xE295 /end MEASUREMENT
/begin MEASUREMENT vkCAN2 "" UBYTE dez 1 100 0.00 255.0 FORMAT "%5.1" ECU_ADDRESS 0xE296 /end MEASUREMENT
/begin MEASUREMENT vkCAN3 "" UBYTE dez 1 100 0.00 255.0 FORMAT "%5.1" ECU_ADDRESS 0xE297 /end MEASUREMENT
/begin MEASUREMENT vkKlima "" UBYTE dez 1 100 0.00 255.0 FORMAT "%5.1" ECU_ADDRESS 0xE298 /end MEASUREMENT
/begin MEASUREMENT vkpedch_uc "" UBYTE dez 1 100 0.00 255.0 FORMAT "%5.1" ECU_ADDRESS 0xF0593 /end MEASUREMENT
/begin MEASUREMENT vkpedch_um "" UBYTE dez 1 100 0.00 255.0 FORMAT "%5.1" ECU_ADDRESS 0x380001 /end MEASUREMENT
/begin MEASUREMENT vnwa_w "" SWORD kwgrad_q0p03052 1 100 -1000.000 999.9695 FORMAT "%8.3" ECU_ADDRESS 0xF2C06 /end MEASUREMENT
/begin MEASUREMENT vnwda_w "" SWORD kwgrad_q0p03052 1 100 -1000.000 999.9695 FORMAT "%8.3" ECU_ADDRESS 0xF2C08 /end MEASUREMENT
/begin MEASUREMENT vnwde_w "" SWORD kwgrad_q0p03052 1 100 -1000.000 999.9695 FORMAT "%8.3" ECU_ADDRESS 0xF2BA8 /end MEASUREMENT
/begin MEASUREMENT vnwdza_w "" SWORD kwgrad_q0p03052 1 100 -1000.000 999.9695 FORMAT "%8.3" ECU_ADDRESS 0xF2C0A /end MEASUREMENT
/begin MEASUREMENT vnwdze_w "" SWORD kwgrad_q0p03052 1 100 -1000.000 999.9695 FORMAT "%8.3" ECU_ADDRESS 0xF2BAA /end MEASUREMENT
/begin MEASUREMENT vnwe_w "" SWORD kwgrad_q0p03052 1 100 -1000.000 999.9695 FORMAT "%8.3" ECU_ADDRESS 0xF2BAC /end MEASUREMENT
/begin MEASUREMENT vsdmr "" UBYTE rel_ub_q0p3906 1 100 0.00 99.61 FORMAT "%5.2" ECU_ADDRESS 0xF05B1 /end MEASUREMENT
/begin MEASUREMENT vsfpses "" UBYTE fak_ub_b2 1 100 0.00 1.992 FORMAT "%5.3" ECU_ADDRESS 0xF05B2 /end MEASUREMENT
/begin MEASUREMENT vsfrk "" UBYTE fak_ub_b1p25_o0p75 1 100 0.7500 1.248 FORMAT "%5.3" ECU_ADDRESS 0xF05B3 /end MEASUREMENT
/begin MEASUREMENT vske "" SBYTE fak_ub_b16 1 100 -8.000 7.938 FORMAT "%5.3" ECU_ADDRESS 0xF05B4 /end MEASUREMENT
/begin MEASUREMENT vsldtv "" UBYTE tv_ub_b100 1 100 0.00 99.61 FORMAT "%5.2" ECU_ADDRESS 0xF05B5 /end MEASUREMENT
/begin MEASUREMENT vsns "" UBYTE nmot_ub_q10 1 100 0.00 2550. FORMAT "%5.0" ECU_ADDRESS 0xF05B6 /end MEASUREMENT
/begin MEASUREMENT vsrlmx "" SBYTE rel_sb_q0p75 1 100 -96.00 95.25 FORMAT "%5.2" ECU_ADDRESS 0xF05B7 /end MEASUREMENT
/begin MEASUREMENT vsvmx_w "" UWORD vfzg_uw_q0p00781 1 100 0.00 511.9922 FORMAT "%8.4" ECU_ADDRESS 0xF478E /end MEASUREMENT
/begin MEASUREMENT vsvw "" SBYTE zw_sb_q6 1 100 -768.0 762.0 FORMAT "%5.1" ECU_ADDRESS 0xF05B8 /end MEASUREMENT
/begin MEASUREMENT vswnws "" UBYTE wkw_ub_q0p25 1 100 0.00 63.7500 FORMAT "%7.4" ECU_ADDRESS 0xF05B9 /end MEASUREMENT
/begin MEASUREMENT vszw "" SBYTE zw_sb_q0p75 1 100 -96.00 95.25 FORMAT "%5.2" ECU_ADDRESS 0xF05BA /end MEASUREMENT
/begin MEASUREMENT vszwkr "" SBYTE zw_sb_q0p75 1 100 -96.00 95.25 FORMAT "%5.2" ARRAY_SIZE 8 ECU_ADDRESS 0xF05BB /end MEASUREMENT
/begin MEASUREMENT wdksom_w "" UWORD relDK_uw_b100 1 100 0.00 100.0000 FORMAT "%8.4" ECU_ADDRESS 0xF1E04 /end MEASUREMENT
/begin MEASUREMENT wfsAusBits1 "" UBYTE dez 1 100 0.00 255.0 FORMAT "%5.1" ECU_ADDRESS 0xF4119 /end MEASUREMENT
/begin MEASUREMENT wfsAusBits10ms1 "" UBYTE dez 1 100 0.00 255.0 FORMAT "%5.1" ECU_ADDRESS 0xE19A /end MEASUREMENT
/begin MEASUREMENT wfsAusBits10ms2 "" UBYTE dez 1 100 0.00 255.0 FORMAT "%5.1" ECU_ADDRESS 0xE19B /end MEASUREMENT
/begin MEASUREMENT wfsAusBits10ms3 "" UBYTE dez 1 100 0.00 255.0 FORMAT "%5.1" ECU_ADDRESS 0xE19C /end MEASUREMENT
/begin MEASUREMENT wfsAusBits10ms4 "" UBYTE dez 1 100 0.00 255.0 FORMAT "%5.1" ECU_ADDRESS 0xE19D /end MEASUREMENT
/begin MEASUREMENT wfsAusBits10ms5 "" UBYTE dez 1 100 0.00 255.0 FORMAT "%5.1" ECU_ADDRESS 0xE19E /end MEASUREMENT
/begin MEASUREMENT wfsAusBits10ms6 "" UBYTE dez 1 100 0.00 255.0 FORMAT "%5.1" ECU_ADDRESS 0xE19F /end MEASUREMENT
/begin MEASUREMENT wfsAusBits10ms7 "" UBYTE dez 1 100 0.00 255.0 FORMAT "%5.1" ECU_ADDRESS 0xE1A0 /end MEASUREMENT
/begin MEASUREMENT wfsAusBitsNov10ms1 "" UBYTE dez 1 100 0.00 255.0 FORMAT "%5.1" ECU_ADDRESS 0x382073 /end MEASUREMENT
/begin MEASUREMENT wfsCommEepOld "" UBYTE dez 1 100 0.00 255.0 FORMAT "%5.1" ECU_ADDRESS 0xF095A /end MEASUREMENT
/begin MEASUREMENT wfsCommImsOld "" UBYTE dez 1 100 0.00 255.0 FORMAT "%5.1" ECU_ADDRESS 0xF095B /end MEASUREMENT
/begin MEASUREMENT wfsCommTstOld "" UBYTE dez 1 100 0.00 255.0 FORMAT "%5.1" ECU_ADDRESS 0xF095C /end MEASUREMENT
/begin MEASUREMENT wfsCtrAuSt "" UBYTE dez 1 100 0.00 255.0 FORMAT "%5.1" ECU_ADDRESS 0xF0960 /end MEASUREMENT
/begin MEASUREMENT wfsCtrAuth "" UBYTE dez 1 100 0.00 255.0 FORMAT "%5.1" ECU_ADDRESS 0xF0961 /end MEASUREMENT
/begin MEASUREMENT wfsCtrn0_w "" UWORD dez 1 100 0.00 65535.00 FORMAT "%8.2" ECU_ADDRESS 0xF21D2 /end MEASUREMENT
/begin MEASUREMENT wfsCtrP2C "" UBYTE dez 1 100 0.00 255.0 FORMAT "%5.1" ECU_ADDRESS 0xF0962 /end MEASUREMENT
/begin MEASUREMENT wfsCtrRcErr "" UBYTE dez 1 100 0.00 255.0 FORMAT "%5.1" ECU_ADDRESS 0x382077 /end MEASUREMENT
/begin MEASUREMENT wfsCtrRcnl "" UBYTE dez 1 100 0.00 255.0 FORMAT "%5.1" ECU_ADDRESS 0xF0963 /end MEASUREMENT
/begin MEASUREMENT wfsCtrRetr "" UBYTE t_q1 1 100 0.00 255.0 FORMAT "%5.1" ECU_ADDRESS 0xF411A /end MEASUREMENT
/begin MEASUREMENT wfsEcuSt_w "" UWORD dez 1 100 0.00 65535.00 FORMAT "%8.2" ECU_ADDRESS 0xF21D4 /end MEASUREMENT
/begin MEASUREMENT wfsEepReq "" UBYTE dez 1 100 0.00 255.0 FORMAT "%5.1" ECU_ADDRESS 0xF0965 /end MEASUREMENT
/begin MEASUREMENT wfsEepReqO "" UBYTE dez 1 100 0.00 255.0 FORMAT "%5.1" ECU_ADDRESS 0xF0966 /end MEASUREMENT
/begin MEASUREMENT wfsIdxSigE "" UBYTE dez 1 100 0.00 255.0 FORMAT "%5.1" ECU_ADDRESS 0xF0967 /end MEASUREMENT
/begin MEASUREMENT wfsIdxSigI "" UBYTE dez 1 100 0.00 255.0 FORMAT "%5.1" ECU_ADDRESS 0xF0968 /end MEASUREMENT
/begin MEASUREMENT wfsIId "" UBYTE dez 1 100 0.00 255.0 FORMAT "%5.1" ARRAY_SIZE 14 ECU_ADDRESS 0xF0969 /end MEASUREMENT
/begin MEASUREMENT wfsIIdIms "" UBYTE dez 1 100 0.00 255.0 FORMAT "%5.1" ARRAY_SIZE 14 ECU_ADDRESS 0xF0977 /end MEASUREMENT
/begin MEASUREMENT wfsKwpRspC "" UBYTE dez 1 100 0.00 255.0 FORMAT "%5.1" ARRAY_SIZE 3 ECU_ADDRESS 0xF0986 /end MEASUREMENT
/begin MEASUREMENT wfsLokBits1 "" UBYTE dez 1 100 0.00 255.0 FORMAT "%5.1" ECU_ADDRESS 0xF411B /end MEASUREMENT
/begin MEASUREMENT wfsLokBits10ms1 "" UBYTE dez 1 100 0.00 255.0 FORMAT "%5.1" ECU_ADDRESS 0xE1A1 /end MEASUREMENT
/begin MEASUREMENT wfsTime "" UBYTE dez 1 100 0.00 255.0 FORMAT "%5.1" ECU_ADDRESS 0xF09E2 /end MEASUREMENT
/begin MEASUREMENT wfsVin "" UBYTE dez 1 100 0.00 255.0 FORMAT "%5.1" ARRAY_SIZE 17 ECU_ADDRESS 0xF09E3 /end MEASUREMENT
/begin MEASUREMENT wfsVinIms "" UBYTE dez 1 100 0.00 255.0 FORMAT "%5.1" ARRAY_SIZE 17 ECU_ADDRESS 0xF09F4 /end MEASUREMENT
/begin MEASUREMENT wfsVinUr "" UBYTE dez 1 100 0.00 255.0 FORMAT "%5.1" ARRAY_SIZE 17 ECU_ADDRESS 0xF0A05 /end MEASUREMENT
/begin MEASUREMENT wfsWinTime "" UBYTE dez 1 100 0.00 255.0 FORMAT "%5.1" ECU_ADDRESS 0xF0A16 /end MEASUREMENT
/begin MEASUREMENT wfs_cyclus "" UBYTE dez 1 100 0.00 255.0 FORMAT "%5.1" ECU_ADDRESS 0xF0A17 /end MEASUREMENT
/begin MEASUREMENT wnwam "" SBYTE kw_q0p5 1 100 -64.00 63.50 FORMAT "%5.2" ECU_ADDRESS 0xF0C2D /end MEASUREMENT
/begin MEASUREMENT wnwaslrs "" UBYTE kw_ub_q0p5 1 100 0.00 127.5 FORMAT "%5.1" ECU_ADDRESS 0xF0C2E /end MEASUREMENT
/begin MEASUREMENT wnwem "" SBYTE kw_q0p5 1 100 -64.00 63.50 FORMAT "%5.2" ECU_ADDRESS 0xF0C13 /end MEASUREMENT
/begin MEASUREMENT wnweolrs "" UBYTE kw_ub_q0p5 1 100 0.00 127.5 FORMAT "%5.1" ECU_ADDRESS 0xF0C14 /end MEASUREMENT
/begin MEASUREMENT wnwgpa_w "" SWORD kw_sw_b128 1 100 -128.0000 127.9961 FORMAT "%8.4" ECU_ADDRESS 0xF2C0C /end MEASUREMENT
/begin MEASUREMENT wnwgpe_w "" SWORD kw_sw_b128 1 100 -128.0000 127.9961 FORMAT "%8.4" ECU_ADDRESS 0xF2BAE /end MEASUREMENT
/begin MEASUREMENT wnwgsa_w "" SWORD kw_sw_b128 1 100 -128.0000 127.9961 FORMAT "%8.4" ECU_ADDRESS 0xF2C0E /end MEASUREMENT
/begin MEASUREMENT wnwgsda_w "" SWORD kw_sw_b128 1 100 -128.0000 127.9961 FORMAT "%8.4" ECU_ADDRESS 0xF2C10 /end MEASUREMENT
/begin MEASUREMENT wnwgsde_w "" SWORD kw_sw_b128 1 100 -128.0000 127.9961 FORMAT "%8.4" ECU_ADDRESS 0xF2BB0 /end MEASUREMENT
/begin MEASUREMENT wnwgse_w "" SWORD kw_sw_b128 1 100 -128.0000 127.9961 FORMAT "%8.4" ECU_ADDRESS 0xF2BB2 /end MEASUREMENT
/begin MEASUREMENT wnwkrva_w "" SWORD kw_sw_b128 1 100 -128.0000 127.9961 FORMAT "%8.4" ECU_ADDRESS 0xF2C12 /end MEASUREMENT
/begin MEASUREMENT wnwkrve_w "" SWORD kw_sw_b128 1 100 -128.0000 127.9961 FORMAT "%8.4" ECU_ADDRESS 0xF2BB4 /end MEASUREMENT
/begin MEASUREMENT wnwssa "" UBYTE kw_q0p5 1 100 0.00 127.5 FORMAT "%5.1" ECU_ADDRESS 0xF0C2F /end MEASUREMENT
/begin MEASUREMENT wnwsse "" UBYTE kw_q0p5 1 100 0.00 127.5 FORMAT "%5.1" ECU_ADDRESS 0xF0C17 /end MEASUREMENT
/begin MEASUREMENT wphg "" SBYTE zw_sb_q0p75 1 100 -96.00 95.25 FORMAT "%5.2" ECU_ADDRESS 0xF0C58 /end MEASUREMENT
/begin MEASUREMENT wri_c_um "" UBYTE dez 1 100 0.00 255.0 FORMAT "%5.1" ECU_ADDRESS 0x382010 /end MEASUREMENT
/begin MEASUREMENT wsnwa_w "" SWORD kw_q0p0039 1 100 -128.0000 127.9961 FORMAT "%8.4" ECU_ADDRESS 0xF2C28 /end MEASUREMENT
/begin MEASUREMENT wsnwe_w "" SWORD kw_sw_b128 1 100 -128.0000 127.9961 FORMAT "%8.4" ECU_ADDRESS 0xF4F76 /end MEASUREMENT
/begin MEASUREMENT wsrnwa_w "" SWORD kw_q0p0039 1 100 -128.0000 127.9961 FORMAT "%8.4" ECU_ADDRESS 0xF2C2A /end MEASUREMENT
/begin MEASUREMENT wsrnwe_w "" SWORD kw_sw_b128 1 100 -128.0000 127.9961 FORMAT "%8.4" ECU_ADDRESS 0xF4F78 /end MEASUREMENT
/begin MEASUREMENT zalt_um "" UWORD dez 1 100 0.00 65535.00 FORMAT "%8.2" ECU_ADDRESS 0x380062 /end MEASUREMENT
/begin MEASUREMENT zcap_um "" UWORD dez 1 100 0.00 65535.00 FORMAT "%8.2" ECU_ADDRESS 0x380064 /end MEASUREMENT
/begin MEASUREMENT znachanz "" UBYTE dez 1 100 0.00 255.0 FORMAT "%5.1" ECU_ADDRESS 0xF0C59 /end MEASUREMENT
/begin MEASUREMENT znwva_w "" SWORD t5msxms_q0p039 1 100 -1280.000 1279.961 FORMAT "%8.3" ECU_ADDRESS 0xF2C2C /end MEASUREMENT
/begin MEASUREMENT znwve_w "" SWORD t5msxms_q0p039 1 100 -1280.000 1279.961 FORMAT "%8.3" ECU_ADDRESS 0xF2BCA /end MEASUREMENT
/begin MEASUREMENT znwvna "" UBYTE t5msxms_q5 1 100 0.00 1275. FORMAT "%5.0" ECU_ADDRESS 0xF0C30 /end MEASUREMENT
/begin MEASUREMENT znwvne "" UBYTE t5msxms_q5 1 100 0.00 1275. FORMAT "%5.0" ECU_ADDRESS 0xF0C18 /end MEASUREMENT
/begin MEASUREMENT znwvpa "" UBYTE t5msxms_q5 1 100 0.00 1275. FORMAT "%5.0" ECU_ADDRESS 0xF0C31 /end MEASUREMENT
/begin MEASUREMENT znwvpe "" UBYTE t5msxms_q5 1 100 0.00 1275. FORMAT "%5.0" ECU_ADDRESS 0xF0C19 /end MEASUREMENT
/begin MEASUREMENT zsync_um "" UBYTE dez 1 100 0.00 255.0 FORMAT "%5.1" ECU_ADDRESS 0xF0562 /end MEASUREMENT
/begin MEASUREMENT zw1_uc "" SBYTE zw_sb_q0p75 1 100 -96.00 95.25 FORMAT "%5.2" ECU_ADDRESS 0xF0587 /end MEASUREMENT
/begin MEASUREMENT zw1_um "" SBYTE zw_sb_q0p75 1 100 -96.00 95.25 FORMAT "%5.2" ECU_ADDRESS 0x38001E /end MEASUREMENT
/begin MEASUREMENT zw2_uc "" SBYTE zw_sb_q0p75 1 100 -96.00 95.25 FORMAT "%5.2" ECU_ADDRESS 0xF0588 /end MEASUREMENT
/begin MEASUREMENT zw2_um "" SBYTE zw_sb_q0p75 1 100 -96.00 95.25 FORMAT "%5.2" ECU_ADDRESS 0x38001F /end MEASUREMENT
/begin MEASUREMENT zwbas "" SBYTE zw_sb_q0p75 1 100 -96.00 95.25 FORMAT "%5.2" ECU_ADDRESS 0xF0C65 /end MEASUREMENT
/begin MEASUREMENT zwbasar "" SBYTE zw_sb_q0p75 1 100 -96.00 95.25 FORMAT "%5.2" ARRAY_SIZE 6 ECU_ADDRESS 0xF0C66 /end MEASUREMENT
/begin MEASUREMENT zwbasobk "" SBYTE zw_sb_q0p75 1 100 -96.00 95.25 FORMAT "%5.2" ECU_ADDRESS 0xF0C6C /end MEASUREMENT
/begin MEASUREMENT zwcalcar "" SBYTE zw_sb_q0p75 1 100 -96.00 95.25 FORMAT "%5.2" ARRAY_SIZE 6 ECU_ADDRESS 0xF0C5A /end MEASUREMENT
/begin MEASUREMENT zwc_c_um "" UBYTE dez 1 100 0.00 255.0 FORMAT "%5.1" ECU_ADDRESS 0x380020 /end MEASUREMENT
/begin MEASUREMENT zwgru "" SBYTE zw_sb_q0p75 1 100 -96.00 95.25 FORMAT "%5.2" ECU_ADDRESS 0xF0C52 /end MEASUREMENT
/begin MEASUREMENT zwist "" SBYTE zw_sb_q0p75 1 100 -96.00 95.25 FORMAT "%5.2" ECU_ADDRESS 0xF0C60 /end MEASUREMENT
/begin MEASUREMENT zwkfzw "" SBYTE zw_sb_q0p75 1 100 -96.00 95.25 FORMAT "%5.2" ECU_ADDRESS 0xF0C53 /end MEASUREMENT
/begin MEASUREMENT zwkfzw0 "" SBYTE zw_sb_q0p75 1 100 -96.00 95.25 FORMAT "%5.2" ECU_ADDRESS 0xF0C54 /end MEASUREMENT
/begin MEASUREMENT zwkfzw1 "" SBYTE zw_sb_q0p75 1 100 -96.00 95.25 FORMAT "%5.2" ECU_ADDRESS 0xF0C55 /end MEASUREMENT
/begin MEASUREMENT zwkrafld "" UBYTE dez 1 100 0.00 255.0 FORMAT "%5.1" ECU_ADDRESS 0xF0C61 /end MEASUREMENT
/begin MEASUREMENT zwmn "" SBYTE zw_sb_q0p75 1 100 -96.00 95.25 FORMAT "%5.2" ECU_ADDRESS 0xF0C43 /end MEASUREMENT
/begin MEASUREMENT zwmnd "" SBYTE zw_sb_q0p75 1 100 -96.00 95.25 FORMAT "%5.2" ECU_ADDRESS 0xF0C44 /end MEASUREMENT
/begin MEASUREMENT zwmnms "" SBYTE zw_sb_q0p75 1 100 -96.00 95.25 FORMAT "%5.2" ECU_ADDRESS 0xF0C45 /end MEASUREMENT
/begin MEASUREMENT zwmnt "" SBYTE zw_sb_q0p75 1 100 -96.00 95.25 FORMAT "%5.2" ECU_ADDRESS 0xF0C46 /end MEASUREMENT
/begin MEASUREMENT zwopt_uc "" SBYTE zw_sb_q0p75 1 100 -96.00 95.25 FORMAT "%5.2" ECU_ADDRESS 0xF0589 /end MEASUREMENT
/begin MEASUREMENT zwout "" SBYTE zw_sb_q0p75 1 100 -96.00 95.25 FORMAT "%5.2" ECU_ADDRESS 0xF0C62 /end MEASUREMENT
/begin MEASUREMENT zwoutcpl "" SBYTE zw_sb_q0p75 1 100 -96.00 95.25 FORMAT "%5.2" ECU_ADDRESS 0xF0C63 /end MEASUREMENT
/begin MEASUREMENT zwout_uc "" SBYTE zw_sb_q0p75 1 100 -96.00 95.25 FORMAT "%5.2" ECU_ADDRESS 0xF058A /end MEASUREMENT
/begin MEASUREMENT zwspae "" SBYTE zw_sb_q0p75 1 100 -96.00 95.25 FORMAT "%5.2" ECU_ADDRESS 0xF0C47 /end MEASUREMENT
/begin MEASUREMENT zwstt "" SBYTE zw_sb_q0p75 1 100 -96.00 95.25 FORMAT "%5.2" ECU_ADDRESS 0xF0C6E /end MEASUREMENT
/begin MEASUREMENT zwzyl1 "" SBYTE zw_sb_q0p75 1 100 -96.00 95.25 FORMAT "%5.2" ECU_ADDRESS 0xF0C64 /end MEASUREMENT
/begin MEASUREMENT z_flags_uc "" UBYTE dez 1 100 0.00 255.0 FORMAT "%5.1" ECU_ADDRESS 0xF0561 /end MEASUREMENT
/begin MEASUREMENT z_flags_um "" UBYTE dez 1 100 0.00 255.0 FORMAT "%5.1" ECU_ADDRESS 0x38000A /end MEASUREMENT
/begin FUNCTION UFMVER "19.10" /begin DEF_CHARACTERISTIC MVER_T_UM /end DEF_CHARACTERISTIC /begin IN_MEASUREMENT B_i_ska_um mi_um mzf_um mzo_um /end IN_MEASUREMENT /begin OUT_MEASUREMENT ei_mver_um /end OUT_MEASUREMENT /begin LOC_MEASUREMENT mdif_w_um mver_c_um mzfo_um /end LOC_MEASUREMENT /end FUNCTION
/begin FUNCTION UFMZF "19.10" /begin DEF_CHARACTERISTIC MZFFIL_UM MZFTV_UM /end DEF_CHARACTERISTIC /begin IN_MEASUREMENT mz_um /end IN_MEASUREMENT /begin OUT_MEASUREMENT mzf_um /end OUT_MEASUREMENT /begin LOC_MEASUREMENT mzf_low_um mzf_ptr_um mzf_reg_um /end LOC_MEASUREMENT /end FUNCTION
/begin FUNCTION UFMZUL "19.30"
 /begin DEF_CHARACTERISTIC KFDMP_UM_0 KFDMP_UM_1 KFDMT_UM_0 KFDMT_UM_1 KFMMKH_UM KFMOF_UM KFPZU_UM_0 KFPZU_UM_1 KLLLRZU_UM KLMIMAX_UM KLMIMIN_UM KLMZUMN_UM MDV08_UM SPSNLL_UM TMMKH_UM TMOMIN_UM TMOV08_UM /end DEF_CHARACTERISTIC
 /begin REF_CHARACTERISTIC NMV08_UM SPSNV08_UM /end REF_CHARACTERISTIC
 /begin IN_MEASUREMENT mfgr_um mmsr_um mrlini_um msgs_um nmot_um nmst08_um nsc_c_um spsnst08_um spsn_um tmot_um vkpedch_um /end IN_MEASUREMENT
 /begin OUT_MEASUREMENT B_klmzu_um mzo_um mz_um /end OUT_MEASUREMENT
 /begin LOC_MEASUREMENT mdst08_um mped_um tmost08_um tmotmn_um /end LOC_MEASUREMENT
/end FUNCTION
/begin FUNCTION UFNC "3.20" /begin DEF_CHARACTERISTIC NC_T_UM NDIF_UM NMIN_UM TZTOL_UM /end DEF_CHARACTERISTIC /begin IN_MEASUREMENT B_i_ska_um nmot /end IN_MEASUREMENT /begin OUT_MEASUREMENT ei_nc_um nmot_um /end OUT_MEASUREMENT /begin LOC_MEASUREMENT nc_c_um nz_um talt_um tcap_um zalt_um zcap_um zsync_um /end LOC_MEASUREMENT /end FUNCTION
/begin FUNCTION UFNSC "2.20"
 /begin DEF_CHARACTERISTIC NSC_T_UM NSOF_T_UM N_START_UM N_STEND_UM TANSMN_UM TMNSMN_UM /end DEF_CHARACTERISTIC
 /begin IN_MEASUREMENT nmot_um tans_um tmot_um /end IN_MEASUREMENT
 /begin OUT_MEASUREMENT B_mzns_um nsc_c_um /end OUT_MEASUREMENT
 /begin LOC_MEASUREMENT nsof_c_um /end LOC_MEASUREMENT
/end FUNCTION
/begin FUNCTION UFREAC "19.10"
 /begin DEF_CHARACTERISTIC KLNPED_UM NMXSKA_UM NOREA_UM NSKAZO_UM REAC_T2_UM REAC_T3_UM /end DEF_CHARACTERISTIC
 /begin IN_MEASUREMENT azoffmsk_w evz_austot nmot_um spsn_um /end IN_MEASUREMENT
 /begin OUT_MEASUREMENT ei_reac_um /end OUT_MEASUREMENT
 /begin LOC_MEASUREMENT nska_um reac_c2_um reac_c3_um /end LOC_MEASUREMENT
/end FUNCTION
/begin FUNCTION UFRKC "4.30" /begin OUT_MEASUREMENT frksch_um lamb1_um lamb2_um mrlini_um /end OUT_MEASUREMENT /end FUNCTION
/begin FUNCTION UFRLC "14.10"
 /begin DEF_CHARACTERISTIC IP1A_MX_UM IP2A_MN_UM IPA_T_UM KFRLIP_UM NRLIP_UM RLC_T_UM RLIPFIL_UM RLIPTV_UM RLIP_T_UM RL_BO_UM RL_MO_UM /end DEF_CHARACTERISTIC
 /begin IN_MEASUREMENT B_dkp2e B_i_ska_um B_mszsdkb iUipoti1_w iUipoti2_w nmot_um rl rl_w udkp1a udkp2a /end IN_MEASUREMENT
 /begin OUT_MEASUREMENT ei_ipa_um ei_rlc_um ei_rlip_um rl_um /end OUT_MEASUREMENT
 /begin LOC_MEASUREMENT ipa_c_um ipsn_um rlc_c_um rlf_ptr_um rlf_reg_um rlipf_l_um rlipf_um rlip_c_um rlip_um rlzo_um rl_w_um /end LOC_MEASUREMENT
/end FUNCTION
/begin FUNCTION UFSGSC "25.10" /begin DEF_CHARACTERISTIC MSGSMX_UM SGSC_T_UM TSGSCNU_UM /end DEF_CHARACTERISTIC
 /begin IN_MEASUREMENT asgphnpl bz_cange B_asgphnpl B_asgpli B_wkauf B_wkr B_zges misgscpl_w misgs_w momint_w mz_um nsyw nsywin /end IN_MEASUREMENT
 /begin OUT_MEASUREMENT B_nosgs_um B_sgspl_um msgs_um /end OUT_MEASUREMENT
 /begin LOC_MEASUREMENT bzsgs_c_um bz_sgsa_um ei_sgsc_um momi_a1_um momi_a2_um sgsc_c_um /end LOC_MEASUREMENT
/end FUNCTION
/begin FUNCTION UFSPSC "12.10" /begin DEF_CHARACTERISTIC SP12LL_UM SP12VG_UM SPSC_MINUM SPSC_T_UM SPSVG_UM /end DEF_CHARACTERISTIC
 /begin IN_MEASUREMENT B_i_ska_um B_pwgnotfr B_sp1s B_sp2s B_spsmin iUspoti1_w iUspoti2_w /end IN_MEASUREMENT
 /begin OUT_MEASUREMENT B_pwgnotum ei_spsc_um spsn_um /end OUT_MEASUREMENT
 /begin LOC_MEASUREMENT sp1s_um sp2ds_um spsc_c_um /end LOC_MEASUREMENT
/end FUNCTION
/begin FUNCTION UFURAM "" /begin DEF_CHARACTERISTIC CW_BDE_UM RST_TV_UM UMECRST_TV_UM UMRST_TV_UM WAIT_T_UM /end DEF_CHARACTERISTIC
 /begin OUT_MEASUREMENT b_flags_um B_i_ska_um c_flags_um d_flags_um f_flags_um n_flags_um ram_c_um reac_c_um reset_indication_um romErrPage romz_c_um rst_tv r_flags_um srst_c_um s_flags_um t_flags_um umrst_c_um wri_c_um z_flags_um /end OUT_MEASUREMENT
 /begin LOC_MEASUREMENT B_accak_um B_accen_um B_accmx_um B_accof_um B_accpc_um B_bboak_um B_bboe_um B_bbovf_um B_blspc_um B_bls_um B_brems_um B_brfgr_um B_bsl_um B_dcdis_c_um B_dcdis_um B_fabr_um B_fgrca_um B_fgrenold_um B_fgren_um B_fgron_um B_fgrpc_um B_fgr_um_c B_i_ska B_kkl_um B_ll_um B_msrmx_um B_msrpc_um B_msthw_um B_mzns_c_um B_nlh_um B_nobrs_um B_nome_c_um B_notlu B_notst_um B_nsakt_um B_nsend_um B_res_um B_rlini_um B_rluf_um B_sgsmx_um B_sgspc_um B_ubska_c_um B_ub_ska B_ufol_um B_vzl_um B_wal_um ei_sgso_um S_schao_um /end LOC_MEASUREMENT
/end FUNCTION
/begin FUNCTION UFVARC "2.10" /begin OUT_MEASUREMENT ei_varc_um vkpedch_um /end OUT_MEASUREMENT /begin LOC_MEASUREMENT varc_c_um /end LOC_MEASUREMENT /end FUNCTION
/begin FUNCTION UFZWC "18.10" /begin DEF_CHARACTERISTIC ZWC_T_UM ZYLANZ_UM /end DEF_CHARACTERISTIC /begin IN_MEASUREMENT B_i_ska_um zwout zwoutcpl /end IN_MEASUREMENT /begin OUT_MEASUREMENT ei_zwc_um zw1_um zw2_um /end OUT_MEASUREMENT /begin LOC_MEASUREMENT zwc_c_um /end LOC_MEASUREMENT /end FUNCTION
/begin FUNCTION UMKOM "16.10" /begin DEF_CHARACTERISTIC AUSC_A_UM /end DEF_CHARACTERISTIC /begin REF_CHARACTERISTIC UMRST_TV_UM /end REF_CHARACTERISTIC /begin IN_MEASUREMENT B_i_ska_um B_ubdve rst_tv umrst_c_um /end IN_MEASUREMENT /begin OUT_MEASUREMENT auscf_c_um ei_ubr_um /end OUT_MEASUREMENT /begin LOC_MEASUREMENT ausc_c_um uma2_res umErrorCtrFr /end LOC_MEASUREMENT /end FUNCTION
/begin FUNCTION UPRAM031 "" /begin OUT_MEASUREMENT tcclkldf_w tccpkldf_w /end OUT_MEASUREMENT /end FUNCTION
/begin FUNCTION URADCC "15.10" /begin DEF_CHARACTERISTIC ADCC_T_UM SP1ADC_DIF SP1_STAT SP1_STAT_T /end DEF_CHARACTERISTIC /begin IN_MEASUREMENT B_i_ska_fr B_i_ska_um B_notlu_fr B_pwgnotum iUspoti1_w /end IN_MEASUREMENT /begin OUT_MEASUREMENT ei_adcc_um /end OUT_MEASUREMENT /begin LOC_MEASUREMENT adcc_c_um sp1p_a_um sp1p_st_um sp1s_a_um sp1s_st_um /end LOC_MEASUREMENT /end FUNCTION
/begin FUNCTION URAUSG "" /begin DEF_CHARACTERISTIC AUSGH_T_UM AUSG_T_UM AUSZH_T_UM AUSZH_T_UR AUSZ_T_UM /end DEF_CHARACTERISTIC /begin LOC_MEASUREMENT ausgh_c_um ausg_c_um auszh_c_um ausz_c_um /end LOC_MEASUREMENT /end FUNCTION
/begin FUNCTION URCFGRC ""
 /begin DEF_CHARACTERISTIC FGRC_BFGR_DAT_UC FGRC_MIFA_DAT_UC FGRC_SFLAGS_DAT_UC FGRC_TFLAGS_DAT_UC FGRC_VFZG_DAT_UC VMINACC_UC VMIN_UC /end DEF_CHARACTERISTIC
 /begin OUT_MEASUREMENT abfgrc_uc B_fgr_bt B_fgr_uc mfgr_uc mifa_bt vfzg_bt /end OUT_MEASUREMENT
/end FUNCTION
/begin FUNCTION URCMIST ""
 /begin DEF_CHARACTERISTIC KFMI_UC KFZW_UC KLDZWOM_UC KLETAZW_UC KLFAKSP_UC KLZL1_UC KLZL2_UC MIST_FRKSCH_DAT_UC MIST_LAMB1_DAT_UC MIST_LAMB2_DAT_UC MIST_NMOT_DAT_UC MIST_NMV08_UC MIST_NSC_DAT_UC MIST_RLV08_UC MIST_RL_DAT_UC MIST_TMOT_DAT_UC MIST_ZW1_DAT_UC MIST_ZW2_DAT_UC NSC_T2_UC TMISTMN_UC /end DEF_CHARACTERISTIC
 /begin IN_MEASUREMENT nmot_uc nmst08_uc tmot_uc /end IN_MEASUREMENT
 /begin OUT_MEASUREMENT abmist_uc mi_uc nsc_c_uc rlst08_uc rl_uc /end OUT_MEASUREMENT
 /begin LOC_MEASUREMENT dzw1_uc dzw2_uc dzw_uc etafrks_uc etazw_uc frksch_uc lamb1_uc lamb2_uc miopt_uc tmnist_uc zw1_uc zw2_uc zwopt_uc zwout_uc /end LOC_MEASUREMENT
/end FUNCTION
/begin FUNCTION URCMSRC ""
 /begin DEF_CHARACTERISTIC BZMSR_T_UC DBMSRMX_UC DBMSR_T_UC MSRC_BMSR_DAT_UC MSRC_BZMSRA_DAT_UC MSRC_BZMSRC_DAT_UC MSRC_BZMSR_DAT_UC MSRC_C_DAT_UC MSRC_DBMSRC_DAT_UC MSRC_MDASRL_DAT_UC MSRC_MDASRS_DAT_UC MSRC_MDMSR_DAT_UC MSRC_MMSR_DAT_UC MSRC_SBIT_DAT_UC MSRC_T_UC NOASR_UC /end DEF_CHARACTERISTIC
 /begin OUT_MEASUREMENT abmsrc_uc B_nomsr_bt B_nomsr_uc B_npmsr_uc ei_msrc_uc mmsr_uc /end OUT_MEASUREMENT
 /begin LOC_MEASUREMENT bzmsr_a_uc bzmsr_c_uc dbmsr_c_uc msrc_c_uc /end LOC_MEASUREMENT
/end FUNCTION
/begin FUNCTION URCMVER ""
 /begin DEF_CHARACTERISTIC MVER_C_DAT_UC MVER_MI_DAT_UC MVER_MZF_DAT_UC MVER_MZO_DAT_UC MVER_RFLAGS_DAT_UC MVER_T_UC /end DEF_CHARACTERISTIC
 /begin IN_MEASUREMENT B_i_ska_uc mi_uc mzf_uc mzo_uc /end IN_MEASUREMENT
 /begin OUT_MEASUREMENT abmver_uc ei_mver_uc /end OUT_MEASUREMENT
 /begin LOC_MEASUREMENT mdif_w_uc mver_c_uc mzfo_uc /end LOC_MEASUREMENT
/end FUNCTION
/begin FUNCTION URCMZF ""
 /begin DEF_CHARACTERISTIC MZFFIL_UC MZFTV_UC MZF_LOW_DAT_UC MZF_MZF_DAT_UC MZF_MZ_DAT_UC MZF_PTR_DAT_UC MZF_REG_DAT_UC /end DEF_CHARACTERISTIC
 /begin IN_MEASUREMENT mz_uc /end IN_MEASUREMENT
 /begin OUT_MEASUREMENT abmzf_uc mzf_uc /end OUT_MEASUREMENT
 /begin LOC_MEASUREMENT mzf_low_uc mzf_ptr_uc mzf_reg_uc mzf_x_uc mzf_y_uc /end LOC_MEASUREMENT
/end FUNCTION
/begin FUNCTION URCMZUL ""
 /begin DEF_CHARACTERISTIC KFDMP_UC_0 KFDMP_UC_1 KFDMT_UC_0 KFDMT_UC_1 KFMMKH_UC KFMOF_UC KFPZU_UC_0 KFPZU_UC_1 KLLLRZU_UC KLMIMAX_UC KLMIMIN_UC KLMZUMN_UC MDV08_UC MZUL_MFGR_DAT_UC MZUL_MMSR_DAT_UC MZUL_MRLINI_DAT_UC MZUL_MSGS_DAT_UC MZUL_NFLAGS_DAT_UC MZUL_NMOT_DAT_UC MZUL_NMV08_UC MZUL_NSC_DAT_UC MZUL_SPSNV08_UC MZUL_SPSN_DAT_UC MZUL_TFLAGS_DAT_UC MZUL_TMOT_DAT_UC MZUL_VKPEDCH_DAT_UC SPSNLL_UC TMMKH_UC TMOMIN_UC TMOV08_UC /end DEF_CHARACTERISTIC
 /begin IN_MEASUREMENT mfgr_uc mmsr_uc mrlini_uc msgs_uc nsc_c_uc /end IN_MEASUREMENT
 /begin OUT_MEASUREMENT abmzul_uc B_klmzu_uc mzo_uc mz_uc nmot_uc nmst08_uc spnst08_uc spsn_uc tmot_uc vkpedch_uc /end OUT_MEASUREMENT
 /begin LOC_MEASUREMENT mdst08_uc mped_uc tmost08_uc tmotmn_uc /end LOC_MEASUREMENT
/end FUNCTION
/begin FUNCTION URCPU "39.10"
 /begin IN_MEASUREMENT abfgrc_uc abmist_uc abmsrc_uc abmver_uc abmzf_uc abmzul_uc abreac_uc abrkc_uc absgsc_uc uma2_res /end IN_MEASUREMENT
/end FUNCTION
/begin FUNCTION URCRAM "" /begin DEF_CHARACTERISTIC CW_BDE_UC /end DEF_CHARACTERISTIC
 /begin OUT_MEASUREMENT b_flags_uc B_i_ska_uc c_flags_uc d_flags_uc f_flags_uc n_flags_uc r_flags_uc s_flags_uc t_flags_uc z_flags_uc /end OUT_MEASUREMENT
/end FUNCTION
/begin FUNCTION URCREAC ""
 /begin DEF_CHARACTERISTIC KLNPED_UC NMXSKA_UC NOREA_UC NSKAZO_UC REAC_AZOFFM_DAT_UC REAC_C2_DAT_UC REAC_C3_DAT_UC REAC_EVZAUS_DAT_UC REAC_NMOT_DAT_UC REAC_RFLAGS_DAT_UC REAC_SPSN_DAT_UC REAC_T2_UC REAC_T3_UC /end DEF_CHARACTERISTIC
 /begin IN_MEASUREMENT nmot_uc spsn_uc /end IN_MEASUREMENT
 /begin OUT_MEASUREMENT abreac_uc azoff_w_bt evz_aus_bt /end OUT_MEASUREMENT
 /begin LOC_MEASUREMENT nska_uc reac_c2_uc reac_c3_uc /end LOC_MEASUREMENT
/end FUNCTION
/begin FUNCTION URCRKC "" /begin DEF_CHARACTERISTIC RKC_MRLINI_DAT_UC /end DEF_CHARACTERISTIC /begin OUT_MEASUREMENT abrkc_uc mrlini_uc /end OUT_MEASUREMENT /end FUNCTION
/begin FUNCTION URCSGSC ""
 /begin DEF_CHARACTERISTIC MSGSMX_UC SGSC_ASGPUC_DAT_UC SGSC_BASGPL_DAT_UC SGSC_BASGPU_DAT_UC SGSC_BWKRA_DAT_UC SGSC_BWKR_DAT_UC SGSC_BZGES_DAT_UC SGSC_BZ_CANGE_DAT_UC SGSC_BZ_SGS_A_DAT_UC SGSC_BZ_SGS_DAT_UC SGSC_C_DAT_UC SGSC_MISGSCPL_DAT_UC SGSC_MISGS_DAT_UC SGSC_MOMIA1_DAT_UC SGSC_MOMIA2_DAT_UC SGSC_MOMINT_DAT_UC SGSC_MSGS_DAT_UC SGSC_MZ_DAT_UC SGSC_NSYWIN_DAT_UC SGSC_NSYW_DAT_UC SGSC_T_UC TSGSCNU_UC /end DEF_CHARACTERISTIC
 /begin IN_MEASUREMENT mz_uc /end IN_MEASUREMENT
 /begin OUT_MEASUREMENT absgsc_uc asgphnpl_bt bz_cange_bt B_asgphnpl_bt B_asgpli_bt B_nosgs_uc B_sgspl_uc B_wkauf_bt B_wkr_bt B_zges_bt misgscpl_bt misgs_bt momint_bt msgs_uc nsywin_bt nsyw_bt /end OUT_MEASUREMENT
 /begin LOC_MEASUREMENT bzsgs_c_uc bz_sgsa_uc B_emintmx_uc B_emint_uc ei_sgsc_uc momi_a1_uc momi_a2_uc sgsc_c_uc /end LOC_MEASUREMENT
/end FUNCTION
/begin FUNCTION URDELAY "" /begin REF_CHARACTERISTIC NOREA_UM RST_TV_UM WAIT_T_UM /end REF_CHARACTERISTIC /begin IN_MEASUREMENT rst_tv /end IN_MEASUREMENT /begin OUT_MEASUREMENT delayedTime_w rst_tv_active /end OUT_MEASUREMENT /end FUNCTION
/begin FUNCTION URMEM "3.20" /begin OUT_MEASUREMENT urmcksc1 urmcksc2 urmcksda urmpatco /end OUT_MEASUREMENT /end FUNCTION
/begin FUNCTION URRAM "2.10" /end FUNCTION
/begin FUNCTION URROM "2.30" /begin DEF_CHARACTERISTIC CW_NOROMCHKRESET ROMRSTA_UM /end DEF_CHARACTERISTIC /begin IN_MEASUREMENT B_nlsiko swOffDlBits /end IN_MEASUREMENT /begin OUT_MEASUREMENT romRstC_um /end OUT_MEASUREMENT /end FUNCTION
/begin FUNCTION VAR "445.20" /begin DEF_CHARACTERISTIC VARTAB /end DEF_CHARACTERISTIC /begin OUT_MEASUREMENT vkAirbag vkCAN vkCAN2 vkCAN3 vkKlima /end OUT_MEASUREMENT /end FUNCTION
/begin FUNCTION VAR_DST "" /begin REF_CHARACTERISTIC VARDEF VARTAB /end REF_CHARACTERISTIC /begin LOC_MEASUREMENT pmcod_w /end LOC_MEASUREMENT /end FUNCTION
/begin FUNCTION VMAXMD "5.10" /begin DEF_CHARACTERISTIC KIVMXG KPVMXG TVMXPRG /end DEF_CHARACTERISTIC /begin IN_MEASUREMENT bfzgl_w dmllri_w gangi mifab_w mimin_w vfzg_w vmax_w /end IN_MEASUREMENT /begin OUT_MEASUREMENT B_vmax mivmx_w /end OUT_MEASUREMENT /begin LOC_MEASUREMENT dvsi_w mivmxi_w mivmxp_w vivmx_w vsvmx_w /end LOC_MEASUREMENT /end FUNCTION
/begin FUNCTION VS_VERST "2.40" /begin DEF_CHARACTERISTIC CWVSV /end DEF_CHARACTERISTIC
 /begin OUT_MEASUREMENT vsdmr vsfpses vsfrk vske vsldtv vsns vsrlmx vsvw vswnws vszw vszwkr /end OUT_MEASUREMENT
 /begin LOC_MEASUREMENT B_mcacti /end LOC_MEASUREMENT
/end FUNCTION
/begin FUNCTION WDKSOM "2.40"
 /begin DEF_CHARACTERISTIC KFWDKSST KFWDKTHO KLWDKABST KLWDKPED KLWDKTAN NWDKSST TFWDKSOM TWDKRED TWDKSNST WDKSNLN /end DEF_CHARACTERISTIC
 /begin IN_MEASUREMENT B_enllri B_llrein B_nmin fho miist_w miszul_w nmot nmot_w tabst_w tans tmst wped /end IN_MEASUREMENT
 /begin OUT_MEASUREMENT B_munst B_tfwdksom B_wdksom tfwdksom_w wdksom_w /end OUT_MEASUREMENT
/end FUNCTION
/begin FUNCTION wfs "" /begin DEF_CHARACTERISTIC CWWFS WFSKLASSE WFSMARKE WFSTRETRY /end DEF_CHARACTERISTIC /begin IN_MEASUREMENT B_ecudev B_pwf nmot_w u_immo /end IN_MEASUREMENT
 /begin OUT_MEASUREMENT B_wfs00ur B_wfs58ur B_wfsaudis B_wfsautos B_wfsch50t B_wfscheck B_wfscrynl B_wfscryva B_wfsdisab B_wfsdwndd B_wfsdwnst B_wfseepnl B_wfsepast B_wfsepctr B_wfsepn0 B_wfsepn1 B_wfsepn2 B_wfsepn3 B_wfsepn4 B_wfsepn5 B_wfsepn6 B_wfsepn7 B_wfsepnok B_wfsepok B_wfseptst B_wfsflsh B_wfsfrest B_wfslnact B_wfsload B_wfsnlrq B_wfsnplau B_wfsp2max B_wfsp2sta B_wfsp2to B_wfsretry B_wfsrpm B_wfsrqdc B_wfsrqdce B_wfsrqdd B_wfsrqdde B_wfsrqtpc B_wfsrqtpo B_wfsrqvc B_wfsrqvce B_wfsrqvd B_wfsrqvde B_wfsrsdc B_wfsrsdce B_wfsrsdd B_wfsrsdde B_wfsrsnet B_wfsstaok B_wfstpco B_wfsulem B_wfsvine B_wfswin2 wfsAusBits1 wfsAusBits10ms1 wfsAusBits10ms2 wfsAusBits10ms3 wfsAusBits10ms4 wfsAusBits10ms5 wfsAusBits10ms6 wfsAusBits10ms7 wfsAusBitsNov10ms1 wfsCommEepOld wfsCommImsOld wfsCommTstOld wfsCtrAuSt wfsCtrAuth wfsCtrn0_w wfsCtrP2C wfsCtrRetr wfsEcuSt_w wfsEepReq wfsEepReqO wfsIdxSigE wfsIdxSigI wfsIId wfsIIdIms wfsKwpRspC wfsVin wfsVinIms wfsVinUr wfs_cyclus /end OUT_MEASUREMENT
 /begin LOC_MEASUREMENT B_wfsdelay B_wfsdgrdy B_wfslnnok B_wfsrcnl B_wfswin1 cmdError_w wfsCtrRcErr wfsCtrRcnl wfsLokBits1 wfsLokBits10ms1 wfsTime wfsWinTime /end LOC_MEASUREMENT
/end FUNCTION
/begin FUNCTION WFSCOM "1.40" /end FUNCTION
/begin FUNCTION WFSIF "48.41" /begin IN_MEASUREMENT B_nlwfs B_wfsnlrq /end IN_MEASUREMENT /begin OUT_MEASUREMENT B_eculock /end OUT_MEASUREMENT /end FUNCTION
/begin FUNCTION WNWRA "5.110"
 /begin DEF_CHARACTERISTIC CWNWRA EDNWA FNWIVA FTANWUBA ITANWHFMA KFIVMXNWA KFNWDA KLFNWPA KLWNWSLRA KLWSNWA KLWSRNWA KNWBNA KNWBPA KNWVTKA KTNWDA KZNWVNA KZNWVPA STO08NAUW TANWNA TANWPSA TANWSDA THTVAI TVINWSA TVNWMNA TVNWMXA TWNWSA TWNWSSRNA TWNWSSRPA WNWSHMNA WNWSHMXA WSNWSA ZNWFILA ZNWVHA /end DEF_CHARACTERISTIC
 /begin REF_CHARACTERISTIC CWKVHR SNM06NWUB /end REF_CHARACTERISTIC
 /begin IN_MEASUREMENT B_kdhre B_nwia B_nwrposa B_nwvfa B_pwofnwa B_wnws0a esst_snm06nwub nmot tmot tnst_w tnwia_w toelzk_w ub wnwass wnwisa_w /end IN_MEASUREMENT
 /begin OUT_MEASUREMENT esst_sto08nauw tanwra tanwraa tnwvtka wnwam wnwgpa_w wsnwa_w wsrnwa_w /end OUT_MEASUREMENT
 /begin LOC_MEASUREMENT B_nwcoa B_nwha B_nwiva B_nwscoa B_nwvha B_nwvna B_nwvpa B_wnwsaii B_wnwsait dwnwa_w dwnwsa_w fnwda_w fnwpa ftanwubka ftnwa ivmxnwa sdnnwa_w sdtnwa_w tanwda_w tanwdza_w tanwoda_w tanwpa_w tanwrha_w tnwda_w tnwdza_w tvnwsai_w tvsta vnwa_w vnwda_w vnwdza_w wnwaslrs wnwgsa_w wnwgsda_w wnwkrva_w wnwssa znwva_w znwvna znwvpa /end LOC_MEASUREMENT
/end FUNCTION
/begin FUNCTION WNWRE "5.110"
 /begin DEF_CHARACTERISTIC CWNWRE EDNWE FNWIVE FTANWUBE ITANWHFME KFIVMXNWE KFNWDE KLFNWPE KLWNWSLRE KLWSNWE KLWSRNWE KNWBNE KNWBPE KNWVTKE KTNWDE KZNWVNE KZNWVPE STO08NEUW TANWNE TANWPSE TANWSDE THTVEI TVINWSE TVNWMNE TVNWMXE TWNWSE TWNWSSRNE TWNWSSRPE WNWSHMNE WNWSHMXE WSNWSE ZNWFILE ZNWVHE /end DEF_CHARACTERISTIC
 /begin REF_CHARACTERISTIC CWKVHR SNM06NWUB /end REF_CHARACTERISTIC
 /begin IN_MEASUREMENT B_kdhre B_nwie B_nwrpose B_nwvfe B_pwofnwe B_wnws0e esst_snm06nwub nmot tmot tnst_w tnwie_w toelk_w toelzk_w ub wnweos wnwise_w /end IN_MEASUREMENT
 /begin OUT_MEASUREMENT esst_STO08NEUW tanwre tanwrea wnwem wnwgpe_w /end OUT_MEASUREMENT
 /begin LOC_MEASUREMENT B_nwcoe B_nwhe B_nwive B_nwscoe B_nwvhe B_nwvne B_nwvpe B_wnwseii B_wnwseit dwnwe_w dwnwse_w fnwde_w fnwpe ftanwubke ftnwe ivmxnwe sdnnwe_w sdtnwe_w tanwde_w tanwdze_w tanwode_w tanwpe_w tanwrhe_w tnwde_w tnwdze_w tnwvtke toelnwr tvnwsei_w tvste vnwde_w vnwdze_w vnwe_w wnweolrs wnwgsde_w wnwgse_w wnwkrve_w wnwsse wsnwe_w wsrnwe_w znwve_w znwvne znwvpe /end LOC_MEASUREMENT
/end FUNCTION
/begin FUNCTION ZUESZ "3.50"
 /begin DEF_CHARACTERISTIC CW_FUBND DTSDRL DUBZS FFLDZ FSWTM FSZTM FTOMN FTSDRLW FUBAOF FWNMOT KFFFANZ KFSZDUB KFSZT KFTSDYN KFTSRL NMNZUESA NMXZUESA TSMNSA TSMX TSMXNL TZSUDYN /end DEF_CHARACTERISTIC
 /begin IN_MEASUREMENT B_lsd B_sa drlsolf_w E_dk E_lm ngfil ngfil_w nmot nmot_w rl tmot ub wped /end IN_MEASUREMENT
 /begin OUT_MEASUREMENT B_ff fubaanz offz_w szfuba_w sztcalc_w /end OUT_MEASUREMENT
 /begin LOC_MEASUREMENT B_swdy B_zb B_zuesa ftsdrl ftsdyn ftsub szout_w szrl_w tsdrlmx_w tsrl tsrldyn tzsCtr ubn uzue /end LOC_MEASUREMENT
/end FUNCTION
/begin FUNCTION ZWBAS "6.10" /begin DEF_CHARACTERISTIC ZWAPPL /end DEF_CHARACTERISTIC /begin IN_MEASUREMENT B_llrein dwkrz dzwwl wkrdy zwgru zwstt zzylzue /end IN_MEASUREMENT /begin OUT_MEASUREMENT zwbas zwbasar /end OUT_MEASUREMENT /begin LOC_MEASUREMENT zwbasobk /end LOC_MEASUREMENT /end FUNCTION
/begin FUNCTION ZWGRU "48.40"
 /begin DEF_CHARACTERISTIC CNOKT DFDZWS DFDZWSU KFDWSZ KFDWSZU KFDZK KFDZWKG KFSWKFZK KFSWKFZKR KFZW KFZW2 KFZWA KFZWA2 TSWZK TSWZKR /end DEF_CHARACTERISTIC
 /begin REF_CHARACTERISTIC SLA09OPUW SNM16ZUUW SRL12ZUUW /end REF_CHARACTERISTIC
 /begin IN_MEASUREMENT B_kr B_krdws B_sunw dzwol esst_sla09opuw esst_snm16opuw esst_snm16zuuw esst_srl11opuw esst_srl12zuuw fnwaa fnwea lambas_w nmot_w rl_w wkrma /end IN_MEASUREMENT
 /begin OUT_MEASUREMENT B_kfzk dzwbankar dzwzk zwgru /end OUT_MEASUREMENT
 /begin LOC_MEASUREMENT dzwb2 dzwkg fdzwsu zwkfzw zwkfzw0 zwkfzw1 /end LOC_MEASUREMENT
/end FUNCTION
/begin FUNCTION ZWMIN "12.20"
 /begin DEF_CHARACTERISTIC CWKHZW DNTIPDYN DNZWMN DZWAML DZWDYN DZWSPM FZWKHMX KFDZMNST KFETAMNMS KFETANKH KFETAZN KLFZWMNKH KLFZWMNST TNSZWTIP TTIPINEN TTIPINON TVZWMSA TVZWMSE ZWSPAEINI /end DEF_CHARACTERISTIC
 /begin REF_CHARACTERISTIC DZWETA ETADZW SNM04ZUUB SNM16OPUW SNS04ZUSB SRL11OPUW STM08__UB /end REF_CHARACTERISTIC
 /begin IN_MEASUREMENT B_kh B_kuppl B_kw B_ll B_llrein B_munst B_sa B_st dns esst_snm04zuub esst_snm16opuw esst_sns04zusb esst_srl11opuw esst_stm08__ub fmdkh gangi migs_w misolv_w misol_w ml ngfil nmot nmot_w nstat rl_w tmot tnst_w zwist zwopt zwstt /end IN_MEASUREMENT
 /begin OUT_MEASUREMENT etamns etazwmn zwspae /end OUT_MEASUREMENT
 /begin LOC_MEASUREMENT B_zwmnpst B_zwms dzwdyntp dzwmna dzwmnms dzwspae dzwspma dzwtipin etamnms fzwmn_w tzwmnnst_w zwmn zwmnd zwmnms zwmnt /end LOC_MEASUREMENT
/end FUNCTION
/begin FUNCTION ZWSEL "5.20" /begin DEF_CHARACTERISTIC NACHANZA WPHN /end DEF_CHARACTERISTIC
 /begin IN_MEASUREMENT B_nozwe B_sa B_zwappl dzwbankar nmot redist zwbas zwbasar zwsol zwspae zzylzue /end IN_MEASUREMENT
 /begin OUT_MEASUREMENT B_zwkra znachanz zwcalcar zwist zwkrafld zwout zwoutcpl zwzyl1 /end OUT_MEASUREMENT
 /begin LOC_MEASUREMENT wphg /end LOC_MEASUREMENT
/end FUNCTION
/begin FUNCTION ZWSTT "4.30" /begin DEF_CHARACTERISTIC DZWSTTA KFZWSTTM /end DEF_CHARACTERISTIC /begin IN_MEASUREMENT B_llrein nmot tans tmst /end IN_MEASUREMENT /begin OUT_MEASUREMENT zwstt /end OUT_MEASUREMENT /end FUNCTION
/begin FUNCTION ZWWL "5.40" /begin DEF_CHARACTERISTIC FZWWLRLN KFZWWLNM KFZWWLRL /end DEF_CHARACTERISTIC /begin REF_CHARACTERISTIC SNM12ESUB SRL06ESUB STA12WLUB /end REF_CHARACTERISTIC
 /begin IN_MEASUREMENT esst_snm12esub esst_srl06esub esst_sta12wlub nmot rl tans tmot /end IN_MEASUREMENT
 /begin OUT_MEASUREMENT dzwwl /end OUT_MEASUREMENT
/end FUNCTION
/begin COMPU_METHOD B_TRUE "" TAB_VERB "%6.3" "" COMPU_TAB_REF B_TRUE /end COMPU_METHOD
/begin COMPU_VTAB B_TRUE "" TAB_VERB 2 0 "----" 1 "TRUE" /end COMPU_VTAB
/begin COMPU_METHOD dez "" RAT_FUNC "%6.2" "" COEFFS 0 1 0 0 0 1 /end COMPU_METHOD
/begin COMPU_METHOD DEZL "" RAT_FUNC "%6.2" "" COEFFS 0 1 0 0 0 1 /end COMPU_METHOD
/begin COMPU_METHOD dezsub1 "" RAT_FUNC "%6.2" "-" COEFFS 0 1 -1 0 0 1 /end COMPU_METHOD
/begin COMPU_METHOD fak_q0p00153 "" RAT_FUNC "%6.4" "-" COEFFS 0 256 0 0 0 0.390625 /end COMPU_METHOD
/begin COMPU_METHOD fak_ub_b1 "" RAT_FUNC "%6.4" "-" COEFFS 0 256 0 0 0 1 /end COMPU_METHOD
/begin COMPU_METHOD fak_ub_b16 "" RAT_FUNC "%6.4" "-" COEFFS 0 256 0 0 0 16 /end COMPU_METHOD
/begin COMPU_METHOD fak_ub_b1p25_o0p75 "" RAT_FUNC "%6.3" "-" COEFFS 0 1 -0.75 0 0 0.00195313 /end COMPU_METHOD
/begin COMPU_METHOD fak_ub_b2 "" RAT_FUNC "%6.4" "-" COEFFS 0 256 0 0 0 2 /end COMPU_METHOD
/begin COMPU_METHOD fak_ub_b4 "" RAT_FUNC "%6.4" "-" COEFFS 0 256 0 0 0 4 /end COMPU_METHOD
/begin COMPU_METHOD fak_ub_b8 "" RAT_FUNC "%6.4" "-" COEFFS 0 256 0 0 0 8 /end COMPU_METHOD
/begin COMPU_METHOD fak_uw_b1 "" RAT_FUNC "%7.6" "-" COEFFS 0 65536 0 0 0 1 /end COMPU_METHOD
/begin COMPU_METHOD fak_uw_b16 "" RAT_FUNC "%6.5" "-" COEFFS 0 65536 0 0 0 16 /end COMPU_METHOD
/begin COMPU_METHOD fak_uw_b2 "" RAT_FUNC "%7.6" "-" COEFFS 0 65536 0 0 0 2 /end COMPU_METHOD
/begin COMPU_METHOD fak_uw_b4 "" RAT_FUNC "%7.6" "-" COEFFS 0 65536 0 0 0 4 /end COMPU_METHOD
/begin COMPU_METHOD fak_uw_b8 "" RAT_FUNC "%6.5" "-" COEFFS 0 65536 0 0 0 8 /end COMPU_METHOD
/begin COMPU_METHOD kwgrad_q0p03052 "" RAT_FUNC "%6.4" "°KW/s" COEFFS 0 8192 0 0 0 250 /end COMPU_METHOD
/begin COMPU_METHOD kwgrad_q3p9 "" RAT_FUNC "%6.2" "°KW/s" COEFFS 0 64 0 0 0 250 /end COMPU_METHOD
/begin COMPU_METHOD kw_q0p0039 "" RAT_FUNC "%6.4" "Grad KW" COEFFS 0 256 0 0 0 1 /end COMPU_METHOD
/begin COMPU_METHOD kw_q0p25 "" RAT_FUNC "%6.3" "Grad KW" COEFFS 0 4 0 0 0 1 /end COMPU_METHOD
/begin COMPU_METHOD kw_q0p5 "" RAT_FUNC "%6.3" "Grad KW" COEFFS 0 2 0 0 0 1 /end COMPU_METHOD
/begin COMPU_METHOD kw_sw_b128 "" RAT_FUNC "%6.4" "Grad KW" COEFFS 0 65536 0 0 0 256 /end COMPU_METHOD
/begin COMPU_METHOD kw_ub_b16 "" RAT_FUNC "%6.4" "°KW" COEFFS 0 16 0 0 0 1 /end COMPU_METHOD
/begin COMPU_METHOD kw_ub_q0p5 "" RAT_FUNC "%6.3" "Grad KW" COEFFS 0 256 0 0 0 128 /end COMPU_METHOD
/begin COMPU_METHOD mdt_q0p15625_Nms "" RAT_FUNC "%6.3" "Nms" COEFFS 0 65536 0 0 0 10240 /end COMPU_METHOD
/begin COMPU_METHOD md_ub_q2_o100 "" RAT_FUNC "%6.2" "Nm" COEFFS 0 1 100 0 0 2 /end COMPU_METHOD
/begin COMPU_METHOD m_ub_b1020 "" RAT_FUNC "%6.2" "kg/h" COEFFS 0 1 0 0 0 4 /end COMPU_METHOD
/begin COMPU_METHOD nmotd_sb_q10 "" RAT_FUNC "%6.1" "1/min" COEFFS 0 1 0 0 0 10 /end COMPU_METHOD
/begin COMPU_METHOD nmotg_sb_q100 "" RAT_FUNC "%6.0" "1/min/s" COEFFS 0 1 0 0 0 100 /end COMPU_METHOD
/begin COMPU_METHOD nmotg_sw_q0p39 "" RAT_FUNC "%6.3" "1/min/s" COEFFS 0 1 0 0 0 0.39063 /end COMPU_METHOD
/begin COMPU_METHOD nmot_ub_q10 "" RAT_FUNC "%6.1" "1/min" COEFFS 0 1 0 0 0 10 /end COMPU_METHOD
/begin COMPU_METHOD nmot_ub_q25 "" RAT_FUNC "%6.1" "Upm" COEFFS 0 1 0 0 0 25 /end COMPU_METHOD
/begin COMPU_METHOD nmot_ub_q40 "" RAT_FUNC "%6.1" "1/min" COEFFS 0 1 0 0 0 40 /end COMPU_METHOD
/begin COMPU_METHOD nmot_uw_q0p25 "" RAT_FUNC "%6.3" "1/min" COEFFS 0 1 0 0 0 0.25 /end COMPU_METHOD
/begin COMPU_METHOD relDK_ub_b100 "" RAT_FUNC "%6.3" "%DK" COEFFS 0 255 0 0 0 100 /end COMPU_METHOD
/begin COMPU_METHOD relDK_uw_b100 "" RAT_FUNC "%6.4" "%DK" COEFFS 0 65535 0 0 0 100 /end COMPU_METHOD
/begin COMPU_METHOD relKW_q0p195 "" RAT_FUNC "%6.3" "%/°KW" COEFFS 0 256 0 0 0 50 /end COMPU_METHOD
/begin COMPU_METHOD relPED_ub_b100 "" RAT_FUNC "%6.3" "%PED" COEFFS 0 255 0 0 0 100 /end COMPU_METHOD
/begin COMPU_METHOD rel_q0p007629 "" RAT_FUNC "%10.6" "%/(km/h)/s" COEFFS 0 65536 0 0 0 500 /end COMPU_METHOD
/begin COMPU_METHOD rel_sb_q0p75 "" RAT_FUNC "%6.3" "%" COEFFS 0 1 0 0 0 0.75 /end COMPU_METHOD
/begin COMPU_METHOD rel_sw_b100 "" RAT_FUNC "%6.4" "%" COEFFS 0 32768 0 0 0 100 /end COMPU_METHOD
/begin COMPU_METHOD rel_sw_b50 "" RAT_FUNC "%6.4" "%" COEFFS 0 65536 0 0 0 100 /end COMPU_METHOD
/begin COMPU_METHOD rel_sw_q0p0234 "" RAT_FUNC "%6.4" "%/seg" COEFFS 0 32 0 0 0 0.75 /end COMPU_METHOD
/begin COMPU_METHOD rel_ub_b127p5 "" RAT_FUNC "%6.3" "%" COEFFS 0 2 0 0 0 1 /end COMPU_METHOD
/begin COMPU_METHOD rel_ub_b1p0 "" RAT_FUNC "%6.4" "%" COEFFS 0 256 0 0 0 1 /end COMPU_METHOD
/begin COMPU_METHOD rel_ub_b99p6 "" RAT_FUNC "%6.3" "%" COEFFS 0 256 0 0 0 100 /end COMPU_METHOD
/begin COMPU_METHOD rel_ub_q0p00153 "" RAT_FUNC "%6.4" "%" COEFFS 0 256 0 0 0 0.3906 /end COMPU_METHOD
/begin COMPU_METHOD rel_ub_q0p0029 "" RAT_FUNC "%6.4" "%" COEFFS 0 256 0 0 0 0.75 /end COMPU_METHOD
/begin COMPU_METHOD rel_ub_q0p03125 "" RAT_FUNC "%6.4" "%" COEFFS 0 256 0 0 0 8 /end COMPU_METHOD
/begin COMPU_METHOD rel_ub_q0p3906 "" RAT_FUNC "%6.3" "%" COEFFS 0 256 0 0 0 100 /end COMPU_METHOD
/begin COMPU_METHOD rel_ub_q0p391 "" RAT_FUNC "%6.3" "%/km/h" COEFFS 0 1 0 0 0 0.391 /end COMPU_METHOD
/begin COMPU_METHOD rel_ub_q0p75 "" RAT_FUNC "%6.3" "%" COEFFS 0 1 0 0 0 0.75 /end COMPU_METHOD
/begin COMPU_METHOD rel_uw_b100 "" RAT_FUNC "%6.4" "%" COEFFS 0 65536 0 0 0 100 /end COMPU_METHOD
/begin COMPU_METHOD rel_uw_q0p0234 "" RAT_FUNC "%6.4" "%" COEFFS 0 32 0 0 0 0.75 /end COMPU_METHOD
/begin COMPU_METHOD spg_ubatt "" RAT_FUNC "%6.4" "V" COEFFS 0 1 0 0 0 0.0704 /end COMPU_METHOD
/begin COMPU_METHOD spg_ubatt_sy "" RAT_FUNC "%6.4" "V" COEFFS 0 14.2222222222222 0 0 0 1 /end COMPU_METHOD
/begin COMPU_METHOD spg_ub_q0p019 "" RAT_FUNC "%6.4" "V" COEFFS 0 256 0 0 0 5 /end COMPU_METHOD
/begin COMPU_METHOD t100msxms_uw_b209 "" RAT_FUNC "%6.4" "ms" COEFFS 0 65536 0 0 0 209.725 /end COMPU_METHOD
/begin COMPU_METHOD t10msxs_ub_b2p55 "" RAT_FUNC "%6.4" "s" COEFFS 0 1 0 0 0 0.01 /end COMPU_METHOD
/begin COMPU_METHOD t10msxs_uw_b655p35 "" RAT_FUNC "%6.4" "s" COEFFS 0 1 0 0 0 0.01 /end COMPU_METHOD
/begin COMPU_METHOD t1sxs_uw_q1 "" RAT_FUNC "%6.2" "s" COEFFS 0 1 0 0 0 1 /end COMPU_METHOD
/begin COMPU_METHOD t20msxs_ub_q0p02 "" RAT_FUNC "%6.4" "s" COEFFS 0 50 0 0 0 1 /end COMPU_METHOD
/begin COMPU_METHOD t40msxs_uw_q0p04 "" RAT_FUNC "%6.4" "s" COEFFS 0 1 0 0 0 0.04 /end COMPU_METHOD
/begin COMPU_METHOD t40ms_ub_b10200 "" RAT_FUNC "%7.2" "ms" COEFFS 0 1 0 0 0 40 /end COMPU_METHOD
/begin COMPU_METHOD t50msxs_q0p05 "" RAT_FUNC "%6.4" "s" COEFFS 0 1 0 0 0 0.05 /end COMPU_METHOD
/begin COMPU_METHOD t50msxs_ub_b12p75 "" RAT_FUNC "%6.4" "s" COEFFS 0 1 0 0 0 0.05 /end COMPU_METHOD
/begin COMPU_METHOD t5msxms_q0p039 "" RAT_FUNC "%6.4" "ms" COEFFS 0 256 0 0 0 10 /end COMPU_METHOD
/begin COMPU_METHOD t5msxms_q5 "" RAT_FUNC "%6.2" "ms" COEFFS 0 1 0 0 0 5 /end COMPU_METHOD
/begin COMPU_METHOD temp_q0p0234_o273 "" RAT_FUNC "%6.1" "Grad C" COEFFS 0 1 273.15 0 0 0.0234375 /end COMPU_METHOD
/begin COMPU_METHOD temp_ub_q0p75_o48 "" RAT_FUNC "%6.2" "Grad C" COEFFS 0 1 48 0 0 0.75 /end COMPU_METHOD
/begin COMPU_METHOD tsegment_sy "" RAT_FUNC "%6.5" "ms" COEFFS 0 1250 0 0 0 1 /end COMPU_METHOD
/begin COMPU_METHOD tv_ub_b100 "" RAT_FUNC "%6.3" "%TV" COEFFS 0 256 0 0 0 100 /end COMPU_METHOD
/begin COMPU_METHOD tv_uw_b100 "" RAT_FUNC "%6.4" "%" COEFFS 0 65536 0 0 0 100 /end COMPU_METHOD
/begin COMPU_METHOD txms_ub_q0p1 "" RAT_FUNC "%6.3" "ms" COEFFS 0 10 0 0 0 1 /end COMPU_METHOD
/begin COMPU_METHOD txms_uw_q0p1 "" RAT_FUNC "%6.3" "ms" COEFFS 0 10 0 0 0 1 /end COMPU_METHOD
/begin COMPU_METHOD t_q1 "" RAT_FUNC "%6.2" "s" COEFFS 0 1 0 0 0 1 /end COMPU_METHOD
/begin COMPU_METHOD t_vanosPre_f4_sy "" RAT_FUNC "%6.4" "ms" COEFFS 0 78.125 0 0 0 1 /end COMPU_METHOD
/begin COMPU_METHOD t_wdt_high "" RAT_FUNC "%6.2" "ms" COEFFS 0 1.220703125 0 0 0 1 /end COMPU_METHOD
/begin COMPU_METHOD vfzg_sw_q0p00781 "" RAT_FUNC "%6.4" "km/h" COEFFS 0 1 0 0 0 0.0078125 /end COMPU_METHOD
/begin COMPU_METHOD vfzg_uw_b512 "" RAT_FUNC "%6.4" "km/h" COEFFS 0 65536 0 0 0 512 /end COMPU_METHOD
/begin COMPU_METHOD vfzg_uw_q0p00781 "" RAT_FUNC "%6.4" "km/h" COEFFS 0 1 0 0 0 0.0078125 /end COMPU_METHOD
/begin COMPU_METHOD wkw_ub_q0p25 "" RAT_FUNC "%7.3" "Grad KW" COEFFS 0 4 0 0 0 1 /end COMPU_METHOD
/begin COMPU_METHOD zk10msxs_ub_b51p2 "" RAT_FUNC "%6.4" "s" COEFFS 0 0 256 0 50 0 /end COMPU_METHOD
/begin COMPU_METHOD zk10msxs_uw_b655 "" RAT_FUNC "%6.2" "s" COEFFS 0 0 65536 0 100 0 /end COMPU_METHOD
/begin COMPU_METHOD zk40ms_ub_b10200 "" RAT_FUNC "%6.1" "ms" COEFFS 0 0 10240 0 1 40 /end COMPU_METHOD
/begin COMPU_METHOD zk5msxs_uw_b327 "" RAT_FUNC "%6.2" "s" COEFFS 0 0 65536 0 200 0 /end COMPU_METHOD
/begin COMPU_METHOD zw_sb_q0p75 "" RAT_FUNC "%6.3" "Grad KW" COEFFS 0 255 0 0 0 191.25 /end COMPU_METHOD
/begin COMPU_METHOD zw_sb_q6 "" RAT_FUNC "%6.2" "Grad KW" COEFFS 0 1 0 0 0 6 /end COMPU_METHOD
/begin COMPU_METHOD zw_ub_q0p75 "" RAT_FUNC "%6.3" "Grad KW" COEFFS 0 255 0 0 0 191.25 /end COMPU_METHOD
/begin COMPU_METHOD zw_ub_qn0p75 "" RAT_FUNC "%6.4" "Grad KW" COEFFS 0 1 0 0 0 -0.75 /end COMPU_METHOD
/begin RECORD_LAYOUT FklWUb FNC_VALUES 1 UBYTE COLUMN_DIR DIRECT /end RECORD_LAYOUT
/begin RECORD_LAYOUT FklWUw FNC_VALUES 1 UWORD COLUMN_DIR DIRECT /end RECORD_LAYOUT
/begin RECORD_LAYOUT GkfWSb FNC_VALUES 1 SBYTE COLUMN_DIR DIRECT /end RECORD_LAYOUT
/begin RECORD_LAYOUT GkfWUb FNC_VALUES 1 UBYTE COLUMN_DIR DIRECT /end RECORD_LAYOUT
/begin RECORD_LAYOUT GklWSb FNC_VALUES 1 SBYTE COLUMN_DIR DIRECT /end RECORD_LAYOUT
/begin RECORD_LAYOUT GklWSw FNC_VALUES 1 SWORD COLUMN_DIR DIRECT /end RECORD_LAYOUT
/begin RECORD_LAYOUT GklWUb FNC_VALUES 1 UBYTE COLUMN_DIR DIRECT /end RECORD_LAYOUT
/begin RECORD_LAYOUT GklWUw FNC_VALUES 1 UWORD COLUMN_DIR DIRECT /end RECORD_LAYOUT
/begin RECORD_LAYOUT KfAxUbAyUbSstxSwSstyUbWUw NO_AXIS_PTS_X 1 UBYTE NO_AXIS_PTS_Y 2 UBYTE AXIS_PTS_X 3 SWORD INDEX_INCR DIRECT AXIS_PTS_Y 4 UBYTE INDEX_INCR DIRECT FNC_VALUES 5 UWORD COLUMN_DIR DIRECT /end RECORD_LAYOUT
/begin RECORD_LAYOUT KfAxUbAyUbSstxUbSstyUbWSb NO_AXIS_PTS_X 1 UBYTE NO_AXIS_PTS_Y 2 UBYTE AXIS_PTS_X 3 UBYTE INDEX_INCR DIRECT AXIS_PTS_Y 4 UBYTE INDEX_INCR DIRECT FNC_VALUES 5 SBYTE COLUMN_DIR DIRECT /end RECORD_LAYOUT
/begin RECORD_LAYOUT KfAxUbAyUbSstxUbSstyUbWUb NO_AXIS_PTS_X 1 UBYTE NO_AXIS_PTS_Y 2 UBYTE AXIS_PTS_X 3 UBYTE INDEX_INCR DIRECT AXIS_PTS_Y 4 UBYTE INDEX_INCR DIRECT FNC_VALUES 5 UBYTE COLUMN_DIR DIRECT /end RECORD_LAYOUT
/begin RECORD_LAYOUT KfAxUbAyUbSstxUbSstyUwWUw NO_AXIS_PTS_X 1 UBYTE NO_AXIS_PTS_Y 2 UBYTE AXIS_PTS_X 3 UBYTE INDEX_INCR DIRECT AXIS_PTS_Y 4 UWORD INDEX_INCR DIRECT FNC_VALUES 5 UWORD COLUMN_DIR DIRECT /end RECORD_LAYOUT
/begin RECORD_LAYOUT KfWUb FNC_VALUES 1 UBYTE COLUMN_DIR DIRECT /end RECORD_LAYOUT
/begin RECORD_LAYOUT KlAUbSstUbWSb NO_AXIS_PTS_X 1 UBYTE AXIS_PTS_X 2 UBYTE INDEX_INCR DIRECT FNC_VALUES 3 SBYTE COLUMN_DIR DIRECT /end RECORD_LAYOUT
/begin RECORD_LAYOUT KlAUbSstUbWUb NO_AXIS_PTS_X 1 UBYTE AXIS_PTS_X 2 UBYTE INDEX_INCR DIRECT FNC_VALUES 3 UBYTE COLUMN_DIR DIRECT /end RECORD_LAYOUT
/begin RECORD_LAYOUT KlAUbSstUbWUw NO_AXIS_PTS_X 1 UBYTE AXIS_PTS_X 2 UBYTE INDEX_INCR DIRECT FNC_VALUES 3 UWORD COLUMN_DIR DIRECT /end RECORD_LAYOUT
/begin RECORD_LAYOUT KlAUwSstSwWUw NO_AXIS_PTS_X 1 UWORD AXIS_PTS_X 2 SWORD INDEX_INCR DIRECT FNC_VALUES 3 UWORD COLUMN_DIR DIRECT /end RECORD_LAYOUT
/begin RECORD_LAYOUT KlAUwSstUwWUw NO_AXIS_PTS_X 1 UWORD AXIS_PTS_X 2 UWORD INDEX_INCR DIRECT FNC_VALUES 3 UWORD COLUMN_DIR DIRECT /end RECORD_LAYOUT
/begin RECORD_LAYOUT KwbUb FNC_VALUES 1 UBYTE COLUMN_DIR DIRECT /end RECORD_LAYOUT
/begin RECORD_LAYOUT KwbUw FNC_VALUES 1 UWORD COLUMN_DIR DIRECT /end RECORD_LAYOUT
/begin RECORD_LAYOUT KwSb FNC_VALUES 1 SBYTE COLUMN_DIR DIRECT /end RECORD_LAYOUT
/begin RECORD_LAYOUT KwSw FNC_VALUES 1 SWORD COLUMN_DIR DIRECT /end RECORD_LAYOUT
/begin RECORD_LAYOUT KwUb FNC_VALUES 1 UBYTE COLUMN_DIR DIRECT /end RECORD_LAYOUT
/begin RECORD_LAYOUT KwUw FNC_VALUES 1 UWORD COLUMN_DIR DIRECT /end RECORD_LAYOUT
/begin RECORD_LAYOUT SstAUbSstSb NO_AXIS_PTS_X 1 SBYTE AXIS_PTS_X 2 SBYTE INDEX_INCR DIRECT /end RECORD_LAYOUT
/begin RECORD_LAYOUT SstAUbSstUb NO_AXIS_PTS_X 1 UBYTE AXIS_PTS_X 2 UBYTE INDEX_INCR DIRECT /end RECORD_LAYOUT
/begin RECORD_LAYOUT SstAUbSstUw NO_AXIS_PTS_X 1 UWORD AXIS_PTS_X 2 UWORD INDEX_INCR DIRECT /end RECORD_LAYOUT
/begin RECORD_LAYOUT SstAUwSstUw NO_AXIS_PTS_X 1 UWORD AXIS_PTS_X 2 UWORD INDEX_INCR DIRECT /end RECORD_LAYOUT
/end MODULE
/end PROJECT
