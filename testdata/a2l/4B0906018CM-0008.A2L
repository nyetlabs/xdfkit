ASAP2_VERSION 1 3
/begin PROJECT X505P_24HG_1 "X505P"
/begin HEADER "" VERSION "X505P_24HG_1" PROJECT_NO X505P_24HG_1 /end HEADER
/begin MODULE DIM ""
/begin MOD_COMMON "" BYTE_ORDER MSB_LAST ALIGNMENT_BYTE 1 ALIGNMENT_WORD 2 ALIGNMENT_LONG 2 /end MOD_COMMON
/begin CHARACTERISTIC CDCAAA "Dummy: Tabellenanfang" VAL_BLK 0x814254 KwbUw 65535.00 dez 0.00 65535.00 FORMAT "%8.2" NUMBER 4 /end CHARACTERISTIC
/begin CHARACTERISTIC CDCAGRE "Codewort CARB: Überwachung AGR-Endstufe" VAL_BLK 0x814264 KwbUw 65535.00 dez 0.00 65535.00 FORMAT "%8.2" NUMBER 4 /end CHARACTERISTIC
/begin CHARACTERISTIC CDCBKVPE "Codewort CARB: BKVPE (Bremskraftverstärker Pumpe)" VAL_BLK 0x8142AC KwbUw 65535.00 dez 0.00 65535.00 FORMAT "%8.2" NUMBER 4 /end CHARACTERISTIC
/begin CHARACTERISTIC CDCDK "Codewort CARB: DK - Potentiometer" VAL_BLK 0x81431C KwbUw 65535.00 dez 0.00 65535.00 FORMAT "%8.2" NUMBER 4 /end CHARACTERISTIC
/begin CHARACTERISTIC CDCDK1P "Codewort CARB: Drosselklappe 1. Poti" VAL_BLK 0x814324 KwbUw 65535.00 dez 0.00 65535.00 FORMAT "%8.2" NUMBER 4 /end CHARACTERISTIC
/begin CHARACTERISTIC CDCDK2P "Codewort CARB: Drosselklappe 2. Poti" VAL_BLK 0x81432C KwbUw 65535.00 dez 0.00 65535.00 FORMAT "%8.2" NUMBER 4 /end CHARACTERISTIC
/begin CHARACTERISTIC CDCDVEE "Codewort CARB: DV-E Endstufe" VAL_BLK 0x814364 KwbUw 65535.00 dez 0.00 65535.00 FORMAT "%8.2" NUMBER 4 /end CHARACTERISTIC
/begin CHARACTERISTIC CDCDVEF "Codewort CARB: DV-E Fehler bei Federprüfung" VAL_BLK 0x81436C KwbUw 65535.00 dez 0.00 65535.00 FORMAT "%8.2" NUMBER 4 /end CHARACTERISTIC
/begin CHARACTERISTIC CDCDVEFO "" VAL_BLK 0x814374 KwbUw 65535.00 dez 0.00 65535.00 FORMAT "%8.2" NUMBER 4 /end CHARACTERISTIC
/begin CHARACTERISTIC CDCDVEL "Codewort CARB: DV-E Lageabweichung" VAL_BLK 0x81437C KwbUw 65535.00 dez 0.00 65535.00 FORMAT "%8.2" NUMBER 4 /end CHARACTERISTIC
/begin CHARACTERISTIC CDCDVEN "Codewort CARB: DV-E Fehler bei Prüfung Notluftposition" VAL_BLK 0x814384 KwbUw 65535.00 dez 0.00 65535.00 FORMAT "%8.2" NUMBER 4 /end CHARACTERISTIC
/begin CHARACTERISTIC CDCDVER "Codewort CARB: DV-E Regelbereich" VAL_BLK 0x81438C KwbUw 65535.00 dez 0.00 65535.00 FORMAT "%8.2" NUMBER 4 /end CHARACTERISTIC
/begin CHARACTERISTIC CDCDVET "" VAL_BLK 0x814394 KwbUw 65535.00 dez 0.00 65535.00 FORMAT "%8.2" NUMBER 4 /end CHARACTERISTIC
/begin CHARACTERISTIC CDCDVEU "Codewort CARB: DV-E Fehler beim UMA-Lernen" VAL_BLK 0x81439C KwbUw 65535.00 dez 0.00 65535.00 FORMAT "%8.2" NUMBER 4 /end CHARACTERISTIC
/begin CHARACTERISTIC CDCDVEUB "" VAL_BLK 0x8143A4 KwbUw 65535.00 dez 0.00 65535.00 FORMAT "%8.2" NUMBER 4 /end CHARACTERISTIC
/begin CHARACTERISTIC CDCDVEUW "" VAL_BLK 0x8143AC KwbUw 65535.00 dez 0.00 65535.00 FORMAT "%8.2" NUMBER 4 /end CHARACTERISTIC
/begin CHARACTERISTIC CDCDVEV "Codewort CARB: DV-E Fehler bei Verstärkerabgleich" VAL_BLK 0x8143B4 KwbUw 65535.00 dez 0.00 65535.00 FORMAT "%8.2" NUMBER 4 /end CHARACTERISTIC
/begin CHARACTERISTIC CDCEGFE "Codewort CARB: Lasterfassung" VAL_BLK 0x8143BC KwbUw 65535.00 dez 0.00 65535.00 FORMAT "%8.2" NUMBER 4 /end CHARACTERISTIC
/begin CHARACTERISTIC CDCENWS "Codewort Carb: Nockenwellensteuerung Einlass Nockenwelle" VAL_BLK 0x8143C4 KwbUw 65535.00 dez 0.00 65535.00 FORMAT "%8.2" NUMBER 4 /end CHARACTERISTIC
/begin CHARACTERISTIC CDCENWSE "Codewort CARB: Einlaßnockenwelle- Endstufe" VAL_BLK 0x8143CC KwbUw 65535.00 dez 0.00 65535.00 FORMAT "%8.2" NUMBER 4 /end CHARACTERISTIC
/begin CHARACTERISTIC CDCEPCLE "Codewort CARB: Fahrverhaltens- Fehlerlampe ( Endstufe )" VAL_BLK 0x8143D4 KwbUw 65535.00 dez 0.00 65535.00 FORMAT "%8.2" NUMBER 4 /end CHARACTERISTIC
/begin CHARACTERISTIC CDCETRE "Codeword CARB: El. Thermostat-Endstufe" VAL_BLK 0x8143DC KwbUw 65535.00 dez 0.00 65535.00 FORMAT "%8.2" NUMBER 4 /end CHARACTERISTIC
/begin CHARACTERISTIC CDCEV1 "Codewort CARB: EV von Zyl. 1" VAL_BLK 0x8143E4 KwbUw 65535.00 dez 0.00 65535.00 FORMAT "%8.2" NUMBER 4 /end CHARACTERISTIC
/begin CHARACTERISTIC CDCEV2 "Codewort CARB: EV von Zyl. 2" VAL_BLK 0x8143EC KwbUw 65535.00 dez 0.00 65535.00 FORMAT "%8.2" NUMBER 4 /end CHARACTERISTIC
/begin CHARACTERISTIC CDCEV3 "Codewort CARB: EV von Zyl. 3" VAL_BLK 0x8143F4 KwbUw 65535.00 dez 0.00 65535.00 FORMAT "%8.2" NUMBER 4 /end CHARACTERISTIC
/begin CHARACTERISTIC CDCEV4 "Codewort CARB: EV von Zyl. 4" VAL_BLK 0x8143FC KwbUw 65535.00 dez 0.00 65535.00 FORMAT "%8.2" NUMBER 4 /end CHARACTERISTIC
/begin CHARACTERISTIC CDCFRAO "Codewort CARB: LR-Adaption obere multiplikativ" VAL_BLK 0x81441C KwbUw 65535.00 dez 0.00 65535.00 FORMAT "%8.2" NUMBER 4 /end CHARACTERISTIC
/begin CHARACTERISTIC CDCFRAU "Codewort CARB: LR-Adaption untere multiplikativ" VAL_BLK 0x814424 KwbUw 65535.00 dez 0.00 65535.00 FORMAT "%8.2" NUMBER 4 /end CHARACTERISTIC
/begin CHARACTERISTIC CDCFRST "Codewort CARB: LR-Abweichung" VAL_BLK 0x81442C KwbUw 65535.00 dez 0.00 65535.00 FORMAT "%8.2" NUMBER 4 /end CHARACTERISTIC
/begin CHARACTERISTIC CDCHSH "Codewort CARB: Lambdasonden-Heizung hinter Katalysator" VAL_BLK 0x814454 KwbUw 65535.00 dez 0.00 65535.00 FORMAT "%8.2" NUMBER 4 /end CHARACTERISTIC
/begin CHARACTERISTIC CDCHSH2 "Codewort CARB: Lambdasonden-Heizung hinter Katalysator; (Bank2)" VAL_BLK 0x81445C KwbUw 65535.00 dez 0.00 65535.00 FORMAT "%8.2" NUMBER 4 /end CHARACTERISTIC
/begin CHARACTERISTIC CDCHSHE "Codewort CARB: Endstufe Heizung Sonde hinter Kat." VAL_BLK 0x814464 KwbUw 65535.00 dez 0.00 65535.00 FORMAT "%8.2" NUMBER 4 /end CHARACTERISTIC
/begin CHARACTERISTIC CDCHSV "Codewort CARB: Lambdasonden-Heizung vor Katalysator" VAL_BLK 0x81446C KwbUw 65535.00 dez 0.00 65535.00 FORMAT "%8.2" NUMBER 4 /end CHARACTERISTIC
/begin CHARACTERISTIC CDCHSV2 "Codewort CARB: Lambdasonden-Heizung vor Katalysator; (Bank2)" VAL_BLK 0x814474 KwbUw 65535.00 dez 0.00 65535.00 FORMAT "%8.2" NUMBER 4 /end CHARACTERISTIC
/begin CHARACTERISTIC CDCHSVSA "Codewort CARB: Lambdasonden-Heizung vor Katalysator" VAL_BLK 0x81447C KwbUw 65535.00 dez 0.00 65535.00 FORMAT "%8.2" NUMBER 4 /end CHARACTERISTIC
/begin CHARACTERISTIC CDCHSVSA2 "Codewort CARB: Lambdasonden-Heizung 2 vor Katalysator" VAL_BLK 0x814484 KwbUw 65535.00 dez 0.00 65535.00 FORMAT "%8.2" NUMBER 4 /end CHARACTERISTIC
/begin CHARACTERISTIC CDCKAT "Codewort CARB: Katalysator-Konvertierung" VAL_BLK 0x81448C KwbUw 65535.00 dez 0.00 65535.00 FORMAT "%8.2" NUMBER 4 /end CHARACTERISTIC
/begin CHARACTERISTIC CDCKPE "Codewort CARB: EKP-Relais Endstufe" VAL_BLK 0x814494 KwbUw 65535.00 dez 0.00 65535.00 FORMAT "%8.2" NUMBER 4 /end CHARACTERISTIC
/begin CHARACTERISTIC CDCKRA01 "Codewort CARB: Klopfregelanschlag Zylinder 1" VAL_BLK 0x81449C KwbUw 65535.00 dez 0.00 65535.00 FORMAT "%8.2" NUMBER 4 /end CHARACTERISTIC
/begin CHARACTERISTIC CDCKRA02 "Codewort CARB: Klopfregelanschlag Zylinder 2" VAL_BLK 0x8144A4 KwbUw 65535.00 dez 0.00 65535.00 FORMAT "%8.2" NUMBER 4 /end CHARACTERISTIC
/begin CHARACTERISTIC CDCKRA03 "Codewort CARB: Klopfregelanschlag Zylinder 3" VAL_BLK 0x8144AC KwbUw 65535.00 dez 0.00 65535.00 FORMAT "%8.2" NUMBER 4 /end CHARACTERISTIC
/begin CHARACTERISTIC CDCKRA04 "Codewort CARB: Klopfregelanschlag Zylinder 4" VAL_BLK 0x8144B4 KwbUw 65535.00 dez 0.00 65535.00 FORMAT "%8.2" NUMBER 4 /end CHARACTERISTIC
/begin CHARACTERISTIC CDCKRNT "Codewort CARB: Klopfregelung Nulltest" VAL_BLK 0x8144BC KwbUw 65535.00 dez 0.00 65535.00 FORMAT "%8.2" NUMBER 4 /end CHARACTERISTIC
/begin CHARACTERISTIC CDCKROF "Codewort CARB: Klopfregelung Offset" VAL_BLK 0x8144C4 KwbUw 65535.00 dez 0.00 65535.00 FORMAT "%8.2" NUMBER 4 /end CHARACTERISTIC
/begin CHARACTERISTIC CDCKRTP "Codewort CARB: Klopfregelung Testimpulse" VAL_BLK 0x8144CC KwbUw 65535.00 dez 0.00 65535.00 FORMAT "%8.2" NUMBER 4 /end CHARACTERISTIC
/begin CHARACTERISTIC CDCKS1 "Codewort CARB: Klopfsensor 1" VAL_BLK 0x8144D4 KwbUw 65535.00 dez 0.00 65535.00 FORMAT "%8.2" NUMBER 4 /end CHARACTERISTIC
/begin CHARACTERISTIC CDCKS2 "Codewort CARB: Klopfsensor 2" VAL_BLK 0x8144DC KwbUw 65535.00 dez 0.00 65535.00 FORMAT "%8.2" NUMBER 4 /end CHARACTERISTIC
/begin CHARACTERISTIC CDCKS3 "Codewort CARB: Klopfsensor 3" VAL_BLK 0x8144E4 KwbUw 65535.00 dez 0.00 65535.00 FORMAT "%8.2" NUMBER 4 /end CHARACTERISTIC
/begin CHARACTERISTIC CDCKS4 "Codewort CARB: Klopfsensor 4" VAL_BLK 0x8144EC KwbUw 65535.00 dez 0.00 65535.00 FORMAT "%8.2" NUMBER 4 /end CHARACTERISTIC
/begin CHARACTERISTIC CDCKUPPL "Codewort CARB: Kupplungspedalwertgeber" VAL_BLK 0x8144F4 KwbUw 65535.00 dez 0.00 65535.00 FORMAT "%8.2" NUMBER 4 /end CHARACTERISTIC
/begin CHARACTERISTIC CDCLDE "Codewort CARB: Ladedrucksteuerventil (Endstufe)" VAL_BLK 0x814504 KwbUw 65535.00 dez 0.00 65535.00 FORMAT "%8.2" NUMBER 4 /end CHARACTERISTIC
/begin CHARACTERISTIC CDCLUE1 "" VAL_BLK 0x81455C KwbUw 65535.00 DEZ 0.00 65535.00 FORMAT "%8.2" NUMBER 4 /end CHARACTERISTIC
/begin CHARACTERISTIC CDCLUES1E "Codeword CARB: Endstufe Lüftersteuerung 1" VAL_BLK 0x814564 KwbUw 65535.00 dez 0.00 65535.00 FORMAT "%8.2" NUMBER 4 /end CHARACTERISTIC
/begin CHARACTERISTIC CDCMILE "Codewort CARB: MIL-Endstufe" VAL_BLK 0x8145A4 KwbUw 65535.00 dez 0.00 65535.00 FORMAT "%8.2" NUMBER 4 /end CHARACTERISTIC
/begin CHARACTERISTIC CDCNWSE "Codewort CARB: Nockenwellensteuerungsventil Endstufe" VAL_BLK 0x8145BC KwbUw 65535.00 dez 0.00 65535.00 FORMAT "%8.2" NUMBER 4 /end CHARACTERISTIC
/begin CHARACTERISTIC CDCRKAT "Codewort CARB: LR-Adaption QL-additiv" VAL_BLK 0x8145DC KwbUw 65535.00 dez 0.00 65535.00 FORMAT "%8.2" NUMBER 4 /end CHARACTERISTIC
/begin CHARACTERISTIC CDCRKAZ "Codewort CARB: LR-Adaption ti-additiv" VAL_BLK 0x8145E4 KwbUw 65535.00 dez 0.00 65535.00 FORMAT "%8.2" NUMBER 4 /end CHARACTERISTIC
/begin CHARACTERISTIC CDCSLPE "Codewort CARB: Sekundärluftpumpe (Endstufe)" VAL_BLK 0x814604 KwbUw 65535.00 dez 0.00 65535.00 FORMAT "%8.2" NUMBER 4 /end CHARACTERISTIC
/begin CHARACTERISTIC CDCSLVE "Codewort CARB: Sekundärluftventil (Endstufe)" VAL_BLK 0x81461C KwbUw 65535.00 dez 0.00 65535.00 FORMAT "%8.2" NUMBER 4 /end CHARACTERISTIC
/begin CHARACTERISTIC CDCTEVE "Codewort CARB: Tankentlüftungsventil Endstufe" VAL_BLK 0x81465C KwbUw 65535.00 dez 0.00 65535.00 FORMAT "%8.2" NUMBER 4 /end CHARACTERISTIC
/begin CHARACTERISTIC CDCUVSE "Codewort CARB: Umluftventil-Steuerung Endstufe" VAL_BLK 0x8146D4 KwbUw 65535.00 dez 0.00 65535.00 FORMAT "%8.2" NUMBER 4 /end CHARACTERISTIC
/begin CHARACTERISTIC CDCZET1 "" VAL_BLK 0x8146F4 KwbUw 65535.00 dez 0.00 65535.00 FORMAT "%8.2" NUMBER 4 /end CHARACTERISTIC
/begin CHARACTERISTIC CDCZET2 "" VAL_BLK 0x8146FC KwbUw 65535.00 dez 0.00 65535.00 FORMAT "%8.2" NUMBER 4 /end CHARACTERISTIC
/begin CHARACTERISTIC CDCZET3 "" VAL_BLK 0x814704 KwbUw 65535.00 dez 0.00 65535.00 FORMAT "%8.2" NUMBER 4 /end CHARACTERISTIC
/begin CHARACTERISTIC CDCZET4 "" VAL_BLK 0x81470C KwbUw 65535.00 dez 0.00 65535.00 FORMAT "%8.2" NUMBER 4 /end CHARACTERISTIC
/begin CHARACTERISTIC CDCZZZ "Dummy: Tabellenende" VAL_BLK 0x814714 KwbUw 65535.00 dez 0.00 65535.00 FORMAT "%8.2" NUMBER 4 /end CHARACTERISTIC
/begin CHARACTERISTIC CDKAAA "Dummy: Tabellenanfang" VAL_BLK 0x81471C KwbUw 65535.00 dez 0.00 65535.00 FORMAT "%8.2" NUMBER 4 /end CHARACTERISTIC
/begin CHARACTERISTIC CDKAGRE "Codewort Kunde: Überwachung AGR-Endstufe" VAL_BLK 0x81472C KwbUw 65535.00 dez 0.00 65535.00 FORMAT "%8.2" NUMBER 4 /end CHARACTERISTIC
/begin CHARACTERISTIC CDKBKVPE "" VAL_BLK 0x814774 KwbUw 65535.00 dez 0.00 65535.00 FORMAT "%8.2" NUMBER 4 /end CHARACTERISTIC
/begin CHARACTERISTIC CDKDK "Codewort Kunde: DK - Potentiometer" VAL_BLK 0x8147E4 KwbUw 65535.00 dez 0.00 65535.00 FORMAT "%8.2" NUMBER 4 /end CHARACTERISTIC
/begin CHARACTERISTIC CDKDK1P "Codewort Kunde: Drosselklappe 1. Poti" VAL_BLK 0x8147EC KwbUw 65535.00 dez 0.00 65535.00 FORMAT "%8.2" NUMBER 4 /end CHARACTERISTIC
/begin CHARACTERISTIC CDKDK2P "Codewort Kunde: Drosselklappenpotentiometer 2" VAL_BLK 0x8147F4 KwbUw 65535.00 dez 0.00 65535.00 FORMAT "%8.2" NUMBER 4 /end CHARACTERISTIC
/begin CHARACTERISTIC CDKDVEE "Codewort Kunde: DV-E Endstufe" VAL_BLK 0x81482C KwbUw 65535.00 dez 0.00 65535.00 FORMAT "%8.2" NUMBER 4 /end CHARACTERISTIC
/begin CHARACTERISTIC CDKDVEF "Codewort Kunde: DV-E Fehler bei Federprüfung" VAL_BLK 0x814834 KwbUw 65535.00 dez 0.00 65535.00 FORMAT "%8.2" NUMBER 4 /end CHARACTERISTIC
/begin CHARACTERISTIC CDKDVEFO "" VAL_BLK 0x81483C KwbUw 65535.00 dez 0.00 65535.00 FORMAT "%8.2" NUMBER 4 /end CHARACTERISTIC
/begin CHARACTERISTIC CDKDVEL "Codewort Kunde: DV-E Lageabweichung" VAL_BLK 0x814844 KwbUw 65535.00 dez 0.00 65535.00 FORMAT "%8.2" NUMBER 4 /end CHARACTERISTIC
/begin CHARACTERISTIC CDKDVEN "Codewort Kunde: DV-E Fehler bei Prüfung Notlufposition" VAL_BLK 0x81484C KwbUw 65535.00 dez 0.00 65535.00 FORMAT "%8.2" NUMBER 4 /end CHARACTERISTIC
/begin CHARACTERISTIC CDKDVER "Codewort Kunde: DV-E Regelbereich" VAL_BLK 0x814854 KwbUw 65535.00 dez 0.00 65535.00 FORMAT "%8.2" NUMBER 4 /end CHARACTERISTIC
/begin CHARACTERISTIC CDKDVET "" VAL_BLK 0x81485C KwbUw 65535.00 dez 0.00 65535.00 FORMAT "%8.2" NUMBER 4 /end CHARACTERISTIC
/begin CHARACTERISTIC CDKDVEU "Codewort Kunde: DV-E Fehler beim UMA-Lernen" VAL_BLK 0x814864 KwbUw 65535.00 dez 0.00 65535.00 FORMAT "%8.2" NUMBER 4 /end CHARACTERISTIC
/begin CHARACTERISTIC CDKDVEUB "" VAL_BLK 0x81486C KwbUw 65535.00 dez 0.00 65535.00 FORMAT "%8.2" NUMBER 4 /end CHARACTERISTIC
/begin CHARACTERISTIC CDKDVEUW "" VAL_BLK 0x814874 KwbUw 65535.00 dez 0.00 65535.00 FORMAT "%8.2" NUMBER 4 /end CHARACTERISTIC
/begin CHARACTERISTIC CDKDVEV "Codewort Kunde: DV-E Fehler bei Verstärkerabgleich" VAL_BLK 0x81487C KwbUw 65535.00 dez 0.00 65535.00 FORMAT "%8.2" NUMBER 4 /end CHARACTERISTIC
/begin CHARACTERISTIC CDKEGFE "Codewort Kunde: Lasterfassung" VAL_BLK 0x814884 KwbUw 65535.00 dez 0.00 65535.00 FORMAT "%8.2" NUMBER 4 /end CHARACTERISTIC
/begin CHARACTERISTIC CDKENWS "Codewort Kunde: Nockenwellensteuerung Einlass Nockenwelle" VAL_BLK 0x81488C KwbUw 65535.00 dez 0.00 65535.00 FORMAT "%8.2" NUMBER 4 /end CHARACTERISTIC
/begin CHARACTERISTIC CDKENWSE "Codewort Kunde: Einlaßnockenwelle- Endstufe" VAL_BLK 0x814894 KwbUw 65535.00 dez 0.00 65535.00 FORMAT "%8.2" NUMBER 4 /end CHARACTERISTIC
/begin CHARACTERISTIC CDKEPCLE "Codewort Kunde: Fahrverhaltens- Fehlerlampe ( Endstufe )" VAL_BLK 0x81489C KwbUw 65535.00 dez 0.00 65535.00 FORMAT "%8.2" NUMBER 4 /end CHARACTERISTIC
/begin CHARACTERISTIC CDKETRE "Kodewort Kunde: Diagnose Endstufe ETR" VAL_BLK 0x8148A4 KwbUw 65535.00 dez 0.00 65535.00 FORMAT "%8.2" NUMBER 4 /end CHARACTERISTIC
/begin CHARACTERISTIC CDKEV1 "Codewort Kunde: EV von Zyl. 1" VAL_BLK 0x8148AC KwbUw 65535.00 dez 0.00 65535.00 FORMAT "%8.2" NUMBER 4 /end CHARACTERISTIC
/begin CHARACTERISTIC CDKEV2 "Codewort Kunde: EV von Zyl. 2" VAL_BLK 0x8148B4 KwbUw 65535.00 dez 0.00 65535.00 FORMAT "%8.2" NUMBER 4 /end CHARACTERISTIC
/begin CHARACTERISTIC CDKEV3 "Codewort Kunde: EV von Zyl. 3" VAL_BLK 0x8148BC KwbUw 65535.00 dez 0.00 65535.00 FORMAT "%8.2" NUMBER 4 /end CHARACTERISTIC
/begin CHARACTERISTIC CDKEV4 "Codewort Kunde: EV von Zyl. 4" VAL_BLK 0x8148C4 KwbUw 65535.00 dez 0.00 65535.00 FORMAT "%8.2" NUMBER 4 /end CHARACTERISTIC
/begin CHARACTERISTIC CDKFRAO "Codewort Kunde: LR- Adaption multi. obere Schwelle" VAL_BLK 0x8148E4 KwbUw 65535.00 dez 0.00 65535.00 FORMAT "%8.2" NUMBER 4 /end CHARACTERISTIC
/begin CHARACTERISTIC CDKFRAU "Codewort Kunde: LR- Adaption multi. untere Schwelle" VAL_BLK 0x8148EC KwbUw 65535.00 dez 0.00 65535.00 FORMAT "%8.2" NUMBER 4 /end CHARACTERISTIC
/begin CHARACTERISTIC CDKFRST "Codewort Kunde: LR- Abweichung" VAL_BLK 0x8148F4 KwbUw 65535.00 dez 0.00 65535.00 FORMAT "%8.2" NUMBER 4 /end CHARACTERISTIC
/begin CHARACTERISTIC CDKHSH "Codewort Kunde: Lambdasonden-Heizung hinter Katalysator" VAL_BLK 0x81491C KwbUw 65535.00 dez 0.00 65535.00 FORMAT "%8.2" NUMBER 4 /end CHARACTERISTIC
/begin CHARACTERISTIC CDKHSH2 "Codewort Kunde: Lambdasonden-Heizung hinter Katalysator, Bank 2" VAL_BLK 0x814924 KwbUw 65535.00 dez 0.00 65535.00 FORMAT "%8.2" NUMBER 4 /end CHARACTERISTIC
/begin CHARACTERISTIC CDKHSHE "Codewort Kunde: Endstufe Heizung Sonde hinter Kat." VAL_BLK 0x81492C KwbUw 65535.00 dez 0.00 65535.00 FORMAT "%8.2" NUMBER 4 /end CHARACTERISTIC
/begin CHARACTERISTIC CDKHSV "Codewort Kunde: Lambdasonden-Heizung vor Katalysator" VAL_BLK 0x814934 KwbUw 65535.00 dez 0.00 65535.00 FORMAT "%8.2" NUMBER 4 /end CHARACTERISTIC
/begin CHARACTERISTIC CDKHSV2 "Codewort Kunde: Lambdasonden-Heizung vor Katalysator, Bank 2" VAL_BLK 0x81493C KwbUw 65535.00 dez 0.00 65535.00 FORMAT "%8.2" NUMBER 4 /end CHARACTERISTIC
/begin CHARACTERISTIC CDKHSVSA "" VAL_BLK 0x814944 KwbUw 65535.00 dez 0.00 65535.00 FORMAT "%8.2" NUMBER 4 /end CHARACTERISTIC
/begin CHARACTERISTIC CDKHSVSA2 "" VAL_BLK 0x81494C KwbUw 65535.00 dez 0.00 65535.00 FORMAT "%8.2" NUMBER 4 /end CHARACTERISTIC
/begin CHARACTERISTIC CDKKAT "Codewort Kunde: Katalysator-Konvertierung" VAL_BLK 0x814954 KwbUw 65535.00 dez 0.00 65535.00 FORMAT "%8.2" NUMBER 4 /end CHARACTERISTIC
/begin CHARACTERISTIC CDKKPE "Codewort Kunde: EKP-Relais Endstufe" VAL_BLK 0x81495C KwbUw 65535.00 dez 0.00 65535.00 FORMAT "%8.2" NUMBER 4 /end CHARACTERISTIC
/begin CHARACTERISTIC CDKKRA01 "Codewort Kunde: Klopfregelanschlag Zylinder 1" VAL_BLK 0x814964 KwbUw 65535.00 dez 0.00 65535.00 FORMAT "%8.2" NUMBER 4 /end CHARACTERISTIC
/begin CHARACTERISTIC CDKKRA02 "Codewort Kunde: Klopfregelanschlag Zylinder 2" VAL_BLK 0x81496C KwbUw 65535.00 dez 0.00 65535.00 FORMAT "%8.2" NUMBER 4 /end CHARACTERISTIC
/begin CHARACTERISTIC CDKKRA03 "Codewort Kunde: Klopfregelanschlag Zylinder 3" VAL_BLK 0x814974 KwbUw 65535.00 dez 0.00 65535.00 FORMAT "%8.2" NUMBER 4 /end CHARACTERISTIC
/begin CHARACTERISTIC CDKKRA04 "Codewort Kunde: Klopfregelanschlag Zylinder 4" VAL_BLK 0x81497C KwbUw 65535.00 dez 0.00 65535.00 FORMAT "%8.2" NUMBER 4 /end CHARACTERISTIC
/begin CHARACTERISTIC CDKKRNT "Codewort Kunde: Klopfregelung Nulltest" VAL_BLK 0x814984 KwbUw 65535.00 dez 0.00 65535.00 FORMAT "%8.2" NUMBER 4 /end CHARACTERISTIC
/begin CHARACTERISTIC CDKKROF "Codewort Kunde: Klopfregelung Offset" VAL_BLK 0x81498C KwbUw 65535.00 dez 0.00 65535.00 FORMAT "%8.2" NUMBER 4 /end CHARACTERISTIC
/begin CHARACTERISTIC CDKKRTP "Codewort Kunde: Klopfregelung Testimpuls" VAL_BLK 0x814994 KwbUw 65535.00 dez 0.00 65535.00 FORMAT "%8.2" NUMBER 4 /end CHARACTERISTIC
/begin CHARACTERISTIC CDKKS1 "Codewort Kunde: Klopfsensor 1" VAL_BLK 0x81499C KwbUw 65535.00 dez 0.00 65535.00 FORMAT "%8.2" NUMBER 4 /end CHARACTERISTIC
/begin CHARACTERISTIC CDKKS2 "Codewort Kunde: Klopfsensor 2" VAL_BLK 0x8149A4 KwbUw 65535.00 dez 0.00 65535.00 FORMAT "%8.2" NUMBER 4 /end CHARACTERISTIC
/begin CHARACTERISTIC CDKKS3 "Codewort Kunde: Klopfsensor 3" VAL_BLK 0x8149AC KwbUw 65535.00 dez 0.00 65535.00 FORMAT "%8.2" NUMBER 4 /end CHARACTERISTIC
/begin CHARACTERISTIC CDKKS4 "Codewort Kunde: Klopfsensor 4" VAL_BLK 0x8149B4 KwbUw 65535.00 dez 0.00 65535.00 FORMAT "%8.2" NUMBER 4 /end CHARACTERISTIC
/begin CHARACTERISTIC CDKKUPPL "Codewort Kunde: Pedalwertgeber Kupplung" VAL_BLK 0x8149BC KwbUw 65535.00 dez 0.00 65535.00 FORMAT "%8.2" NUMBER 4 /end CHARACTERISTIC
/begin CHARACTERISTIC CDKLDE "Codeword Kunde: Ladedrucksteuerventil (Endstufe)" VAL_BLK 0x8149CC KwbUw 65535.00 dez 0.00 65535.00 FORMAT "%8.2" NUMBER 4 /end CHARACTERISTIC
/begin CHARACTERISTIC CDKLUE1 "" VAL_BLK 0x814A24 KwbUw 65535.00 DEZ 0.00 65535.00 FORMAT "%8.2" NUMBER 4 /end CHARACTERISTIC
/begin CHARACTERISTIC CDKLUES1E "" VAL_BLK 0x814A2C KwbUw 65535.00 dez 0.00 65535.00 FORMAT "%8.2" NUMBER 4 /end CHARACTERISTIC
/begin CHARACTERISTIC CDKMILE "Codewort Kunde: MIL-Endstufe" VAL_BLK 0x814A6C KwbUw 65535.00 dez 0.00 65535.00 FORMAT "%8.2" NUMBER 4 /end CHARACTERISTIC
/begin CHARACTERISTIC CDKNWSE "Codewort Kunde: Nockenwellensteuerungsventil Endstufe" VAL_BLK 0x814A84 KwbUw 65535.00 dez 0.00 65535.00 FORMAT "%8.2" NUMBER 4 /end CHARACTERISTIC
/begin CHARACTERISTIC CDKRKAT "Codewort Kunde: LR- Adaption pro Zeit" VAL_BLK 0x814AA4 KwbUw 65535.00 dez 0.00 65535.00 FORMAT "%8.2" NUMBER 4 /end CHARACTERISTIC
/begin CHARACTERISTIC CDKRKAZ "Codewort Kunde: LR- Adaption additiv pro Zündung" VAL_BLK 0x814AAC KwbUw 65535.00 dez 0.00 65535.00 FORMAT "%8.2" NUMBER 4 /end CHARACTERISTIC
/begin CHARACTERISTIC CDKSLPE "Codewort Kunde: Sekundärluftpumpe  (Endstufe)" VAL_BLK 0x814ACC KwbUw 65535.00 dez 0.00 65535.00 FORMAT "%8.2" NUMBER 4 /end CHARACTERISTIC
/begin CHARACTERISTIC CDKSLVE "Codewort Kunde: Sekundärluftventil (Endstufe)" VAL_BLK 0x814AE4 KwbUw 65535.00 dez 0.00 65535.00 FORMAT "%8.2" NUMBER 4 /end CHARACTERISTIC
/begin CHARACTERISTIC CDKTEVE "Codewort Kunde: Tankentlüftungsventil Endstufe" VAL_BLK 0x814B24 KwbUw 65535.00 dez 0.00 65535.00 FORMAT "%8.2" NUMBER 4 /end CHARACTERISTIC
/begin CHARACTERISTIC CDKUVSE "Codeword Kunde: Endstufe Umluftventil turbo" VAL_BLK 0x814B9C KwbUw 65535.00 dez 0.00 65535.00 FORMAT "%8.2" NUMBER 4 /end CHARACTERISTIC
/begin CHARACTERISTIC CDKZET1 "" VAL_BLK 0x814BBC KwbUw 65535.00 dez 0.00 65535.00 FORMAT "%8.2" NUMBER 4 /end CHARACTERISTIC
/begin CHARACTERISTIC CDKZET2 "" VAL_BLK 0x814BC4 KwbUw 65535.00 dez 0.00 65535.00 FORMAT "%8.2" NUMBER 4 /end CHARACTERISTIC
/begin CHARACTERISTIC CDKZET3 "" VAL_BLK 0x814BCC KwbUw 65535.00 dez 0.00 65535.00 FORMAT "%8.2" NUMBER 4 /end CHARACTERISTIC
/begin CHARACTERISTIC CDKZET4 "" VAL_BLK 0x814BD4 KwbUw 65535.00 dez 0.00 65535.00 FORMAT "%8.2" NUMBER 4 /end CHARACTERISTIC
/begin CHARACTERISTIC CDKZZZ "Dummy: Tabellenendeng" VAL_BLK 0x814BDC KwbUw 65535.00 dez 0.00 65535.00 FORMAT "%8.2" NUMBER 4 /end CHARACTERISTIC
/begin CHARACTERISTIC CDTAAA "Dummy: Tabellenanfang" VALUE 0x814BE4 KwUw 65535.00 dez 0.00 65535.00 FORMAT "%8.2" /end CHARACTERISTIC
/begin CHARACTERISTIC CDTAGRE "Codewort Tester: Überwachung AGR-Endstufe" VALUE 0x814BE8 KwUw 65535.00 dez 0.00 65535.00 FORMAT "%8.2" /end CHARACTERISTIC
/begin CHARACTERISTIC CDTBKVPE "" VALUE 0x814BFA KwUw 65535.00 dez 0.00 65535.00 FORMAT "%8.2" /end CHARACTERISTIC
/begin CHARACTERISTIC CDTDK "Codewort Tester: DK - Potentiometer" VALUE 0x814C16 KwUw 65535.00 dez 0.00 65535.00 FORMAT "%8.2" /end CHARACTERISTIC
/begin CHARACTERISTIC CDTDK1P "Codewort Tester: Drosselklappe 1. Poti" VALUE 0x814C18 KwUw 65535.00 dez 0.00 65535.00 FORMAT "%8.2" /end CHARACTERISTIC
/begin CHARACTERISTIC CDTDK2P "Codewort Tester: Drosselklappenpotentiometer 2" VALUE 0x814C1A KwUw 65535.00 dez 0.00 65535.00 FORMAT "%8.2" /end CHARACTERISTIC
/begin CHARACTERISTIC CDTDVEE "Codewort Tester: DV-E Endstufe" VALUE 0x814C28 KwUw 65535.00 dez 0.00 65535.00 FORMAT "%8.2" /end CHARACTERISTIC
/begin CHARACTERISTIC CDTDVEF "Codewort Tester: DV-E Fehler bei Federprüfung" VALUE 0x814C2A KwUw 65535.00 dez 0.00 65535.00 FORMAT "%8.2" /end CHARACTERISTIC
/begin CHARACTERISTIC CDTDVEFO "" VALUE 0x814C2C KwUw 65535.00 dez 0.00 65535.00 FORMAT "%8.2" /end CHARACTERISTIC
/begin CHARACTERISTIC CDTDVEL "Codewort Tester: DV-E Lageabweichung" VALUE 0x814C2E KwUw 65535.00 dez 0.00 65535.00 FORMAT "%8.2" /end CHARACTERISTIC
/begin CHARACTERISTIC CDTDVEN "Codewort Tester: DV-E Fehler bei Prüfung Notlufposition" VALUE 0x814C30 KwUw 65535.00 dez 0.00 65535.00 FORMAT "%8.2" /end CHARACTERISTIC
/begin CHARACTERISTIC CDTDVER "Codewort Tester: DV-E Regelbereich" VALUE 0x814C32 KwUw 65535.00 dez 0.00 65535.00 FORMAT "%8.2" /end CHARACTERISTIC
/begin CHARACTERISTIC CDTDVET "" VALUE 0x814C34 KwUw 65535.00 dez 0.00 65535.00 FORMAT "%8.2" /end CHARACTERISTIC
/begin CHARACTERISTIC CDTDVEU "Codewort Tester: DV-E Fehler beim UMA-Lernen" VALUE 0x814C36 KwUw 65535.00 dez 0.00 65535.00 FORMAT "%8.2" /end CHARACTERISTIC
/begin CHARACTERISTIC CDTDVEUB "" VALUE 0x814C38 KwUw 65535.00 dez 0.00 65535.00 FORMAT "%8.2" /end CHARACTERISTIC
/begin CHARACTERISTIC CDTDVEUW "" VALUE 0x814C3A KwUw 65535.00 dez 0.00 65535.00 FORMAT "%8.2" /end CHARACTERISTIC
/begin CHARACTERISTIC CDTDVEV "Codewort Tester: DV-E Fehler bei Verstärkerabgleich" VALUE 0x814C3C KwUw 65535.00 dez 0.00 65535.00 FORMAT "%8.2" /end CHARACTERISTIC
/begin CHARACTERISTIC CDTEGFE "Codeowort Tester: Eingangsgröße Füllungserfassung" VALUE 0x814C3E KwUw 65535.00 dez 0.00 65535.00 FORMAT "%8.2" /end CHARACTERISTIC
/begin CHARACTERISTIC CDTENWS "Codewort Tester: Nockenwellensteuerung Einlass Nockenwelle" VALUE 0x814C40 KwUw 65535.00 dez 0.00 65535.00 FORMAT "%8.2" /end CHARACTERISTIC
/begin CHARACTERISTIC CDTENWSE "Codewort Tester: Einlaßnockenwelle- Endstufe" VALUE 0x814C42 KwUw 65535.00 dez 0.00 65535.00 FORMAT "%8.2" /end CHARACTERISTIC
/begin CHARACTERISTIC CDTEPCLE "Codewort Tester: Fahrverhaltens- Fehllampe ( Endstufe )" VALUE 0x814C44 KwUw 65535.00 dez 0.00 65535.00 FORMAT "%8.2" /end CHARACTERISTIC
/begin CHARACTERISTIC CDTETRE "Codeword Tester: El. Thermostat-Endstufe" VALUE 0x814C46 KwUw 65535.00 dez 0.00 65535.00 FORMAT "%8.2" /end CHARACTERISTIC
/begin CHARACTERISTIC CDTEV1 "Codewort Tester: EV von Zyl. 1" VALUE 0x814C48 KwUw 65535.00 dez 0.00 65535.00 FORMAT "%8.2" /end CHARACTERISTIC
/begin CHARACTERISTIC CDTEV2 "Codewort Tester: EV von Zyl. 2" VALUE 0x814C4A KwUw 65535.00 dez 0.00 65535.00 FORMAT "%8.2" /end CHARACTERISTIC
/begin CHARACTERISTIC CDTEV3 "Codewort Tester: EV von Zyl. 3" VALUE 0x814C4C KwUw 65535.00 dez 0.00 65535.00 FORMAT "%8.2" /end CHARACTERISTIC
/begin CHARACTERISTIC CDTEV4 "Codewort Tester: EV von Zyl. 4" VALUE 0x814C4E KwUw 65535.00 dez 0.00 65535.00 FORMAT "%8.2" /end CHARACTERISTIC
/begin CHARACTERISTIC CDTFRAO "Codewort Tester: LR-Adaption multiplikativ obere Schwelle" VALUE 0x814C56 KwUw 65535.00 dez 0.00 65535.00 FORMAT "%8.2" /end CHARACTERISTIC
/begin CHARACTERISTIC CDTFRAU "Codewort Tester: LR-Adaption multiplikativ untere Schwelle" VALUE 0x814C58 KwUw 65535.00 dez 0.00 65535.00 FORMAT "%8.2" /end CHARACTERISTIC
/begin CHARACTERISTIC CDTFRST "Codewort Tester: LR-Abweichung" VALUE 0x814C5A KwUw 65535.00 dez 0.00 65535.00 FORMAT "%8.2" /end CHARACTERISTIC
/begin CHARACTERISTIC CDTHSH "Codewort Tester: Lambdasonden-Heizung hinter Katalysator" VALUE 0x814C64 KwUw 65535.00 dez 0.00 65535.00 FORMAT "%8.2" /end CHARACTERISTIC
/begin CHARACTERISTIC CDTHSH2 "Codewort Tester: Lambdasonden-Heizung hinter Kat., Bank 2" VALUE 0x814C66 KwUw 65535.00 dez 0.00 65535.00 FORMAT "%8.2" /end CHARACTERISTIC
/begin CHARACTERISTIC CDTHSHE "Codewort Tester: Endstufe Lambdasonden-Heizung hinter Katalysator" VALUE 0x814C68 KwUw 65535.00 dez 0.00 65535.00 FORMAT "%8.2" /end CHARACTERISTIC
/begin CHARACTERISTIC CDTHSV "Codewort Tester: Lambdasonden-Heizung vor Katalysator" VALUE 0x814C6A KwUw 65535.00 dez 0.00 65535.00 FORMAT "%8.2" /end CHARACTERISTIC
/begin CHARACTERISTIC CDTHSV2 "Codewort Tester: Lambdasonden-Heizung vor Kat., Bank 2" VALUE 0x814C6C KwUw 65535.00 dez 0.00 65535.00 FORMAT "%8.2" /end CHARACTERISTIC
/begin CHARACTERISTIC CDTHSVSA "Codewort Tester: Lambdasonden-Heizung vor Katalysator" VALUE 0x814C6E KwUw 65535.00 dez 0.00 65535.00 FORMAT "%8.2" /end CHARACTERISTIC
/begin CHARACTERISTIC CDTHSVSA2 "Codewort Tester: Lambdasonden-Heizung vor Kat., Bank 2" VALUE 0x814C70 KwUw 65535.00 dez 0.00 65535.00 FORMAT "%8.2" /end CHARACTERISTIC
/begin CHARACTERISTIC CDTKAT "Codewort Tester: Katalysator-Konvertierung" VALUE 0x814C72 KwUw 65535.00 dez 0.00 65535.00 FORMAT "%8.2" /end CHARACTERISTIC
/begin CHARACTERISTIC CDTKPE "Codewort Tester: EKP-Relais Endstufe" VALUE 0x814C74 KwUw 65535.00 dez 0.00 65535.00 FORMAT "%8.2" /end CHARACTERISTIC
/begin CHARACTERISTIC CDTKRA01 "" VALUE 0x814C76 KwUw 65535.00 dez 0.00 65535.00 FORMAT "%8.2" /end CHARACTERISTIC
/begin CHARACTERISTIC CDTKRA02 "" VALUE 0x814C78 KwUw 65535.00 dez 0.00 65535.00 FORMAT "%8.2" /end CHARACTERISTIC
/begin CHARACTERISTIC CDTKRA03 "" VALUE 0x814C7A KwUw 65535.00 dez 0.00 65535.00 FORMAT "%8.2" /end CHARACTERISTIC
/begin CHARACTERISTIC CDTKRA04 "" VALUE 0x814C7C KwUw 65535.00 dez 0.00 65535.00 FORMAT "%8.2" /end CHARACTERISTIC
/begin CHARACTERISTIC CDTKRNT "Codewort Tester: Klopfregelung Nulltest" VALUE 0x814C7E KwUw 65535.00 dez 0.00 65535.00 FORMAT "%8.2" /end CHARACTERISTIC
/begin CHARACTERISTIC CDTKROF "Codewort Tester: Klopfregelung Offset" VALUE 0x814C80 KwUw 65535.00 dez 0.00 65535.00 FORMAT "%8.2" /end CHARACTERISTIC
/begin CHARACTERISTIC CDTKRTP "Codewort Tester: Klopfregelung Testimpuls" VALUE 0x814C82 KwUw 65535.00 dez 0.00 65535.00 FORMAT "%8.2" /end CHARACTERISTIC
/begin CHARACTERISTIC CDTKS1 "Codewort Tester: Klopfsensor 1" VALUE 0x814C84 KwUw 65535.00 dez 0.00 65535.00 FORMAT "%8.2" /end CHARACTERISTIC
/begin CHARACTERISTIC CDTKS2 "Codewort Tester: Klopfsensor 2" VALUE 0x814C86 KwUw 65535.00 dez 0.00 65535.00 FORMAT "%8.2" /end CHARACTERISTIC
/begin CHARACTERISTIC CDTKS3 "Codewort Tester: Klopfsensor 3" VALUE 0x814C88 KwUw 65535.00 dez 0.00 65535.00 FORMAT "%8.2" /end CHARACTERISTIC
/begin CHARACTERISTIC CDTKS4 "Codewort Tester: Klopfsensor 4" VALUE 0x814C8A KwUw 65535.00 dez 0.00 65535.00 FORMAT "%8.2" /end CHARACTERISTIC
/begin CHARACTERISTIC CDTKUPPL "Fehlerpfadcode: Pedalwertgeber Kupplung" VALUE 0x814C8C KwUw 65535.00 dez 0.00 65535.00 FORMAT "%8.2" /end CHARACTERISTIC
/begin CHARACTERISTIC CDTLDE "Codewort Tester: Ladedrucksteuerventil (Endstufe)" VALUE 0x814C90 KwUw 65535.00 dez 0.00 65535.00 FORMAT "%8.2" /end CHARACTERISTIC
/begin CHARACTERISTIC CDTLUE1 "" VALUE 0x814CA6 KwUw 65535.00 DEZ 0.00 65535.00 FORMAT "%8.2" /end CHARACTERISTIC
/begin CHARACTERISTIC CDTLUES1E "Codewort Tester: Endstufe Lüftersteuerung 1" VALUE 0x814CA8 KwUw 65535.00 dez 0.00 65535.00 FORMAT "%8.2" /end CHARACTERISTIC
/begin CHARACTERISTIC CDTMILE "Codewort Tester: MIL-Endstufe" VALUE 0x814CB8 KwUw 65535.00 dez 0.00 65535.00 FORMAT "%8.2" /end CHARACTERISTIC
/begin CHARACTERISTIC CDTNWSE "Codewort Tester: Nockenwellensteuerungsventil Endstufe" VALUE 0x814CBE KwUw 65535.00 dez 0.00 65535.00 FORMAT "%8.2" /end CHARACTERISTIC
/begin CHARACTERISTIC CDTRKAT "Codewort Tester: LR-Adaption additiv pro Zeit" VALUE 0x814CC6 KwUw 65535.00 dez 0.00 65535.00 FORMAT "%8.2" /end CHARACTERISTIC
/begin CHARACTERISTIC CDTRKAZ "Codewort Tester: LR-Adaption additiv pro Zündung" VALUE 0x814CC8 KwUw 65535.00 dez 0.00 65535.00 FORMAT "%8.2" /end CHARACTERISTIC
/begin CHARACTERISTIC CDTSLPE "Codewort Tester: Sekundärluftpumpe (Endstufe)" VALUE 0x814CD0 KwUw 65535.00 dez 0.00 65535.00 FORMAT "%8.2" /end CHARACTERISTIC
/begin CHARACTERISTIC CDTSLVE "Codewort Tester: Sekundärluftventil (Endstufe)" VALUE 0x814CD6 KwUw 65535.00 dez 0.00 65535.00 FORMAT "%8.2" /end CHARACTERISTIC
/begin CHARACTERISTIC CDTTEVE "Codewort Tester: Tankentlüftungsventil Endstufe" VALUE 0x814CE6 KwUw 65535.00 dez 0.00 65535.00 FORMAT "%8.2" /end CHARACTERISTIC
/begin CHARACTERISTIC CDTUVSE "Codewort Tester: Endstufe Umluftventil Turbo" VALUE 0x814D04 KwUw 65535.00 dez 0.00 65535.00 FORMAT "%8.2" /end CHARACTERISTIC
/begin CHARACTERISTIC CDTZET1 "" VALUE 0x814D0C KwUw 65535.00 dez 0.00 65535.00 FORMAT "%8.2" /end CHARACTERISTIC
/begin CHARACTERISTIC CDTZET2 "" VALUE 0x814D0E KwUw 65535.00 dez 0.00 65535.00 FORMAT "%8.2" /end CHARACTERISTIC
/begin CHARACTERISTIC CDTZET3 "" VALUE 0x814D10 KwUw 65535.00 dez 0.00 65535.00 FORMAT "%8.2" /end CHARACTERISTIC
/begin CHARACTERISTIC CDTZET4 "" VALUE 0x814D12 KwUw 65535.00 dez 0.00 65535.00 FORMAT "%8.2" /end CHARACTERISTIC
/begin CHARACTERISTIC CDTZZZ "Dummy: Tabellenende" VALUE 0x814D14 KwUw 65535.00 dez 0.00 65535.00 FORMAT "%8.2" /end CHARACTERISTIC
/begin CHARACTERISTIC CLAAAA "Dummy: Tabellenanfang" VALUE 0x8108D0 KwUb 255.0 dez 0.00 255.0 FORMAT "%5.1" /end CHARACTERISTIC
/begin CHARACTERISTIC CLAAGRE "Fehlerklasse: AGR-Ventil Endstufe" VALUE 0x8108D2 KwUb 255.0 dez 0.00 255.0 FORMAT "%5.1" /end CHARACTERISTIC
/begin CHARACTERISTIC CLABKVPE "Fehlerklasse: BKV-Pumpe-Endstufe" VALUE 0x8108DB KwUb 255.0 dez 0.00 255.0 FORMAT "%5.1" /end CHARACTERISTIC
/begin CHARACTERISTIC CLADK "Fehlerklasse: DK- Potentiometer" VALUE 0x8108E9 KwUb 255.0 dez 0.00 255.0 FORMAT "%5.1" /end CHARACTERISTIC
/begin CHARACTERISTIC CLADK1P "Fehlerklassse: Drosselklappe 1. Poti" VALUE 0x8108EA KwUb 255.0 dez 0.00 255.0 FORMAT "%5.1" /end CHARACTERISTIC
/begin CHARACTERISTIC CLADK2P "Fehlerklasse: Drosselklappenpotentiometer 2" VALUE 0x8108EB KwUb 255.0 dez 0.00 255.0 FORMAT "%5.1" /end CHARACTERISTIC
/begin CHARACTERISTIC CLADVEE "Fehlerklasse: DV-E Endstufe" VALUE 0x8108F2 KwUb 255.0 dez 0.00 255.0 FORMAT "%5.1" /end CHARACTERISTIC
/begin CHARACTERISTIC CLADVEF "Fehlerklasse: DV-E Fehler bei Federprüfung" VALUE 0x8108F3 KwUb 255.0 dez 0.00 255.0 FORMAT "%5.1" /end CHARACTERISTIC
/begin CHARACTERISTIC CLADVEFO "Fehlerklasse: DV-E Fehler bei Federprüfung -Öffnen-" VALUE 0x8108F4 KwUb 255.0 dez 0.00 255.0 FORMAT "%5.1" /end CHARACTERISTIC
/begin CHARACTERISTIC CLADVEL "Fehlerklasse: DV-E Lageabweichung" VALUE 0x8108F5 KwUb 255.0 dez 0.00 255.0 FORMAT "%5.1" /end CHARACTERISTIC
/begin CHARACTERISTIC CLADVEN "Fehlerklasse: DV-E Fehler bei Prüfung Notluftposition" VALUE 0x8108F6 KwUb 255.0 dez 0.00 255.0 FORMAT "%5.1" /end CHARACTERISTIC
/begin CHARACTERISTIC CLADVER "Fehlerklasse: DV-E Regelbereich" VALUE 0x8108F7 KwUb 255.0 dez 0.00 255.0 FORMAT "%5.1" /end CHARACTERISTIC
/begin CHARACTERISTIC CLADVET "Fehlerklasse: DV-E Tauscherkennung ohne Adaption" VALUE 0x8108F8 KwUb 255.0 dez 0.00 255.0 FORMAT "%5.1" /end CHARACTERISTIC
/begin CHARACTERISTIC CLADVEU "Fehlerklasse: DV-E Fehler beim UMA-Lernen" VALUE 0x8108F9 KwUb 255.0 dez 0.00 255.0 FORMAT "%5.1" /end CHARACTERISTIC
/begin CHARACTERISTIC CLADVEUB "Fehlerklasse: DV-E Adaption Abbruch wegen Umweltbedingung" VALUE 0x8108FA KwUb 255.0 dez 0.00 255.0 FORMAT "%5.1" /end CHARACTERISTIC
/begin CHARACTERISTIC CLADVEUW "Fehlerklasse: UMA Wiederlernen" VALUE 0x8108FB KwUb 255.0 dez 0.00 255.0 FORMAT "%5.1" /end CHARACTERISTIC
/begin CHARACTERISTIC CLADVEV "Fehlerklasse: DV-E Fehler bei Verstärkerabgleich" VALUE 0x8108FC KwUb 255.0 dez 0.00 255.0 FORMAT "%5.1" /end CHARACTERISTIC
/begin CHARACTERISTIC CLAEGFE "Fehlerklasse: Lasterfassung" VALUE 0x8108FD KwUb 255.0 dez 0.00 255.0 FORMAT "%5.1" /end CHARACTERISTIC
/begin CHARACTERISTIC CLAENWS "Fehlerklasse: Nockenwellensteuerung Einlass Nockenwelle" VALUE 0x8108FE KwUb 255.0 dez 0.00 255.0 FORMAT "%5.1" /end CHARACTERISTIC
/begin CHARACTERISTIC CLAENWSE "Fehlerklasse: Einlaßnockenwelle- Endstufe" VALUE 0x8108FF KwUb 255.0 dez 0.00 255.0 FORMAT "%5.1" /end CHARACTERISTIC
/begin CHARACTERISTIC CLAEPCLE "Fehlerklasse: Fahrverhaltens- Fehllampe ( Endstufe )" VALUE 0x810900 KwUb 255.0 dez 0.00 255.0 FORMAT "%5.1" /end CHARACTERISTIC
/begin CHARACTERISTIC CLAETRE "Fehlerklasse: El. Thermostat-Endstufe" VALUE 0x810901 KwUb 255.0 dez 0.00 255.0 FORMAT "%5.1" /end CHARACTERISTIC
/begin CHARACTERISTIC CLAEV1 "Fehlerklasse: EV Endstufe 1" VALUE 0x810902 KwUb 255.0 dez 0.00 255.0 FORMAT "%5.1" /end CHARACTERISTIC
/begin CHARACTERISTIC CLAEV2 "Fehlerklasse: EV Endstufe 2" VALUE 0x810903 KwUb 255.0 dez 0.00 255.0 FORMAT "%5.1" /end CHARACTERISTIC
/begin CHARACTERISTIC CLAEV3 "Fehlerklasse: EV Endstufe 3" VALUE 0x810904 KwUb 255.0 dez 0.00 255.0 FORMAT "%5.1" /end CHARACTERISTIC
/begin CHARACTERISTIC CLAEV4 "Fehlerklasse: EV Endstufe 4" VALUE 0x810905 KwUb 255.0 dez 0.00 255.0 FORMAT "%5.1" /end CHARACTERISTIC
/begin CHARACTERISTIC CLAFRAO "Fehlerklasse: LR-Adaption oberer Bereich" VALUE 0x810909 KwUb 255.0 dez 0.00 255.0 FORMAT "%5.1" /end CHARACTERISTIC
/begin CHARACTERISTIC CLAFRAU "Fehlerklasse: LR-Adaption unterer Bereich" VALUE 0x81090A KwUb 255.0 dez 0.00 255.0 FORMAT "%5.1" /end CHARACTERISTIC
/begin CHARACTERISTIC CLAFRST "Fehlerklasse: LR-Abweichung" VALUE 0x81090B KwUb 255.0 dez 0.00 255.0 FORMAT "%5.1" /end CHARACTERISTIC
/begin CHARACTERISTIC CLAHSH "Fehlerklasse: Heizung Lambdasonde hinter Kat" VALUE 0x810910 KwUb 255.0 dez 0.00 255.0 FORMAT "%5.1" /end CHARACTERISTIC
/begin CHARACTERISTIC CLAHSH2 "Fehlerklasse: Heizung Lambdasonde 2 hinter Kat" VALUE 0x810911 KwUb 255.0 dez 0.00 255.0 FORMAT "%5.1" /end CHARACTERISTIC
/begin CHARACTERISTIC CLAHSHE "Fehlerklasse: Endstufe Heizung Lambdasonde hinter Kat" VALUE 0x810912 KwUb 255.0 dez 0.00 255.0 FORMAT "%5.1" /end CHARACTERISTIC
/begin CHARACTERISTIC CLAHSV "Fehlerklasse: Heizung Lambdasonde vor Kat" VALUE 0x810913 KwUb 255.0 dez 0.00 255.0 FORMAT "%5.1" /end CHARACTERISTIC
/begin CHARACTERISTIC CLAHSV2 "Fehlerklasse: Heizung Lambdasonde 2 vor Kat" VALUE 0x810914 KwUb 255.0 dez 0.00 255.0 FORMAT "%5.1" /end CHARACTERISTIC
/begin CHARACTERISTIC CLAHSVSA "Fehlerklasse: Heizung Lambdasonde vor Kat" VALUE 0x810915 KwUb 255.0 dez 0.00 255.0 FORMAT "%5.1" /end CHARACTERISTIC
/begin CHARACTERISTIC CLAHSVSA2 "Fehlerklasse: Heizung Lambdasonde 2 vor Kat" VALUE 0x810916 KwUb 255.0 dez 0.00 255.0 FORMAT "%5.1" /end CHARACTERISTIC
/begin CHARACTERISTIC CLAKAT "Fehlerklasse: Katalysator" VALUE 0x810917 KwUb 255.0 dez 0.00 255.0 FORMAT "%5.1" /end CHARACTERISTIC
/begin CHARACTERISTIC CLAKPE "Fehlerklasse: EKP-Relais Endstufe" VALUE 0x810918 KwUb 255.0 dez 0.00 255.0 FORMAT "%5.1" /end CHARACTERISTIC
/begin CHARACTERISTIC CLAKRA01 "Fehlerklasse: Klopfregelanschlag Zylinder 1" VALUE 0x810919 KwUb 255.0 dez 0.00 255.0 FORMAT "%5.1" /end CHARACTERISTIC
/begin CHARACTERISTIC CLAKRA02 "Fehlerklasse: Klopfregelanschlag Zylinder 2" VALUE 0x81091A KwUb 255.0 dez 0.00 255.0 FORMAT "%5.1" /end CHARACTERISTIC
/begin CHARACTERISTIC CLAKRA03 "Fehlerklasse: Klopfregelanschlag Zylinder 3" VALUE 0x81091B KwUb 255.0 dez 0.00 255.0 FORMAT "%5.1" /end CHARACTERISTIC
/begin CHARACTERISTIC CLAKRA04 "Fehlerklasse: Klopfregelanschlag Zylinder 4" VALUE 0x81091C KwUb 255.0 dez 0.00 255.0 FORMAT "%5.1" /end CHARACTERISTIC
/begin CHARACTERISTIC CLAKRNT "Fehlerklasse: Klopfregelung Nulltest" VALUE 0x81091D KwUb 255.0 dez 0.00 255.0 FORMAT "%5.1" /end CHARACTERISTIC
/begin CHARACTERISTIC CLAKROF "Fehlerklasse: Klopfregelung Offset" VALUE 0x81091E KwUb 255.0 dez 0.00 255.0 FORMAT "%5.1" /end CHARACTERISTIC
/begin CHARACTERISTIC CLAKRTP "Fehlerklasse: Klopfregelung Testimpuls" VALUE 0x81091F KwUb 255.0 dez 0.00 255.0 FORMAT "%5.1" /end CHARACTERISTIC
/begin CHARACTERISTIC CLAKS1 "Fehlerklasse: Klopfsensor 1" VALUE 0x810920 KwUb 255.0 dez 0.00 255.0 FORMAT "%5.1" /end CHARACTERISTIC
/begin CHARACTERISTIC CLAKS2 "Fehlerklasse: Klopfsensor 2" VALUE 0x810921 KwUb 255.0 dez 0.00 255.0 FORMAT "%5.1" /end CHARACTERISTIC
/begin CHARACTERISTIC CLAKS3 "Fehlerklasse: Klopfsensor 3" VALUE 0x810922 KwUb 255.0 dez 0.00 255.0 FORMAT "%5.1" /end CHARACTERISTIC
/begin CHARACTERISTIC CLAKS4 "Fehlerklasse: Klopfsensor 4" VALUE 0x810923 KwUb 255.0 dez 0.00 255.0 FORMAT "%5.1" /end CHARACTERISTIC
/begin CHARACTERISTIC CLAKUPPL "Fehlerklasse: Pedalwertgeber Kupplung" VALUE 0x810924 KwUb 255.0 dez 0.00 255.0 FORMAT "%5.1" /end CHARACTERISTIC
/begin CHARACTERISTIC CLALDE "Fehlerklasse: LDR-Taktventil Endstufe" VALUE 0x810926 KwUb 255.0 dez 0.00 255.0 FORMAT "%5.1" /end CHARACTERISTIC
/begin CHARACTERISTIC CLALUE1 "Fehlerklasse: Kühlerlüfter-SG Lüfter 1" VALUE 0x810931 KwUb 255.0 DEZ 0.00 255.0 FORMAT "%5.1" /end CHARACTERISTIC
/begin CHARACTERISTIC CLALUES1E "Fehlerklasse: Endstufe Lüftersteuerung 1" VALUE 0x810932 KwUb 255.0 dez 0.00 255.0 FORMAT "%5.1" /end CHARACTERISTIC
/begin CHARACTERISTIC CLAMILE "Fehlerklasse: MIL-Endstufe" VALUE 0x81093A KwUb 255.0 dez 0.00 255.0 FORMAT "%5.1" /end CHARACTERISTIC
/begin CHARACTERISTIC CLANWSE "Fehlerklasse: Nockenwellensteuerungsventil Endstufe" VALUE 0x81093D KwUb 255.0 dez 0.00 255.0 FORMAT "%5.1" /end CHARACTERISTIC
/begin CHARACTERISTIC CLARKAT "Fehlerklasse: LR-Adaption additiver Bereich pro Zeit" VALUE 0x810941 KwUb 255.0 dez 0.00 255.0 FORMAT "%5.1" /end CHARACTERISTIC
/begin CHARACTERISTIC CLARKAZ "Fehlerklasse: LR-Adaption additiver Bereich pro Zündung" VALUE 0x810942 KwUb 255.0 dez 0.00 255.0 FORMAT "%5.1" /end CHARACTERISTIC
/begin CHARACTERISTIC CLASLPE "Fehlerklasse: Sekundärluftpumpe Endstufe" VALUE 0x810946 KwUb 255.0 dez 0.00 255.0 FORMAT "%5.1" /end CHARACTERISTIC
/begin CHARACTERISTIC CLASLVE "Fehlerklasse: Sekundärluftventil Endstufe" VALUE 0x810949 KwUb 255.0 dez 0.00 255.0 FORMAT "%5.1" /end CHARACTERISTIC
/begin CHARACTERISTIC CLATEVE "Fehlerklasse: Tankentlüftungsventil Endstufe" VALUE 0x810951 KwUb 255.0 dez 0.00 255.0 FORMAT "%5.1" /end CHARACTERISTIC
/begin CHARACTERISTIC CLAUVSE "Fehlerklasse: Endstufe Umluftventil Turbo" VALUE 0x810960 KwUb 255.0 dez 0.00 255.0 FORMAT "%5.1" /end CHARACTERISTIC
/begin CHARACTERISTIC CLAZET1 "Fehlerklasse: Zündendstufe Zylinder 1" VALUE 0x810964 KwUb 255.0 dez 0.00 255.0 FORMAT "%5.1" /end CHARACTERISTIC
/begin CHARACTERISTIC CLAZET2 "Fehlerklasse: Zündendstufe Zylinder 2" VALUE 0x810965 KwUb 255.0 dez 0.00 255.0 FORMAT "%5.1" /end CHARACTERISTIC
/begin CHARACTERISTIC CLAZET3 "Fehlerklasse: Zündendstufe Zylinder 3" VALUE 0x810966 KwUb 255.0 dez 0.00 255.0 FORMAT "%5.1" /end CHARACTERISTIC
/begin CHARACTERISTIC CLAZET4 "Fehlerklasse: Diagnose Zündendstufe 4" VALUE 0x810967 KwUb 255.0 dez 0.00 255.0 FORMAT "%5.1" /end CHARACTERISTIC
/begin CHARACTERISTIC CLAZZZ "Dummy: Tabellenende" VALUE 0x810968 KwUb 255.0 dez 0.00 255.0 FORMAT "%5.1" /end CHARACTERISTIC
/begin CHARACTERISTIC FFTAAA "Dummy: Tabellenanfang" VAL_BLK 0x810969 KwbUb 255.0 dez 0.00 255.0 FORMAT "%5.1" NUMBER 2 /end CHARACTERISTIC
/begin CHARACTERISTIC FFTAGRE "Freeze Frame Tabelle: AGR-Ventil Endstufe" VAL_BLK 0x81096D KwbUb 255.0 dez 0.00 255.0 FORMAT "%5.1" NUMBER 2 /end CHARACTERISTIC
/begin CHARACTERISTIC FFTBKVPE "" VAL_BLK 0x81097F KwbUb 255.0 dez 0.00 255.0 FORMAT "%5.1" NUMBER 2 /end CHARACTERISTIC
/begin CHARACTERISTIC FFTDK "Freeze Frame Tabelle: DK- Potentiometer" VAL_BLK 0x81099B KwbUb 255.0 dez 0.00 255.0 FORMAT "%5.1" NUMBER 2 /end CHARACTERISTIC
/begin CHARACTERISTIC FFTDK1P "Freeze Frame Tabelle: Drosselklappe 1. Poti" VAL_BLK 0x81099D KwbUb 255.0 dez 0.00 255.0 FORMAT "%5.1" NUMBER 2 /end CHARACTERISTIC
/begin CHARACTERISTIC FFTDK2P "Freeze Frame Tabelle: Drosselklappenpotentiometer 2" VAL_BLK 0x81099F KwbUb 255.0 dez 0.00 255.0 FORMAT "%5.1" NUMBER 2 /end CHARACTERISTIC
/begin CHARACTERISTIC FFTDVEE "Freeze Frame Tabelle: DV-E Endstufe" VAL_BLK 0x8109AD KwbUb 255.0 dez 0.00 255.0 FORMAT "%5.1" NUMBER 2 /end CHARACTERISTIC
/begin CHARACTERISTIC FFTDVEF "Freeze Frame Tabelle: DV-E Fehler bei Federprüfung" VAL_BLK 0x8109AF KwbUb 255.0 dez 0.00 255.0 FORMAT "%5.1" NUMBER 2 /end CHARACTERISTIC
/begin CHARACTERISTIC FFTDVEFO "" VAL_BLK 0x8109B1 KwbUb 255.0 dez 0.00 255.0 FORMAT "%5.1" NUMBER 2 /end CHARACTERISTIC
/begin CHARACTERISTIC FFTDVEL "Freeze Frame Tabelle: DV-E Lageabweichung" VAL_BLK 0x8109B3 KwbUb 255.0 dez 0.00 255.0 FORMAT "%5.1" NUMBER 2 /end CHARACTERISTIC
/begin CHARACTERISTIC FFTDVEN "Freeze Frame Tabelle: DV-E Fehler bei Prüfung Notluftposition" VAL_BLK 0x8109B5 KwbUb 255.0 dez 0.00 255.0 FORMAT "%5.1" NUMBER 2 /end CHARACTERISTIC
/begin CHARACTERISTIC FFTDVER "Freeze Frame Tabelle: DV-E Regelbereich" VAL_BLK 0x8109B7 KwbUb 255.0 dez 0.00 255.0 FORMAT "%5.1" NUMBER 2 /end CHARACTERISTIC
/begin CHARACTERISTIC FFTDVET "" VAL_BLK 0x8109B9 KwbUb 255.0 dez 0.00 255.0 FORMAT "%5.1" NUMBER 2 /end CHARACTERISTIC
/begin CHARACTERISTIC FFTDVEU "Freeze Frame Tabelle: DV-E Fehler beim UMA-Lernen" VAL_BLK 0x8109BB KwbUb 255.0 dez 0.00 255.0 FORMAT "%5.1" NUMBER 2 /end CHARACTERISTIC
/begin CHARACTERISTIC FFTDVEUB "" VAL_BLK 0x8109BD KwbUb 255.0 dez 0.00 255.0 FORMAT "%5.1" NUMBER 2 /end CHARACTERISTIC
/begin CHARACTERISTIC FFTDVEUW "" VAL_BLK 0x8109BF KwbUb 255.0 dez 0.00 255.0 FORMAT "%5.1" NUMBER 2 /end CHARACTERISTIC
/begin CHARACTERISTIC FFTDVEV "Freeze Frame Tabelle: DV-E Fehler bei Verstärkerabgleich" VAL_BLK 0x8109C1 KwbUb 255.0 dez 0.00 255.0 FORMAT "%5.1" NUMBER 2 /end CHARACTERISTIC
/begin CHARACTERISTIC FFTEGFE "Freeze Frame Tabelle: Lasterfassung" VAL_BLK 0x8109C3 KwbUb 255.0 dez 0.00 255.0 FORMAT "%5.1" NUMBER 2 /end CHARACTERISTIC
/begin CHARACTERISTIC FFTENWS "Freeze Frame Tabelle: Nockenwellensteuerung Einlass Nockenwelle" VAL_BLK 0x8109C5 KwbUb 255.0 dez 0.00 255.0 FORMAT "%5.1" NUMBER 2 /end CHARACTERISTIC
/begin CHARACTERISTIC FFTENWSE "Freeze Frame Tabelle: Einlaßnockenwelle- Endstufe" VAL_BLK 0x8109C7 KwbUb 255.0 dez 0.00 255.0 FORMAT "%5.1" NUMBER 2 /end CHARACTERISTIC
/begin CHARACTERISTIC FFTEPCLE "Freeze Frame Tabelle: Fahrverhaltens- Fehllampe ( Endstufe )" VAL_BLK 0x8109C9 KwbUb 255.0 dez 0.00 255.0 FORMAT "%5.1" NUMBER 2 /end CHARACTERISTIC
/begin CHARACTERISTIC FFTETRE "Freeze Frame Tabelle: El. Thermostat-Endstufe" VAL_BLK 0x8109CB KwbUb 255.0 dez 0.00 255.0 FORMAT "%5.1" NUMBER 2 /end CHARACTERISTIC
/begin CHARACTERISTIC FFTEV1 "Freeze Frame Tabelle: EV Endstufe 1" VAL_BLK 0x8109CD KwbUb 255.0 dez 0.00 255.0 FORMAT "%5.1" NUMBER 2 /end CHARACTERISTIC
/begin CHARACTERISTIC FFTEV2 "Freeze Frame Tabelle: EV Endstufe 2" VAL_BLK 0x8109CF KwbUb 255.0 dez 0.00 255.0 FORMAT "%5.1" NUMBER 2 /end CHARACTERISTIC
/begin CHARACTERISTIC FFTEV3 "Freeze Frame Tabelle: EV Endstufe 3" VAL_BLK 0x8109D1 KwbUb 255.0 dez 0.00 255.0 FORMAT "%5.1" NUMBER 2 /end CHARACTERISTIC
/begin CHARACTERISTIC FFTEV4 "Freeze Frame Tabelle: EV Endstufe 4" VAL_BLK 0x8109D3 KwbUb 255.0 dez 0.00 255.0 FORMAT "%5.1" NUMBER 2 /end CHARACTERISTIC
/begin CHARACTERISTIC FFTFRAO "Freeze Frame Tabelle: FRAO Gemischadaption" VAL_BLK 0x8109DB KwbUb 255.0 dez 0.00 255.0 FORMAT "%5.1" NUMBER 2 /end CHARACTERISTIC
/begin CHARACTERISTIC FFTFRAU "Freeze Frame Tabelle: FRAU Gemischadaption" VAL_BLK 0x8109DD KwbUb 255.0 dez 0.00 255.0 FORMAT "%5.1" NUMBER 2 /end CHARACTERISTIC
/begin CHARACTERISTIC FFTFRST "Freeze Frame Tabelle: LR-Abweichung" VAL_BLK 0x8109DF KwbUb 255.0 dez 0.00 255.0 FORMAT "%5.1" NUMBER 2 /end CHARACTERISTIC
/begin CHARACTERISTIC FFTHSH "Tabelle Umweltbedingungen Heizung Lambdasonde hinter Kat" VAL_BLK 0x8109E9 KwbUb 255.0 dez 0.00 255.0 FORMAT "%5.1" NUMBER 2 /end CHARACTERISTIC
/begin CHARACTERISTIC FFTHSH2 "Tabelle Umweltbedingungen Heizung Lambdasonde hinter Kat Bank2" VAL_BLK 0x8109EB KwbUb 255.0 dez 0.00 255.0 FORMAT "%5.1" NUMBER 2 /end CHARACTERISTIC
/begin CHARACTERISTIC FFTHSHE "Freeze Frame Tabelle: Endstufe Heizung Lambdasonde hinter Kat" VAL_BLK 0x8109ED KwbUb 255.0 dez 0.00 255.0 FORMAT "%5.1" NUMBER 2 /end CHARACTERISTIC
/begin CHARACTERISTIC FFTHSV "Tabelle Umweltbedingungen Heizung Lambdasonde vor Kat" VAL_BLK 0x8109EF KwbUb 255.0 dez 0.00 255.0 FORMAT "%5.1" NUMBER 2 /end CHARACTERISTIC
/begin CHARACTERISTIC FFTHSV2 "Tabelle Umweltbedingungen Heizung Lambdasonde vor Kat Bank2" VAL_BLK 0x8109F1 KwbUb 255.0 dez 0.00 255.0 FORMAT "%5.1" NUMBER 2 /end CHARACTERISTIC
/begin CHARACTERISTIC FFTHSVSA "Tabelle Umweltbedingungen Heizung Lambdasonde vor Kat" VAL_BLK 0x8109F3 KwbUb 255.0 dez 0.00 255.0 FORMAT "%5.1" NUMBER 2 /end CHARACTERISTIC
/begin CHARACTERISTIC FFTHSVSA2 "Tabelle Umweltbedingungen Heizung Lambdasonde vor Kat Bank2" VAL_BLK 0x8109F5 KwbUb 255.0 dez 0.00 255.0 FORMAT "%5.1" NUMBER 2 /end CHARACTERISTIC
/begin CHARACTERISTIC FFTKAT "Freeze Frame Tabelle: Katalysator" VAL_BLK 0x8109F7 KwbUb 255.0 dez 0.00 255.0 FORMAT "%5.1" NUMBER 2 /end CHARACTERISTIC
/begin CHARACTERISTIC FFTKPE "Freeze Frame Tabelle: EKP-Relais Endstufe" VAL_BLK 0x8109F9 KwbUb 255.0 dez 0.00 255.0 FORMAT "%5.1" NUMBER 2 /end CHARACTERISTIC
/begin CHARACTERISTIC FFTKRA01 "Freeze Frame Tabelle: Klopfregelanschlag Zylinder 1" VAL_BLK 0x8109FB KwbUb 255.0 dez 0.00 255.0 FORMAT "%5.1" NUMBER 2 /end CHARACTERISTIC
/begin CHARACTERISTIC FFTKRA02 "Freeze Frame Tabelle: Klopfregelanschlag Zylinder 2" VAL_BLK 0x8109FD KwbUb 255.0 dez 0.00 255.0 FORMAT "%5.1" NUMBER 2 /end CHARACTERISTIC
/begin CHARACTERISTIC FFTKRA03 "Freeze Frame Tabelle: Klopfregelanschlag Zylinder 3" VAL_BLK 0x8109FF KwbUb 255.0 dez 0.00 255.0 FORMAT "%5.1" NUMBER 2 /end CHARACTERISTIC
/begin CHARACTERISTIC FFTKRA04 "Freeze Frame Tabelle: Klopfregelanschlag Zylinder 4" VAL_BLK 0x810A01 KwbUb 255.0 dez 0.00 255.0 FORMAT "%5.1" NUMBER 2 /end CHARACTERISTIC
/begin CHARACTERISTIC FFTKRNT "Freeze frame Tabelle: Klopfregelung Nulltest" VAL_BLK 0x810A03 KwbUb 255.0 dez 0.00 255.0 FORMAT "%5.1" NUMBER 2 /end CHARACTERISTIC
/begin CHARACTERISTIC FFTKROF "Freeze Frame Tabelle: Klopfregelung Offset" VAL_BLK 0x810A05 KwbUb 255.0 dez 0.00 255.0 FORMAT "%5.1" NUMBER 2 /end CHARACTERISTIC
/begin CHARACTERISTIC FFTKRTP "Freeze Frame Tabelle: Klopfregelung Testimpuls" VAL_BLK 0x810A07 KwbUb 255.0 dez 0.00 255.0 FORMAT "%5.1" NUMBER 2 /end CHARACTERISTIC
/begin CHARACTERISTIC FFTKS1 "Freeze Frame Tabelle: Klopfsensor 1" VAL_BLK 0x810A09 KwbUb 255.0 dez 0.00 255.0 FORMAT "%5.1" NUMBER 2 /end CHARACTERISTIC
/begin CHARACTERISTIC FFTKS2 "Freeze Frame Tabelle: Klopfsensor 2" VAL_BLK 0x810A0B KwbUb 255.0 dez 0.00 255.0 FORMAT "%5.1" NUMBER 2 /end CHARACTERISTIC
/begin CHARACTERISTIC FFTKS3 "Freeze Frame Tabelle: Klopfsensor 3" VAL_BLK 0x810A0D KwbUb 255.0 dez 0.00 255.0 FORMAT "%5.1" NUMBER 2 /end CHARACTERISTIC
/begin CHARACTERISTIC FFTKS4 "Freeze Frame Tabelle: Klopfsensor 4" VAL_BLK 0x810A0F KwbUb 255.0 dez 0.00 255.0 FORMAT "%5.1" NUMBER 2 /end CHARACTERISTIC
/begin CHARACTERISTIC FFTKUPPL "Freeze Frame Tabelle: Pedalwertgeber Kupplung" VAL_BLK 0x810A11 KwbUb 255.0 dez 0.00 255.0 FORMAT "%5.1" NUMBER 2 /end CHARACTERISTIC
/begin CHARACTERISTIC FFTLDE "Freeze Frame Tabelle: LDR Taktventil Endstufe" VAL_BLK 0x810A15 KwbUb 255.0 dez 0.00 255.0 FORMAT "%5.1" NUMBER 2 /end CHARACTERISTIC
/begin CHARACTERISTIC FFTLUE1 "" VAL_BLK 0x810A2B KwbUb 255.0 DEZ 0.00 255.0 FORMAT "%5.1" NUMBER 2 /end CHARACTERISTIC
/begin CHARACTERISTIC FFTLUES1E "Freeze Frame Tabelle: Endstufe Lüftersteuerung 1" VAL_BLK 0x810A2D KwbUb 255.0 dez 0.00 255.0 FORMAT "%5.1" NUMBER 2 /end CHARACTERISTIC
/begin CHARACTERISTIC FFTMILE "Freeze Frame Tabelle: MIL-Endstufe" VAL_BLK 0x810A3D KwbUb 255.0 dez 0.00 255.0 FORMAT "%5.1" NUMBER 2 /end CHARACTERISTIC
/begin CHARACTERISTIC FFTNWSE "Freeze Frame Tabelle: Nockenwellensteuerungsventil Endstufe" VAL_BLK 0x810A43 KwbUb 255.0 dez 0.00 255.0 FORMAT "%5.1" NUMBER 2 /end CHARACTERISTIC
/begin CHARACTERISTIC FFTRKAT "Freeze Frame Tabelle: RKAT Gemischadaption" VAL_BLK 0x810A4B KwbUb 255.0 dez 0.00 255.0 FORMAT "%5.1" NUMBER 2 /end CHARACTERISTIC
/begin CHARACTERISTIC FFTRKAZ "Freeze Frame Tabelle: RKAZ Gemischadaption" VAL_BLK 0x810A4D KwbUb 255.0 dez 0.00 255.0 FORMAT "%5.1" NUMBER 2 /end CHARACTERISTIC
/begin CHARACTERISTIC FFTSLPE "Freeze Frame Tabelle: Sekundärluftpumpe Endstufe" VAL_BLK 0x810A55 KwbUb 255.0 dez 0.00 255.0 FORMAT "%5.1" NUMBER 2 /end CHARACTERISTIC
/begin CHARACTERISTIC FFTSLVE "Freeze Frame Tabelle: Sekundärluftventil Endstufe" VAL_BLK 0x810A5B KwbUb 255.0 dez 0.00 255.0 FORMAT "%5.1" NUMBER 2 /end CHARACTERISTIC
/begin CHARACTERISTIC FFTTEVE "Freeze Frame Tabelle: Tankentlüftungsventil Endstufe" VAL_BLK 0x810A6B KwbUb 255.0 dez 0.00 255.0 FORMAT "%5.1" NUMBER 2 /end CHARACTERISTIC
/begin CHARACTERISTIC FFTUVSE "Freeze Frame Tabelle:Endstufe Umluftventil Turbo" VAL_BLK 0x810A89 KwbUb 255.0 dez 0.00 255.0 FORMAT "%5.1" NUMBER 2 /end CHARACTERISTIC
/begin CHARACTERISTIC FFTZET1 "" VAL_BLK 0x810A91 KwbUb 255.0 dez 0.00 255.0 FORMAT "%5.1" NUMBER 2 /end CHARACTERISTIC
/begin CHARACTERISTIC FFTZET2 "" VAL_BLK 0x810A93 KwbUb 255.0 dez 0.00 255.0 FORMAT "%5.1" NUMBER 2 /end CHARACTERISTIC
/begin CHARACTERISTIC FFTZET3 "" VAL_BLK 0x810A95 KwbUb 255.0 dez 0.00 255.0 FORMAT "%5.1" NUMBER 2 /end CHARACTERISTIC
/begin CHARACTERISTIC FFTZET4 "" VAL_BLK 0x810A97 KwbUb 255.0 dez 0.00 255.0 FORMAT "%5.1" NUMBER 2 /end CHARACTERISTIC
/begin CHARACTERISTIC FFTZZZ "Dummy: Tabellenende" VAL_BLK 0x810A99 KwbUb 255.0 dez 0.00 255.0 FORMAT "%5.1" NUMBER 2 /end CHARACTERISTIC
/begin CHARACTERISTIC TSFAAA "Dummy: Tabellenanfang" VALUE 0x810A9B KwUb 255.0 dez 0.00 255.0 FORMAT "%5.1" /end CHARACTERISTIC
/begin CHARACTERISTIC TSFAGRE "Fehlersummenzeit: Überwachung AGR-Endstufe" VALUE 0x810A9D KwUb 255.0 dez 0.00 255.0 FORMAT "%5.1" /end CHARACTERISTIC
/begin CHARACTERISTIC TSFBKVPE "" VALUE 0x810AA6 KwUb 255.0 dez 0.00 255.0 FORMAT "%5.1" /end CHARACTERISTIC
/begin CHARACTERISTIC TSFDK "Fehlersummenzeit: DK - Potentiometer" VALUE 0x810AB4 KwUb 255.0 dez 0.00 255.0 FORMAT "%5.1" /end CHARACTERISTIC
/begin CHARACTERISTIC TSFDK1P "Fehlersummenzeit: Drosselklappe 1. Poti" VALUE 0x810AB5 KwUb 255.0 dez 0.00 255.0 FORMAT "%5.1" /end CHARACTERISTIC
/begin CHARACTERISTIC TSFDK2P "Fehlersummenzeit: Drosselklappenpotentiometer 2" VALUE 0x810AB6 KwUb 255.0 dez 0.00 255.0 FORMAT "%5.1" /end CHARACTERISTIC
/begin CHARACTERISTIC TSFDVEE "Fehlersummenzeit: DV-E Endstufe" VALUE 0x810ABD KwUb 255.0 dez 0.00 255.0 FORMAT "%5.1" /end CHARACTERISTIC
/begin CHARACTERISTIC TSFDVEF "Fehlersummenzeit: DV-E Fehler bei Federprüfung" VALUE 0x810ABE KwUb 255.0 dez 0.00 255.0 FORMAT "%5.1" /end CHARACTERISTIC
/begin CHARACTERISTIC TSFDVEFO "" VALUE 0x810ABF KwUb 255.0 dez 0.00 255.0 FORMAT "%5.1" /end CHARACTERISTIC
/begin CHARACTERISTIC TSFDVEL "Fehlersummenzeit: DV-E Lageabweichung" VALUE 0x810AC0 KwUb 255.0 dez 0.00 255.0 FORMAT "%5.1" /end CHARACTERISTIC
/begin CHARACTERISTIC TSFDVEN "Fehlersummenzeit: DV-E Fehler bei Prüfung Notluftposition" VALUE 0x810AC1 KwUb 255.0 dez 0.00 255.0 FORMAT "%5.1" /end CHARACTERISTIC
/begin CHARACTERISTIC TSFDVER "Fehlersummenzeit: DV-E Regelbereich" VALUE 0x810AC2 KwUb 255.0 dez 0.00 255.0 FORMAT "%5.1" /end CHARACTERISTIC
/begin CHARACTERISTIC TSFDVET "" VALUE 0x810AC3 KwUb 255.0 dez 0.00 255.0 FORMAT "%5.1" /end CHARACTERISTIC
/begin CHARACTERISTIC TSFDVEU "Fehlersummenzeit: DV-E Fehler beim UMA-Lernen" VALUE 0x810AC4 KwUb 255.0 dez 0.00 255.0 FORMAT "%5.1" /end CHARACTERISTIC
/begin CHARACTERISTIC TSFDVEUB "" VALUE 0x810AC5 KwUb 255.0 dez 0.00 255.0 FORMAT "%5.1" /end CHARACTERISTIC
/begin CHARACTERISTIC TSFDVEUW "" VALUE 0x810AC6 KwUb 255.0 dez 0.00 255.0 FORMAT "%5.1" /end CHARACTERISTIC
/begin CHARACTERISTIC TSFDVEV "Fehlersummenzeit: DV-E Fehler bei Verstärkerabgleich" VALUE 0x810AC7 KwUb 255.0 dez 0.00 255.0 FORMAT "%5.1" /end CHARACTERISTIC
/begin CHARACTERISTIC TSFEGFE "Fehlersummenzeit: Eingangsgröße Füllunserfassung" VALUE 0x810AC8 KwUb 255.0 dez 0.00 255.0 FORMAT "%5.1" /end CHARACTERISTIC
/begin CHARACTERISTIC TSFENWS "Fehlersummenzeit: Nockenwellensteuerung Einlass Nockenwelle" VALUE 0x810AC9 KwUb 255.0 dez 0.00 255.0 FORMAT "%5.1" /end CHARACTERISTIC
/begin CHARACTERISTIC TSFENWSE "Fehlersummenzeit: Einlaßnockenwelle- Endstufe" VALUE 0x810ACA KwUb 255.0 dez 0.00 255.0 FORMAT "%5.1" /end CHARACTERISTIC
/begin CHARACTERISTIC TSFEPCLE "Fehlersummenzeit: Fahrverhaltens- Fehllampe ( Endstufe )" VALUE 0x810ACB KwUb 255.0 dez 0.00 255.0 FORMAT "%5.1" /end CHARACTERISTIC
/begin CHARACTERISTIC TSFETRE "Fehlersummenzeit: Diagnose Endstufe ETR" VALUE 0x810ACC KwUb 255.0 dez 0.00 255.0 FORMAT "%5.1" /end CHARACTERISTIC
/begin CHARACTERISTIC TSFEV1 "Fehlersummenzeit: EV von Zyl. 1" VALUE 0x810ACD KwUb 255.0 dez 0.00 255.0 FORMAT "%5.1" /end CHARACTERISTIC
/begin CHARACTERISTIC TSFEV2 "Fehlersummenzeit: EV von Zyl. 2" VALUE 0x810ACE KwUb 255.0 dez 0.00 255.0 FORMAT "%5.1" /end CHARACTERISTIC
/begin CHARACTERISTIC TSFEV3 "Fehlersummenzeit: EV von Zyl. 3" VALUE 0x810ACF KwUb 255.0 dez 0.00 255.0 FORMAT "%5.1" /end CHARACTERISTIC
/begin CHARACTERISTIC TSFEV4 "Fehlersummenzeit: EV von Zyl. 4" VALUE 0x810AD0 KwUb 255.0 dez 0.00 255.0 FORMAT "%5.1" /end CHARACTERISTIC
/begin CHARACTERISTIC TSFFRAO "Fehlersummenzeit: LR-Adaption oberer Bereich" VALUE 0x810AD4 KwUb 255.0 dez 0.00 255.0 FORMAT "%5.1" /end CHARACTERISTIC
/begin CHARACTERISTIC TSFFRAU "Fehlersummenzeit: LR-Adaption unterer Bereich" VALUE 0x810AD5 KwUb 255.0 dez 0.00 255.0 FORMAT "%5.1" /end CHARACTERISTIC
/begin CHARACTERISTIC TSFFRST "Fehlersummenzeit: LR-Abweichung" VALUE 0x810AD6 KwUb 255.0 dez 0.00 255.0 FORMAT "%5.1" /end CHARACTERISTIC
/begin CHARACTERISTIC TSFHSH "Fehlersummenzeit: Lambdasonden-Heizung hinter Katalysator" VALUE 0x810ADB KwUb 255.0 dez 0.00 255.0 FORMAT "%5.1" /end CHARACTERISTIC
/begin CHARACTERISTIC TSFHSH2 "Fehlersummenzeit: Lambdasonden-Heizung hinter Katalysator, Bank 2" VALUE 0x810ADC KwUb 255.0 dez 0.00 255.0 FORMAT "%5.1" /end CHARACTERISTIC
/begin CHARACTERISTIC TSFHSHE "Fehlersummenzeit: Endstufe Heizung Sonde hinter Kat." VALUE 0x810ADD KwUb 255.0 dez 0.00 255.0 FORMAT "%5.1" /end CHARACTERISTIC
/begin CHARACTERISTIC TSFHSV "Fehlersummenzeit: Lambdasonden-Heizung vor Katalysator" VALUE 0x810ADE KwUb 255.0 dez 0.00 255.0 FORMAT "%5.1" /end CHARACTERISTIC
/begin CHARACTERISTIC TSFHSV2 "Fehlersummenzeit: Lambdasonden-Heizung vor Katalysator, Bank 2" VALUE 0x810ADF KwUb 255.0 dez 0.00 255.0 FORMAT "%5.1" /end CHARACTERISTIC
/begin CHARACTERISTIC TSFHSVSA "Fehlersummenzeit: Lambdasonden-Heizung vor Katalysator" VALUE 0x810AE0 KwUb 255.0 dez 0.00 255.0 FORMAT "%5.1" /end CHARACTERISTIC
/begin CHARACTERISTIC TSFHSVSA2 "Fehlersummenzeit: Lambdasonden-Heizung vor Katalysator, Bank 2" VALUE 0x810AE1 KwUb 255.0 dez 0.00 255.0 FORMAT "%5.1" /end CHARACTERISTIC
/begin CHARACTERISTIC TSFKAT "Fehlersummenzeit: Katalysator-Konvertierung" VALUE 0x810AE2 KwUb 255.0 dez 0.00 255.0 FORMAT "%5.1" /end CHARACTERISTIC
/begin CHARACTERISTIC TSFKPE "Fehlersummenzeit: EKP-Relais Endstufe" VALUE 0x810AE3 KwUb 255.0 dez 0.00 255.0 FORMAT "%5.1" /end CHARACTERISTIC
/begin CHARACTERISTIC TSFKRA01 "Fehlersummenzeit: Klopfregelanschlag Zylinder 1" VALUE 0x810AE4 KwUb 255.0 dez 0.00 255.0 FORMAT "%5.1" /end CHARACTERISTIC
/begin CHARACTERISTIC TSFKRA02 "Fehlersummenzeit: Klopfregelanschlag Zylinder 2" VALUE 0x810AE5 KwUb 255.0 dez 0.00 255.0 FORMAT "%5.1" /end CHARACTERISTIC
/begin CHARACTERISTIC TSFKRA03 "Fehlersummenzeit: Klopfregelanschlag Zylinder 3" VALUE 0x810AE6 KwUb 255.0 dez 0.00 255.0 FORMAT "%5.1" /end CHARACTERISTIC
/begin CHARACTERISTIC TSFKRA04 "Fehlersummenzeit: Klopfregelanschlag Zylinder 4" VALUE 0x810AE7 KwUb 255.0 dez 0.00 255.0 FORMAT "%5.1" /end CHARACTERISTIC
/begin CHARACTERISTIC TSFKRNT "Fehlersummenzeit: Klopfregelung Nulltest" VALUE 0x810AE8 KwUb 255.0 dez 0.00 255.0 FORMAT "%5.1" /end CHARACTERISTIC
/begin CHARACTERISTIC TSFKROF "Fehlersummenzeit: Klopfregelung Offset" VALUE 0x810AE9 KwUb 255.0 dez 0.00 255.0 FORMAT "%5.1" /end CHARACTERISTIC
/begin CHARACTERISTIC TSFKRTP "Fehlersummenzeit: Klopfregelung Testimpuls" VALUE 0x810AEA KwUb 255.0 dez 0.00 255.0 FORMAT "%5.1" /end CHARACTERISTIC
/begin CHARACTERISTIC TSFKS1 "Fehlersummenzeit: Klopfsensor 1" VALUE 0x810AEB KwUb 255.0 dez 0.00 255.0 FORMAT "%5.1" /end CHARACTERISTIC
/begin CHARACTERISTIC TSFKS2 "Fehlersummenzeit: Klopfsensor 2" VALUE 0x810AEC KwUb 255.0 dez 0.00 255.0 FORMAT "%5.1" /end CHARACTERISTIC
/begin CHARACTERISTIC TSFKS3 "Fehlersummenzeit: Klopfsensor 3" VALUE 0x810AED KwUb 255.0 dez 0.00 255.0 FORMAT "%5.1" /end CHARACTERISTIC
/begin CHARACTERISTIC TSFKS4 "Fehlersummenzeit: Klopfsensor 4" VALUE 0x810AEE KwUb 255.0 dez 0.00 255.0 FORMAT "%5.1" /end CHARACTERISTIC
/begin CHARACTERISTIC TSFKUPPL "Fehlersummenzeit: Pedalwertgeber Kupplung" VALUE 0x810AEF KwUb 255.0 dez 0.00 255.0 FORMAT "%5.1" /end CHARACTERISTIC
/begin CHARACTERISTIC TSFLDE "Fehlersummenzeit: Ladedrucksteuerventil (Endstufe)" VALUE 0x810AF1 KwUb 255.0 dez 0.00 255.0 FORMAT "%5.1" /end CHARACTERISTIC
/begin CHARACTERISTIC TSFLUE1 "" VALUE 0x810AFC KwUb 255.0 DEZ 0.00 255.0 FORMAT "%5.1" /end CHARACTERISTIC
/begin CHARACTERISTIC TSFLUES1E "" VALUE 0x810AFD KwUb 255.0 dez 0.00 255.0 FORMAT "%5.1" /end CHARACTERISTIC
/begin CHARACTERISTIC TSFMILE "Fehlersummenzeit: MIL-Endstufe" VALUE 0x810B05 KwUb 255.0 dez 0.00 255.0 FORMAT "%5.1" /end CHARACTERISTIC
/begin CHARACTERISTIC TSFNWSE "Fehlersummenzeit: Nockenwellensteuerungsventil Endstufe" VALUE 0x810B08 KwUb 255.0 dez 0.00 255.0 FORMAT "%5.1" /end CHARACTERISTIC
/begin CHARACTERISTIC TSFRKAT "Fehlersummenzeit: LR-Adaption additiver Bereich pro Zeit" VALUE 0x810B0C KwUb 255.0 dez 0.00 255.0 FORMAT "%5.1" /end CHARACTERISTIC
/begin CHARACTERISTIC TSFRKAZ "Fehlersummenzeit: LR-Adaption additiver Bereich pro Zündung" VALUE 0x810B0D KwUb 255.0 dez 0.00 255.0 FORMAT "%5.1" /end CHARACTERISTIC
/begin CHARACTERISTIC TSFSLPE "Fehlersummenzeit: Sekundärluftpumpe (Endstufe)" VALUE 0x810B11 KwUb 255.0 dez 0.00 255.0 FORMAT "%5.1" /end CHARACTERISTIC
/begin CHARACTERISTIC TSFSLVE "Fehlersummenzeit: Sekundärluftventil (Endstufe)" VALUE 0x810B14 KwUb 255.0 dez 0.00 255.0 FORMAT "%5.1" /end CHARACTERISTIC
/begin CHARACTERISTIC TSFTEVE "Fehlersummenzeit: Tankentlüftungsventil Endstufe" VALUE 0x810B1C KwUb 255.0 dez 0.00 255.0 FORMAT "%5.1" /end CHARACTERISTIC
/begin CHARACTERISTIC TSFUVSE "Fehlersummenzeit: Endstufe Umluftventil Turbo" VALUE 0x810B2B KwUb 255.0 dez 0.00 255.0 FORMAT "%5.1" /end CHARACTERISTIC
/begin CHARACTERISTIC TSFZET1 "" VALUE 0x810B2F KwUb 255.0 dez 0.00 255.0 FORMAT "%5.1" /end CHARACTERISTIC
/begin CHARACTERISTIC TSFZET2 "" VALUE 0x810B30 KwUb 255.0 dez 0.00 255.0 FORMAT "%5.1" /end CHARACTERISTIC
/begin CHARACTERISTIC TSFZET3 "" VALUE 0x810B31 KwUb 255.0 dez 0.00 255.0 FORMAT "%5.1" /end CHARACTERISTIC
/begin CHARACTERISTIC TSFZET4 "" VALUE 0x810B32 KwUb 255.0 dez 0.00 255.0 FORMAT "%5.1" /end CHARACTERISTIC
/begin CHARACTERISTIC TSFZZZ "Dummy: Tabellenende" VALUE 0x810B33 KwUb 255.0 dez 0.00 255.0 FORMAT "%5.1" /end CHARACTERISTIC
/begin MEASUREMENT B_beagre "Bedingung Bandende-Funktionsanforderung AGR-Endstufendiagnose" UWORD B_TRUE 1 100 0 1 BIT_MASK 0x20 FORMAT "%13.11" ECU_ADDRESS 0x383B0A /end MEASUREMENT
/begin MEASUREMENT B_bebkvpe "Bedingung Bandende-Funktionsanforderung BKV-Pumpe Endstufe" UWORD B_TRUE 1 100 0 1 BIT_MASK 0x20 FORMAT "%13.11" ECU_ADDRESS 0x383B1C /end MEASUREMENT
/begin MEASUREMENT B_bedk "Bedingung Bandende-Funktionsanforderung Drosselklappe" UWORD B_TRUE 1 100 0 1 BIT_MASK 0x20 FORMAT "%13.11" ECU_ADDRESS 0x383B38 /end MEASUREMENT
/begin MEASUREMENT B_bedk1p "Nicht benutzt" UWORD B_TRUE 1 100 0 1 BIT_MASK 0x20 FORMAT "%13.11" ECU_ADDRESS 0x383B3A /end MEASUREMENT
/begin MEASUREMENT B_bedk2p "Nicht benutzt" UWORD B_TRUE 1 100 0 1 BIT_MASK 0x20 FORMAT "%13.11" ECU_ADDRESS 0x383B3C /end MEASUREMENT
/begin MEASUREMENT B_bedvee "Nicht benutzt" UWORD B_TRUE 1 100 0 1 BIT_MASK 0x20 FORMAT "%13.11" ECU_ADDRESS 0x383B4A /end MEASUREMENT
/begin MEASUREMENT B_bedvef "Nicht benutzt" UWORD B_TRUE 1 100 0 1 BIT_MASK 0x20 FORMAT "%13.11" ECU_ADDRESS 0x383B4C /end MEASUREMENT
/begin MEASUREMENT B_bedvefo "Nicht benutzt" UWORD B_TRUE 1 100 0 1 BIT_MASK 0x20 FORMAT "%13.11" ECU_ADDRESS 0x383B4E /end MEASUREMENT
/begin MEASUREMENT B_bedvel "Nicht benutzt" UWORD B_TRUE 1 100 0 1 BIT_MASK 0x20 FORMAT "%13.11" ECU_ADDRESS 0x383B50 /end MEASUREMENT
/begin MEASUREMENT B_bedven "Nicht benutzt" UWORD B_TRUE 1 100 0 1 BIT_MASK 0x20 FORMAT "%13.11" ECU_ADDRESS 0x383B52 /end MEASUREMENT
/begin MEASUREMENT B_bedver "Nicht benutzt" UWORD B_TRUE 1 100 0 1 BIT_MASK 0x20 FORMAT "%13.11" ECU_ADDRESS 0x383B54 /end MEASUREMENT
/begin MEASUREMENT B_bedvet "Nicht benutzt" UWORD B_TRUE 1 100 0 1 BIT_MASK 0x20 FORMAT "%13.11" ECU_ADDRESS 0x383B56 /end MEASUREMENT
/begin MEASUREMENT B_bedveu "Nicht benutzt" UWORD B_TRUE 1 100 0 1 BIT_MASK 0x20 FORMAT "%13.11" ECU_ADDRESS 0x383B58 /end MEASUREMENT
/begin MEASUREMENT B_bedveub "Nicht benutzt" UWORD B_TRUE 1 100 0 1 BIT_MASK 0x20 FORMAT "%13.11" ECU_ADDRESS 0x383B5A /end MEASUREMENT
/begin MEASUREMENT B_bedveuw "Nicht benutzt" UWORD B_TRUE 1 100 0 1 BIT_MASK 0x20 FORMAT "%13.11" ECU_ADDRESS 0x383B5C /end MEASUREMENT
/begin MEASUREMENT B_bedvev "Nicht benutzt" UWORD B_TRUE 1 100 0 1 BIT_MASK 0x20 FORMAT "%13.11" ECU_ADDRESS 0x383B5E /end MEASUREMENT
/begin MEASUREMENT B_beegfe "Bedingung: Bandende-Anforderung bei Eingangsgrößen der Füllungserfassung" UWORD B_TRUE 1 100 0 1 BIT_MASK 0x20 FORMAT "%13.11" ECU_ADDRESS 0x383B60 /end MEASUREMENT
/begin MEASUREMENT B_beenws "Bedingung Bandende-Funktionsanforderung NWS (Einlass,Bank1)" UWORD B_TRUE 1 100 0 1 BIT_MASK 0x20 FORMAT "%13.11" ECU_ADDRESS 0x383B62 /end MEASUREMENT
/begin MEASUREMENT B_beenwse "Bedingung Bandende-Funktionsanforderung NWS Endstufe (Bank1, Einlaß)" UWORD B_TRUE 1 100 0 1 BIT_MASK 0x20 FORMAT "%13.11" ECU_ADDRESS 0x383B64 /end MEASUREMENT
/begin MEASUREMENT B_beepcle "" UWORD B_TRUE 1 100 0 1 BIT_MASK 0x20 FORMAT "%13.11" ECU_ADDRESS 0x383B66 /end MEASUREMENT
/begin MEASUREMENT B_beetre "Bedingung Bandendeanford. für Fehler Elektro Thermostat Regelung Endstufe" UWORD B_TRUE 1 100 0 1 BIT_MASK 0x20 FORMAT "%13.11" ECU_ADDRESS 0x383B68 /end MEASUREMENT
/begin MEASUREMENT B_beev1 "Bedingung Bandendeanforderung  für Fehler Endstufe EV1" UWORD B_TRUE 1 100 0 1 BIT_MASK 0x20 FORMAT "%13.11" ECU_ADDRESS 0x383B6A /end MEASUREMENT
/begin MEASUREMENT B_beev2 "Bedingung Bandendeanforderung  für Fehler Endstufe EV2" UWORD B_TRUE 1 100 0 1 BIT_MASK 0x20 FORMAT "%13.11" ECU_ADDRESS 0x383B6C /end MEASUREMENT
/begin MEASUREMENT B_beev3 "Bedingung Bandendeanforderung  für Fehler Endstufe EV3" UWORD B_TRUE 1 100 0 1 BIT_MASK 0x20 FORMAT "%13.11" ECU_ADDRESS 0x383B6E /end MEASUREMENT
/begin MEASUREMENT B_beev4 "Bedingung Bandendeanforderung  für Fehler Endstufe EV4" UWORD B_TRUE 1 100 0 1 BIT_MASK 0x20 FORMAT "%13.11" ECU_ADDRESS 0x383B70 /end MEASUREMENT
/begin MEASUREMENT B_befrao "Bedingung: Bandendefunktionanford. für FRAO" UWORD B_TRUE 1 100 0 1 BIT_MASK 0x20 FORMAT "%13.11" ECU_ADDRESS 0x383B78 /end MEASUREMENT
/begin MEASUREMENT B_befrau "Bedingung: Bandendefunktionanford. für FRAU" UWORD B_TRUE 1 100 0 1 BIT_MASK 0x20 FORMAT "%13.11" ECU_ADDRESS 0x383B7A /end MEASUREMENT
/begin MEASUREMENT B_befrst "Bedingung: Bandendefunktionanford. für LR- Kurztest" UWORD B_TRUE 1 100 0 1 BIT_MASK 0x20 FORMAT "%13.11" ECU_ADDRESS 0x383B7C /end MEASUREMENT
/begin MEASUREMENT B_behsh "Bedingung: Bandendefunktionanford. für %DHLS" UWORD B_TRUE 1 100 0 1 BIT_MASK 0x20 FORMAT "%13.11" ECU_ADDRESS 0x383B86 /end MEASUREMENT
/begin MEASUREMENT B_behsh2 "Bedingung: Bandendefunktionanford. für %DHLS Bank 2" UWORD B_TRUE 1 100 0 1 BIT_MASK 0x20 FORMAT "%13.11" ECU_ADDRESS 0x383B88 /end MEASUREMENT
/begin MEASUREMENT B_behshe "Bedingung Bandende-Funktionsanforderung Endstufe Sondenheizung nach Kat" UWORD B_TRUE 1 100 0 1 BIT_MASK 0x20 FORMAT "%13.11" ECU_ADDRESS 0x383B8A /end MEASUREMENT
/begin MEASUREMENT B_behsv "Bedingung: Bandendefunktionanford. für %DHRLSU" UWORD B_TRUE 1 100 0 1 BIT_MASK 0x20 FORMAT "%13.11" ECU_ADDRESS 0x383B8C /end MEASUREMENT
/begin MEASUREMENT B_behsv2 "Bedingung: Bandendefunktionanford. für %DHRLSU, Bank 2" UWORD B_TRUE 1 100 0 1 BIT_MASK 0x20 FORMAT "%13.11" ECU_ADDRESS 0x383B8E /end MEASUREMENT
/begin MEASUREMENT B_behsvsa "Bedingung: Bandendefunktionanford. für %DHLSU" UWORD B_TRUE 1 100 0 1 BIT_MASK 0x20 FORMAT "%13.11" ECU_ADDRESS 0x383B90 /end MEASUREMENT
/begin MEASUREMENT B_behsvsa2 "Bedingung: Bandendefunktionanford. für %DHLSU, Bank 2" UWORD B_TRUE 1 100 0 1 BIT_MASK 0x20 FORMAT "%13.11" ECU_ADDRESS 0x383B92 /end MEASUREMENT
/begin MEASUREMENT B_bekat "Bedingung Bandende-Funktionsanforderung Katalysatordiagnose" UWORD B_TRUE 1 100 0 1 BIT_MASK 0x20 FORMAT "%13.11" ECU_ADDRESS 0x383B94 /end MEASUREMENT
/begin MEASUREMENT B_bekpe "Bedingung Bandendeanforderung für Fehler Endstufe EKP" UWORD B_TRUE 1 100 0 1 BIT_MASK 0x20 FORMAT "%13.11" ECU_ADDRESS 0x383B96 /end MEASUREMENT
/begin MEASUREMENT B_bekrnt "Bedingung Bandende-Funktionsanforderung Klopfregelung Diagnose Nulltest" UWORD B_TRUE 1 100 0 1 BIT_MASK 0x20 FORMAT "%13.11" ECU_ADDRESS 0x383BA0 /end MEASUREMENT
/begin MEASUREMENT B_bekrof "Bedingung Bandende-Funktionsanforderung Klopfregelung Diagnose Integrator Offset" UWORD B_TRUE 1 100 0 1 BIT_MASK 0x20 FORMAT "%13.11" ECU_ADDRESS 0x383BA2 /end MEASUREMENT
/begin MEASUREMENT B_bekrtp "Bedingung Bandende-Funktionsanforderung Klopfregelung Diagnose Testpuls" UWORD B_TRUE 1 100 0 1 BIT_MASK 0x20 FORMAT "%13.11" ECU_ADDRESS 0x383BA4 /end MEASUREMENT
/begin MEASUREMENT B_beks1 "Bedingung Bandende-Funktionsanforderung Diagnose Klopfsensor 1" UWORD B_TRUE 1 100 0 1 BIT_MASK 0x20 FORMAT "%13.11" ECU_ADDRESS 0x383BA6 /end MEASUREMENT
/begin MEASUREMENT B_beks2 "Bedingung Bandende-Funktionsanforderung Diagnose Klopfsensor 2" UWORD B_TRUE 1 100 0 1 BIT_MASK 0x20 FORMAT "%13.11" ECU_ADDRESS 0x383BA8 /end MEASUREMENT
/begin MEASUREMENT B_beks3 "Bedingung Bandende-Funktionsanforderung Diagnose Klopfsensor 3" UWORD B_TRUE 1 100 0 1 BIT_MASK 0x20 FORMAT "%13.11" ECU_ADDRESS 0x383BAA /end MEASUREMENT
/begin MEASUREMENT B_beks4 "Bedingung Bandende-Funktionsanforderung Diagnose Klopfsensor 1" UWORD B_TRUE 1 100 0 1 BIT_MASK 0x20 FORMAT "%13.11" ECU_ADDRESS 0x383BAC /end MEASUREMENT
/begin MEASUREMENT B_bekuppl "Bedingung Bandende-Funktionsanforderung Kupplungssensor" UWORD B_TRUE 1 100 0 1 BIT_MASK 0x20 FORMAT "%13.11" ECU_ADDRESS 0x383BAE /end MEASUREMENT
/begin MEASUREMENT B_belde "Bedingung: Fehlereintrag  LDR-Taktventil (Bandende)" UWORD B_TRUE 1 100 0 1 BIT_MASK 0x20 FORMAT "%13.11" ECU_ADDRESS 0x383BB2 /end MEASUREMENT
/begin MEASUREMENT B_belue1 "Bedingung Bandende-Funktionsanforderung allgemein" UWORD B_TRUE 1 100 0 1 BIT_MASK 0x20 FORMAT "%13.11" ECU_ADDRESS 0x383BC8 /end MEASUREMENT
/begin MEASUREMENT B_belues1e "Bedingung Bandende-Funktionsanforderung allgemein" UWORD B_TRUE 1 100 0 1 BIT_MASK 0x20 FORMAT "%13.11" ECU_ADDRESS 0x383BCA /end MEASUREMENT
/begin MEASUREMENT B_bemile "Bedingung Bandende-Funktionsanforderung Endstufe Fehlerlampe" UWORD B_TRUE 1 100 0 1 BIT_MASK 0x20 FORMAT "%13.11" ECU_ADDRESS 0x383BDA /end MEASUREMENT
/begin MEASUREMENT B_benwse "Bedingung Bandende-Funktionsanforderung NWS" UWORD B_TRUE 1 100 0 1 BIT_MASK 0x20 FORMAT "%13.11" ECU_ADDRESS 0x383BE0 /end MEASUREMENT
/begin MEASUREMENT B_berkat "Bedingung: Bandendefunktionanford. für RKAT" UWORD B_TRUE 1 100 0 1 BIT_MASK 0x20 FORMAT "%13.11" ECU_ADDRESS 0x383BE8 /end MEASUREMENT
/begin MEASUREMENT B_berkaz "Bedingung: Bandendefunktionanford. für RKAZ" UWORD B_TRUE 1 100 0 1 BIT_MASK 0x20 FORMAT "%13.11" ECU_ADDRESS 0x383BEA /end MEASUREMENT
/begin MEASUREMENT B_beslpe "Bedingung Bandendeanforderung setzt Fehler Sekundärluftpumpe Endstufe" UWORD B_TRUE 1 100 0 1 BIT_MASK 0x20 FORMAT "%13.11" ECU_ADDRESS 0x383BF2 /end MEASUREMENT
/begin MEASUREMENT B_beslve "Bedingung Bandendeanforderung setzt Fehler Sekundärluftventil Endstufe" UWORD B_TRUE 1 100 0 1 BIT_MASK 0x20 FORMAT "%13.11" ECU_ADDRESS 0x383BF8 /end MEASUREMENT
/begin MEASUREMENT B_beteve "Bedingung Bandendeanford. für Fehler Tanentlüftungsventil Endstufe" UWORD B_TRUE 1 100 0 1 BIT_MASK 0x20 FORMAT "%13.11" ECU_ADDRESS 0x383C08 /end MEASUREMENT
/begin MEASUREMENT B_beuvse "Bedingung: Fehlereintrag  Umluftventil turbo (Bandende)" UWORD B_TRUE 1 100 0 1 BIT_MASK 0x20 FORMAT "%13.11" ECU_ADDRESS 0x383C26 /end MEASUREMENT
/begin MEASUREMENT B_bezet1 "Zündkreisfehler" UWORD B_TRUE 1 100 0 1 BIT_MASK 0x20 FORMAT "%13.11" ECU_ADDRESS 0x383C2E /end MEASUREMENT
/begin MEASUREMENT B_bezet2 "" UWORD B_TRUE 1 100 0 1 BIT_MASK 0x20 FORMAT "%13.11" ECU_ADDRESS 0x383C30 /end MEASUREMENT
/begin MEASUREMENT B_bezet3 "" UWORD B_TRUE 1 100 0 1 BIT_MASK 0x20 FORMAT "%13.11" ECU_ADDRESS 0x383C32 /end MEASUREMENT
/begin MEASUREMENT B_bezet4 "" UWORD B_TRUE 1 100 0 1 BIT_MASK 0x20 FORMAT "%13.11" ECU_ADDRESS 0x383C34 /end MEASUREMENT
/begin MEASUREMENT B_bkagre "Bedingung: Abgasrückführungsventil Endstufe" UWORD B_TRUE 1 100 0 1 BIT_MASK 0x40 FORMAT "%13.11" ECU_ADDRESS 0x383B0A /end MEASUREMENT
/begin MEASUREMENT B_bkbkvpe "Bedingung: Bremskraftverstärker-Pumpe-Endstufe aktiv" UWORD B_TRUE 1 100 0 1 BIT_MASK 0x40 FORMAT "%13.11" ECU_ADDRESS 0x383B1C /end MEASUREMENT
/begin MEASUREMENT B_bkdk "Bedingung Eratzwert aktiv: Fehler Drosselklappenpoti löschen" UWORD B_TRUE 1 100 0 1 BIT_MASK 0x40 FORMAT "%13.11" ECU_ADDRESS 0x383B38 /end MEASUREMENT
/begin MEASUREMENT B_bkdk1p "Bedingung Ersatzwert aktiv: Drosselklappe 1.Poti" UWORD B_TRUE 1 100 0 1 BIT_MASK 0x40 FORMAT "%13.11" ECU_ADDRESS 0x383B3A /end MEASUREMENT
/begin MEASUREMENT B_bkdk2p "Bedingung Ersatzwert aktiv: Drosselklappe 2.Poti" UWORD B_TRUE 1 100 0 1 BIT_MASK 0x40 FORMAT "%13.11" ECU_ADDRESS 0x383B3C /end MEASUREMENT
/begin MEASUREMENT B_bkdvee "Bedingung: DV-E Endstufe" UWORD B_TRUE 1 100 0 1 BIT_MASK 0x40 FORMAT "%13.11" ECU_ADDRESS 0x383B4A /end MEASUREMENT
/begin MEASUREMENT B_bkdvef "Bedingung: DV-E Fehler bei Federprüfung" UWORD B_TRUE 1 100 0 1 BIT_MASK 0x40 FORMAT "%13.11" ECU_ADDRESS 0x383B4C /end MEASUREMENT
/begin MEASUREMENT B_bkdvefo "Nicht benutzt" UWORD B_TRUE 1 100 0 1 BIT_MASK 0x40 FORMAT "%13.11" ECU_ADDRESS 0x383B4E /end MEASUREMENT
/begin MEASUREMENT B_bkdvel "Bedingung: DV-E Lageabweichung" UWORD B_TRUE 1 100 0 1 BIT_MASK 0x40 FORMAT "%13.11" ECU_ADDRESS 0x383B50 /end MEASUREMENT
/begin MEASUREMENT B_bkdven "Ersatzwert aktiv: DV-E Notluftposition" UWORD B_TRUE 1 100 0 1 BIT_MASK 0x40 FORMAT "%13.11" ECU_ADDRESS 0x383B52 /end MEASUREMENT
/begin MEASUREMENT B_bkdver "Bedingung: DV-E Regelbereich" UWORD B_TRUE 1 100 0 1 BIT_MASK 0x40 FORMAT "%13.11" ECU_ADDRESS 0x383B54 /end MEASUREMENT
/begin MEASUREMENT B_bkdvet "Nicht benutzt" UWORD B_TRUE 1 100 0 1 BIT_MASK 0x40 FORMAT "%13.11" ECU_ADDRESS 0x383B56 /end MEASUREMENT
/begin MEASUREMENT B_bkdveu "Ersatzwert aktiv: DV-E UMA-Lernen" UWORD B_TRUE 1 100 0 1 BIT_MASK 0x40 FORMAT "%13.11" ECU_ADDRESS 0x383B58 /end MEASUREMENT
/begin MEASUREMENT B_bkdveub "Nicht benutzt" UWORD B_TRUE 1 100 0 1 BIT_MASK 0x40 FORMAT "%13.11" ECU_ADDRESS 0x383B5A /end MEASUREMENT
/begin MEASUREMENT B_bkdveuw "Bedingung Ersatzwert aktiv: Fehler bei UMA-Wiederlernen" UWORD B_TRUE 1 100 0 1 BIT_MASK 0x40 FORMAT "%13.11" ECU_ADDRESS 0x383B5C /end MEASUREMENT
/begin MEASUREMENT B_bkdvev "Ersatzwert aktiv: DV-E Verstärkerabgleich" UWORD B_TRUE 1 100 0 1 BIT_MASK 0x40 FORMAT "%13.11" ECU_ADDRESS 0x383B5E /end MEASUREMENT
/begin MEASUREMENT B_bkegfe "Bedingung: Ersatzwert aktiv bei Eingangsgrößen der Füllungserfassung" UWORD B_TRUE 1 100 0 1 BIT_MASK 0x40 FORMAT "%13.11" ECU_ADDRESS 0x383B60 /end MEASUREMENT
/begin MEASUREMENT B_bkenws "Bedingung Ersatzwert aktiv: NWS (Einlass,Bank1)" UWORD B_TRUE 1 100 0 1 BIT_MASK 0x40 FORMAT "%13.11" ECU_ADDRESS 0x383B62 /end MEASUREMENT
/begin MEASUREMENT B_bkenwse "Bedingung Ersatzwert aktiv: NWS Endstufe (Bank1, Einlaß)" UWORD B_TRUE 1 100 0 1 BIT_MASK 0x40 FORMAT "%13.11" ECU_ADDRESS 0x383B64 /end MEASUREMENT
/begin MEASUREMENT B_bkepcle "Bedingung: Fahrverhaltens-Fehllampe Endstufe" UWORD B_TRUE 1 100 0 1 BIT_MASK 0x40 FORMAT "%13.11" ECU_ADDRESS 0x383B66 /end MEASUREMENT
/begin MEASUREMENT B_bketre "Bedingung: Elektro Thermostat Regelung Endstufe aktiv" UWORD B_TRUE 1 100 0 1 BIT_MASK 0x40 FORMAT "%13.11" ECU_ADDRESS 0x383B68 /end MEASUREMENT
/begin MEASUREMENT B_bkev1 "Bedingung: Einspritzventil 1 aktiv" UWORD B_TRUE 1 100 0 1 BIT_MASK 0x40 FORMAT "%13.11" ECU_ADDRESS 0x383B6A /end MEASUREMENT
/begin MEASUREMENT B_bkev2 "Bedingung: Einspritzventil 2 aktiv" UWORD B_TRUE 1 100 0 1 BIT_MASK 0x40 FORMAT "%13.11" ECU_ADDRESS 0x383B6C /end MEASUREMENT
/begin MEASUREMENT B_bkev3 "Bedingung: Einspritzventil 3 aktiv" UWORD B_TRUE 1 100 0 1 BIT_MASK 0x40 FORMAT "%13.11" ECU_ADDRESS 0x383B6E /end MEASUREMENT
/begin MEASUREMENT B_bkev4 "Bedingung: Einspritzventil 4 aktiv" UWORD B_TRUE 1 100 0 1 BIT_MASK 0x40 FORMAT "%13.11" ECU_ADDRESS 0x383B70 /end MEASUREMENT
/begin MEASUREMENT B_bkfrao "Ersatzwert für FRAO aktiv" UWORD B_TRUE 1 100 0 1 BIT_MASK 0x40 FORMAT "%13.11" ECU_ADDRESS 0x383B78 /end MEASUREMENT
/begin MEASUREMENT B_bkfrau "Ersatzwert für FRAU aktiv" UWORD B_TRUE 1 100 0 1 BIT_MASK 0x40 FORMAT "%13.11" ECU_ADDRESS 0x383B7A /end MEASUREMENT
/begin MEASUREMENT B_bkfrst "Bedingung: LR-Abweichung" UWORD B_TRUE 1 100 0 1 BIT_MASK 0x40 FORMAT "%13.11" ECU_ADDRESS 0x383B7C /end MEASUREMENT
/begin MEASUREMENT B_bkhsh "Bedingung: Lambdasondenheizung hinter Kat. aktiv" UWORD B_TRUE 1 100 0 1 BIT_MASK 0x40 FORMAT "%13.11" ECU_ADDRESS 0x383B86 /end MEASUREMENT
/begin MEASUREMENT B_bkhsh2 "Bedingung: Lambdasondenheizung hinter Kat. aktiv, Bank 2" UWORD B_TRUE 1 100 0 1 BIT_MASK 0x40 FORMAT "%13.11" ECU_ADDRESS 0x383B88 /end MEASUREMENT
/begin MEASUREMENT B_bkhshe "Bedingung: Lambdasondenheizung hinter Kat. Endstufe" UWORD B_TRUE 1 100 0 1 BIT_MASK 0x40 FORMAT "%13.11" ECU_ADDRESS 0x383B8A /end MEASUREMENT
/begin MEASUREMENT B_bkhsv "Bedingung: Lambdasondenheizung vor Kat. aktiv" UWORD B_TRUE 1 100 0 1 BIT_MASK 0x40 FORMAT "%13.11" ECU_ADDRESS 0x383B8C /end MEASUREMENT
/begin MEASUREMENT B_bkhsv2 "Bedingung: Lambdasondenheizung vor Kat. aktiv, Bank 2" UWORD B_TRUE 1 100 0 1 BIT_MASK 0x40 FORMAT "%13.11" ECU_ADDRESS 0x383B8E /end MEASUREMENT
/begin MEASUREMENT B_bkhsvsa "Bedingung: Lambdasondenheizung vor Kat. aktiv" UWORD B_TRUE 1 100 0 1 BIT_MASK 0x40 FORMAT "%13.11" ECU_ADDRESS 0x383B90 /end MEASUREMENT
/begin MEASUREMENT B_bkhsvsa2 "Bedingung: Lambdasondenheizung vor Kat. aktiv, Bank 2" UWORD B_TRUE 1 100 0 1 BIT_MASK 0x40 FORMAT "%13.11" ECU_ADDRESS 0x383B92 /end MEASUREMENT
/begin MEASUREMENT B_bkkat "Bedingung Ersatzwert für Katalysator" UWORD B_TRUE 1 100 0 1 BIT_MASK 0x40 FORMAT "%13.11" ECU_ADDRESS 0x383B94 /end MEASUREMENT
/begin MEASUREMENT B_bkkpe "Bedingung Ersatzwert für  EKP-Relais Endstufe" UWORD B_TRUE 1 100 0 1 BIT_MASK 0x40 FORMAT "%13.11" ECU_ADDRESS 0x383B96 /end MEASUREMENT
/begin MEASUREMENT B_bkkrnt "Bedingung: Klopfregelung Nulltest aktiv" UWORD B_TRUE 1 100 0 1 BIT_MASK 0x40 FORMAT "%13.11" ECU_ADDRESS 0x383BA0 /end MEASUREMENT
/begin MEASUREMENT B_bkkrof "Bedingung: Klopfregelung Offset aktiv" UWORD B_TRUE 1 100 0 1 BIT_MASK 0x40 FORMAT "%13.11" ECU_ADDRESS 0x383BA2 /end MEASUREMENT
/begin MEASUREMENT B_bkkrtp "Bedingung: Klopfregelung Testimpuls aktiv" UWORD B_TRUE 1 100 0 1 BIT_MASK 0x40 FORMAT "%13.11" ECU_ADDRESS 0x383BA4 /end MEASUREMENT
/begin MEASUREMENT B_bkks1 "Bedingung: Klopfsensor 1 aktiv" UWORD B_TRUE 1 100 0 1 BIT_MASK 0x40 FORMAT "%13.11" ECU_ADDRESS 0x383BA6 /end MEASUREMENT
/begin MEASUREMENT B_bkks2 "Bedingung: Klopfsensor 2 aktiv" UWORD B_TRUE 1 100 0 1 BIT_MASK 0x40 FORMAT "%13.11" ECU_ADDRESS 0x383BA8 /end MEASUREMENT
/begin MEASUREMENT B_bkks3 "Bedingung: Klopfsensor 3 aktiv" UWORD B_TRUE 1 100 0 1 BIT_MASK 0x40 FORMAT "%13.11" ECU_ADDRESS 0x383BAA /end MEASUREMENT
/begin MEASUREMENT B_bkks4 "Bedingung: Klopfsensor 4 aktiv" UWORD B_TRUE 1 100 0 1 BIT_MASK 0x40 FORMAT "%13.11" ECU_ADDRESS 0x383BAC /end MEASUREMENT
/begin MEASUREMENT B_bkkuppl "Ersatzwert aktiv" UWORD B_TRUE 1 100 0 1 BIT_MASK 0x40 FORMAT "%13.11" ECU_ADDRESS 0x383BAE /end MEASUREMENT
/begin MEASUREMENT B_bklde "Bedingung: Ladedrucksteuerventil Endstufe aktiv" UWORD B_TRUE 1 100 0 1 BIT_MASK 0x40 FORMAT "%13.11" ECU_ADDRESS 0x383BB2 /end MEASUREMENT
/begin MEASUREMENT B_bklue1 "Bedingung: Ersatzwert atkiv Lüftersteuerung 1" UWORD B_TRUE 1 100 0 1 BIT_MASK 0x40 FORMAT "%13.11" ECU_ADDRESS 0x383BC8 /end MEASUREMENT
/begin MEASUREMENT B_bklues1e "Bedingung Ersatzwert aktiv: Lüftersteuerung 1" UWORD B_TRUE 1 100 0 1 BIT_MASK 0x40 FORMAT "%13.11" ECU_ADDRESS 0x383BCA /end MEASUREMENT
/begin MEASUREMENT B_bkmile "Bedingung: MIL-Endstufe aktiv" UWORD B_TRUE 1 100 0 1 BIT_MASK 0x40 FORMAT "%13.11" ECU_ADDRESS 0x383BDA /end MEASUREMENT
/begin MEASUREMENT B_bknwse "Bedingung: Nockenwellensteuerung Endstufe aktiv" UWORD B_TRUE 1 100 0 1 BIT_MASK 0x40 FORMAT "%13.11" ECU_ADDRESS 0x383BE0 /end MEASUREMENT
/begin MEASUREMENT B_bkrkat "Ersatzwert für RKAT aktiv" UWORD B_TRUE 1 100 0 1 BIT_MASK 0x40 FORMAT "%13.11" ECU_ADDRESS 0x383BE8 /end MEASUREMENT
/begin MEASUREMENT B_bkrkaz "Ersatzwert für RKAZ aktiv" UWORD B_TRUE 1 100 0 1 BIT_MASK 0x40 FORMAT "%13.11" ECU_ADDRESS 0x383BEA /end MEASUREMENT
/begin MEASUREMENT B_bkslpe "Bedingung: Sekundärluftpumpe ( Endstufe) aktiv" UWORD B_TRUE 1 100 0 1 BIT_MASK 0x40 FORMAT "%13.11" ECU_ADDRESS 0x383BF2 /end MEASUREMENT
/begin MEASUREMENT B_bkslve "Bedingung: Sekundärluftventil Endstufe" UWORD B_TRUE 1 100 0 1 BIT_MASK 0x40 FORMAT "%13.11" ECU_ADDRESS 0x383BF8 /end MEASUREMENT
/begin MEASUREMENT B_bkteve "Bedingung: Tankentlüftungsventil Endstufe aktiv" UWORD B_TRUE 1 100 0 1 BIT_MASK 0x40 FORMAT "%13.11" ECU_ADDRESS 0x383C08 /end MEASUREMENT
/begin MEASUREMENT B_bkuvse "Bedingung: Endstufe Umluftventil Turbo aktiv" UWORD B_TRUE 1 100 0 1 BIT_MASK 0x40 FORMAT "%13.11" ECU_ADDRESS 0x383C26 /end MEASUREMENT
/begin MEASUREMENT B_bkzet1 "Zündkreisfehler" UWORD B_TRUE 1 100 0 1 BIT_MASK 0x40 FORMAT "%13.11" ECU_ADDRESS 0x383C2E /end MEASUREMENT
/begin MEASUREMENT B_bkzet2 "" UWORD B_TRUE 1 100 0 1 BIT_MASK 0x40 FORMAT "%13.11" ECU_ADDRESS 0x383C30 /end MEASUREMENT
/begin MEASUREMENT B_bkzet3 "" UWORD B_TRUE 1 100 0 1 BIT_MASK 0x40 FORMAT "%13.11" ECU_ADDRESS 0x383C32 /end MEASUREMENT
/begin MEASUREMENT B_bkzet4 "" UWORD B_TRUE 1 100 0 1 BIT_MASK 0x40 FORMAT "%13.11" ECU_ADDRESS 0x383C34 /end MEASUREMENT
/begin MEASUREMENT B_clagre "Bedingung Fehlerpfad AGR-Endstufe löschen" UWORD B_TRUE 1 100 0 1 BIT_MASK 0x80 FORMAT "%13.11" ECU_ADDRESS 0x383B0A /end MEASUREMENT
/begin MEASUREMENT B_clbkvpe "Bedingung Fehlerpfad Bremskraftverstärker-Pumpe-Endstufe löschen" UWORD B_TRUE 1 100 0 1 BIT_MASK 0x80 FORMAT "%13.11" ECU_ADDRESS 0x383B1C /end MEASUREMENT
/begin MEASUREMENT B_cldk "Bedingung Fehlerpfad DK (Drosselklappen-Poti) löschen" UWORD B_TRUE 1 100 0 1 BIT_MASK 0x80 FORMAT "%13.11" ECU_ADDRESS 0x383B38 /end MEASUREMENT
/begin MEASUREMENT B_cldk1p "Bedingung Fehlerpfad DK1P (Drosselklappen-Poti 1) löschen" UWORD B_TRUE 1 100 0 1 BIT_MASK 0x80 FORMAT "%13.11" ECU_ADDRESS 0x383B3A /end MEASUREMENT
/begin MEASUREMENT B_cldk2p "Bedingung Fehlerpfad DK2P (Drosselklappen-Poti 2) löschen" UWORD B_TRUE 1 100 0 1 BIT_MASK 0x80 FORMAT "%13.11" ECU_ADDRESS 0x383B3C /end MEASUREMENT
/begin MEASUREMENT B_cldvee "Flag für Löschmaßnahmen: DV-E Endstufe" UWORD B_TRUE 1 100 0 1 BIT_MASK 0x80 FORMAT "%13.11" ECU_ADDRESS 0x383B4A /end MEASUREMENT
/begin MEASUREMENT B_cldvef "Flag für Löschung: DV-E Fehler bei Federprüfung" UWORD B_TRUE 1 100 0 1 BIT_MASK 0x80 FORMAT "%13.11" ECU_ADDRESS 0x383B4C /end MEASUREMENT
/begin MEASUREMENT B_cldvefo "Flag für Löschung: Fehler bei Federprüfung ""Öffnen""" UWORD B_TRUE 1 100 0 1 BIT_MASK 0x80 FORMAT "%13.11" ECU_ADDRESS 0x383B4E /end MEASUREMENT
/begin MEASUREMENT B_cldvel "Flag für Löschmaßnahmen: DV-E Lageabweichung" UWORD B_TRUE 1 100 0 1 BIT_MASK 0x80 FORMAT "%13.11" ECU_ADDRESS 0x383B50 /end MEASUREMENT
/begin MEASUREMENT B_cldven "Flag für Löschung: DV-E Fehler bei Prüfung Notluftposition" UWORD B_TRUE 1 100 0 1 BIT_MASK 0x80 FORMAT "%13.11" ECU_ADDRESS 0x383B52 /end MEASUREMENT
/begin MEASUREMENT B_cldver "Flag für Löschmaßnahmen: DV-E Regelabweichung" UWORD B_TRUE 1 100 0 1 BIT_MASK 0x80 FORMAT "%13.11" ECU_ADDRESS 0x383B54 /end MEASUREMENT
/begin MEASUREMENT B_cldvet "Flag für Löschung: DV-E-Tauscherkennung ohne Adaption" UWORD B_TRUE 1 100 0 1 BIT_MASK 0x80 FORMAT "%13.11" ECU_ADDRESS 0x383B56 /end MEASUREMENT
/begin MEASUREMENT B_cldveu "Flag für Löschung: DV-E Fehler beim UMA-Lernen" UWORD B_TRUE 1 100 0 1 BIT_MASK 0x80 FORMAT "%13.11" ECU_ADDRESS 0x383B58 /end MEASUREMENT
/begin MEASUREMENT B_cldveub "Flag für Löschung: DV-E-Adaption Abbruch wg. Umweltbedingung" UWORD B_TRUE 1 100 0 1 BIT_MASK 0x80 FORMAT "%13.11" ECU_ADDRESS 0x383B5A /end MEASUREMENT
/begin MEASUREMENT B_cldveuw "Flag für Löschung: Fehler bei UMA-Wiederlernen" UWORD B_TRUE 1 100 0 1 BIT_MASK 0x80 FORMAT "%13.11" ECU_ADDRESS 0x383B5C /end MEASUREMENT
/begin MEASUREMENT B_cldvev "Flag für Löschung: DV-E Fehler bei Verstärkerabgleich" UWORD B_TRUE 1 100 0 1 BIT_MASK 0x80 FORMAT "%13.11" ECU_ADDRESS 0x383B5E /end MEASUREMENT
/begin MEASUREMENT B_clegfe "Bedingung Fehlerpfad EGFE löschen" UWORD B_TRUE 1 100 0 1 BIT_MASK 0x80 FORMAT "%13.11" ECU_ADDRESS 0x383B60 /end MEASUREMENT
/begin MEASUREMENT B_clenws "Bedingung Fehlerpfad Nockenwellensteuerung (Einlaß,Bank1) löschen" UWORD B_TRUE 1 100 0 1 BIT_MASK 0x80 FORMAT "%13.11" ECU_ADDRESS 0x383B62 /end MEASUREMENT
/begin MEASUREMENT B_clenwse "Bedingung Fehlerpfad Nockenwellensteuerung Endstufe löschen (Bank1,Einlaß)" UWORD B_TRUE 1 100 0 1 BIT_MASK 0x80 FORMAT "%13.11" ECU_ADDRESS 0x383B64 /end MEASUREMENT
/begin MEASUREMENT B_clepcle "Bedingung Fehlerpfad EPCL-Endstufe löschen" UWORD B_TRUE 1 100 0 1 BIT_MASK 0x80 FORMAT "%13.11" ECU_ADDRESS 0x383B66 /end MEASUREMENT
/begin MEASUREMENT B_cletre "Bedingung: Fehlerpfad Endstufe el. Thermostat löschen" UWORD B_TRUE 1 100 0 1 BIT_MASK 0x80 FORMAT "%13.11" ECU_ADDRESS 0x383B68 /end MEASUREMENT
/begin MEASUREMENT B_clev1 "Bedingung Fehlerpfad EV 1 löschen" UWORD B_TRUE 1 100 0 1 BIT_MASK 0x80 FORMAT "%13.11" ECU_ADDRESS 0x383B6A /end MEASUREMENT
/begin MEASUREMENT B_clev2 "Bedingung Fehlerpfad EV 2 löschen" UWORD B_TRUE 1 100 0 1 BIT_MASK 0x80 FORMAT "%13.11" ECU_ADDRESS 0x383B6C /end MEASUREMENT
/begin MEASUREMENT B_clev3 "Bedingung Fehlerpfad EV 3 löschen" UWORD B_TRUE 1 100 0 1 BIT_MASK 0x80 FORMAT "%13.11" ECU_ADDRESS 0x383B6E /end MEASUREMENT
/begin MEASUREMENT B_clev4 "Bedingung Fehlerpfad EV 4 löschen" UWORD B_TRUE 1 100 0 1 BIT_MASK 0x80 FORMAT "%13.11" ECU_ADDRESS 0x383B70 /end MEASUREMENT
/begin MEASUREMENT B_clfrao "Bedingung Fehlerpfad FRAO löschen (obere Multipl. Bereich)" UWORD B_TRUE 1 100 0 1 BIT_MASK 0x80 FORMAT "%13.11" ECU_ADDRESS 0x383B78 /end MEASUREMENT
/begin MEASUREMENT B_clfrau "Bedingung Fehlerpfad FRAU löschen (untere Multipl. Bereich)" UWORD B_TRUE 1 100 0 1 BIT_MASK 0x80 FORMAT "%13.11" ECU_ADDRESS 0x383B7A /end MEASUREMENT
/begin MEASUREMENT B_clfrst "Bedingung Fehlerpfad FRST löschen (Kurztest)" UWORD B_TRUE 1 100 0 1 BIT_MASK 0x80 FORMAT "%13.11" ECU_ADDRESS 0x383B7C /end MEASUREMENT
/begin MEASUREMENT B_clhsh "Bedingung Fehlerpfad DHLSHK löschen" UWORD B_TRUE 1 100 0 1 BIT_MASK 0x80 FORMAT "%13.11" ECU_ADDRESS 0x383B86 /end MEASUREMENT
/begin MEASUREMENT B_clhsh2 "Bedingung Fehlerpfad DHLSHK2 löschen" UWORD B_TRUE 1 100 0 1 BIT_MASK 0x80 FORMAT "%13.11" ECU_ADDRESS 0x383B88 /end MEASUREMENT
/begin MEASUREMENT B_clhshe "Bedingung Fehlerpfad DHLSHK löschen (Endstufe)" UWORD B_TRUE 1 100 0 1 BIT_MASK 0x80 FORMAT "%13.11" ECU_ADDRESS 0x383B8A /end MEASUREMENT
/begin MEASUREMENT B_clhsv "Bedingung Fehlerpfad DHLSVK löschen" UWORD B_TRUE 1 100 0 1 BIT_MASK 0x80 FORMAT "%13.11" ECU_ADDRESS 0x383B8C /end MEASUREMENT
/begin MEASUREMENT B_clhsv2 "Bedingung Fehlerpfad DHLSVK2 löschen" UWORD B_TRUE 1 100 0 1 BIT_MASK 0x80 FORMAT "%13.11" ECU_ADDRESS 0x383B8E /end MEASUREMENT
/begin MEASUREMENT B_clhsvsa "Bedingung Fehlerpfad DHLSUSA löschen" UWORD B_TRUE 1 100 0 1 BIT_MASK 0x80 FORMAT "%13.11" ECU_ADDRESS 0x383B90 /end MEASUREMENT
/begin MEASUREMENT B_clhsvsa2 "Bedingung Fehlerpfad DHLSUSA2 löschen" UWORD B_TRUE 1 100 0 1 BIT_MASK 0x80 FORMAT "%13.11" ECU_ADDRESS 0x383B92 /end MEASUREMENT
/begin MEASUREMENT B_clkat "Bedingung Fehlerpfad der Katalysatordiagnose löschen" UWORD B_TRUE 1 100 0 1 BIT_MASK 0x80 FORMAT "%13.11" ECU_ADDRESS 0x383B94 /end MEASUREMENT
/begin MEASUREMENT B_clkpe "Bedingung Fehlerpfad EKP-Relais Endstufe löschen" UWORD B_TRUE 1 100 0 1 BIT_MASK 0x80 FORMAT "%13.11" ECU_ADDRESS 0x383B96 /end MEASUREMENT
/begin MEASUREMENT B_clkra01 "Bedingung Fehlerpfad Klopfregelanschlag Zylinder 1 löschen" UWORD B_TRUE 1 100 0 1 BIT_MASK 0x80 FORMAT "%13.11" ECU_ADDRESS 0x383B98 /end MEASUREMENT
/begin MEASUREMENT B_clkra02 "Bedingung Fehlerpfad Klopfregelanschlag Zylinder 2 löschen" UWORD B_TRUE 1 100 0 1 BIT_MASK 0x80 FORMAT "%13.11" ECU_ADDRESS 0x383B9A /end MEASUREMENT
/begin MEASUREMENT B_clkra03 "Bedingung Fehlerpfad Klopfregelanschlag Zylinder 3 löschen" UWORD B_TRUE 1 100 0 1 BIT_MASK 0x80 FORMAT "%13.11" ECU_ADDRESS 0x383B9C /end MEASUREMENT
/begin MEASUREMENT B_clkra04 "Bedingung Fehlerpfad Klopfregelanschlag Zylinder 4 löschen" UWORD B_TRUE 1 100 0 1 BIT_MASK 0x80 FORMAT "%13.11" ECU_ADDRESS 0x383B9E /end MEASUREMENT
/begin MEASUREMENT B_clkrnt "Bedingung Fehlerpfad KR-Diagnose Integratorsteigung löschen" UWORD B_TRUE 1 100 0 1 BIT_MASK 0x80 FORMAT "%13.11" ECU_ADDRESS 0x383BA0 /end MEASUREMENT
/begin MEASUREMENT B_clkrof "Bedingung Fehlerpfad KR-Diagnose Resetwert löschen" UWORD B_TRUE 1 100 0 1 BIT_MASK 0x80 FORMAT "%13.11" ECU_ADDRESS 0x383BA2 /end MEASUREMENT
/begin MEASUREMENT B_clkrtp "Bedingung Fehlerpfad KR-Diagnose Testimpuls löschen" UWORD B_TRUE 1 100 0 1 BIT_MASK 0x80 FORMAT "%13.11" ECU_ADDRESS 0x383BA4 /end MEASUREMENT
/begin MEASUREMENT B_clks1 "Bedingung: Fehlerpfad löschen, Klopfsensor 1" UWORD B_TRUE 1 100 0 1 BIT_MASK 0x80 FORMAT "%13.11" ECU_ADDRESS 0x383BA6 /end MEASUREMENT
/begin MEASUREMENT B_clks2 "Bedingung: Fehlerpfad löschen, Klopfsensor 2" UWORD B_TRUE 1 100 0 1 BIT_MASK 0x80 FORMAT "%13.11" ECU_ADDRESS 0x383BA8 /end MEASUREMENT
/begin MEASUREMENT B_clks3 "Bedingung: Fehlerpfad löschen, Klopfsensor 3" UWORD B_TRUE 1 100 0 1 BIT_MASK 0x80 FORMAT "%13.11" ECU_ADDRESS 0x383BAA /end MEASUREMENT
/begin MEASUREMENT B_clks4 "Bedingung: Fehlerpfad löschen, Klopfsensor 4" UWORD B_TRUE 1 100 0 1 BIT_MASK 0x80 FORMAT "%13.11" ECU_ADDRESS 0x383BAC /end MEASUREMENT
/begin MEASUREMENT B_clkuppl "Bedingung: Fehlerpfad KUPPL (Gebergröße Kupplung) löschen" UWORD B_TRUE 1 100 0 1 BIT_MASK 0x80 FORMAT "%13.11" ECU_ADDRESS 0x383BAE /end MEASUREMENT
/begin MEASUREMENT B_cllde "Bedingung Fehlerpfad LDE löschen" UWORD B_TRUE 1 100 0 1 BIT_MASK 0x80 FORMAT "%13.11" ECU_ADDRESS 0x383BB2 /end MEASUREMENT
/begin MEASUREMENT B_cllue1 "Bedingung: Fehlerpfad Lüftereinheit 1 löschen" UWORD B_TRUE 1 100 0 1 BIT_MASK 0x80 FORMAT "%13.11" ECU_ADDRESS 0x383BC8 /end MEASUREMENT
/begin MEASUREMENT B_cllues1e "Bedingung: Fehlerpfad Endstufe Lüftersteuerung 1 löschen" UWORD B_TRUE 1 100 0 1 BIT_MASK 0x80 FORMAT "%13.11" ECU_ADDRESS 0x383BCA /end MEASUREMENT
/begin MEASUREMENT B_clmile "Bedingung Fehlerpfad MIL-Endstufe löschen" UWORD B_TRUE 1 100 0 1 BIT_MASK 0x80 FORMAT "%13.11" ECU_ADDRESS 0x383BDA /end MEASUREMENT
/begin MEASUREMENT B_clnwse "Bedingung Fehlerpfad Nockenwellensteuerung Endstufe löschen" UWORD B_TRUE 1 100 0 1 BIT_MASK 0x80 FORMAT "%13.11" ECU_ADDRESS 0x383BE0 /end MEASUREMENT
/begin MEASUREMENT B_clrkat "Bedingung Fehlerpfad RKAT löschen (add. pro Zeit)" UWORD B_TRUE 1 100 0 1 BIT_MASK 0x80 FORMAT "%13.11" ECU_ADDRESS 0x383BE8 /end MEASUREMENT
/begin MEASUREMENT B_clrkaz "Bedingung Fehlerpfad RKAZ löschen (add. pro Zündung)" UWORD B_TRUE 1 100 0 1 BIT_MASK 0x80 FORMAT "%13.11" ECU_ADDRESS 0x383BEA /end MEASUREMENT
/begin MEASUREMENT B_clslpe "Bedingung: Fehlerpfad Endstufe Sekundärluftpumpe löschen" UWORD B_TRUE 1 100 0 1 BIT_MASK 0x80 FORMAT "%13.11" ECU_ADDRESS 0x383BF2 /end MEASUREMENT
/begin MEASUREMENT B_clslve "Bedingung: Fehlerpfad Endstufe Sekundärluftventil löschen" UWORD B_TRUE 1 100 0 1 BIT_MASK 0x80 FORMAT "%13.11" ECU_ADDRESS 0x383BF8 /end MEASUREMENT
/begin MEASUREMENT B_clteve "Bedingung Fehlerphad TEVE löschen" UWORD B_TRUE 1 100 0 1 BIT_MASK 0x80 FORMAT "%13.11" ECU_ADDRESS 0x383C08 /end MEASUREMENT
/begin MEASUREMENT B_cluvse "Bedingung Fehlerpfad UVSE löschen" UWORD B_TRUE 1 100 0 1 BIT_MASK 0x80 FORMAT "%13.11" ECU_ADDRESS 0x383C26 /end MEASUREMENT
/begin MEASUREMENT B_clzet1 "Bedingung Fehlerpfad Zündendstufentreiber löschen" UWORD B_TRUE 1 100 0 1 BIT_MASK 0x80 FORMAT "%13.11" ECU_ADDRESS 0x383C2E /end MEASUREMENT
/begin MEASUREMENT B_clzet2 "Bedingung Fehlerpfad Zündendstufentreiber löschen" UWORD B_TRUE 1 100 0 1 BIT_MASK 0x80 FORMAT "%13.11" ECU_ADDRESS 0x383C30 /end MEASUREMENT
/begin MEASUREMENT B_clzet3 "Bedingung Fehlerpfad Zündendstufentreiber löschen" UWORD B_TRUE 1 100 0 1 BIT_MASK 0x80 FORMAT "%13.11" ECU_ADDRESS 0x383C32 /end MEASUREMENT
/begin MEASUREMENT B_clzet4 "Bedingung Fehlerpfad Zündendstufentreiber löschen" UWORD B_TRUE 1 100 0 1 BIT_MASK 0x80 FORMAT "%13.11" ECU_ADDRESS 0x383C34 /end MEASUREMENT
/begin MEASUREMENT B_fahsh "Bedingung Funktionsanforderung Diagnose Heizung Hinterkat-Lambdasonde" UWORD B_TRUE 1 100 0 1 BIT_MASK 0x10 FORMAT "%13.11" ECU_ADDRESS 0x383B86 /end MEASUREMENT
/begin MEASUREMENT B_fahsh2 "" UWORD B_TRUE 1 100 0 1 BIT_MASK 0x10 FORMAT "%13.11" ECU_ADDRESS 0x383B88 /end MEASUREMENT
/begin MEASUREMENT B_ftagre "Bedingung: Fehlereintrag durch Tester" UWORD B_TRUE 1 100 0 1 BIT_MASK 0x10 FORMAT "%13.11" ECU_ADDRESS 0x383B0A /end MEASUREMENT
/begin MEASUREMENT B_ftbkvpe "Bedingung: Fehlereintrag durch Tester für BKV-Pumpe-Endstufe" UWORD B_TRUE 1 100 0 1 BIT_MASK 0x10 FORMAT "%13.11" ECU_ADDRESS 0x383B1C /end MEASUREMENT
/begin MEASUREMENT B_ftdk "Condition fault entry by tester for DK" UWORD B_TRUE 1 100 0 1 BIT_MASK 0x10 FORMAT "%13.11" ECU_ADDRESS 0x383B38 /end MEASUREMENT
/begin MEASUREMENT B_ftdk1p "Nicht benutzt" UWORD B_TRUE 1 100 0 1 BIT_MASK 0x10 FORMAT "%13.11" ECU_ADDRESS 0x383B3A /end MEASUREMENT
/begin MEASUREMENT B_ftdk2p "Nicht benutzt" UWORD B_TRUE 1 100 0 1 BIT_MASK 0x10 FORMAT "%13.11" ECU_ADDRESS 0x383B3C /end MEASUREMENT
/begin MEASUREMENT B_ftdvee "Nicht benutzt" UWORD B_TRUE 1 100 0 1 BIT_MASK 0x10 FORMAT "%13.11" ECU_ADDRESS 0x383B4A /end MEASUREMENT
/begin MEASUREMENT B_ftdvef "Nicht benutzt" UWORD B_TRUE 1 100 0 1 BIT_MASK 0x10 FORMAT "%13.11" ECU_ADDRESS 0x383B4C /end MEASUREMENT
/begin MEASUREMENT B_ftdvefo "Nicht benutzt" UWORD B_TRUE 1 100 0 1 BIT_MASK 0x10 FORMAT "%13.11" ECU_ADDRESS 0x383B4E /end MEASUREMENT
/begin MEASUREMENT B_ftdvel "Nicht benutzt" UWORD B_TRUE 1 100 0 1 BIT_MASK 0x10 FORMAT "%13.11" ECU_ADDRESS 0x383B50 /end MEASUREMENT
/begin MEASUREMENT B_ftdven "Nicht benutzt" UWORD B_TRUE 1 100 0 1 BIT_MASK 0x10 FORMAT "%13.11" ECU_ADDRESS 0x383B52 /end MEASUREMENT
/begin MEASUREMENT B_ftdver "Nicht benutzt" UWORD B_TRUE 1 100 0 1 BIT_MASK 0x10 FORMAT "%13.11" ECU_ADDRESS 0x383B54 /end MEASUREMENT
/begin MEASUREMENT B_ftdvet "Nicht benutzt" UWORD B_TRUE 1 100 0 1 BIT_MASK 0x10 FORMAT "%13.11" ECU_ADDRESS 0x383B56 /end MEASUREMENT
/begin MEASUREMENT B_ftdveu "Nicht benutzt" UWORD B_TRUE 1 100 0 1 BIT_MASK 0x10 FORMAT "%13.11" ECU_ADDRESS 0x383B58 /end MEASUREMENT
/begin MEASUREMENT B_ftdveub "Nicht benutzt" UWORD B_TRUE 1 100 0 1 BIT_MASK 0x10 FORMAT "%13.11" ECU_ADDRESS 0x383B5A /end MEASUREMENT
/begin MEASUREMENT B_ftdveuw "Nicht benutzt" UWORD B_TRUE 1 100 0 1 BIT_MASK 0x10 FORMAT "%13.11" ECU_ADDRESS 0x383B5C /end MEASUREMENT
/begin MEASUREMENT B_ftdvev "Nicht benutzt" UWORD B_TRUE 1 100 0 1 BIT_MASK 0x10 FORMAT "%13.11" ECU_ADDRESS 0x383B5E /end MEASUREMENT
/begin MEASUREMENT B_ftegfe "Bedingung: Fehlereintrag durch Tester für DEGFE" UWORD B_TRUE 1 100 0 1 BIT_MASK 0x10 FORMAT "%13.11" ECU_ADDRESS 0x383B60 /end MEASUREMENT
/begin MEASUREMENT B_ftenws "Bedingung: Fehlereintrag durch Tester für NWS (Einlaß, Bank1)" UWORD B_TRUE 1 100 0 1 BIT_MASK 0x10 FORMAT "%13.11" ECU_ADDRESS 0x383B62 /end MEASUREMENT
/begin MEASUREMENT B_ftenwse "Bedingung: Fehlereintrag durch Tester für NWS Endstufe (Einlaß, Bank1)" UWORD B_TRUE 1 100 0 1 BIT_MASK 0x10 FORMAT "%13.11" ECU_ADDRESS 0x383B64 /end MEASUREMENT
/begin MEASUREMENT B_ftepcle "" UWORD B_TRUE 1 100 0 1 BIT_MASK 0x10 FORMAT "%13.11" ECU_ADDRESS 0x383B66 /end MEASUREMENT
/begin MEASUREMENT B_ftetre "Bedingung Fehlereintrag durch Tester Elektro Thermostat Regelung Endstufe" UWORD B_TRUE 1 100 0 1 BIT_MASK 0x10 FORMAT "%13.11" ECU_ADDRESS 0x383B68 /end MEASUREMENT
/begin MEASUREMENT B_ftev1 "Bedingung: Fehlereintrag durch Tester für Endstufendiagnose EV1" UWORD B_TRUE 1 100 0 1 BIT_MASK 0x10 FORMAT "%13.11" ECU_ADDRESS 0x383B6A /end MEASUREMENT
/begin MEASUREMENT B_ftev2 "Bedingung: Fehlereintrag durch Tester für Endstufendiagnose EV2" UWORD B_TRUE 1 100 0 1 BIT_MASK 0x10 FORMAT "%13.11" ECU_ADDRESS 0x383B6C /end MEASUREMENT
/begin MEASUREMENT B_ftev3 "Bedingung: Fehlereintrag durch Tester für Endstufendiagnose EV3" UWORD B_TRUE 1 100 0 1 BIT_MASK 0x10 FORMAT "%13.11" ECU_ADDRESS 0x383B6E /end MEASUREMENT
/begin MEASUREMENT B_ftev4 "Bedingung: Fehlereintrag durch Tester für Endstufendiagnose EV4" UWORD B_TRUE 1 100 0 1 BIT_MASK 0x10 FORMAT "%13.11" ECU_ADDRESS 0x383B70 /end MEASUREMENT
/begin MEASUREMENT B_ftfrao "Bedingung Fehlereintrag durch Tester für FRAO" UWORD B_TRUE 1 100 0 1 BIT_MASK 0x10 FORMAT "%13.11" ECU_ADDRESS 0x383B78 /end MEASUREMENT
/begin MEASUREMENT B_ftfrau "Bedingung Fehlereintrag durch Tester für FRAU" UWORD B_TRUE 1 100 0 1 BIT_MASK 0x10 FORMAT "%13.11" ECU_ADDRESS 0x383B7A /end MEASUREMENT
/begin MEASUREMENT B_ftfrst "Bedingung Fehlereintrag durch Tester für FRST (FR-Kurztest)" UWORD B_TRUE 1 100 0 1 BIT_MASK 0x10 FORMAT "%13.11" ECU_ADDRESS 0x383B7C /end MEASUREMENT
/begin MEASUREMENT B_fthshe "Bedingung Fehlereintrag durch Tester für Endstufe LS-Heizung hinter Kat" UWORD B_TRUE 1 100 0 1 BIT_MASK 0x10 FORMAT "%13.11" ECU_ADDRESS 0x383B8A /end MEASUREMENT
/begin MEASUREMENT B_fthsv "Bedingung Fehlereintrag durch Tester für LSU-Heizung" UWORD B_TRUE 1 100 0 1 BIT_MASK 0x10 FORMAT "%13.11" ECU_ADDRESS 0x383B8C /end MEASUREMENT
/begin MEASUREMENT B_fthsv2 "Bedingung Fehlereintrag durch Tester für LSU-Heizung, Bank 2" UWORD B_TRUE 1 100 0 1 BIT_MASK 0x10 FORMAT "%13.11" ECU_ADDRESS 0x383B8E /end MEASUREMENT
/begin MEASUREMENT B_fthsvsa "Bedingung Fehlereintrag durch Tester für LSU-Heizung" UWORD B_TRUE 1 100 0 1 BIT_MASK 0x10 FORMAT "%13.11" ECU_ADDRESS 0x383B90 /end MEASUREMENT
/begin MEASUREMENT B_fthsvsa2 "Bedingung Fehlereintrag durch Tester für LSU-Heizung, Bank 2" UWORD B_TRUE 1 100 0 1 BIT_MASK 0x10 FORMAT "%13.11" ECU_ADDRESS 0x383B92 /end MEASUREMENT
/begin MEASUREMENT B_ftkat "Bedingung Fehlereintrag durch Tester für Katalysator" UWORD B_TRUE 1 100 0 1 BIT_MASK 0x10 FORMAT "%13.11" ECU_ADDRESS 0x383B94 /end MEASUREMENT
/begin MEASUREMENT B_ftkpe "Bedingung: Fehlereintrag durch Tester für Endstufendiagnose EKP" UWORD B_TRUE 1 100 0 1 BIT_MASK 0x10 FORMAT "%13.11" ECU_ADDRESS 0x383B96 /end MEASUREMENT
/begin MEASUREMENT B_ftkrnt "" UWORD B_TRUE 1 100 0 1 BIT_MASK 0x10 FORMAT "%13.11" ECU_ADDRESS 0x383BA0 /end MEASUREMENT
/begin MEASUREMENT B_ftkrof "" UWORD B_TRUE 1 100 0 1 BIT_MASK 0x10 FORMAT "%13.11" ECU_ADDRESS 0x383BA2 /end MEASUREMENT
/begin MEASUREMENT B_ftkrtp "" UWORD B_TRUE 1 100 0 1 BIT_MASK 0x10 FORMAT "%13.11" ECU_ADDRESS 0x383BA4 /end MEASUREMENT
/begin MEASUREMENT B_ftks1 "Bedingung:Fehlereintrag durch Tester, Klopfsensor 1" UWORD B_TRUE 1 100 0 1 BIT_MASK 0x10 FORMAT "%13.11" ECU_ADDRESS 0x383BA6 /end MEASUREMENT
/begin MEASUREMENT B_ftks2 "Bedingung:Fehlereintrag durch Tester, Klopfsensor 2" UWORD B_TRUE 1 100 0 1 BIT_MASK 0x10 FORMAT "%13.11" ECU_ADDRESS 0x383BA8 /end MEASUREMENT
/begin MEASUREMENT B_ftks3 "Bedingung:Fehlereintrag durch Tester, Klopfsensor 3" UWORD B_TRUE 1 100 0 1 BIT_MASK 0x10 FORMAT "%13.11" ECU_ADDRESS 0x383BAA /end MEASUREMENT
/begin MEASUREMENT B_ftks4 "Bedingung:Fehlereintrag durch Tester, Klopfsensor 4" UWORD B_TRUE 1 100 0 1 BIT_MASK 0x10 FORMAT "%13.11" ECU_ADDRESS 0x383BAC /end MEASUREMENT
/begin MEASUREMENT B_ftkuppl "Bedingung: Fehlereintrag durch Tester für Kupplungssensor" UWORD B_TRUE 1 100 0 1 BIT_MASK 0x10 FORMAT "%13.11" ECU_ADDRESS 0x383BAE /end MEASUREMENT
/begin MEASUREMENT B_ftlde "Bedingung: Fehlereintrag durch Ladedrucksteuerventil (Tester)" UWORD B_TRUE 1 100 0 1 BIT_MASK 0x10 FORMAT "%13.11" ECU_ADDRESS 0x383BB2 /end MEASUREMENT
/begin MEASUREMENT B_ftlue1 "Bedingung: Fehlereintrag durch Tester" UWORD B_TRUE 1 100 0 1 BIT_MASK 0x10 FORMAT "%13.11" ECU_ADDRESS 0x383BC8 /end MEASUREMENT
/begin MEASUREMENT B_ftlues1e "Bedingung: Fehlereintrag durch Tester" UWORD B_TRUE 1 100 0 1 BIT_MASK 0x10 FORMAT "%13.11" ECU_ADDRESS 0x383BCA /end MEASUREMENT
/begin MEASUREMENT B_ftmile "Bedingung: Fehlereintrag durch Tester für Endstufendiagnose Fehlerlampe" UWORD B_TRUE 1 100 0 1 BIT_MASK 0x10 FORMAT "%13.11" ECU_ADDRESS 0x383BDA /end MEASUREMENT
/begin MEASUREMENT B_ftnwse "Bedingung: Fehlereintrag durch Tester für Endstufe NWS" UWORD B_TRUE 1 100 0 1 BIT_MASK 0x10 FORMAT "%13.11" ECU_ADDRESS 0x383BE0 /end MEASUREMENT
/begin MEASUREMENT B_ftrkat "Bedingung Fehlereintrag durch Tester für RKAT" UWORD B_TRUE 1 100 0 1 BIT_MASK 0x10 FORMAT "%13.11" ECU_ADDRESS 0x383BE8 /end MEASUREMENT
/begin MEASUREMENT B_ftrkaz "Bedingung Fehlereintrag durch Tester für RKAZ" UWORD B_TRUE 1 100 0 1 BIT_MASK 0x10 FORMAT "%13.11" ECU_ADDRESS 0x383BEA /end MEASUREMENT
/begin MEASUREMENT B_ftslpe "Bedingung Fehlereintrag durch Tester Sekundärluftpumpe Endstufe" UWORD B_TRUE 1 100 0 1 BIT_MASK 0x10 FORMAT "%13.11" ECU_ADDRESS 0x383BF2 /end MEASUREMENT
/begin MEASUREMENT B_ftslve "Bedingung Fehlereintrag durch Tester Sekundärluftventil Endstufe" UWORD B_TRUE 1 100 0 1 BIT_MASK 0x10 FORMAT "%13.11" ECU_ADDRESS 0x383BF8 /end MEASUREMENT
/begin MEASUREMENT B_ftteve "Bedingung Fehlereintrag durch Tester Tankentlüftungsventil Endstufe" UWORD B_TRUE 1 100 0 1 BIT_MASK 0x10 FORMAT "%13.11" ECU_ADDRESS 0x383C08 /end MEASUREMENT
/begin MEASUREMENT B_ftuvse "Bedingung: Fehlereintrag durch Umluftventil turbo (Tester)" UWORD B_TRUE 1 100 0 1 BIT_MASK 0x10 FORMAT "%13.11" ECU_ADDRESS 0x383C26 /end MEASUREMENT
/begin MEASUREMENT B_ftzet1 "Zündkreisfehler" UWORD B_TRUE 1 100 0 1 BIT_MASK 0x10 FORMAT "%13.11" ECU_ADDRESS 0x383C2E /end MEASUREMENT
/begin MEASUREMENT B_ftzet2 "" UWORD B_TRUE 1 100 0 1 BIT_MASK 0x10 FORMAT "%13.11" ECU_ADDRESS 0x383C30 /end MEASUREMENT
/begin MEASUREMENT B_ftzet3 "" UWORD B_TRUE 1 100 0 1 BIT_MASK 0x10 FORMAT "%13.11" ECU_ADDRESS 0x383C32 /end MEASUREMENT
/begin MEASUREMENT B_ftzet4 "" UWORD B_TRUE 1 100 0 1 BIT_MASK 0x10 FORMAT "%13.11" ECU_ADDRESS 0x383C34 /end MEASUREMENT
/begin MEASUREMENT B_mnagre "Übertemperatur Endstufe AGR-Ventil" UWORD B_TRUE 1 100 0 1 BIT_MASK 0x200 FORMAT "%13.11" ECU_ADDRESS 0x383B0A /end MEASUREMENT
/begin MEASUREMENT B_mnbkvpe "Fehlerart: Kurzschluß Masse an BKV-Pumpe-Endstufe" UWORD B_TRUE 1 100 0 1 BIT_MASK 0x200 FORMAT "%13.11" ECU_ADDRESS 0x383B1C /end MEASUREMENT
/begin MEASUREMENT B_mndk "Fehlertype: Kurzschluss nach Masse Drosselklappenpoti" UWORD B_TRUE 1 100 0 1 BIT_MASK 0x200 FORMAT "%13.11" ECU_ADDRESS 0x383B38 /end MEASUREMENT
/begin MEASUREMENT B_mndk1p "Fehlertyp min.: Drosselklappe 1. Poti" UWORD B_TRUE 1 100 0 1 BIT_MASK 0x200 FORMAT "%13.11" ECU_ADDRESS 0x383B3A /end MEASUREMENT
/begin MEASUREMENT B_mndk2p "Fehlertyp min.: Drosselklappe 2. Poti" UWORD B_TRUE 1 100 0 1 BIT_MASK 0x200 FORMAT "%13.11" ECU_ADDRESS 0x383B3C /end MEASUREMENT
/begin MEASUREMENT B_mndvee "Fehlertyp min.: DV-E Endstufe" UWORD B_TRUE 1 100 0 1 BIT_MASK 0x200 FORMAT "%13.11" ECU_ADDRESS 0x383B4A /end MEASUREMENT
/begin MEASUREMENT B_mndvef "Fehlertyp min.: DV-E Fehler bei Prüfung der öffnenden Feder" UWORD B_TRUE 1 100 0 1 BIT_MASK 0x200 FORMAT "%13.11" ECU_ADDRESS 0x383B4C /end MEASUREMENT
/begin MEASUREMENT B_mndvefo "Fehlertyp min.: Fehler bei Federprüfung ""Öffnen""" UWORD B_TRUE 1 100 0 1 BIT_MASK 0x200 FORMAT "%13.11" ECU_ADDRESS 0x383B4E /end MEASUREMENT
/begin MEASUREMENT B_mndvel "Fehlertyp min.: DV-E Lageabweichung" UWORD B_TRUE 1 100 0 1 BIT_MASK 0x200 FORMAT "%13.11" ECU_ADDRESS 0x383B50 /end MEASUREMENT
/begin MEASUREMENT B_mndven "Fehlertyp min.: DV-E Fehler bei Prüfung Notluftposition" UWORD B_TRUE 1 100 0 1 BIT_MASK 0x200 FORMAT "%13.11" ECU_ADDRESS 0x383B52 /end MEASUREMENT
/begin MEASUREMENT B_mndver "Fehlertyp min.: DV-E Regelbereich, kurzfristig überschritten" UWORD B_TRUE 1 100 0 1 BIT_MASK 0x200 FORMAT "%13.11" ECU_ADDRESS 0x383B54 /end MEASUREMENT
/begin MEASUREMENT B_mndvet "Nicht benutzt" UWORD B_TRUE 1 100 0 1 BIT_MASK 0x200 FORMAT "%13.11" ECU_ADDRESS 0x383B56 /end MEASUREMENT
/begin MEASUREMENT B_mndveu "Fehlertyp min.: DV-E Fehler beim UMA-Lernen" UWORD B_TRUE 1 100 0 1 BIT_MASK 0x200 FORMAT "%13.11" ECU_ADDRESS 0x383B58 /end MEASUREMENT
/begin MEASUREMENT B_mndveub "Fehlertyp min.: DV-E-Adaption Abbruch wg. Umweltbed/Unterspng" UWORD B_TRUE 1 100 0 1 BIT_MASK 0x200 FORMAT "%13.11" ECU_ADDRESS 0x383B5A /end MEASUREMENT
/begin MEASUREMENT B_mndveuw "Nicht benutzt" UWORD B_TRUE 1 100 0 1 BIT_MASK 0x200 FORMAT "%13.11" ECU_ADDRESS 0x383B5C /end MEASUREMENT
/begin MEASUREMENT B_mndvev "Fehlertyp min.: DV-E Fehler bei Verstärkerabgleich" UWORD B_TRUE 1 100 0 1 BIT_MASK 0x200 FORMAT "%13.11" ECU_ADDRESS 0x383B5E /end MEASUREMENT
/begin MEASUREMENT B_mnegfe "Bedingung: MIN-Fehler Eingangsgrößen Füllungserfassung" UWORD B_TRUE 1 100 0 1 BIT_MASK 0x200 FORMAT "%13.11" ECU_ADDRESS 0x383B60 /end MEASUREMENT
/begin MEASUREMENT B_mnenws "Bed. Nockenwellenverstellung hat Frühposition nicht erreicht (Einlaß,Bank1)" UWORD B_TRUE 1 100 0 1 BIT_MASK 0x200 FORMAT "%13.11" ECU_ADDRESS 0x383B62 /end MEASUREMENT
/begin MEASUREMENT B_mnenwse "Fehlerart: Kurzschluß Masse Nockenwellensteuerungsventil Endstufe" UWORD B_TRUE 1 100 0 1 BIT_MASK 0x200 FORMAT "%13.11" ECU_ADDRESS 0x383B64 /end MEASUREMENT
/begin MEASUREMENT B_mnepcle "Fehlerart: Kurzschluß Masse an EPCL-Endstufe" UWORD B_TRUE 1 100 0 1 BIT_MASK 0x200 FORMAT "%13.11" ECU_ADDRESS 0x383B66 /end MEASUREMENT
/begin MEASUREMENT B_mnetre "Fehlertype: Kurzschluß nach Masse Endstufe el. Thermostat" UWORD B_TRUE 1 100 0 1 BIT_MASK 0x200 FORMAT "%13.11" ECU_ADDRESS 0x383B68 /end MEASUREMENT
/begin MEASUREMENT B_mnev1 "Fehlerart: Kurzschluß Masse an Endstufe EV1" UWORD B_TRUE 1 100 0 1 BIT_MASK 0x200 FORMAT "%13.11" ECU_ADDRESS 0x383B6A /end MEASUREMENT
/begin MEASUREMENT B_mnev2 "Fehlerart: Kurzschluß Masse an Endstufe EV2" UWORD B_TRUE 1 100 0 1 BIT_MASK 0x200 FORMAT "%13.11" ECU_ADDRESS 0x383B6C /end MEASUREMENT
/begin MEASUREMENT B_mnev3 "Fehlerart: Kurzschluß Masse an Endstufe EV3" UWORD B_TRUE 1 100 0 1 BIT_MASK 0x200 FORMAT "%13.11" ECU_ADDRESS 0x383B6E /end MEASUREMENT
/begin MEASUREMENT B_mnev4 "Fehlerart: Kurzschluß Masse an Endstufe EV4" UWORD B_TRUE 1 100 0 1 BIT_MASK 0x200 FORMAT "%13.11" ECU_ADDRESS 0x383B70 /end MEASUREMENT
/begin MEASUREMENT B_mnfrao "Bedingung untere Plausibilitätsschwelle unterschritten (obere Multipl.)" UWORD B_TRUE 1 100 0 1 BIT_MASK 0x200 FORMAT "%13.11" ECU_ADDRESS 0x383B78 /end MEASUREMENT
/begin MEASUREMENT B_mnfrau "Bedingung untere Plausibilitätsschwelle unterschritten (untere Multipl.)" UWORD B_TRUE 1 100 0 1 BIT_MASK 0x200 FORMAT "%13.11" ECU_ADDRESS 0x383B7A /end MEASUREMENT
/begin MEASUREMENT B_mnfrst "Bedingung untere Plausibilitätsschwelle unterschritten(short test)" UWORD B_TRUE 1 100 0 1 BIT_MASK 0x200 FORMAT "%13.11" ECU_ADDRESS 0x383B7C /end MEASUREMENT
/begin MEASUREMENT B_mnhsh "Kurzschluß Heizung Lambdasonde hinter Kat nach Masse" UWORD B_TRUE 1 100 0 1 BIT_MASK 0x200 FORMAT "%13.11" ECU_ADDRESS 0x383B86 /end MEASUREMENT
/begin MEASUREMENT B_mnhsh2 "Kurzschluß Heizung Lambdasonde2 hinter Kat nach Masse" UWORD B_TRUE 1 100 0 1 BIT_MASK 0x200 FORMAT "%13.11" ECU_ADDRESS 0x383B88 /end MEASUREMENT
/begin MEASUREMENT B_mnhshe "Kurzschluß Heizung Lambdasonde hinter Kat nach Masse (Endstufe)" UWORD B_TRUE 1 100 0 1 BIT_MASK 0x200 FORMAT "%13.11" ECU_ADDRESS 0x383B8A /end MEASUREMENT
/begin MEASUREMENT B_mnhsv "Kurzschluß Heizung Lambdasonde vor Kat nach Masse" UWORD B_TRUE 1 100 0 1 BIT_MASK 0x200 FORMAT "%13.11" ECU_ADDRESS 0x383B8C /end MEASUREMENT
/begin MEASUREMENT B_mnhsv2 "Kurzschluß Heizung Lambdasonde2 vor Kat nach Masse" UWORD B_TRUE 1 100 0 1 BIT_MASK 0x200 FORMAT "%13.11" ECU_ADDRESS 0x383B8E /end MEASUREMENT
/begin MEASUREMENT B_mnhsvsa "Min-Fehler erkannt" UWORD B_TRUE 1 100 0 1 BIT_MASK 0x200 FORMAT "%13.11" ECU_ADDRESS 0x383B90 /end MEASUREMENT
/begin MEASUREMENT B_mnhsvsa2 "Min-Fehler erkannt Bank 2" UWORD B_TRUE 1 100 0 1 BIT_MASK 0x200 FORMAT "%13.11" ECU_ADDRESS 0x383B92 /end MEASUREMENT
/begin MEASUREMENT B_mnkat "Bedingung Fehlertyp 'Minimalwert' erkannt (Katalysator defekt)" UWORD B_TRUE 1 100 0 1 BIT_MASK 0x200 FORMAT "%13.11" ECU_ADDRESS 0x383B94 /end MEASUREMENT
/begin MEASUREMENT B_mnkpe "Bedingung für Fehlertyp Kurzschluß nach Masse für EKP-Relais Endstufe erkannt" UWORD B_TRUE 1 100 0 1 BIT_MASK 0x200 FORMAT "%13.11" ECU_ADDRESS 0x383B96 /end MEASUREMENT
/begin MEASUREMENT B_mnkrnt "Fehlertyp min.: Klopfregelung Nulltest" UWORD B_TRUE 1 100 0 1 BIT_MASK 0x200 FORMAT "%13.11" ECU_ADDRESS 0x383BA0 /end MEASUREMENT
/begin MEASUREMENT B_mnkrof "Fehlertyp min.: Klopfregelung Offset" UWORD B_TRUE 1 100 0 1 BIT_MASK 0x200 FORMAT "%13.11" ECU_ADDRESS 0x383BA2 /end MEASUREMENT
/begin MEASUREMENT B_mnkrtp "Fehlertyp min.: Klopfregelung Testimpuls" UWORD B_TRUE 1 100 0 1 BIT_MASK 0x200 FORMAT "%13.11" ECU_ADDRESS 0x383BA4 /end MEASUREMENT
/begin MEASUREMENT B_mnks1 "Bedingung: Min-Fehler Klopfsensor 1" UWORD B_TRUE 1 100 0 1 BIT_MASK 0x200 FORMAT "%13.11" ECU_ADDRESS 0x383BA6 /end MEASUREMENT
/begin MEASUREMENT B_mnks2 "Bedingung: Min-Fehler Klopfsensor 2" UWORD B_TRUE 1 100 0 1 BIT_MASK 0x200 FORMAT "%13.11" ECU_ADDRESS 0x383BA8 /end MEASUREMENT
/begin MEASUREMENT B_mnks3 "Bedingung: Min-Fehler Klopfsensor 3" UWORD B_TRUE 1 100 0 1 BIT_MASK 0x200 FORMAT "%13.11" ECU_ADDRESS 0x383BAA /end MEASUREMENT
/begin MEASUREMENT B_mnks4 "Bedingung: Min-fehler Klopfsensor 4" UWORD B_TRUE 1 100 0 1 BIT_MASK 0x200 FORMAT "%13.11" ECU_ADDRESS 0x383BAC /end MEASUREMENT
/begin MEASUREMENT B_mnkuppl "Fehlertyp KUPPL: Minimalwert unterschritten" UWORD B_TRUE 1 100 0 1 BIT_MASK 0x200 FORMAT "%13.11" ECU_ADDRESS 0x383BAE /end MEASUREMENT
/begin MEASUREMENT B_mnlde "Fehlertyp: Kurzschluß Masse LDR-Taktventil" UWORD B_TRUE 1 100 0 1 BIT_MASK 0x200 FORMAT "%13.11" ECU_ADDRESS 0x383BB2 /end MEASUREMENT
/begin MEASUREMENT B_mnlue1 "Fehlertyp: Schwergängigkeit Lüfter 1" UWORD B_TRUE 1 100 0 1 BIT_MASK 0x200 FORMAT "%13.11" ECU_ADDRESS 0x383BC8 /end MEASUREMENT
/begin MEASUREMENT B_mnlues1e "Fehlertype: Kurzschluß nach Masse Endstufe Lüftersteuerung 1" UWORD B_TRUE 1 100 0 1 BIT_MASK 0x200 FORMAT "%13.11" ECU_ADDRESS 0x383BCA /end MEASUREMENT
/begin MEASUREMENT B_mnmile "Fehlerart: Kurzschluß Masse an MIL-Endstufe" UWORD B_TRUE 1 100 0 1 BIT_MASK 0x200 FORMAT "%13.11" ECU_ADDRESS 0x383BDA /end MEASUREMENT
/begin MEASUREMENT B_mnnwse "Fehlerart: Kurzschluß Masse Nockenwellensteuerungsventil Endstufe" UWORD B_TRUE 1 100 0 1 BIT_MASK 0x200 FORMAT "%13.11" ECU_ADDRESS 0x383BE0 /end MEASUREMENT
/begin MEASUREMENT B_mnrkat "Bedingung untere Plausibilitätsschwelle unterschritten (add. pro Zeit)" UWORD B_TRUE 1 100 0 1 BIT_MASK 0x200 FORMAT "%13.11" ECU_ADDRESS 0x383BE8 /end MEASUREMENT
/begin MEASUREMENT B_mnrkaz "Bedingung untere Plausibilitätsschwelle unterschritten (add. pro Zündung)" UWORD B_TRUE 1 100 0 1 BIT_MASK 0x200 FORMAT "%13.11" ECU_ADDRESS 0x383BEA /end MEASUREMENT
/begin MEASUREMENT B_mnslpe "Fehlertype: Kurzschluß nach Masse Endstufe Sekundärluftpumpe" UWORD B_TRUE 1 100 0 1 BIT_MASK 0x200 FORMAT "%13.11" ECU_ADDRESS 0x383BF2 /end MEASUREMENT
/begin MEASUREMENT B_mnslve "Fehlertype: Kurzschluß nach Masse Endstufe Sekundärluftventil" UWORD B_TRUE 1 100 0 1 BIT_MASK 0x200 FORMAT "%13.11" ECU_ADDRESS 0x383BF8 /end MEASUREMENT
/begin MEASUREMENT B_mnteve "Fehlertyp: Kurzschluß Masse Tankentlüftungsventil Endstufe" UWORD B_TRUE 1 100 0 1 BIT_MASK 0x200 FORMAT "%13.11" ECU_ADDRESS 0x383C08 /end MEASUREMENT
/begin MEASUREMENT B_mnuvse "Fehlertyp: Kurzschluß Masse Umluftventil Turbo" UWORD B_TRUE 1 100 0 1 BIT_MASK 0x200 FORMAT "%13.11" ECU_ADDRESS 0x383C26 /end MEASUREMENT
/begin MEASUREMENT B_mnzet1 "Fehler Zündendstufentreiber Kurzschluß nach Masse" UWORD B_TRUE 1 100 0 1 BIT_MASK 0x200 FORMAT "%13.11" ECU_ADDRESS 0x383C2E /end MEASUREMENT
/begin MEASUREMENT B_mnzet2 "" UWORD B_TRUE 1 100 0 1 BIT_MASK 0x200 FORMAT "%13.11" ECU_ADDRESS 0x383C30 /end MEASUREMENT
/begin MEASUREMENT B_mnzet3 "" UWORD B_TRUE 1 100 0 1 BIT_MASK 0x200 FORMAT "%13.11" ECU_ADDRESS 0x383C32 /end MEASUREMENT
/begin MEASUREMENT B_mnzet4 "" UWORD B_TRUE 1 100 0 1 BIT_MASK 0x200 FORMAT "%13.11" ECU_ADDRESS 0x383C34 /end MEASUREMENT
/begin MEASUREMENT B_mxagre "Kurzschluß Endstufe AGR-Ventil" UWORD B_TRUE 1 100 0 1 BIT_MASK 0x100 FORMAT "%13.11" ECU_ADDRESS 0x383B0A /end MEASUREMENT
/begin MEASUREMENT B_mxbkvpe "Fehlerart: Kurzschluß Ubat an BKV-Pumpe-Endstufe" UWORD B_TRUE 1 100 0 1 BIT_MASK 0x100 FORMAT "%13.11" ECU_ADDRESS 0x383B1C /end MEASUREMENT
/begin MEASUREMENT B_mxdk "Fehlertype: Kurzschluss nach Ubat Drosselklappenpoti" UWORD B_TRUE 1 100 0 1 BIT_MASK 0x100 FORMAT "%13.11" ECU_ADDRESS 0x383B38 /end MEASUREMENT
/begin MEASUREMENT B_mxdk1p "Fehlertyp max.: Drosselklappe 1. Poti" UWORD B_TRUE 1 100 0 1 BIT_MASK 0x100 FORMAT "%13.11" ECU_ADDRESS 0x383B3A /end MEASUREMENT
/begin MEASUREMENT B_mxdk2p "Fehlertyp max.: Drosselklappe 2. Poti" UWORD B_TRUE 1 100 0 1 BIT_MASK 0x100 FORMAT "%13.11" ECU_ADDRESS 0x383B3C /end MEASUREMENT
/begin MEASUREMENT B_mxdvee "Fehlertyp max.: DV-E Endstufe" UWORD B_TRUE 1 100 0 1 BIT_MASK 0x100 FORMAT "%13.11" ECU_ADDRESS 0x383B4A /end MEASUREMENT
/begin MEASUREMENT B_mxdvef "Fehlertyp max.: DV-E Fehler bei Prüfung der Rückstellfeder" UWORD B_TRUE 1 100 0 1 BIT_MASK 0x100 FORMAT "%13.11" ECU_ADDRESS 0x383B4C /end MEASUREMENT
/begin MEASUREMENT B_mxdvefo "Fehlertyp max.: Fehler bei Federprüfung ""Öffnen""" UWORD B_TRUE 1 100 0 1 BIT_MASK 0x100 FORMAT "%13.11" ECU_ADDRESS 0x383B4E /end MEASUREMENT
/begin MEASUREMENT B_mxdvel "Fehlertyp max.: DV-E Lageabweichung" UWORD B_TRUE 1 100 0 1 BIT_MASK 0x100 FORMAT "%13.11" ECU_ADDRESS 0x383B50 /end MEASUREMENT
/begin MEASUREMENT B_mxdven "Fehlertyp max.: DV-E Fehler bei Prüfung Notluftposition" UWORD B_TRUE 1 100 0 1 BIT_MASK 0x100 FORMAT "%13.11" ECU_ADDRESS 0x383B52 /end MEASUREMENT
/begin MEASUREMENT B_mxdver "Fehlertyp max.: DV-E Regelbereich, langfristig verletzt" UWORD B_TRUE 1 100 0 1 BIT_MASK 0x100 FORMAT "%13.11" ECU_ADDRESS 0x383B54 /end MEASUREMENT
/begin MEASUREMENT B_mxdvet "Nicht benutzt" UWORD B_TRUE 1 100 0 1 BIT_MASK 0x100 FORMAT "%13.11" ECU_ADDRESS 0x383B56 /end MEASUREMENT
/begin MEASUREMENT B_mxdveu "Fehlertyp max.: DV-E Fehler beim UMA-Lernen" UWORD B_TRUE 1 100 0 1 BIT_MASK 0x100 FORMAT "%13.11" ECU_ADDRESS 0x383B58 /end MEASUREMENT
/begin MEASUREMENT B_mxdveub "Fehlertyp max.: DV-E-Adaption Abbruch wg. Umweltbedingung" UWORD B_TRUE 1 100 0 1 BIT_MASK 0x100 FORMAT "%13.11" ECU_ADDRESS 0x383B5A /end MEASUREMENT
/begin MEASUREMENT B_mxdveuw "Nicht benutzt" UWORD B_TRUE 1 100 0 1 BIT_MASK 0x100 FORMAT "%13.11" ECU_ADDRESS 0x383B5C /end MEASUREMENT
/begin MEASUREMENT B_mxdvev "Fehlertyp max.: DV-E Fehler bei Verstärkerabgleich" UWORD B_TRUE 1 100 0 1 BIT_MASK 0x100 FORMAT "%13.11" ECU_ADDRESS 0x383B5E /end MEASUREMENT
/begin MEASUREMENT B_mxegfe "Bedingung: MAX-Fehler Eingangsgrößen Füllungserfassung" UWORD B_TRUE 1 100 0 1 BIT_MASK 0x100 FORMAT "%13.11" ECU_ADDRESS 0x383B60 /end MEASUREMENT
/begin MEASUREMENT B_mxenws "Bed. Nockenwellenverstellung hat Spätposition nicht erreicht (Einlaß,Bank1)" UWORD B_TRUE 1 100 0 1 BIT_MASK 0x100 FORMAT "%13.11" ECU_ADDRESS 0x383B62 /end MEASUREMENT
/begin MEASUREMENT B_mxenwse "Fehlerart: Kurzschluß Ubat Nockenwellensteuerungsventil Endstufe" UWORD B_TRUE 1 100 0 1 BIT_MASK 0x100 FORMAT "%13.11" ECU_ADDRESS 0x383B64 /end MEASUREMENT
/begin MEASUREMENT B_mxepcle "Fehlerart: Kurzschluß Ubat an EPCL-Endstufe" UWORD B_TRUE 1 100 0 1 BIT_MASK 0x100 FORMAT "%13.11" ECU_ADDRESS 0x383B66 /end MEASUREMENT
/begin MEASUREMENT B_mxetre "Fehlertype: Kurzschluß nach Ubatt Endstufe el. Thermostat" UWORD B_TRUE 1 100 0 1 BIT_MASK 0x100 FORMAT "%13.11" ECU_ADDRESS 0x383B68 /end MEASUREMENT
/begin MEASUREMENT B_mxev1 "Fehlerart: Kurzschluß UBat an Endstufe EV1" UWORD B_TRUE 1 100 0 1 BIT_MASK 0x100 FORMAT "%13.11" ECU_ADDRESS 0x383B6A /end MEASUREMENT
/begin MEASUREMENT B_mxev2 "Fehlerart: Kurzschluß UBat an Endstufe EV2" UWORD B_TRUE 1 100 0 1 BIT_MASK 0x100 FORMAT "%13.11" ECU_ADDRESS 0x383B6C /end MEASUREMENT
/begin MEASUREMENT B_mxev3 "Fehlerart: Kurzschluß UBat an Endstufe EV3" UWORD B_TRUE 1 100 0 1 BIT_MASK 0x100 FORMAT "%13.11" ECU_ADDRESS 0x383B6E /end MEASUREMENT
/begin MEASUREMENT B_mxev4 "Fehlerart: Kurzschluß UBat an Endstufe EV4" UWORD B_TRUE 1 100 0 1 BIT_MASK 0x100 FORMAT "%13.11" ECU_ADDRESS 0x383B70 /end MEASUREMENT
/begin MEASUREMENT B_mxfrao "Bedingung obere Plausibilitätsschwelle überschritten (obere Multipl.)" UWORD B_TRUE 1 100 0 1 BIT_MASK 0x100 FORMAT "%13.11" ECU_ADDRESS 0x383B78 /end MEASUREMENT
/begin MEASUREMENT B_mxfrau "Bedingung obere Plausiblitätsschwelle überschritten (untere Multipl.)" UWORD B_TRUE 1 100 0 1 BIT_MASK 0x100 FORMAT "%13.11" ECU_ADDRESS 0x383B7A /end MEASUREMENT
/begin MEASUREMENT B_mxfrst "Bedingung obere Plausiblitätsschwelle überschritten (short test" UWORD B_TRUE 1 100 0 1 BIT_MASK 0x100 FORMAT "%13.11" ECU_ADDRESS 0x383B7C /end MEASUREMENT
/begin MEASUREMENT B_mxhsh "Kurzschluß Heizung Lambdasonde hinter Kat nach UB" UWORD B_TRUE 1 100 0 1 BIT_MASK 0x100 FORMAT "%13.11" ECU_ADDRESS 0x383B86 /end MEASUREMENT
/begin MEASUREMENT B_mxhsh2 "Kurzschluß Heizung Lambdasonde2 hinter Kat nach UB" UWORD B_TRUE 1 100 0 1 BIT_MASK 0x100 FORMAT "%13.11" ECU_ADDRESS 0x383B88 /end MEASUREMENT
/begin MEASUREMENT B_mxhshe "Kurzschluß Heizung Lambdasonde hinter Kat nach UB (Endstufe)" UWORD B_TRUE 1 100 0 1 BIT_MASK 0x100 FORMAT "%13.11" ECU_ADDRESS 0x383B8A /end MEASUREMENT
/begin MEASUREMENT B_mxhsv "Kurzschluß Heizung Lambdasonde vor Kat nach UB" UWORD B_TRUE 1 100 0 1 BIT_MASK 0x100 FORMAT "%13.11" ECU_ADDRESS 0x383B8C /end MEASUREMENT
/begin MEASUREMENT B_mxhsv2 "Kurzschluß Heizung Lambdasonde2 vor Kat nach UB" UWORD B_TRUE 1 100 0 1 BIT_MASK 0x100 FORMAT "%13.11" ECU_ADDRESS 0x383B8E /end MEASUREMENT
/begin MEASUREMENT B_mxhsvsa "Max-Fehler erkannt" UWORD B_TRUE 1 100 0 1 BIT_MASK 0x100 FORMAT "%13.11" ECU_ADDRESS 0x383B90 /end MEASUREMENT
/begin MEASUREMENT B_mxhsvsa2 "Max-Fehler erkannt Bank 2" UWORD B_TRUE 1 100 0 1 BIT_MASK 0x100 FORMAT "%13.11" ECU_ADDRESS 0x383B92 /end MEASUREMENT
/begin MEASUREMENT B_mxkat "Bedingung obere Plausibilitätsschwelle überschritten" UWORD B_TRUE 1 100 0 1 BIT_MASK 0x100 FORMAT "%13.11" ECU_ADDRESS 0x383B94 /end MEASUREMENT
/begin MEASUREMENT B_mxkpe "Fehlertyp Kurzschluß nach Ubat für EKP-Relais Endstufe erkannt" UWORD B_TRUE 1 100 0 1 BIT_MASK 0x100 FORMAT "%13.11" ECU_ADDRESS 0x383B96 /end MEASUREMENT
/begin MEASUREMENT B_mxkra01 "Fehlertyp max.: Klopfregelanschlag Zylinder 1" UWORD B_TRUE 1 100 0 1 BIT_MASK 0x100 FORMAT "%13.11" ECU_ADDRESS 0x383B98 /end MEASUREMENT
/begin MEASUREMENT B_mxkra02 "Fehlertyp max.: Klopfregelanschlag Zylinder 2" UWORD B_TRUE 1 100 0 1 BIT_MASK 0x100 FORMAT "%13.11" ECU_ADDRESS 0x383B9A /end MEASUREMENT
/begin MEASUREMENT B_mxkra03 "Fehlertyp max.: Klopfregelanschlag Zylinder 3" UWORD B_TRUE 1 100 0 1 BIT_MASK 0x100 FORMAT "%13.11" ECU_ADDRESS 0x383B9C /end MEASUREMENT
/begin MEASUREMENT B_mxkra04 "Fehlertyp max.: Klopfregelanschlag Zylinder 4" UWORD B_TRUE 1 100 0 1 BIT_MASK 0x100 FORMAT "%13.11" ECU_ADDRESS 0x383B9E /end MEASUREMENT
/begin MEASUREMENT B_mxkrnt "Fehlertyp max.: Klopfregelung Nulltest" UWORD B_TRUE 1 100 0 1 BIT_MASK 0x100 FORMAT "%13.11" ECU_ADDRESS 0x383BA0 /end MEASUREMENT
/begin MEASUREMENT B_mxkrof "Fehlertyp max.: Klopfregelung Offset" UWORD B_TRUE 1 100 0 1 BIT_MASK 0x100 FORMAT "%13.11" ECU_ADDRESS 0x383BA2 /end MEASUREMENT
/begin MEASUREMENT B_mxkrtp "Fehlertyp max.: Klopfregelung Testimpuls" UWORD B_TRUE 1 100 0 1 BIT_MASK 0x100 FORMAT "%13.11" ECU_ADDRESS 0x383BA4 /end MEASUREMENT
/begin MEASUREMENT B_mxks1 "Bedingung: Max-Fehler Klopfsensor 1" UWORD B_TRUE 1 100 0 1 BIT_MASK 0x100 FORMAT "%13.11" ECU_ADDRESS 0x383BA6 /end MEASUREMENT
/begin MEASUREMENT B_mxks2 "Bedingung: Max-Fehler Klopfsensor 2" UWORD B_TRUE 1 100 0 1 BIT_MASK 0x100 FORMAT "%13.11" ECU_ADDRESS 0x383BA8 /end MEASUREMENT
/begin MEASUREMENT B_mxks3 "Bedingung: Max-Fehler Klopfsensor 3" UWORD B_TRUE 1 100 0 1 BIT_MASK 0x100 FORMAT "%13.11" ECU_ADDRESS 0x383BAA /end MEASUREMENT
/begin MEASUREMENT B_mxks4 "Bedingung: Max-Fehler Klopfsensor 4" UWORD B_TRUE 1 100 0 1 BIT_MASK 0x100 FORMAT "%13.11" ECU_ADDRESS 0x383BAC /end MEASUREMENT
/begin MEASUREMENT B_mxkuppl "Fehlertyp KUPPL: Maximalwert überschritten" UWORD B_TRUE 1 100 0 1 BIT_MASK 0x100 FORMAT "%13.11" ECU_ADDRESS 0x383BAE /end MEASUREMENT
/begin MEASUREMENT B_mxlde "Fehlertyp: Kurzschluß Ubat LDR-Taktventil" UWORD B_TRUE 1 100 0 1 BIT_MASK 0x100 FORMAT "%13.11" ECU_ADDRESS 0x383BB2 /end MEASUREMENT
/begin MEASUREMENT B_mxlue1 "Fehlertyp: Übertemperatur Lüftereinheit 1" UWORD B_TRUE 1 100 0 1 BIT_MASK 0x100 FORMAT "%13.11" ECU_ADDRESS 0x383BC8 /end MEASUREMENT
/begin MEASUREMENT B_mxlues1e "Fehlertype: Kurzschluß nach Ubatt Endstufe Lüftersteuerung 1" UWORD B_TRUE 1 100 0 1 BIT_MASK 0x100 FORMAT "%13.11" ECU_ADDRESS 0x383BCA /end MEASUREMENT
/begin MEASUREMENT B_mxmile "Fehlerart: Kurzschluß Ubat an MIL-Endstufe" UWORD B_TRUE 1 100 0 1 BIT_MASK 0x100 FORMAT "%13.11" ECU_ADDRESS 0x383BDA /end MEASUREMENT
/begin MEASUREMENT B_mxnwse "Fehlerart: Kurzschluß Ubat Nockenwellensteuerungsventil Endstufe" UWORD B_TRUE 1 100 0 1 BIT_MASK 0x100 FORMAT "%13.11" ECU_ADDRESS 0x383BE0 /end MEASUREMENT
/begin MEASUREMENT B_mxrkat "Bedingung obere Plausibilitätsschwelle überschritten (add. pro Zeit)" UWORD B_TRUE 1 100 0 1 BIT_MASK 0x100 FORMAT "%13.11" ECU_ADDRESS 0x383BE8 /end MEASUREMENT
/begin MEASUREMENT B_mxrkaz "Bedingung obere Plausibilitätsschwelle überschritten (add. pro Zündung)" UWORD B_TRUE 1 100 0 1 BIT_MASK 0x100 FORMAT "%13.11" ECU_ADDRESS 0x383BEA /end MEASUREMENT
/begin MEASUREMENT B_mxslpe "Fehlertype: Kurzschluß nach Ubatt Endstufe Sekundärluftpumpe" UWORD B_TRUE 1 100 0 1 BIT_MASK 0x100 FORMAT "%13.11" ECU_ADDRESS 0x383BF2 /end MEASUREMENT
/begin MEASUREMENT B_mxslve "Fehlertype: Kurzschluß nach Masse Endstufe Sekundärluftventil" UWORD B_TRUE 1 100 0 1 BIT_MASK 0x100 FORMAT "%13.11" ECU_ADDRESS 0x383BF8 /end MEASUREMENT
/begin MEASUREMENT B_mxteve "Fehlertyp: Kurzschluß Ubat Tankentlüftungsventil Endstufe" UWORD B_TRUE 1 100 0 1 BIT_MASK 0x100 FORMAT "%13.11" ECU_ADDRESS 0x383C08 /end MEASUREMENT
/begin MEASUREMENT B_mxuvse "Fehlertyp: Kurzschluß Ubat Umluftventil Turbo" UWORD B_TRUE 1 100 0 1 BIT_MASK 0x100 FORMAT "%13.11" ECU_ADDRESS 0x383C26 /end MEASUREMENT
/begin MEASUREMENT B_mxzet1 "Fehler Zündendstufentreiber Kurzschluß nach UBAT" UWORD B_TRUE 1 100 0 1 BIT_MASK 0x100 FORMAT "%13.11" ECU_ADDRESS 0x383C2E /end MEASUREMENT
/begin MEASUREMENT B_mxzet2 "" UWORD B_TRUE 1 100 0 1 BIT_MASK 0x100 FORMAT "%13.11" ECU_ADDRESS 0x383C30 /end MEASUREMENT
/begin MEASUREMENT B_mxzet3 "" UWORD B_TRUE 1 100 0 1 BIT_MASK 0x100 FORMAT "%13.11" ECU_ADDRESS 0x383C32 /end MEASUREMENT
/begin MEASUREMENT B_mxzet4 "" UWORD B_TRUE 1 100 0 1 BIT_MASK 0x100 FORMAT "%13.11" ECU_ADDRESS 0x383C34 /end MEASUREMENT
/begin MEASUREMENT B_npagre "Abgasrückführungsventil Endstufe genereller Fehler" UWORD B_TRUE 1 100 0 1 BIT_MASK 0x800 FORMAT "%13.11" ECU_ADDRESS 0x383B0A /end MEASUREMENT
/begin MEASUREMENT B_npbkvpe "Fehlerart: Zustand nicht plausibel an BKV-Pumpe-Endstufe" UWORD B_TRUE 1 100 0 1 BIT_MASK 0x800 FORMAT "%13.11" ECU_ADDRESS 0x383B1C /end MEASUREMENT
/begin MEASUREMENT B_npdk "Bedingung unplausible Potisignale von der Drosselklappe" UWORD B_TRUE 1 100 0 1 BIT_MASK 0x800 FORMAT "%13.11" ECU_ADDRESS 0x383B38 /end MEASUREMENT
/begin MEASUREMENT B_npdk1p "Fehlertyp unplaus.: Drosselklappe 1. Poti" UWORD B_TRUE 1 100 0 1 BIT_MASK 0x800 FORMAT "%13.11" ECU_ADDRESS 0x383B3A /end MEASUREMENT
/begin MEASUREMENT B_npdk2p "Fehlertyp unplaus.: Drosselklappe 2. Poti" UWORD B_TRUE 1 100 0 1 BIT_MASK 0x800 FORMAT "%13.11" ECU_ADDRESS 0x383B3C /end MEASUREMENT
/begin MEASUREMENT B_npdvee "Fehlertyp unplaus.: DV-E Endstufe" UWORD B_TRUE 1 100 0 1 BIT_MASK 0x800 FORMAT "%13.11" ECU_ADDRESS 0x383B4A /end MEASUREMENT
/begin MEASUREMENT B_npdvef "Fehlertyp unplaus.: DV-E Fehler bei Federprüfung" UWORD B_TRUE 1 100 0 1 BIT_MASK 0x800 FORMAT "%13.11" ECU_ADDRESS 0x383B4C /end MEASUREMENT
/begin MEASUREMENT B_npdvefo "Nicht benutzt" UWORD B_TRUE 1 100 0 1 BIT_MASK 0x800 FORMAT "%13.11" ECU_ADDRESS 0x383B4E /end MEASUREMENT
/begin MEASUREMENT B_npdvel "Fehlertyp unplaus.: DV-E Lageabweichung" UWORD B_TRUE 1 100 0 1 BIT_MASK 0x800 FORMAT "%13.11" ECU_ADDRESS 0x383B50 /end MEASUREMENT
/begin MEASUREMENT B_npdven "Fehlertyp unplaus.: DV-E Fehler bei Prüfung Notluftposition" UWORD B_TRUE 1 100 0 1 BIT_MASK 0x800 FORMAT "%13.11" ECU_ADDRESS 0x383B52 /end MEASUREMENT
/begin MEASUREMENT B_npdver "Fehlertyp unplaus.: DV-E Regelbereich" UWORD B_TRUE 1 100 0 1 BIT_MASK 0x800 FORMAT "%13.11" ECU_ADDRESS 0x383B54 /end MEASUREMENT
/begin MEASUREMENT B_npdvet "Fehlertyp ""unplausibel"": DV-E-Tauscherkennung ohne Adaption" UWORD B_TRUE 1 100 0 1 BIT_MASK 0x800 FORMAT "%13.11" ECU_ADDRESS 0x383B56 /end MEASUREMENT
/begin MEASUREMENT B_npdveu "Fehlertyp unplaus.: DV-E Fehler beim UMA-Lernen" UWORD B_TRUE 1 100 0 1 BIT_MASK 0x800 FORMAT "%13.11" ECU_ADDRESS 0x383B58 /end MEASUREMENT
/begin MEASUREMENT B_npdveub "Nicht benutzt" UWORD B_TRUE 1 100 0 1 BIT_MASK 0x800 FORMAT "%13.11" ECU_ADDRESS 0x383B5A /end MEASUREMENT
/begin MEASUREMENT B_npdveuw "Fehlertyp ""unplausibel"" bei UMA-Wiederlernen" UWORD B_TRUE 1 100 0 1 BIT_MASK 0x800 FORMAT "%13.11" ECU_ADDRESS 0x383B5C /end MEASUREMENT
/begin MEASUREMENT B_npdvev "Fehlertyp unplaus.: DV-E Fehler bei Verstärkerabgleich" UWORD B_TRUE 1 100 0 1 BIT_MASK 0x800 FORMAT "%13.11" ECU_ADDRESS 0x383B5E /end MEASUREMENT
/begin MEASUREMENT B_npegfe "Bedingung: unplausibler Wert bei den Eingangsgrößen der Füllungserfassung" UWORD B_TRUE 1 100 0 1 BIT_MASK 0x800 FORMAT "%13.11" ECU_ADDRESS 0x383B60 /end MEASUREMENT
/begin MEASUREMENT B_npenws "Bed. Nockenwellenverstellung hat unplausible Position (Einlaß,Bank1)" UWORD B_TRUE 1 100 0 1 BIT_MASK 0x800 FORMAT "%13.11" ECU_ADDRESS 0x383B62 /end MEASUREMENT
/begin MEASUREMENT B_npenwse "Fehlertyp unplaus.: Nockenwellensteuerung Endstufe (Einlaß, Bank1)" UWORD B_TRUE 1 100 0 1 BIT_MASK 0x800 FORMAT "%13.11" ECU_ADDRESS 0x383B64 /end MEASUREMENT
/begin MEASUREMENT B_npepcle "" UWORD B_TRUE 1 100 0 1 BIT_MASK 0x800 FORMAT "%13.11" ECU_ADDRESS 0x383B66 /end MEASUREMENT
/begin MEASUREMENT B_npetre "Nicht plausibler Fehler: Elektro Thermostat Regelung Endstufe" UWORD B_TRUE 1 100 0 1 BIT_MASK 0x800 FORMAT "%13.11" ECU_ADDRESS 0x383B68 /end MEASUREMENT
/begin MEASUREMENT B_npev1 "Fehlerart: Zustand nicht plausibel EV1" UWORD B_TRUE 1 100 0 1 BIT_MASK 0x800 FORMAT "%13.11" ECU_ADDRESS 0x383B6A /end MEASUREMENT
/begin MEASUREMENT B_npev2 "Fehlerart: Zustand nicht plausibel EV2" UWORD B_TRUE 1 100 0 1 BIT_MASK 0x800 FORMAT "%13.11" ECU_ADDRESS 0x383B6C /end MEASUREMENT
/begin MEASUREMENT B_npev3 "Fehlerart: Zustand nicht plausibel EV3" UWORD B_TRUE 1 100 0 1 BIT_MASK 0x800 FORMAT "%13.11" ECU_ADDRESS 0x383B6E /end MEASUREMENT
/begin MEASUREMENT B_npev4 "Fehlerart: Zustand nicht plausibel EV4" UWORD B_TRUE 1 100 0 1 BIT_MASK 0x800 FORMAT "%13.11" ECU_ADDRESS 0x383B70 /end MEASUREMENT
/begin MEASUREMENT B_npfrao "Bedingung FRAO ist unplausibel" UWORD B_TRUE 1 100 0 1 BIT_MASK 0x800 FORMAT "%13.11" ECU_ADDRESS 0x383B78 /end MEASUREMENT
/begin MEASUREMENT B_npfrau "Bedingung FRAU ist unplausibel" UWORD B_TRUE 1 100 0 1 BIT_MASK 0x800 FORMAT "%13.11" ECU_ADDRESS 0x383B7A /end MEASUREMENT
/begin MEASUREMENT B_npfrst "Fehlertyp 'unplausibles Prüfresultat' erkannt (DKVS Kurztest)" UWORD B_TRUE 1 100 0 1 BIT_MASK 0x800 FORMAT "%13.11" ECU_ADDRESS 0x383B7C /end MEASUREMENT
/begin MEASUREMENT B_nphsh "Nernstwiderstand Sonde hinter Kat zu groß" UWORD B_TRUE 1 100 0 1 BIT_MASK 0x800 FORMAT "%13.11" ECU_ADDRESS 0x383B86 /end MEASUREMENT
/begin MEASUREMENT B_nphsh2 "Nernstwiderstand Sonde 2 hinter Kat zu groß" UWORD B_TRUE 1 100 0 1 BIT_MASK 0x800 FORMAT "%13.11" ECU_ADDRESS 0x383B88 /end MEASUREMENT
/begin MEASUREMENT B_nphshe "Nicht plausibler Fehler: Lambda-Sonden Heizung hinter Kat. (Endstufe)" UWORD B_TRUE 1 100 0 1 BIT_MASK 0x800 FORMAT "%13.11" ECU_ADDRESS 0x383B8A /end MEASUREMENT
/begin MEASUREMENT B_nphsv "Nernstwiderstand Sonde vor Kat zu groß" UWORD B_TRUE 1 100 0 1 BIT_MASK 0x800 FORMAT "%13.11" ECU_ADDRESS 0x383B8C /end MEASUREMENT
/begin MEASUREMENT B_nphsv2 "Nernstwiderstand Sonde 2 vor Kat zu groß" UWORD B_TRUE 1 100 0 1 BIT_MASK 0x800 FORMAT "%13.11" ECU_ADDRESS 0x383B8E /end MEASUREMENT
/begin MEASUREMENT B_nphsvsa "reduzierte  LSU-Heizung oder LSU-Kennlinie abgeflacht" UWORD B_TRUE 1 100 0 1 BIT_MASK 0x800 FORMAT "%13.11" ECU_ADDRESS 0x383B90 /end MEASUREMENT
/begin MEASUREMENT B_nphsvsa2 "reduzierte  LSU_2-Heizung oder LSU_2-Kennlinie abgeflacht" UWORD B_TRUE 1 100 0 1 BIT_MASK 0x800 FORMAT "%13.11" ECU_ADDRESS 0x383B92 /end MEASUREMENT
/begin MEASUREMENT B_npkat "Bedingung Fehlertyp 'unplausibles Prüfresultat' erkannt (Katalysator)" UWORD B_TRUE 1 100 0 1 BIT_MASK 0x800 FORMAT "%13.11" ECU_ADDRESS 0x383B94 /end MEASUREMENT
/begin MEASUREMENT B_npkpe "Bedingung für Fehlertyp 'Wert unplausibel' für EKP-Relais Endstufe erkannt" UWORD B_TRUE 1 100 0 1 BIT_MASK 0x800 FORMAT "%13.11" ECU_ADDRESS 0x383B96 /end MEASUREMENT
/begin MEASUREMENT B_npkrnt "Bedingung Plausibilitätsfehler der KR-Diagnose Integratorsteigung" UWORD B_TRUE 1 100 0 1 BIT_MASK 0x800 FORMAT "%13.11" ECU_ADDRESS 0x383BA0 /end MEASUREMENT
/begin MEASUREMENT B_npkrof "Bedingung Plausibilitätsfehler der KR-Diagnose Resetwert" UWORD B_TRUE 1 100 0 1 BIT_MASK 0x800 FORMAT "%13.11" ECU_ADDRESS 0x383BA2 /end MEASUREMENT
/begin MEASUREMENT B_npkrtp "Bedingung Plausibilitätsfehler der KR-Diagnose Testimpuls" UWORD B_TRUE 1 100 0 1 BIT_MASK 0x800 FORMAT "%13.11" ECU_ADDRESS 0x383BA4 /end MEASUREMENT
/begin MEASUREMENT B_npks1 "Nicht plausibler Fehler: Klopfsensor 1" UWORD B_TRUE 1 100 0 1 BIT_MASK 0x800 FORMAT "%13.11" ECU_ADDRESS 0x383BA6 /end MEASUREMENT
/begin MEASUREMENT B_npks2 "Nicht plausibler Fehler: Klopfsensor 2" UWORD B_TRUE 1 100 0 1 BIT_MASK 0x800 FORMAT "%13.11" ECU_ADDRESS 0x383BA8 /end MEASUREMENT
/begin MEASUREMENT B_npks3 "Nicht plausibler Fehler: Klopfsensor 3" UWORD B_TRUE 1 100 0 1 BIT_MASK 0x800 FORMAT "%13.11" ECU_ADDRESS 0x383BAA /end MEASUREMENT
/begin MEASUREMENT B_npks4 "Nicht plausibler Fehler: Klopfsensor 4" UWORD B_TRUE 1 100 0 1 BIT_MASK 0x800 FORMAT "%13.11" ECU_ADDRESS 0x383BAC /end MEASUREMENT
/begin MEASUREMENT B_npkuppl "Fehlertyp KUPPL: Prüfresultat nicht plausibel" UWORD B_TRUE 1 100 0 1 BIT_MASK 0x800 FORMAT "%13.11" ECU_ADDRESS 0x383BAE /end MEASUREMENT
/begin MEASUREMENT B_nplde "Nicht plausibler Fehler: Ladedrucksteuerventil Endstufe" UWORD B_TRUE 1 100 0 1 BIT_MASK 0x800 FORMAT "%13.11" ECU_ADDRESS 0x383BB2 /end MEASUREMENT
/begin MEASUREMENT B_nplue1 "Fehlertyp: Elektronikfehler Lüftereinheit 1" UWORD B_TRUE 1 100 0 1 BIT_MASK 0x800 FORMAT "%13.11" ECU_ADDRESS 0x383BC8 /end MEASUREMENT
/begin MEASUREMENT B_nplues1e "Bedingung Ansteuerungssignal Lüfter 1 nicht plausibel" UWORD B_TRUE 1 100 0 1 BIT_MASK 0x800 FORMAT "%13.11" ECU_ADDRESS 0x383BCA /end MEASUREMENT
/begin MEASUREMENT B_npmile "Fehlerart: Zustand nicht plausibel an MIL-Endstufe" UWORD B_TRUE 1 100 0 1 BIT_MASK 0x800 FORMAT "%13.11" ECU_ADDRESS 0x383BDA /end MEASUREMENT
/begin MEASUREMENT B_npnwse "Nicht plausibler Fehler: Nockenwellenverstellung Endstufe" UWORD B_TRUE 1 100 0 1 BIT_MASK 0x800 FORMAT "%13.11" ECU_ADDRESS 0x383BE0 /end MEASUREMENT
/begin MEASUREMENT B_nprkat "Bedingung RKAT ist unplausibel" UWORD B_TRUE 1 100 0 1 BIT_MASK 0x800 FORMAT "%13.11" ECU_ADDRESS 0x383BE8 /end MEASUREMENT
/begin MEASUREMENT B_nprkaz "Bedingung RKAZ ist unplausibel" UWORD B_TRUE 1 100 0 1 BIT_MASK 0x800 FORMAT "%13.11" ECU_ADDRESS 0x383BEA /end MEASUREMENT
/begin MEASUREMENT B_npslpe "Nicht plausibler Fehler: Sekundärluftpumpe Endstufe" UWORD B_TRUE 1 100 0 1 BIT_MASK 0x800 FORMAT "%13.11" ECU_ADDRESS 0x383BF2 /end MEASUREMENT
/begin MEASUREMENT B_npslve "Fehlerart: Offsetwert Sekundärluftmasse Endstufe" UWORD B_TRUE 1 100 0 1 BIT_MASK 0x800 FORMAT "%13.11" ECU_ADDRESS 0x383BF8 /end MEASUREMENT
/begin MEASUREMENT B_npteve "Nicht plausibler Fehler: Tankentlüftungsventil Endstufe" UWORD B_TRUE 1 100 0 1 BIT_MASK 0x800 FORMAT "%13.11" ECU_ADDRESS 0x383C08 /end MEASUREMENT
/begin MEASUREMENT B_npuvse "Nicht plausibler  Fehler: Endstufe Umluftventil Turbo" UWORD B_TRUE 1 100 0 1 BIT_MASK 0x800 FORMAT "%13.11" ECU_ADDRESS 0x383C26 /end MEASUREMENT
/begin MEASUREMENT B_npzet1 "unplausibler Zündkreisfehler" UWORD B_TRUE 1 100 0 1 BIT_MASK 0x800 FORMAT "%13.11" ECU_ADDRESS 0x383C2E /end MEASUREMENT
/begin MEASUREMENT B_npzet2 "" UWORD B_TRUE 1 100 0 1 BIT_MASK 0x800 FORMAT "%13.11" ECU_ADDRESS 0x383C30 /end MEASUREMENT
/begin MEASUREMENT B_npzet3 "" UWORD B_TRUE 1 100 0 1 BIT_MASK 0x800 FORMAT "%13.11" ECU_ADDRESS 0x383C32 /end MEASUREMENT
/begin MEASUREMENT B_npzet4 "" UWORD B_TRUE 1 100 0 1 BIT_MASK 0x800 FORMAT "%13.11" ECU_ADDRESS 0x383C34 /end MEASUREMENT
/begin MEASUREMENT B_siagre "Leitungsabfall Endstufe AGR-Ventil" UWORD B_TRUE 1 100 0 1 BIT_MASK 0x400 FORMAT "%13.11" ECU_ADDRESS 0x383B0A /end MEASUREMENT
/begin MEASUREMENT B_sibkvpe "Fehlerart: Unterbrechung an BKV-Pumpe-Endstufe" UWORD B_TRUE 1 100 0 1 BIT_MASK 0x400 FORMAT "%13.11" ECU_ADDRESS 0x383B1C /end MEASUREMENT
/begin MEASUREMENT B_sidk "Fehlertyp sig: Drosselklappenpoti" UWORD B_TRUE 1 100 0 1 BIT_MASK 0x400 FORMAT "%13.11" ECU_ADDRESS 0x383B38 /end MEASUREMENT
/begin MEASUREMENT B_sidk1p "Fehlendes Signal: Drosselklappe 1. Poti" UWORD B_TRUE 1 100 0 1 BIT_MASK 0x400 FORMAT "%13.11" ECU_ADDRESS 0x383B3A /end MEASUREMENT
/begin MEASUREMENT B_sidk2p "Fehlendes Signal: Drosselklappe 2. Poti" UWORD B_TRUE 1 100 0 1 BIT_MASK 0x400 FORMAT "%13.11" ECU_ADDRESS 0x383B3C /end MEASUREMENT
/begin MEASUREMENT B_sidvee "Fehlertyp sig.: DV-E Endstufe" UWORD B_TRUE 1 100 0 1 BIT_MASK 0x400 FORMAT "%13.11" ECU_ADDRESS 0x383B4A /end MEASUREMENT
/begin MEASUREMENT B_sidvef "Fehlertyp sig.: DV-E Fehler bei Federprüfung" UWORD B_TRUE 1 100 0 1 BIT_MASK 0x400 FORMAT "%13.11" ECU_ADDRESS 0x383B4C /end MEASUREMENT
/begin MEASUREMENT B_sidvefo "Nicht benutzt" UWORD B_TRUE 1 100 0 1 BIT_MASK 0x400 FORMAT "%13.11" ECU_ADDRESS 0x383B4E /end MEASUREMENT
/begin MEASUREMENT B_sidvel "Fehlertyp sig.: DV-E Lageabweichung" UWORD B_TRUE 1 100 0 1 BIT_MASK 0x400 FORMAT "%13.11" ECU_ADDRESS 0x383B50 /end MEASUREMENT
/begin MEASUREMENT B_sidven "Fehlertyp sig.: DV-E Fehler bei Prüfung Notluftposition" UWORD B_TRUE 1 100 0 1 BIT_MASK 0x400 FORMAT "%13.11" ECU_ADDRESS 0x383B52 /end MEASUREMENT
/begin MEASUREMENT B_sidver "Fehlertyp sig.: DV-E Regelbereich" UWORD B_TRUE 1 100 0 1 BIT_MASK 0x400 FORMAT "%13.11" ECU_ADDRESS 0x383B54 /end MEASUREMENT
/begin MEASUREMENT B_sidvet "Nicht benutzt" UWORD B_TRUE 1 100 0 1 BIT_MASK 0x400 FORMAT "%13.11" ECU_ADDRESS 0x383B56 /end MEASUREMENT
/begin MEASUREMENT B_sidveu "Fehlertyp sig.: DV-E Fehler beim UMA-Lernen" UWORD B_TRUE 1 100 0 1 BIT_MASK 0x400 FORMAT "%13.11" ECU_ADDRESS 0x383B58 /end MEASUREMENT
/begin MEASUREMENT B_sidveub "Nicht benutzt" UWORD B_TRUE 1 100 0 1 BIT_MASK 0x400 FORMAT "%13.11" ECU_ADDRESS 0x383B5A /end MEASUREMENT
/begin MEASUREMENT B_sidveuw "Nicht benutzt" UWORD B_TRUE 1 100 0 1 BIT_MASK 0x400 FORMAT "%13.11" ECU_ADDRESS 0x383B5C /end MEASUREMENT
/begin MEASUREMENT B_sidvev "Fehlertyp sig.: DV-E Fehler bei Verstärkerabgleich" UWORD B_TRUE 1 100 0 1 BIT_MASK 0x400 FORMAT "%13.11" ECU_ADDRESS 0x383B5E /end MEASUREMENT
/begin MEASUREMENT B_sienws "Fehlerart: Leitungsabfall Nockenwellensteuerungsventil (Bank1, Einlaß)" UWORD B_TRUE 1 100 0 1 BIT_MASK 0x400 FORMAT "%13.11" ECU_ADDRESS 0x383B62 /end MEASUREMENT
/begin MEASUREMENT B_sienwse "Fehlerart: Leitungsabfall Nockenwellensteuerungsventil Endstufe (Bank1, Einlaß)" UWORD B_TRUE 1 100 0 1 BIT_MASK 0x400 FORMAT "%13.11" ECU_ADDRESS 0x383B64 /end MEASUREMENT
/begin MEASUREMENT B_siepcle "Fehlerart: Unterbrechung an EPCL-Endstufe" UWORD B_TRUE 1 100 0 1 BIT_MASK 0x400 FORMAT "%13.11" ECU_ADDRESS 0x383B66 /end MEASUREMENT
/begin MEASUREMENT B_sietre "Fehlertype: Leitungsabfall Endstufe el. Thermostat" UWORD B_TRUE 1 100 0 1 BIT_MASK 0x400 FORMAT "%13.11" ECU_ADDRESS 0x383B68 /end MEASUREMENT
/begin MEASUREMENT B_siev1 "Fehlerart: Unterbrechung an Endstufe EV1" UWORD B_TRUE 1 100 0 1 BIT_MASK 0x400 FORMAT "%13.11" ECU_ADDRESS 0x383B6A /end MEASUREMENT
/begin MEASUREMENT B_siev2 "Fehlerart: Unterbrechung an Endstufe EV2" UWORD B_TRUE 1 100 0 1 BIT_MASK 0x400 FORMAT "%13.11" ECU_ADDRESS 0x383B6C /end MEASUREMENT
/begin MEASUREMENT B_siev3 "Fehlerart: Unterbrechung an Endstufe EV3" UWORD B_TRUE 1 100 0 1 BIT_MASK 0x400 FORMAT "%13.11" ECU_ADDRESS 0x383B6E /end MEASUREMENT
/begin MEASUREMENT B_siev4 "Fehlerart: Unterbrechung an Endstufe EV4" UWORD B_TRUE 1 100 0 1 BIT_MASK 0x400 FORMAT "%13.11" ECU_ADDRESS 0x383B70 /end MEASUREMENT
/begin MEASUREMENT B_sifrao "Fehlertyp 'Signal fehlt' for FRAO erkannt" UWORD B_TRUE 1 100 0 1 BIT_MASK 0x400 FORMAT "%13.11" ECU_ADDRESS 0x383B78 /end MEASUREMENT
/begin MEASUREMENT B_sifrau "Fehlertyp 'Signal fehlt' für FRAU erkannt" UWORD B_TRUE 1 100 0 1 BIT_MASK 0x400 FORMAT "%13.11" ECU_ADDRESS 0x383B7A /end MEASUREMENT
/begin MEASUREMENT B_sifrst "Fehlerart: LR-Abweichung" UWORD B_TRUE 1 100 0 1 BIT_MASK 0x400 FORMAT "%13.11" ECU_ADDRESS 0x383B7C /end MEASUREMENT
/begin MEASUREMENT B_sihsh "Lastabfall Sondenheizung hinter Kat" UWORD B_TRUE 1 100 0 1 BIT_MASK 0x400 FORMAT "%13.11" ECU_ADDRESS 0x383B86 /end MEASUREMENT
/begin MEASUREMENT B_sihsh2 "Lastabfall Sondenheizung2 hinter Kat" UWORD B_TRUE 1 100 0 1 BIT_MASK 0x400 FORMAT "%13.11" ECU_ADDRESS 0x383B88 /end MEASUREMENT
/begin MEASUREMENT B_sihshe "Lastabfall Sondenheizung hinter Kat (Endstufe)" UWORD B_TRUE 1 100 0 1 BIT_MASK 0x400 FORMAT "%13.11" ECU_ADDRESS 0x383B8A /end MEASUREMENT
/begin MEASUREMENT B_sihsv "Lastabfall Sondenheizung vor Kat" UWORD B_TRUE 1 100 0 1 BIT_MASK 0x400 FORMAT "%13.11" ECU_ADDRESS 0x383B8C /end MEASUREMENT
/begin MEASUREMENT B_sihsv2 "Lastabfall Sondenheizung2 vor Kat" UWORD B_TRUE 1 100 0 1 BIT_MASK 0x400 FORMAT "%13.11" ECU_ADDRESS 0x383B8E /end MEASUREMENT
/begin MEASUREMENT B_sihsvsa "Signal - Fehler erkannt" UWORD B_TRUE 1 100 0 1 BIT_MASK 0x400 FORMAT "%13.11" ECU_ADDRESS 0x383B90 /end MEASUREMENT
/begin MEASUREMENT B_sihsvsa2 "Signal - Fehler erkannt Bank 2" UWORD B_TRUE 1 100 0 1 BIT_MASK 0x400 FORMAT "%13.11" ECU_ADDRESS 0x383B92 /end MEASUREMENT
/begin MEASUREMENT B_sikat "Bedingung Fehlertyp 'Signal fehlt' erkannt (Katalysator)" UWORD B_TRUE 1 100 0 1 BIT_MASK 0x400 FORMAT "%13.11" ECU_ADDRESS 0x383B94 /end MEASUREMENT
/begin MEASUREMENT B_sikpe "Bedingung für Fehlertyp Leitungsabfall für EKP-Relais Endstufe erkannt" UWORD B_TRUE 1 100 0 1 BIT_MASK 0x400 FORMAT "%13.11" ECU_ADDRESS 0x383B96 /end MEASUREMENT
/begin MEASUREMENT B_sikrnt "Fehlertyp: Klopfregelung Nulltest" UWORD B_TRUE 1 100 0 1 BIT_MASK 0x400 FORMAT "%13.11" ECU_ADDRESS 0x383BA0 /end MEASUREMENT
/begin MEASUREMENT B_sikrof "Fehlertyp: Klopfregelung Offset" UWORD B_TRUE 1 100 0 1 BIT_MASK 0x400 FORMAT "%13.11" ECU_ADDRESS 0x383BA2 /end MEASUREMENT
/begin MEASUREMENT B_sikrtp "Fehlertyp: Klopfregelung Testimpuls" UWORD B_TRUE 1 100 0 1 BIT_MASK 0x400 FORMAT "%13.11" ECU_ADDRESS 0x383BA4 /end MEASUREMENT
/begin MEASUREMENT B_siks1 "Fehlertyp: Klopfsensor 1" UWORD B_TRUE 1 100 0 1 BIT_MASK 0x400 FORMAT "%13.11" ECU_ADDRESS 0x383BA6 /end MEASUREMENT
/begin MEASUREMENT B_siks2 "Fehlertyp: Klopfsensor 2" UWORD B_TRUE 1 100 0 1 BIT_MASK 0x400 FORMAT "%13.11" ECU_ADDRESS 0x383BA8 /end MEASUREMENT
/begin MEASUREMENT B_siks3 "Fehlertyp: Klopfsensor 3" UWORD B_TRUE 1 100 0 1 BIT_MASK 0x400 FORMAT "%13.11" ECU_ADDRESS 0x383BAA /end MEASUREMENT
/begin MEASUREMENT B_siks4 "Fehlertyp: Klopfsensor 4" UWORD B_TRUE 1 100 0 1 BIT_MASK 0x400 FORMAT "%13.11" ECU_ADDRESS 0x383BAC /end MEASUREMENT
/begin MEASUREMENT B_sikuppl "Fehlertyp KUPPL: Signal inaktiv" UWORD B_TRUE 1 100 0 1 BIT_MASK 0x400 FORMAT "%13.11" ECU_ADDRESS 0x383BAE /end MEASUREMENT
/begin MEASUREMENT B_silde "Fehlertyp: Leitungsabfall LDR-Taktventil" UWORD B_TRUE 1 100 0 1 BIT_MASK 0x400 FORMAT "%13.11" ECU_ADDRESS 0x383BB2 /end MEASUREMENT
/begin MEASUREMENT B_silue1 "Fehlertyp: Kurzschluss am Lüftereinheit 1" UWORD B_TRUE 1 100 0 1 BIT_MASK 0x400 FORMAT "%13.11" ECU_ADDRESS 0x383BC8 /end MEASUREMENT
/begin MEASUREMENT B_silues1e "Fehlertype: Leitungsabfall Endstufe Lüftersteuerung 1" UWORD B_TRUE 1 100 0 1 BIT_MASK 0x400 FORMAT "%13.11" ECU_ADDRESS 0x383BCA /end MEASUREMENT
/begin MEASUREMENT B_simile "Fehlerart: Unterbrechung an MIL-Endstufe" UWORD B_TRUE 1 100 0 1 BIT_MASK 0x400 FORMAT "%13.11" ECU_ADDRESS 0x383BDA /end MEASUREMENT
/begin MEASUREMENT B_sinwse "Fehlerart: Leitungsabfall Nockenwellensteuerungsventil Endstufe" UWORD B_TRUE 1 100 0 1 BIT_MASK 0x400 FORMAT "%13.11" ECU_ADDRESS 0x383BE0 /end MEASUREMENT
/begin MEASUREMENT B_sirkat "Fehlertyp 'Signal fehlt' for RKAT erkannt" UWORD B_TRUE 1 100 0 1 BIT_MASK 0x400 FORMAT "%13.11" ECU_ADDRESS 0x383BE8 /end MEASUREMENT
/begin MEASUREMENT B_sirkaz "Fehlertyp 'Signal fehlt' for RKAZ erkannt" UWORD B_TRUE 1 100 0 1 BIT_MASK 0x400 FORMAT "%13.11" ECU_ADDRESS 0x383BEA /end MEASUREMENT
/begin MEASUREMENT B_sislpe "Fehlertype: Leitungsabfall Endstufe Sekundärluftpumpe" UWORD B_TRUE 1 100 0 1 BIT_MASK 0x400 FORMAT "%13.11" ECU_ADDRESS 0x383BF2 /end MEASUREMENT
/begin MEASUREMENT B_sislve "Fehlertype: Leitungsabfall Endstufe Sekundärluftventil" UWORD B_TRUE 1 100 0 1 BIT_MASK 0x400 FORMAT "%13.11" ECU_ADDRESS 0x383BF8 /end MEASUREMENT
/begin MEASUREMENT B_siteve "Fehlertyp: Leitungsabfall Tankentlüftungsventil Endstufe" UWORD B_TRUE 1 100 0 1 BIT_MASK 0x400 FORMAT "%13.11" ECU_ADDRESS 0x383C08 /end MEASUREMENT
/begin MEASUREMENT B_siuvse "Fehlertyp: Leitungsabfall Umluftventil turbo" UWORD B_TRUE 1 100 0 1 BIT_MASK 0x400 FORMAT "%13.11" ECU_ADDRESS 0x383C26 /end MEASUREMENT
/begin MEASUREMENT B_sizet1 "Fehler Zündendstufentreiber Lastabfall" UWORD B_TRUE 1 100 0 1 BIT_MASK 0x400 FORMAT "%13.11" ECU_ADDRESS 0x383C2E /end MEASUREMENT
/begin MEASUREMENT B_sizet2 "" UWORD B_TRUE 1 100 0 1 BIT_MASK 0x400 FORMAT "%13.11" ECU_ADDRESS 0x383C30 /end MEASUREMENT
/begin MEASUREMENT B_sizet3 "" UWORD B_TRUE 1 100 0 1 BIT_MASK 0x400 FORMAT "%13.11" ECU_ADDRESS 0x383C32 /end MEASUREMENT
/begin MEASUREMENT B_sizet4 "" UWORD B_TRUE 1 100 0 1 BIT_MASK 0x400 FORMAT "%13.11" ECU_ADDRESS 0x383C34 /end MEASUREMENT
/begin MEASUREMENT E_aaa "Dummy: Tabellenanfang" UWORD B_TRUE 1 100 0 1 BIT_MASK 0x1 FORMAT "%13.11" ECU_ADDRESS 0x383B06 /end MEASUREMENT
/begin MEASUREMENT E_agre "Errorflag: Überwachung AGR-Endstufe" UWORD B_TRUE 1 100 0 1 BIT_MASK 0x1 FORMAT "%13.11" ECU_ADDRESS 0x383B0A /end MEASUREMENT
/begin MEASUREMENT E_bkvpe "Fehlerflag: BKV-Pumpe-Endstufe" UWORD B_TRUE 1 100 0 1 BIT_MASK 0x1 FORMAT "%13.11" ECU_ADDRESS 0x383B1C /end MEASUREMENT
/begin MEASUREMENT E_dk "Errorflag: DK - Potentiometer" UWORD B_TRUE 1 100 0 1 BIT_MASK 0x1 FORMAT "%13.11" ECU_ADDRESS 0x383B38 /end MEASUREMENT
/begin MEASUREMENT E_dk1p "Errorflag: Drosselklappe 1. Poti" UWORD B_TRUE 1 100 0 1 BIT_MASK 0x1 FORMAT "%13.11" ECU_ADDRESS 0x383B3A /end MEASUREMENT
/begin MEASUREMENT E_dk2p "Errorflag: Drosselklappe 2. Poti" UWORD B_TRUE 1 100 0 1 BIT_MASK 0x1 FORMAT "%13.11" ECU_ADDRESS 0x383B3C /end MEASUREMENT
/begin MEASUREMENT E_dvee "Errorflag: DV-E Endstufe" UWORD B_TRUE 1 100 0 1 BIT_MASK 0x1 FORMAT "%13.11" ECU_ADDRESS 0x383B4A /end MEASUREMENT
/begin MEASUREMENT E_dvef "Errorflag: DV-E Fehler bei Federprüfung" UWORD B_TRUE 1 100 0 1 BIT_MASK 0x1 FORMAT "%13.11" ECU_ADDRESS 0x383B4C /end MEASUREMENT
/begin MEASUREMENT E_dvefo "Errorflag: DV-E-Fehler bei Federprüfung ""Öffnen""" UWORD B_TRUE 1 100 0 1 BIT_MASK 0x1 FORMAT "%13.11" ECU_ADDRESS 0x383B4E /end MEASUREMENT
/begin MEASUREMENT E_dvel "Errorflag: DV-E Lageabweichung" UWORD B_TRUE 1 100 0 1 BIT_MASK 0x1 FORMAT "%13.11" ECU_ADDRESS 0x383B50 /end MEASUREMENT
/begin MEASUREMENT E_dven "Errorflag: DV-E Fehler bei Prüfung Notluftposition" UWORD B_TRUE 1 100 0 1 BIT_MASK 0x1 FORMAT "%13.11" ECU_ADDRESS 0x383B52 /end MEASUREMENT
/begin MEASUREMENT E_dver "Errorflag: DV-E Regelbereich" UWORD B_TRUE 1 100 0 1 BIT_MASK 0x1 FORMAT "%13.11" ECU_ADDRESS 0x383B54 /end MEASUREMENT
/begin MEASUREMENT E_dvet "Errorflag: DV-E-Tauscherkennung ohne Adaption" UWORD B_TRUE 1 100 0 1 BIT_MASK 0x1 FORMAT "%13.11" ECU_ADDRESS 0x383B56 /end MEASUREMENT
/begin MEASUREMENT E_dveu "Errorflag: DV-E Fehler beim UMA-Lernen" UWORD B_TRUE 1 100 0 1 BIT_MASK 0x1 FORMAT "%13.11" ECU_ADDRESS 0x383B58 /end MEASUREMENT
/begin MEASUREMENT E_dveub "Errorflag: DV-E-Adaption Abbruch wg. Umweltbedingung" UWORD B_TRUE 1 100 0 1 BIT_MASK 0x1 FORMAT "%13.11" ECU_ADDRESS 0x383B5A /end MEASUREMENT
/begin MEASUREMENT E_dveuw "Errorflag: Fehler bei UMA-Wiederlernen" UWORD B_TRUE 1 100 0 1 BIT_MASK 0x1 FORMAT "%13.11" ECU_ADDRESS 0x383B5C /end MEASUREMENT
/begin MEASUREMENT E_dvev "Errorflag: DV-E Fehler bei Verstärkerabgleich" UWORD B_TRUE 1 100 0 1 BIT_MASK 0x1 FORMAT "%13.11" ECU_ADDRESS 0x383B5E /end MEASUREMENT
/begin MEASUREMENT E_egfe "Errorflag: Eingangsgrößen Füllungserfassung" UWORD B_TRUE 1 100 0 1 BIT_MASK 0x1 FORMAT "%13.11" ECU_ADDRESS 0x383B60 /end MEASUREMENT
/begin MEASUREMENT E_enws "Errorflag: Nockenwellensteuerung (Einlaß,Bank1)" UWORD B_TRUE 1 100 0 1 BIT_MASK 0x1 FORMAT "%13.11" ECU_ADDRESS 0x383B62 /end MEASUREMENT
/begin MEASUREMENT E_enwse "Errorflag: Endstufe Nockenwellensteuerung (Einlaß, Bank1)" UWORD B_TRUE 1 100 0 1 BIT_MASK 0x1 FORMAT "%13.11" ECU_ADDRESS 0x383B64 /end MEASUREMENT
/begin MEASUREMENT E_epcle "Fehlerflag: EPCL-Endstufe" UWORD B_TRUE 1 100 0 1 BIT_MASK 0x1 FORMAT "%13.11" ECU_ADDRESS 0x383B66 /end MEASUREMENT
/begin MEASUREMENT E_etre "Errorflag: El. Thermostat (Endstufe)" UWORD B_TRUE 1 100 0 1 BIT_MASK 0x1 FORMAT "%13.11" ECU_ADDRESS 0x383B68 /end MEASUREMENT
/begin MEASUREMENT E_ev1 "Errorflag: EV von Zyl. 1" UWORD B_TRUE 1 100 0 1 BIT_MASK 0x1 FORMAT "%13.11" ECU_ADDRESS 0x383B6A /end MEASUREMENT
/begin MEASUREMENT E_ev2 "Errorflag: EV von Zyl. 2" UWORD B_TRUE 1 100 0 1 BIT_MASK 0x1 FORMAT "%13.11" ECU_ADDRESS 0x383B6C /end MEASUREMENT
/begin MEASUREMENT E_ev3 "Errorflag: EV von Zyl. 3" UWORD B_TRUE 1 100 0 1 BIT_MASK 0x1 FORMAT "%13.11" ECU_ADDRESS 0x383B6E /end MEASUREMENT
/begin MEASUREMENT E_ev4 "Errorflag: EV von Zyl. 4" UWORD B_TRUE 1 100 0 1 BIT_MASK 0x1 FORMAT "%13.11" ECU_ADDRESS 0x383B70 /end MEASUREMENT
/begin MEASUREMENT E_frao "Errorflag: LR-Adaption oberer multiplikativer Bereich" UWORD B_TRUE 1 100 0 1 BIT_MASK 0x1 FORMAT "%13.11" ECU_ADDRESS 0x383B78 /end MEASUREMENT
/begin MEASUREMENT E_frau "Errorflag: LR-Adaption unterer multiplikativer Bereich" UWORD B_TRUE 1 100 0 1 BIT_MASK 0x1 FORMAT "%13.11" ECU_ADDRESS 0x383B7A /end MEASUREMENT
/begin MEASUREMENT E_frst "Errorflag: Fehler aus Diagnose Kraftstoffversorgungssystem (Kurztest)" UWORD B_TRUE 1 100 0 1 BIT_MASK 0x1 FORMAT "%13.11" ECU_ADDRESS 0x383B7C /end MEASUREMENT
/begin MEASUREMENT E_hsh "Errorflag: Lambdasonden-Heizung hinter Katalysator" UWORD B_TRUE 1 100 0 1 BIT_MASK 0x1 FORMAT "%13.11" ECU_ADDRESS 0x383B86 /end MEASUREMENT
/begin MEASUREMENT E_hsh2 "Errorflag: Lambdasonden-Heizung hinter Katalysator Bank 2" UWORD B_TRUE 1 100 0 1 BIT_MASK 0x1 FORMAT "%13.11" ECU_ADDRESS 0x383B88 /end MEASUREMENT
/begin MEASUREMENT E_hshe "Errorflag: Lambdasonden-Heizung hinter Katalysator (Endstufe)" UWORD B_TRUE 1 100 0 1 BIT_MASK 0x1 FORMAT "%13.11" ECU_ADDRESS 0x383B8A /end MEASUREMENT
/begin MEASUREMENT E_hsv "Errorflag: Lambdasonden-Heizung vor Katalysator" UWORD B_TRUE 1 100 0 1 BIT_MASK 0x1 FORMAT "%13.11" ECU_ADDRESS 0x383B8C /end MEASUREMENT
/begin MEASUREMENT E_hsv2 "Errorflag: Lambdasonden-Heizung vor Katalysator Bank 2" UWORD B_TRUE 1 100 0 1 BIT_MASK 0x1 FORMAT "%13.11" ECU_ADDRESS 0x383B8E /end MEASUREMENT
/begin MEASUREMENT E_hsvsa "Errorflag: reduzierte  LSU-Heizung oder LSU-Kennlinie abgeflacht" UWORD B_TRUE 1 100 0 1 BIT_MASK 0x1 FORMAT "%13.11" ECU_ADDRESS 0x383B90 /end MEASUREMENT
/begin MEASUREMENT E_hsvsa2 "Errorflag: reduzierte  LSU_2-Heizung oder LSU_2-Kennlinie abgeflacht" UWORD B_TRUE 1 100 0 1 BIT_MASK 0x1 FORMAT "%13.11" ECU_ADDRESS 0x383B92 /end MEASUREMENT
/begin MEASUREMENT E_kat "Errorflag: Katalysator-Konvertierung" UWORD B_TRUE 1 100 0 1 BIT_MASK 0x1 FORMAT "%13.11" ECU_ADDRESS 0x383B94 /end MEASUREMENT
/begin MEASUREMENT E_kpe "Errorflag: EKP-Relais Endstufe" UWORD B_TRUE 1 100 0 1 BIT_MASK 0x1 FORMAT "%13.11" ECU_ADDRESS 0x383B96 /end MEASUREMENT
/begin MEASUREMENT E_kra01 "Errorflag: Klopfregelanschlag Zyl.1" UWORD B_TRUE 1 100 0 1 BIT_MASK 0x1 FORMAT "%13.11" ECU_ADDRESS 0x383B98 /end MEASUREMENT
/begin MEASUREMENT E_kra02 "Errorflag: Klopfregelanschlag Zyl.2" UWORD B_TRUE 1 100 0 1 BIT_MASK 0x1 FORMAT "%13.11" ECU_ADDRESS 0x383B9A /end MEASUREMENT
/begin MEASUREMENT E_kra03 "Errorflag: Klopfregelanschlag Zyl.3" UWORD B_TRUE 1 100 0 1 BIT_MASK 0x1 FORMAT "%13.11" ECU_ADDRESS 0x383B9C /end MEASUREMENT
/begin MEASUREMENT E_kra04 "Errorflag: Klopfregelanschlag Zyl.4" UWORD B_TRUE 1 100 0 1 BIT_MASK 0x1 FORMAT "%13.11" ECU_ADDRESS 0x383B9E /end MEASUREMENT
/begin MEASUREMENT E_krnt "Errorflag: Klopfregelung Nulltest" UWORD B_TRUE 1 100 0 1 BIT_MASK 0x1 FORMAT "%13.11" ECU_ADDRESS 0x383BA0 /end MEASUREMENT
/begin MEASUREMENT E_krof "Errorflag: Klopfregelung Offset" UWORD B_TRUE 1 100 0 1 BIT_MASK 0x1 FORMAT "%13.11" ECU_ADDRESS 0x383BA2 /end MEASUREMENT
/begin MEASUREMENT E_krtp "Errorflag: Klopfregelung Testimpuls" UWORD B_TRUE 1 100 0 1 BIT_MASK 0x1 FORMAT "%13.11" ECU_ADDRESS 0x383BA4 /end MEASUREMENT
/begin MEASUREMENT E_ks1 "Errorflag: Klopfsensor 1" UWORD B_TRUE 1 100 0 1 BIT_MASK 0x1 FORMAT "%13.11" ECU_ADDRESS 0x383BA6 /end MEASUREMENT
/begin MEASUREMENT E_ks2 "Errorflag: Klopfsensor 2" UWORD B_TRUE 1 100 0 1 BIT_MASK 0x1 FORMAT "%13.11" ECU_ADDRESS 0x383BA8 /end MEASUREMENT
/begin MEASUREMENT E_ks3 "Errorflag: Klopfsensor 3" UWORD B_TRUE 1 100 0 1 BIT_MASK 0x1 FORMAT "%13.11" ECU_ADDRESS 0x383BAA /end MEASUREMENT
/begin MEASUREMENT E_ks4 "Errorflag: Klopfsensor 4" UWORD B_TRUE 1 100 0 1 BIT_MASK 0x1 FORMAT "%13.11" ECU_ADDRESS 0x383BAC /end MEASUREMENT
/begin MEASUREMENT E_kuppl "Fehlerflag: Gebergröße Kupplung" UWORD B_TRUE 1 100 0 1 BIT_MASK 0x1 FORMAT "%13.11" ECU_ADDRESS 0x383BAE /end MEASUREMENT
/begin MEASUREMENT E_lde "Errorflag: Ladedrucksteuerventil (Endstufe)" UWORD B_TRUE 1 100 0 1 BIT_MASK 0x1 FORMAT "%13.11" ECU_ADDRESS 0x383BB2 /end MEASUREMENT
/begin MEASUREMENT E_lue1 "Fehler Endstufe Lüfter 1" UWORD B_TRUE 1 100 0 1 BIT_MASK 0x1 FORMAT "%13.11" ECU_ADDRESS 0x383BC8 /end MEASUREMENT
/begin MEASUREMENT E_lues1e "Errorflag: Lüftersteuerung 1 (Endstufe)" UWORD B_TRUE 1 100 0 1 BIT_MASK 0x1 FORMAT "%13.11" ECU_ADDRESS 0x383BCA /end MEASUREMENT
/begin MEASUREMENT E_mile "Fehlerflag: MIL-Endstufe" UWORD B_TRUE 1 100 0 1 BIT_MASK 0x1 FORMAT "%13.11" ECU_ADDRESS 0x383BDA /end MEASUREMENT
/begin MEASUREMENT E_nwse "Errorflag: Summenfehler Nockenwelle(n) Einlass" UWORD B_TRUE 1 100 0 1 BIT_MASK 0x1 FORMAT "%13.11" ECU_ADDRESS 0x383BE0 /end MEASUREMENT
/begin MEASUREMENT E_rkat "Errorflag DKVS (additive Korrektur pro Zeit)" UWORD B_TRUE 1 100 0 1 BIT_MASK 0x1 FORMAT "%13.11" ECU_ADDRESS 0x383BE8 /end MEASUREMENT
/begin MEASUREMENT E_rkaz "Errorflag DKVS (additive Korrektur pro Zündung)" UWORD B_TRUE 1 100 0 1 BIT_MASK 0x1 FORMAT "%13.11" ECU_ADDRESS 0x383BEA /end MEASUREMENT
/begin MEASUREMENT E_slpe "Errorflag: Sekundärluftpumpe (Endstufe)" UWORD B_TRUE 1 100 0 1 BIT_MASK 0x1 FORMAT "%13.11" ECU_ADDRESS 0x383BF2 /end MEASUREMENT
/begin MEASUREMENT E_slve "Errorflag: Sekundärluftventil (Endstufe)" UWORD B_TRUE 1 100 0 1 BIT_MASK 0x1 FORMAT "%13.11" ECU_ADDRESS 0x383BF8 /end MEASUREMENT
/begin MEASUREMENT E_teve "Errorflag: Tankentlüftungsventil Endstufe" UWORD B_TRUE 1 100 0 1 BIT_MASK 0x1 FORMAT "%13.11" ECU_ADDRESS 0x383C08 /end MEASUREMENT
/begin MEASUREMENT E_uvse "Errorflag: Endstufe Umluftventil Turbo" UWORD B_TRUE 1 100 0 1 BIT_MASK 0x1 FORMAT "%13.11" ECU_ADDRESS 0x383C26 /end MEASUREMENT
/begin MEASUREMENT E_zet1 "Errorflag: Zündtreiber ZUE1" UWORD B_TRUE 1 100 0 1 BIT_MASK 0x1 FORMAT "%13.11" ECU_ADDRESS 0x383C2E /end MEASUREMENT
/begin MEASUREMENT E_zet2 "Errorflag: Zündtreiber ZUE2" UWORD B_TRUE 1 100 0 1 BIT_MASK 0x1 FORMAT "%13.11" ECU_ADDRESS 0x383C30 /end MEASUREMENT
/begin MEASUREMENT E_zet3 "Errorflag: Zündtreiber ZUE3" UWORD B_TRUE 1 100 0 1 BIT_MASK 0x1 FORMAT "%13.11" ECU_ADDRESS 0x383C32 /end MEASUREMENT
/begin MEASUREMENT E_zet4 "Errorflag: Zündtreiber ZUE4" UWORD B_TRUE 1 100 0 1 BIT_MASK 0x1 FORMAT "%13.11" ECU_ADDRESS 0x383C34 /end MEASUREMENT
/begin MEASUREMENT sfpaaa "Status Fehlerpfad: Tabellenanfang" UWORD dez 1 100 0 65535 FORMAT "%8.2" ECU_ADDRESS 0x383B06 /end MEASUREMENT
/begin MEASUREMENT sfpagre "Status Fehlerpfad: AGR-Ventil Endstufe" UWORD default 1 100 0 65535 FORMAT "%8.2" ECU_ADDRESS 0x383B0A /end MEASUREMENT
/begin MEASUREMENT sfpbkvpe "Status Fehlerpfad: BKV-Pumpe - Endstufe" UWORD default 1 100 0 65535 FORMAT "%8.2" ECU_ADDRESS 0x383B1C /end MEASUREMENT
/begin MEASUREMENT sfpdk "Status Fehlerpfad DK: Drosselklappe" UWORD dez 1 100 0 65535 FORMAT "%8.2" ECU_ADDRESS 0x383B38 /end MEASUREMENT
/begin MEASUREMENT sfpdk1p "Status Fehlerpfad DK1P: Drosselklappe 1. Poti" UWORD dez 1 100 0 65535 FORMAT "%8.2" ECU_ADDRESS 0x383B3A /end MEASUREMENT
/begin MEASUREMENT sfpdk2p "Status Fehlerpfad DK2P: Drosselklappe 2. Poti" UWORD dez 1 100 0 65535 FORMAT "%8.2" ECU_ADDRESS 0x383B3C /end MEASUREMENT
/begin MEASUREMENT sfpdvee "Statuswort: DV-E Endstufe" UWORD dez 1 100 0 65535 FORMAT "%8.2" ECU_ADDRESS 0x383B4A /end MEASUREMENT
/begin MEASUREMENT sfpdvef "Statuswort: DV-E Fehler bei Federprüfung" UWORD dez 1 100 0 65535 FORMAT "%8.2" ECU_ADDRESS 0x383B4C /end MEASUREMENT
/begin MEASUREMENT sfpdvefo "Statuswort: DV-E-Fehler bei Federprüfung ""Öffnen""" UWORD dez 1 100 0 65535 FORMAT "%8.2" ECU_ADDRESS 0x383B4E /end MEASUREMENT
/begin MEASUREMENT sfpdvel "Statuswort: DV-E Lageabweichung" UWORD dez 1 100 0 65535 FORMAT "%8.2" ECU_ADDRESS 0x383B50 /end MEASUREMENT
/begin MEASUREMENT sfpdven "Statuswort: DV-E Fehler bei Prüfung Notluftposition" UWORD dez 1 100 0 65535 FORMAT "%8.2" ECU_ADDRESS 0x383B52 /end MEASUREMENT
/begin MEASUREMENT sfpdver "Statuswort: DV-E Regelbereich" UWORD dez 1 100 0 65535 FORMAT "%8.2" ECU_ADDRESS 0x383B54 /end MEASUREMENT
/begin MEASUREMENT sfpdvet "Statuswort: DV-E-Tauscherkennung ohne Adaption" UWORD dez 1 100 0 65535 FORMAT "%8.2" ECU_ADDRESS 0x383B56 /end MEASUREMENT
/begin MEASUREMENT sfpdveu "Statuswort: DV-E Fehler beim UMA-Lernen" UWORD dez 1 100 0 65535 FORMAT "%8.2" ECU_ADDRESS 0x383B58 /end MEASUREMENT
/begin MEASUREMENT sfpdveub "Statuswort: DV-E-Adaption Abbruch wg. Umweltbedingung" UWORD dez 1 100 0 65535 FORMAT "%8.2" ECU_ADDRESS 0x383B5A /end MEASUREMENT
/begin MEASUREMENT sfpdveuw "Statuswort: UMA-Wiederlernen" UWORD dez 1 100 0 65535 FORMAT "%8.2" ECU_ADDRESS 0x383B5C /end MEASUREMENT
/begin MEASUREMENT sfpdvev "Statuswort: DV-E Fehler bei Verstärkerabgleich" UWORD dez 1 100 0 65535 FORMAT "%8.2" ECU_ADDRESS 0x383B5E /end MEASUREMENT
/begin MEASUREMENT sfpegfe "Status Fehlerpfad: Diagose der Eingangsgrößen der Füllungserfassung" UWORD default 1 100 0 65535 FORMAT "%8.2" ECU_ADDRESS 0x383B60 /end MEASUREMENT
/begin MEASUREMENT sfpenws "Status Fehlerpfad: Nockenwellensteuerung (Einlaß, Bank1)" UWORD dez 1 100 0 65535 FORMAT "%8.2" ECU_ADDRESS 0x383B62 /end MEASUREMENT
/begin MEASUREMENT sfpenwse "Status Fehlerpfad: Nockenwellensteuerung Endstufe (Einlaß, Bank1)" UWORD default 1 100 0 65535 FORMAT "%8.2" ECU_ADDRESS 0x383B64 /end MEASUREMENT
/begin MEASUREMENT sfpepcle "Status Fehlerpfad: Fahrverhaltens-Fehllampe Endstufe" UWORD default 1 100 0 65535 FORMAT "%8.2" ECU_ADDRESS 0x383B66 /end MEASUREMENT
/begin MEASUREMENT sfpetre "Status Fehlerpfad: Elektro Thermostat Regelung Endstufe" UWORD default 1 100 0 65535 FORMAT "%8.2" ECU_ADDRESS 0x383B68 /end MEASUREMENT
/begin MEASUREMENT sfpev1 "Status Fehlerpfad: EV1" UWORD default 1 100 0 65535 FORMAT "%8.2" ECU_ADDRESS 0x383B6A /end MEASUREMENT
/begin MEASUREMENT sfpev2 "Status Fehlerpfad: EV2" UWORD default 1 100 0 65535 FORMAT "%8.2" ECU_ADDRESS 0x383B6C /end MEASUREMENT
/begin MEASUREMENT sfpev3 "Status Fehlerpfad: EV3" UWORD default 1 100 0 65535 FORMAT "%8.2" ECU_ADDRESS 0x383B6E /end MEASUREMENT
/begin MEASUREMENT sfpev4 "Status Fehlerpfad: EV4" UWORD default 1 100 0 65535 FORMAT "%8.2" ECU_ADDRESS 0x383B70 /end MEASUREMENT
/begin MEASUREMENT sfpfrao "Status Fehlerpfad: LR-Adaption oberer multiplikativer Bereich" UWORD dez 1 100 0 65535 FORMAT "%8.2" ECU_ADDRESS 0x383B78 /end MEASUREMENT
/begin MEASUREMENT sfpfrau "Status Fehlerpfad: LR Adaption unterer multiplikativer Bereich" UWORD dez 1 100 0 65535 FORMAT "%8.2" ECU_ADDRESS 0x383B7A /end MEASUREMENT
/begin MEASUREMENT sfpfrst "Status Fehlerpfad: LR-Abweichung" UWORD dez 1 100 0 65535 FORMAT "%8.2" ECU_ADDRESS 0x383B7C /end MEASUREMENT
/begin MEASUREMENT sfphsh "Status Fehlerpfad: Heizung Lambdasonde hinter Kat" UWORD dez 1 100 0 65535 FORMAT "%8.2" ECU_ADDRESS 0x383B86 /end MEASUREMENT
/begin MEASUREMENT sfphsh2 "Status Fehlerpfad: Heizung Lambdasonde 2 hinter Kat" UWORD dez 1 100 0 65535 FORMAT "%8.2" ECU_ADDRESS 0x383B88 /end MEASUREMENT
/begin MEASUREMENT sfphshe "Status Fehlerpfad: Endstufe Heizung Lambdasonde hinter Kat" UWORD default 1 100 0 65535 FORMAT "%8.2" ECU_ADDRESS 0x383B8A /end MEASUREMENT
/begin MEASUREMENT sfphsv "Status Fehlerpfad: Heizung Lambdasonde vor Kat" UWORD dez 1 100 0 65535 FORMAT "%8.2" ECU_ADDRESS 0x383B8C /end MEASUREMENT
/begin MEASUREMENT sfphsv2 "Status Fehlerpfad: Heizung Lambdasonde 2 vor Kat" UWORD dez 1 100 0 65535 FORMAT "%8.2" ECU_ADDRESS 0x383B8E /end MEASUREMENT
/begin MEASUREMENT sfphsvsa "Status Fehlerpfad: Heizung Lambdasonde vor Kat" UWORD dez 1 100 0 65535 FORMAT "%8.2" ECU_ADDRESS 0x383B90 /end MEASUREMENT
/begin MEASUREMENT sfphsvsa2 "Status Fehlerpfad: Heizung Lambdasonde 2 vor Kat" UWORD dez 1 100 0 65535 FORMAT "%8.2" ECU_ADDRESS 0x383B92 /end MEASUREMENT
/begin MEASUREMENT sfpkat "Status Fehlerpfad: Katalysator-Überwachung" UWORD dez 1 100 0 65535 FORMAT "%8.2" ECU_ADDRESS 0x383B94 /end MEASUREMENT
/begin MEASUREMENT sfpkpe "Status Fehlerpfad: EKP-Relais Endstufe" UWORD default 1 100 0 65535 FORMAT "%8.2" ECU_ADDRESS 0x383B96 /end MEASUREMENT
/begin MEASUREMENT sfpkra01 "Status Fehlerpfad: Klopfregelanschlag Zylinder 1" UWORD dez 1 100 0 65535 FORMAT "%8.2" ECU_ADDRESS 0x383B98 /end MEASUREMENT
/begin MEASUREMENT sfpkra02 "Status Fehlerpfad: Klopfregelanschlag Zylinder 2" UWORD dez 1 100 0 65535 FORMAT "%8.2" ECU_ADDRESS 0x383B9A /end MEASUREMENT
/begin MEASUREMENT sfpkra03 "Status Fehlerpfad: Klopfregelanschlag Zylinder 3" UWORD dez 1 100 0 65535 FORMAT "%8.2" ECU_ADDRESS 0x383B9C /end MEASUREMENT
/begin MEASUREMENT sfpkra04 "Status Fehlerpfad: Klopfregelanschlag Zylinder 4" UWORD dez 1 100 0 65535 FORMAT "%8.2" ECU_ADDRESS 0x383B9E /end MEASUREMENT
/begin MEASUREMENT sfpkrnt "Status Fehlerpfad: Klopfregelung Nulltest" UWORD dez 1 100 0 65535 FORMAT "%8.2" ECU_ADDRESS 0x383BA0 /end MEASUREMENT
/begin MEASUREMENT sfpkrof "Status Fehlerpfad: Klopfregelung Offset" UWORD dez 1 100 0 65535 FORMAT "%8.2" ECU_ADDRESS 0x383BA2 /end MEASUREMENT
/begin MEASUREMENT sfpkrtp "Status Fehlerpfad: Klopfregelung Testimpuls" UWORD dez 1 100 0 65535 FORMAT "%8.2" ECU_ADDRESS 0x383BA4 /end MEASUREMENT
/begin MEASUREMENT sfpks1 "Status Fehlerpfad: Klopfsensor 1" UWORD dez 1 100 0 65535 FORMAT "%8.2" ECU_ADDRESS 0x383BA6 /end MEASUREMENT
/begin MEASUREMENT sfpks2 "Status Fehlerpfad: Klopfsensor 2" UWORD dez 1 100 0 65535 FORMAT "%8.2" ECU_ADDRESS 0x383BA8 /end MEASUREMENT
/begin MEASUREMENT sfpks3 "Status Fehlerpfad: Klopfsensor 3" UWORD dez 1 100 0 65535 FORMAT "%8.2" ECU_ADDRESS 0x383BAA /end MEASUREMENT
/begin MEASUREMENT sfpks4 "Status Fehlerpfad: Klopfsensor 4" UWORD dez 1 100 0 65535 FORMAT "%8.2" ECU_ADDRESS 0x383BAC /end MEASUREMENT
/begin MEASUREMENT sfpkuppl "Status Fehlerpfad KUPPL: Gebergröße Kupplung" UWORD dez 1 100 0 65535 FORMAT "%8.2" ECU_ADDRESS 0x383BAE /end MEASUREMENT
/begin MEASUREMENT sfplde "Status Fehlerpfad: Ladedrucksteuerventil Endstufe" UWORD default 1 100 0 65535 FORMAT "%8.2" ECU_ADDRESS 0x383BB2 /end MEASUREMENT
/begin MEASUREMENT sfplue1 "Status Fehlerpfad: Lüfter 1" UWORD dez 1 100 0 65535 FORMAT "%8.2" ECU_ADDRESS 0x383BC8 /end MEASUREMENT
/begin MEASUREMENT sfplues1e "Status Fehlerpfad: Lüfterendstufe 1" UWORD default 1 100 0 65535 FORMAT "%8.2" ECU_ADDRESS 0x383BCA /end MEASUREMENT
/begin MEASUREMENT sfpmile "Status Fehlerpfad: Mil - Endstufe" UWORD default 1 100 0 65535 FORMAT "%8.2" ECU_ADDRESS 0x383BDA /end MEASUREMENT
/begin MEASUREMENT sfpnwse "Status Fehlerpfad: Nockenwellensteuerungsventil Endstufe" UWORD default 1 100 0 65535 FORMAT "%8.2" ECU_ADDRESS 0x383BE0 /end MEASUREMENT
/begin MEASUREMENT sfprkat "Status Fehlerpfad: LR Adaption additive Korrektur pro Zeit" UWORD dez 1 100 0 65535 FORMAT "%8.2" ECU_ADDRESS 0x383BE8 /end MEASUREMENT
/begin MEASUREMENT sfprkaz "Status Fehlerpfad: LR Adaption additive Korrektur pro Zündung" UWORD dez 1 100 0 65535 FORMAT "%8.2" ECU_ADDRESS 0x383BEA /end MEASUREMENT
/begin MEASUREMENT sfpslpe "Status Fehlerpfad: Sekundärluftpumpe Endstufe" UWORD default 1 100 0 65535 FORMAT "%8.2" ECU_ADDRESS 0x383BF2 /end MEASUREMENT
/begin MEASUREMENT sfpslve "Status Fehlerpfad: Sekundärluftventil Endstufe" UWORD default 1 100 0 65535 FORMAT "%8.2" ECU_ADDRESS 0x383BF8 /end MEASUREMENT
/begin MEASUREMENT sfpteve "Status Fehlerpfad: Tanklüftungsventil Endstufe" UWORD default 1 100 0 65535 FORMAT "%8.2" ECU_ADDRESS 0x383C08 /end MEASUREMENT
/begin MEASUREMENT sfpuvse "Status Fehlerpfad: Endstufe Umluftventil Turbo" UWORD default 1 100 0 65535 FORMAT "%8.2" ECU_ADDRESS 0x383C26 /end MEASUREMENT
/begin MEASUREMENT sfpzet1 "Status Fehlerpfad: Diagnose Zündtreiber ZUE1  Status Fehlerpfad: Diagnose Zündtr" UWORD default 1 100 0 65535 FORMAT "%8.2" ECU_ADDRESS 0x383C2E /end MEASUREMENT
/begin MEASUREMENT sfpzet2 "Status Fehlerpfad: Diagnose Zündtreiber ZUE2  Status Fehlerpfad: Diagnose Zündtr" UWORD default 1 100 0 65535 FORMAT "%8.2" ECU_ADDRESS 0x383C30 /end MEASUREMENT
/begin MEASUREMENT sfpzet3 "Status Fehlerpfad: Diagnose Zündtreiber ZUE3  Status Fehlerpfad: Diagnose Zündtr" UWORD default 1 100 0 65535 FORMAT "%8.2" ECU_ADDRESS 0x383C32 /end MEASUREMENT
/begin MEASUREMENT sfpzet4 "Status Fehlerpfad: Diagnose Zündtreiber ZUE4" UWORD default 1 100 0 65535 FORMAT "%8.2" ECU_ADDRESS 0x383C34 /end MEASUREMENT
/begin MEASUREMENT sfpzzz "Dummy: Tabellenende" UWORD dez 1 100 0 65535 FORMAT "%8.2" ECU_ADDRESS 0x383C36 /end MEASUREMENT
/begin MEASUREMENT TYPkra01 "" UWORD B_TRUE 1 100 0 1 BIT_MASK 0xf00 FORMAT "%13.11" ECU_ADDRESS 0x383B98 /end MEASUREMENT
/begin MEASUREMENT TYPkra02 "" UWORD B_TRUE 1 100 0 1 BIT_MASK 0xf00 FORMAT "%13.11" ECU_ADDRESS 0x383B9A /end MEASUREMENT
/begin MEASUREMENT TYPkra03 "" UWORD B_TRUE 1 100 0 1 BIT_MASK 0xf00 FORMAT "%13.11" ECU_ADDRESS 0x383B9C /end MEASUREMENT
/begin MEASUREMENT TYPkra04 "" UWORD B_TRUE 1 100 0 1 BIT_MASK 0xf00 FORMAT "%13.11" ECU_ADDRESS 0x383B9E /end MEASUREMENT
/begin MEASUREMENT TYP_agre "" UWORD B_TRUE 1 100 0 1 BIT_MASK 0xf00 FORMAT "%13.11" ECU_ADDRESS 0x383B0A /end MEASUREMENT
/begin MEASUREMENT TYP_bkvpe "" UWORD B_TRUE 1 100 0 1 BIT_MASK 0xf00 FORMAT "%13.11" ECU_ADDRESS 0x383B1C /end MEASUREMENT
/begin MEASUREMENT TYP_dk "" UWORD B_TRUE 1 100 0 1 BIT_MASK 0xf00 FORMAT "%13.11" ECU_ADDRESS 0x383B38 /end MEASUREMENT
/begin MEASUREMENT TYP_dk1p "" UWORD B_TRUE 1 100 0 1 BIT_MASK 0xf00 FORMAT "%13.11" ECU_ADDRESS 0x383B3A /end MEASUREMENT
/begin MEASUREMENT TYP_dk2p "" UWORD B_TRUE 1 100 0 1 BIT_MASK 0xf00 FORMAT "%13.11" ECU_ADDRESS 0x383B3C /end MEASUREMENT
/begin MEASUREMENT TYP_dvee "Fehlertyp: DV-E Endstufe" UWORD B_TRUE 1 100 0 1 BIT_MASK 0xf00 FORMAT "%13.11" ECU_ADDRESS 0x383B4A /end MEASUREMENT
/begin MEASUREMENT TYP_dvef "Fehlertyp: DV-E Fehler bei Federprüfung" UWORD B_TRUE 1 100 0 1 BIT_MASK 0xf00 FORMAT "%13.11" ECU_ADDRESS 0x383B4C /end MEASUREMENT
/begin MEASUREMENT TYP_dvefo "" UWORD B_TRUE 1 100 0 1 BIT_MASK 0xf00 FORMAT "%13.11" ECU_ADDRESS 0x383B4E /end MEASUREMENT
/begin MEASUREMENT TYP_dvel "Fehlertyp: DV-E Lageabweichung" UWORD B_TRUE 1 100 0 1 BIT_MASK 0xf00 FORMAT "%13.11" ECU_ADDRESS 0x383B50 /end MEASUREMENT
/begin MEASUREMENT TYP_dven "Fehlertyp: DV-E Fehler bei Prüfung Notluftposition" UWORD B_TRUE 1 100 0 1 BIT_MASK 0xf00 FORMAT "%13.11" ECU_ADDRESS 0x383B52 /end MEASUREMENT
/begin MEASUREMENT TYP_dver "Fehlertyp: DV-E Regelbereich" UWORD B_TRUE 1 100 0 1 BIT_MASK 0xf00 FORMAT "%13.11" ECU_ADDRESS 0x383B54 /end MEASUREMENT
/begin MEASUREMENT TYP_dvet "" UWORD B_TRUE 1 100 0 1 BIT_MASK 0xf00 FORMAT "%13.11" ECU_ADDRESS 0x383B56 /end MEASUREMENT
/begin MEASUREMENT TYP_dveu "Fehlertyp: DV-E Fehler beim UMA-Lernen" UWORD B_TRUE 1 100 0 1 BIT_MASK 0xf00 FORMAT "%13.11" ECU_ADDRESS 0x383B58 /end MEASUREMENT
/begin MEASUREMENT TYP_dveub "" UWORD B_TRUE 1 100 0 1 BIT_MASK 0xf00 FORMAT "%13.11" ECU_ADDRESS 0x383B5A /end MEASUREMENT
/begin MEASUREMENT TYP_dveuw "" UWORD B_TRUE 1 100 0 1 BIT_MASK 0xf00 FORMAT "%13.11" ECU_ADDRESS 0x383B5C /end MEASUREMENT
/begin MEASUREMENT TYP_dvev "Fehlertyp: DV-E Fehler bei Verstärkerabgleich" UWORD B_TRUE 1 100 0 1 BIT_MASK 0xf00 FORMAT "%13.11" ECU_ADDRESS 0x383B5E /end MEASUREMENT
/begin MEASUREMENT TYP_egfe "" UWORD B_TRUE 1 100 0 1 BIT_MASK 0xf00 FORMAT "%13.11" ECU_ADDRESS 0x383B60 /end MEASUREMENT
/begin MEASUREMENT TYP_enws "" UWORD B_TRUE 1 100 0 1 BIT_MASK 0xf00 FORMAT "%13.11" ECU_ADDRESS 0x383B62 /end MEASUREMENT
/begin MEASUREMENT TYP_enwse "" UWORD B_TRUE 1 100 0 1 BIT_MASK 0xf00 FORMAT "%13.11" ECU_ADDRESS 0x383B64 /end MEASUREMENT
/begin MEASUREMENT TYP_epcle "" UWORD B_TRUE 1 100 0 1 BIT_MASK 0xf00 FORMAT "%13.11" ECU_ADDRESS 0x383B66 /end MEASUREMENT
/begin MEASUREMENT TYP_etre "" UWORD B_TRUE 1 100 0 1 BIT_MASK 0xf00 FORMAT "%13.11" ECU_ADDRESS 0x383B68 /end MEASUREMENT
/begin MEASUREMENT TYP_ev1 "" UWORD B_TRUE 1 100 0 1 BIT_MASK 0xf00 FORMAT "%13.11" ECU_ADDRESS 0x383B6A /end MEASUREMENT
/begin MEASUREMENT TYP_ev2 "" UWORD B_TRUE 1 100 0 1 BIT_MASK 0xf00 FORMAT "%13.11" ECU_ADDRESS 0x383B6C /end MEASUREMENT
/begin MEASUREMENT TYP_ev3 "" UWORD B_TRUE 1 100 0 1 BIT_MASK 0xf00 FORMAT "%13.11" ECU_ADDRESS 0x383B6E /end MEASUREMENT
/begin MEASUREMENT TYP_ev4 "" UWORD B_TRUE 1 100 0 1 BIT_MASK 0xf00 FORMAT "%13.11" ECU_ADDRESS 0x383B70 /end MEASUREMENT
/begin MEASUREMENT TYP_frao "" UWORD B_TRUE 1 100 0 1 BIT_MASK 0xf00 FORMAT "%13.11" ECU_ADDRESS 0x383B78 /end MEASUREMENT
/begin MEASUREMENT TYP_frau "" UWORD B_TRUE 1 100 0 1 BIT_MASK 0xf00 FORMAT "%13.11" ECU_ADDRESS 0x383B7A /end MEASUREMENT
/begin MEASUREMENT TYP_frst "" UWORD B_TRUE 1 100 0 1 BIT_MASK 0xf00 FORMAT "%13.11" ECU_ADDRESS 0x383B7C /end MEASUREMENT
/begin MEASUREMENT TYP_hsh "Fehlertyp: Heizung Lambdasonde 1 hinter Kat" UWORD B_TRUE 1 100 0 1 BIT_MASK 0xf00 FORMAT "%13.11" ECU_ADDRESS 0x383B86 /end MEASUREMENT
/begin MEASUREMENT TYP_hsh2 "Fehlertyp: Heizung Lambdasonde 2 hinter Kat" UWORD B_TRUE 1 100 0 1 BIT_MASK 0xf00 FORMAT "%13.11" ECU_ADDRESS 0x383B88 /end MEASUREMENT
/begin MEASUREMENT TYP_hshe "Fehlertyp: Endstufe Heizung Lambdasonde 1 hinter Kat" UWORD B_TRUE 1 100 0 1 BIT_MASK 0xf00 FORMAT "%13.11" ECU_ADDRESS 0x383B8A /end MEASUREMENT
/begin MEASUREMENT TYP_hsv "Fehlertyp: Heizung Lambdasonde 1 vor Kat" UWORD B_TRUE 1 100 0 1 BIT_MASK 0xf00 FORMAT "%13.11" ECU_ADDRESS 0x383B8C /end MEASUREMENT
/begin MEASUREMENT TYP_hsv2 "Fehlertyp: Heizung Lambdasonde 2 vor Kat" UWORD B_TRUE 1 100 0 1 BIT_MASK 0xf00 FORMAT "%13.11" ECU_ADDRESS 0x383B8E /end MEASUREMENT
/begin MEASUREMENT TYP_hsvsa "" UWORD B_TRUE 1 100 0 1 BIT_MASK 0xf00 FORMAT "%13.11" ECU_ADDRESS 0x383B90 /end MEASUREMENT
/begin MEASUREMENT TYP_hsvsa2 "" UWORD B_TRUE 1 100 0 1 BIT_MASK 0xf00 FORMAT "%13.11" ECU_ADDRESS 0x383B92 /end MEASUREMENT
/begin MEASUREMENT TYP_kat "Fehlertyp: Katalysator-Diagnose" UWORD B_TRUE 1 100 0 1 BIT_MASK 0xf00 FORMAT "%13.11" ECU_ADDRESS 0x383B94 /end MEASUREMENT
/begin MEASUREMENT TYP_kpe "Fehlertyp: EKP-Relais Endstufe" UWORD B_TRUE 1 100 0 1 BIT_MASK 0xf00 FORMAT "%13.11" ECU_ADDRESS 0x383B96 /end MEASUREMENT
/begin MEASUREMENT TYP_krnt "" UWORD B_TRUE 1 100 0 1 BIT_MASK 0xf00 FORMAT "%13.11" ECU_ADDRESS 0x383BA0 /end MEASUREMENT
/begin MEASUREMENT TYP_krof "" UWORD B_TRUE 1 100 0 1 BIT_MASK 0xf00 FORMAT "%13.11" ECU_ADDRESS 0x383BA2 /end MEASUREMENT
/begin MEASUREMENT TYP_krtp "" UWORD B_TRUE 1 100 0 1 BIT_MASK 0xf00 FORMAT "%13.11" ECU_ADDRESS 0x383BA4 /end MEASUREMENT
/begin MEASUREMENT TYP_ks1 "" UWORD B_TRUE 1 100 0 1 BIT_MASK 0xf00 FORMAT "%13.11" ECU_ADDRESS 0x383BA6 /end MEASUREMENT
/begin MEASUREMENT TYP_ks2 "" UWORD B_TRUE 1 100 0 1 BIT_MASK 0xf00 FORMAT "%13.11" ECU_ADDRESS 0x383BA8 /end MEASUREMENT
/begin MEASUREMENT TYP_ks3 "" UWORD B_TRUE 1 100 0 1 BIT_MASK 0xf00 FORMAT "%13.11" ECU_ADDRESS 0x383BAA /end MEASUREMENT
/begin MEASUREMENT TYP_ks4 "" UWORD B_TRUE 1 100 0 1 BIT_MASK 0xf00 FORMAT "%13.11" ECU_ADDRESS 0x383BAC /end MEASUREMENT
/begin MEASUREMENT TYP_kuppl "Fehlertyp: Gebergröße Kupplungsschalter" UWORD B_TRUE 1 100 0 1 BIT_MASK 0xf00 FORMAT "%13.11" ECU_ADDRESS 0x383BAE /end MEASUREMENT
/begin MEASUREMENT TYP_lde "" UWORD B_TRUE 1 100 0 1 BIT_MASK 0xf00 FORMAT "%13.11" ECU_ADDRESS 0x383BB2 /end MEASUREMENT
/begin MEASUREMENT TYP_lue1 "" UWORD B_TRUE 1 100 0 1 BIT_MASK 0xf00 FORMAT "%13.11" ECU_ADDRESS 0x383BC8 /end MEASUREMENT
/begin MEASUREMENT TYP_lues1e "" UWORD B_TRUE 1 100 0 1 BIT_MASK 0xf00 FORMAT "%13.11" ECU_ADDRESS 0x383BCA /end MEASUREMENT
/begin MEASUREMENT TYP_mile "" UWORD B_TRUE 1 100 0 1 BIT_MASK 0xf00 FORMAT "%13.11" ECU_ADDRESS 0x383BDA /end MEASUREMENT
/begin MEASUREMENT TYP_nwse "" UWORD B_TRUE 1 100 0 1 BIT_MASK 0xf00 FORMAT "%13.11" ECU_ADDRESS 0x383BE0 /end MEASUREMENT
/begin MEASUREMENT TYP_rkat "" UWORD B_TRUE 1 100 0 1 BIT_MASK 0xf00 FORMAT "%13.11" ECU_ADDRESS 0x383BE8 /end MEASUREMENT
/begin MEASUREMENT TYP_rkaz "" UWORD B_TRUE 1 100 0 1 BIT_MASK 0xf00 FORMAT "%13.11" ECU_ADDRESS 0x383BEA /end MEASUREMENT
/begin MEASUREMENT TYP_slpe "" UWORD B_TRUE 1 100 0 1 BIT_MASK 0xf00 FORMAT "%13.11" ECU_ADDRESS 0x383BF2 /end MEASUREMENT
/begin MEASUREMENT TYP_slve "" UWORD B_TRUE 1 100 0 1 BIT_MASK 0xf00 FORMAT "%13.11" ECU_ADDRESS 0x383BF8 /end MEASUREMENT
/begin MEASUREMENT TYP_teve "" UWORD B_TRUE 1 100 0 1 BIT_MASK 0xf00 FORMAT "%13.11" ECU_ADDRESS 0x383C08 /end MEASUREMENT
/begin MEASUREMENT TYP_uvse "" UWORD B_TRUE 1 100 0 1 BIT_MASK 0xf00 FORMAT "%13.11" ECU_ADDRESS 0x383C26 /end MEASUREMENT
/begin MEASUREMENT TYP_zet1 "" UWORD B_TRUE 1 100 0 1 BIT_MASK 0xf00 FORMAT "%13.11" ECU_ADDRESS 0x383C2E /end MEASUREMENT
/begin MEASUREMENT TYP_zet2 "" UWORD B_TRUE 1 100 0 1 BIT_MASK 0xf00 FORMAT "%13.11" ECU_ADDRESS 0x383C30 /end MEASUREMENT
/begin MEASUREMENT TYP_zet3 "" UWORD B_TRUE 1 100 0 1 BIT_MASK 0xf00 FORMAT "%13.11" ECU_ADDRESS 0x383C32 /end MEASUREMENT
/begin MEASUREMENT TYP_zet4 "" UWORD B_TRUE 1 100 0 1 BIT_MASK 0xf00 FORMAT "%13.11" ECU_ADDRESS 0x383C34 /end MEASUREMENT
/begin MEASUREMENT Z_aaa "Dummy: Tabellenanfang" UWORD B_TRUE 1 100 0 1 BIT_MASK 0x2 FORMAT "%13.11" ECU_ADDRESS 0x383B06 /end MEASUREMENT
/begin MEASUREMENT Z_agre "Zyklusflag: Abgasrückführungsventil Endstufe" UWORD B_TRUE 1 100 0 1 BIT_MASK 0x2 FORMAT "%13.11" ECU_ADDRESS 0x383B0A /end MEASUREMENT
/begin MEASUREMENT Z_bkvpe "Zyklusflag: BKV-Pumpe-Endstufe" UWORD B_TRUE 1 100 0 1 BIT_MASK 0x2 FORMAT "%13.11" ECU_ADDRESS 0x383B1C /end MEASUREMENT
/begin MEASUREMENT Z_dk "Zyklusflag: DK - Potentiometer" UWORD B_TRUE 1 100 0 1 BIT_MASK 0x2 FORMAT "%13.11" ECU_ADDRESS 0x383B38 /end MEASUREMENT
/begin MEASUREMENT Z_dk1p "Zyklusflag: Drosselklappe 1. Poti" UWORD B_TRUE 1 100 0 1 BIT_MASK 0x2 FORMAT "%13.11" ECU_ADDRESS 0x383B3A /end MEASUREMENT
/begin MEASUREMENT Z_dk2p "Zyklusflag: Drosselklappe 2. Poti" UWORD B_TRUE 1 100 0 1 BIT_MASK 0x2 FORMAT "%13.11" ECU_ADDRESS 0x383B3C /end MEASUREMENT
/begin MEASUREMENT Z_dvee "Zyklusflag: DV-E Endstufe" UWORD B_TRUE 1 100 0 1 BIT_MASK 0x2 FORMAT "%13.11" ECU_ADDRESS 0x383B4A /end MEASUREMENT
/begin MEASUREMENT Z_dvef "Zyklusflag: DV-E Fehler bei Federprüfung" UWORD B_TRUE 1 100 0 1 BIT_MASK 0x2 FORMAT "%13.11" ECU_ADDRESS 0x383B4C /end MEASUREMENT
/begin MEASUREMENT Z_dvefo "Zyklusflag: DV-E-Fehler bei Federprüfung ""Öffnen""" UWORD B_TRUE 1 100 0 1 BIT_MASK 0x2 FORMAT "%13.11" ECU_ADDRESS 0x383B4E /end MEASUREMENT
/begin MEASUREMENT Z_dvel "Zyklusflag: DV-E Lageabweichung" UWORD B_TRUE 1 100 0 1 BIT_MASK 0x2 FORMAT "%13.11" ECU_ADDRESS 0x383B50 /end MEASUREMENT
/begin MEASUREMENT Z_dven "Zyklusflag: DV-E Fehler bei Prüfung Notluftposition" UWORD B_TRUE 1 100 0 1 BIT_MASK 0x2 FORMAT "%13.11" ECU_ADDRESS 0x383B52 /end MEASUREMENT
/begin MEASUREMENT Z_dver "Zyklusflag: DV-E Regelbereich" UWORD B_TRUE 1 100 0 1 BIT_MASK 0x2 FORMAT "%13.11" ECU_ADDRESS 0x383B54 /end MEASUREMENT
/begin MEASUREMENT Z_dvet "Zyklusflag: DV-E-Tauscherkennung ohne Adaption" UWORD B_TRUE 1 100 0 1 BIT_MASK 0x2 FORMAT "%13.11" ECU_ADDRESS 0x383B56 /end MEASUREMENT
/begin MEASUREMENT Z_dveu "Zyklusflag: DV-E Fehler beim UMA-Lernen" UWORD B_TRUE 1 100 0 1 BIT_MASK 0x2 FORMAT "%13.11" ECU_ADDRESS 0x383B58 /end MEASUREMENT
/begin MEASUREMENT Z_dveub "Zyklusflag: DV-E-Adaption Abbruch wg. Umweltbedingung" UWORD B_TRUE 1 100 0 1 BIT_MASK 0x2 FORMAT "%13.11" ECU_ADDRESS 0x383B5A /end MEASUREMENT
/begin MEASUREMENT Z_dveuw "Zyklusflag: Fehler bei UMA-Wiederlernen" UWORD B_TRUE 1 100 0 1 BIT_MASK 0x2 FORMAT "%13.11" ECU_ADDRESS 0x383B5C /end MEASUREMENT
/begin MEASUREMENT Z_dvev "Zyklusflag: DV-E Fehler bei Verstärkerabgleich" UWORD B_TRUE 1 100 0 1 BIT_MASK 0x2 FORMAT "%13.11" ECU_ADDRESS 0x383B5E /end MEASUREMENT
/begin MEASUREMENT Z_egfe "Zyklusflag: Eingangsgrößen Füllungserfassung" UWORD B_TRUE 1 100 0 1 BIT_MASK 0x2 FORMAT "%13.11" ECU_ADDRESS 0x383B60 /end MEASUREMENT
/begin MEASUREMENT Z_enws "Zyklusflag: Nockenwellensteuerung (Einlaß,Bank1)" UWORD B_TRUE 1 100 0 1 BIT_MASK 0x2 FORMAT "%13.11" ECU_ADDRESS 0x383B62 /end MEASUREMENT
/begin MEASUREMENT Z_enwse "Zyklusflag: Nockenwellensteuerungsventil Endstufe (Bank1,Einlaß)" UWORD B_TRUE 1 100 0 1 BIT_MASK 0x2 FORMAT "%13.11" ECU_ADDRESS 0x383B64 /end MEASUREMENT
/begin MEASUREMENT Z_epcle "Zyklusflag: EPCL-Endstufe" UWORD B_TRUE 1 100 0 1 BIT_MASK 0x2 FORMAT "%13.11" ECU_ADDRESS 0x383B66 /end MEASUREMENT
/begin MEASUREMENT Z_etre "Zyklusflag: El. Thermostat (Endstufe)" UWORD B_TRUE 1 100 0 1 BIT_MASK 0x2 FORMAT "%13.11" ECU_ADDRESS 0x383B68 /end MEASUREMENT
/begin MEASUREMENT Z_ev1 "Zyklusflag: EV von Zyl. 1" UWORD B_TRUE 1 100 0 1 BIT_MASK 0x2 FORMAT "%13.11" ECU_ADDRESS 0x383B6A /end MEASUREMENT
/begin MEASUREMENT Z_ev2 "Zyklusflag: EV von Zyl. 2" UWORD B_TRUE 1 100 0 1 BIT_MASK 0x2 FORMAT "%13.11" ECU_ADDRESS 0x383B6C /end MEASUREMENT
/begin MEASUREMENT Z_ev3 "Zyklusflag: EV von Zyl. 3" UWORD B_TRUE 1 100 0 1 BIT_MASK 0x2 FORMAT "%13.11" ECU_ADDRESS 0x383B6E /end MEASUREMENT
/begin MEASUREMENT Z_ev4 "Zyklusflag: EV von Zyl. 4" UWORD B_TRUE 1 100 0 1 BIT_MASK 0x2 FORMAT "%13.11" ECU_ADDRESS 0x383B70 /end MEASUREMENT
/begin MEASUREMENT Z_frao "Zyklusflag: LR-Adaption oberer multiplikativer Bereich" UWORD B_TRUE 1 100 0 1 BIT_MASK 0x2 FORMAT "%13.11" ECU_ADDRESS 0x383B78 /end MEASUREMENT
/begin MEASUREMENT Z_frau "Zyklusflag: LR-Adaption unterer multiplikativer Bereich" UWORD B_TRUE 1 100 0 1 BIT_MASK 0x2 FORMAT "%13.11" ECU_ADDRESS 0x383B7A /end MEASUREMENT
/begin MEASUREMENT Z_frst "Zyklusmeldung Diagnose Kraftstoffversorgungssystem (Kurztest)" UWORD B_TRUE 1 100 0 1 BIT_MASK 0x2 FORMAT "%13.11" ECU_ADDRESS 0x383B7C /end MEASUREMENT
/begin MEASUREMENT Z_hsh "Zyklusflag: Lambdasonden-Heizung hinter Katalysator" UWORD B_TRUE 1 100 0 1 BIT_MASK 0x2 FORMAT "%13.11" ECU_ADDRESS 0x383B86 /end MEASUREMENT
/begin MEASUREMENT Z_hsh2 "Zyklusflag: Lambdasonden-Heizung hinter Katalysator, Bank2" UWORD B_TRUE 1 100 0 1 BIT_MASK 0x2 FORMAT "%13.11" ECU_ADDRESS 0x383B88 /end MEASUREMENT
/begin MEASUREMENT Z_hshe "Zyklusflag: Lambdasonden-Heizung hinter Katalysator (Endstufe)" UWORD B_TRUE 1 100 0 1 BIT_MASK 0x2 FORMAT "%13.11" ECU_ADDRESS 0x383B8A /end MEASUREMENT
/begin MEASUREMENT Z_hsv "Zyklusflag: Lambdasonden-Heizung vor Katalysator" UWORD B_TRUE 1 100 0 1 BIT_MASK 0x2 FORMAT "%13.11" ECU_ADDRESS 0x383B8C /end MEASUREMENT
/begin MEASUREMENT Z_hsv2 "Zyklusflag: Lambdasonden-Heizung vor Katalysator, Bank2" UWORD B_TRUE 1 100 0 1 BIT_MASK 0x2 FORMAT "%13.11" ECU_ADDRESS 0x383B8E /end MEASUREMENT
/begin MEASUREMENT Z_hsvsa "Zyklusflag:  reduzierte  LSU-Heizung oder LSU-Kennlinie abgeflacht" UWORD B_TRUE 1 100 0 1 BIT_MASK 0x2 FORMAT "%13.11" ECU_ADDRESS 0x383B90 /end MEASUREMENT
/begin MEASUREMENT Z_hsvsa2 "Zyklusflag: reduzierte  LSU_2-Heizung oder LSU_2-Kennlinie abgeflacht" UWORD B_TRUE 1 100 0 1 BIT_MASK 0x2 FORMAT "%13.11" ECU_ADDRESS 0x383B92 /end MEASUREMENT
/begin MEASUREMENT Z_kat "Zyklusflag: Katalysator-Konvertierung" UWORD B_TRUE 1 100 0 1 BIT_MASK 0x2 FORMAT "%13.11" ECU_ADDRESS 0x383B94 /end MEASUREMENT
/begin MEASUREMENT Z_kpe "Zyklusflag: EKP-Relais Endstufe" UWORD B_TRUE 1 100 0 1 BIT_MASK 0x2 FORMAT "%13.11" ECU_ADDRESS 0x383B96 /end MEASUREMENT
/begin MEASUREMENT Z_kra01 "Zyklusflag: Klopfregelanschlag Zylinder 1" UWORD B_TRUE 1 100 0 1 BIT_MASK 0x2 FORMAT "%13.11" ECU_ADDRESS 0x383B98 /end MEASUREMENT
/begin MEASUREMENT Z_kra02 "Zyklusflag: Klopfregelanschlag Zylinder 2" UWORD B_TRUE 1 100 0 1 BIT_MASK 0x2 FORMAT "%13.11" ECU_ADDRESS 0x383B9A /end MEASUREMENT
/begin MEASUREMENT Z_kra03 "Zyklusflag: Klopfregelanschlag Zylinder 3" UWORD B_TRUE 1 100 0 1 BIT_MASK 0x2 FORMAT "%13.11" ECU_ADDRESS 0x383B9C /end MEASUREMENT
/begin MEASUREMENT Z_kra04 "Zyklusflag: Klopfregelanschlag Zylinder 4" UWORD B_TRUE 1 100 0 1 BIT_MASK 0x2 FORMAT "%13.11" ECU_ADDRESS 0x383B9E /end MEASUREMENT
/begin MEASUREMENT Z_krnt "Zyklusflag: Klopfregelung Nulltest" UWORD B_TRUE 1 100 0 1 BIT_MASK 0x2 FORMAT "%13.11" ECU_ADDRESS 0x383BA0 /end MEASUREMENT
/begin MEASUREMENT Z_krof "Zyklusflag: Klopfregelung Offset" UWORD B_TRUE 1 100 0 1 BIT_MASK 0x2 FORMAT "%13.11" ECU_ADDRESS 0x383BA2 /end MEASUREMENT
/begin MEASUREMENT Z_krtp "Zyklusflag: Klopfregelung Testimpuls" UWORD B_TRUE 1 100 0 1 BIT_MASK 0x2 FORMAT "%13.11" ECU_ADDRESS 0x383BA4 /end MEASUREMENT
/begin MEASUREMENT Z_ks1 "Zyklusflag: Klopfsensor 1" UWORD B_TRUE 1 100 0 1 BIT_MASK 0x2 FORMAT "%13.11" ECU_ADDRESS 0x383BA6 /end MEASUREMENT
/begin MEASUREMENT Z_ks2 "Zyklusflag: Klopfsensor 2" UWORD B_TRUE 1 100 0 1 BIT_MASK 0x2 FORMAT "%13.11" ECU_ADDRESS 0x383BA8 /end MEASUREMENT
/begin MEASUREMENT Z_ks3 "Zyklusflag: Klopfsensor 3" UWORD B_TRUE 1 100 0 1 BIT_MASK 0x2 FORMAT "%13.11" ECU_ADDRESS 0x383BAA /end MEASUREMENT
/begin MEASUREMENT Z_ks4 "Zyklusflag: Klopfsensor 4" UWORD B_TRUE 1 100 0 1 BIT_MASK 0x2 FORMAT "%13.11" ECU_ADDRESS 0x383BAC /end MEASUREMENT
/begin MEASUREMENT Z_kuppl "Zyklusflag: Kupplung betaetigt" UWORD B_TRUE 1 100 0 1 BIT_MASK 0x2 FORMAT "%13.11" ECU_ADDRESS 0x383BAE /end MEASUREMENT
/begin MEASUREMENT Z_lde "Zyklusflag: Ladedrucksteuerventil (Endstufe)" UWORD B_TRUE 1 100 0 1 BIT_MASK 0x2 FORMAT "%13.11" ECU_ADDRESS 0x383BB2 /end MEASUREMENT
/begin MEASUREMENT Z_lue1 "Zyklusflag LUE1" UWORD B_TRUE 1 100 0 1 BIT_MASK 0x2 FORMAT "%13.11" ECU_ADDRESS 0x383BC8 /end MEASUREMENT
/begin MEASUREMENT Z_lues1e "Zyklusflag: Lüftersteuerung 1 (Endstufe)" UWORD B_TRUE 1 100 0 1 BIT_MASK 0x2 FORMAT "%13.11" ECU_ADDRESS 0x383BCA /end MEASUREMENT
/begin MEASUREMENT Z_mile "Zyklusflag: MIL-Endstufe" UWORD B_TRUE 1 100 0 1 BIT_MASK 0x2 FORMAT "%13.11" ECU_ADDRESS 0x383BDA /end MEASUREMENT
/begin MEASUREMENT Z_nwse "Zyklusflag: Nockenwellensteuerungsventil Endstufe" UWORD B_TRUE 1 100 0 1 BIT_MASK 0x2 FORMAT "%13.11" ECU_ADDRESS 0x383BE0 /end MEASUREMENT
/begin MEASUREMENT Z_rkat "Zyklusflag: LR-Adaption additiv pro Zeit" UWORD B_TRUE 1 100 0 1 BIT_MASK 0x2 FORMAT "%13.11" ECU_ADDRESS 0x383BE8 /end MEASUREMENT
/begin MEASUREMENT Z_rkaz "Zyklusflag: LR-Adaption additiv pro Einspritzung" UWORD B_TRUE 1 100 0 1 BIT_MASK 0x2 FORMAT "%13.11" ECU_ADDRESS 0x383BEA /end MEASUREMENT
/begin MEASUREMENT Z_slpe "Zyklusflag: Sekundärluftpumpe (Endstufe)" UWORD B_TRUE 1 100 0 1 BIT_MASK 0x2 FORMAT "%13.11" ECU_ADDRESS 0x383BF2 /end MEASUREMENT
/begin MEASUREMENT Z_slve "Zyklusflag: Sekundärluftventil (Endstufe)" UWORD B_TRUE 1 100 0 1 BIT_MASK 0x2 FORMAT "%13.11" ECU_ADDRESS 0x383BF8 /end MEASUREMENT
/begin MEASUREMENT Z_teve "Zyklusflag: Tankentlüftungsventil Endstufe" UWORD B_TRUE 1 100 0 1 BIT_MASK 0x2 FORMAT "%13.11" ECU_ADDRESS 0x383C08 /end MEASUREMENT
/begin MEASUREMENT Z_uvse "Zyklusflag: Endstufe Umluftventil Turbo" UWORD B_TRUE 1 100 0 1 BIT_MASK 0x2 FORMAT "%13.11" ECU_ADDRESS 0x383C26 /end MEASUREMENT
/begin MEASUREMENT Z_zet1 "Zyklus-Flag Zündendstufentreiber" UWORD B_TRUE 1 100 0 1 BIT_MASK 0x2 FORMAT "%13.11" ECU_ADDRESS 0x383C2E /end MEASUREMENT
/begin MEASUREMENT Z_zet2 "" UWORD B_TRUE 1 100 0 1 BIT_MASK 0x2 FORMAT "%13.11" ECU_ADDRESS 0x383C30 /end MEASUREMENT
/begin MEASUREMENT Z_zet3 "" UWORD B_TRUE 1 100 0 1 BIT_MASK 0x2 FORMAT "%13.11" ECU_ADDRESS 0x383C32 /end MEASUREMENT
/begin MEASUREMENT Z_zet4 "" UWORD B_TRUE 1 100 0 1 BIT_MASK 0x2 FORMAT "%13.11" ECU_ADDRESS 0x383C34 /end MEASUREMENT
/begin FUNCTION DFPM_DDVE ""
 /begin DEF_CHARACTERISTIC CDCDK CDCDK1P CDCDK2P CDCDVEE CDCDVEF CDCDVEFO CDCDVEL CDCDVEN CDCDVER CDCDVET CDCDVEU CDCDVEUB CDCDVEUW CDCDVEV CDKDK CDKDK1P CDKDK2P CDKDVEE CDKDVEF CDKDVEFO CDKDVEL CDKDVEN CDKDVER CDKDVET CDKDVEU CDKDVEUB CDKDVEUW CDKDVEV CDTDK CDTDK1P CDTDK2P CDTDVEE CDTDVEF CDTDVEFO CDTDVEL CDTDVEN CDTDVER CDTDVET CDTDVEU CDTDVEUB CDTDVEUW CDTDVEV CLADK CLADK1P CLADK2P CLADVEE CLADVEF CLADVEFO CLADVEL CLADVEN CLADVER CLADVET CLADVEU CLADVEUB CLADVEUW CLADVEV FFTDK FFTDK1P FFTDK2P FFTDVEE FFTDVEF FFTDVEFO FFTDVEL FFTDVEN FFTDVER FFTDVET FFTDVEU FFTDVEUB FFTDVEUW FFTDVEV TSFDK TSFDK1P TSFDK2P TSFDVEE TSFDVEF TSFDVEFO TSFDVEL TSFDVEN TSFDVER TSFDVET TSFDVEU TSFDVEUB TSFDVEUW TSFDVEV /end DEF_CHARACTERISTIC
 /begin REF_CHARACTERISTIC /end REF_CHARACTERISTIC
 /begin IN_MEASUREMENT /end IN_MEASUREMENT
 /begin OUT_MEASUREMENT B_bedk B_bedk1p B_bedk2p B_bedvee B_bedvef B_bedvefo B_bedvel B_bedven B_bedver B_bedvet B_bedveu B_bedveub B_bedveuw B_bedvev B_bkdk B_bkdk1p B_bkdk2p B_bkdvee B_bkdvef B_bkdvefo B_bkdvel B_bkdven B_bkdver B_bkdvet B_bkdveu B_bkdveub B_bkdveuw B_bkdvev B_cldk B_cldk1p B_cldk2p B_cldvee B_cldvef B_cldvefo B_cldvel B_cldven B_cldver B_cldvet B_cldveu B_cldveub B_cldveuw B_cldvev B_ftdk B_ftdk1p B_ftdk2p B_ftdvee B_ftdvef B_ftdvefo B_ftdvel B_ftdven B_ftdver B_ftdvet B_ftdveu B_ftdveub B_ftdveuw B_ftdvev B_mndk B_mndk1p B_mndk2p B_mndvee B_mndvef B_mndvefo B_mndvel B_mndven B_mndver B_mndvet B_mndveu B_mndveub B_mndveuw B_mndvev B_mxdk B_mxdk1p B_mxdk2p B_mxdvee B_mxdvef B_mxdvefo B_mxdvel B_mxdven B_mxdver B_mxdvet B_mxdveu B_mxdveub B_mxdveuw B_mxdvev B_npdk B_npdk1p B_npdk2p B_npdvee B_npdvef B_npdvefo B_npdvel B_npdven B_npdver B_npdvet B_npdveu B_npdveub B_npdveuw B_npdvev B_sidk B_sidk1p B_sidk2p B_sidvee B_sidvef B_sidvefo B_sidvel B_sidven B_sidver B_sidvet B_sidveu B_sidveub B_sidveuw B_sidvev E_dk E_dk1p E_dk2p E_dvee E_dvef E_dvefo E_dvel E_dven E_dver E_dvet E_dveu E_dveub E_dveuw E_dvev sfpdk sfpdk1p sfpdk2p sfpdvee sfpdvef sfpdvefo sfpdvel sfpdven sfpdver sfpdvet sfpdveu sfpdveub sfpdveuw sfpdvev TYP_dk TYP_dk1p TYP_dk2p TYP_dvee TYP_dvef TYP_dvefo TYP_dvel TYP_dven TYP_dver TYP_dvet TYP_dveu TYP_dveub TYP_dveuw TYP_dvev Z_dk Z_dk1p Z_dk2p Z_dvee Z_dvef Z_dvefo Z_dvel Z_dven Z_dver Z_dvet Z_dveu Z_dveub Z_dveuw Z_dvev /end OUT_MEASUREMENT
 /begin LOC_MEASUREMENT /end LOC_MEASUREMENT
 /begin SUB_FUNCTION /end SUB_FUNCTION
/end FUNCTION
/begin FUNCTION DFPM_DEGFE "" /begin DEF_CHARACTERISTIC CDCEGFE CDKEGFE CDTEGFE CLAEGFE FFTEGFE TSFEGFE /end DEF_CHARACTERISTIC /begin REF_CHARACTERISTIC /end REF_CHARACTERISTIC /begin IN_MEASUREMENT /end IN_MEASUREMENT
 /begin OUT_MEASUREMENT B_beegfe B_bkegfe B_clegfe B_ftegfe B_mnegfe B_mxegfe B_npegfe E_egfe sfpegfe TYP_egfe Z_egfe /end OUT_MEASUREMENT
 /begin LOC_MEASUREMENT /end LOC_MEASUREMENT
 /begin SUB_FUNCTION /end SUB_FUNCTION
/end FUNCTION
/begin FUNCTION DFPM_DEKON ""
 /begin DEF_CHARACTERISTIC CDCAGRE CDCBKVPE CDCENWSE CDCEPCLE CDCETRE CDCEV1 CDCEV2 CDCEV3 CDCEV4 CDCHSHE CDCKPE CDCLDE CDCLUES1E CDCMILE CDCNWSE CDCSLPE CDCSLVE CDCTEVE CDCUVSE CDCZET1 CDCZET2 CDCZET3 CDCZET4 CDKAGRE CDKBKVPE CDKENWSE CDKEPCLE CDKETRE CDKEV1 CDKEV2 CDKEV3 CDKEV4 CDKHSHE CDKKPE CDKLDE CDKLUES1E CDKMILE CDKNWSE CDKSLPE CDKSLVE CDKTEVE CDKUVSE CDKZET1 CDKZET2 CDKZET3 CDKZET4 CDTAGRE CDTBKVPE CDTENWSE CDTEPCLE CDTETRE CDTEV1 CDTEV2 CDTEV3 CDTEV4 CDTHSHE CDTKPE CDTLDE CDTLUES1E CDTMILE CDTNWSE CDTSLPE CDTSLVE CDTTEVE CDTUVSE CDTZET1 CDTZET2 CDTZET3 CDTZET4 CLAAGRE CLABKVPE CLAENWSE CLAEPCLE CLAETRE CLAEV1 CLAEV2 CLAEV3 CLAEV4 CLAHSHE CLAKPE CLALDE CLALUES1E CLAMILE CLANWSE CLASLPE CLASLVE CLATEVE CLAUVSE CLAZET1 CLAZET2 CLAZET3 CLAZET4 FFTAGRE FFTBKVPE FFTENWSE FFTEPCLE FFTETRE FFTEV1 FFTEV2 FFTEV3 FFTEV4 FFTHSHE FFTKPE FFTLDE FFTLUES1E FFTMILE FFTNWSE FFTSLPE FFTSLVE FFTTEVE FFTUVSE FFTZET1 FFTZET2 FFTZET3 FFTZET4 TSFAGRE TSFBKVPE TSFENWSE TSFEPCLE TSFETRE TSFEV1 TSFEV2 TSFEV3 TSFEV4 TSFHSHE TSFKPE TSFLDE TSFLUES1E TSFMILE TSFNWSE TSFSLPE TSFSLVE TSFTEVE TSFUVSE TSFZET1 TSFZET2 TSFZET3 TSFZET4 /end DEF_CHARACTERISTIC
 /begin REF_CHARACTERISTIC /end REF_CHARACTERISTIC
 /begin IN_MEASUREMENT /end IN_MEASUREMENT
 /begin OUT_MEASUREMENT B_beagre B_bebkvpe B_beenwse B_beepcle B_beetre B_beev1 B_beev2 B_beev3 B_beev4 B_behshe B_bekpe B_belde B_belues1e B_bemile B_benwse B_beslpe B_beslve B_beteve B_beuvse B_bezet1 B_bezet2 B_bezet3 B_bezet4 B_bkagre B_bkbkvpe B_bkenwse B_bkepcle B_bketre B_bkev1 B_bkev2 B_bkev3 B_bkev4 B_bkhshe B_bkkpe B_bklde B_bklues1e B_bkmile B_bknwse B_bkslpe B_bkslve B_bkteve B_bkuvse B_bkzet1 B_bkzet2 B_bkzet3 B_bkzet4 B_clagre B_clbkvpe B_clenwse B_clepcle B_cletre B_clev1 B_clev2 B_clev3 B_clev4 B_clhshe B_clkpe B_cllde B_cllues1e B_clmile B_clnwse B_clslpe B_clslve B_clteve B_cluvse B_clzet1 B_clzet2 B_clzet3 B_clzet4 B_ftagre B_ftbkvpe B_ftenwse B_ftepcle B_ftetre B_ftev1 B_ftev2 B_ftev3 B_ftev4 B_fthshe B_ftkpe B_ftlde B_ftlues1e B_ftmile B_ftnwse B_ftslpe B_ftslve B_ftteve B_ftuvse B_ftzet1 B_ftzet2 B_ftzet3 B_ftzet4 B_mnagre B_mnbkvpe B_mnenwse B_mnepcle B_mnetre B_mnev1 B_mnev2 B_mnev3 B_mnev4 B_mnhshe B_mnkpe B_mnlde B_mnlues1e B_mnmile B_mnnwse B_mnslpe B_mnslve B_mnteve B_mnuvse B_mnzet1 B_mnzet2 B_mnzet3 B_mnzet4 B_mxagre B_mxbkvpe B_mxenwse B_mxepcle B_mxetre B_mxev1 B_mxev2 B_mxev3 B_mxev4 B_mxhshe B_mxkpe B_mxlde B_mxlues1e B_mxmile B_mxnwse B_mxslpe B_mxslve B_mxteve B_mxuvse B_mxzet1 B_mxzet2 B_mxzet3 B_mxzet4 B_npagre B_npbkvpe B_npenwse B_npepcle B_npetre B_npev1 B_npev2 B_npev3 B_npev4 B_nphshe B_npkpe B_nplde B_nplues1e B_npmile B_npnwse B_npslpe B_npslve B_npteve B_npuvse B_npzet1 B_npzet2 B_npzet3 B_npzet4 B_siagre B_sibkvpe B_sienwse B_siepcle B_sietre B_siev1 B_siev2 B_siev3 B_siev4 B_sihshe B_sikpe B_silde B_silues1e B_simile B_sinwse B_sislpe B_sislve B_siteve B_siuvse B_sizet1 B_sizet2 B_sizet3 B_sizet4 E_agre E_bkvpe E_enwse E_epcle E_etre E_ev1 E_ev2 E_ev3 E_ev4 E_hshe E_kpe E_lde E_lues1e E_mile E_nwse E_slpe E_slve E_teve E_uvse E_zet1 E_zet2 E_zet3 E_zet4 sfpagre sfpbkvpe sfpenwse sfpepcle sfpetre sfpev1 sfpev2 sfpev3 sfpev4 sfphshe sfpkpe sfplde sfplues1e sfpmile sfpnwse sfpslpe sfpslve sfpteve sfpuvse sfpzet1 sfpzet2 sfpzet3 sfpzet4 TYP_agre TYP_bkvpe TYP_enwse TYP_epcle TYP_etre TYP_ev1 TYP_ev2 TYP_ev3 TYP_ev4 TYP_hshe TYP_kpe TYP_lde TYP_lues1e TYP_mile TYP_nwse TYP_slpe TYP_slve TYP_teve TYP_uvse TYP_zet1 TYP_zet2 TYP_zet3 TYP_zet4 Z_agre Z_bkvpe Z_enwse Z_epcle Z_etre Z_ev1 Z_ev2 Z_ev3 Z_ev4 Z_hshe Z_kpe Z_lde Z_lues1e Z_mile Z_nwse Z_slpe Z_slve Z_teve Z_uvse Z_zet1 Z_zet2 Z_zet3 Z_zet4 /end OUT_MEASUREMENT
 /begin LOC_MEASUREMENT /end LOC_MEASUREMENT
 /begin SUB_FUNCTION /end SUB_FUNCTION
/end FUNCTION
/begin FUNCTION DFPM_DENWS "" /begin DEF_CHARACTERISTIC CDCENWS CDKENWS CDTENWS CLAENWS FFTENWS TSFENWS /end DEF_CHARACTERISTIC /begin REF_CHARACTERISTIC /end REF_CHARACTERISTIC /begin IN_MEASUREMENT /end IN_MEASUREMENT
 /begin OUT_MEASUREMENT B_beenws B_bkenws B_clenws B_ftenws B_mnenws B_mxenws B_npenws B_sienws E_enws sfpenws TYP_enws Z_enws /end OUT_MEASUREMENT
 /begin LOC_MEASUREMENT /end LOC_MEASUREMENT
 /begin SUB_FUNCTION /end SUB_FUNCTION
/end FUNCTION
/begin FUNCTION DFPM_DFPM ""
 /begin DEF_CHARACTERISTIC CDCAAA CDCZZZ CDKAAA CDKZZZ CDTAAA CDTZZZ CLAAAA CLAZZZ FFTAAA FFTZZZ TSFAAA TSFZZZ /end DEF_CHARACTERISTIC
 /begin REF_CHARACTERISTIC /end REF_CHARACTERISTIC
 /begin IN_MEASUREMENT /end IN_MEASUREMENT
 /begin OUT_MEASUREMENT E_aaa sfpaaa sfpzzz Z_aaa /end OUT_MEASUREMENT
 /begin LOC_MEASUREMENT /end LOC_MEASUREMENT
 /begin SUB_FUNCTION /end SUB_FUNCTION
/end FUNCTION
/begin FUNCTION DFPM_DHFM "" /begin DEF_CHARACTERISTIC /end DEF_CHARACTERISTIC /begin REF_CHARACTERISTIC /end REF_CHARACTERISTIC /begin IN_MEASUREMENT /end IN_MEASUREMENT /begin OUT_MEASUREMENT /end OUT_MEASUREMENT /begin LOC_MEASUREMENT /end LOC_MEASUREMENT /begin SUB_FUNCTION /end SUB_FUNCTION /end FUNCTION
/begin FUNCTION DFPM_DHLSHK ""
 /begin DEF_CHARACTERISTIC CDCHSH CDCHSH2 CDKHSH CDKHSH2 CDTHSH CDTHSH2 CLAHSH CLAHSH2 FFTHSH FFTHSH2 TSFHSH TSFHSH2 /end DEF_CHARACTERISTIC
 /begin REF_CHARACTERISTIC /end REF_CHARACTERISTIC
 /begin IN_MEASUREMENT /end IN_MEASUREMENT
 /begin OUT_MEASUREMENT B_behsh B_behsh2 B_bkhsh B_bkhsh2 B_clhsh B_clhsh2 B_fahsh B_fahsh2 B_mnhsh B_mnhsh2 B_mxhsh B_mxhsh2 B_nphsh B_nphsh2 B_sihsh B_sihsh2 E_hsh E_hsh2 sfphsh sfphsh2 TYP_hsh TYP_hsh2 Z_hsh Z_hsh2 /end OUT_MEASUREMENT
 /begin LOC_MEASUREMENT /end LOC_MEASUREMENT
 /begin SUB_FUNCTION /end SUB_FUNCTION
/end FUNCTION
/begin FUNCTION DFPM_DHLSU ""
 /begin DEF_CHARACTERISTIC CDCHSV CDCHSV2 CDCHSVSA CDCHSVSA2 CDKHSV CDKHSV2 CDKHSVSA CDKHSVSA2 CDTHSV CDTHSV2 CDTHSVSA CDTHSVSA2 CLAHSV CLAHSV2 CLAHSVSA CLAHSVSA2 FFTHSV FFTHSV2 FFTHSVSA FFTHSVSA2 TSFHSV TSFHSV2 TSFHSVSA TSFHSVSA2 /end DEF_CHARACTERISTIC
 /begin REF_CHARACTERISTIC /end REF_CHARACTERISTIC
 /begin IN_MEASUREMENT /end IN_MEASUREMENT
 /begin OUT_MEASUREMENT B_behsv B_behsv2 B_behsvsa B_behsvsa2 B_bkhsv B_bkhsv2 B_bkhsvsa B_bkhsvsa2 B_clhsv B_clhsv2 B_clhsvsa B_clhsvsa2 B_fthsv B_fthsv2 B_fthsvsa B_fthsvsa2 B_mnhsv B_mnhsv2 B_mnhsvsa B_mnhsvsa2 B_mxhsv B_mxhsv2 B_mxhsvsa B_mxhsvsa2 B_nphsv B_nphsv2 B_nphsvsa B_nphsvsa2 B_sihsv B_sihsv2 B_sihsvsa B_sihsvsa2 E_hsv E_hsv2 E_hsvsa E_hsvsa2 sfphsv sfphsv2 sfphsvsa sfphsvsa2 TYP_hsv TYP_hsv2 TYP_hsvsa TYP_hsvsa2 Z_hsv Z_hsv2 Z_hsvsa Z_hsvsa2 /end OUT_MEASUREMENT
 /begin LOC_MEASUREMENT /end LOC_MEASUREMENT
 /begin SUB_FUNCTION /end SUB_FUNCTION
/end FUNCTION
/begin FUNCTION DFPM_DKATSP "" /begin DEF_CHARACTERISTIC CDCKAT CDKKAT CDTKAT CLAKAT FFTKAT TSFKAT /end DEF_CHARACTERISTIC /begin REF_CHARACTERISTIC /end REF_CHARACTERISTIC /begin IN_MEASUREMENT /end IN_MEASUREMENT
 /begin OUT_MEASUREMENT B_bekat B_bkkat B_clkat B_ftkat B_mnkat B_mxkat B_npkat B_sikat E_kat sfpkat TYP_kat Z_kat /end OUT_MEASUREMENT
 /begin LOC_MEASUREMENT /end LOC_MEASUREMENT
 /begin SUB_FUNCTION /end SUB_FUNCTION
/end FUNCTION
/begin FUNCTION DFPM_dkmtr "dkmtr." /begin DEF_CHARACTERISTIC CDCLUE1 CDKLUE1 CDTLUE1 CLALUE1 FFTLUE1 TSFLUE1 /end DEF_CHARACTERISTIC /begin REF_CHARACTERISTIC /end REF_CHARACTERISTIC /begin IN_MEASUREMENT /end IN_MEASUREMENT
 /begin OUT_MEASUREMENT B_belue1 B_bklue1 B_cllue1 B_ftlue1 B_mnlue1 B_mxlue1 B_nplue1 B_silue1 E_lue1 sfplue1 TYP_lue1 Z_lue1 /end OUT_MEASUREMENT
 /begin LOC_MEASUREMENT /end LOC_MEASUREMENT
 /begin SUB_FUNCTION /end SUB_FUNCTION
/end FUNCTION
/begin FUNCTION DFPM_DKRA ""
 /begin DEF_CHARACTERISTIC CDCKRA01 CDCKRA02 CDCKRA03 CDCKRA04 CDKKRA01 CDKKRA02 CDKKRA03 CDKKRA04 CDTKRA01 CDTKRA02 CDTKRA03 CDTKRA04 CLAKRA01 CLAKRA02 CLAKRA03 CLAKRA04 FFTKRA01 FFTKRA02 FFTKRA03 FFTKRA04 TSFKRA01 TSFKRA02 TSFKRA03 TSFKRA04 /end DEF_CHARACTERISTIC
 /begin REF_CHARACTERISTIC /end REF_CHARACTERISTIC
 /begin IN_MEASUREMENT /end IN_MEASUREMENT
 /begin OUT_MEASUREMENT B_clkra01 B_clkra02 B_clkra03 B_clkra04 B_mxkra01 B_mxkra02 B_mxkra03 B_mxkra04 E_kra01 E_kra02 E_kra03 E_kra04 sfpkra01 sfpkra02 sfpkra03 sfpkra04 TYPkra01 TYPkra02 TYPkra03 TYPkra04 Z_kra01 Z_kra02 Z_kra03 Z_kra04 /end OUT_MEASUREMENT
 /begin LOC_MEASUREMENT /end LOC_MEASUREMENT
 /begin SUB_FUNCTION /end SUB_FUNCTION
/end FUNCTION
/begin FUNCTION DFPM_DKRNT ""
 /begin DEF_CHARACTERISTIC CDCKRNT CDCKROF CDKKRNT CDKKROF CDTKRNT CDTKROF CLAKRNT CLAKROF FFTKRNT FFTKROF TSFKRNT TSFKROF /end DEF_CHARACTERISTIC
 /begin REF_CHARACTERISTIC /end REF_CHARACTERISTIC
 /begin IN_MEASUREMENT /end IN_MEASUREMENT
 /begin OUT_MEASUREMENT B_bekrnt B_bekrof B_bkkrnt B_bkkrof B_clkrnt B_clkrof B_ftkrnt B_ftkrof B_mnkrnt B_mnkrof B_mxkrnt B_mxkrof B_npkrnt B_npkrof B_sikrnt B_sikrof E_krnt E_krof sfpkrnt sfpkrof TYP_krnt TYP_krof Z_krnt Z_krof /end OUT_MEASUREMENT
 /begin LOC_MEASUREMENT /end LOC_MEASUREMENT
 /begin SUB_FUNCTION /end SUB_FUNCTION
/end FUNCTION
/begin FUNCTION DFPM_DKRS ""
 /begin DEF_CHARACTERISTIC CDCKS1 CDCKS2 CDCKS3 CDCKS4 CDKKS1 CDKKS2 CDKKS3 CDKKS4 CDTKS1 CDTKS2 CDTKS3 CDTKS4 CLAKS1 CLAKS2 CLAKS3 CLAKS4 FFTKS1 FFTKS2 FFTKS3 FFTKS4 TSFKS1 TSFKS2 TSFKS3 TSFKS4 /end DEF_CHARACTERISTIC
 /begin REF_CHARACTERISTIC /end REF_CHARACTERISTIC
 /begin IN_MEASUREMENT /end IN_MEASUREMENT
 /begin OUT_MEASUREMENT B_beks1 B_beks2 B_beks3 B_beks4 B_bkks1 B_bkks2 B_bkks3 B_bkks4 B_clks1 B_clks2 B_clks3 B_clks4 B_ftks1 B_ftks2 B_ftks3 B_ftks4 B_mnks1 B_mnks2 B_mnks3 B_mnks4 B_mxks1 B_mxks2 B_mxks3 B_mxks4 B_npks1 B_npks2 B_npks3 B_npks4 B_siks1 B_siks2 B_siks3 B_siks4 E_ks1 E_ks2 E_ks3 E_ks4 sfpks1 sfpks2 sfpks3 sfpks4 TYP_ks1 TYP_ks2 TYP_ks3 TYP_ks4 Z_ks1 Z_ks2 Z_ks3 Z_ks4 /end OUT_MEASUREMENT
 /begin LOC_MEASUREMENT /end LOC_MEASUREMENT
 /begin SUB_FUNCTION /end SUB_FUNCTION
/end FUNCTION
/begin FUNCTION DFPM_DKRTP "" /begin DEF_CHARACTERISTIC CDCKRTP CDKKRTP CDTKRTP CLAKRTP FFTKRTP TSFKRTP /end DEF_CHARACTERISTIC /begin REF_CHARACTERISTIC /end REF_CHARACTERISTIC /begin IN_MEASUREMENT /end IN_MEASUREMENT
 /begin OUT_MEASUREMENT B_bekrtp B_bkkrtp B_clkrtp B_ftkrtp B_mnkrtp B_mxkrtp B_npkrtp B_sikrtp E_krtp sfpkrtp TYP_krtp Z_krtp /end OUT_MEASUREMENT
 /begin LOC_MEASUREMENT /end LOC_MEASUREMENT
 /begin SUB_FUNCTION /end SUB_FUNCTION
/end FUNCTION
/begin FUNCTION DFPM_DKUPPL "" /begin DEF_CHARACTERISTIC CDCKUPPL CDKKUPPL CDTKUPPL CLAKUPPL FFTKUPPL TSFKUPPL /end DEF_CHARACTERISTIC /begin REF_CHARACTERISTIC /end REF_CHARACTERISTIC /begin IN_MEASUREMENT /end IN_MEASUREMENT
 /begin OUT_MEASUREMENT B_bekuppl B_bkkuppl B_clkuppl B_ftkuppl B_mnkuppl B_mxkuppl B_npkuppl B_sikuppl E_kuppl sfpkuppl TYP_kuppl Z_kuppl /end OUT_MEASUREMENT
 /begin LOC_MEASUREMENT /end LOC_MEASUREMENT
 /begin SUB_FUNCTION /end SUB_FUNCTION
/end FUNCTION
/begin FUNCTION DFPM_DKVS ""
 /begin DEF_CHARACTERISTIC CDCFRAO CDCFRAU CDCFRST CDCRKAT CDCRKAZ CDKFRAO CDKFRAU CDKFRST CDKRKAT CDKRKAZ CDTFRAO CDTFRAU CDTFRST CDTRKAT CDTRKAZ CLAFRAO CLAFRAU CLAFRST CLARKAT CLARKAZ FFTFRAO FFTFRAU FFTFRST FFTRKAT FFTRKAZ TSFFRAO TSFFRAU TSFFRST TSFRKAT TSFRKAZ /end DEF_CHARACTERISTIC
 /begin REF_CHARACTERISTIC /end REF_CHARACTERISTIC
 /begin IN_MEASUREMENT /end IN_MEASUREMENT
 /begin OUT_MEASUREMENT B_befrao B_befrau B_befrst B_berkat B_berkaz B_bkfrao B_bkfrau B_bkfrst B_bkrkat B_bkrkaz B_clfrao B_clfrau B_clfrst B_clrkat B_clrkaz B_ftfrao B_ftfrau B_ftfrst B_ftrkat B_ftrkaz B_mnfrao B_mnfrau B_mnfrst B_mnrkat B_mnrkaz B_mxfrao B_mxfrau B_mxfrst B_mxrkat B_mxrkaz B_npfrao B_npfrau B_npfrst B_nprkat B_nprkaz B_sifrao B_sifrau B_sifrst B_sirkat B_sirkaz E_frao E_frau E_frst E_rkat E_rkaz sfpfrao sfpfrau sfpfrst sfprkat sfprkaz TYP_frao TYP_frau TYP_frst TYP_rkat TYP_rkaz Z_frao Z_frau Z_frst Z_rkat Z_rkaz /end OUT_MEASUREMENT
 /begin LOC_MEASUREMENT /end LOC_MEASUREMENT
 /begin SUB_FUNCTION /end SUB_FUNCTION
/end FUNCTION
/begin COMPU_METHOD B_TRUE "boolsche Zustände, positive Logik" TAB_VERB "%6.3" "" COMPU_TAB_REF B_TRUE /end COMPU_METHOD
/begin COMPU_VTAB B_TRUE "boolsche Zustände, positive Logik" TAB_VERB 2 0 "----" 1 "TRUE" /end COMPU_VTAB
/begin COMPU_METHOD DEZ "1 : 1 Umrechnug (dez/hex)" RAT_FUNC "%6.2" "" COEFFS 0 1 0 0 0 1 /end COMPU_METHOD
/begin COMPU_METHOD dez "1 : 1 Umrechnug (dez/hex)" RAT_FUNC "%6.2" "" COEFFS 0 1 0 0 0 1 /end COMPU_METHOD
/begin COMPU_METHOD default "" RAT_FUNC "%6.2" "" COEFFS 0 1 0 0 0 1 /end COMPU_METHOD
/begin RECORD_LAYOUT KwbUb FNC_VALUES 1 UBYTE COLUMN_DIR DIRECT /end RECORD_LAYOUT
/begin RECORD_LAYOUT KwbUw FNC_VALUES 1 UWORD COLUMN_DIR DIRECT /end RECORD_LAYOUT
/begin RECORD_LAYOUT KwUb FNC_VALUES 1 UBYTE COLUMN_DIR DIRECT /end RECORD_LAYOUT
/begin RECORD_LAYOUT KwUw FNC_VALUES 1 UWORD COLUMN_DIR DIRECT /end RECORD_LAYOUT
/end MODULE
/end PROJECT
