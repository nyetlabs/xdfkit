ASAP2_VERSION 1 3
/begin PROJECT X505R_24d1_0 "4019.XX"
/begin HEADER "" VERSION "X505R_24d1_0" PROJECT_NO X505R_24d1_0 /end HEADER
/begin MODULE DIM ""
/begin MOD_COMMON "" BYTE_ORDER MSB_LAST ALIGNMENT_BYTE 1 ALIGNMENT_WORD 2 ALIGNMENT_LONG 2 /end MOD_COMMON
/begin CHARACTERISTIC ADKATNF "Normierungsfaktor für Signalamplitude der Sonde bzw. Katbelastung" VALUE 0x8187DB KwUb 23.87 spg_ub_b24 0.00 23.87 FORMAT "%5.2" /end CHARACTERISTIC
/begin CHARACTERISTIC AGANGW "Anzahl Gangwechsel für Diagnose Kupplungsschalter" VALUE 0x8188D9 KwUb 255.0 dez 0.00 255.0 FORMAT "%5.1" /end CHARACTERISTIC
/begin CHARACTERISTIC AHKATMN_0_A "Schwellwert Katalysator gut,  AHKAT < AHKATMN" VALUE 0x81BE42 KwUb 0.9961 fak_ub_b1 0.00 0.9961 /end CHARACTERISTIC
/begin CHARACTERISTIC AHKATMN_1_A "Schwellwert Katalysator gut,  AHKAT < AHKATMN" VALUE 0x81BE43 KwUb 0.9961 fak_ub_b1 0.00 0.9961 /end CHARACTERISTIC
/begin CHARACTERISTIC AHKATMX_0_A "Schwellwert Katalysator defekt,  AHKAT > AHKATMX" VALUE 0x81BE44 KwUb 0.9961 fak_ub_b1 0.00 0.9961 /end CHARACTERISTIC
/begin CHARACTERISTIC AHKATMX_1_A "Schwellwert Katalysator defekt,  AHKAT > AHKATMX" VALUE 0x81BE45 KwUb 0.9961 fak_ub_b1 0.00 0.9961 /end CHARACTERISTIC
/begin CHARACTERISTIC AHKATS "Schwellwert für Summe AHKAT,AHKAT2 (Stereo )" VALUE 0x8187DC KwUb 1.992 fak_ub_b2 0.00 1.992 FORMAT "%5.3" /end CHARACTERISTIC
/begin CHARACTERISTIC AHKATSB "Schwellwert für Summenbereichfehler (Stereo)" VALUE 0x8187DD KwUb 0.9961 fak_ub_b1 0.00 0.9961 /end CHARACTERISTIC
/begin CHARACTERISTIC AHKTMXT_0_A "Schwellwert Katalysator defekt bei Testerbetrieb" VALUE 0x81BE46 KwUb 0.9961 fak_ub_b1 0.00 0.9961 /end CHARACTERISTIC
/begin CHARACTERISTIC AHKTMXT_1_A "Schwellwert Katalysator defekt bei Testerbetrieb" VALUE 0x81BE47 KwUb 0.9961 fak_ub_b1 0.00 0.9961 /end CHARACTERISTIC
/begin CHARACTERISTIC AHKTTSW "Setztwert für Zeitgeber in Signalauswertung" VALUE 0x81BE0E KwUw 3276.750 t50msxs_uw_b3276p75 0.00 3276.750 FORMAT "%8.3" /end CHARACTERISTIC
/begin CHARACTERISTIC AKUPPLB "Anzahl Kupplung betätigt für Diagnose Kupplungsschalter" VALUE 0x8188DA KwUb 255.0 dez 0.00 255.0 FORMAT "%5.1" /end CHARACTERISTIC
/begin CHARACTERISTIC ANZDYNSH "Anzahl der Dynamikmessungen für Schwingungsprüfung Sonde hinter KAT" VALUE 0x818779 KwUb 255.0 dez 0.00 255.0 FORMAT "%5.1" /end CHARACTERISTIC
/begin CHARACTERISTIC APEKTDX "max. Anzahl Fehlerprüfungen bei Kat-Diagnose" VALUE 0x8187DE KwUb 255.0 dez 0.00 255.0 FORMAT "%5.1" /end CHARACTERISTIC
/begin CHARACTERISTIC APULSMX "Maximale Anzahl Impulse bei Einzelimpulsansteuerung" VALUE 0x811F21 KwUb 255.0 dez 0.00 255.0 FORMAT "%5.1" /end CHARACTERISTIC
/begin CHARACTERISTIC AVKATFS "Setztwert für AVKATF wenn Powerfail" VALUE 0x8187DF KwUb 0.9961 fak_ub_b1 0.00 0.9961 /end CHARACTERISTIC
/begin CHARACTERISTIC AZLRKTD_0_A "Zwangsamplitude für Lambdaregelung aus Kat-Diagnose" VALUE 0x81BE48 KwUb 0.249023438 fak_ub_b0p25 0.00 0.249023438 FORMAT "%11.9" /end CHARACTERISTIC
/begin CHARACTERISTIC AZLRKTD_1_A "Zwangsamplitude für Lambdaregelung aus Kat-Diagnose" VALUE 0x81BE49 KwUb 0.249023438 fak_ub_b0p25 0.00 0.249023438 FORMAT "%11.9" /end CHARACTERISTIC
/begin CHARACTERISTIC AZLRKTT_0_A "Zwangsamplitude für Lambdaregelung aus Kat-Diagnose bei Testeranforderung" VALUE 0x81BE4A KwUb 0.249023438 fak_ub_b0p25 0.00 0.249023438 FORMAT "%11.9" /end CHARACTERISTIC
/begin CHARACTERISTIC AZLRKTT_1_A "Zwangsamplitude für Lambdaregelung aus Kat-Diagnose bei Testeranforderung" VALUE 0x81BE4B KwUb 0.249023438 fak_ub_b0p25 0.00 0.249023438 FORMAT "%11.9" /end CHARACTERISTIC
/begin CHARACTERISTIC BLDPMX "Max. Fahrzeugbeschleunigung bei 0.5 mm - Diagnose" VALUE 0x82835C KwSw 13.8899313 bfzg_sw_q4p239Em4 0.00 13.8899313 /end CHARACTERISTIC
/begin CHARACTERISTIC CDCAATUN "Codewort CARB: Tuningschutz" VAL_BLK 0x813370 KwbUw 65535.00 dez 0.00 65535.00 FORMAT "%8.2" NUMBER 4 /end CHARACTERISTIC
/begin CHARACTERISTIC CDCHRE "" VAL_BLK 0x813558 KwbUw 65535.00 dez 0.00 65535.00 FORMAT "%8.2" NUMBER 4 /end CHARACTERISTIC
/begin CHARACTERISTIC CDCLDPE "Codewort CARB: Leckdiagnosepumpe Endstufe" VAL_BLK 0x813630 KwbUw 65535.00 dez 0.00 65535.00 FORMAT "%8.2" NUMBER 4 /end CHARACTERISTIC
/begin CHARACTERISTIC CDCMDB "Codewort CARB: Momentbegrenzung Sollmoment" VAL_BLK 0x813698 KwbUw 65535.00 dez 0.00 65535.00 FORMAT "%8.2" NUMBER 4 /end CHARACTERISTIC
/begin CHARACTERISTIC CDCSGEEW "Codewort CARB: Steuergerät defekt (EEPROM WFS-Bereich)" VAL_BLK 0x8136F8 KwbUw 65535.00 dez 0.00 65535.00 FORMAT "%8.2" NUMBER 4 /end CHARACTERISTIC
/begin CHARACTERISTIC CDCUB "Codewort CARB: Batteriespannung UB (Bordnetz)" VAL_BLK 0x813788 KwbUw 65535.00 dez 0.00 65535.00 FORMAT "%8.2" NUMBER 4 /end CHARACTERISTIC
/begin CHARACTERISTIC CDCUBR "Codewort CARB: UBR Bordnetzspannung über Hauptrelais" VAL_BLK 0x813790 KwbUw 65535.00 dez 0.00 65535.00 FORMAT "%8.2" NUMBER 4 /end CHARACTERISTIC
/begin CHARACTERISTIC CDCWFS "Codewort CARB: Wegfahrsperre" VAL_BLK 0x8137D0 KwbUw 65535.00 dez 0.00 65535.00 FORMAT "%8.2" NUMBER 4 /end CHARACTERISTIC
/begin CHARACTERISTIC CDCWFSRC "Codewort CARB: Wegfahrsperre RC-Glied" VAL_BLK 0x8137D8 KwbUw 65535.00 dez 0.00 65535.00 FORMAT "%8.2" NUMBER 4 /end CHARACTERISTIC
/begin CHARACTERISTIC CDKAATUN "" VAL_BLK 0x813810 KwbUw 65535.00 dez 0.00 65535.00 FORMAT "%8.2" NUMBER 4 /end CHARACTERISTIC
/begin CHARACTERISTIC CDKATLK "Codewort für B_lrka aktiv" VALUE 0x8187E0 KwUb 255.0 dez 0.00 255.0 FORMAT "%5.1" /end CHARACTERISTIC
/begin CHARACTERISTIC CDKHRE "" VAL_BLK 0x8139F8 KwbUw 65535.00 dez 0.00 65535.00 FORMAT "%8.2" NUMBER 4 /end CHARACTERISTIC
/begin CHARACTERISTIC CDKLDPE "Codewort Kunde: Leckdiagnosepumpe Endstufe" VAL_BLK 0x813AD0 KwbUw 65535.00 dez 0.00 65535.00 FORMAT "%8.2" NUMBER 4 /end CHARACTERISTIC
/begin CHARACTERISTIC CDKMDB "Codewort Kunde: Momentbegrenzung Sollmoment" VAL_BLK 0x813B38 KwbUw 65535.00 dez 0.00 65535.00 FORMAT "%8.2" NUMBER 4 /end CHARACTERISTIC
/begin CHARACTERISTIC CDKSGEEW "Codewort Kunde: Steuergerät defekt (EEPROM WFS-Bereich)" VAL_BLK 0x813B98 KwbUw 65535.00 dez 0.00 65535.00 FORMAT "%8.2" NUMBER 4 /end CHARACTERISTIC
/begin CHARACTERISTIC CDKUB "Codewort Kunde:	UB" VAL_BLK 0x813C28 KwbUw 65535.00 dez 0.00 65535.00 FORMAT "%8.2" NUMBER 4 /end CHARACTERISTIC
/begin CHARACTERISTIC CDKUBR "" VAL_BLK 0x813C30 KwbUw 65535.00 dez 0.00 65535.00 FORMAT "%8.2" NUMBER 4 /end CHARACTERISTIC
/begin CHARACTERISTIC CDKWFS "Codewort Kunde: Wegfahrsperre" VAL_BLK 0x813C70 KwbUw 65535.00 dez 0.00 65535.00 FORMAT "%8.2" NUMBER 4 /end CHARACTERISTIC
/begin CHARACTERISTIC CDKWFSRC "Codewort Kunde: Wegfahrsperre RC-Glied" VAL_BLK 0x813C78 KwbUw 65535.00 dez 0.00 65535.00 FORMAT "%8.2" NUMBER 4 /end CHARACTERISTIC
/begin CHARACTERISTIC CDTAATUN "Codewort Tester: Tuningschutz" VALUE 0x813CAA KwUw 65535.00 dez 0.00 65535.00 FORMAT "%8.2" /end CHARACTERISTIC
/begin CHARACTERISTIC CDTHRE "" VALUE 0x813D24 KwUw 65535.00 dez 0.00 65535.00 FORMAT "%8.2" /end CHARACTERISTIC
/begin CHARACTERISTIC CDTLDPE "Codewort Tester: Leckdiagnosepumpe Endstufe" VALUE 0x813D5A KwUw 65535.00 dez 0.00 65535.00 FORMAT "%8.2" /end CHARACTERISTIC
/begin CHARACTERISTIC CDTMDB "Codewort Tester: Momentbegrenzung Sollmoment" VALUE 0x813D74 KwUw 65535.00 dez 0.00 65535.00 FORMAT "%8.2" /end CHARACTERISTIC
/begin CHARACTERISTIC CDTSGEEW "Codewort Tester: Steuergerät defekt (EEPROM WFS-Bereich)" VALUE 0x813D8C KwUw 65535.00 dez 0.00 65535.00 FORMAT "%8.2" /end CHARACTERISTIC
/begin CHARACTERISTIC CDTUB "Codewort Tester: UB" VALUE 0x813DB0 KwUw 65535.00 dez 0.00 65535.00 FORMAT "%8.2" /end CHARACTERISTIC
/begin CHARACTERISTIC CDTUBR "Codewort Tester: UBR Bordnetzspannung über Hauptrelais" VALUE 0x813DB2 KwUw 65535.00 dez 0.00 65535.00 FORMAT "%8.2" /end CHARACTERISTIC
/begin CHARACTERISTIC CDTWFS "Codewort Tester: Wegfahrsperre" VALUE 0x813DC2 KwUw 65535.00 dez 0.00 65535.00 FORMAT "%8.2" /end CHARACTERISTIC
/begin CHARACTERISTIC CDTWFSRC "Codewort Tester: Wegfahrsperre RC-Glied" VALUE 0x813DC4 KwUw 65535.00 dez 0.00 65535.00 FORMAT "%8.2" /end CHARACTERISTIC
/begin CHARACTERISTIC CLAAATUN "Fehlerklasse: Tuningschutz" VALUE 0x810764 KwUb 255.0 dez 0.00 255.0 FORMAT "%5.1" /end CHARACTERISTIC
/begin CHARACTERISTIC CLAHRE "" VALUE 0x8107A1 KwUb 255.0 dez 0.00 255.0 FORMAT "%5.1" /end CHARACTERISTIC
/begin CHARACTERISTIC CLALDPE "Fehlerklasse: LDP  Endstufe" VALUE 0x8107BC KwUb 255.0 dez 0.00 255.0 FORMAT "%5.1" /end CHARACTERISTIC
/begin CHARACTERISTIC CLAMDB "Fehlerklasse: Momentbgrenzung Sollmoment" VALUE 0x8107C9 KwUb 255.0 dez 0.00 255.0 FORMAT "%5.1" /end CHARACTERISTIC
/begin CHARACTERISTIC CLASGEEW "Fehlerklasse: SG defekt (EEPROM WFS- Bereich)" VALUE 0x8107D5 KwUb 255.0 dez 0.00 255.0 FORMAT "%5.1" /end CHARACTERISTIC
/begin CHARACTERISTIC CLAUB "Fehlerklasse: Batteriespannung UB (Bordnetz)" VALUE 0x8107E7 KwUb 255.0 dez 0.00 255.0 FORMAT "%5.1" /end CHARACTERISTIC
/begin CHARACTERISTIC CLAUBR "Fehlerklasse: UBR Bordnetzspannung über Hauptrelais" VALUE 0x8107E8 KwUb 255.0 dez 0.00 255.0 FORMAT "%5.1" /end CHARACTERISTIC
/begin CHARACTERISTIC CLAWFS "Fehlerklasse: Wegfahrsperre" VALUE 0x8107F0 KwUb 255.0 dez 0.00 255.0 FORMAT "%5.1" /end CHARACTERISTIC
/begin CHARACTERISTIC CLAWFSRC "Fehlerklasse: Wegfahrsperre RC-Glied" VALUE 0x8107F1 KwUb 255.0 dez 0.00 255.0 FORMAT "%5.1" /end CHARACTERISTIC
/begin CHARACTERISTIC CLDPAAV "Codewort Elektrisches AAV vorhanden" VALUE 0x811F22 KwUb 255.0 dez 0.00 255.0 FORMAT "%5.1" /end CHARACTERISTIC
/begin CHARACTERISTIC CLDPTVC "Codewort DLDP-TEV- Check" VALUE 0x81A26D KwUb 255.0 dez 0.00 255.0 FORMAT "%5.1" /end CHARACTERISTIC
/begin CHARACTERISTIC CPLRA "Codewort für Umschaltung DKVS von HFM- auf P-System" VALUE 0x81925F KwUb 255.0 dez 0.00 255.0 FORMAT "%5.1" /end CHARACTERISTIC
/begin CHARACTERISTIC CWBAESEL "Codewort für Umschaltung Bergaberkennung usw." VALUE 0x811F23 KwUb 255.0 dez 0.00 255.0 FORMAT "%5.1" /end CHARACTERISTIC
/begin CHARACTERISTIC CWDHFM "Codewort in DHFM" VALUE 0x818A25 KwUb 255.0 dez 0.00 255.0 FORMAT "%5.1" /end CHARACTERISTIC
/begin CHARACTERISTIC CWDHLSH "Codewort in DHLSHK" VALUE 0x8184BE KwUb 255.0 dez 0.00 255.0 FORMAT "%5.1" /end CHARACTERISTIC
/begin CHARACTERISTIC CWDKRNT "Codewort: KR-Diagnose Integratorsteigung" VALUE 0x8111F8 KwUb 255.0 dez 0.00 255.0 FORMAT "%5.1" /end CHARACTERISTIC
/begin CHARACTERISTIC CWDKROF "Codewort: KR-Diagnose Resetwert" VALUE 0x8111F9 KwUb 255.0 dez 0.00 255.0 FORMAT "%5.1" /end CHARACTERISTIC
/begin CHARACTERISTIC CWDKRTP "Codewort: KR-Diagnose Testimpuls" VALUE 0x8111FD KwUb 255.0 dez 0.00 255.0 FORMAT "%5.1" /end CHARACTERISTIC
/begin CHARACTERISTIC CWDKS1 "Codewort: Klopfsensordiagnose Sensor1" VALUE 0x81994A KwUb 255.0 dez 0.00 255.0 FORMAT "%5.1" /end CHARACTERISTIC
/begin CHARACTERISTIC CWDKS2 "Codewort: Klopfsensordiagnose Sensor 2" VALUE 0x81994B KwUb 255.0 dez 0.00 255.0 FORMAT "%5.1" /end CHARACTERISTIC
/begin CHARACTERISTIC CWDKS3 "Codewort: Klopfsensordiagnose Sensor 3" VALUE 0x81994C KwUb 255.0 dez 0.00 255.0 FORMAT "%5.1" /end CHARACTERISTIC
/begin CHARACTERISTIC CWDKS4 "Codewort: Klopfsensordiagnose Sensor 4" VALUE 0x81994D KwUb 255.0 dez 0.00 255.0 FORMAT "%5.1" /end CHARACTERISTIC
/begin CHARACTERISTIC CWDKVSS "Codewort für Error in DKVS sperren, wenn andere Fehler vorliegen" VALUE 0x819260 KwUb 255.0 dez 0.00 255.0 FORMAT "%5.1" /end CHARACTERISTIC
/begin CHARACTERISTIC CWDLDP "Codewort Leckdiagnose DLDP" VALUE 0x81A26E KwUb 255.0 dez 0.00 255.0 FORMAT "%5.1" /end CHARACTERISTIC
/begin CHARACTERISTIC CWDLDUV "Codeword für Diagnose Schubumluftventil" VALUE 0x811247 KwUb 255.0 dez 0.00 255.0 FORMAT "%5.1" /end CHARACTERISTIC
/begin CHARACTERISTIC CWDLSAHK "Codewort CWDLSAHK für Alterung Sonde hinter KAT" VALUE 0x81877A KwUb 255.0 dez 0.00 255.0 FORMAT "%5.1" /end CHARACTERISTIC
/begin CHARACTERISTIC CWKATUM "Codewort für Umschalten in der Katdiagnose" VALUE 0x810A3D KwUb 255.0 dez 0.00 255.0 FORMAT "%5.1" /end CHARACTERISTIC
/begin CHARACTERISTIC DASA "Anzahl der SAS-Phasen zur Erkennung LLS Fehler" VALUE 0x819D8B KwUb 255.0 dez 0.00 255.0 FORMAT "%5.1" /end CHARACTERISTIC
/begin CHARACTERISTIC DELTATA "Delta  Ansauglufttemperatur zu Starttemperatur des Motors" VALUE 0x81A26F KwSb 191.3 temp_ub_q0p75 -96.00 95.25 FORMAT "%5.2" /end CHARACTERISTIC
/begin CHARACTERISTIC DFRMST "Delta frm-schwelle für Erkennung der eingeschwungenen Grundadaption" VALUE 0x819261 KwUb 1.992 fak_ub_b2 0.00 1.992 FORMAT "%5.3" /end CHARACTERISTIC
/begin CHARACTERISTIC DKATCW "einmaliger Lauf bzw. Initialisierung der DKAT-Funktion" VALUE 0x8187E1 KwUb 255.0 dez 0.00 255.0 FORMAT "%5.1" /end CHARACTERISTIC
/begin CHARACTERISTIC DKLDPN "Maximaler Drosselklappenwinkel bei Leckdiagnose" CURVE 0x811F24 KlAUbSstUbWUb 100.0 relDK_ub_b100 0.00 100.0 FORMAT "%5.1"
 /begin AXIS_DESCR STD_AXIS nmot nmot_ub_q40 6 0.00 10200. FORMAT "%5.0" DEPOSIT ABSOLUTE /end AXIS_DESCR
/end CHARACTERISTIC
/begin CHARACTERISTIC DKRAMX "Maximale Anzahl Spätverstellungen für Klopfregelanschlag" VALUE 0x81585A KwUw 65535.00 dez 0.00 65535.00 FORMAT "%8.2" /end CHARACTERISTIC
/begin CHARACTERISTIC DKRAZ "Zündungzähler für Klopfregelanschlag" VALUE 0x81585C KwUw 65535.00 dez 0.00 65535.00 FORMAT "%8.2" /end CHARACTERISTIC
/begin CHARACTERISTIC DKROFN "Grenzwert der Integratorsteigung für Nulltest" CURVE 0x8159D0 KlAUwSstUwWUw 7323.536 tknockintgrad_sy 0.00 7323.536 FORMAT "%8.3"
 /begin AXIS_DESCR STD_AXIS tmfln_w tknockcon_sy 6 0.00 0.1747600 FORMAT "%9.7" DEPOSIT ABSOLUTE /end AXIS_DESCR
/end CHARACTERISTIC
/begin CHARACTERISTIC DKROKU "Untere Drehzahlschwelle für Ermittlung Offsetkompensationswert" VALUE 0x8111FA KwUb 10200. nmot_ub_q40 0.00 10200. FORMAT "%5.0" /end CHARACTERISTIC
/begin CHARACTERISTIC DKTLMT "Max. Dauer tL-/wdkbl- Grenzwertüberschreitung" CURVE 0x81A270 KlAUbSstUbWUb 255.0 t1sxs_ub_b255 0.00 255.0 FORMAT "%5.1"
 /begin AXIS_DESCR STD_AXIS tfpg t1sxs_ub_b255 6 0.00 255.0 FORMAT "%5.1" DEPOSIT ABSOLUTE /end AXIS_DESCR
/end CHARACTERISTIC
/begin CHARACTERISTIC DLAMLASHF "Delta-Lambda-Sollwert (Fett) für Test Schwingungsprüfung hinter KAT" VALUE 0x81BDBC KwUw 15.99976 fak_uw_b16 0.00 15.99976 FORMAT "%8.5" /end CHARACTERISTIC
/begin CHARACTERISTIC DLAMLASHM "Delta-Lambda-Sollwert (Mager) für Test Schwingungsprüfung hinter KAT" VALUE 0x81BDBE KwUw 15.99976 fak_uw_b16 0.00 15.99976 FORMAT "%8.5" /end CHARACTERISTIC
/begin CHARACTERISTIC DLDUVES "Einschaltschwelle f(pspvds_w) für Schubumluftventildiagnose beim Turbo" VALUE 0x815F62 KwUw 2559.961 p_uw_q0p039 0.00 2559.961 FORMAT "%8.3" /end CHARACTERISTIC
/begin CHARACTERISTIC DLUL "Delta-Last für Überladeschutz-Reset" VALUE 0x819AC9 KwUb 250.0 p_ub_q5 0.00 250.0 FORMAT "%5.1" /end CHARACTERISTIC
/begin CHARACTERISTIC DMRKTD_0_A "Momentenreserve für Katalysator-Diagnose" VALUE 0x81BE26 KwUw 99.99847 rel_uw_b100 0.00 99.99847 FORMAT "%8.5" /end CHARACTERISTIC
/begin CHARACTERISTIC DMRKTD_1_A "Momentenreserve für Katalysator-Diagnose" VALUE 0x81BE28 KwUw 99.99847 rel_uw_b100 0.00 99.99847 FORMAT "%8.5" /end CHARACTERISTIC
/begin CHARACTERISTIC DMRLASH "Momentenreserve für Diagnose Lambdasonden-Alterungsüberwachung hinter KAT" VALUE 0x81BDC0 KwUw 99.99847 rel_uw_b100 0.00 99.99847 FORMAT "%8.5" /end CHARACTERISTIC
/begin CHARACTERISTIC DNDLLRO "Maximale Drehzahlabweichung (Unterdrehzahl) für Diagnose LLR" VALUE 0x819D8C KwUb 1270. nmot_ub_q10 0.00 1270. FORMAT "%5.0" /end CHARACTERISTIC
/begin CHARACTERISTIC DNDLLRU "Maximale Drehzahlabweichung (Überdrehzahl) für Diagnose LLR" VALUE 0x819D8D KwSb 1280. nmot_ub_q10 -1280. 0.00 FORMAT "%5.0" /end CHARACTERISTIC
/begin CHARACTERISTIC DPLPLGD "Abstand Ladesolldruck zu Grundladedruck für Diagnose" VALUE 0x819ACA KwUb 2550. p_ub_q10 0.00 2550. FORMAT "%5.0" /end CHARACTERISTIC
/begin CHARACTERISTIC DPUBABMX "Maximale Schwelle Delta Umgebungsdruck für Bergaberkennung" VALUE 0x8170B0 KwSw 2559.961 p_uw_q0p039 -1280.000 1279.961 FORMAT "%8.3" /end CHARACTERISTIC
/begin CHARACTERISTIC DPUFFMN "Minimale Schwelle für Delta-Umgebungsdruck, Bergauferkennung (0.5 mm - Diagnose)" VALUE 0x8170B2 KwSw 2559.961 p_uw_q0p039 -1280.000 1279.961 FORMAT "%8.3" /end CHARACTERISTIC
/begin CHARACTERISTIC DPUFFMX "Maximale Schwelle für Delta-Umgebungsdruck, Bergaberkennung (0.5 mm - Diagnose)" VALUE 0x8170B4 KwSw 2559.961 p_uw_q0p039 -1280.000 1279.961 FORMAT "%8.3" /end CHARACTERISTIC
/begin CHARACTERISTIC DPUFVMN "Spezifische Druckdifferenz für Saugrohrdrucküberwachung" VALUE 0x8170B6 KwSw 5119.922 p_uw_q0p078 -2560.000 2559.922 FORMAT "%8.3" /end CHARACTERISTIC
/begin CHARACTERISTIC DPUFVSMN "Soll-Druckdifferenz für Saugrohrdrucküberwachung" VALUE 0x8170B8 KwSw 5119.922 p_uw_q0p078 -2560.000 2559.922 FORMAT "%8.3" /end CHARACTERISTIC
/begin CHARACTERISTIC DPULSUV "Hysterese für Pulsationsschwelle Schubumluftventildiagnose beim Turbo" VALUE 0x811248 KwSb 1.992 fak_sb_b1 -1.000 0.9922 FORMAT "%5.3" /end CHARACTERISTIC
/begin CHARACTERISTIC DRLFFMX "Maximale Laständerung bei 0.5 mm - Diagnose" VALUE 0x8170BA KwSw 767.9766 rel_sw_q0p0234 0.00 767.9766 FORMAT "%8.4" /end CHARACTERISTIC
/begin CHARACTERISTIC DRLKTDP_0_A "Schwelle für Laständerung in Kat-Diagnose" VALUE 0x81BE4C KwSb 191.3 rel_sb_q0p75 -96.00 95.25 FORMAT "%5.2" /end CHARACTERISTIC
/begin CHARACTERISTIC DRLKTDP_1_A "Schwelle für Laständerung in Kat-Diagnose" VALUE 0x81BE4D KwSb 191.3 rel_sb_q0p75 -96.00 95.25 FORMAT "%5.2" /end CHARACTERISTIC
/begin CHARACTERISTIC DRLKTDPT_0_A "Schwelle für Laständerung in Kat-Diagnose bei Testeransteuerung" VALUE 0x81BE4E KwSb 191.3 rel_sb_q0p75 -96.00 95.25 FORMAT "%5.2" /end CHARACTERISTIC
/begin CHARACTERISTIC DRLKTDPT_1_A "Schwelle für Laständerung in Kat-Diagnose bei Testeransteuerung" VALUE 0x81BE4F KwSb 191.3 rel_sb_q0p75 -96.00 95.25 FORMAT "%5.2" /end CHARACTERISTIC
/begin CHARACTERISTIC DTMFFU "Differenz Abstelltemperatur - tmot im Start für 0.5 mm - Diagnose" VALUE 0x81A27D KwUb 191.3 temp_sb_q0p75 0.00 191.3 FORMAT "%5.1" /end CHARACTERISTIC
/begin CHARACTERISTIC DTMLDP "Differenz Motorabstelltemperatur - TMOT bei Start" VALUE 0x81A27E KwUb 191.3 temp_sb_q0p75 0.00 191.3 FORMAT "%5.1" /end CHARACTERISTIC
/begin CHARACTERISTIC DTPLDP "Delta-Periodendauer zur Berechnung des Fensters bei Leckdiagnose" VALUE 0x8170BC KwUw 655.3500 t10msxs_uw_b655p35 0.00 655.3500 FORMAT "%8.4" /end CHARACTERISTIC
/begin CHARACTERISTIC DTPXF "Delta-Periodendauer zur Berechnung des Fensters bei 0.5 mm - Diagnose" VALUE 0x8170BE KwUw 655.3500 t10msxs_uw_b655p35 0.00 655.3500 FORMAT "%8.4" /end CHARACTERISTIC
/begin CHARACTERISTIC DVBABFF "Geschwindigkeitsdifferenz zur Bergaberkennung bei 0.5 mm - Diagnose" VALUE 0x81A27F KwSb 318.8 vfzg_ub_q1p25 -160.0 158.8 FORMAT "%5.1" /end CHARACTERISTIC
/begin CHARACTERISTIC DVFZBAB "Geschwindigkeitsdifferenz zur Bergaberkennung" VALUE 0x81A280 KwSb 318.8 vfzg_ub_q1p25 -160.0 158.8 FORMAT "%5.1" /end CHARACTERISTIC
/begin CHARACTERISTIC EBEN "Bypass-Hauptschalter" VALUE 0x8109BF KwUb 255.0 default 0.00 255.0 FORMAT "%5.1" /end CHARACTERISTIC
/begin CHARACTERISTIC EBMISS_T "if more messages are missing, the bypass communication is switched off" VALUE 0x813FA4 KwUw 65535.00 default 0.00 65535.00 FORMAT "%8.2" /end CHARACTERISTIC
/begin CHARACTERISTIC EBMISS_Y "if more messages are missing, the bypass communication is switched off" VALUE 0x813FA6 KwUw 65535.00 default 0.00 65535.00 FORMAT "%8.2" /end CHARACTERISTIC
/begin CHARACTERISTIC ELDUVCLR "Schwelle zum Rücksetzen des Fehlers Schubumluftventil defekt beim Turbo" VALUE 0x819ADB KwUb 255.0 dez 0.00 255.0 FORMAT "%5.1" /end CHARACTERISTIC
/begin CHARACTERISTIC ELDUVSET "Schwelle zum Setzen des Fehlers Schubumluftventil defekt beim Turbo" VALUE 0x819ADC KwUb 255.0 dez 0.00 255.0 FORMAT "%5.1" /end CHARACTERISTIC
/begin CHARACTERISTIC FFTAATUN "Freeze Frame Tabelle: Tuningschutz" VAL_BLK 0x8107F9 KwbUb 255.0 dez 0.00 255.0 FORMAT "%5.1" NUMBER 2 /end CHARACTERISTIC
/begin CHARACTERISTIC FFTHRE "" VAL_BLK 0x810873 KwbUb 255.0 dez 0.00 255.0 FORMAT "%5.1" NUMBER 2 /end CHARACTERISTIC
/begin CHARACTERISTIC FFTLDPE "Freeze Frame Tabelle: LDP Endstufe" VAL_BLK 0x8108A9 KwbUb 255.0 dez 0.00 255.0 FORMAT "%5.1" NUMBER 2 /end CHARACTERISTIC
/begin CHARACTERISTIC FFTMDB "Freeze Frame Tabelle: Momentbegrenzung Sollmoment" VAL_BLK 0x8108C3 KwbUb 255.0 dez 0.00 255.0 FORMAT "%5.1" NUMBER 2 /end CHARACTERISTIC
/begin CHARACTERISTIC FFTSGEEW "Freeze Frame Tabelle: SG defekt (EEPROM WFS- Bereich)" VAL_BLK 0x8108DB KwbUb 255.0 dez 0.00 255.0 FORMAT "%5.1" NUMBER 2 /end CHARACTERISTIC
/begin CHARACTERISTIC FFTUB "Freeze Frame Tabelle: Batteriespannung UB (Bordnetz)" VAL_BLK 0x8108FF KwbUb 255.0 dez 0.00 255.0 FORMAT "%5.1" NUMBER 2 /end CHARACTERISTIC
/begin CHARACTERISTIC FFTUBR "Freeze Frame Tabelle: Bordnetzspannung über Hauptrelais UBR" VAL_BLK 0x810901 KwbUb 255.0 dez 0.00 255.0 FORMAT "%5.1" NUMBER 2 /end CHARACTERISTIC
/begin CHARACTERISTIC FFTWFS "Freeze Frame Tabelle: Wegfahrsperre" VAL_BLK 0x810911 KwbUb 255.0 dez 0.00 255.0 FORMAT "%5.1" NUMBER 2 /end CHARACTERISTIC
/begin CHARACTERISTIC FFTWFSRC "Freeze Frame Tabelle: Wegfahrsperre RC-Glied" VAL_BLK 0x810913 KwbUb 255.0 dez 0.00 255.0 FORMAT "%5.1" NUMBER 2 /end CHARACTERISTIC
/begin CHARACTERISTIC FHDLLR "Höhenschwelle für Durchführung Diagnose Leerlaufsteller" VALUE 0x819D8E KwUb 3.984 fak_ub_b4 0.00 3.984 FORMAT "%5.3" /end CHARACTERISTIC
/begin CHARACTERISTIC FPUPT "Periodendauer für Fast Pulse Leckdiagnosepumpe" CURVE 0x81A281 KlAUbSstUbWUb 2.550 t10msxs_ub_b2p55 0.00 2.550 FORMAT "%5.3"
 /begin AXIS_DESCR STD_AXIS tfpg t1sxs_ub_b255 6 0.00 255.0 FORMAT "%5.1" DEPOSIT ABSOLUTE /end AXIS_DESCR
/end CHARACTERISTIC
/begin CHARACTERISTIC FRAE "Delta-fra-Schwelle für Erkennung der eingeschwungenen Grundadaption" VALUE 0x81D214 KwUw 1.999969 fak_uw_b2 0.00 1.999969 FORMAT "%8.6" /end CHARACTERISTIC
/begin CHARACTERISTIC FRAODN "untere Diagnoseschwelle des Korrekturfaktors frao" VALUE 0x81D216 KwUw 1.999969 fak_uw_b2 0.00 1.999969 FORMAT "%8.6" /end CHARACTERISTIC
/begin CHARACTERISTIC FRAODX "obere Diagnoseschwelle des Korrekturfaktors frao" VALUE 0x81D218 KwUw 1.999969 fak_uw_b2 0.00 1.999969 FORMAT "%8.6" /end CHARACTERISTIC
/begin CHARACTERISTIC FRAUDN "untere Diagnoseschwelle des Korrekturfaktors frau" VALUE 0x81D21A KwUw 1.999969 fak_uw_b2 0.00 1.999969 FORMAT "%8.6" /end CHARACTERISTIC
/begin CHARACTERISTIC FRAUDX "obere Diagnoseschwelle des Korrekturfaktors frau" VALUE 0x81D21C KwUw 1.999969 fak_uw_b2 0.00 1.999969 FORMAT "%8.6" /end CHARACTERISTIC
/begin CHARACTERISTIC FRINH1 "Multiplikativer Faktor für RIN Sollwert hinter Kat" CURVE 0x81BB2E KlAUbSstUwWUb 63.75 fak_ub_b64 0.00 63.75 FORMAT "%5.2"
 /begin AXIS_DESCR STD_AXIS tahsomf_w temp_q0p0234_o273 5 -273.1500 1262.827 FORMAT "%8.3" DEPOSIT ABSOLUTE /end AXIS_DESCR
/end CHARACTERISTIC
/begin CHARACTERISTIC FRMSTDN "untere Diagnoseschwelle (short test)" VALUE 0x819262 KwUb 1.992 fak_ub_b2 0.00 1.992 FORMAT "%5.3" /end CHARACTERISTIC
/begin CHARACTERISTIC FRMSTDX "obere Diagnoseschwelle (short test)" VALUE 0x819263 KwUb 1.992 fak_ub_b2 0.00 1.992 FORMAT "%5.3" /end CHARACTERISTIC
/begin CHARACTERISTIC FVMXLDRA "Wichtungsfaktor  für max. zulässiges Druckverhältnis zur Auslösung von B_mxldra" VALUE 0x819ACB KwUb 1.992 fak_ub_b2 0.00 1.992 FORMAT "%5.3" /end CHARACTERISTIC
/begin CHARACTERISTIC FVPDKLDL "Wichtungsfaktor  für max. zulässiges Druckverhältnis zur Auslösung von E_lkvdk" VALUE 0x819ACC KwUb 1.992 fak_ub_b2 0.00 1.992 FORMAT "%5.3" /end CHARACTERISTIC
/begin CHARACTERISTIC FVPDKLDS "Wichtungsfaktor  für min. zulässiges Druckverhältnis zur Auslösung von E_lkvdk" VALUE 0x819ACD KwUb 1.992 fak_ub_b2 0.00 1.992 FORMAT "%5.3" /end CHARACTERISTIC
/begin CHARACTERISTIC FVPDKLDUS "Untere Schwelle für Leck vor Drosselklappe Erkennung im Leerlauf bei niedriger t" CURVE 0x81F726 KlAUbSstUbWUb 1.992 fak_ub_b2 0.00 1.992 FORMAT "%5.3"
 /begin AXIS_DESCR STD_AXIS tmot temp_ub_q0p75_o48 5 -48.00 143.3 FORMAT "%5.1" DEPOSIT ABSOLUTE /end AXIS_DESCR
/end CHARACTERISTIC
/begin CHARACTERISTIC FWMLHFMMN "Wichtungsfaktor für minimale HFM-Luftmassen Schwelle in Abhängigkeit von d.Höhe" CURVE 0x81C66C KlAUwSstUwWUw 0.9999847 fak_uw_b1 0.00 0.9999847 FORMAT "%9.7"
 /begin AXIS_DESCR STD_AXIS fho_w fak_uw_b4 2 0.00 3.999939 FORMAT "%8.6" DEPOSIT ABSOLUTE /end AXIS_DESCR
/end CHARACTERISTIC
/begin CHARACTERISTIC HLDPU "Untere Höhenschwelle für Leckdiagnosemodul" VALUE 0x81A28E KwUb 3.984 fak_ub_b4 0.00 3.984 FORMAT "%5.3" /end CHARACTERISTIC
/begin CHARACTERISTIC HYKATA_0_A "Absolute Hysterese bei Katalysatordiagnose" VALUE 0x81BE50 KwUb 0.9961 fak_ub_b1 0.00 0.9961 /end CHARACTERISTIC
/begin CHARACTERISTIC HYKATA_1_A "Absolute Hysterese bei Katalysatordiagnose" VALUE 0x81BE51 KwUb 0.9961 fak_ub_b1 0.00 0.9961 /end CHARACTERISTIC
/begin CHARACTERISTIC HYKATR_0_A "Relative Hysterese bei Katalysatordiagnose" VALUE 0x81BE52 KwUb 0.9961 fak_ub_b1 0.00 0.9961 /end CHARACTERISTIC
/begin CHARACTERISTIC HYKATR_1_A "Relative Hysterese bei Katalysatordiagnose" VALUE 0x81BE53 KwUb 0.9961 fak_ub_b1 0.00 0.9961 /end CHARACTERISTIC
/begin CHARACTERISTIC IMLKVSMX "Maximale Integrationsschwelle für Fehlerfreigabe in DKVS (Tank leer)" VALUE 0x81D21E KwUw 233.0133 m_q0p00355 0.00 233.0133 FORMAT "%8.4" /end CHARACTERISTIC
/begin CHARACTERISTIC KATBFML_0_A "Filterzeitkonstante für Signaldämpfung in Katbelastung" CURVE 0x8187E2 GklWUb 12.7498039 zk50msxs_ub_b12p8 0.0501960784 12.8000000 FORMAT "%10.7"
 /begin AXIS_DESCR COM_AXIS ml m_ub_b1020 5 0.00 1020. AXIS_PTS_REF SML05DKUB_0_A /end AXIS_DESCR
/end CHARACTERISTIC
/begin CHARACTERISTIC KATBFML_1_A "Filterzeitkonstante für Signaldämpfung in Katbelastung" CURVE 0x8187E7 GklWUb 12.7498039 zk50msxs_ub_b12p8 0.0501960784 12.8000000 FORMAT "%10.7"
 /begin AXIS_DESCR COM_AXIS ml m_ub_b1020 5 0.00 1020. AXIS_PTS_REF SML05DKUB_1_A /end AXIS_DESCR
/end CHARACTERISTIC
/begin CHARACTERISTIC KATBFMN_0_A "Schwellwert für kleine Katalysatorbelastung" VALUE 0x81BE54 KwUb 0.9961 fak_ub_b1 0.00 0.9961 /end CHARACTERISTIC
/begin CHARACTERISTIC KATBFMN_1_A "Schwellwert für kleine Katalysatorbelastung" VALUE 0x81BE55 KwUb 0.9961 fak_ub_b1 0.00 0.9961 /end CHARACTERISTIC
/begin CHARACTERISTIC KATBFMNT_0_A "Schwellwert für kleine Katalysatorbelastung bei Testeransteuerung" VALUE 0x81BE56 KwUb 0.9961 fak_ub_b1 0.00 0.9961 /end CHARACTERISTIC
/begin CHARACTERISTIC KATBFMNT_1_A "Schwellwert für kleine Katalysatorbelastung bei Testeransteuerung" VALUE 0x81BE57 KwUb 0.9961 fak_ub_b1 0.00 0.9961 /end CHARACTERISTIC
/begin CHARACTERISTIC KATBFN_0_A "normierter Mittelwert der Sondenamplitude" VALUE 0x81BE58 KwUb 0.9961 fak_ub_b1 0.00 0.9961 /end CHARACTERISTIC
/begin CHARACTERISTIC KATBFN_1_A "normierter Mittelwert der Sondenamplitude" VALUE 0x81BE59 KwUb 0.9961 fak_ub_b1 0.00 0.9961 /end CHARACTERISTIC
/begin CHARACTERISTIC KATBFNM "Normierungsfaktor multiplikativ für Katbelastung" VALUE 0x8187EC KwUb 1.330 spg_ub_b1p33 0.00 1.330 FORMAT "%5.3" /end CHARACTERISTIC
/begin CHARACTERISTIC KATBFNP "Normierungsfaktor additiv für Katbelastung" VALUE 0x8187ED KwUb 1.330 spg_ub_b1p33 0.00 1.330 FORMAT "%5.3" /end CHARACTERISTIC
/begin CHARACTERISTIC KATBFSX "Max. Integrationsschwelle für Stoppbedingung" VALUE 0x8187EE KwSb 1.992 fak_sb_b1 -1.000 0.9922 FORMAT "%5.3" /end CHARACTERISTIC
/begin CHARACTERISTIC KATBFXM_0_A "Maximale Katbelastungsschwelle für Stoppbedingung" CURVE 0x81BE10 GklWSw 1023.984 freq_sw_b512 -512.0000 511.9844 FORMAT "%8.4"
 /begin AXIS_DESCR COM_AXIS ml m_ub_b1020 5 0.00 1020. AXIS_PTS_REF SML05DKUB_0_A /end AXIS_DESCR
/end CHARACTERISTIC
/begin CHARACTERISTIC KATBFXM_1_A "Maximale Katbelastungsschwelle für Stoppbedingung" CURVE 0x81BE1A GklWSw 1023.984 freq_sw_b512 -512.0000 511.9844 FORMAT "%8.4"
 /begin AXIS_DESCR COM_AXIS ml m_ub_b1020 5 0.00 1020. AXIS_PTS_REF SML05DKUB_1_A /end AXIS_DESCR
/end CHARACTERISTIC
/begin CHARACTERISTIC KATBFXT_0_A "Maximale Katbelastungsschwelle für Stoppbedingung, Testerbetrieb" VALUE 0x81BE2A KwSw 1023.984 freq_sw_b512 -512.0000 511.9844 FORMAT "%8.4" /end CHARACTERISTIC
/begin CHARACTERISTIC KATBFXT_1_A "Maximale Katbelastungsschwelle für Stoppbedingung, Testerbetrieb" VALUE 0x81BE2C KwSw 1023.984 freq_sw_b512 -512.0000 511.9844 FORMAT "%8.4" /end CHARACTERISTIC
/begin CHARACTERISTIC KATBSG_0_A "Katalysatorspeichergröße für Katbelastung" VALUE 0x81BE5A KwUb 220.5 m_ub_b221p35 0.8681 221.4 FORMAT "%5.1" /end CHARACTERISTIC
/begin CHARACTERISTIC KATBSG_1_A "Katalysatorspeichergröße für Katbelastung" VALUE 0x81BE5B KwUb 220.5 m_ub_b221p35 0.8681 221.4 FORMAT "%5.1" /end CHARACTERISTIC
/begin CHARACTERISTIC KATBSH_0_A "Offset für Lambdaregelung leicht im fetten Bereich" VALUE 0x81BE5C KwUb 221.4 mgrad_ub_b221p35 0.00 221.4 FORMAT "%5.1" /end CHARACTERISTIC
/begin CHARACTERISTIC KATBSH_1_A "Offset für Lambdaregelung leicht im fetten Bereich" VALUE 0x81BE5D KwUb 221.4 mgrad_ub_b221p35 0.00 221.4 FORMAT "%5.1" /end CHARACTERISTIC
/begin CHARACTERISTIC KATBSHF_0_A "Verstärkungsfaktor für Regellagendifferenz" VALUE 0x81BE2E KwUw 9996.308 mgrad_uw_q0p0961 0.00 9996.308 FORMAT "%8.3" /end CHARACTERISTIC
/begin CHARACTERISTIC KATBSHF_1_A "Verstärkungsfaktor für Regellagendifferenz" VALUE 0x81BE30 KwUw 9996.308 mgrad_uw_q0p0961 0.00 9996.308 FORMAT "%8.3" /end CHARACTERISTIC
/begin CHARACTERISTIC KATBSHG "Begrenzungsfaktor der Regellagenkorrektur" VALUE 0x8187EF KwUb 0.9961 fak_ub_b1 0.00 0.9961 /end CHARACTERISTIC
/begin CHARACTERISTIC KFFLTA "Schwelle zur Erkennung Feinleck" MAP 0x82835E KfAxUbAyUbSstxUbSstyUwWUb 12.75 t50msxs_ub_b12p75 0.00 12.75 FORMAT "%5.2"
 /begin AXIS_DESCR STD_AXIS tans temp_ub_q0p75_o48 4 -48.00 143.3 FORMAT "%5.1" DEPOSIT ABSOLUTE /end AXIS_DESCR
 /begin AXIS_DESCR STD_AXIS pukorf_w p_uw_q0p039 4 0.00 2559.961 FORMAT "%8.3" DEPOSIT ABSOLUTE /end AXIS_DESCR
/end CHARACTERISTIC
/begin CHARACTERISTIC KFGLTA "Schwelle zur Erkennung Grobleck" MAP 0x82837C KfAxUbAyUbSstxUbSstyUwWUb 12.75 t50msxs_ub_b12p75 0.00 12.75 FORMAT "%5.2"
 /begin AXIS_DESCR STD_AXIS tans temp_ub_q0p75_o48 4 -48.00 143.3 FORMAT "%5.1" DEPOSIT ABSOLUTE /end AXIS_DESCR
 /begin AXIS_DESCR STD_AXIS pukorf_w p_uw_q0p039 4 0.00 2559.961 FORMAT "%8.3" DEPOSIT ABSOLUTE /end AXIS_DESCR
/end CHARACTERISTIC
/begin CHARACTERISTIC KFKABMT_0_A "Kennfeld Korrekturfaktor für berechnete Amplitude, abhängig von ml und Kat.-Tem" MAP 0x8187F0 KfAxUbAyUbSstxUbSstyUbWUb 1.992 fak_ub_b2 0.00 1.992 FORMAT "%5.3"
 /begin AXIS_DESCR STD_AXIS ml m_ub_b1020 8 0.00 1020. FORMAT "%5.0" DEPOSIT ABSOLUTE /end AXIS_DESCR
 /begin AXIS_DESCR STD_AXIS tkdkte temp_ub_q5_o50 8 -50.00 1225. FORMAT "%5.0" DEPOSIT ABSOLUTE /end AXIS_DESCR
/end CHARACTERISTIC
/begin CHARACTERISTIC KFKABMT_1_A "Kennfeld Korrekturfaktor für berechnete Amplitude, abhängig von ml und Kat.-Tem" MAP 0x818842 KfAxUbAyUbSstxUbSstyUbWUb 1.992 fak_ub_b2 0.00 1.992 FORMAT "%5.3"
 /begin AXIS_DESCR STD_AXIS ml m_ub_b1020 8 0.00 1020. FORMAT "%5.0" DEPOSIT ABSOLUTE /end AXIS_DESCR
 /begin AXIS_DESCR STD_AXIS tkdkte temp_ub_q5_o50 8 -50.00 1225. FORMAT "%5.0" DEPOSIT ABSOLUTE /end AXIS_DESCR
/end CHARACTERISTIC
/begin CHARACTERISTIC KFMLDMN "ML-Schwelle für B_minflr-Diagnose HFM/HLM" MAP 0x81C676 KfAxUwAyUwSstxUwSstyUwWSw 6553.500 m_sw_q0p1 -3276.800 3276.700 FORMAT "%8.3"
 /begin AXIS_DESCR STD_AXIS wdkbadmn_w relDK_q0p02441 8 0.00 1599.976 FORMAT "%8.3" DEPOSIT ABSOLUTE /end AXIS_DESCR
 /begin AXIS_DESCR STD_AXIS nmot_w nmot_uw_q0p25 8 0.00 16383.75 FORMAT "%8.2" DEPOSIT ABSOLUTE /end AXIS_DESCR
/end CHARACTERISTIC
/begin CHARACTERISTIC KFMLDMX "ML-Schwelle für B_maxflr-Diagnose HFM/HLM" MAP 0x81C71A KfAxUwAyUwSstxUwSstyUwWUw 6553.500 m_sw_q0p1 0.00 6553.500 FORMAT "%8.3"
 /begin AXIS_DESCR STD_AXIS wdkbadmx_w relDK_q0p02441 8 0.00 1599.976 FORMAT "%8.3" DEPOSIT ABSOLUTE /end AXIS_DESCR
 /begin AXIS_DESCR STD_AXIS nmot_w nmot_uw_q0p25 8 0.00 16383.75 FORMAT "%8.2" DEPOSIT ABSOLUTE /end AXIS_DESCR
/end CHARACTERISTIC
/begin CHARACTERISTIC KFRINH "Kennfeld für Nernst-Innenwiderstand hinter Kat" MAP 0x81BB40 KfAxUbAyUbSstxUwSstyUbWUb 2040. r_q8 0.00 2040. FORMAT "%5.0"
 /begin AXIS_DESCR STD_AXIS tahsomf_w temp_q0p0234_o273 5 -273.1500 1262.827 FORMAT "%8.3" DEPOSIT ABSOLUTE /end AXIS_DESCR
 /begin AXIS_DESCR STD_AXIS phlsnhf fak_ub_q0p01 3 0.00 2.550 FORMAT "%5.3" DEPOSIT ABSOLUTE /end AXIS_DESCR
/end CHARACTERISTIC
/begin CHARACTERISTIC KFTXFTA "Periodendauer zur Erkennung Feinstleck (>=0,5mm) bei Testeranforderung" MAP 0x82839A KfAxUbAyUbSstxUbSstyUwWUb 12.75 t50msxs_ub_b12p75 0.00 12.75 FORMAT "%5.2"
 /begin AXIS_DESCR STD_AXIS tans temp_ub_q0p75_o48 4 -48.00 143.3 FORMAT "%5.1" DEPOSIT ABSOLUTE /end AXIS_DESCR
 /begin AXIS_DESCR STD_AXIS pukorf_w p_uw_q0p039 4 0.00 2559.961 FORMAT "%8.3" DEPOSIT ABSOLUTE /end AXIS_DESCR
/end CHARACTERISTIC
/begin CHARACTERISTIC KFVPDKLD "Max. zulässiges Druckverhältnis DK für ldra Diagnose" MAP 0x81F731 KfAxUbAyUbSstxUbSstyUbWUb 3.984 fak_ub_b4 0.00 3.984 FORMAT "%5.3"
 /begin AXIS_DESCR STD_AXIS nmot nmot_ub_q40 10 0.00 10200. FORMAT "%5.0" DEPOSIT ABSOLUTE /end AXIS_DESCR
 /begin AXIS_DESCR STD_AXIS wdkba relDK_ub_b100 12 0.00 100.0 FORMAT "%5.1" DEPOSIT ABSOLUTE /end AXIS_DESCR
/end CHARACTERISTIC
/begin CHARACTERISTIC KFXFTA "Schwelle zur Erkennung Feinstleck (>= 0.5 mm)" MAP 0x8283B8 KfAxUbAyUbSstxUbSstyUwWUb 12.75 t50msxs_ub_b12p75 0.00 12.75 FORMAT "%5.2"
 /begin AXIS_DESCR STD_AXIS tans temp_ub_q0p75_o48 4 -48.00 143.3 FORMAT "%5.1" DEPOSIT ABSOLUTE /end AXIS_DESCR
 /begin AXIS_DESCR STD_AXIS pukorf_w p_uw_q0p039 4 0.00 2559.961 FORMAT "%8.3" DEPOSIT ABSOLUTE /end AXIS_DESCR
/end CHARACTERISTIC
/begin CHARACTERISTIC KLDLUL "Schwelle negative Regelabweichung für Überladefehler" CURVE 0x81F7C2 KlAUbSstSbWUb 1275. p_ub_q5 0.00 1275. FORMAT "%5.0"
 /begin AXIS_DESCR STD_AXIS dplsplsdn p_sb_q10 8 -1280. 1270. FORMAT "%5.0" DEPOSIT ABSOLUTE /end AXIS_DESCR
/end CHARACTERISTIC
/begin CHARACTERISTIC KMXSTG "Filterkonstante für Filter max. Steigung für Sonde hinter KAT" VALUE 0x81BDC2 KwUw 0.9999847 fak_uw_b1 0.00 0.9999847 FORMAT "%9.7" /end CHARACTERISTIC
/begin CHARACTERISTIC KRFHKS "Fehlerhäufigkeit Klopfsensoren" VALUE 0x81994E KwUb 255.0 dez 0.00 255.0 FORMAT "%5.1" /end CHARACTERISTIC
/begin CHARACTERISTIC KRFHT "Fehlerhäufigkeit Testimpuls" VALUE 0x8111FB KwUb 254.0 dez 1.000 255.0 FORMAT "%5.1" /end CHARACTERISTIC
/begin CHARACTERISTIC KTLAMSTEIG "I-Faktor  für  Rampensteigung lamlash im Kurztrip für Testfunktion hinter KAT" VALUE 0x81BDC4 KwUw 0.9999847 fak_uw_b1 0.00 0.9999847 FORMAT "%9.7" /end CHARACTERISTIC
/begin CHARACTERISTIC LAMLASHMIN "Minimaler Lambda-Sollwert (Fett) für Test Schwingungsprüfung hinter KAT" VALUE 0x81BDC6 KwUw 15.99976 fak_uw_b16 0.00 15.99976 FORMAT "%8.5" /end CHARACTERISTIC
/begin CHARACTERISTIC LAMSONSVL "Schwelle für Vollast Lambda-Betrieb bei der Sondenspannung überprüft wird" VALUE 0x81BDC8 KwUw 15.99976 fak_uw_b16 0.00 15.99976 FORMAT "%8.5" /end CHARACTERISTIC
/begin CHARACTERISTIC LAMSTEIG "I-Faktor  für  Rampensteigung lamlash für Testfunktion hinter KAT" VALUE 0x81BDCA KwUw 0.9999847 fak_uw_b1 0.00 0.9999847 FORMAT "%9.7" /end CHARACTERISTIC
/begin CHARACTERISTIC LDELDRAO "Obere Grenze für tiefpassgefilterte LDR-Regelabweichung" VALUE 0x81F7D4 KwSw 1279.961 p_sw_q0p039 0.00 1279.961 FORMAT "%8.3" /end CHARACTERISTIC
/begin CHARACTERISTIC LDELDRAU "Untere Grenze für tiefpassgefilterte LDR-Regelabweichung f. Heilbedingung" VALUE 0x81F7D6 KwSw 1279.961 p_sw_q0p039 0.00 1279.961 FORMAT "%8.3" /end CHARACTERISTIC
/begin CHARACTERISTIC LKVDKNMN "Drehzahlschwelle für Leckekennung vor DK beim Turbo" VALUE 0x819ACE KwUb 10200. nmot_ub_q40 0.00 10200. FORMAT "%5.0" /end CHARACTERISTIC
/begin CHARACTERISTIC MLDKVSF "Luftmassenschwelle für Fehlerfreigabe im DKVS (Tank leer)" VALUE 0x81D220 KwUw 233.0133 m_q0p00355 0.00 233.0133 FORMAT "%8.4" /end CHARACTERISTIC
/begin CHARACTERISTIC MLDKVSG "Luftmassenschwelle für Fehlerfreigabe Tank leer" VALUE 0x81D222 KwUw 233.0133 m_q0p00355 0.00 233.0133 FORMAT "%8.4" /end CHARACTERISTIC
/begin CHARACTERISTIC MLHFMMN "minimale HFM-Luftmassen Schwelle zum Rücksetzen des Min-Fehlers" VALUE 0x81C7BE KwUw 6553.500 m_q0p1 0.00 6553.500 FORMAT "%8.3" /end CHARACTERISTIC
/begin CHARACTERISTIC MLLASH "Luftmassenschwelle für Schwingungsprüfung hinter KAT" VALUE 0x81BDCC KwUw 6553.500 m_q0p1 0.00 6553.500 FORMAT "%8.3" /end CHARACTERISTIC
/begin CHARACTERISTIC MLOSTEST "obere Luftmassenschwelle für Testbeginn Schwingungsprüfung hinter KAT" VALUE 0x81BDCE KwUw 6553.500 m_q0p1 0.00 6553.500 FORMAT "%8.3" /end CHARACTERISTIC
/begin CHARACTERISTIC MLUSSTG "Luftmassenschwelle für Dynamikprüfung hinter KAT" VALUE 0x813FFA KwUw 6553.500 m_q0p1 0.00 6553.500 FORMAT "%8.3" /end CHARACTERISTIC
/begin CHARACTERISTIC MLUSTEST "untere Luftmassenschwelle für Testbeginn Schwingungsprüfung hinter KAT" VALUE 0x81BDD0 KwUw 6553.500 m_q0p1 0.00 6553.500 FORMAT "%8.3" /end CHARACTERISTIC
/begin CHARACTERISTIC MLUSVL "Luftmassenschwelle für Vollast-Prüfung für Sonde hinter KAT" VALUE 0x81BDD2 KwUw 6553.500 m_q0p1 0.00 6553.500 FORMAT "%8.3" /end CHARACTERISTIC
/begin CHARACTERISTIC MSABHMN "untere Luftmassenschwelle für Plausibilitätsprüfung LSU" VALUE 0x810A34 KwUb 1020. m_ub_b1020 0.00 1020. FORMAT "%5.0" /end CHARACTERISTIC
/begin CHARACTERISTIC MSTELDP "Mindestluftmasse bei Initial- u. Fortsetzungsspülung" VALUE 0x811F31 KwUb 11.32 m_ub_q0p0444 0.00 11.32 FORMAT "%5.2" /end CHARACTERISTIC
/begin CHARACTERISTIC NDKRA "Drehzahlschwelle für Diagnose Klopfregelanschlag" VALUE 0x8111F0 KwUb 10200. nmot_ub_q40 0.00 10200. FORMAT "%5.0" /end CHARACTERISTIC
/begin CHARACTERISTIC NDKS "Drehzahlschwelle für Dia KS" VALUE 0x81994F KwUb 10200. nmot_ub_q40 0.00 10200. FORMAT "%5.0" /end CHARACTERISTIC
/begin CHARACTERISTIC NDKSBET "Drehzahlschwelle für Dia KS, Bandendetest" VALUE 0x819950 KwUb 10200. nmot_ub_q40 0.00 10200. FORMAT "%5.0" /end CHARACTERISTIC
/begin CHARACTERISTIC NDKTSO_0_A "Obere Drehzahlgrenze für DKAT-aktiv" VALUE 0x81BE5E KwUb 10200. nmot_ub_q40 0.00 10200. FORMAT "%5.0" /end CHARACTERISTIC
/begin CHARACTERISTIC NDKTSO_1_A "Obere Drehzahlgrenze für DKAT-aktiv" VALUE 0x81BE5F KwUb 10200. nmot_ub_q40 0.00 10200. FORMAT "%5.0" /end CHARACTERISTIC
/begin CHARACTERISTIC NDKTSOT_0_A "Obere Drehzahlgrenze für Funktionsanforderung" VALUE 0x81BE60 KwUb 10200. nmot_ub_q40 0.00 10200. FORMAT "%5.0" /end CHARACTERISTIC
/begin CHARACTERISTIC NDKTSOT_1_A "Obere Drehzahlgrenze für Funktionsanforderung" VALUE 0x81BE61 KwUb 10200. nmot_ub_q40 0.00 10200. FORMAT "%5.0" /end CHARACTERISTIC
/begin CHARACTERISTIC NDKTSU_0_A "untere Drehzahlgrenze für DKAT-aktiv" VALUE 0x81BE62 KwUb 10200. nmot_ub_q40 0.00 10200. FORMAT "%5.0" /end CHARACTERISTIC
/begin CHARACTERISTIC NDKTSU_1_A "untere Drehzahlgrenze für DKAT-aktiv" VALUE 0x81BE63 KwUb 10200. nmot_ub_q40 0.00 10200. FORMAT "%5.0" /end CHARACTERISTIC
/begin CHARACTERISTIC NDKTSUT_0_A "Untere Drehzahlgrenze für Funktionsanforderung" VALUE 0x81BE64 KwUb 10200. nmot_ub_q40 0.00 10200. FORMAT "%5.0" /end CHARACTERISTIC
/begin CHARACTERISTIC NDKTSUT_1_A "Untere Drehzahlgrenze für Funktionsanforderung" VALUE 0x81BE65 KwUb 10200. nmot_ub_q40 0.00 10200. FORMAT "%5.0" /end CHARACTERISTIC
/begin CHARACTERISTIC NDLDRAPU "Drehzahlschwelle für LDRA Fehlerpfad und Heilung LDO Fehlerpfad" CURVE 0x81F7D8 KlAUbSstUbWUb 10200. nmot_ub_q40 0.00 10200. FORMAT "%5.0"
 /begin AXIS_DESCR STD_AXIS pu p_ub_q5 2 0.00 1275. FORMAT "%5.0" DEPOSIT ABSOLUTE /end AXIS_DESCR
/end CHARACTERISTIC
/begin CHARACTERISTIC NKTDX "Maximale Drehzahlgrenze DKAT für Berechnung" VALUE 0x818894 KwUb 10200. nmot_ub_q40 0.00 10200. FORMAT "%5.0" /end CHARACTERISTIC
/begin CHARACTERISTIC PLGRUELDD "Ersatzwert des Grundladedrucks für LDR-Diagnose" VALUE 0x81F7DE KwUw 2559.961 p_uw_q0p039 0.00 2559.961 FORMAT "%8.3" /end CHARACTERISTIC
/begin CHARACTERISTIC PULDR "Schwelle Umgebungsdruck für Ladedruckdiagnose" VALUE 0x819ACF KwUb 1275. p_ub_q5 0.00 1275. FORMAT "%5.0" /end CHARACTERISTIC
/begin CHARACTERISTIC PULSUV "Pulsationsschwelle für Schubumluftventildiagnose beim Turbo" VALUE 0x811249 KwSb 1.992 fak_sb_b1 -1.000 0.9922 FORMAT "%5.3" /end CHARACTERISTIC
/begin CHARACTERISTIC RKAE "Delta rkat- bzw. rkaz-Schwelle für Erkennung der eingeschwungenen Grundadaption" VALUE 0x81D224 KwSw 3071.953 rel_sw_b1536 -1536.000 1535.953 FORMAT "%8.3" /end CHARACTERISTIC
/begin CHARACTERISTIC RKATDN "untere Diagnoseschwelle additive Korrektur pro Zeit" VALUE 0x81D226 KwSw 3071.953 rel_sw_b1536 -1536.000 1535.953 FORMAT "%8.3" /end CHARACTERISTIC
/begin CHARACTERISTIC RKATDX "obere Diagnoseschwelle additive Korrektur pro Zeit" VALUE 0x81D228 KwSw 3071.953 rel_sw_b1536 -1536.000 1535.953 FORMAT "%8.3" /end CHARACTERISTIC
/begin CHARACTERISTIC RKAZDN "untere Diagnoseschwelle additive Korrektur pro Zündung" VALUE 0x81D22A KwSw 3071.953 rel_sw_b1536 -1536.000 1535.953 FORMAT "%8.3" /end CHARACTERISTIC
/begin CHARACTERISTIC RKAZDX "obere Diagnoseschwelle additive Korrektur pro Zündung" VALUE 0x81D22C KwSw 3071.953 rel_sw_b1536 -1536.000 1535.953 FORMAT "%8.3" /end CHARACTERISTIC
/begin CHARACTERISTIC RL1FGV "RL-Kennlinie Bergaberkennung Gang 1 bei Feinstleckdiagnose" CURVE 0x81A28F GklWUb 191.3 rel_ub_q0p75 0.00 191.3 FORMAT "%5.1"
 /begin AXIS_DESCR COM_AXIS vfzg vfzg_ub_q1p25 6 0.00 318.8 AXIS_PTS_REF SVF06D_UB /end AXIS_DESCR
/end CHARACTERISTIC
/begin CHARACTERISTIC RL1GV "RL - Kennlinie Bergaberkennung Gang 1" CURVE 0x81A295 GklWUb 191.3 rel_ub_q0p75 0.00 191.3 FORMAT "%5.1"
 /begin AXIS_DESCR COM_AXIS vfzg vfzg_ub_q1p25 6 0.00 318.8 AXIS_PTS_REF SVF06D_UB /end AXIS_DESCR
/end CHARACTERISTIC
/begin CHARACTERISTIC RL2FGV "RL-Kennlinie Bergaberkennung Gang 2 bei Feinstleckdiagnose" CURVE 0x81A29B GklWUb 191.3 rel_ub_q0p75 0.00 191.3 FORMAT "%5.1"
 /begin AXIS_DESCR COM_AXIS vfzg vfzg_ub_q1p25 6 0.00 318.8 AXIS_PTS_REF SVF06D_UB /end AXIS_DESCR
/end CHARACTERISTIC
/begin CHARACTERISTIC RL2GV "RL - Kennlinie Bergaberkennung Gang 2" CURVE 0x81A2A1 GklWUb 191.3 rel_ub_q0p75 0.00 191.3 FORMAT "%5.1"
 /begin AXIS_DESCR COM_AXIS vfzg vfzg_ub_q1p25 6 0.00 318.8 AXIS_PTS_REF SVF06D_UB /end AXIS_DESCR
/end CHARACTERISTIC
/begin CHARACTERISTIC RL3FGV "RL-Kennlinie Bergaberkennung Gang 3 bei Feinstleckdiagnose" CURVE 0x81A2A7 GklWUb 191.3 rel_ub_q0p75 0.00 191.3 FORMAT "%5.1"
 /begin AXIS_DESCR COM_AXIS vfzg vfzg_ub_q1p25 6 0.00 318.8 AXIS_PTS_REF SVF06D_UB /end AXIS_DESCR
/end CHARACTERISTIC
/begin CHARACTERISTIC RL3GV "RL - Kennlinie Bergaberkennung Gang 3" CURVE 0x81A2AD GklWUb 191.3 rel_ub_q0p75 0.00 191.3 FORMAT "%5.1"
 /begin AXIS_DESCR COM_AXIS vfzg vfzg_ub_q1p25 6 0.00 318.8 AXIS_PTS_REF SVF06D_UB /end AXIS_DESCR
/end CHARACTERISTIC
/begin CHARACTERISTIC RL4FGV "RL-Kennlinie Bergaberkennung Gang 4 bei Feinstleckdiagnose" CURVE 0x81A2B3 GklWUb 191.3 rel_ub_q0p75 0.00 191.3 FORMAT "%5.1"
 /begin AXIS_DESCR COM_AXIS vfzg vfzg_ub_q1p25 6 0.00 318.8 AXIS_PTS_REF SVF06D_UB /end AXIS_DESCR
/end CHARACTERISTIC
/begin CHARACTERISTIC RL4GV "RL - Kennlinie Bergaberkennung Gang 4" CURVE 0x81A2B9 GklWUb 191.3 rel_ub_q0p75 0.00 191.3 FORMAT "%5.1"
 /begin AXIS_DESCR COM_AXIS vfzg vfzg_ub_q1p25 6 0.00 318.8 AXIS_PTS_REF SVF06D_UB /end AXIS_DESCR
/end CHARACTERISTIC
/begin CHARACTERISTIC RL5FGV "RL-Kennlinie Bergaberkennung Gang 5 bei Feinstleckdiagnose" CURVE 0x81A2BF GklWUb 191.3 rel_ub_q0p75 0.00 191.3 FORMAT "%5.1"
 /begin AXIS_DESCR COM_AXIS vfzg vfzg_ub_q1p25 6 0.00 318.8 AXIS_PTS_REF SVF06D_UB /end AXIS_DESCR
/end CHARACTERISTIC
/begin CHARACTERISTIC RL5GV "RL - Kennlinie Bergaberkennung Gang 5" CURVE 0x81A2C5 GklWUb 191.3 rel_ub_q0p75 0.00 191.3 FORMAT "%5.1"
 /begin AXIS_DESCR COM_AXIS vfzg vfzg_ub_q1p25 6 0.00 318.8 AXIS_PTS_REF SVF06D_UB /end AXIS_DESCR
/end CHARACTERISTIC
/begin CHARACTERISTIC RL6FGV "RL-Kennlinie Bergaberkennung Gang 6 bei Feinstleckdiagnose" CURVE 0x81A2CB GklWUb 191.3 rel_ub_q0p75 0.00 191.3 FORMAT "%5.1"
 /begin AXIS_DESCR COM_AXIS vfzg vfzg_ub_q1p25 6 0.00 318.8 AXIS_PTS_REF SVF06D_UB /end AXIS_DESCR
/end CHARACTERISTIC
/begin CHARACTERISTIC RL6GV "RL - Kennlinie Bergaberkennung Gang 6" CURVE 0x81A2D1 GklWUb 191.3 rel_ub_q0p75 0.00 191.3 FORMAT "%5.1"
 /begin AXIS_DESCR COM_AXIS vfzg vfzg_ub_q1p25 6 0.00 318.8 AXIS_PTS_REF SVF06D_UB /end AXIS_DESCR
/end CHARACTERISTIC
/begin CHARACTERISTIC RLBABMX "Begrenzung Filter Bergaberkennung" VALUE 0x8283D6 KwUw 1535.977 rel_uw_q0p0234 0.00 1535.977 FORMAT "%8.3" /end CHARACTERISTIC
/begin CHARACTERISTIC RLDKTOT_0_A "Obere Lastgrenze für Funktionsanforderung" VALUE 0x81BE66 KwUb 191.3 rel_ub_q0p75 0.00 191.3 FORMAT "%5.1" /end CHARACTERISTIC
/begin CHARACTERISTIC RLDKTOT_1_A "Obere Lastgrenze für Funktionsanforderung" VALUE 0x81BE67 KwUb 191.3 rel_ub_q0p75 0.00 191.3 FORMAT "%5.1" /end CHARACTERISTIC
/begin CHARACTERISTIC RLDKTSO_0_A "Obere Lastkennlinie für DKAT-aktiv" CURVE 0x818895 GklWUb 191.3 rel_ub_q0p75 0.00 191.3 FORMAT "%5.1"
 /begin AXIS_DESCR COM_AXIS nmot nmot_ub_q40 5 0.00 10200. AXIS_PTS_REF SNM05DKUB_0_A /end AXIS_DESCR
/end CHARACTERISTIC
/begin CHARACTERISTIC RLDKTSO_1_A "Obere Lastkennlinie für DKAT-aktiv" CURVE 0x81889A GklWUb 191.3 rel_ub_q0p75 0.00 191.3 FORMAT "%5.1"
 /begin AXIS_DESCR COM_AXIS nmot nmot_ub_q40 5 0.00 10200. AXIS_PTS_REF SNM05DKUB_1_A /end AXIS_DESCR
/end CHARACTERISTIC
/begin CHARACTERISTIC RLDKTSU_0_A "Untere Lastkennlinie für DKAT-aktiv" CURVE 0x81889F GklWUb 191.3 rel_ub_q0p75 0.00 191.3 FORMAT "%5.1"
 /begin AXIS_DESCR COM_AXIS nmot nmot_ub_q40 5 0.00 10200. AXIS_PTS_REF SNM05DKUB_0_A /end AXIS_DESCR
/end CHARACTERISTIC
/begin CHARACTERISTIC RLDKTSU_1_A "Untere Lastkennlinie für DKAT-aktiv" CURVE 0x8188A4 GklWUb 191.3 rel_ub_q0p75 0.00 191.3 FORMAT "%5.1"
 /begin AXIS_DESCR COM_AXIS nmot nmot_ub_q40 5 0.00 10200. AXIS_PTS_REF SNM05DKUB_1_A /end AXIS_DESCR
/end CHARACTERISTIC
/begin CHARACTERISTIC RLDKTUT_0_A "Untere Lastgrenze für Funktionsanforderung" VALUE 0x81BE68 KwUb 191.3 rel_ub_q0p75 0.00 191.3 FORMAT "%5.1" /end CHARACTERISTIC
/begin CHARACTERISTIC RLDKTUT_1_A "Untere Lastgrenze für Funktionsanforderung" VALUE 0x81BE69 KwUb 191.3 rel_ub_q0p75 0.00 191.3 FORMAT "%5.1" /end CHARACTERISTIC
/begin CHARACTERISTIC RLLDPMX "Maximale Last bei Diagnose" VALUE 0x811F32 KwUb 191.3 rel_ub_q0p75 0.00 191.3 FORMAT "%5.1" /end CHARACTERISTIC
/begin CHARACTERISTIC RLMDVERL "Lastschwelle für Unterdrehzahlprüfung abh. von mdverl_w" CURVE 0x81F9E2 KlAUwSstUwWUw 99.99902 rel_uw_b192 0.00 99.99902 FORMAT "%8.5"
 /begin AXIS_DESCR STD_AXIS mdverl_w rel_uw_b100 3 0.00 99.99847 FORMAT "%8.5" DEPOSIT ABSOLUTE /end AXIS_DESCR
/end CHARACTERISTIC
/begin AXIS_PTS SML05DKUB_0_A "Stützstellenvert. Luftmasse" 0x8181DE ml SstAUbSstUb 1020. m_ub_b1020 5 0.00 1020. FORMAT "%5.0" DEPOSIT ABSOLUTE /end AXIS_PTS
/begin AXIS_PTS SML05DKUB_1_A "Stützstellenvert. Luftmasse" 0x8181E4 ml SstAUbSstUb 1020. m_ub_b1020 5 0.00 1020. FORMAT "%5.0" DEPOSIT ABSOLUTE /end AXIS_PTS
/begin CHARACTERISTIC SMLDYN "Luftmassenschwelle für Sondendynamik hinter KAT" VALUE 0x81BDD4 KwUw 182.0417 m_q0p00277 0.00 182.0417 FORMAT "%8.4" /end CHARACTERISTIC
/begin AXIS_PTS SNM05DKUB_0_A "Stützstellenvert. nmot" 0x818203 nmot SstAUbSstUb 10200. nmot_ub_q40 5 0.00 10200. FORMAT "%5.0" DEPOSIT ABSOLUTE /end AXIS_PTS
/begin AXIS_PTS SNM05DKUB_1_A "Stützstellenvert. nmot" 0x818209 nmot SstAUbSstUb 10200. nmot_ub_q40 5 0.00 10200. FORMAT "%5.0" DEPOSIT ABSOLUTE /end AXIS_PTS
/begin AXIS_PTS SNM16KRUB "Stützstellenverteilung Drehzahl, 16 Sst." 0x81826C nmot SstAUbSstUb 10200. nmot_ub_q40 16 0.00 10200. FORMAT "%5.0" DEPOSIT ABSOLUTE /end AXIS_PTS
/begin CHARACTERISTIC SRLLKH "Mindestfuellung zur Fehlerheilung Leck vor Drosselklappe" VALUE 0x819AD0 KwUb 191.3 rel_ub_q0p75 0.00 191.3 FORMAT "%5.1" /end CHARACTERISTIC
/begin CHARACTERISTIC SRYAGR "Schwelle für Readiness-Bildung Abgasrückführungs-Diagnose" VALUE 0x8109B7 KwUb 255.0 dez 0.00 255.0 FORMAT "%5.1" /end CHARACTERISTIC
/begin CHARACTERISTIC SRYHS "Schwelle für Readiness-Bildung Sondenheizungs-Diagnose" VALUE 0x8109B8 KwUb 255.0 dez 0.00 255.0 FORMAT "%5.1" /end CHARACTERISTIC
/begin CHARACTERISTIC SRYKAT "Schwelle für Readiness-Bildung Katalysator-Diagnose" VALUE 0x8109B9 KwUb 255.0 dez 0.00 255.0 FORMAT "%5.1" /end CHARACTERISTIC
/begin CHARACTERISTIC SRYLS "Schwelle für Readiness-Bildung Lambdasonden-Diagnose" VALUE 0x8109BA KwUb 255.0 dez 0.00 255.0 FORMAT "%5.1" /end CHARACTERISTIC
/begin CHARACTERISTIC SRYSLS "Schwelle für Readiness-Bildung Sekundärluft-Diagnose" VALUE 0x8109BB KwUb 255.0 dez 0.00 255.0 FORMAT "%5.1" /end CHARACTERISTIC
/begin CHARACTERISTIC SRYTES "Schwelle für Readiness-Bildung Tankentlüftungs-Diagnose" VALUE 0x8109BC KwUb 255.0 dez 0.00 255.0 FORMAT "%5.1" /end CHARACTERISTIC
/begin CHARACTERISTIC SSRLKVDK "Schwelle Spülrate Tankentl. zur Aktivierung der Leckerkennungsdiagnose Turbo" VALUE 0x81F7E0 KwUw 0.4999924 fak_uw_b0p5 0.00 0.4999924 FORMAT "%9.7" /end CHARACTERISTIC
/begin CHARACTERISTIC SULSUMN "Schwellwert für Plausibilitätsfehler während B_sa" VALUE 0x81BDE2 KwUw 319.9951 spg_q0p00488 0.00 319.9951 FORMAT "%8.4" /end CHARACTERISTIC
/begin CHARACTERISTIC SULSUMNN "Schwellwert für Plausibilitätsfehler während B_sa" VALUE 0x81BDE4 KwUw 319.9951 spg_q0p00488 0.00 319.9951 FORMAT "%8.4" /end CHARACTERISTIC
/begin CHARACTERISTIC SULSUMXH "Schwellwert für Plausibilitätsfehler CJ110" VALUE 0x81BDE6 KwUw 319.9951 spg_q0p00488 0.00 319.9951 FORMAT "%8.4" /end CHARACTERISTIC
/begin AXIS_PTS SVF06D_UB "" 0x81A2D7 vfzg SstAUbSstUb 318.8 vfzg_ub_q1p25 6 0.00 318.8 FORMAT "%5.1" DEPOSIT ABSOLUTE /end AXIS_PTS
/begin CHARACTERISTIC TABGSTGK "Abgastemperaturschwelle für Dynamik-Messung" VALUE 0x813FFC KwUw 1535.977 temp_q0p0234_o273 -273.1500 1262.827 FORMAT "%8.3" /end CHARACTERISTIC
/begin CHARACTERISTIC TABSTHLSH "Mindestabstellzeit für Diagnose Heizung Lambdasonde hinter Kat" VALUE 0x81BB5E KwUw 65535.00 t1sxs_uw_q1 0.00 65535.00 FORMAT "%8.2" /end CHARACTERISTIC
/begin CHARACTERISTIC TADHMNH "untere Temperaturschwelle für die Heizerdiagnose hinter Kat" VALUE 0x81BB60 KwUw 1535.977 temp_q0p0234_o273 -273.1500 1262.827 FORMAT "%8.3" /end CHARACTERISTIC
/begin CHARACTERISTIC TADHMXH "obere Temperaturschwelle für die Heizerdiagnose hinter Kat" VALUE 0x81BB62 KwUw 1535.977 temp_q0p0234_o273 -273.1500 1262.827 FORMAT "%8.3" /end CHARACTERISTIC
/begin CHARACTERISTIC TADLDUV "Ansauglufttemperautrschwelle zum Einschalten der Diagnose f. SUV" VALUE 0x81124A KwUb 191.3 temp_ub_q0p75_o48 -48.00 143.3 FORMAT "%5.1" /end CHARACTERISTIC
/begin CHARACTERISTIC TADLLR "Ansauglufttemperaturschwelle für Diagnose Leerlaufsteller" VALUE 0x819D8F KwUb 191.3 temp_ub_q0p75_o48 -48.00 143.3 FORMAT "%5.1" /end CHARACTERISTIC
/begin CHARACTERISTIC TAFFO "Obere tans-Schwelle für 0.5 mm - Diagnose" VALUE 0x81A2DE KwUb 191.3 temp_ub_q0p75_o48 -48.00 143.3 FORMAT "%5.1" /end CHARACTERISTIC
/begin CHARACTERISTIC TAFLDPO "Obere TANS- Schwelle für Leckdiagnose bei Kurztrip" VALUE 0x81A2DF KwUb 191.3 temp_ub_q0p75_o48 -48.00 143.3 FORMAT "%5.1" /end CHARACTERISTIC
/begin CHARACTERISTIC TALDPO "Obere Ansaugtemperaturschwelle für Leckdiagnosemodul" VALUE 0x81A2E0 KwUb 191.3 temp_ub_q0p75_o48 -48.00 143.3 FORMAT "%5.1" /end CHARACTERISTIC
/begin CHARACTERISTIC TALDPU "Untere Ansaugtemperaturschwelle für Leckdiagnosemodul" VALUE 0x81A2E1 KwUb 191.3 temp_ub_q0p75_o48 -48.00 143.3 FORMAT "%5.1" /end CHARACTERISTIC
/begin CHARACTERISTIC TALSUMN "Abgastemperatur-Schwellwert für Heilung E_hsvsa" VALUE 0x814300 KwUw 1535.977 temp_q0p0234_o273 -273.1500 1262.827 FORMAT "%8.3" /end CHARACTERISTIC
/begin CHARACTERISTIC TALSUSAE "Abgastemperatur-Schwellwert für Fehlereintrag E_hsvsa" VALUE 0x814302 KwUw 1535.977 temp_q0p0234_o273 -273.1500 1262.827 FORMAT "%8.3" /end CHARACTERISTIC
/begin CHARACTERISTIC TANSDHLSH "Ansauglufttemperaturschwelle für Ri- Diagnose hinter Kat" VALUE 0x8184BF KwUb 191.3 temp_ub_q0p75_o48 -48.00 143.3 FORMAT "%5.1" /end CHARACTERISTIC
/begin CHARACTERISTIC TASOH "Temperaturschwelle für Sonde hinter Kat ohne Heizung funktionsfähig" VALUE 0x81BB64 KwUw 1535.977 temp_q0p0234_o273 -273.1500 1262.827 FORMAT "%8.3" /end CHARACTERISTIC
/begin CHARACTERISTIC TC6LDPC1 "Mode 6 Component ID für Prüfung Grob-/Feinleck" VALUE 0x811F33 KwUb 127.0 dez 0.00 127.0 FORMAT "%5.1" /end CHARACTERISTIC
/begin CHARACTERISTIC TC6LDPC2 "Mode 6 Component ID für Prüfung 'Reed-Kontakt geschlossen'" VALUE 0x811F34 KwUb 127.0 dez 0.00 127.0 FORMAT "%5.1" /end CHARACTERISTIC
/begin CHARACTERISTIC TC6LDPC3 "Mode 6 Component ID für Prüfung 'Reed-Kontakt öffnet'" VALUE 0x811F35 KwUb 127.0 dez 0.00 127.0 FORMAT "%5.1" /end CHARACTERISTIC
/begin CHARACTERISTIC TC6LDPC4 "Mode 6 Component ID für Prüfung 'System dicht während Initialspülung'" VALUE 0x811F36 KwUb 127.0 dez 0.00 127.0 FORMAT "%5.1" /end CHARACTERISTIC
/begin CHARACTERISTIC TC6LDPC5 "" VALUE 0x811F37 KwUb 127.0 dez 0.00 127.0 FORMAT "%5.1" /end CHARACTERISTIC
/begin CHARACTERISTIC TDFHS "Entprellzeit für Heizerendstufe" VALUE 0x810A35 KwUb 2.550 t10msxs_ub_b2p55 0.00 2.550 FORMAT "%5.3" /end CHARACTERISTIC
/begin CHARACTERISTIC TDHR "Entprellzeit für Diagnose Hauptrelais" VALUE 0x8299D2 KwUw 6553.500 t100msxs_uw_b6553p5 0.00 6553.500 FORMAT "%8.3" /end CHARACTERISTIC
/begin CHARACTERISTIC TDKATAKT_0_A "Schwellwert Zyklus fertig wenn aktive Überwachungszeit > TDKATAKT" VALUE 0x81BE32 KwUw 3276.750 t50msxs_uw_b3276p75 0.00 3276.750 FORMAT "%8.3" /end CHARACTERISTIC
/begin CHARACTERISTIC TDKATAKT_1_A "Schwellwert Zyklus fertig wenn aktive Überwachungszeit > TDKATAKT" VALUE 0x81BE34 KwUw 3276.750 t50msxs_uw_b3276p75 0.00 3276.750 FORMAT "%8.3" /end CHARACTERISTIC
/begin CHARACTERISTIC TDKATATT_0_A "Schwellwert Zyklus fertig für Funktionsanforderung" VALUE 0x81BE36 KwUw 3276.750 t50msxs_uw_b3276p75 0.00 3276.750 FORMAT "%8.3" /end CHARACTERISTIC
/begin CHARACTERISTIC TDKATATT_1_A "Schwellwert Zyklus fertig für Funktionsanforderung" VALUE 0x81BE38 KwUw 3276.750 t50msxs_uw_b3276p75 0.00 3276.750 FORMAT "%8.3" /end CHARACTERISTIC
/begin CHARACTERISTIC TDKUPNOG "Verzögerungszeit nach Gangwechsel bis erneute Gangwechselerk. möglich" VALUE 0x8188DB KwUb 255.0 t1sxs_ub_b255 0.00 255.0 FORMAT "%5.1" /end CHARACTERISTIC
/begin CHARACTERISTIC TDLDEUK "Zeitschwelle für Tiepass-filterung von LDR-Regelabweichung" VALUE 0x819AD1 KwUb 12.75 t_q0p05 0.00 12.75 FORMAT "%5.2" /end CHARACTERISTIC
/begin CHARACTERISTIC TDLDPE "Entprellzeit für Fehler setzen LDP-Endstufe" VALUE 0x8189A3 KwUb 25.50 t100msxs_ub_b25p5 0.00 25.50 FORMAT "%5.2" /end CHARACTERISTIC
/begin CHARACTERISTIC TDLDRA2 "Zeitschwelle für Dia LDR - Regelabweichung (B_mxldra)" VALUE 0x819AD2 KwUb 12.75 t50msxs_ub_b12p75 0.00 12.75 FORMAT "%5.2" /end CHARACTERISTIC
/begin CHARACTERISTIC TDLKVDKH "Zeitverzögerung für löschen von E_lkvdk" VALUE 0x819AD3 KwUb 12.75 t50msxs_ub_b12p75 0.00 12.75 FORMAT "%5.2" /end CHARACTERISTIC
/begin CHARACTERISTIC TDLKVDKL "Zeitverzögerung für setzen von E_lkvdk im Ladebetrieb" VALUE 0x819AD4 KwUb 12.75 t50msxs_ub_b12p75 0.00 12.75 FORMAT "%5.2" /end CHARACTERISTIC
/begin CHARACTERISTIC TDLKVDKLL "Zeitverzögerung für setzen von E_lkvdk im Saugbetrieb untere Schwelle" VALUE 0x819AD5 KwUb 12.75 t50msxs_ub_b12p75 0.00 12.75 FORMAT "%5.2" /end CHARACTERISTIC
/begin CHARACTERISTIC TDLKVDKS "Zeitverzögerung für setzen von E_lkvdk im Saugbetrieb" VALUE 0x819AD6 KwUb 12.75 t50msxs_ub_b12p75 0.00 12.75 FORMAT "%5.2" /end CHARACTERISTIC
/begin CHARACTERISTIC TDLKVDKST "Zeitverzögerung für setzen von E_lkvdk nach Startende" VALUE 0x819AD7 KwUb 12.75 t50msxs_ub_b12p75 0.00 12.75 FORMAT "%5.2" /end CHARACTERISTIC
/begin CHARACTERISTIC TDLKVDKT "Zeitverzögerung für setzen von E_lkvdk im Ladebetrieb ab B_ll=true" VALUE 0x819AD8 KwUb 12.75 t50msxs_ub_b12p75 0.00 12.75 FORMAT "%5.2" /end CHARACTERISTIC
/begin CHARACTERISTIC TDLLR "Wartezeit bis setzen der Bedingung Diagnose Leerlaufsteller" VALUE 0x81F9F0 KwUw 255.0000 t200msxs_ub_b51 0.00 255.0000 FORMAT "%8.4" /end CHARACTERISTIC
/begin CHARACTERISTIC TDLLRMN "Wartezeit bis Fehlereintrag Steller geschlossen" VALUE 0x81F9F2 KwUw 255.0000 t200msxs_ub_b51 0.00 255.0000 FORMAT "%8.4" /end CHARACTERISTIC
/begin CHARACTERISTIC TDLLRMX "Wartezeit bis Fehlereintrag Steller offen" VALUE 0x81F9F4 KwUw 255.0000 t200msxs_ub_b51 0.00 255.0000 FORMAT "%8.4" /end CHARACTERISTIC
/begin CHARACTERISTIC TDLLRNF "Wartezeit bis Meldung kein Fehler bei Leerlaufsteller" VALUE 0x81F9F6 KwUw 255.0000 t200msxs_ub_b51 0.00 255.0000 FORMAT "%8.4" /end CHARACTERISTIC
/begin CHARACTERISTIC TDMLHFM "Zeitverzögerung für das Setzen von B_ehfm" VALUE 0x810D2C KwUb 2.540 t10msxs_ub_b2p55 0.01000 2.550 FORMAT "%5.3" /end CHARACTERISTIC
/begin CHARACTERISTIC TDMLMN "Entprellzeit HFM-(Hauptlastgeber-)Fehlererkennung Minimalwert" VALUE 0x818A26 KwUb 25.50 t100msxs_ub_b25p5 0.00 25.50 FORMAT "%5.2" /end CHARACTERISTIC
/begin CHARACTERISTIC TDMLMX "Entprellzeit HFM-(Hauptlastgeber-)Fehlererkennung Maximalwert" VALUE 0x818A27 KwUb 25.50 t100msxs_ub_b25p5 0.00 25.50 FORMAT "%5.2" /end CHARACTERISTIC
/begin CHARACTERISTIC TDMLNF "Entprellzeit HFM-(Hauptlastgeber-)Diagnose mit i.O.-Meldung" VALUE 0x818A28 KwUb 25.50 t100msxs_ub_b25p5 0.00 25.50 FORMAT "%5.2" /end CHARACTERISTIC
/begin CHARACTERISTIC TDMLST "Entprellzeit HFM-(Hauptlastgeber-)Fehlererkennung im Start" VALUE 0x818A29 KwUb 25.50 t100msxs_ub_b25p5 0.00 25.50 FORMAT "%5.2" /end CHARACTERISTIC
/begin CHARACTERISTIC TDUBHFM "Zeit für HFM-Diagnose mit u < UBHFM" VALUE 0x818A2A KwUb 25.40 t100msxs_ub_b25p5 0.1000 25.50 FORMAT "%5.2" /end CHARACTERISTIC
/begin CHARACTERISTIC TDZHR "Entprellzeit für Setzen des Zyklusflag" VALUE 0x8299D4 KwUw 6553.500 t100msxs_uw_b6553p5 0.00 6553.500 FORMAT "%8.3" /end CHARACTERISTIC
/begin CHARACTERISTIC TEVCKMX "Maximale Spülzeit bei DLDP-TEV- Check" VALUE 0x8170C0 KwUw 655.3500 t10msxs_uw_b655p35 0.00 655.3500 FORMAT "%8.4" /end CHARACTERISTIC
/begin CHARACTERISTIC TFDLLRO "Obere Schwelle für Zeitfenster für DLLR" VALUE 0x81F9F8 KwUw 6553.500 t100msxs_uw_b6553p5 0.00 6553.500 FORMAT "%8.3" /end CHARACTERISTIC
/begin CHARACTERISTIC TFDLLRU "Untere Schwelle für Zeitfenster für DLLR" VALUE 0x81F9FA KwUw 6553.500 t100msxs_uw_b6553p5 0.00 6553.500 FORMAT "%8.3" /end CHARACTERISTIC
/begin CHARACTERISTIC TFRA "Erkennungszeit für eingeschwungene Grundadaption von fra" VALUE 0x819264 KwUb 51.00 t200msxs_ub_b51 0.00 51.00 FORMAT "%5.2" /end CHARACTERISTIC
/begin CHARACTERISTIC TFRAOZ "Verweilzeit in FRAO für Zyklusflag bei nicht eingeschw. Adaption" VALUE 0x819265 KwUb 51.00 t200msxs_ub_b51 0.00 51.00 FORMAT "%5.2" /end CHARACTERISTIC
/begin CHARACTERISTIC TFRAUZ "Verweilzeit in FRAU für Zyklusflag bei nicht eingeschw. Adaption" VALUE 0x819266 KwUb 51.00 t200msxs_ub_b51 0.00 51.00 FORMAT "%5.2" /end CHARACTERISTIC
/begin CHARACTERISTIC TFRMST "Erkennungszeit für eingeschwungene Grundadaption von frm" VALUE 0x819267 KwUb 51.00 t200msxs_ub_b51 0.00 51.00 FORMAT "%5.2" /end CHARACTERISTIC
/begin CHARACTERISTIC TFRMZST "Verweilzeit für unplausibles frm-Signal (Kurztest)" VALUE 0x819268 KwUb 51.00 t200msxs_ub_b51 0.00 51.00 FORMAT "%5.2" /end CHARACTERISTIC
/begin CHARACTERISTIC TIZUMN "Minimale Zeit für TEV-zu bei Initialspülung Leckdiagnose" VALUE 0x81A2E2 KwUb 255.0 t1sxs_ub_b255 0.00 255.0 FORMAT "%5.1" /end CHARACTERISTIC
/begin CHARACTERISTIC TLDEUK "Zeitkonstante Tiefpass-Filterung für LDR-Regelabweichung" VALUE 0x81F7E2 KwUw 3276.7499992 zk50msxs_uw_b3276p8 0.050000762951 3276.8000000 FORMAT "%12.7" /end CHARACTERISTIC
/begin CHARACTERISTIC TLDP1SD "Zeitschwelle 1 für Erkennung System dicht bei Leckdiagnosemodul" VALUE 0x8170C2 KwUw 655.3500 t10msxs_uw_b655p35 0.00 655.3500 FORMAT "%8.4" /end CHARACTERISTIC
/begin CHARACTERISTIC TLDP2SD "Zeitschwelle 2 für Erkennung System dicht bei Leckdiagnosemodul" VALUE 0x8170C4 KwUw 655.3500 t10msxs_uw_b655p35 0.00 655.3500 FORMAT "%8.4" /end CHARACTERISTIC
/begin CHARACTERISTIC TLDPDISA1 "Anfang Zeitfenster 1 für DLDP-Verbot" VALUE 0x8283D8 KwUw 65535.00 t1sxs_uw_b65535 0.00 65535.00 FORMAT "%8.2" /end CHARACTERISTIC
/begin CHARACTERISTIC TLDPDISA2 "Anfang Zeitfenster 2 für DLDP-Verbot" VALUE 0x8283DA KwUw 65535.00 t1sxs_uw_b65535 0.00 65535.00 FORMAT "%8.2" /end CHARACTERISTIC
/begin CHARACTERISTIC TLDPDISE1 "Ende Zeitfenster 1 für DLDP-Verbot" VALUE 0x8283DC KwUw 65535.00 t1sxs_uw_b65535 0.00 65535.00 FORMAT "%8.2" /end CHARACTERISTIC
/begin CHARACTERISTIC TLDPDISE2 "Ende Zeitfenster 2 für DLDP-Verbot" VALUE 0x8283DE KwUw 65535.00 t1sxs_uw_b65535 0.00 65535.00 FORMAT "%8.2" /end CHARACTERISTIC
/begin CHARACTERISTIC TLDPMN "Wartezeit nach Start für Freigabe Leckdiagnose" VALUE 0x8283E0 KwUw 65535.00 t1sxs_uw_b65535 0.00 65535.00 FORMAT "%8.2" /end CHARACTERISTIC
/begin CHARACTERISTIC TLDPMX "Maximale Diagnosezeit nach Start" VALUE 0x8283E2 KwUw 65535.00 t1sxs_uw_b65535 0.00 65535.00 FORMAT "%8.2" /end CHARACTERISTIC
/begin CHARACTERISTIC TLDPRKL "Zeit für 'Reed-Kontakt zu'-Erkennung Closed Check" VALUE 0x8170C6 KwUw 655.3500 t10msxs_uw_b655p35 0.00 655.3500 FORMAT "%8.4" /end CHARACTERISTIC
/begin CHARACTERISTIC TLDPRKO "Zeit für ""Reed-Kontankt offen""-Erkennung bei Leckdiagnosemodul" VALUE 0x8170C8 KwUw 655.3500 t10msxs_uw_b655p35 0.00 655.3500 FORMAT "%8.4" /end CHARACTERISTIC
/begin CHARACTERISTIC TLDPRPDEL "Mindestwartezeit bis 1. Wiederholungsprüfung" VALUE 0x8283E4 KwUw 65535.00 t1sxs_uw_b65535 0.00 65535.00 FORMAT "%8.2" /end CHARACTERISTIC
/begin CHARACTERISTIC TLDPZMN "Minimale Zeit für TEV-zu vor Fortsetzung Leckdiagnose" VALUE 0x8170CA KwUw 655.3500 t10msxs_uw_b655p35 0.00 655.3500 FORMAT "%8.4" /end CHARACTERISTIC
/begin CHARACTERISTIC TLLASH "Verzög.zeit um lamlash_w zu sperren wenn lamsons_w ungleich lamlash_w ist" VALUE 0x81877B KwUb 25.50 t100msxs_ub_b25p5 0.00 25.50 FORMAT "%5.2" /end CHARACTERISTIC
/begin CHARACTERISTIC TLSUSAE "Zeit für Fehlereintrag während B_sa" VALUE 0x814304 KwUw 1310.700 t20msxs_uw_b1310 0.00 1310.700 FORMAT "%8.3" /end CHARACTERISTIC
/begin CHARACTERISTIC TMAXKAT_0_A "maximale Kat-Temperatur für Kat-diagnose" VALUE 0x81BE6A KwUb 1275. temp_ub_q5_o50 -50.00 1225. FORMAT "%5.0" /end CHARACTERISTIC
/begin CHARACTERISTIC TMAXKAT_1_A "maximale Kat-Temperatur für Kat-diagnose" VALUE 0x81BE6B KwUb 1275. temp_ub_q5_o50 -50.00 1225. FORMAT "%5.0" /end CHARACTERISTIC
/begin CHARACTERISTIC TMDLDUV "Motortemperaturschwelle zum Einschalten der Diagnose für SUV" VALUE 0x81124B KwUb 191.3 temp_ub_q0p75_o48 -48.00 143.3 FORMAT "%5.1" /end CHARACTERISTIC
/begin CHARACTERISTIC TMDLLR "Motortemperaturschwelle für Diagnose Leerlaufsteller" VALUE 0x819D90 KwUb 191.3 temp_ub_q0p75_o48 -48.00 143.3 FORMAT "%5.1" /end CHARACTERISTIC
/begin CHARACTERISTIC TMFDUV "Meßfensterzeit zur Pulsationsauswertung für Diagnose Schubumluftventil" VALUE 0x81124C KwUb 2.550 t_q0p01 0.00 2.550 FORMAT "%5.3" /end CHARACTERISTIC
/begin CHARACTERISTIC TMFFO "Obere tmot-Schwelle für 0.5 mm - Diagnose" VALUE 0x81A2E3 KwUb 191.3 temp_ub_q0p75_o48 -48.00 143.3 FORMAT "%5.1" /end CHARACTERISTIC
/begin CHARACTERISTIC TMFRST "Einschalttemperatur LR- Kurztest" VALUE 0x819269 KwUb 191.3 temp_ub_q0p75_o48 -48.00 143.3 FORMAT "%5.1" /end CHARACTERISTIC
/begin CHARACTERISTIC TMINKAT_0_A "Minimale Kat-Temperatur für Überwachung" VALUE 0x81BE6C KwUb 1275. temp_ub_q5_o50 -50.00 1225. FORMAT "%5.0" /end CHARACTERISTIC
/begin CHARACTERISTIC TMINKAT_1_A "Minimale Kat-Temperatur für Überwachung" VALUE 0x81BE6D KwUb 1275. temp_ub_q5_o50 -50.00 1225. FORMAT "%5.0" /end CHARACTERISTIC
/begin CHARACTERISTIC TMLDPO "Obere Motortemperaturschwelle für Leckdiagnosemodul" VALUE 0x81A2E4 KwUb 191.3 temp_ub_q0p75_o48 -48.00 143.3 FORMAT "%5.1" /end CHARACTERISTIC
/begin CHARACTERISTIC TMLDPU "Untere Motortemperaturschwelle für Leckdiagnosemodul" VALUE 0x81A2E5 KwUb 191.3 temp_ub_q0p75_o48 -48.00 143.3 FORMAT "%5.1" /end CHARACTERISTIC
/begin CHARACTERISTIC TMMZUV "Mindestmesszeit für Schubumluftventildignose" VALUE 0x81124D KwUb 2.550 t_q0p01 0.00 2.550 FORMAT "%5.3" /end CHARACTERISTIC
/begin CHARACTERISTIC TMNKATT_0_A "Minimale Kat-Temperatur für Überwachung bei Testerbetrieb" VALUE 0x81BE6E KwUb 1275. temp_ub_q5_o50 -50.00 1225. FORMAT "%5.0" /end CHARACTERISTIC
/begin CHARACTERISTIC TMNKATT_1_A "Minimale Kat-Temperatur für Überwachung bei Testerbetrieb" VALUE 0x81BE6F KwUb 1275. temp_ub_q5_o50 -50.00 1225. FORMAT "%5.0" /end CHARACTERISTIC
/begin CHARACTERISTIC TMSUKTD "Minimale tmot-Start-Temperatur für Katdiagnose" VALUE 0x8188A9 KwUb 191.3 temp_ub_q0p75_o48 -48.00 143.3 FORMAT "%5.1" /end CHARACTERISTIC
/begin CHARACTERISTIC TNLDHLSU "SG-Nachlaufzeit für DHLSU" VALUE 0x81BDE8 KwUw 65535.00 t1sxs_uw_q1 0.00 65535.00 FORMAT "%8.2" /end CHARACTERISTIC
/begin CHARACTERISTIC TPFIFOANZ "Anzahl FIFO-Einträge für Berechnung Periodendauer-Mittelwert" VALUE 0x811F38 KwUb 3.000 dez 1.000 4.000 FORMAT "%5.3" /end CHARACTERISTIC
/begin CHARACTERISTIC TPLGPLG "Zeitschwelle die Berechnung von ldeldra" VALUE 0x81F7E4 KwUw 3276.750 t_q0p05 0.00 3276.750 FORMAT "%8.3" /end CHARACTERISTIC
/begin CHARACTERISTIC TPTEVMN "Periodendauerschwelle bei LDP-TEV-Check" VALUE 0x8170CC KwUw 655.3500 t10msxs_uw_b655p35 0.00 655.3500 FORMAT "%8.4" /end CHARACTERISTIC
/begin CHARACTERISTIC TPUPH "Kennlinie für die Pumpzeit abhängig von den vorherigen Durchläufen" VAL_BLK 0x8170CE KwbUw 655.3500 t10msxs_uw_b655p35 0.00 655.3500 FORMAT "%8.4" NUMBER 30 /end CHARACTERISTIC
/begin CHARACTERISTIC TRIPFASH "Mindest Zeitdauer für aktive Lamda Regelung vor KAT" VALUE 0x81BDD6 KwUw 6553.500 t100msxs_uw_b6553p5 0.00 6553.500 FORMAT "%8.3" /end CHARACTERISTIC
/begin CHARACTERISTIC TRKA "Erkennungszeit für eingeschwungene Grundadaption von rkat bzw. rkaz" VALUE 0x81926A KwUb 51.00 t200msxs_ub_b51 0.00 51.00 FORMAT "%5.2" /end CHARACTERISTIC
/begin CHARACTERISTIC TRKATZ "Aktivierungszeit von rkat bis Setzen Zyklusflag, wenn B_gae = FALSE" VALUE 0x81926B KwUb 51.00 t200msxs_ub_b51 0.00 51.00 FORMAT "%5.2" /end CHARACTERISTIC
/begin CHARACTERISTIC TRKAUF "Überwachungszeit Reedkontakt öffnet während Fast Pulse" VALUE 0x81710A KwUw 655.3500 t10msxs_uw_b655p35 0.00 655.3500 FORMAT "%8.4" /end CHARACTERISTIC
/begin CHARACTERISTIC TRKAZZ "Aktivierungszeit von rkaz bis Setzen Zyklusflag, wenn B_gae = FALSE" VALUE 0x81926C KwUb 51.00 t200msxs_ub_b51 0.00 51.00 FORMAT "%5.2" /end CHARACTERISTIC
/begin CHARACTERISTIC TSALASH "Zeit nach Schub für Überprüfung Sonde hinter KAT" VALUE 0x81877C KwUb 25.50 t100msxs_ub_b25p5 0.00 25.50 FORMAT "%5.2" /end CHARACTERISTIC
/begin CHARACTERISTIC TSFAATUN "Fehlersummenzeit: Tuningschutz" VALUE 0x810920 KwUb 255.0 dez 0.00 255.0 FORMAT "%5.1" /end CHARACTERISTIC
/begin CHARACTERISTIC TSFHRE "" VALUE 0x81095D KwUb 255.0 dez 0.00 255.0 FORMAT "%5.1" /end CHARACTERISTIC
/begin CHARACTERISTIC TSFLDPE "Fehlersummenzeit: Leckdiagnosepumpe Endstufe" VALUE 0x810978 KwUb 255.0 dez 0.00 255.0 FORMAT "%5.1" /end CHARACTERISTIC
/begin CHARACTERISTIC TSFMDB "Fehlersummenzeit: Momentbegrenzung Sollmoment" VALUE 0x810985 KwUb 255.0 dez 0.00 255.0 FORMAT "%5.1" /end CHARACTERISTIC
/begin CHARACTERISTIC TSFSGEEW "Fehlersummenzeit: Steuergerät defekt (EEPROM WFS-Bereich)" VALUE 0x810991 KwUb 255.0 dez 0.00 255.0 FORMAT "%5.1" /end CHARACTERISTIC
/begin CHARACTERISTIC TSFUB "Fehlersummenzeit: Batteriespannung UB (Bordnetz)" VALUE 0x8109A3 KwUb 255.0 dez 0.00 255.0 FORMAT "%5.1" /end CHARACTERISTIC
/begin CHARACTERISTIC TSFUBR "Fehlersummenzeit: Bordnetzspannung über Hauptrelais UBR" VALUE 0x8109A4 KwUb 255.0 dez 0.00 255.0 FORMAT "%5.1" /end CHARACTERISTIC
/begin CHARACTERISTIC TSFWFS "Fehlersummenzeit: Wegfahrsperre" VALUE 0x8109AC KwUb 255.0 dez 0.00 255.0 FORMAT "%5.1" /end CHARACTERISTIC
/begin CHARACTERISTIC TSFWFSRC "Fehlersummenzeit: Wegfahrsperre RC-Glied" VALUE 0x8109AD KwUb 255.0 dez 0.00 255.0 FORMAT "%5.1" /end CHARACTERISTIC
/begin CHARACTERISTIC TSLDPV "Entprellzeit für Unterschreiten der Fz-Geschwindigkeitsschwelle für Übergang nac" VALUE 0x81A2E6 KwUb 25.50 t_q0p1 0.00 25.50 FORMAT "%5.2" /end CHARACTERISTIC
/begin CHARACTERISTIC TSRFPAB "Mindestschaltzeit Reed-Kontakt für Abbruch Fast Pulse" VALUE 0x81710C KwUw 655.3500 t10msxs_uw_b655p35 0.00 655.3500 FORMAT "%8.4" /end CHARACTERISTIC
/begin CHARACTERISTIC TSTZUMN "Zeit nach Start für zwangsgeschlossenes TEV" VALUE 0x81710E KwUw 65535.00 t1sxs_uw_b65535 0.00 65535.00 FORMAT "%8.2" /end CHARACTERISTIC
/begin CHARACTERISTIC TTLASH "Zeit für Verweildauer der Sonde hinter KAT unter/oberhalb des Sollwertes" VALUE 0x81BDD8 KwUw 6553.500 t100msxs_uw_b6553p5 0.00 6553.500 FORMAT "%8.3" /end CHARACTERISTIC
/begin CHARACTERISTIC TTOTLDP "Totzeit LDP- Sofortansteuerung während Fast Pulse" VALUE 0x817110 KwUw 655.3500 t10msxs_uw_b655p35 0.00 655.3500 FORMAT "%8.4" /end CHARACTERISTIC
/begin CHARACTERISTIC TULV1 "Verzögerung Überladeabschneiden, ti-Ausblengung Stufe 1" VALUE 0x819AD9 KwUb 12.75 t50msxs_ub_b12p75 0.00 12.75 FORMAT "%5.2" /end CHARACTERISTIC
/begin CHARACTERISTIC TULV3 "Verzögerungszeit für Heilung Überladefehler" VALUE 0x819ADA KwUb 12.75 t50msxs_ub_b12p75 0.00 12.75 FORMAT "%5.2" /end CHARACTERISTIC
/begin CHARACTERISTIC TUSCHUB "Verzögerungszeit für Störspitzen bei Schubprüfung der Sonde hinter KAT" VALUE 0x81877D KwUb 25.50 t100msxs_ub_b25p5 0.00 25.50 FORMAT "%5.2" /end CHARACTERISTIC
/begin CHARACTERISTIC TUSENLASH "Zeitdauer bis Sonden Mager/Fett Erkennung erlaubt hinter Kat" VALUE 0x81BDDA KwUw 6553.500 t100msxs_uw_b6553p5 0.00 6553.500 FORMAT "%8.3" /end CHARACTERISTIC
/begin CHARACTERISTIC TUSHKRFM "Zeitdauer bis zur Freig. Wiederholungsmess. Schwingungspr. (Reset F/M-Flip-Flop)" VALUE 0x81BDDC KwUw 6553.500 t100msxs_uw_b6553p5 0.00 6553.500 FORMAT "%8.3" /end CHARACTERISTIC
/begin CHARACTERISTIC TUSHKVL "Verzögerungszeit für Störspitzen bei Vollastprüfung der Sonde hinter KAT" VALUE 0x81877E KwUb 25.50 t100msxs_ub_b25p5 0.00 25.50 FORMAT "%5.2" /end CHARACTERISTIC
/begin CHARACTERISTIC TUSHSMIN "Mindestdauer für Steigungsmessung für enable Filter hinter Kat" VALUE 0x81877F KwUb 25.50 t100msxs_ub_b25p5 0.00 25.50 FORMAT "%5.2" /end CHARACTERISTIC
/begin CHARACTERISTIC TUSLASH "Testzeit füt Dauer Anfettung/Abmagerung hinter KAT" VALUE 0x81BDDE KwUw 6553.500 t100msxs_uw_b6553p5 0.00 6553.500 FORMAT "%8.3" /end CHARACTERISTIC
/begin CHARACTERISTIC TUSMSVL "Zeit nach Vollast für Überprüfung Sonde hinter KAT" VALUE 0x818780 KwUb 25.50 t100msxs_ub_b25p5 0.00 25.50 FORMAT "%5.2" /end CHARACTERISTIC
/begin CHARACTERISTIC TUSSA "Verzögerungszeit nach Über/Unterschreiten der Regelschwelle hinter KAT" VALUE 0x818781 KwUb 25.50 t100msxs_ub_b25p5 0.00 25.50 FORMAT "%5.2" /end CHARACTERISTIC
/begin CHARACTERISTIC TUSTALLASH "Verzög.zeit für Erkennung B_maxlash nach ""Tank leer"" fahren für Sonde h. KAT" VALUE 0x81BDE0 KwUw 6553.500 t100msxs_uw_b6553p5 0.00 6553.500 FORMAT "%8.3" /end CHARACTERISTIC
/begin CHARACTERISTIC TVFZDIF "Zeitintervall für vfz-Differenzberechnung" VALUE 0x81A2E7 KwUb 25.50 t100msxs_ub_b25p5 0.00 25.50 FORMAT "%5.2" /end CHARACTERISTIC
/begin CHARACTERISTIC TVHSHEE "Entprellzeit für Heizerendstufdiagnose hinter Kat" VALUE 0x8184C0 KwUb 12.75 t50msxs_ub_b12p75 0.00 12.75 FORMAT "%5.2" /end CHARACTERISTIC
/begin CHARACTERISTIC TVHSHRI "Verzögerungszeit für Ri-Fehler hinter Kat" VALUE 0x8184C1 KwUb 255.0 t1sxs_ub_b255 0.00 255.0 FORMAT "%5.1" /end CHARACTERISTIC
/begin CHARACTERISTIC TVHSHRIHEL "Verzögerungszeit für Heilung Ri-Fehler hinter Kat, wenn B_npfhsh =1" VALUE 0x8184C2 KwUb 255.0 t1sxs_ub_b255 0.00 255.0 FORMAT "%5.1" /end CHARACTERISTIC
/begin CHARACTERISTIC TVHSHRIZ "Verzögerungszeit für Heilung Ri-Fehler hinter Kat" VALUE 0x8184C3 KwUb 255.0 t1sxs_ub_b255 0.00 255.0 FORMAT "%5.1" /end CHARACTERISTIC
/begin CHARACTERISTIC TVLDPMN "Minimales TEV-Tastverhältnis für Fortsetzung Leckdiagnose" VALUE 0x81A2E8 KwUb 99.61 rel_ub_b99p6 0.00 99.61 FORMAT "%5.2" /end CHARACTERISTIC
/begin CHARACTERISTIC TVLDPT "Tastverhältnis für Fast Pulse Leckdiagnosepumpe" CURVE 0x81A2E9 KlAUbSstUbWUb 99.61 rel_ub_b99p6 0.00 99.61 FORMAT "%5.2"
 /begin AXIS_DESCR STD_AXIS tfpg t1sxs_ub_b255 6 0.00 255.0 FORMAT "%5.1" DEPOSIT ABSOLUTE /end AXIS_DESCR
/end CHARACTERISTIC
/begin CHARACTERISTIC TVLSUBM "maximal zul. Verzögerungszeit für Betriebsbereitschaft stetige Lambdasonde LSU" VALUE 0x81BDEA KwUw 3276.750 t50msxs_uw_b3276p75 0.00 3276.750 FORMAT "%8.3" /end CHARACTERISTIC
/begin CHARACTERISTIC TVLSUEE "Verzögerungszeit für LSU Heizerendstufenfehler" VALUE 0x818786 KwUb 12.75 t50msxs_ub_b12p75 0.00 12.75 FORMAT "%5.2" /end CHARACTERISTIC
/begin CHARACTERISTIC TVLSUNP "Verzögerungszeit für Fehler stetige Lambdasonde LSU" VALUE 0x818787 KwUb 12.75 t50msxs_ub_b12p75 0.00 12.75 FORMAT "%5.2" /end CHARACTERISTIC
/begin CHARACTERISTIC TVLSUSA "Verzögerungszeit für Funktionsprüfung während B_sa" VALUE 0x81BDEC KwUw 1310.700 t20msxs_uw_q0p02 0.00 1310.700 FORMAT "%8.3" /end CHARACTERISTIC
/begin CHARACTERISTIC TVLSUSAE "Verzögerungszeit für Fehlereintrag während B_sa" VALUE 0x81BDEE KwUw 1310.700 t20msxs_uw_q0p02 0.00 1310.700 FORMAT "%8.3" /end CHARACTERISTIC
/begin CHARACTERISTIC TVLSUSAH "Verzögerungszeit für Fehlerheilung während B_sa" VALUE 0x81BDF0 KwUw 1310.700 t20msxs_uw_q0p02 0.00 1310.700 FORMAT "%8.3" /end CHARACTERISTIC
/begin CHARACTERISTIC TVRIHEE "Verzögerungszeit für Ri-Fehler nach Endstufenfehler hinter Kat" VALUE 0x8184C4 KwUb 255.0 t1sxs_ub_b255 0.00 255.0 FORMAT "%5.1" /end CHARACTERISTIC
/begin CHARACTERISTIC TVTEVMN "minimales TEV- Tastverhältnis bei DLDP- TEV- Check" VALUE 0x811F39 KwUb 99.61 rel_ub_b99p6 0.00 99.61 FORMAT "%5.2" /end CHARACTERISTIC
/begin CHARACTERISTIC TWDKATST "Wartezeit nach Stoppbedingung für Filter und Integrator" VALUE 0x8188AA KwUb 12.75 t50msxs_ub_b12p75 0.00 12.75 FORMAT "%5.2" /end CHARACTERISTIC
/begin CHARACTERISTIC TWDLDPE "Wartezeit für Fehlerdiagnose LDP-Endstufe" VALUE 0x8189A4 KwUb 25.50 t100msxs_ub_b25p5 0.00 25.50 FORMAT "%5.2" /end CHARACTERISTIC
/begin CHARACTERISTIC TWKTDLP "Wartezeit nach Parameterumschaltung in Lambdaregelung" VALUE 0x8188AB KwUb 12.75 t50msxs_ub_b12p75 0.00 12.75 FORMAT "%5.2" /end CHARACTERISTIC
/begin CHARACTERISTIC TWKTDTK "Temperaturabhängige Wartezeit für Katdiagnose" CURVE 0x8143C4 KlAUbSstUbWUw 3276.750 t50msxs_uw_b3276p75 0.00 3276.750 FORMAT "%8.3"
 /begin AXIS_DESCR STD_AXIS tkdkth temp_ub_q5 4 0.00 1275. FORMAT "%5.0" DEPOSIT ABSOLUTE /end AXIS_DESCR
/end CHARACTERISTIC
/begin CHARACTERISTIC TWLDPE "Entprellzeit für i.O.-Prüfung LDP-Endstufe" VALUE 0x8189A5 KwUb 25.50 t100msxs_ub_b25p5 0.00 25.50 FORMAT "%5.2" /end CHARACTERISTIC
/begin CHARACTERISTIC TXFMX "Max. Zeit nach Start für Feinstleckdiagnose (0.5 mm)" VALUE 0x8283E6 KwUw 65535.00 t1sxs_uw_b65535 0.00 65535.00 FORMAT "%8.2" /end CHARACTERISTIC
/begin CHARACTERISTIC TZLRKTD_0_A "Periodendauer für Lambdaregelung aus Kat-Diagnose" VALUE 0x81BE3A KwUw 655.3500 t10msxs_uw_b655p35 0.00 655.3500 FORMAT "%8.4" /end CHARACTERISTIC
/begin CHARACTERISTIC TZLRKTD_1_A "Periodendauer für Lambdaregelung aus Kat-Diagnose" VALUE 0x81BE3C KwUw 655.3500 t10msxs_uw_b655p35 0.00 655.3500 FORMAT "%8.4" /end CHARACTERISTIC
/begin CHARACTERISTIC TZLRKTT_0_A "Periodendauer für Lambdaregelung aus Kat-Diagnose b. Testerbetreib" VALUE 0x81BE3E KwUw 655.3500 t10msxs_uw_b655p35 0.00 655.3500 FORMAT "%8.4" /end CHARACTERISTIC
/begin CHARACTERISTIC TZLRKTT_1_A "Periodendauer für Lambdaregelung aus Kat-Diagnose b. Testerbetreib" VALUE 0x81BE40 KwUw 655.3500 t10msxs_uw_b655p35 0.00 655.3500 FORMAT "%8.4" /end CHARACTERISTIC
/begin CHARACTERISTIC UADHFMMN "min. Spannungswert für Diagnose HFM im Start" VALUE 0x818A2B KwUb 4.9805 spg_ub_q0p019 0.00 4.9805 /end CHARACTERISTIC
/begin CHARACTERISTIC UADHFMMX "max. Spannungswert für Diagnose HFM im Start" VALUE 0x818A2C KwUb 4.9805 spg_ub_q0p019 0.00 4.9805 /end CHARACTERISTIC
/begin CHARACTERISTIC UBDHLSHMN "untere Batteriespannungsschwelle zur Freigabe der Lambdasonden-Heizer-Diagnose" VALUE 0x81BB66 KwUw 25.59961 spg_q0p00039 0.00 25.59961 FORMAT "%8.5" /end CHARACTERISTIC
/begin CHARACTERISTIC UBDHLSHMX "obere Batteriespannungsschwelle für die Lambdasonden- Heizer-Diagnose" VALUE 0x81BB68 KwUw 25.59961 spg_q0p00039 0.00 25.59961 FORMAT "%8.5" /end CHARACTERISTIC
/begin CHARACTERISTIC UBDHLSUMN "Batteriespannungsschwelle zur Freigabe der Heizer-Diagnose LSU" VALUE 0x814306 KwUw 25.59961 spg_q0p00039 0.00 25.59961 FORMAT "%8.5" /end CHARACTERISTIC
/begin CHARACTERISTIC UBDHLSUMX "obere Batteriespannungsschwelle für die  Heizer-Diagnose LSU" VALUE 0x814308 KwUw 25.59961 spg_q0p00039 0.00 25.59961 FORMAT "%8.5" /end CHARACTERISTIC
/begin CHARACTERISTIC UBDOLDPE "obere Spannungschwelle für Freigabe LDP-Endstufendiagnose" VALUE 0x8189A6 KwUb 17.95 spg_ubatt 0.00 17.95 FORMAT "%5.2" /end CHARACTERISTIC
/begin CHARACTERISTIC UBDULDPE "untere Spannungschwelle für Freigabe LDP-Endstufendiagnose" VALUE 0x8189A7 KwUb 17.95 spg_ubatt 0.00 17.95 FORMAT "%5.2" /end CHARACTERISTIC
/begin CHARACTERISTIC UBHFM "Batteriespannungsschwelle zur Umschaltung auf Ersatzlastsignal" VALUE 0x818A2D KwUb 17.95 spg_ubatt 0.00 17.95 FORMAT "%5.2" /end CHARACTERISTIC
/begin CHARACTERISTIC UDKRGOFS "Spannungsschwelle für DIA/KR Grundoffset Verstärker" VALUE 0x8111FC KwUb 4.980 spg_ub_b5 0.00 4.980 FORMAT "%5.3" /end CHARACTERISTIC
/begin CHARACTERISTIC UDKRTP "Integratorspannungsschwelle für Dia KS - Auswerteschaltung Testimpuls" VALUE 0x8111FE KwUb 4.980 spg_ub_b5 0.00 4.980 FORMAT "%5.3" /end CHARACTERISTIC
/begin CHARACTERISTIC UDKSNO "Obere Referenzspannungsschwelle DIA KS" CURVE 0x81E0E0 GklWUw 319.9813 spg_uw_b1280 0.00 319.9813 FORMAT "%8.4"
 /begin AXIS_DESCR COM_AXIS nmot nmot_ub_q40 16 0.00 10200. AXIS_PTS_REF SNM16KRUB /end AXIS_DESCR
/end CHARACTERISTIC
/begin CHARACTERISTIC UDKSNU "untere Referenzspannungsschwelle DIA KS" CURVE 0x81E100 GklWUw 319.9813 spg_uw_b1280 0.00 319.9813 FORMAT "%8.4"
 /begin AXIS_DESCR COM_AXIS nmot nmot_ub_q40 16 0.00 10200. AXIS_PTS_REF SNM16KRUB /end AXIS_DESCR
/end CHARACTERISTIC
/begin CHARACTERISTIC UHEMN "Schwellwert für bestromte Heizerendstufe" VALUE 0x810A36 KwUb 4.9805 spg_ub_q0p019 0.00 4.9805 /end CHARACTERISTIC
/begin CHARACTERISTIC UHEMX "Schwellwert für stromlose Heizerendstufe" VALUE 0x810A37 KwUb 4.9805 spg_ub_q0p019 0.00 4.9805 /end CHARACTERISTIC
/begin CHARACTERISTIC UHRMN1 "untere Grenze HR-Spannung, Erkennung Kurzschl. n. Masse" VALUE 0x81A6E2 KwUb 4.980 spg_ub_b5 0.00 4.980 FORMAT "%5.3" /end CHARACTERISTIC
/begin CHARACTERISTIC UHRMN2 "untere Grenze HR-Spannung, Erkennung Signalfehler" VALUE 0x81A6E3 KwUb 4.980 spg_ub_b5 0.00 4.980 FORMAT "%5.3" /end CHARACTERISTIC
/begin CHARACTERISTIC UHRMX1 "obere Grenze HR-Spannung" VALUE 0x81A6E4 KwUb 4.980 spg_ub_b5 0.00 4.980 FORMAT "%5.3" /end CHARACTERISTIC
/begin CHARACTERISTIC UHRMX2 "obere Grenze HR-Spannung, Erkennung Kurzschl. n. ub." VALUE 0x81A6E5 KwUb 4.980 spg_ub_b5 0.00 4.980 FORMAT "%5.3" /end CHARACTERISTIC
/begin CHARACTERISTIC ULDPEMN "Minimale Spannung für Diagnose LDP-Endstufe i.O." VALUE 0x8189A8 KwUb 4.9805 spg_ub_q0p019 0.00 4.9805 /end CHARACTERISTIC
/begin CHARACTERISTIC ULDPEMX "Maximale Spannung für Diagnose LDP-Endstufe i.O." VALUE 0x8189A9 KwUb 4.9805 spg_ub_q0p019 0.00 4.9805 /end CHARACTERISTIC
/begin CHARACTERISTIC UNWDHFM "Umdrehungen Nockenwelle für Fehlerentprellung Diagnose HFM" VALUE 0x818A2E KwUb 255.0 dez 0.00 255.0 FORMAT "%5.1" /end CHARACTERISTIC
/begin CHARACTERISTIC USHKVL "Schwellwert für Sondenspannung hinter KAT im Vollast-Betrieb" VALUE 0x818782 KwUb 1.330 spg_ub_q0p0052_o0p2 -0.2000 1.130 FORMAT "%5.3" /end CHARACTERISTIC
/begin CHARACTERISTIC USHLEAN "Schwelle für Magerspannung für Reset Dynamikmessung der Sonde hinter KAT" VALUE 0x810A32 KwUb 1.330 spg_ub_q0p0052_o0p2 -0.2000 1.130 FORMAT "%5.3" /end CHARACTERISTIC
/begin CHARACTERISTIC USHRICH "Schwelle für Fettspannung für gültige Dynamikmessung der Sonde hinter KAT" VALUE 0x810A33 KwUb 1.330 spg_ub_q0p0052_o0p2 -0.2000 1.130 FORMAT "%5.3" /end CHARACTERISTIC
/begin CHARACTERISTIC USHSTGMX "Wert für maximale Steigung für Startwert Filter" VALUE 0x818783 KwUb 132.6 spgg_q0p52 0.00 132.6 FORMAT "%5.1" /end CHARACTERISTIC
/begin CHARACTERISTIC USHSTSOLL "Schwelle für zulässige Steigung der Sondenspannung hinter KAT" VALUE 0x818784 KwUb 132.6 spgg_q0p52 0.00 132.6 FORMAT "%5.1" /end CHARACTERISTIC
/begin CHARACTERISTIC USSCHUB "Schwelle für Sondenspannung hinter KAT nach Schub" VALUE 0x818785 KwUb 1.330 spg_ub_q0p0052_o0p2 -0.2000 1.130 FORMAT "%5.3" /end CHARACTERISTIC
/begin CHARACTERISTIC VALDPMN "minimale Fahrzeuggeschwindigkeit bei Aktivierung DLDP" VALUE 0x811F3A KwUb 318.8 vfzg_ub_q1p25 0.00 318.8 FORMAT "%5.1" /end CHARACTERISTIC
/begin CHARACTERISTIC VDKUPPLMN "min. vfzg-Schwelle für Diagnose Kupplungsschalter" VALUE 0x8188DC KwUb 318.8 vfzg_ub_q1p25 0.00 318.8 FORMAT "%5.1" /end CHARACTERISTIC
/begin CHARACTERISTIC VLDPMN "Min. Geschwindigkeit für Grobleckverifikation" VALUE 0x811F3B KwUb 318.8 vfzg_ub_q1p25 0.00 318.8 FORMAT "%5.1" /end CHARACTERISTIC
/begin CHARACTERISTIC VLDPO "Obere vfz-Schwelle für 0.5 mm - Diagnose" VALUE 0x811F3C KwUb 318.8 vfzg_ub_q1p25 0.00 318.8 FORMAT "%5.1" /end CHARACTERISTIC
/begin CHARACTERISTIC VLDPTEV "Geschwindigkeitsschwelle bei Deaktivierung im DTEV-Zeitfenster" VALUE 0x811F3D KwUb 318.8 vfzg_ub_q1p25 0.00 318.8 FORMAT "%5.1" /end CHARACTERISTIC
/begin CHARACTERISTIC VLDPU "Untere vfz-Schwelle für 0.5 mm - Diagnose" VALUE 0x811F3E KwUb 318.8 vfzg_ub_q1p25 0.00 318.8 FORMAT "%5.1" /end CHARACTERISTIC
/begin CHARACTERISTIC VSLDPMN "minimale Fahrzeuggeschwindigkeit DLDP für Übergang in Zustand A_Stop" VALUE 0x811F3F KwUb 318.8 vfzg_ub_q1p25 0.00 318.8 FORMAT "%5.1" /end CHARACTERISTIC
/begin CHARACTERISTIC WZLDPD "Max. Anzahl Wiederholversuche bei 1mm-Dichtprüfung" VALUE 0x811F40 KwUb 255.0 dez 0.00 255.0 FORMAT "%5.1" /end CHARACTERISTIC
/begin CHARACTERISTIC WZLDPGS "Max. Anzahl Wiederholversuche nach Unterbrechung insgesamt" VALUE 0x811F41 KwUb 255.0 dez 0.00 255.0 FORMAT "%5.1" /end CHARACTERISTIC
/begin CHARACTERISTIC WZLDPMX "Max. Anzahl Wiederholversuche nach Unterbrechung bei erkanntem Leck" VALUE 0x811F42 KwUb 255.0 dez 0.00 255.0 FORMAT "%5.1" /end CHARACTERISTIC
/begin CHARACTERISTIC WZLDPRO "Max. Anzahl Wiederholversuche Reed-Switch Close to Open Check" VALUE 0x811F43 KwUb 255.0 dez 0.00 255.0 FORMAT "%5.1" /end CHARACTERISTIC
/begin CHARACTERISTIC ZDKATAD_0_A "Filterzeitkonstante der Differenzierer für Signalamplitude" VALUE 0x81BE70 KwUb 12.7498039 zk50msxs_ub_b12p8 0.0501960784 12.8000000 FORMAT "%10.7" /end CHARACTERISTIC
/begin CHARACTERISTIC ZDKATAD_1_A "Filterzeitkonstante der Differenzierer für Signalamplitude" VALUE 0x81BE71 KwUb 12.7498039 zk50msxs_ub_b12p8 0.0501960784 12.8000000 FORMAT "%10.7" /end CHARACTERISTIC
/begin CHARACTERISTIC ZDKATAF_0_A "Zeitkonstante Betrags-Filter für Signalamplitude" VALUE 0x81BE72 KwUb 12.7498039 zk50msxs_ub_b12p8 0.0501960784 12.8000000 FORMAT "%10.7" /end CHARACTERISTIC
/begin CHARACTERISTIC ZDKATAF_1_A "Zeitkonstante Betrags-Filter für Signalamplitude" VALUE 0x81BE73 KwUb 12.7498039 zk50msxs_ub_b12p8 0.0501960784 12.8000000 FORMAT "%10.7" /end CHARACTERISTIC
/begin CHARACTERISTIC ZDKATSH "Zeitkonstante Tiefpaß, Regellagendifferenz" VALUE 0x8188AC KwUb 12.7498039 zk50msxs_ub_b12p8 0.0501960784 12.8000000 FORMAT "%10.7" /end CHARACTERISTIC
/begin CHARACTERISTIC ZDKTBD_0_A "Zeitkonstante der Differenzierer für FR-Wechselanteil" VALUE 0x81BE74 KwUb 12.7498039 zk50msxs_ub_b12p8 0.0501960784 12.8000000 FORMAT "%10.7" /end CHARACTERISTIC
/begin CHARACTERISTIC ZDKTBD_1_A "Zeitkonstante der Differenzierer für FR-Wechselanteil" VALUE 0x81BE75 KwUb 12.7498039 zk50msxs_ub_b12p8 0.0501960784 12.8000000 FORMAT "%10.7" /end CHARACTERISTIC
/begin CHARACTERISTIC ZDKTBF_0_A "Zeitkonstante für Gasvermischungsvorgang vor Katalysator" VALUE 0x81BE76 KwUb 12.7498039 zk50msxs_ub_b12p8 0.0501960784 12.8000000 FORMAT "%10.7" /end CHARACTERISTIC
/begin CHARACTERISTIC ZDKTBF_1_A "Zeitkonstante für Gasvermischungsvorgang vor Katalysator" VALUE 0x81BE77 KwUb 12.7498039 zk50msxs_ub_b12p8 0.0501960784 12.8000000 FORMAT "%10.7" /end CHARACTERISTIC
/begin CHARACTERISTIC ZFRMST "Zeitkonstante für frm-Filter (short test)" VALUE 0x81926D KwUb 50.8000 zk200msxs_ub_b51p2 0.200000 51.0000 FORMAT "%7.4" /end CHARACTERISTIC
/begin CHARACTERISTIC ZKARIH1 "Filterzeitkonst.für Nachbildung Dynamik der Keramiktemperatur h. Kat" CURVE 0x81BB6A KlAUbSstUwWUw 6553.4999985 zk100msxs_uw_b6553 0.10000152590 6553.6000000 FORMAT "%12.7"
 /begin AXIS_DESCR STD_AXIS msabg_w m_uw_b6553p5 5 0.00 6553.500 FORMAT "%8.3" DEPOSIT ABSOLUTE /end AXIS_DESCR
/end CHARACTERISTIC
/begin CHARACTERISTIC ZKDXLDPE "Einschaltzeit(konstante) für Max-Fehler-Prüfung (KS_UB) LDP-Endst.-Diagnose" VALUE 0x8189AA KwUb 25.50 t100msxs_ub_b25p5 0.00 25.50 FORMAT "%5.2" /end CHARACTERISTIC
/begin CHARACTERISTIC ZKLSU "Filterzeitkonst.für Nachbildung Dynamik der LSU-Keramiktemp. aus Abgastemp.v.Kat" VALUE 0x81430A KwUw 6553.5000000 zk100msxs_uw_b6553 0.10000000000 6553.6000000 FORMAT "%12.7" /end CHARACTERISTIC
/begin CHARACTERISTIC ZKPRIH "Filter für Nachbildung Dynamik der Sondenkeramiktemp.aus el.Heizleistung h.Kat" VALUE 0x81BB80 KwUw 6553.4999985 zk100msxs_uw_b6553 0.10000152590 6553.6000000 FORMAT "%12.7" /end CHARACTERISTIC
/begin CHARACTERISTIC ZKTDRL "Zeitkonstante Tiefpaß, rl-Filterung" VALUE 0x8188AD KwUb 12.7498039 zk50msxs_ub_b12p8 0.0501960784 12.8000000 FORMAT "%10.7" /end CHARACTERISTIC
/begin CHARACTERISTIC ZKTDTKM "Tiefpaß-Filterzeitkonstante für tkatm-Filterung" VALUE 0x81BE24 KwUw 3276.7499992 zk50msxs_uw_b3276p8 0.050000762951 3276.8000000 FORMAT "%12.7" /end CHARACTERISTIC
/begin CHARACTERISTIC ZMLRO "Zeitkonstante mlroh-Tiefpaß bei Diagnose HFM/HLM" VALUE 0x810D2D KwUb 2.54000 zk10msxs_ub_b2p55 0.0100000 2.55000 FORMAT "%7.5" /end CHARACTERISTIC
/begin CHARACTERISTIC ZRLBAB "Zeitkonstante RL-Tiefpaß bei Bergaberkennung" VALUE 0x8283E8 KwUw 6553.4999985 zk100msxs_uw_b6553 0.10000152590 6553.6000000 FORMAT "%12.7" /end CHARACTERISTIC
/begin MEASUREMENT ahkat "Mittelwert der Amplitude Sondensignal hinter Kat. korrigiert mit KB" UBYTE fak_ub_b1 1 100 0 0.996094 ECU_ADDRESS 0x380995 /end MEASUREMENT
/begin MEASUREMENT ahkatn "Amplitude Sondensignal hinter Katalysator normiert" UBYTE fak_ub_b1 1 100 0 0.996094 ECU_ADDRESS 0x380996 /end MEASUREMENT
/begin MEASUREMENT ahktki_w "Amplitude Sondensignal hinter Katalysator korrigiert und integiert" UWORD t50msxs_uw_b819p2 1 100 0 819.188 FORMAT "%8.4" ECU_ADDRESS 0x381BB8 /end MEASUREMENT
/begin MEASUREMENT ahktnk "Korrigierte Sondensignal-Amplitude normiert" UBYTE fak_ub_b1 1 100 0 0.996094 ECU_ADDRESS 0x380997 /end MEASUREMENT
/begin MEASUREMENT akatbn "Amplitude der Katalysatorbelastungssignal" UBYTE fak_ub_b1 1 100 0 0.996094 ECU_ADDRESS 0x380998 /end MEASUREMENT
/begin MEASUREMENT akatbnk "korrigierte Amplitude der Katalysatorbelastungssignal" UBYTE fak_ub_b1 1 100 0 0.996094 ECU_ADDRESS 0x38484A /end MEASUREMENT
/begin MEASUREMENT anzgangw "Anzahl erkannter Gangwechsel" UBYTE dez 1 100 0 255 FORMAT "%5.1" ECU_ADDRESS 0x3809B1 /end MEASUREMENT
/begin MEASUREMENT anzkupplb "Anzahl erkannter Kupplungsbetätigungen" UBYTE dez 1 100 0 255 FORMAT "%5.1" ECU_ADDRESS 0x3809B2 /end MEASUREMENT
/begin MEASUREMENT anzpuls "Zähler für Gesamtimpulsanzahl bei Einzelimpulsansteuerung" UBYTE dez 1 100 0 255 FORMAT "%5.1" ECU_ADDRESS 0x380B9E /end MEASUREMENT
/begin MEASUREMENT apedkt "Anzahl der Prüfungen mit Fehlerergebnis bei Katdiagnose" UBYTE dez 1 100 0 255 FORMAT "%5.1" ECU_ADDRESS 0x380999 /end MEASUREMENT
/begin MEASUREMENT avkatf "AmplitudenVerhältnis laafh/laafv gefiltert" UBYTE fak_ub_b1 1 100 0 0.996094 ECU_ADDRESS 0x383124 /end MEASUREMENT
/begin MEASUREMENT azlrdkt "Lambdaregler-Zwangsamplitude aus Kat-Diagnose" UBYTE fak_ub_b0p25 1 100 0 0.249023 FORMAT "%11.9" ECU_ADDRESS 0x38099A /end MEASUREMENT
/begin MEASUREMENT B_aav "Bedingung AAV wird angesteuert erfüllt" UWORD B_TRUE 1 100 0 1 BIT_MASK 0x40 FORMAT "%13.11" ECU_ADDRESS 0xFDA2 /end MEASUREMENT
/begin MEASUREMENT B_abgstg "Bedingung Modelltemperatur (tkatm od. tanhkm_w) hinter KAT ist oberhalb Schwelle" UBYTE B_TRUE 1 100 0 1 BIT_MASK 0x1 FORMAT "%13.11" ECU_ADDRESS 0x38098F /end MEASUREMENT
/begin MEASUREMENT B_agrrdy "Bedingung AGR geprüft für 'ready-Byte'" UBYTE B_TRUE 1 100 0 1 BIT_MASK 0x80 FORMAT "%13.11" ECU_ADDRESS 0x383113 /end MEASUREMENT
/begin MEASUREMENT B_atla "Bedingung Abgasturbolader ist aktiv" UBYTE B_TRUE 1 100 0 1 BIT_MASK 0x4 FORMAT "%13.11" ECU_ADDRESS 0x380AF2 /end MEASUREMENT
/begin MEASUREMENT B_beaatun "" UWORD B_TRUE 1 100 0 1 BIT_MASK 0x20 FORMAT "%13.11" ECU_ADDRESS 0x38390A /end MEASUREMENT
/begin MEASUREMENT B_behre "" UWORD B_TRUE 1 100 0 1 BIT_MASK 0x20 FORMAT "%13.11" ECU_ADDRESS 0x383984 /end MEASUREMENT
/begin MEASUREMENT B_beldpe "" UWORD B_TRUE 1 100 0 1 BIT_MASK 0x20 FORMAT "%13.11" ECU_ADDRESS 0x3839BA /end MEASUREMENT
/begin MEASUREMENT B_bemdb "Bedingung Bandende-Funktionsanforderung MDB" UWORD B_TRUE 1 100 0 1 BIT_MASK 0x20 FORMAT "%13.11" ECU_ADDRESS 0x3839D4 /end MEASUREMENT
/begin MEASUREMENT B_bergab "Bedingung Bergabfahrt erkannt" UBYTE B_TRUE 1 100 0 1 BIT_MASK 0x1 FORMAT "%13.11" ECU_ADDRESS 0x380BA1 /end MEASUREMENT
/begin MEASUREMENT B_bergabd "Bergabfahrt erkannt über Umgebungsdruck" UBYTE B_TRUE 1 100 0 1 BIT_MASK 0x10 FORMAT "%13.11" ECU_ADDRESS 0x380BA3 /end MEASUREMENT
/begin MEASUREMENT B_bergabl "Bedingung Bergabfahrt erkannt über Last und Geschwindigkeit" UBYTE B_TRUE 1 100 0 1 BIT_MASK 0x8 FORMAT "%13.11" ECU_ADDRESS 0x380BA3 /end MEASUREMENT
/begin MEASUREMENT B_bergxf "Bedingung Bergabfahrt erkannt für 0.5 mm - Diagnose" UBYTE B_TRUE 1 100 0 1 BIT_MASK 0x40 FORMAT "%13.11" ECU_ADDRESS 0x380BA2 /end MEASUREMENT
/begin MEASUREMENT B_bergxfd "Bedingung Bergabfahrt erkannt über Umgebungsdruck für 0,5mm-Leck-Erken" UBYTE B_TRUE 1 100 0 1 BIT_MASK 0x40 FORMAT "%13.11" ECU_ADDRESS 0x380BA3 /end MEASUREMENT
/begin MEASUREMENT B_bergxfl "Bedingung Bergabfahrt erkannt über Last und Geschwindigkeit für 0,5mm-Leck-Erken" UBYTE B_TRUE 1 100 0 1 BIT_MASK 0x20 FORMAT "%13.11" ECU_ADDRESS 0x380BA3 /end MEASUREMENT
/begin MEASUREMENT B_besgeew "" UWORD B_TRUE 1 100 0 1 BIT_MASK 0x20 FORMAT "%13.11" ECU_ADDRESS 0x3839EC /end MEASUREMENT
/begin MEASUREMENT B_beub "Bedingung: Bandendefunktionanford. für Batteriespannung (Bordnetz)" UWORD B_TRUE 1 100 0 1 BIT_MASK 0x20 FORMAT "%13.11" ECU_ADDRESS 0x383A10 /end MEASUREMENT
/begin MEASUREMENT B_beubr "Bedingung: Bandendefunktionanford. für Batteriespannung (Bordnetz)" UWORD B_TRUE 1 100 0 1 BIT_MASK 0x20 FORMAT "%13.11" ECU_ADDRESS 0x383A12 /end MEASUREMENT
/begin MEASUREMENT B_bewfs "" UWORD B_TRUE 1 100 0 1 BIT_MASK 0x20 FORMAT "%13.11" ECU_ADDRESS 0x383A22 /end MEASUREMENT
/begin MEASUREMENT B_bewfsrc "" UWORD B_TRUE 1 100 0 1 BIT_MASK 0x20 FORMAT "%13.11" ECU_ADDRESS 0x383A24 /end MEASUREMENT
/begin MEASUREMENT B_bkaatun "Bedingung Ersatzwert für Tuningschutz" UWORD B_TRUE 1 100 0 1 BIT_MASK 0x40 FORMAT "%13.11" ECU_ADDRESS 0x38390A /end MEASUREMENT
/begin MEASUREMENT B_bkhre "" UWORD B_TRUE 1 100 0 1 BIT_MASK 0x40 FORMAT "%13.11" ECU_ADDRESS 0x383984 /end MEASUREMENT
/begin MEASUREMENT B_bkldpe "Bedingung: Leckdiagnosemodul Endstufe aktiv" UWORD B_TRUE 1 100 0 1 BIT_MASK 0x40 FORMAT "%13.11" ECU_ADDRESS 0x3839BA /end MEASUREMENT
/begin MEASUREMENT B_bkmdb "Bedingung: Momentanüberwachung (bergrenzt dauerhaft) aktiv" UWORD B_TRUE 1 100 0 1 BIT_MASK 0x40 FORMAT "%13.11" ECU_ADDRESS 0x3839D4 /end MEASUREMENT
/begin MEASUREMENT B_bksgeew "Bedingung: Steuergerät defekt (EEPROM WFS)" UWORD B_TRUE 1 100 0 1 BIT_MASK 0x40 FORMAT "%13.11" ECU_ADDRESS 0x3839EC /end MEASUREMENT
/begin MEASUREMENT B_bkub "Bedingung Ersatzwert für Batteriespannung (Bordnetz)" UWORD B_TRUE 1 100 0 1 BIT_MASK 0x40 FORMAT "%13.11" ECU_ADDRESS 0x383A10 /end MEASUREMENT
/begin MEASUREMENT B_bkubr "Bedingung Ersatzwert für Batteriespannung (Bordnetz)" UWORD B_TRUE 1 100 0 1 BIT_MASK 0x40 FORMAT "%13.11" ECU_ADDRESS 0x383A12 /end MEASUREMENT
/begin MEASUREMENT B_bkwfs "Bedingung: Wegfahrsperre" UWORD B_TRUE 1 100 0 1 BIT_MASK 0x40 FORMAT "%13.11" ECU_ADDRESS 0x383A22 /end MEASUREMENT
/begin MEASUREMENT B_bkwfsrc "Bedingung: Wegfahrsperre RC-Glied" UWORD B_TRUE 1 100 0 1 BIT_MASK 0x40 FORMAT "%13.11" ECU_ADDRESS 0x383A24 /end MEASUREMENT
/begin MEASUREMENT B_bxf1 "Flip-Flop 1: Obere vfz-Schwelle überschrittenh für 0.5 mm - Diagnose" UWORD B_TRUE 1 100 0 1 BIT_MASK 0x1 FORMAT "%13.11" ECU_ADDRESS 0x382B5E /end MEASUREMENT
/begin MEASUREMENT B_bxf2 "Flip-Flop2: Untere vfz-Schwelle überschrittenh für 0.5 mm - Diagnose" UWORD B_TRUE 1 100 0 1 BIT_MASK 0x2 FORMAT "%13.11" ECU_ADDRESS 0x382B5E /end MEASUREMENT
/begin MEASUREMENT B_bxf3 "Flip-Flop3: Beschleunigung größer Maximalschwelle für 0.5 mm - Diagnose" UWORD B_TRUE 1 100 0 1 BIT_MASK 0x4 FORMAT "%13.11" ECU_ADDRESS 0x382B5E /end MEASUREMENT
/begin MEASUREMENT B_bxf4 "Flip-Flop4: Laständerung größer Maximalschwelle für 0.5 mm - Diagnose" UWORD B_TRUE 1 100 0 1 BIT_MASK 0x8 FORMAT "%13.11" ECU_ADDRESS 0x382B5E /end MEASUREMENT
/begin MEASUREMENT B_bxf5 "Flip-Flop5: Motortemperatur größer Maximalschwelle für 0.5 mm - Diagnose" UWORD B_TRUE 1 100 0 1 BIT_MASK 0x10 FORMAT "%13.11" ECU_ADDRESS 0x382B5E /end MEASUREMENT
/begin MEASUREMENT B_bxf6 "Flip-Flop6: Ansauglufttemperatur größer Maximalschwelle für 0.5 mm - Diagnose" UWORD B_TRUE 1 100 0 1 BIT_MASK 0x20 FORMAT "%13.11" ECU_ADDRESS 0x382B5E /end MEASUREMENT
/begin MEASUREMENT B_bxf7 "Flip-Flop7: Motortemperaturdifferenz im Start kleiner Minimalschwelle für 0.5 mm" UWORD B_TRUE 1 100 0 1 BIT_MASK 0x40 FORMAT "%13.11" ECU_ADDRESS 0x382B5E /end MEASUREMENT
/begin MEASUREMENT B_bxf8 "Flip-Flop8: Bergabfahrt während 0.5 mm - Diagnose erkannt" UWORD B_TRUE 1 100 0 1 BIT_MASK 0x80 FORMAT "%13.11" ECU_ADDRESS 0x382B5E /end MEASUREMENT
/begin MEASUREMENT B_bxf9 "Flip-Flop9: Maximalzeit nach Start für 0.5 mm - Diagnose überschritten" UWORD B_TRUE 1 100 0 1 BIT_MASK 0x100 FORMAT "%13.11" ECU_ADDRESS 0x382B5E /end MEASUREMENT
/begin MEASUREMENT B_claatun "" UWORD B_TRUE 1 100 0 1 BIT_MASK 0x80 FORMAT "%13.11" ECU_ADDRESS 0x38390A /end MEASUREMENT
/begin MEASUREMENT B_clhre "Bedingung Fehlerpfad Hauptrelaisendstufe löschen" UWORD B_TRUE 1 100 0 1 BIT_MASK 0x80 FORMAT "%13.11" ECU_ADDRESS 0x383984 /end MEASUREMENT
/begin MEASUREMENT B_clldpe "Bedingung: Fehlerpfad Endstufe LDP löschen" UWORD B_TRUE 1 100 0 1 BIT_MASK 0x80 FORMAT "%13.11" ECU_ADDRESS 0x3839BA /end MEASUREMENT
/begin MEASUREMENT B_clmdb "Flag für Löschung: Momentenbegrenzung begrenzt dauerhaft" UWORD B_TRUE 1 100 0 1 BIT_MASK 0x80 FORMAT "%13.11" ECU_ADDRESS 0x3839D4 /end MEASUREMENT
/begin MEASUREMENT B_clsgeew "Bedingung Steuergerät defekt  (EEPROM-WFS) löschen" UWORD B_TRUE 1 100 0 1 BIT_MASK 0x80 FORMAT "%13.11" ECU_ADDRESS 0x3839EC /end MEASUREMENT
/begin MEASUREMENT B_club "Bedingung Fehlerpfad Batteriespannung (Bordnetz) löschen" UWORD B_TRUE 1 100 0 1 BIT_MASK 0x80 FORMAT "%13.11" ECU_ADDRESS 0x383A10 /end MEASUREMENT
/begin MEASUREMENT B_clubr "Bedingung Fehlerpfad Bordspannung über Hauptrelais  löschen" UWORD B_TRUE 1 100 0 1 BIT_MASK 0x80 FORMAT "%13.11" ECU_ADDRESS 0x383A12 /end MEASUREMENT
/begin MEASUREMENT B_clwfs "Bedingung Wegfahrsperre löschen" UWORD B_TRUE 1 100 0 1 BIT_MASK 0x80 FORMAT "%13.11" ECU_ADDRESS 0x383A22 /end MEASUREMENT
/begin MEASUREMENT B_clwfsrc "Bedingung löschen: Wegfahrsperre RC-Glied" UWORD B_TRUE 1 100 0 1 BIT_MASK 0x80 FORMAT "%13.11" ECU_ADDRESS 0x383A24 /end MEASUREMENT
/begin MEASUREMENT B_ddylash "Bedingung Sonde hinter KAT dynamisch langsam" UWORD B_TRUE 1 100 0 1 BIT_MASK 0x200 FORMAT "%13.11" ECU_ADDRESS 0xFD36 /end MEASUREMENT
/begin MEASUREMENT B_dhrnio "Bedingung Diagnose HR momentan nicht möglich" UWORD B_TRUE 1 100 0 1 BIT_MASK 0x400 FORMAT "%13.11" ECU_ADDRESS 0xFDB2 /end MEASUREMENT
/begin MEASUREMENT B_dkini "Bedingung für DKAT-Funktion initialisieren" UWORD B_TRUE 1 100 0 1 BIT_MASK 0x100 FORMAT "%13.11" ECU_ADDRESS 0xFD3A /end MEASUREMENT
/begin MEASUREMENT B_dklpi "interne Umschaltung d. Lambdregelungsparameter angefordert" UWORD B_TRUE 1 100 0 1 BIT_MASK 0x200 FORMAT "%13.11" ECU_ADDRESS 0xFD3A /end MEASUREMENT
/begin MEASUREMENT B_dktakt "DKAT-Funktion aktiv" UWORD B_TRUE 1 100 0 1 BIT_MASK 0x400 FORMAT "%13.11" ECU_ADDRESS 0xFD3A /end MEASUREMENT
/begin MEASUREMENT B_dkten "DKAT für diesen Trip nicht mehr aktiv" UWORD B_TRUE 1 100 0 1 BIT_MASK 0x800 FORMAT "%13.11" ECU_ADDRESS 0xFD3A /end MEASUREMENT
/begin MEASUREMENT B_dktlp "Umschaltung der Lambdaregelungsparameter angefordert" UWORD B_TRUE 1 100 0 1 BIT_MASK 0x1000 FORMAT "%13.11" ECU_ADDRESS 0xFD3A /end MEASUREMENT
/begin MEASUREMENT B_dktnr "DKAT: n/rl-Bereich verlassen" UWORD B_TRUE 1 100 0 1 BIT_MASK 0x2000 FORMAT "%13.11" ECU_ADDRESS 0xFD3A /end MEASUREMENT
/begin MEASUREMENT B_dktpb "DKAT Prüfung beendet" UWORD B_TRUE 1 100 0 1 BIT_MASK 0x4000 FORMAT "%13.11" ECU_ADDRESS 0xFD3A /end MEASUREMENT
/begin MEASUREMENT B_dktsb "Bankspezifische Stoppbedingung" UWORD B_TRUE 1 100 0 1 BIT_MASK 0x8000 FORMAT "%13.11" ECU_ADDRESS 0xFD3A /end MEASUREMENT
/begin MEASUREMENT B_dktsp "physikalische Stoppbedingung" UWORD B_TRUE 1 100 0 1 BIT_MASK 0x1 FORMAT "%13.11" ECU_ADDRESS 0xFD3C /end MEASUREMENT
/begin MEASUREMENT B_dktst "DKAT-Funktion ist gestoppt (B_dktst=FALSE)" UWORD B_TRUE 1 100 0 1 BIT_MASK 0x2 FORMAT "%13.11" ECU_ADDRESS 0xFD3C /end MEASUREMENT
/begin MEASUREMENT B_dktt "DKAT-Aktiv-Zeit abgelaufen" UWORD B_TRUE 1 100 0 1 BIT_MASK 0x4 FORMAT "%13.11" ECU_ADDRESS 0xFD3C /end MEASUREMENT
/begin MEASUREMENT B_dkttk "Katdiagnose temperaturbedingt gesperrt (Kat-Temperatur)" UWORD B_TRUE 1 100 0 1 BIT_MASK 0x8 FORMAT "%13.11" ECU_ADDRESS 0xFD3C /end MEASUREMENT
/begin MEASUREMENT B_dkvsef "Errorflag in DKVS trotz weitere Fehler im System freigeben" UWORD B_TRUE 1 100 0 1 BIT_MASK 0x40 FORMAT "%13.11" ECU_ADDRESS 0xFD64 /end MEASUREMENT
/begin MEASUREMENT B_dkvsf "Bedingung: Freigabe des Fehlers" UWORD B_TRUE 1 100 0 1 BIT_MASK 0x80 FORMAT "%13.11" ECU_ADDRESS 0xFD64 /end MEASUREMENT
/begin MEASUREMENT B_dkvsfm "Bedingung: Freigabe des Fehlers (Flipflop Ausgang)" UBYTE B_TRUE 1 100 0 1 BIT_MASK 0x1 FORMAT "%13.11" ECU_ADDRESS 0x383137 /end MEASUREMENT
/begin MEASUREMENT B_dkvstr "Bedingung: Integrator bei Tankleer zurücksetzen" UWORD B_TRUE 1 100 0 1 BIT_MASK 0x100 FORMAT "%13.11" ECU_ADDRESS 0xFD64 /end MEASUREMENT
/begin MEASUREMENT B_dlams "Bedingung Lambdaverstellung für Integrator hat max. Grenzwert erreicht." UBYTE B_TRUE 1 100 0 1 BIT_MASK 0x2 FORMAT "%13.11" ECU_ADDRESS 0x384843 /end MEASUREMENT
/begin MEASUREMENT B_dlash "Bedingung Freigabe Schwingungsprüfung hinter Kat." UWORD B_TRUE 1 100 0 1 BIT_MASK 0x400 FORMAT "%13.11" ECU_ADDRESS 0xFD36 /end MEASUREMENT
/begin MEASUREMENT B_dldp "Aktive Diagnose: Leckdiagnosemodul" UBYTE B_TRUE 1 100 0 1 BIT_MASK 0x1 FORMAT "%13.11" ECU_ADDRESS 0x380B9F /end MEASUREMENT
/begin MEASUREMENT B_dldpf "Flag DLDP ist prinzipiell freigegeben" UBYTE B_TRUE 1 100 0 1 BIT_MASK 0x4 FORMAT "%13.11" ECU_ADDRESS 0x380BA1 /end MEASUREMENT
/begin MEASUREMENT B_dldpte "Anforderung TEV schließen aus Tankentlüftungsdiagnose" UWORD B_TRUE 1 100 0 1 BIT_MASK 0x80 FORMAT "%13.11" ECU_ADDRESS 0xFDA2 /end MEASUREMENT
/begin MEASUREMENT B_dllr "Aktive diagnose: Leerlaufstellerdiagnose" UWORD B_TRUE 1 100 0 1 BIT_MASK 0x8 FORMAT "%13.11" ECU_ADDRESS 0xFD86 /end MEASUREMENT
/begin MEASUREMENT B_dllra "Bedingung DLLR Anforderung" UWORD B_TRUE 1 100 0 1 BIT_MASK 0x10 FORMAT "%13.11" ECU_ADDRESS 0xFD86 /end MEASUREMENT
/begin MEASUREMENT B_dpumn "Bedingung minimale Differenz Umgebungsdruck - Saugrohrdruck unterschritten" UBYTE B_TRUE 1 100 0 1 BIT_MASK 0x80 FORMAT "%13.11" ECU_ADDRESS 0x380BA1 /end MEASUREMENT
/begin MEASUREMENT B_ds "KR: Sensordiagnose aktiv" UWORD B_TRUE 1 100 0 1 BIT_MASK 0x1 FORMAT "%13.11" ECU_ADDRESS 0xFD76 /end MEASUREMENT
/begin MEASUREMENT B_dshk "Bedingung Diagnosefunktion in %DLSH und %DHLS mit i.O.-Meldung h. KAT" UWORD B_TRUE 1 100 0 1 BIT_MASK 0x800 FORMAT "%13.11" ECU_ADDRESS 0xFD36 /end MEASUREMENT
/begin MEASUREMENT B_dteven "Bedingung Freigabe DLDP-TEV- Check" UBYTE B_TRUE 1 100 0 1 BIT_MASK 0x2 FORMAT "%13.11" ECU_ADDRESS 0x380BA2 /end MEASUREMENT
/begin MEASUREMENT B_dushkvl "Bed. Schwelle für Sonde h. KAT bei Vollast nicht überschritten" UBYTE B_TRUE 1 100 0 1 BIT_MASK 0x1 FORMAT "%13.11" ECU_ADDRESS 0x384842 /end MEASUREMENT
/begin MEASUREMENT B_dushsch "Bedingung Schwelle für Sonde hinter KAT im Schub nicht unterschritten" UWORD B_TRUE 1 100 0 1 BIT_MASK 0x1000 FORMAT "%13.11" ECU_ADDRESS 0xFD36 /end MEASUREMENT
/begin MEASUREMENT B_dylash "Bedingung Sonde hinter KAT dynamisch langsam" UBYTE B_TRUE 1 100 0 1 BIT_MASK 0x1 FORMAT "%13.11" ECU_ADDRESS 0x384A60 /end MEASUREMENT
/begin MEASUREMENT B_dynsp "Bedingung Leckerkennung bei Dynamik gesperrt" UBYTE B_TRUE 1 100 0 1 BIT_MASK 0x10 FORMAT "%13.11" ECU_ADDRESS 0x380AF3 /end MEASUREMENT
/begin MEASUREMENT B_ebDavT "Bedingung ETK_Bypass Daten verfügbar" UWORD B_TRUE 1 100 0 1 BIT_MASK 0x200 FORMAT "%13.11" ECU_ADDRESS 0xFD28 /end MEASUREMENT
/begin MEASUREMENT B_ebDavY "ETK-Bypass Daten vorhanden" UWORD B_TRUE 1 100 0 1 BIT_MASK 0x400 FORMAT "%13.11" ECU_ADDRESS 0xFD28 /end MEASUREMENT
/begin MEASUREMENT B_edkvs "Bedingung Adaptionsfehlerschwellen aktuell überschritten" UWORD B_TRUE 1 100 0 1 BIT_MASK 0x200 FORMAT "%13.11" ECU_ADDRESS 0xFD64 /end MEASUREMENT
/begin MEASUREMENT B_efrao "Bedingung Diagnoseschwellen obere multipl. Korrektur aktuell überschritten" UWORD B_TRUE 1 100 0 1 BIT_MASK 0x400 FORMAT "%13.11" ECU_ADDRESS 0xFD64 /end MEASUREMENT
/begin MEASUREMENT B_efrau "Bedingung Diagnoseschwellen untere multipl. Korrektur aktuell überschritten" UWORD B_TRUE 1 100 0 1 BIT_MASK 0x800 FORMAT "%13.11" ECU_ADDRESS 0xFD64 /end MEASUREMENT
/begin MEASUREMENT B_ehfm "Bedingung Fehler HFM (ohne Entprellung)" UWORD B_TRUE 1 100 0 1 BIT_MASK 0x10 FORMAT "%13.11" ECU_ADDRESS 0xFD54 /end MEASUREMENT
/begin MEASUREMENT B_ehfm1 "Bedingung Fehler HFM (ohne Entprellung) (Zwischengröße ohne Abfrage von UBAT)" UWORD B_TRUE 1 100 0 1 BIT_MASK 0x20 FORMAT "%13.11" ECU_ADDRESS 0xFD54 /end MEASUREMENT
/begin MEASUREMENT B_ehfs "Bedingung Ersatzwert Hauptfüllungssensor" UWORD B_TRUE 1 100 0 1 BIT_MASK 0x40 FORMAT "%13.11" ECU_ADDRESS 0xFD54 /end MEASUREMENT
/begin MEASUREMENT B_ehlsu "Bedingung Fehler Heizung LSU" UWORD B_TRUE 1 100 0 1 BIT_MASK 0x2000 FORMAT "%13.11" ECU_ADDRESS 0xFD38 /end MEASUREMENT
/begin MEASUREMENT B_ehsh "Bedingung Error HSH" UBYTE B_TRUE 1 100 0 1 BIT_MASK 0x1 FORMAT "%13.11" ECU_ADDRESS 0x38482B /end MEASUREMENT
/begin MEASUREMENT B_ekats "Summenfehler für MODE 6" UWORD B_TRUE 1 100 0 1 BIT_MASK 0x10 FORMAT "%13.11" ECU_ADDRESS 0xFD3C /end MEASUREMENT
/begin MEASUREMENT B_elmi "Bedingung Error Luftmasse bei Initialisierung" UWORD B_TRUE 1 100 0 1 BIT_MASK 0x80 FORMAT "%13.11" ECU_ADDRESS 0xFD54 /end MEASUREMENT
/begin MEASUREMENT B_emxldr "Bedingung Setzen maximaler LDR-Fehler" UBYTE B_TRUE 1 100 0 1 BIT_MASK 0x1 FORMAT "%13.11" ECU_ADDRESS 0x380AF2 /end MEASUREMENT
/begin MEASUREMENT B_enfmst "Bedingung Enable für Filter; Maximum der Steigung übernehmen hinter Kat" UWORD B_TRUE 1 100 0 1 BIT_MASK 0x2000 FORMAT "%13.11" ECU_ADDRESS 0xFD36 /end MEASUREMENT
/begin MEASUREMENT B_enh "Bedingung Freigabe Ri-Diagnose Sondenheizung hinter Kat" UBYTE B_TRUE 1 100 0 1 BIT_MASK 0x20 FORMAT "%13.11" ECU_ADDRESS 0x38482B /end MEASUREMENT
/begin MEASUREMENT B_enheat "Bedingung Freigabe Diagnose Sondenheizung LSU" UWORD B_TRUE 1 100 0 1 BIT_MASK 0x4000 FORMAT "%13.11" ECU_ADDRESS 0xFD38 /end MEASUREMENT
/begin MEASUREMENT B_enlash "Bedingung Test für Schwingungsprüfung abgeschlossen hinteer Kat" UWORD B_TRUE 1 100 0 1 BIT_MASK 0x4000 FORMAT "%13.11" ECU_ADDRESS 0xFD36 /end MEASUREMENT
/begin MEASUREMENT B_enmaxla "Bedingung enable B_maxlash ""setzen"" bei Fehler Lambdasonden hinter Kat" UBYTE B_TRUE 1 100 0 1 BIT_MASK 0x2 FORMAT "%13.11" ECU_ADDRESS 0x384844 /end MEASUREMENT
/begin MEASUREMENT B_enramph "Bedingung Eenable Rampentest für Sonde hinter KAT" UBYTE B_TRUE 1 100 0 1 BIT_MASK 0x40 FORMAT "%13.11" ECU_ADDRESS 0x384845 /end MEASUREMENT
/begin MEASUREMENT B_enswit "Einschaltbedingung für die Endstufendiagnose LSU" UWORD B_TRUE 1 100 0 1 BIT_MASK 0x8000 FORMAT "%13.11" ECU_ADDRESS 0xFD38 /end MEASUREMENT
/begin MEASUREMENT B_entest "Bedingung Wartezeit abgeschlossen für Test-Überprüfung Sonde hinter KAT" UWORD B_TRUE 1 100 0 1 BIT_MASK 0x8000 FORMAT "%13.11" ECU_ADDRESS 0xFD36 /end MEASUREMENT
/begin MEASUREMENT B_erdkt "Interner Fehler Kat-Überwachung" UWORD B_TRUE 1 100 0 1 BIT_MASK 0x20 FORMAT "%13.11" ECU_ADDRESS 0xFD3C /end MEASUREMENT
/begin MEASUREMENT B_erkat "Bedingung Diagnoseschwellen additive Korr. pro Zeit aktuell überschritten" UWORD B_TRUE 1 100 0 1 BIT_MASK 0x1000 FORMAT "%13.11" ECU_ADDRESS 0xFD64 /end MEASUREMENT
/begin MEASUREMENT B_erkaz "Bedingung Diagnoseschwellen additive Korr. pro Einspr.  aktuell überschritten" UWORD B_TRUE 1 100 0 1 BIT_MASK 0x2000 FORMAT "%13.11" ECU_ADDRESS 0xFD64 /end MEASUREMENT
/begin MEASUREMENT B_erl "Bedingung für Errorpfad ldo vom rl check" UBYTE B_TRUE 1 100 0 1 BIT_MASK 0x1 FORMAT "%13.11" ECU_ADDRESS 0x380AF3 /end MEASUREMENT
/begin MEASUREMENT B_errldp "Bedingung Fehlerbit erfüllt" UBYTE B_TRUE 1 100 0 1 BIT_MASK 0x8 FORMAT "%13.11" ECU_ADDRESS 0x380BA1 /end MEASUREMENT
/begin MEASUREMENT B_extaav "Bedingung elektrisches AAV vorhanden" UBYTE B_TRUE 1 100 0 1 BIT_MASK 0x10 FORMAT "%13.11" ECU_ADDRESS 0x380BA2 /end MEASUREMENT
/begin MEASUREMENT B_faldpa "" UBYTE B_TRUE 1 100 0 1 BIT_MASK 0x2 FORMAT "%13.11" ECU_ADDRESS 0x380BA0 /end MEASUREMENT
/begin MEASUREMENT B_fev1 "Bedingung Ansaugluft<Minimalwert erkannt" UWORD B_TRUE 1 100 0 1 BIT_MASK 0x1 FORMAT "%13.11" ECU_ADDRESS 0x382B62 /end MEASUREMENT
/begin MEASUREMENT B_fev10 "Bedingung kurze Lastüberschreitung rl über Maxwert" UWORD B_TRUE 1 100 0 1 BIT_MASK 0x200 FORMAT "%13.11" ECU_ADDRESS 0x382B62 /end MEASUREMENT
/begin MEASUREMENT B_fev11 "Bedingung TEV nicht erfüllt" UWORD B_TRUE 1 100 0 1 BIT_MASK 0x400 FORMAT "%13.11" ECU_ADDRESS 0x382B62 /end MEASUREMENT
/begin MEASUREMENT B_fev12 "Bedingung Reedkontakt öffnet in der Fast Pulse Phase" UWORD B_TRUE 1 100 0 1 BIT_MASK 0x800 FORMAT "%13.11" ECU_ADDRESS 0x382B62 /end MEASUREMENT
/begin MEASUREMENT B_fev13 "Bedingung Warmabfahrt in kalte Umgebung" UWORD B_TRUE 1 100 0 1 BIT_MASK 0x1000 FORMAT "%13.11" ECU_ADDRESS 0x382B62 /end MEASUREMENT
/begin MEASUREMENT B_fev2 "Bedingung Ansaugluft>Maximalwert erkannt" UWORD B_TRUE 1 100 0 1 BIT_MASK 0x2 FORMAT "%13.11" ECU_ADDRESS 0x382B62 /end MEASUREMENT
/begin MEASUREMENT B_fev3 "Bedingung Motortemperatur<Minimalwert erkannt" UWORD B_TRUE 1 100 0 1 BIT_MASK 0x4 FORMAT "%13.11" ECU_ADDRESS 0x382B62 /end MEASUREMENT
/begin MEASUREMENT B_fev4 "Bedingung Motortemperatur>Maximalwert erkannt" UWORD B_TRUE 1 100 0 1 BIT_MASK 0x8 FORMAT "%13.11" ECU_ADDRESS 0x382B62 /end MEASUREMENT
/begin MEASUREMENT B_fev5 "Bedingung Differenz zwischen Motorabstell- und Motorstarttemperatur erkannt" UWORD B_TRUE 1 100 0 1 BIT_MASK 0x10 FORMAT "%13.11" ECU_ADDRESS 0x382B62 /end MEASUREMENT
/begin MEASUREMENT B_fev6 "Bedingung Höhe>Maximalwert erkannt" UWORD B_TRUE 1 100 0 1 BIT_MASK 0x20 FORMAT "%13.11" ECU_ADDRESS 0x382B62 /end MEASUREMENT
/begin MEASUREMENT B_fev7 "Bedingung Fahrzeuggeschwindigkeit<Minimalwert erfüllt" UWORD B_TRUE 1 100 0 1 BIT_MASK 0x40 FORMAT "%13.11" ECU_ADDRESS 0x382B62 /end MEASUREMENT
/begin MEASUREMENT B_fev8 "Bedingung Bergabfahrt erkannt" UWORD B_TRUE 1 100 0 1 BIT_MASK 0x80 FORMAT "%13.11" ECU_ADDRESS 0x382B62 /end MEASUREMENT
/begin MEASUREMENT B_fev9 "Bedingung lange Lastüberschreitung rl über Maxwert" UWORD B_TRUE 1 100 0 1 BIT_MASK 0x100 FORMAT "%13.11" ECU_ADDRESS 0x382B62 /end MEASUREMENT
/begin MEASUREMENT B_fgdhfmst "Bedingung Freigabe der HFM Diagnose nach Startende" UWORD B_TRUE 1 100 0 1 BIT_MASK 0x100 FORMAT "%13.11" ECU_ADDRESS 0xFD54 /end MEASUREMENT
/begin MEASUREMENT B_fpchk "Bedingung Prüfung auf Abbruch Fast Pulse" UBYTE B_TRUE 1 100 0 1 BIT_MASK 0x10 FORMAT "%13.11" ECU_ADDRESS 0x380BA1 /end MEASUREMENT
/begin MEASUREMENT B_frste "Bedingung frm_w eingeschwungen (Kurztest)" UWORD B_TRUE 1 100 0 1 BIT_MASK 0x4000 FORMAT "%13.11" ECU_ADDRESS 0xFD64 /end MEASUREMENT
/begin MEASUREMENT B_ftaatun "" UWORD B_TRUE 1 100 0 1 BIT_MASK 0x10 FORMAT "%13.11" ECU_ADDRESS 0x38390A /end MEASUREMENT
/begin MEASUREMENT B_fthre "" UWORD B_TRUE 1 100 0 1 BIT_MASK 0x10 FORMAT "%13.11" ECU_ADDRESS 0x383984 /end MEASUREMENT
/begin MEASUREMENT B_ftldpe "" UWORD B_TRUE 1 100 0 1 BIT_MASK 0x10 FORMAT "%13.11" ECU_ADDRESS 0x3839BA /end MEASUREMENT
/begin MEASUREMENT B_ftmdb "Bedingung: Fehlereintrag durch Tester für MDB" UWORD B_TRUE 1 100 0 1 BIT_MASK 0x10 FORMAT "%13.11" ECU_ADDRESS 0x3839D4 /end MEASUREMENT
/begin MEASUREMENT B_ftsgeew "" UWORD B_TRUE 1 100 0 1 BIT_MASK 0x10 FORMAT "%13.11" ECU_ADDRESS 0x3839EC /end MEASUREMENT
/begin MEASUREMENT B_ftub "Bedingung Fehlereintrag durch Tester für Batteriespannung (Bordnetz)" UWORD B_TRUE 1 100 0 1 BIT_MASK 0x10 FORMAT "%13.11" ECU_ADDRESS 0x383A10 /end MEASUREMENT
/begin MEASUREMENT B_ftubr "Bedingung Fehlereintrag durch Tester für Batteriespannung (Bordnetz)" UWORD B_TRUE 1 100 0 1 BIT_MASK 0x10 FORMAT "%13.11" ECU_ADDRESS 0x383A12 /end MEASUREMENT
/begin MEASUREMENT B_ftwfs "" UWORD B_TRUE 1 100 0 1 BIT_MASK 0x10 FORMAT "%13.11" ECU_ADDRESS 0x383A22 /end MEASUREMENT
/begin MEASUREMENT B_ftwfsrc "" UWORD B_TRUE 1 100 0 1 BIT_MASK 0x10 FORMAT "%13.11" ECU_ADDRESS 0x383A24 /end MEASUREMENT
/begin MEASUREMENT B_gae "Bedingung Grundadaption eingeschwungen" UWORD B_TRUE 1 100 0 1 BIT_MASK 0x8000 FORMAT "%13.11" ECU_ADDRESS 0xFD64 /end MEASUREMENT
/begin MEASUREMENT B_gaefra "Bedingung Grundadaption (fra-Integrator) eingeschwungen" UWORD B_TRUE 1 100 0 1 BIT_MASK 0x1 FORMAT "%13.11" ECU_ADDRESS 0xFD66 /end MEASUREMENT
/begin MEASUREMENT B_gaefra2 "Bedingung Grundadaption (fra2-Integrator) eingeschwungen" UWORD B_TRUE 1 100 0 1 BIT_MASK 0x2 FORMAT "%13.11" ECU_ADDRESS 0xFD66 /end MEASUREMENT
/begin MEASUREMENT B_gaeing "Bedingung Grundadaption Bank 1 eingeschwungen" UWORD B_TRUE 1 100 0 1 BIT_MASK 0x4 FORMAT "%13.11" ECU_ADDRESS 0xFD66 /end MEASUREMENT
/begin MEASUREMENT B_gaeing2 "Bedingung Grundadaption Bank 2 eingeschwungenen" UWORD B_TRUE 1 100 0 1 BIT_MASK 0x8 FORMAT "%13.11" ECU_ADDRESS 0xFD66 /end MEASUREMENT
/begin MEASUREMENT B_gangok "Bedingung Gangwechselerkennung prinziell erlaubt" UWORD B_TRUE 1 100 0 1 BIT_MASK 0x80 FORMAT "%13.11" ECU_ADDRESS 0xFD3E /end MEASUREMENT
/begin MEASUREMENT B_helsunp "Bedingung Freigabe Heilung LSU- Heizung Plausibilität" UBYTE B_TRUE 1 100 0 1 BIT_MASK 0x4 FORMAT "%13.11" ECU_ADDRESS 0x384849 /end MEASUREMENT
/begin MEASUREMENT B_helsusa "Bedingung Freigabe Heilung LSU- Heizung Plausibilität (Schubspannung)" UBYTE B_TRUE 1 100 0 1 BIT_MASK 0x1 FORMAT "%13.11" ECU_ADDRESS 0x380992 /end MEASUREMENT
/begin MEASUREMENT B_helsusw "Bedingung Freigabe Heilung LSU- Heizungsendstufe" UBYTE B_TRUE 1 100 0 1 BIT_MASK 0x1 FORMAT "%13.11" ECU_ADDRESS 0x384849 /end MEASUREMENT
/begin MEASUREMENT B_hfm "Bedingung HFM messbereit" UWORD B_TRUE 1 100 0 1 BIT_MASK 0x200 FORMAT "%13.11" ECU_ADDRESS 0xFD54 /end MEASUREMENT
/begin MEASUREMENT B_hshtpk "Bed. Taupuktende überschritten und Sonde ausreichend heiß hinter Kat" UBYTE B_TRUE 1 100 0 1 BIT_MASK 0x10 FORMAT "%13.11" ECU_ADDRESS 0x384846 /end MEASUREMENT
/begin MEASUREMENT B_hsokh "Bedingung Sondenheizung OK hinter Kat" UBYTE B_TRUE 1 100 0 1 BIT_MASK 0x2 FORMAT "%13.11" ECU_ADDRESS 0x38482C /end MEASUREMENT
/begin MEASUREMENT B_hsrdy "Bedingung Sondenheizung geprüft für 'ready-Byte'" UBYTE B_TRUE 1 100 0 1 BIT_MASK 0x40 FORMAT "%13.11" ECU_ADDRESS 0x383113 /end MEASUREMENT
/begin MEASUREMENT B_imlkvse "Bedingung Luftmassenintegral Rücksetzen" UBYTE B_TRUE 1 100 0 1 BIT_MASK 0x2 FORMAT "%13.11" ECU_ADDRESS 0x383137 /end MEASUREMENT
/begin MEASUREMENT B_ispuel "Flag Initialspülung ist erfolgt" UBYTE B_TRUE 1 100 0 1 BIT_MASK 0x1 FORMAT "%13.11" ECU_ADDRESS 0x380BA0 /end MEASUREMENT
/begin MEASUREMENT B_kathrdy "Bedingung Katalysator-Heizungen geprüft für 'ready-Byte'" UBYTE B_TRUE 1 100 0 1 BIT_MASK 0x2 FORMAT "%13.11" ECU_ADDRESS 0x383113 /end MEASUREMENT
/begin MEASUREMENT B_katrdy "Bedingung Katalysatoren geprüft für 'ready-Byte'" UBYTE B_TRUE 1 100 0 1 BIT_MASK 0x1 FORMAT "%13.11" ECU_ADDRESS 0x383113 /end MEASUREMENT
/begin MEASUREMENT B_kkrdy "Bedingung Klimakühlmittel geprüft für 'ready-Byte'" UBYTE B_TRUE 1 100 0 1 BIT_MASK 0x10 FORMAT "%13.11" ECU_ADDRESS 0x383113 /end MEASUREMENT
/begin MEASUREMENT B_ktrlash "Bedingung Kurztrip für Schwingungsprüfung durchführen Sonde hinter KAT" UBYTE B_TRUE 1 100 0 1 BIT_MASK 0x4 FORMAT "%13.11" ECU_ADDRESS 0x384843 /end MEASUREMENT
/begin MEASUREMENT B_kvsffl "Bedingung: Freigabe des Fehlers trotz Tank leer" UWORD B_TRUE 1 100 0 1 BIT_MASK 0x10 FORMAT "%13.11" ECU_ADDRESS 0xFD66 /end MEASUREMENT
/begin MEASUREMENT B_ladan "Bedingung für Laderansprechdrehzahl" UBYTE B_TRUE 1 100 0 1 BIT_MASK 0x2 FORMAT "%13.11" ECU_ADDRESS 0x380AF3 /end MEASUREMENT
/begin MEASUREMENT B_lamend "Bedingung Ende der Lambdaverstellung in %LAMKO hinter Kat" UWORD B_TRUE 1 100 0 1 BIT_MASK 0x1 FORMAT "%13.11" ECU_ADDRESS 0xFD38 /end MEASUREMENT
/begin MEASUREMENT B_lamlash "Bedingung für Abmagern/Anfetten in %LAMKO" UWORD B_TRUE 1 100 0 1 BIT_MASK 0x2 FORMAT "%13.11" ECU_ADDRESS 0xFD38 /end MEASUREMENT
/begin MEASUREMENT B_lamverg "Bedingung Vergleich Lambdasoll in %DLSAHK mit %LAMKO übereinstimmend" UWORD B_TRUE 1 100 0 1 BIT_MASK 0x4 FORMAT "%13.11" ECU_ADDRESS 0xFD38 /end MEASUREMENT
/begin MEASUREMENT B_ldp "Bedingung LDP wird angesteuert erfüllt" UWORD B_TRUE 1 100 0 1 BIT_MASK 0x100 FORMAT "%13.11" ECU_ADDRESS 0xFDA2 /end MEASUREMENT
/begin MEASUREMENT B_ldpabb "Flag DLDP-Abbruch" UBYTE B_TRUE 1 100 0 1 BIT_MASK 0x4 FORMAT "%13.11" ECU_ADDRESS 0x380BA0 /end MEASUREMENT
/begin MEASUREMENT B_ldpe "Bedingung LDP-Endstufe angesteuert (eingeschaltet)" UWORD B_TRUE 1 100 0 1 BIT_MASK 0x400 FORMAT "%13.11" ECU_ADDRESS 0xFD50 /end MEASUREMENT
/begin MEASUREMENT B_ldpelok "" UWORD B_TRUE 1 100 0 1 BIT_MASK 0x800 FORMAT "%13.11" ECU_ADDRESS 0xFD50 /end MEASUREMENT
/begin MEASUREMENT B_ldpf1 "Fehler fault_1" UBYTE B_TRUE 1 100 0 1 BIT_MASK 0x8 FORMAT "%13.11" ECU_ADDRESS 0x380BA0 /end MEASUREMENT
/begin MEASUREMENT B_ldpf2 "Fehler fault_2" UBYTE B_TRUE 1 100 0 1 BIT_MASK 0x10 FORMAT "%13.11" ECU_ADDRESS 0x380BA0 /end MEASUREMENT
/begin MEASUREMENT B_ldpf5 "Fehler fault_5" UBYTE B_TRUE 1 100 0 1 BIT_MASK 0x20 FORMAT "%13.11" ECU_ADDRESS 0x380BA0 /end MEASUREMENT
/begin MEASUREMENT B_ldpf6 "Fehler fault_6" UBYTE B_TRUE 1 100 0 1 BIT_MASK 0x40 FORMAT "%13.11" ECU_ADDRESS 0x380BA0 /end MEASUREMENT
/begin MEASUREMENT B_ldpf7 "Fehler fault_7: Feinstleck ( >= 0.5 mm) erkannt" UBYTE B_TRUE 1 100 0 1 BIT_MASK 0x4 FORMAT "%13.11" ECU_ADDRESS 0x380BA3 /end MEASUREMENT
/begin MEASUREMENT B_ldpflv "Bedingung Feinleckverifikation der DLDP aktiv" UBYTE B_TRUE 1 100 0 1 BIT_MASK 0x1 FORMAT "%13.11" ECU_ADDRESS 0x380BA2 /end MEASUREMENT
/begin MEASUREMENT B_ldpglv "Grobleckverifikation der DLDP aktiv" UBYTE B_TRUE 1 100 0 1 BIT_MASK 0x8 FORMAT "%13.11" ECU_ADDRESS 0x380BA2 /end MEASUREMENT
/begin MEASUREMENT B_ldra "Bedingung für Ersatzmaßnahme bei E_ldra bzw. E_LKVDK" UBYTE B_TRUE 1 100 0 1 BIT_MASK 0x2 FORMAT "%13.11" ECU_ADDRESS 0x380AF2 /end MEASUREMENT
/begin MEASUREMENT B_lldia "Diagnose Leerlaufregelung freigegeben" UWORD B_TRUE 1 100 0 1 BIT_MASK 0x20 FORMAT "%13.11" ECU_ADDRESS 0xFD86 /end MEASUREMENT
/begin MEASUREMENT B_lsahksp "allgemeine Stop-Bedingungen für die DLSAHK" UWORD B_TRUE 1 100 0 1 BIT_MASK 0x8 FORMAT "%13.11" ECU_ADDRESS 0xFD38 /end MEASUREMENT
/begin MEASUREMENT B_lshkspe "Enable allgemeine Stop-Bedingungen für die DLSAHK" UBYTE B_TRUE 1 100 0 1 BIT_MASK 0x4 FORMAT "%13.11" ECU_ADDRESS 0x384846 /end MEASUREMENT
/begin MEASUREMENT B_lshswok "Bedingung Sonde hinter KAT nach Schwingungsprüfung in Ordnung" UBYTE B_TRUE 1 100 0 1 BIT_MASK 0x1 FORMAT "%13.11" ECU_ADDRESS 0x384841 /end MEASUREMENT
/begin MEASUREMENT B_lsrdy "Bedingung Lambda-Sonden geprüft für 'ready-Byte'" UBYTE B_TRUE 1 100 0 1 BIT_MASK 0x20 FORMAT "%13.11" ECU_ADDRESS 0x383113 /end MEASUREMENT
/begin MEASUREMENT B_maxla "Maximalwert für Schwingungs-Prüfung hinter KAT erkannt" UBYTE B_TRUE 1 100 0 1 BIT_MASK 0x4 FORMAT "%13.11" ECU_ADDRESS 0x384844 /end MEASUREMENT
/begin MEASUREMENT B_maxlash "Maximalwert für Schwingungs-Prüfung hinter KAT erkannt" UWORD B_TRUE 1 100 0 1 BIT_MASK 0x10 FORMAT "%13.11" ECU_ADDRESS 0xFD38 /end MEASUREMENT
/begin MEASUREMENT B_maxlavh "Bedingung Maximalwert für Vollast-Prüfung hinter KAT erkannt" UBYTE B_TRUE 1 100 0 1 BIT_MASK 0x4 FORMAT "%13.11" ECU_ADDRESS 0x384842 /end MEASUREMENT
/begin MEASUREMENT B_messe "Flag Periodendauermessung (State 5) beendet" UBYTE B_TRUE 1 100 0 1 BIT_MASK 0x80 FORMAT "%13.11" ECU_ADDRESS 0x380BA0 /end MEASUREMENT
/begin MEASUREMENT B_messf "Messfensterzeit zur Diagnose Schubumluftventil beim Turbo" UWORD B_TRUE 1 100 0 1 BIT_MASK 0x40 FORMAT "%13.11" ECU_ADDRESS 0xFD82 /end MEASUREMENT
/begin MEASUREMENT B_minlash "Minimalwert für Schwingungsprüfung hinter KAT erkannt" UWORD B_TRUE 1 100 0 1 BIT_MASK 0x20 FORMAT "%13.11" ECU_ADDRESS 0xFD38 /end MEASUREMENT
/begin MEASUREMENT B_minldra "Bedingung zum Setzen des Min-Fehlers von DFPM_LDRA erfüllt" UBYTE B_TRUE 1 100 0 1 BIT_MASK 0x4 FORMAT "%13.11" ECU_ADDRESS 0x380AF3 /end MEASUREMENT
/begin MEASUREMENT B_mldyn "Bedingung erforderliche Luftmasse im Schubbetrieb für Dynamikmessung erreicht" UWORD B_TRUE 1 100 0 1 BIT_MASK 0x40 FORMAT "%13.11" ECU_ADDRESS 0xFD38 /end MEASUREMENT
/begin MEASUREMENT B_mlustest "Bedingung ml ist innerhalb den Schwellen" UWORD B_TRUE 1 100 0 1 BIT_MASK 0x80 FORMAT "%13.11" ECU_ADDRESS 0xFD38 /end MEASUREMENT
/begin MEASUREMENT B_mnaatun "Bedingung: Min-Fehler Tuningschutz" UWORD B_TRUE 1 100 0 1 BIT_MASK 0x200 FORMAT "%13.11" ECU_ADDRESS 0x38390A /end MEASUREMENT
/begin MEASUREMENT B_mnfhsh "Kurzschluß Heizung Lambdasonde hinter Kat nach Masse" UBYTE B_TRUE 1 100 0 1 BIT_MASK 0x4 FORMAT "%13.11" ECU_ADDRESS 0x38482B /end MEASUREMENT
/begin MEASUREMENT B_mnhfm "Bedingung untere Plausibilitätsschwelle unterschritten" UWORD B_TRUE 1 100 0 1 BIT_MASK 0x400 FORMAT "%13.11" ECU_ADDRESS 0xFD54 /end MEASUREMENT
/begin MEASUREMENT B_mnhlsu "Kurzschluß Heizung LSU1 nach Masse" UWORD B_TRUE 1 100 0 1 BIT_MASK 0x1 FORMAT "%13.11" ECU_ADDRESS 0xFD3A /end MEASUREMENT
/begin MEASUREMENT B_mnhre "Bedingung für Fehlertyp 'Minimalwert' Hauptrelaisentstufe erkannt" UWORD B_TRUE 1 100 0 1 BIT_MASK 0x200 FORMAT "%13.11" ECU_ADDRESS 0x383984 /end MEASUREMENT
/begin MEASUREMENT B_mnld "Fehlertype: Kurzschluß nach Masse LDP-Endstufe (aktuell)" UWORD B_TRUE 1 100 0 1 BIT_MASK 0x1000 FORMAT "%13.11" ECU_ADDRESS 0xFD50 /end MEASUREMENT
/begin MEASUREMENT B_mnldpe "Fehlertype: Kurzschluß nach Masse LDP-Endstufe" UWORD B_TRUE 1 100 0 1 BIT_MASK 0x200 FORMAT "%13.11" ECU_ADDRESS 0x3839BA /end MEASUREMENT
/begin MEASUREMENT B_mnmdb "Fehlertyp min.: Momentanüberwachung begrenzt dauerhaft" UWORD B_TRUE 1 100 0 1 BIT_MASK 0x200 FORMAT "%13.11" ECU_ADDRESS 0x3839D4 /end MEASUREMENT
/begin MEASUREMENT B_mnsgeew "Fehlertyp min.:Steuergerät defekt (EEPROM-WFS)" UWORD B_TRUE 1 100 0 1 BIT_MASK 0x200 FORMAT "%13.11" ECU_ADDRESS 0x3839EC /end MEASUREMENT
/begin MEASUREMENT B_mnub "Fehlertyp: Minimalwertunterschreitung Batteriespannung (Bordnetz)" UWORD B_TRUE 1 100 0 1 BIT_MASK 0x200 FORMAT "%13.11" ECU_ADDRESS 0x383A10 /end MEASUREMENT
/begin MEASUREMENT B_mnubr "Fehlertyp: Minimalwertunterschreitung Bordnetzspannung über Hauptrelais" UWORD B_TRUE 1 100 0 1 BIT_MASK 0x200 FORMAT "%13.11" ECU_ADDRESS 0x383A12 /end MEASUREMENT
/begin MEASUREMENT B_mnwfs "Fehlertyp min.: Wegfahrsperre" UWORD B_TRUE 1 100 0 1 BIT_MASK 0x200 FORMAT "%13.11" ECU_ADDRESS 0x383A22 /end MEASUREMENT
/begin MEASUREMENT B_mnwfsrc "Fehlertyp min.: Wegfahrsperre RC-Glied" UWORD B_TRUE 1 100 0 1 BIT_MASK 0x200 FORMAT "%13.11" ECU_ADDRESS 0x383A24 /end MEASUREMENT
/begin MEASUREMENT B_mxaatun "Bedingung: Max-Fehler Tuningschutz" UWORD B_TRUE 1 100 0 1 BIT_MASK 0x100 FORMAT "%13.11" ECU_ADDRESS 0x38390A /end MEASUREMENT
/begin MEASUREMENT B_mxaok "Bedingung Fehlerpfad ldra o.k." UBYTE B_TRUE 1 100 0 1 BIT_MASK 0x8 FORMAT "%13.11" ECU_ADDRESS 0x380AF3 /end MEASUREMENT
/begin MEASUREMENT B_mxfhsh "Kurzschluß Heizung Lambdasonde hinter Kat nach UB" UBYTE B_TRUE 1 100 0 1 BIT_MASK 0x2 FORMAT "%13.11" ECU_ADDRESS 0x38482B /end MEASUREMENT
/begin MEASUREMENT B_mxhfm "Bedingung obere Plausibilitätsschwelle HFM überschritten" UWORD B_TRUE 1 100 0 1 BIT_MASK 0x800 FORMAT "%13.11" ECU_ADDRESS 0xFD54 /end MEASUREMENT
/begin MEASUREMENT B_mxhlsu "Kurzschluß Heizung LSU1 nach UB" UWORD B_TRUE 1 100 0 1 BIT_MASK 0x2 FORMAT "%13.11" ECU_ADDRESS 0xFD3A /end MEASUREMENT
/begin MEASUREMENT B_mxhre "Bedingung für Fehlertyp 'Maximalwert' Hauptrelaisentstufe erkannt" UWORD B_TRUE 1 100 0 1 BIT_MASK 0x100 FORMAT "%13.11" ECU_ADDRESS 0x383984 /end MEASUREMENT
/begin MEASUREMENT B_mxld "Fehlertype: Kurzschluß nach Ubatt Endstufe LDP (aktuell)" UWORD B_TRUE 1 100 0 1 BIT_MASK 0x2000 FORMAT "%13.11" ECU_ADDRESS 0xFD50 /end MEASUREMENT
/begin MEASUREMENT B_mxldpe "Fehlertype: Kurzschluß nach Ubatt Endstufe LDP" UWORD B_TRUE 1 100 0 1 BIT_MASK 0x100 FORMAT "%13.11" ECU_ADDRESS 0x3839BA /end MEASUREMENT
/begin MEASUREMENT B_mxmdb "Fehlerart: Maximal zulässiges Sollmoment wird dauerhaft überschritten" UWORD B_TRUE 1 100 0 1 BIT_MASK 0x100 FORMAT "%13.11" ECU_ADDRESS 0x3839D4 /end MEASUREMENT
/begin MEASUREMENT B_mxsgeew "Fehlertyp max.: Steuergerät defekt (EEPROM-WFS)" UWORD B_TRUE 1 100 0 1 BIT_MASK 0x100 FORMAT "%13.11" ECU_ADDRESS 0x3839EC /end MEASUREMENT
/begin MEASUREMENT B_mxub "Fehlertyp: Maximalwertüberschreitung Batteriespannung (Bordnetz)" UWORD B_TRUE 1 100 0 1 BIT_MASK 0x100 FORMAT "%13.11" ECU_ADDRESS 0x383A10 /end MEASUREMENT
/begin MEASUREMENT B_mxubr "Fehlertyp: Maximalwertüberschreitung Bordnetzspannung über Hauptrelais" UWORD B_TRUE 1 100 0 1 BIT_MASK 0x100 FORMAT "%13.11" ECU_ADDRESS 0x383A12 /end MEASUREMENT
/begin MEASUREMENT B_mxwfs "Fehlertyp max.: Wegfahrsperre" UWORD B_TRUE 1 100 0 1 BIT_MASK 0x100 FORMAT "%13.11" ECU_ADDRESS 0x383A22 /end MEASUREMENT
/begin MEASUREMENT B_mxwfsrc "Fehlertyp max.: Wegfahrsperre RC-Glied" UWORD B_TRUE 1 100 0 1 BIT_MASK 0x100 FORMAT "%13.11" ECU_ADDRESS 0x383A24 /end MEASUREMENT
/begin MEASUREMENT B_nodldp "Bedingung Leckdiagnose inaktiv" UBYTE B_TRUE 1 100 0 1 BIT_MASK 0x80 FORMAT "%13.11" ECU_ADDRESS 0x380BA3 /end MEASUREMENT
/begin MEASUREMENT B_nolash "Bedingung Diagnosefunktion Schwingungs-Prüfung. i.O.-Meldung beendet." UWORD B_TRUE 1 100 0 1 BIT_MASK 0x100 FORMAT "%13.11" ECU_ADDRESS 0xFD38 /end MEASUREMENT
/begin MEASUREMENT B_nolavh "Bedingung Diagnosefunktion Vollast-Prüf i.O.-Meldung" UBYTE B_TRUE 1 100 0 1 BIT_MASK 0x1 FORMAT "%13.11" ECU_ADDRESS 0x384846 /end MEASUREMENT
/begin MEASUREMENT B_norkam "Bedingung additive Korrektur der Adaption pro Zeit oder Zündung abgeschaltet" UWORD B_TRUE 1 100 0 1 BIT_MASK 0x20 FORMAT "%13.11" ECU_ADDRESS 0xFD66 /end MEASUREMENT
/begin MEASUREMENT B_npaatun "Bedingung: Tuningschutz unplausibel" UWORD B_TRUE 1 100 0 1 BIT_MASK 0x800 FORMAT "%13.11" ECU_ADDRESS 0x38390A /end MEASUREMENT
/begin MEASUREMENT B_npfhsh "Nernstwiderstand Sonde hinter Kat zu groß" UBYTE B_TRUE 1 100 0 1 BIT_MASK 0x10 FORMAT "%13.11" ECU_ADDRESS 0x38482B /end MEASUREMENT
/begin MEASUREMENT B_nphealh "Heilung von B_nphsh" UBYTE B_TRUE 1 100 0 1 BIT_MASK 0x80 FORMAT "%13.11" ECU_ADDRESS 0x38482B /end MEASUREMENT
/begin MEASUREMENT B_nphlsu "Bedingung Signal LSU1 ist unplausibel" UWORD B_TRUE 1 100 0 1 BIT_MASK 0x4 FORMAT "%13.11" ECU_ADDRESS 0xFD3A /end MEASUREMENT
/begin MEASUREMENT B_nphre "" UWORD B_TRUE 1 100 0 1 BIT_MASK 0x800 FORMAT "%13.11" ECU_ADDRESS 0x383984 /end MEASUREMENT
/begin MEASUREMENT B_npldpe "Nicht plausibler Fehler: Leckdiagnosemodul Endstufe" UWORD B_TRUE 1 100 0 1 BIT_MASK 0x800 FORMAT "%13.11" ECU_ADDRESS 0x3839BA /end MEASUREMENT
/begin MEASUREMENT B_npllash "Bedingung  ""nicht plausibler Wert"" für Sonde hinter KAT" UBYTE B_TRUE 1 100 0 1 BIT_MASK 0x4 FORMAT "%13.11" ECU_ADDRESS 0x384845 /end MEASUREMENT
/begin MEASUREMENT B_nplsusa "Bedingung Signal LSU1 ist unplausibel während B_sa" UWORD B_TRUE 1 100 0 1 BIT_MASK 0x8 FORMAT "%13.11" ECU_ADDRESS 0xFD3A /end MEASUREMENT
/begin MEASUREMENT B_npmdb "Nicht plausibler Fehler: Momentanüberwachung begrenzt dauerhaft" UWORD B_TRUE 1 100 0 1 BIT_MASK 0x800 FORMAT "%13.11" ECU_ADDRESS 0x3839D4 /end MEASUREMENT
/begin MEASUREMENT B_npsgeew "Fehlerart: Steuergerät defekt (EEPROM-WFS)" UWORD B_TRUE 1 100 0 1 BIT_MASK 0x800 FORMAT "%13.11" ECU_ADDRESS 0x3839EC /end MEASUREMENT
/begin MEASUREMENT B_npub "Fehlerart: Batteriespannungssignal nicht plausibel" UWORD B_TRUE 1 100 0 1 BIT_MASK 0x800 FORMAT "%13.11" ECU_ADDRESS 0x383A10 /end MEASUREMENT
/begin MEASUREMENT B_npubr "Fehlerart: Signal von Bordspannung über Hauptrelais nicht plausibel" UWORD B_TRUE 1 100 0 1 BIT_MASK 0x800 FORMAT "%13.11" ECU_ADDRESS 0x383A12 /end MEASUREMENT
/begin MEASUREMENT B_npwfs "Fehlerart: Wegfahrsperre" UWORD B_TRUE 1 100 0 1 BIT_MASK 0x800 FORMAT "%13.11" ECU_ADDRESS 0x383A22 /end MEASUREMENT
/begin MEASUREMENT B_npwfsrc "Fehlerart: Wegfahrsperre RC-Glied" UWORD B_TRUE 1 100 0 1 BIT_MASK 0x800 FORMAT "%13.11" ECU_ADDRESS 0x383A24 /end MEASUREMENT
/begin MEASUREMENT B_plra "Bedingung für Umschaltung DKVS von HFM- auf P-System" UWORD B_TRUE 1 100 0 1 BIT_MASK 0x40 FORMAT "%13.11" ECU_ADDRESS 0xFD66 /end MEASUREMENT
/begin MEASUREMENT B_prxf "Bedingung Prüfung Feinstleck (0.5 mm - Diagnose) aktiv" UBYTE B_TRUE 1 100 0 1 BIT_MASK 0x2 FORMAT "%13.11" ECU_ADDRESS 0x380BA3 /end MEASUREMENT
/begin MEASUREMENT B_pulsa "Pulssationserkennung  für Diagnose Schubumluftventil beim Turbo" UWORD B_TRUE 1 100 0 1 BIT_MASK 0x80 FORMAT "%13.11" ECU_ADDRESS 0xFD82 /end MEASUREMENT
/begin MEASUREMENT B_rierrh "Ri- Fehler Lambdasonde hinter Kat" UBYTE B_TRUE 1 100 0 1 BIT_MASK 0x40 FORMAT "%13.11" ECU_ADDRESS 0x38482B /end MEASUREMENT
/begin MEASUREMENT B_rkack "Bedingung Überwachung Reedkontakt auf aktiv" UBYTE B_TRUE 1 100 0 1 BIT_MASK 0x20 FORMAT "%13.11" ECU_ADDRESS 0x380BA1 /end MEASUREMENT
/begin MEASUREMENT B_rkam "Bedingung einer der beiden additiven Bereiche aktiv" UWORD B_TRUE 1 100 0 1 BIT_MASK 0x80 FORMAT "%13.11" ECU_ADDRESS 0xFD66 /end MEASUREMENT
/begin MEASUREMENT B_rkamr "Bedingung rkat oder rkaz außerhalb reduzierter Schwellen" UWORD B_TRUE 1 100 0 1 BIT_MASK 0x100 FORMAT "%13.11" ECU_ADDRESS 0xFD66 /end MEASUREMENT
/begin MEASUREMENT B_rkcke "Komponentenprüfung ist abgeschlossen" UBYTE B_TRUE 1 100 0 1 BIT_MASK 0x4 FORMAT "%13.11" ECU_ADDRESS 0x380BA2 /end MEASUREMENT
/begin MEASUREMENT B_rkzck "Bedingung Überwachung Reedkontakt zu aktiv" UBYTE B_TRUE 1 100 0 1 BIT_MASK 0x40 FORMAT "%13.11" ECU_ADDRESS 0x380BA1 /end MEASUREMENT
/begin MEASUREMENT B_sbbhkv "Bedingung Sonde betriebsbereit hinter Kat verzögert" UBYTE B_TRUE 1 100 0 1 BIT_MASK 0x10 FORMAT "%13.11" ECU_ADDRESS 0x384845 /end MEASUREMENT
/begin MEASUREMENT B_siaatun "Signalfehler Tuningschutz" UWORD B_TRUE 1 100 0 1 BIT_MASK 0x400 FORMAT "%13.11" ECU_ADDRESS 0x38390A /end MEASUREMENT
/begin MEASUREMENT B_sifhsh "Lastabfall Sondenheizung hinter Kat" UBYTE B_TRUE 1 100 0 1 BIT_MASK 0x8 FORMAT "%13.11" ECU_ADDRESS 0x38482B /end MEASUREMENT
/begin MEASUREMENT B_siglash "Bedingung Sonden-Fehler hinter KAT im Schub erkannt" UBYTE B_TRUE 1 100 0 1 BIT_MASK 0x1 FORMAT "%13.11" ECU_ADDRESS 0x384845 /end MEASUREMENT
/begin MEASUREMENT B_sihlsu "Unterbrechung im Heizstromkreis LSU1" UWORD B_TRUE 1 100 0 1 BIT_MASK 0x10 FORMAT "%13.11" ECU_ADDRESS 0xFD3A /end MEASUREMENT
/begin MEASUREMENT B_sihre "Bedingung für Fehlertyp 'Signal fehlt' Hauptrelaisentstufe erkannt" UWORD B_TRUE 1 100 0 1 BIT_MASK 0x400 FORMAT "%13.11" ECU_ADDRESS 0x383984 /end MEASUREMENT
/begin MEASUREMENT B_sild "Fehlertype: Leitungsabfall Endstufe Leckage Pumpe (aktuell)" UWORD B_TRUE 1 100 0 1 BIT_MASK 0x4000 FORMAT "%13.11" ECU_ADDRESS 0xFD50 /end MEASUREMENT
/begin MEASUREMENT B_sildpe "Fehlertype: Leitungsabfall Endstufe Leckage Pumpe" UWORD B_TRUE 1 100 0 1 BIT_MASK 0x400 FORMAT "%13.11" ECU_ADDRESS 0x3839BA /end MEASUREMENT
/begin MEASUREMENT B_simdb "Fehlertyp: Momentanüberwachung begrenzt dauerhaft" UWORD B_TRUE 1 100 0 1 BIT_MASK 0x400 FORMAT "%13.11" ECU_ADDRESS 0x3839D4 /end MEASUREMENT
/begin MEASUREMENT B_sisgeew "Fehlerart: Steuergerät defekt (EEPROM-WFS)" UWORD B_TRUE 1 100 0 1 BIT_MASK 0x400 FORMAT "%13.11" ECU_ADDRESS 0x3839EC /end MEASUREMENT
/begin MEASUREMENT B_siub "Fehlertyp: Umweltbedingungen" UWORD B_TRUE 1 100 0 1 BIT_MASK 0x400 FORMAT "%13.11" ECU_ADDRESS 0x383A10 /end MEASUREMENT
/begin MEASUREMENT B_siubr "Fehlerart: Signalfehler Leitungsabfall Bordnetzspannung über Hauptrelais" UWORD B_TRUE 1 100 0 1 BIT_MASK 0x400 FORMAT "%13.11" ECU_ADDRESS 0x383A12 /end MEASUREMENT
/begin MEASUREMENT B_siwfs "Fehlerart: Wegfahrsperre" UWORD B_TRUE 1 100 0 1 BIT_MASK 0x400 FORMAT "%13.11" ECU_ADDRESS 0x383A22 /end MEASUREMENT
/begin MEASUREMENT B_siwfsrc "Fehlerart: Wegfahrsperre RC-Glied" UWORD B_TRUE 1 100 0 1 BIT_MASK 0x400 FORMAT "%13.11" ECU_ADDRESS 0x383A24 /end MEASUREMENT
/begin MEASUREMENT B_slkvdkg "Bedingung Signale für Diagnose Leck vor Drosselklappe gültig" UBYTE B_TRUE 1 100 0 1 BIT_MASK 0x20 FORMAT "%13.11" ECU_ADDRESS 0x380AF3 /end MEASUREMENT
/begin MEASUREMENT B_slsrdy "Bedingung SLS geprüft für 'ready-Byte'" UBYTE B_TRUE 1 100 0 1 BIT_MASK 0x8 FORMAT "%13.11" ECU_ADDRESS 0x383113 /end MEASUREMENT
/begin MEASUREMENT B_steigm "Bedingung Steigung des Sondensignals messen hinter KAT" UBYTE B_TRUE 1 100 0 1 BIT_MASK 0x2 FORMAT "%13.11" ECU_ADDRESS 0x38098F /end MEASUREMENT
/begin MEASUREMENT B_szkat "Zykluszeit und Fehler in einer Bank abgelaufen" UWORD B_TRUE 1 100 0 1 BIT_MASK 0x40 FORMAT "%13.11" ECU_ADDRESS 0xFD3C /end MEASUREMENT
/begin MEASUREMENT B_sztesf "Bit für Zyklusbit-Sonderfall aus DLDP (1mm Dichterk. nach abgesp. Feinstleckf.)" UWORD B_TRUE 1 100 0 1 BIT_MASK 0x200 FORMAT "%13.11" ECU_ADDRESS 0xFDA2 /end MEASUREMENT
/begin MEASUREMENT B_tepldp "Bedingung Spülphase und prinzipielle Freigabe TEB" UBYTE B_TRUE 1 100 0 1 BIT_MASK 0x20 FORMAT "%13.11" ECU_ADDRESS 0x380BA2 /end MEASUREMENT
/begin MEASUREMENT B_teslash "Bedingung Test ausführen für Überprüfung Sonde hinter KAT" UWORD B_TRUE 1 100 0 1 BIT_MASK 0x200 FORMAT "%13.11" ECU_ADDRESS 0xFD38 /end MEASUREMENT
/begin MEASUREMENT B_tesrdy "Bedingung TES geprüft für 'ready-Byte'" UBYTE B_TRUE 1 100 0 1 BIT_MASK 0x4 FORMAT "%13.11" ECU_ADDRESS 0x383113 /end MEASUREMENT
/begin MEASUREMENT B_tevioi "Bedingung TEV durch DLDP (Initialspülung) als i.O. erkannt." UWORD B_TRUE 1 100 0 1 BIT_MASK 0x400 FORMAT "%13.11" ECU_ADDRESS 0xFDA2 /end MEASUREMENT
/begin MEASUREMENT B_teviot "Bedingung TEV durch DLDP (Abfallzeiterhöhung) als i.O. erkannt." UWORD B_TRUE 1 100 0 1 BIT_MASK 0x800 FORMAT "%13.11" ECU_ADDRESS 0xFDA2 /end MEASUREMENT
/begin MEASUREMENT B_teza "Bedingung Tankentlüftung zwangsaktiv" UWORD B_TRUE 1 100 0 1 BIT_MASK 0x1000 FORMAT "%13.11" ECU_ADDRESS 0xFDA2 /end MEASUREMENT
/begin MEASUREMENT B_tpstab "Flag Stabilitätskriteriom erfüllt" UBYTE B_TRUE 1 100 0 1 BIT_MASK 0x80 FORMAT "%13.11" ECU_ADDRESS 0x380BA2 /end MEASUREMENT
/begin MEASUREMENT B_trfash "Bedingung Kurztrip einleiten für Schwingungsprüfung Sonde hinter KAT" UWORD B_TRUE 1 100 0 1 BIT_MASK 0x400 FORMAT "%13.11" ECU_ADDRESS 0xFD38 /end MEASUREMENT
/begin MEASUREMENT B_trig "Bedingung für Umschaltung der Verstärkerstufen und Skalierung des Referenzpegels" UWORD B_TRUE 1 100 0 1 BIT_MASK 0x80 FORMAT "%13.11" ECU_ADDRESS 0xFD3C /end MEASUREMENT
/begin MEASUREMENT B_ubok "Status: Ubat-Fenster, Taupunkt hinter Kat und B_nmot" UBYTE B_TRUE 1 100 0 1 BIT_MASK 0x1 FORMAT "%13.11" ECU_ADDRESS 0x38482C /end MEASUREMENT
/begin MEASUREMENT B_uefgab "Übernahmefreigabe für Hold Counter" UWORD B_TRUE 1 100 0 1 BIT_MASK 0x100 FORMAT "%13.11" ECU_ADDRESS 0xFD82 /end MEASUREMENT
/begin MEASUREMENT B_uscherf "Bedingung Messung Sondenspannung hinter KAT für Schubmessung erfüllt" UBYTE B_TRUE 1 100 0 1 BIT_MASK 0x1 FORMAT "%13.11" ECU_ADDRESS 0x384844 /end MEASUREMENT
/begin MEASUREMENT B_ushkf "Bedingung Sondenspannung hinter Kat ""Fett"" (Sollwert überschritten)" UWORD B_TRUE 1 100 0 1 BIT_MASK 0x800 FORMAT "%13.11" ECU_ADDRESS 0xFD38 /end MEASUREMENT
/begin MEASUREMENT B_ushkm "Bedingung Sondenspannung hinter KAT ""Mager"" (Sollwert unterschritten)" UWORD B_TRUE 1 100 0 1 BIT_MASK 0x1000 FORMAT "%13.11" ECU_ADDRESS 0xFD38 /end MEASUREMENT
/begin MEASUREMENT B_ushkrfm "Bedingung für Wiederholungsmessung Schwingungspr. h. KAT (Reset F/M -Flip-Flop)" UBYTE B_TRUE 1 100 0 1 BIT_MASK 0x8 FORMAT "%13.11" ECU_ADDRESS 0x384843 /end MEASUREMENT
/begin MEASUREMENT B_ushsch "Bed. Schwelle für Sonde h. KAT im Schub nicht unterschritten `statichisch`" UBYTE B_TRUE 1 100 0 1 BIT_MASK 0x4 FORMAT "%13.11" ECU_ADDRESS 0x384A60 /end MEASUREMENT
/begin MEASUREMENT B_usrhkmx "Bedingung für fehlerhafte Sonden hinter KAT nach abgeschlossenem Test" UBYTE B_TRUE 1 100 0 1 BIT_MASK 0x10 FORMAT "%13.11" ECU_ADDRESS 0x384A60 /end MEASUREMENT
/begin MEASUREMENT B_vekat "Fehlerverdacht bei Katdiagnose" UBYTE B_TRUE 1 100 0 1 BIT_MASK 0x1 FORMAT "%13.11" ECU_ADDRESS 0x383125 /end MEASUREMENT
/begin MEASUREMENT B_xfstab "Stabilitätskriterium 0.5 mm - Diagnose erfüllt" UBYTE B_TRUE 1 100 0 1 BIT_MASK 0x1 FORMAT "%13.11" ECU_ADDRESS 0x380BA3 /end MEASUREMENT
/begin MEASUREMENT B_zkatb "Bankspezifische Zykluszeit für MODE 6" UWORD B_TRUE 1 100 0 1 BIT_MASK 0x100 FORMAT "%13.11" ECU_ADDRESS 0xFD3C /end MEASUREMENT
/begin MEASUREMENT B_zkats "Zykluszeit für eine Bank abgelaufen" UWORD B_TRUE 1 100 0 1 BIT_MASK 0x200 FORMAT "%13.11" ECU_ADDRESS 0xFD3C /end MEASUREMENT
/begin MEASUREMENT B_zkatz "Bedinging für Summenfehler im MODE 6" UWORD B_TRUE 1 100 0 1 BIT_MASK 0x400 FORMAT "%13.11" ECU_ADDRESS 0xFD3C /end MEASUREMENT
/begin MEASUREMENT B_ztes "DTEV einmal abgelaufen" UBYTE B_TRUE 1 100 0 1 BIT_MASK 0x1 FORMAT "%13.11" ECU_ADDRESS 0x383112 /end MEASUREMENT
/begin MEASUREMENT B_ztesf "Interne Bedingung Prüfung auf Feinleck abgeschlossen" UBYTE B_TRUE 1 100 0 1 BIT_MASK 0x2 FORMAT "%13.11" ECU_ADDRESS 0x383112 /end MEASUREMENT
/begin MEASUREMENT cryhs "Counter für Readinessbildung Sondenheizungs-Diagnose" UBYTE dez 1 100 0 255 FORMAT "%5.1" ECU_ADDRESS 0x38310C /end MEASUREMENT
/begin MEASUREMENT crykat "Counter für Readinessbildung Katalysator-Diagnose" UBYTE dez 1 100 0 255 FORMAT "%5.1" ECU_ADDRESS 0x38310D /end MEASUREMENT
/begin MEASUREMENT cryls "Counter für Readinessbildung Lambdasonden-Diagnose" UBYTE dez 1 100 0 255 FORMAT "%5.1" ECU_ADDRESS 0x38310E /end MEASUREMENT
/begin MEASUREMENT crysls "Counter für Readinessbildung Sekundärluft-Diagnose" UBYTE dez 1 100 0 255 FORMAT "%5.1" ECU_ADDRESS 0x38310F /end MEASUREMENT
/begin MEASUREMENT crytes "Counter für Readinessbildung Tankentlüftungs-Diagnose" UBYTE dez 1 100 0 255 FORMAT "%5.1" ECU_ADDRESS 0x383110 /end MEASUREMENT
/begin MEASUREMENT ctr_fein "Zähler für erkannte Feinlecks (>= 1.0 mm)" UBYTE dez 1 100 0 255 FORMAT "%5.1" ECU_ADDRESS 0x383250 /end MEASUREMENT
/begin MEASUREMENT ctr_feinst "Zähler für erkannte Feinstlecks (>= 0.5 mm)" UBYTE dez 1 100 0 255 FORMAT "%5.1" ECU_ADDRESS 0x383251 /end MEASUREMENT
/begin MEASUREMENT dkatakt_w "aktive Überwachungszeit für DKAT" UWORD t50msxs_uw_b3276p75 1 100 0 3276.75 FORMAT "%8.3" ECU_ADDRESS 0x381BBA /end MEASUREMENT
/begin MEASUREMENT dkractr "Zündungszähler für Diagnose Klopfregelanschlag" UWORD dez 1 100 0 65535 FORMAT "%8.2" ECU_ADDRESS 0x3822F8 /end MEASUREMENT
/begin MEASUREMENT DKVSbits "" UBYTE dez 1 100 0 255 FORMAT "%5.1" ECU_ADDRESS 0x383137 /end MEASUREMENT
/begin MEASUREMENT dlams_w "Maximalwert Lambdasoll für Test Schwingungsprüfung hinter KAT" UWORD fak_uw_b16 1 100 0 15.9998 FORMAT "%8.5" ECU_ADDRESS 0x384A54 /end MEASUREMENT
/begin MEASUREMENT DLDPlokbits1 "" UBYTE dez 1 100 0 255 FORMAT "%5.1" ECU_ADDRESS 0x380BA0 /end MEASUREMENT
/begin MEASUREMENT DLDPlokbits2 "" UBYTE dez 1 100 0 255 FORMAT "%5.1" ECU_ADDRESS 0x380BA1 /end MEASUREMENT
/begin MEASUREMENT DLDPlokbits3 "" UBYTE dez 1 100 0 255 FORMAT "%5.1" ECU_ADDRESS 0x380BA2 /end MEASUREMENT
/begin MEASUREMENT DLDPlokbits4 "" UBYTE dez 1 100 0 255 FORMAT "%5.1" ECU_ADDRESS 0x380BA3 /end MEASUREMENT
/begin MEASUREMENT dldrAusBits "" UBYTE dez 1 100 0 255 FORMAT "%5.1" ECU_ADDRESS 0x380AF2 /end MEASUREMENT
/begin MEASUREMENT dldrLokBits "" UBYTE dez 1 100 0 255 FORMAT "%5.1" ECU_ADDRESS 0x380AF3 /end MEASUREMENT
/begin MEASUREMENT dmrdkt_w "Momenten-Reserve für Katalysatordiagnose" UWORD rel_uw_b100 1 100 0 99.9985 FORMAT "%8.5" ECU_ADDRESS 0x384A6E /end MEASUREMENT
/begin MEASUREMENT dmrlash_w "Momenten-Reserve für Lambdasonden-Alterungsüberwachung hinter Kat" UWORD rel_uw_b100 1 100 0 99.9985 FORMAT "%8.5" ECU_ADDRESS 0x384A56 /end MEASUREMENT
/begin MEASUREMENT dplsplsdn "Differenz Solladedruck-minimaler Solladedruck für die Diagnose" SBYTE p_sb_q10 1 100 -1280 1270 FORMAT "%5.0" ECU_ADDRESS 0x3848DD /end MEASUREMENT
/begin MEASUREMENT dpu_w "Druckdifferenz Umgebungsdruck - Saugrohrdruck" SWORD p_uw_q0p078 1 100 -2560 2559.92 FORMAT "%8.3" ECU_ADDRESS 0x382B5A /end MEASUREMENT
/begin MEASUREMENT drlldp_w "Last-Differenz für 0.5 mm - Diagnose" SWORD rel_sw_q0p0234 1 100 -768 767.977 FORMAT "%8.4" ECU_ADDRESS 0x382B5C /end MEASUREMENT
/begin MEASUREMENT dtmast "Motortemperaturänderung zwischen letztem Abstellen und aktuellem Start" UBYTE temp_sb_q0p75 1 100 0 191.25 FORMAT "%5.1" ECU_ADDRESS 0x384911 /end MEASUREMENT
/begin MEASUREMENT dvbab "Fahrzeuggeschwindigkeitsdifferenzbei Bergaberkennung" SBYTE vfzg_ub_q1p25 1 100 -160 158.75 FORMAT "%5.1" ECU_ADDRESS 0x384912 /end MEASUREMENT
/begin MEASUREMENT ebCtrNewT "ETK bypass counter new, channel T" UBYTE default 1 100 0 255 FORMAT "%5.1" ECU_ADDRESS 0x38095E /end MEASUREMENT
/begin MEASUREMENT ebCtrNewY "ETK bypass counter new, channel Y" UBYTE default 1 100 0 255 FORMAT "%5.1" ECU_ADDRESS 0x38095F /end MEASUREMENT
/begin MEASUREMENT ebCtrOldT "ETK bypass counter old, channel T" UBYTE default 1 100 0 255 FORMAT "%5.1" ECU_ADDRESS 0x380960 /end MEASUREMENT
/begin MEASUREMENT ebCtrOldY "ETK bypass counter old, channel Y" UBYTE default 1 100 0 255 FORMAT "%5.1" ECU_ADDRESS 0x380961 /end MEASUREMENT
/begin MEASUREMENT ebMissT "ETK bypass counter misses, channel T" UWORD default 1 100 0 65535 FORMAT "%8.2" ECU_ADDRESS 0x3819E6 /end MEASUREMENT
/begin MEASUREMENT ebMissY "ETK bypass counter misses, channel Y" UWORD default 1 100 0 65535 FORMAT "%8.2" ECU_ADDRESS 0x3819E8 /end MEASUREMENT
/begin MEASUREMENT esst_svf06d_ub "" UWORD dez 1 100 0 65535 FORMAT "%8.2" ECU_ADDRESS 0x38539C /end MEASUREMENT
/begin MEASUREMENT evsup1 "Funktionskennungsbyte für Ausgabe SAE J1979 Mode2" UBYTE dez 1 100 0 255 FORMAT "%5.1" ECU_ADDRESS 0x383111 /end MEASUREMENT
/begin MEASUREMENT E_aatun "Errorflag: Tuningschutz" UWORD B_TRUE 1 100 0 1 BIT_MASK 0x1 FORMAT "%13.11" ECU_ADDRESS 0x38390A /end MEASUREMENT
/begin MEASUREMENT E_hre "Errorflag: Hauptrelaisentstufe" UWORD B_TRUE 1 100 0 1 BIT_MASK 0x1 FORMAT "%13.11" ECU_ADDRESS 0x383984 /end MEASUREMENT
/begin MEASUREMENT E_ldpe "Errorflag: Leckdiagnosepumpe Endstufe" UWORD B_TRUE 1 100 0 1 BIT_MASK 0x1 FORMAT "%13.11" ECU_ADDRESS 0x3839BA /end MEASUREMENT
/begin MEASUREMENT E_mdb "Errorflag: Momentenüberwachung begrenzt dauerhaft" UWORD B_TRUE 1 100 0 1 BIT_MASK 0x1 FORMAT "%13.11" ECU_ADDRESS 0x3839D4 /end MEASUREMENT
/begin MEASUREMENT E_sgeew "Errorflag: Steuergerät defekt (EEPROM - WFS)" UWORD B_TRUE 1 100 0 1 BIT_MASK 0x1 FORMAT "%13.11" ECU_ADDRESS 0x3839EC /end MEASUREMENT
/begin MEASUREMENT E_ub "Errorflag: UB" UWORD B_TRUE 1 100 0 1 BIT_MASK 0x1 FORMAT "%13.11" ECU_ADDRESS 0x383A10 /end MEASUREMENT
/begin MEASUREMENT E_ubr "Errorflag: Bordnetzspannung über Hauptrelais UBR" UWORD B_TRUE 1 100 0 1 BIT_MASK 0x1 FORMAT "%13.11" ECU_ADDRESS 0x383A12 /end MEASUREMENT
/begin MEASUREMENT E_wfs "Errorflag: Wegfahrsperre" UWORD B_TRUE 1 100 0 1 BIT_MASK 0x1 FORMAT "%13.11" ECU_ADDRESS 0x383A22 /end MEASUREMENT
/begin MEASUREMENT E_wfsrc "Errorflag: Wegfahrsperre RC-Glied" UWORD B_TRUE 1 100 0 1 BIT_MASK 0x1 FORMAT "%13.11" ECU_ADDRESS 0x383A24 /end MEASUREMENT
/begin MEASUREMENT flgdimc "" UBYTE dez 1 100 0 255 FORMAT "%5.1" ECU_ADDRESS 0x383112 /end MEASUREMENT
/begin MEASUREMENT flgdkatlrs "" UBYTE dez 1 100 0 255 FORMAT "%5.1" ECU_ADDRESS 0x383125 /end MEASUREMENT
/begin MEASUREMENT flgxfb "" UWORD dez 1 100 0 65535 FORMAT "%8.2" ECU_ADDRESS 0x382B5E /end MEASUREMENT
/begin MEASUREMENT flmxctr "Zähler Zündfolge bei erkanntem Klopfregelanschlag" UWORD dez 1 100 0 65535 FORMAT "%8.2" ARRAY_SIZE 8 ECU_ADDRESS 0x3822FA /end MEASUREMENT
/begin MEASUREMENT fppcnt "Zähler Pumpphasen bei Fast Pulse" UBYTE dez 1 100 0 255 FORMAT "%5.1" ECU_ADDRESS 0x380BA4 /end MEASUREMENT
/begin MEASUREMENT fpper "Aktuelle Periodendauer Fast Pulse" UBYTE t10msxs_ub_b2p55 1 100 0 2.55 FORMAT "%5.3" ECU_ADDRESS 0x380BA5 /end MEASUREMENT
/begin MEASUREMENT fpuls "Pulsdauer für Fast Pulse" UWORD t10msxs_uw_b655p35 1 100 0 655.35 FORMAT "%8.4" ECU_ADDRESS 0x382B60 /end MEASUREMENT
/begin MEASUREMENT frauzs_w "multiplikativer Gemischadaptionsfaktor unterer mult. Bereich (alter Wert)" UWORD fak_uw_b2 1 100 0 1.99997 FORMAT "%8.6" ECU_ADDRESS 0x384B5E /end MEASUREMENT
/begin MEASUREMENT fvdldp "" UWORD dez 1 100 0 65535 FORMAT "%8.2" ECU_ADDRESS 0x382B62 /end MEASUREMENT
/begin MEASUREMENT fwmlhfm "gewichteter MLHFMMN in Abhängigkeit von Faktor Höhe" UWORD m_q0p1 1 100 0 6553.5 FORMAT "%8.3" ECU_ADDRESS 0x384AA0 /end MEASUREMENT
/begin MEASUREMENT imlkvszs_w "Zwischenspeicher: Luftmasse nach Auftreten eines DKVS Fehles bei leerem Tank" UWORD m_q0p00355 1 100 0 233.013 FORMAT "%8.4" ECU_ADDRESS 0x384038 /end MEASUREMENT
/begin MEASUREMENT imlkvs_w "Luftmasse nach Auftreten eines DKVS Fehles bei leerem Tank" UWORD m_q0p00355 1 100 0 233.013 FORMAT "%8.4" ECU_ADDRESS 0x384B60 /end MEASUREMENT
/begin MEASUREMENT imsteldp "Luftmassenintegrator bei Initial- u. Fortsetzungsspülung" UBYTE m_ub_q0p0444 1 100 0 11.322 FORMAT "%5.2" ECU_ADDRESS 0x380BA6 /end MEASUREMENT
/begin MEASUREMENT intlash_w "Integrator (Rampe) für Lambdasoll Test Schwingungsprüfung h. KAT" UWORD fak_uw_b16 1 100 0 15.9998 FORMAT "%8.5" ECU_ADDRESS 0x384A58 /end MEASUREMENT
/begin MEASUREMENT kakbmt "Korrekturwert der berechneten Kat-Amplitude abhängig von Luftmasse und Kat.-Temp" UBYTE fak_ub_b2 1 100 0 1.99219 FORMAT "%5.3" ECU_ADDRESS 0x38484B /end MEASUREMENT
/begin MEASUREMENT katbf "Signal nach Speicher normiert vergleichbar mit ushk" UBYTE spg_ub_q0p0052_o0p2 1 100 -0.2 1.13 FORMAT "%5.3" ECU_ADDRESS 0x38099B /end MEASUREMENT
/begin MEASUREMENT katbfi_w "Sauerstoff-Anteil vor dem Speicher (Kat-Modell)" SWORD freq_sw_b512 1 100 -512 511.984 FORMAT "%8.4" ECU_ADDRESS 0x381BBC /end MEASUREMENT
/begin MEASUREMENT katbfs "Signal nach Speicher (Kat-Modell)" SBYTE fak_sb_b1 1 100 -1 0.992188 FORMAT "%5.3" ECU_ADDRESS 0x38099C /end MEASUREMENT
/begin MEASUREMENT katbftp "Signal nach Speicher normiert, tiefpaßgefiltert" UBYTE spg_ub_q0p0052 1 100 0 1.33 FORMAT "%5.3" ECU_ADDRESS 0x38099D /end MEASUREMENT
/begin MEASUREMENT katbshd_w "Signal für Fett-Verschiebung des Modells" SWORD mgrad_sw_b28p44 1 100 -28.4444 28.4436 FORMAT "%8.5" ECU_ADDRESS 0x381BBE /end MEASUREMENT
/begin MEASUREMENT kbdkt_w "Katbelastungssignal" SWORD mgrad_sw_b28p44 1 100 -28.4444 28.4436 FORMAT "%8.5" ECU_ADDRESS 0x381BC0 /end MEASUREMENT
/begin MEASUREMENT lamlash_w "Lambdasoll für Test Schwingungsprüfung hinter KAT" UWORD fak_uw_b16 1 100 0 15.9998 FORMAT "%8.5" ECU_ADDRESS 0x384A5A /end MEASUREMENT
/begin MEASUREMENT lamtrip_w "gespeicherte Lambdaabweichung aus lamsbg_w für Sonde hinter KAT" UWORD fak_uw_b16 1 100 0 15.9998 FORMAT "%8.5" ECU_ADDRESS 0x384A5C /end MEASUREMENT
/begin MEASUREMENT ldeldrae_w "Zeit für die LDELDRA-Berechnung enabled war" UWORD t_q0p05 1 100 0 3276.75 FORMAT "%8.3" ECU_ADDRESS 0x384C36 /end MEASUREMENT
/begin MEASUREMENT ldeo "obere Schwelle für Regelabweichung lde zur Auslösung Überladefehler" UBYTE p_ub_q5 1 100 0 1275 FORMAT "%5.0" ECU_ADDRESS 0x3848DE /end MEASUREMENT
/begin MEASUREMENT ldeukm_w "gemittelte LDR-Regelabweichung (Sollwert - Istwert) unkorrigiert" SWORD p_sw_q0p039 1 100 -1280 1279.96 FORMAT "%8.3" ECU_ADDRESS 0x38404C /end MEASUREMENT
/begin MEASUREMENT ldeuk_w "LDR-Regelabweichung (Sollwert - Istwert) unkorrigiert" SWORD p_sw_q0p039 1 100 -1279.96 1279.96 FORMAT "%8.3" ECU_ADDRESS 0x384C38 /end MEASUREMENT
/begin MEASUREMENT mldmn_w "minimale Luftmasse aus Kennfeld KFMLDMN" SWORD m_q0p1 1 100 -3276.8 3276.7 FORMAT "%8.3" ECU_ADDRESS 0x384AA2 /end MEASUREMENT
/begin MEASUREMENT mldmx_w "maximale Luftmasse aus Kennfeld KFMLDMX" UWORD m_q0p1 1 100 0 6553.5 FORMAT "%8.3" ECU_ADDRESS 0x384AA4 /end MEASUREMENT
/begin MEASUREMENT mldyn_w "Luftmassenintegral im Schubbetrieb für Sonde hinter Kat" UWORD m_q0p00277 1 100 0 182.042 FORMAT "%8.4" ECU_ADDRESS 0x384A5E /end MEASUREMENT
/begin MEASUREMENT mlhfmf_w "gefilterter Luftmassen HFM-Mittelwert 16Bit-Wert" UWORD m_q0p1 1 100 0 6553.5 FORMAT "%8.3" ECU_ADDRESS 0x381E54 /end MEASUREMENT
/begin MEASUREMENT modeldp "" UBYTE dez 1 100 0 255 FORMAT "%5.1" ECU_ADDRESS 0x380BA7 /end MEASUREMENT
/begin MEASUREMENT modeldp_old "" UBYTE dez 1 100 0 255 FORMAT "%5.1" ECU_ADDRESS 0x380BA8 /end MEASUREMENT
/begin MEASUREMENT phlsnhf "normierte Heizleistung der Lambdasonde hinter Kat, gefiltert" UBYTE fak_ub_q0p01 1 100 0 2.55 FORMAT "%5.3" ECU_ADDRESS 0x38482D /end MEASUREMENT
/begin MEASUREMENT pspvdsmx "Ausgangswert von Kennfeld KFVPDKLD (maximales zulässiges Druckverhältnis pspvds)" UBYTE fak_ub_b4 1 100 0 3.98438 FORMAT "%5.3" ECU_ADDRESS 0x3848DF /end MEASUREMENT
/begin MEASUREMENT pulsct "Pulssationscounter  für Diagnose Schubumluftventil beim Turbo" UBYTE dez 1 100 0 255 FORMAT "%5.1" ECU_ADDRESS 0xF9F0 /end MEASUREMENT
/begin MEASUREMENT pulscthld "Pulssationscounter sample and hold  für Diagnose Schubumluftventil beim Turbo" UBYTE dez 1 100 0 255 FORMAT "%5.1" ECU_ADDRESS 0xF9F1 /end MEASUREMENT
/begin MEASUREMENT pumem_w "Korrigierter Umgebungsdruck zu Beginn der Pump-Phase" UWORD p_uw_q0p039 1 100 0 2559.96 FORMAT "%8.3" ECU_ADDRESS 0x382B64 /end MEASUREMENT
/begin MEASUREMENT ready "readiness-Byte für Ausgabe SAE J1979 Mode2" UBYTE dez 1 100 0 255 FORMAT "%5.1" ECU_ADDRESS 0x383113 /end MEASUREMENT
/begin MEASUREMENT rinkfh "Innenwiderstand Nernstzelle der Lambdasonde aus Kennfeld vor Kat" UBYTE r_q8 1 100 0 2040 FORMAT "%5.0" ECU_ADDRESS 0x38482E /end MEASUREMENT
/begin MEASUREMENT rinsh_w "Grenzwert Innenwiderstand Nernstzelle der Lambdasonde hinter Kat" UWORD r_uw_q2 1 100 0 131070 FORMAT "%8.1" ECU_ADDRESS 0x384A38 /end MEASUREMENT
/begin MEASUREMENT rkamzs_w "additive Gemischkorrektur (pro Zeit oder Zündung); alter Wert" SWORD rel_sw_b1536 1 100 -1536 1535.95 FORMAT "%8.3" ECU_ADDRESS 0x384B62 /end MEASUREMENT
/begin MEASUREMENT rkam_w "Auswahl additive Gemischkorrektur der Gemischadaption für Bestimmung B_gae" SWORD rel_sw_b1536 1 100 -1536 1535.95 FORMAT "%8.3" ECU_ADDRESS 0x384B64 /end MEASUREMENT
/begin MEASUREMENT rkrn_w "normierter Referenzpegel Klopfregelung" UWORD spg_uw_b1280 1 100 0 1279.98 FORMAT "%8.3" ARRAY_SIZE 8 ECU_ADDRESS 0x384BDE /end MEASUREMENT
/begin MEASUREMENT rlbab "Aktuelle RL-Schwelle bei Bergaberkennung" UBYTE rel_ub_q0p75 1 100 0 191.25 FORMAT "%5.1" ECU_ADDRESS 0x384913 /end MEASUREMENT
/begin MEASUREMENT rlbabxf "Aktuelle RL-Schwelle bei Bergaberkennung (0.5 mm - Diagnose)" UBYTE rel_ub_q0p75 1 100 0 191.25 FORMAT "%5.1" ECU_ADDRESS 0x384914 /end MEASUREMENT
/begin MEASUREMENT rldkthp "Hochpaßgefiltertes rl-Signal" SBYTE rel_sb_q0p75 1 100 -96 95.25 FORMAT "%5.2" ECU_ADDRESS 0x38099E /end MEASUREMENT
/begin MEASUREMENT rlf "Tiefpaßgefiltertes RL bei Bergaberkennung" UBYTE rel_ub_q0p75 1 100 0 191.25 FORMAT "%5.1" ECU_ADDRESS 0x384915 /end MEASUREMENT
/begin MEASUREMENT rsmcnt "Zähler Wiederholversuche nach Unterbrechung bei erkanntem Leck" UBYTE dez 1 100 0 255 FORMAT "%5.1" ECU_ADDRESS 0x380BA9 /end MEASUREMENT
/begin MEASUREMENT rsmcntd "Zähler Wiederholungen 1mm-Dichtprüfungen" UBYTE dez 1 100 0 255 FORMAT "%5.1" ECU_ADDRESS 0x380BAA /end MEASUREMENT
/begin MEASUREMENT rsmcntg "Zähler Wiederholversuche nach Unterbrechung insgesamt" UBYTE dez 1 100 0 255 FORMAT "%5.1" ECU_ADDRESS 0x380BAB /end MEASUREMENT
/begin MEASUREMENT sfpaatun "Status Fehlerpfad: Tuningschutz" UWORD default 1 100 0 65535 FORMAT "%8.2" ECU_ADDRESS 0x38390A /end MEASUREMENT
/begin MEASUREMENT sfphre "" UWORD default 1 100 0 65535 FORMAT "%8.2" ECU_ADDRESS 0x383984 /end MEASUREMENT
/begin MEASUREMENT sfpldpe "Status Fehlerpfad: Leckdiagnosepumpe - Endstufe" UWORD dez 1 100 0 65535 FORMAT "%8.2" ECU_ADDRESS 0x3839BA /end MEASUREMENT
/begin MEASUREMENT sfpmdb "Status Fehlerpfad: Momentanüberwachung begrenzt dauerhaft" UWORD dez 1 100 0 65535 FORMAT "%8.2" ECU_ADDRESS 0x3839D4 /end MEASUREMENT
/begin MEASUREMENT sfpsgeew "Status Fehlerpfad: Steuergerät defekt (EEPROM WFS)" UWORD dez 1 100 0 65535 FORMAT "%8.2" ECU_ADDRESS 0x3839EC /end MEASUREMENT
/begin MEASUREMENT sfpub "Status Fehlerpfad: Batteriespannung UB (Bordnetz)" UWORD dez 1 100 0 65535 FORMAT "%8.2" ECU_ADDRESS 0x383A10 /end MEASUREMENT
/begin MEASUREMENT sfpubr "Status Fehlerpfad: Bordnetzspannung über Hauptrelais UBR" UWORD dez 1 100 0 65535 FORMAT "%8.2" ECU_ADDRESS 0x383A12 /end MEASUREMENT
/begin MEASUREMENT sfpwfs "Status Fehlerpfad: Wegfahrsperre" UWORD dez 1 100 0 65535 FORMAT "%8.2" ECU_ADDRESS 0x383A22 /end MEASUREMENT
/begin MEASUREMENT sfpwfsrc "Status Fehlerpfad: Wegfahrsperre RC-Glied" UWORD dez 1 100 0 65535 FORMAT "%8.2" ECU_ADDRESS 0x383A24 /end MEASUREMENT
/begin MEASUREMENT stptr "Zustandspointer der DLDP" UBYTE dez 1 100 0 255 FORMAT "%5.1" ECU_ADDRESS 0x380BAC /end MEASUREMENT
/begin MEASUREMENT tahsomf_w "gefilterte Abgastemperatur an Sonde hinter Kat aus Modell" UWORD temp_q0p0234_o273 1 100 -273.15 1262.83 FORMAT "%8.3" ECU_ADDRESS 0x384A3A /end MEASUREMENT
/begin MEASUREMENT taldpst "Ansaugluft-Temperatur bei Start" UBYTE temp_ub_q0p75_o48 1 100 -48 143.25 FORMAT "%5.1" ECU_ADDRESS 0x384916 /end MEASUREMENT
/begin MEASUREMENT talsuf_w "gefilterte Abgastemperatur aus Modell" UWORD temp_q0p0234_o273 1 100 -273.15 1262.83 FORMAT "%8.3" ECU_ADDRESS 0x384A62 /end MEASUREMENT
/begin MEASUREMENT tc6kata "Anzahl der Ausgabe-Codes SCAN-Tool Mode6 aus Kat-Diagnose" UBYTE dez 1 100 0 255 FORMAT "%5.1" ECU_ADDRESS 0x383126 /end MEASUREMENT
/begin MEASUREMENT tc6katc "Ausgabe-Code SCAN-Tool Mode 6 aus KAT-Diagnose" UBYTE dez 1 100 0 255 FORMAT "%5.1" ECU_ADDRESS 0x383127 /end MEASUREMENT
/begin MEASUREMENT tc6kats "Ausgabe Schwellwert SCAN-Tool Mode 6 aus KAT-Diagnose" UBYTE dez 1 100 0 255 FORMAT "%5.1" ECU_ADDRESS 0x383128 /end MEASUREMENT
/begin MEASUREMENT tc6katw "Ausgabe Prüfwert SCAN-Tool Mode 6 aus KAT-Diagnose" UBYTE dez 1 100 0 255 FORMAT "%5.1" ECU_ADDRESS 0x383129 /end MEASUREMENT
/begin MEASUREMENT tc6ldpc "Ausgabe Code SCAN-Tool Mode 6 aus LDP-Diagnose" UBYTE dez 1 100 0 255 FORMAT "%5.1" ECU_ADDRESS 0x384017 /end MEASUREMENT
/begin MEASUREMENT tc6ldps "Ausgabe Schwellwert SCAN-Tool Mode 6 aus LDP-Diagnose" UWORD dez 1 100 0 65535 FORMAT "%8.2" ECU_ADDRESS 0x384076 /end MEASUREMENT
/begin MEASUREMENT tc6ldpw "Ausgabe Prüfwert SCAN-Tool Mode 6 aus LDP-Diagnose" UWORD dez 1 100 0 65535 FORMAT "%8.2" ECU_ADDRESS 0x384078 /end MEASUREMENT
/begin MEASUREMENT tdaufp "Bereitstellung Zeitdauer Fast Pulse" UWORD t10msxs_uw_b655p35 1 100 0 655.35 FORMAT "%8.4" ECU_ADDRESS 0x382B66 /end MEASUREMENT
/begin MEASUREMENT tfpg "Timer Fast Pulse Gesamtdauer" UBYTE t1sxs_ub_b255 1 100 0 255 FORMAT "%5.1" ECU_ADDRESS 0x380BAD /end MEASUREMENT
/begin MEASUREMENT timaldp "" UWORD t10msxs_uw_b655p35 1 100 0 655.35 FORMAT "%8.4" ECU_ADDRESS 0x382B68 /end MEASUREMENT
/begin MEASUREMENT timfp "Timer für Zeitdauer Fast Pulse" UWORD t10msxs_uw_b655p35 1 100 0 655.35 FORMAT "%8.4" ECU_ADDRESS 0x382B6A /end MEASUREMENT
/begin MEASUREMENT timldp "Timer für maximale Diagnosezeit DLDP" UWORD t1sxs_uw_b65535 1 100 0 65535 FORMAT "%8.2" ECU_ADDRESS 0x38539E /end MEASUREMENT
/begin MEASUREMENT timrs "Timer für Reed-Switch Closed Check" UWORD t10msxs_uw_b655p35 1 100 0 655.35 FORMAT "%8.4" ECU_ADDRESS 0x382B6C /end MEASUREMENT
/begin MEASUREMENT timtev "" UWORD t10msxs_uw_b655p35 1 100 0 655.35 FORMAT "%8.4" ECU_ADDRESS 0x382B6E /end MEASUREMENT
/begin MEASUREMENT timzldp "" UWORD t10msxs_uw_b655p35 1 100 0 655.35 FORMAT "%8.4" ECU_ADDRESS 0x382B70 /end MEASUREMENT
/begin MEASUREMENT tispldpx_w "Schwelle für Zeit für Initialspülung bis LDP-Membran abgefallen ist" UWORD dez 1 100 0 65535 FORMAT "%8.2" ECU_ADDRESS 0x3853A0 /end MEASUREMENT
/begin MEASUREMENT tispldp_w "Zeit für Initialspülung bis LDP-Membran abgefallen ist" UWORD dez 1 100 0 65535 FORMAT "%8.2" ECU_ADDRESS 0x3853A2 /end MEASUREMENT
/begin MEASUREMENT tispuel "" UBYTE t1sxs_ub_b255 1 100 0 255 FORMAT "%5.1" ECU_ADDRESS 0x384917 /end MEASUREMENT
/begin MEASUREMENT tkdkte "Eingangstemperatur für Katalysator-Diagnose" UBYTE temp_ub_q5_o50 1 100 -50 1225 FORMAT "%5.0" ECU_ADDRESS 0x38484C /end MEASUREMENT
/begin MEASUREMENT tkdkth "hochpaßgefilterte Katalysator-Temperatur nach Halteglied" UBYTE temp_ub_q5 1 100 0 1275 FORMAT "%5.0" ECU_ADDRESS 0x38099F /end MEASUREMENT
/begin MEASUREMENT tkdkthp "hochpaßgefilterte Katalysator-Temperatur" UBYTE temp_ub_q5 1 100 0 1275 FORMAT "%5.0" ECU_ADDRESS 0x38484D /end MEASUREMENT
/begin MEASUREMENT tldktim "Timer Überwachungszeit Überschreitung der tL-/wdkbl- Schwelle" UWORD t10msxs_uw_b655p35 1 100 0 655.35 FORMAT "%8.4" ECU_ADDRESS 0x382B72 /end MEASUREMENT
/begin MEASUREMENT tldpein "" UWORD t10msxs_uw_b655p35 1 100 0 655.35 FORMAT "%8.4" ECU_ADDRESS 0x382B74 /end MEASUREMENT
/begin MEASUREMENT tldppmw "Gleitender Mittelwert Periodendauer bei Leckdiagnose" UWORD t10msxs_uw_b655p35 1 100 0 655.35 FORMAT "%8.4" ECU_ADDRESS 0x382B76 /end MEASUREMENT
/begin MEASUREMENT tpfifo "FIFO-Speicher für Periodendauer" UWORD t10msxs_uw_b655p35 1 100 0 655.35 FORMAT "%8.4" ARRAY_SIZE 4 ECU_ADDRESS 0x382B78 /end MEASUREMENT
/begin MEASUREMENT tpldptcx_w "Schwelle Zeit für bis LDP-Membran abgefallen ist nachdem TEV geöffnet wurde" UWORD dez 1 100 0 65535 FORMAT "%8.2" ECU_ADDRESS 0x3853A4 /end MEASUREMENT
/begin MEASUREMENT tpldptc_w "Zeit für bis LDP-Membran abgefallen ist nachdem TEV geöffnet wurde" UWORD dez 1 100 0 65535 FORMAT "%8.2" ECU_ADDRESS 0x3853A6 /end MEASUREMENT
/begin MEASUREMENT tpmeanv_w "Mittelwert der Periodendauern" UWORD t10msxs_uw_b655p35 1 100 0 655.35 FORMAT "%8.4" ECU_ADDRESS 0x382B80 /end MEASUREMENT
/begin MEASUREMENT trklow "Timer zur Überwachung Reedkontakt öffnet während Fast Pulse" UWORD t10msxs_uw_b655p35 1 100 0 655.35 FORMAT "%8.4" ECU_ADDRESS 0x382B82 /end MEASUREMENT
/begin MEASUREMENT tvfzctr "" UBYTE t100msxs_ub_b25p5 1 100 0 25.5 FORMAT "%5.2" ECU_ADDRESS 0x384918 /end MEASUREMENT
/begin MEASUREMENT twdkttk_w "Temperaturabhängige Wartezeit" UWORD t50msxs_uw_b3276p75 1 100 0 3276.75 FORMAT "%8.3" ECU_ADDRESS 0x384A70 /end MEASUREMENT
/begin MEASUREMENT TYP_AATUN "" UWORD B_TRUE 1 100 0 1 BIT_MASK 0xf00 FORMAT "%13.11" ECU_ADDRESS 0x38390A /end MEASUREMENT
/begin MEASUREMENT TYP_hre "" UWORD B_TRUE 1 100 0 1 BIT_MASK 0xf00 FORMAT "%13.11" ECU_ADDRESS 0x383984 /end MEASUREMENT
/begin MEASUREMENT TYP_ldpe "" UWORD B_TRUE 1 100 0 1 BIT_MASK 0xf00 FORMAT "%13.11" ECU_ADDRESS 0x3839BA /end MEASUREMENT
/begin MEASUREMENT TYP_mdb "Fehlertyp: Momentenbegrenzung (begrenzt dauerhaft) aktiv" UWORD B_TRUE 1 100 0 1 BIT_MASK 0xf00 FORMAT "%13.11" ECU_ADDRESS 0x3839D4 /end MEASUREMENT
/begin MEASUREMENT TYP_sgeew "" UWORD B_TRUE 1 100 0 1 BIT_MASK 0xf00 FORMAT "%13.11" ECU_ADDRESS 0x3839EC /end MEASUREMENT
/begin MEASUREMENT TYP_ub "" UWORD B_TRUE 1 100 0 1 BIT_MASK 0xf00 FORMAT "%13.11" ECU_ADDRESS 0x383A10 /end MEASUREMENT
/begin MEASUREMENT TYP_ubr "" UWORD B_TRUE 1 100 0 1 BIT_MASK 0xf00 FORMAT "%13.11" ECU_ADDRESS 0x383A12 /end MEASUREMENT
/begin MEASUREMENT TYP_wfs "" UWORD B_TRUE 1 100 0 1 BIT_MASK 0xf00 FORMAT "%13.11" ECU_ADDRESS 0x383A22 /end MEASUREMENT
/begin MEASUREMENT TYP_wfsrc "" UWORD B_TRUE 1 100 0 1 BIT_MASK 0xf00 FORMAT "%13.11" ECU_ADDRESS 0x383A24 /end MEASUREMENT
/begin MEASUREMENT tzlrdkt_w "Lambdaregler-Periodendauer aus Katdiagnose" UWORD t10msxs_uw_b655p35 1 100 0 655.35 FORMAT "%8.4" ECU_ADDRESS 0x381BC2 /end MEASUREMENT
/begin MEASUREMENT udksnoa_w "KS-Diagnose: Aktueller Wert obere Schwelle (UDKSNO)" UWORD spg_uw_b1280 1 100 0 1279.98 FORMAT "%8.3" ECU_ADDRESS 0x38233E /end MEASUREMENT
/begin MEASUREMENT udksnua_w "KS-Diagnose: Aktueller Wert untere Schwelle (UDKSNU)" UWORD spg_uw_b1280 1 100 0 1279.98 FORMAT "%8.3" ECU_ADDRESS 0x382340 /end MEASUREMENT
/begin MEASUREMENT urddktp "Regelspannungsdifferenz, tiefpaßgefiltert" SBYTE spg_sb_q0p01043 1 100 -1.33522 1.32478 FORMAT "%5.3" ECU_ADDRESS 0x3809A0 /end MEASUREMENT
/begin MEASUREMENT ushdktp "Spannung Lambdsonde hinter KAt, tiefpassgefiltert" UBYTE spg_ub_q0p0052 1 100 0 1.33 FORMAT "%5.3" ECU_ADDRESS 0x3809A1 /end MEASUREMENT
/begin MEASUREMENT ushfmxstg "Gefilterte maximale Steigung der Sondenspannung hinter KAT" UBYTE spgg_q0p52 1 100 0 132.6 FORMAT "%5.1" ECU_ADDRESS 0x383123 /end MEASUREMENT
/begin MEASUREMENT ushkmxstg "Maximale Steigung der Sondenspannung hinter KAT" UBYTE spgg_q0p52 1 100 0 132.6 FORMAT "%5.1" ECU_ADDRESS 0x380990 /end MEASUREMENT
/begin MEASUREMENT ushksteig "Steigung der Sondenspannung hinter KAT" UBYTE spgg_q0p52 1 100 0 132.6 FORMAT "%5.1" ECU_ADDRESS 0x380991 /end MEASUREMENT
/begin MEASUREMENT usrhkmx "maximale Regelschwelle im Fehlerfall  für Sonden-Diagnose hinter KAT" UBYTE spg_ub_q0p0052_o0p2 1 100 -0.2 1.13 FORMAT "%5.3" ECU_ADDRESS 0x384004 /end MEASUREMENT
/begin MEASUREMENT usrhks "aktueller Regel-Sollwert für Diagnose hinter KAT" UBYTE spg_ub_q0p0052_o0p2 1 100 -0.2 1.13 FORMAT "%5.3" ECU_ADDRESS 0x384847 /end MEASUREMENT
/begin MEASUREMENT wdkbadmn_w "Winkel-DK für Adressierung von KFMLDMN" SWORD relDK_q0p02441 1 100 -800 799.976 FORMAT "%8.4" ECU_ADDRESS 0x381E56 /end MEASUREMENT
/begin MEASUREMENT wdkbadmx_w "Winkel-DK für Adressierung von KFMLDMX" SWORD relDK_q0p02441 1 100 -800 799.976 FORMAT "%8.4" ECU_ADDRESS 0x381E58 /end MEASUREMENT
/begin MEASUREMENT wzcto "Zähler Wiederholversuche Close to Open Check" UBYTE dez 1 100 0 255 FORMAT "%5.1" ECU_ADDRESS 0x380BAE /end MEASUREMENT
/begin MEASUREMENT xzkrznt "Zähler Klopfregelung Zyklusflag Z_krnt" UBYTE dez 1 100 0 255 FORMAT "%5.1" ECU_ADDRESS 0x380AD9 /end MEASUREMENT
/begin MEASUREMENT xzkrzof "Zähler Klopfregelung Zyklusflag Z_krof" UBYTE dez 1 100 0 255 FORMAT "%5.1" ECU_ADDRESS 0x380ADA /end MEASUREMENT
/begin MEASUREMENT xzkrzs "Zähler für Zyklusflag Diagnose Klopfsensor" UBYTE dez 1 100 0 255 FORMAT "%5.1" ARRAY_SIZE 4 ECU_ADDRESS 0x3848CE /end MEASUREMENT
/begin MEASUREMENT xzkrztp "Zähler Klopfregelung Zyklusflag Z_krtp" UBYTE dez 1 100 0 255 FORMAT "%5.1" ECU_ADDRESS 0x380ADD /end MEASUREMENT
/begin MEASUREMENT xzsen "Entprellzähler Diagnose Klopfsensor" UBYTE dez 1 100 0 255 FORMAT "%5.1" ARRAY_SIZE 4 ECU_ADDRESS 0x3848D2 /end MEASUREMENT
/begin MEASUREMENT xzskrnt "Sicherheitszähler Klopfregelung Nulltest" UBYTE dez 1 100 0 255 FORMAT "%5.1" ECU_ADDRESS 0x380ADB /end MEASUREMENT
/begin MEASUREMENT xzskrof "Sicherheitszähler Klopfregelung Offset" UBYTE dez 1 100 0 255 FORMAT "%5.1" ECU_ADDRESS 0x380ADC /end MEASUREMENT
/begin MEASUREMENT xzskrtp "Zähler Klopfregelung Errorflag E_krtp" UBYTE dez 1 100 0 255 FORMAT "%5.1" ECU_ADDRESS 0x380ADE /end MEASUREMENT
/begin MEASUREMENT zlash_w "Zeitzähler für Sondenspannung hinter KAT ober/unterhalb des Sollwertes" UWORD t100msxs_uw_b6553p5 1 100 0 6553.5 FORMAT "%8.3" ECU_ADDRESS 0x381B56 /end MEASUREMENT
/begin MEASUREMENT zwdynsh "Zähler für Anzahl der Dynamikmessungen für Sonde hinter KAT" UBYTE dez 1 100 0 255 FORMAT "%5.1" ECU_ADDRESS 0x384848 /end MEASUREMENT
/begin MEASUREMENT Z_aatun "Zyklusflag: Tuningschutz" UWORD B_TRUE 1 100 0 1 BIT_MASK 0x2 FORMAT "%13.11" ECU_ADDRESS 0x38390A /end MEASUREMENT
/begin MEASUREMENT Z_hre "Zyklusflag: Hauptrelaisentstufe" UWORD B_TRUE 1 100 0 1 BIT_MASK 0x2 FORMAT "%13.11" ECU_ADDRESS 0x383984 /end MEASUREMENT
/begin MEASUREMENT Z_ldpe "Zyklusflag: Leckdiagnosepumpe Endstufe" UWORD B_TRUE 1 100 0 1 BIT_MASK 0x2 FORMAT "%13.11" ECU_ADDRESS 0x3839BA /end MEASUREMENT
/begin MEASUREMENT Z_mdb "Zyklusflag: Momentenbegrenzung begrenzt dauerhaft" UWORD B_TRUE 1 100 0 1 BIT_MASK 0x2 FORMAT "%13.11" ECU_ADDRESS 0x3839D4 /end MEASUREMENT
/begin MEASUREMENT Z_sgeew "Zyklusflag: Steuergerät defekt (EEPROM-WFS)" UWORD B_TRUE 1 100 0 1 BIT_MASK 0x2 FORMAT "%13.11" ECU_ADDRESS 0x3839EC /end MEASUREMENT
/begin MEASUREMENT Z_ub "Zyklusflag:	UB" UWORD B_TRUE 1 100 0 1 BIT_MASK 0x2 FORMAT "%13.11" ECU_ADDRESS 0x383A10 /end MEASUREMENT
/begin MEASUREMENT Z_ubr "Zyklusflag: Bordnetzspannung über Hauptrelais UBR" UWORD B_TRUE 1 100 0 1 BIT_MASK 0x2 FORMAT "%13.11" ECU_ADDRESS 0x383A12 /end MEASUREMENT
/begin MEASUREMENT Z_wfs "Zyklusflag: Wegfahrsperre" UWORD B_TRUE 1 100 0 1 BIT_MASK 0x2 FORMAT "%13.11" ECU_ADDRESS 0x383A22 /end MEASUREMENT
/begin MEASUREMENT Z_wfsrc "Zyklusflag: Wegfahrsperre RC-Glied" UWORD B_TRUE 1 100 0 1 BIT_MASK 0x2 FORMAT "%13.11" ECU_ADDRESS 0x383A24 /end MEASUREMENT
/begin FUNCTION DFPM_GGUB "" /begin DEF_CHARACTERISTIC CDCUB CDKUB CDTUB CLAUB FFTUB TSFUB /end DEF_CHARACTERISTIC /begin REF_CHARACTERISTIC /end REF_CHARACTERISTIC /begin IN_MEASUREMENT /end IN_MEASUREMENT
 /begin OUT_MEASUREMENT B_beub B_bkub B_club B_ftub B_mnub B_mxub B_npub B_siub E_ub sfpub TYP_ub Z_ub /end OUT_MEASUREMENT
 /begin LOC_MEASUREMENT /end LOC_MEASUREMENT
 /begin SUB_FUNCTION /end SUB_FUNCTION
/end FUNCTION
/begin FUNCTION DFPM_GGUBR "" /begin DEF_CHARACTERISTIC CDCUBR CDKUBR CDTUBR CLAUBR FFTUBR TSFUBR /end DEF_CHARACTERISTIC /begin REF_CHARACTERISTIC /end REF_CHARACTERISTIC /begin IN_MEASUREMENT /end IN_MEASUREMENT
 /begin OUT_MEASUREMENT B_beubr B_bkubr B_clubr B_ftubr B_mnubr B_mxubr B_npubr B_siubr E_ubr sfpubr TYP_ubr Z_ubr /end OUT_MEASUREMENT
 /begin LOC_MEASUREMENT /end LOC_MEASUREMENT
 /begin SUB_FUNCTION /end SUB_FUNCTION
/end FUNCTION
/begin FUNCTION DFPM_HRE "" /begin DEF_CHARACTERISTIC CDCHRE CDKHRE CDTHRE CLAHRE FFTHRE TSFHRE /end DEF_CHARACTERISTIC /begin REF_CHARACTERISTIC /end REF_CHARACTERISTIC /begin IN_MEASUREMENT /end IN_MEASUREMENT
 /begin OUT_MEASUREMENT B_behre B_bkhre B_clhre B_fthre B_mnhre B_mxhre B_nphre B_sihre E_hre sfphre TYP_hre Z_hre /end OUT_MEASUREMENT
 /begin LOC_MEASUREMENT /end LOC_MEASUREMENT
 /begin SUB_FUNCTION /end SUB_FUNCTION
/end FUNCTION
/begin FUNCTION DFPM_IMS ""
 /begin DEF_CHARACTERISTIC CDCSGEEW CDCWFS CDCWFSRC CDKSGEEW CDKWFS CDKWFSRC CDTSGEEW CDTWFS CDTWFSRC CLASGEEW CLAWFS CLAWFSRC FFTSGEEW FFTWFS FFTWFSRC TSFSGEEW TSFWFS TSFWFSRC /end DEF_CHARACTERISTIC
 /begin REF_CHARACTERISTIC /end REF_CHARACTERISTIC
 /begin IN_MEASUREMENT /end IN_MEASUREMENT
 /begin OUT_MEASUREMENT B_besgeew B_bewfs B_bewfsrc B_bksgeew B_bkwfs B_bkwfsrc B_clsgeew B_clwfs B_clwfsrc B_ftsgeew B_ftwfs B_ftwfsrc B_mnsgeew B_mnwfs B_mnwfsrc B_mxsgeew B_mxwfs B_mxwfsrc B_npsgeew B_npwfs B_npwfsrc B_sisgeew B_siwfs B_siwfsrc E_sgeew E_wfs E_wfsrc sfpsgeew sfpwfs sfpwfsrc TYP_sgeew TYP_wfs TYP_wfsrc Z_sgeew Z_wfs Z_wfsrc /end OUT_MEASUREMENT
 /begin LOC_MEASUREMENT /end LOC_MEASUREMENT
 /begin SUB_FUNCTION /end SUB_FUNCTION
/end FUNCTION
/begin FUNCTION DFPM_LDPE "" /begin DEF_CHARACTERISTIC CDCLDPE CDKLDPE CDTLDPE CLALDPE FFTLDPE TSFLDPE /end DEF_CHARACTERISTIC /begin REF_CHARACTERISTIC /end REF_CHARACTERISTIC /begin IN_MEASUREMENT /end IN_MEASUREMENT
 /begin OUT_MEASUREMENT B_beldpe B_bkldpe B_clldpe B_ftldpe B_mnldpe B_mxldpe B_npldpe B_sildpe E_ldpe sfpldpe TYP_ldpe Z_ldpe /end OUT_MEASUREMENT
 /begin LOC_MEASUREMENT /end LOC_MEASUREMENT
 /begin SUB_FUNCTION /end SUB_FUNCTION
/end FUNCTION
/begin FUNCTION DFPM_MDKOG "" /begin DEF_CHARACTERISTIC CDCMDB CDKMDB CDTMDB CLAMDB FFTMDB TSFMDB /end DEF_CHARACTERISTIC /begin REF_CHARACTERISTIC /end REF_CHARACTERISTIC /begin IN_MEASUREMENT /end IN_MEASUREMENT
 /begin OUT_MEASUREMENT B_bemdb B_bkmdb B_clmdb B_ftmdb B_mnmdb B_mxmdb B_npmdb B_simdb E_mdb sfpmdb TYP_mdb Z_mdb /end OUT_MEASUREMENT
 /begin LOC_MEASUREMENT /end LOC_MEASUREMENT
 /begin SUB_FUNCTION /end SUB_FUNCTION
/end FUNCTION
/begin FUNCTION DFPM_TUNING "" /begin DEF_CHARACTERISTIC CDCAATUN CDKAATUN CDTAATUN CLAAATUN FFTAATUN TSFAATUN /end DEF_CHARACTERISTIC /begin REF_CHARACTERISTIC /end REF_CHARACTERISTIC /begin IN_MEASUREMENT /end IN_MEASUREMENT
 /begin OUT_MEASUREMENT B_beaatun B_bkaatun B_claatun B_ftaatun B_mnaatun B_mxaatun B_npaatun B_siaatun E_aatun sfpaatun TYP_AATUN Z_aatun /end OUT_MEASUREMENT
 /begin LOC_MEASUREMENT /end LOC_MEASUREMENT
 /begin SUB_FUNCTION /end SUB_FUNCTION
/end FUNCTION
/begin FUNCTION DFRZ "20.20     OBDII; Beschreibung 'freeze frame'" /begin DEF_CHARACTERISTIC /end DEF_CHARACTERISTIC /begin REF_CHARACTERISTIC /end REF_CHARACTERISTIC /begin IN_MEASUREMENT /end IN_MEASUREMENT /begin OUT_MEASUREMENT /end OUT_MEASUREMENT /begin LOC_MEASUREMENT /end LOC_MEASUREMENT /begin SUB_FUNCTION /end SUB_FUNCTION /end FUNCTION
/begin FUNCTION DHFM "63.130    Diagnose; Plausibilitätsprüfung HFM"
 /begin DEF_CHARACTERISTIC CWDHFM FWMLHFMMN KFMLDMN KFMLDMX MLHFMMN TDMLHFM TDMLMN TDMLMX TDMLNF TDMLST TDUBHFM UADHFMMN UADHFMMX UBHFM UNWDHFM ZMLRO /end DEF_CHARACTERISTIC
 /begin REF_CHARACTERISTIC MLOFS /end REF_CHARACTERISTIC
 /begin IN_MEASUREMENT B_bvhfm B_edks B_ehfmfe B_ldrugd B_stend fho_w mlhfmm_w nmot_w ub uhfm_w uzkw_w wdkba_w /end IN_MEASUREMENT
 /begin OUT_MEASUREMENT B_ehfm B_ehfs B_elmi B_hfm fwmlhfm /end OUT_MEASUREMENT
 /begin LOC_MEASUREMENT B_ehfm1 B_fgdhfmst B_mnhfm B_mxhfm mldmn_w mldmx_w mlhfmf_w wdkbadmn_w wdkbadmx_w /end LOC_MEASUREMENT
 /begin SUB_FUNCTION /end SUB_FUNCTION
/end FUNCTION
/begin FUNCTION DHLSHK "4.90      Diagnose Sondenheizung hinter Kat"
 /begin DEF_CHARACTERISTIC CWDHLSH FRINH1 KFRINH TABSTHLSH TADHMNH TADHMXH TANSDHLSH TASOH TVHSHEE TVHSHRI TVHSHRIHEL TVHSHRIZ TVRIHEE UBDHLSHMN UBDHLSHMX ZKARIH1 ZKPRIH /end DEF_CHARACTERISTIC
 /begin REF_CHARACTERISTIC /end REF_CHARACTERISTIC
 /begin IN_MEASUREMENT B_atmst B_bvhls B_cdhsh B_lsh B_nmot B_rinh B_risigh B_stend msabg_w phlsnh rinh_w tabst_w tahsom_w tans ubsq_w /end IN_MEASUREMENT
 /begin OUT_MEASUREMENT B_hsokh B_ubok /end OUT_MEASUREMENT
 /begin LOC_MEASUREMENT B_ehsh B_enh B_mnfhsh B_mxfhsh B_npfhsh B_nphealh B_rierrh B_sifhsh phlsnhf rinkfh rinsh_w tahsomf_w /end LOC_MEASUREMENT
 /begin SUB_FUNCTION /end SUB_FUNCTION
/end FUNCTION
/begin FUNCTION DHLSHKE "1.10      Diagnose Endstufe Sondenheizung hinter Kat" /begin DEF_CHARACTERISTIC /end DEF_CHARACTERISTIC /begin REF_CHARACTERISTIC /end REF_CHARACTERISTIC /begin IN_MEASUREMENT B_cdhshe B_desee B_hshe /end IN_MEASUREMENT /begin OUT_MEASUREMENT /end OUT_MEASUREMENT /begin LOC_MEASUREMENT /end LOC_MEASUREMENT /begin SUB_FUNCTION /end SUB_FUNCTION /end FUNCTION
/begin FUNCTION DHLSU "2.171     Diagnose Heizung LSU"
 /begin DEF_CHARACTERISTIC MSABHMN SULSUMN SULSUMNN SULSUMXH TALSUMN TALSUSAE TDFHS TLSUSAE TNLDHLSU TVLSUBM TVLSUEE TVLSUNP TVLSUSA TVLSUSAE TVLSUSAH UBDHLSUMN UBDHLSUMX UHEMN UHEMX ZKLSU /end DEF_CHARACTERISTIC
 /begin REF_CHARACTERISTIC /end REF_CHARACTERISTIC
 /begin IN_MEASUREMENT B_bvhls B_cdhsv B_cdhsvsa B_elsu B_hsv B_hsve B_kl15 B_sa B_sbbvk B_stend msabg tabst_w tavvkm_w ubsq_w uhsv usvkk_w /end IN_MEASUREMENT
 /begin OUT_MEASUREMENT B_ehlsu B_nplsusa talsuf_w /end OUT_MEASUREMENT
 /begin LOC_MEASUREMENT B_enheat B_enswit B_helsunp B_helsusa B_helsusw B_mnhlsu B_mxhlsu B_nphlsu B_sihlsu /end LOC_MEASUREMENT
 /begin SUB_FUNCTION /end SUB_FUNCTION
/end FUNCTION
/begin FUNCTION DHR "2.20      Diagnose; Hauptrelais" /begin DEF_CHARACTERISTIC TDHR TDZHR UHRMN1 UHRMN2 UHRMX1 UHRMX2 /end DEF_CHARACTERISTIC /begin REF_CHARACTERISTIC /end REF_CHARACTERISTIC /begin IN_MEASUREMENT B_ubrdmn1 B_ubrdmn2 wuhr /end IN_MEASUREMENT /begin OUT_MEASUREMENT B_dhrnio /end OUT_MEASUREMENT /begin LOC_MEASUREMENT /end LOC_MEASUREMENT /begin SUB_FUNCTION /end SUB_FUNCTION /end FUNCTION
/begin FUNCTION DIAVALVE "" /begin DEF_CHARACTERISTIC /end DEF_CHARACTERISTIC /begin REF_CHARACTERISTIC /end REF_CHARACTERISTIC /begin IN_MEASUREMENT eevx /end IN_MEASUREMENT /begin OUT_MEASUREMENT /end OUT_MEASUREMENT /begin LOC_MEASUREMENT /end LOC_MEASUREMENT /begin SUB_FUNCTION /end SUB_FUNCTION /end FUNCTION
/begin FUNCTION DIMC "27.70     OBDII; inspection/maintenance-ready" /begin DEF_CHARACTERISTIC SRYAGR SRYHS SRYKAT SRYLS SRYSLS SRYTES /end DEF_CHARACTERISTIC /begin REF_CHARACTERISTIC /end REF_CHARACTERISTIC
 /begin IN_MEASUREMENT B_cdagr B_cdhsv B_cdldp B_cdlsv B_cdsls B_cdtes B_cwdslt B_cwdslty B_katfz B_kath B_mslmin B_pwf B_sztesf cd_bits1_w cd_bits2_w /end IN_MEASUREMENT
 /begin OUT_MEASUREMENT B_agrrdy B_hsrdy B_kathrdy B_katrdy B_kkrdy B_lsrdy B_slsrdy B_tesrdy evsup1 ready /end OUT_MEASUREMENT
 /begin LOC_MEASUREMENT B_ztes B_ztesf cryhs crykat cryls crysls crytes flgdimc /end LOC_MEASUREMENT
 /begin SUB_FUNCTION /end SUB_FUNCTION
/end FUNCTION
/begin FUNCTION DISTAB12 "" /begin DEF_CHARACTERISTIC EBEN EBMISS_T EBMISS_Y /end DEF_CHARACTERISTIC /begin REF_CHARACTERISTIC /end REF_CHARACTERISTIC /begin IN_MEASUREMENT /end IN_MEASUREMENT
 /begin OUT_MEASUREMENT B_ebDavT B_ebDavY ebCtrNewT ebCtrNewY ebCtrOldT ebCtrOldY ebMissT ebMissY /end OUT_MEASUREMENT
 /begin LOC_MEASUREMENT /end LOC_MEASUREMENT
 /begin SUB_FUNCTION /end SUB_FUNCTION
/end FUNCTION
/begin FUNCTION DKATLRS "5.100     Eigendiagnose : Katalysatorkonvertierung"
 /begin DEF_CHARACTERISTIC ADKATNF AHKATMN_0_A AHKATMN_1_A AHKATMX_0_A AHKATMX_1_A AHKATS AHKATSB AHKTMXT_0_A AHKTMXT_1_A AHKTTSW APEKTDX AVKATFS AZLRKTD_0_A AZLRKTD_1_A AZLRKTT_0_A AZLRKTT_1_A CDKATLK CWKATUM DKATCW DMRKTD_0_A DMRKTD_1_A DRLKTDP_0_A DRLKTDP_1_A DRLKTDPT_0_A DRLKTDPT_1_A HYKATA_0_A HYKATA_1_A HYKATR_0_A HYKATR_1_A KATBFML_0_A KATBFML_1_A KATBFMN_0_A KATBFMN_1_A KATBFMNT_0_A KATBFMNT_1_A KATBFN_0_A KATBFN_1_A KATBFNM KATBFNP KATBFSX KATBFXM_0_A KATBFXM_1_A KATBFXT_0_A KATBFXT_1_A KATBSG_0_A KATBSG_1_A KATBSH_0_A KATBSH_1_A KATBSHF_0_A KATBSHF_1_A KATBSHG KFKABMT_0_A KFKABMT_1_A NDKTSO_0_A NDKTSO_1_A NDKTSOT_0_A NDKTSOT_1_A NDKTSU_0_A NDKTSU_1_A NDKTSUT_0_A NDKTSUT_1_A NKTDX RLDKTOT_0_A RLDKTOT_1_A RLDKTSO_0_A RLDKTSO_1_A RLDKTSU_0_A RLDKTSU_1_A RLDKTUT_0_A RLDKTUT_1_A TDKATAKT_0_A TDKATAKT_1_A TDKATATT_0_A TDKATATT_1_A TMAXKAT_0_A TMAXKAT_1_A TMINKAT_0_A TMINKAT_1_A TMNKATT_0_A TMNKATT_1_A TMSUKTD TWDKATST TWKTDLP TWKTDTK TZLRKTD_0_A TZLRKTD_1_A TZLRKTT_0_A TZLRKTT_1_A ZDKATAD_0_A ZDKATAD_1_A ZDKATAF_0_A ZDKATAF_1_A ZDKATSH ZDKTBD_0_A ZDKTBD_1_A ZDKTBF_0_A ZDKTBF_1_A ZKTDRL ZKTDTKM /end DEF_CHARACTERISTIC
 /begin REF_CHARACTERISTIC SML05DKUB_0_A SML05DKUB_1_A SNM05DKUB_0_A SNM05DKUB_1_A /end REF_CHARACTERISTIC
 /begin IN_MEASUREMENT B_cdkat B_dsls B_dtes B_edkvs B_fa B_fakat B_frmax B_frmin B_ll B_lr B_lrka B_mdarv B_mdkat B_pwf B_sbbhk B_sls B_tehb B_ukg cd_bits1_w esst_sml05dkub esst_snm05dkub lamsoni_w ml ml_w nmot rl tikatm tkatm tmst ushk /end IN_MEASUREMENT
 /begin OUT_MEASUREMENT avkatf azlrdkt B_dktlp B_vekat dmrdkt_w flgdkatlrs tc6kata tc6katc tc6kats tc6katw tzlrdkt_w /end OUT_MEASUREMENT
 /begin LOC_MEASUREMENT ahkat ahkatn ahktki_w ahktnk akatbn akatbnk apedkt B_dkini B_dklpi B_dktakt B_dkten B_dktnr B_dktpb B_dktsb B_dktsp B_dktst B_dktt B_dkttk B_ekats B_erdkt B_szkat B_trig B_zkatb B_zkats B_zkatz dkatakt_w kakbmt katbf katbfi_w katbfs katbftp katbshd_w kbdkt_w rldkthp tkdkte tkdkth tkdkthp twdkttk_w urddktp ushdktp /end LOC_MEASUREMENT
 /begin SUB_FUNCTION /end SUB_FUNCTION
/end FUNCTION
/begin FUNCTION DKRA "6.40      Diagnose; Klopfregelanschlag" /begin DEF_CHARACTERISTIC DKRAMX DKRAZ NDKRA /end DEF_CHARACTERISTIC /begin REF_CHARACTERISTIC /end REF_CHARACTERISTIC /begin IN_MEASUREMENT B_kl B_kr B_krwa B_pwf nmot tpnt_aktiv zzylkr /end IN_MEASUREMENT /begin OUT_MEASUREMENT flmxctr /end OUT_MEASUREMENT /begin LOC_MEASUREMENT dkractr /end LOC_MEASUREMENT /begin SUB_FUNCTION /end SUB_FUNCTION /end FUNCTION
/begin FUNCTION DKRNT "11.10     Diagnose; Klopfregelung, Nulltest (OBDII)" /begin DEF_CHARACTERISTIC CWDKRNT CWDKROF DKROFN DKROKU KRFHT UDKRGOFS /end DEF_CHARACTERISTIC /begin REF_CHARACTERISTIC DKROKD /end REF_CHARACTERISTIC /begin IN_MEASUREMENT B_dnt B_pwf B_stend igod_w ikrma nmot tmfln_w tpnt_aktiv /end IN_MEASUREMENT /begin OUT_MEASUREMENT /end OUT_MEASUREMENT /begin LOC_MEASUREMENT xzkrznt xzkrzof xzskrnt xzskrof /end LOC_MEASUREMENT /begin SUB_FUNCTION /end SUB_FUNCTION /end FUNCTION
/begin FUNCTION DKRS "30.20     Diagnose; Klopfsensor (OBDII)"
 /begin DEF_CHARACTERISTIC CWDKS1 CWDKS2 CWDKS3 CWDKS4 KRFHKS NDKS NDKSBET UDKSNO UDKSNU /end DEF_CHARACTERISTIC
 /begin REF_CHARACTERISTIC SNM16KRUB /end REF_CHARACTERISTIC
 /begin IN_MEASUREMENT B_fakrs B_kr B_krfdks B_krldy B_krndy B_pwf B_tmkr esst_snm16krub ks_sym nmot rkr sen_c95 vkr /end IN_MEASUREMENT
 /begin OUT_MEASUREMENT B_ds rkrn_w udksnoa_w udksnua_w xzkrzs xzsen /end OUT_MEASUREMENT
 /begin LOC_MEASUREMENT /end LOC_MEASUREMENT
 /begin SUB_FUNCTION /end SUB_FUNCTION
/end FUNCTION
/begin FUNCTION DKRTP "11.10     Diagnose; Klopfregelung, Testimpuls (OBDII)" /begin DEF_CHARACTERISTIC CWDKRTP UDKRTP /end DEF_CHARACTERISTIC /begin REF_CHARACTERISTIC KRFHT /end REF_CHARACTERISTIC /begin IN_MEASUREMENT B_dtp B_pwf ikrma ikrmet tpnt_aktiv /end IN_MEASUREMENT /begin OUT_MEASUREMENT /end OUT_MEASUREMENT /begin LOC_MEASUREMENT xzkrztp xzskrtp /end LOC_MEASUREMENT /begin SUB_FUNCTION /end SUB_FUNCTION /end FUNCTION
/begin FUNCTION DKUPPL "1.40      Diagnose Kupplungsschalter" /begin DEF_CHARACTERISTIC AGANGW AKUPPLB TDKUPNOG VDKUPPLMN /end DEF_CHARACTERISTIC /begin REF_CHARACTERISTIC /end REF_CHARACTERISTIC /begin IN_MEASUREMENT B_autget B_brems B_lsd gangi S_kupp vfzg /end IN_MEASUREMENT /begin OUT_MEASUREMENT anzgangw anzkupplb B_gangok /end OUT_MEASUREMENT /begin LOC_MEASUREMENT /end LOC_MEASUREMENT /begin SUB_FUNCTION /end SUB_FUNCTION /end FUNCTION
/begin FUNCTION DKVS "17.80     Diagnose; Plausibilitätsprüfung Kraftstoffversorgungssysteme"
 /begin DEF_CHARACTERISTIC CPLRA CWDKVSS DFRMST FRAE FRAODN FRAODX FRAUDN FRAUDX FRMSTDN FRMSTDX IMLKVSMX MLDKVSF MLDKVSG RKAE RKATDN RKATDX RKAZDN RKAZDX TFRA TFRAOZ TFRAUZ TFRMST TFRMZST TMFRST TRKA TRKATZ TRKAZZ ZFRMST /end DEF_CHARACTERISTIC
 /begin REF_CHARACTERISTIC /end REF_CHARACTERISTIC
 /begin IN_MEASUREMENT B_cdkvs B_fa B_fakvs B_frao B_frau B_fraur B_lr B_lra B_lrare B_nofra B_norkat B_norkaz B_pwf B_rkat B_rkatr B_rkaz B_rkazr B_sa B_tal B_talval B_te cd_bits1_w frao_w frau_w frm_w ml rkat_w rkaz_w tmot /end IN_MEASUREMENT
 /begin OUT_MEASUREMENT B_dkvsf B_dkvstr B_edkvs B_gae B_gaefra B_gaefra2 B_kvsffl /end OUT_MEASUREMENT
 /begin LOC_MEASUREMENT B_dkvsef B_dkvsfm B_efrao B_efrau B_erkat B_erkaz B_frste B_gaeing B_gaeing2 B_imlkvse B_norkam B_plra B_rkam B_rkamr DKVSbits frauzs_w imlkvszs_w imlkvs_w rkamzs_w rkam_w /end LOC_MEASUREMENT
 /begin SUB_FUNCTION /end SUB_FUNCTION
/end FUNCTION
/begin FUNCTION DLDE "7.10      Diagnose LDR-Endstufe" /begin DEF_CHARACTERISTIC /end DEF_CHARACTERISTIC /begin REF_CHARACTERISTIC /end REF_CHARACTERISTIC /begin IN_MEASUREMENT B_desee ldtvm /end IN_MEASUREMENT /begin OUT_MEASUREMENT /end OUT_MEASUREMENT /begin LOC_MEASUREMENT /end LOC_MEASUREMENT /begin SUB_FUNCTION /end SUB_FUNCTION /end FUNCTION
/begin FUNCTION DLDP "19.110    OBD II, Tankentlüftungsdiagnosemodul"
 /begin DEF_CHARACTERISTIC APULSMX BLDPMX CLDPAAV CLDPTVC CWBAESEL CWDLDP DELTATA DKLDPN DKTLMT DPUBABMX DPUFFMN DPUFFMX DPUFVMN DPUFVSMN DRLFFMX DTMFFU DTMLDP DTPLDP DTPXF DVBABFF DVFZBAB FPUPT HLDPU KFFLTA KFGLTA KFTXFTA KFXFTA MSTELDP RL1FGV RL1GV RL2FGV RL2GV RL3FGV RL3GV RL4FGV RL4GV RL5FGV RL5GV RL6FGV RL6GV RLBABMX RLLDPMX SVF06D_UB TAFFO TAFLDPO TALDPO TALDPU TC6LDPC1 TC6LDPC2 TC6LDPC3 TC6LDPC4 TC6LDPC5 TEVCKMX TIZUMN TLDP1SD TLDP2SD TLDPDISA1 TLDPDISA2 TLDPDISE1 TLDPDISE2 TLDPMN TLDPMX TLDPRKL TLDPRKO TLDPRPDEL TLDPZMN TMFFO TMLDPO TMLDPU TPFIFOANZ TPTEVMN TPUPH TRKAUF TSLDPV TSRFPAB TSTZUMN TTOTLDP TVFZDIF TVLDPMN TVLDPT TVTEVMN TXFMX VALDPMN VLDPMN VLDPO VLDPTEV VLDPU VSLDPMN WZLDPD WZLDPGS WZLDPMX WZLDPRO ZRLBAB /end DEF_CHARACTERISTIC
 /begin REF_CHARACTERISTIC /end REF_CHARACTERISTIC
 /begin IN_MEASUREMENT bfzgl_w B_autget B_cdldp B_daav B_daavreq B_daavte B_dtes B_fa B_faldp B_fs B_ldpi B_ll B_lrar B_m8te B_nmin B_puerr B_pwf B_resmode B_st B_stend B_tef B_tep cd_bits1_w fho ftefsoll_w gangi modedaavrq mstedte_w mstesoll_w nmot ps_w pukorf_w pu_w rl rl_w tans tateout tmot tmotab vfzg wdkba /end IN_MEASUREMENT
 /begin OUT_MEASUREMENT B_aav B_dldp B_dldpte B_ldp B_sztesf B_tevioi B_teviot B_teza esst_svf06d_ub tc6ldpc tc6ldps tc6ldpw tispldpx_w tispldp_w tpldptcx_w tpldptc_w /end OUT_MEASUREMENT
 /begin LOC_MEASUREMENT anzpuls B_bergab B_bergabd B_bergabl B_bergxf B_bergxfd B_bergxfl B_bxf1 B_bxf2 B_bxf3 B_bxf4 B_bxf5 B_bxf6 B_bxf7 B_bxf8 B_bxf9 B_dldpf B_dpumn B_dteven B_errldp B_extaav B_faldpa B_fev1 B_fev10 B_fev11 B_fev12 B_fev13 B_fev2 B_fev3 B_fev4 B_fev5 B_fev6 B_fev7 B_fev8 B_fev9 B_fpchk B_ispuel B_ldpabb B_ldpf1 B_ldpf2 B_ldpf5 B_ldpf6 B_ldpf7 B_ldpflv B_ldpglv B_messe B_nodldp B_prxf B_rkack B_rkcke B_rkzck B_tepldp B_tpstab B_xfstab ctr_fein ctr_feinst DLDPlokbits1 DLDPlokbits2 DLDPlokbits3 DLDPlokbits4 dpu_w drlldp_w dtmast dvbab flgxfb fppcnt fpper fpuls fvdldp imsteldp modeldp modeldp_old pumem_w rlbab rlbabxf rlf rsmcnt rsmcntd rsmcntg stptr taldpst tdaufp tfpg timaldp timfp timldp timrs timtev timzldp tispuel tldktim tldpein tldppmw tpfifo tpmeanv_w trklow tvfzctr wzcto /end LOC_MEASUREMENT
 /begin SUB_FUNCTION /end SUB_FUNCTION
/end FUNCTION
/begin FUNCTION DLDPE "5.50      Endstufendiagnose; Überdruckpumpe der Tank-Leck-Diagnose"
 /begin DEF_CHARACTERISTIC TDLDPE TWDLDPE TWLDPE UBDOLDPE UBDULDPE ULDPEMN ULDPEMX ZKDXLDPE /end DEF_CHARACTERISTIC
 /begin REF_CHARACTERISTIC /end REF_CHARACTERISTIC
 /begin IN_MEASUREMENT B_airbag B_kl15 B_ldp B_nmot B_stend ub uldpe /end IN_MEASUREMENT
 /begin OUT_MEASUREMENT B_ldpe B_ldpelok /end OUT_MEASUREMENT
 /begin LOC_MEASUREMENT B_mnld B_mxld B_sild /end LOC_MEASUREMENT
 /begin SUB_FUNCTION /end SUB_FUNCTION
/end FUNCTION
/begin FUNCTION DLDR "7.20      Diagnose LDR"
 /begin DEF_CHARACTERISTIC DLUL DPLPLGD FVMXLDRA FVPDKLDL FVPDKLDS FVPDKLDUS KFVPDKLD KLDLUL LDELDRAO LDELDRAU LKVDKNMN NDLDRAPU PLGRUELDD PULDR SRLLKH SSRLKVDK TDLDEUK TDLDRA2 TDLKVDKH TDLKVDKL TDLKVDKLL TDLKVDKS TDLKVDKST TDLKVDKT TLDEUK TPLGPLG TULV1 TULV3 /end DEF_CHARACTERISTIC
 /begin REF_CHARACTERISTIC /end REF_CHARACTERISTIC
 /begin IN_MEASUREMENT B_asr B_dkp1e B_dkp2e B_fgren B_hfm B_ldr B_ll B_mszsdkb B_pug B_pwf B_spldd B_stend ftefsoll_w nmot plgru_w plsol_w pspvds_w pu pvdkds_w rl_w tmot wdkba /end IN_MEASUREMENT
 /begin OUT_MEASUREMENT B_atla B_emxldr B_ldra dldrAusBits ldeukm_w ldeuk_w /end OUT_MEASUREMENT
 /begin LOC_MEASUREMENT B_dynsp B_erl B_ladan B_minldra B_mxaok B_slkvdkg dldrLokBits dplsplsdn ldeldrae_w ldeo pspvdsmx /end LOC_MEASUREMENT
 /begin SUB_FUNCTION DFPM_DLDR /end SUB_FUNCTION
/end FUNCTION
/begin FUNCTION DLDUV "1.70      Diagnose Schubumluftventil beim Turbomotor"
 /begin DEF_CHARACTERISTIC CWDLDUV DLDUVES DPULSUV ELDUVCLR ELDUVSET PULSUV TADLDUV TMDLDUV TMFDUV TMMZUV /end DEF_CHARACTERISTIC
 /begin REF_CHARACTERISTIC /end REF_CHARACTERISTIC
 /begin IN_MEASUREMENT B_ldsua B_neglgrd dfuelsan_w pvdkds_w tans tmot /end IN_MEASUREMENT
 /begin OUT_MEASUREMENT B_messf B_pulsa B_uefgab pulsct pulscthld /end OUT_MEASUREMENT
 /begin LOC_MEASUREMENT /end LOC_MEASUREMENT
 /begin SUB_FUNCTION DFPM_DLDUV /end SUB_FUNCTION
/end FUNCTION
/begin FUNCTION DLDUVSE "2.10      Diagnose Endstufe Umluftventil Turbo" /begin DEF_CHARACTERISTIC /end DEF_CHARACTERISTIC /begin REF_CHARACTERISTIC /end REF_CHARACTERISTIC /begin IN_MEASUREMENT B_desee B_ldsua /end IN_MEASUREMENT /begin OUT_MEASUREMENT /end OUT_MEASUREMENT /begin LOC_MEASUREMENT /end LOC_MEASUREMENT /begin SUB_FUNCTION /end SUB_FUNCTION /end FUNCTION
/begin FUNCTION DLLR "28.120    Diagnose: Leerlaufregelung Erkennung blockierter Steller"
 /begin DEF_CHARACTERISTIC DASA DNDLLRO DNDLLRU FHDLLR RLMDVERL TADLLR TDLLR TDLLRMN TDLLRMX TDLLRNF TFDLLRO TFDLLRU TMDLLR /end DEF_CHARACTERISTIC
 /begin REF_CHARACTERISTIC /end REF_CHARACTERISTIC
 /begin IN_MEASUREMENT B_cdllr B_dknolu B_dkpu B_dsls B_dtes B_ll B_llr B_lrar B_nldg B_nmot B_nswo1 B_sa B_st B_tehb cd_bits2_w dmllri_w dns fho limax_w limin_w mdverl_w rl tans tmot tnse_w vfzg /end IN_MEASUREMENT
 /begin OUT_MEASUREMENT B_dllr B_dllra /end OUT_MEASUREMENT
 /begin LOC_MEASUREMENT B_lldia /end LOC_MEASUREMENT
 /begin SUB_FUNCTION /end SUB_FUNCTION
/end FUNCTION
/begin FUNCTION DLSAHK "Lambdasondenalterungsüberwachung hinter KAT"
 /begin DEF_CHARACTERISTIC ANZDYNSH CWDLSAHK DLAMLASHF DLAMLASHM DMRLASH KMXSTG KTLAMSTEIG LAMLASHMIN LAMSONSVL LAMSTEIG MLLASH MLOSTEST MLUSSTG MLUSTEST MLUSVL SMLDYN TABGSTGK TLLASH TRIPFASH TSALASH TTLASH TUSCHUB TUSENLASH TUSHKRFM TUSHKVL TUSHSMIN TUSLASH TUSMSVL TUSSA TUSTALLASH USHKVL USHLEAN USHRICH USHSTGMX USHSTSOLL USSCHUB /end DEF_CHARACTERISTIC
 /begin REF_CHARACTERISTIC /end REF_CHARACTERISTIC
 /begin IN_MEASUREMENT B_atmtpk B_cdlash B_cwlshdyn B_cwlshsch B_cwlshvl B_dsls B_dtest B_edkvs B_evloc B_fa B_fash B_hsha B_lr B_lrhk B_lrhkp B_lsh B_mdarv B_pwf B_sa B_sbbhk B_tal B_talval B_vlsumrb cd_bits2_w lamsbg_w lamsons_w ml_w tahsom_w ushk usrhk /end IN_MEASUREMENT
 /begin OUT_MEASUREMENT B_ddylash B_dlash B_dshk B_dushkvl B_dushsch B_enfmst B_enlash B_entest B_lamend B_lamlash B_lamverg B_lsahksp B_lshswok B_maxlavh B_minlash B_mldyn B_mlustest B_nolash B_teslash B_trfash B_ushkf B_ushkm dmrlash_w lamlash_w mldyn_w ushfmxstg ushkmxstg ushksteig zlash_w zwdynsh /end OUT_MEASUREMENT
 /begin LOC_MEASUREMENT B_abgstg B_dlams B_dylash B_enmaxla B_enramph B_hshtpk B_ktrlash B_lshkspe B_maxla B_maxlash B_nolavh B_npllash B_sbbhkv B_siglash B_steigm B_uscherf B_ushkrfm B_ushsch B_usrhkmx dlams_w intlash_w lamtrip_w usrhkmx usrhks /end LOC_MEASUREMENT
 /begin SUB_FUNCTION /end SUB_FUNCTION
/end FUNCTION
/begin COMPU_METHOD bfzg_sw_q4p239Em4 "" RAT_FUNC "%10.7" "m/s^2" COEFFS 0 1 0 0 0 0.0004239 /end COMPU_METHOD
/begin COMPU_METHOD B_TRUE "boolsche Zustände, positive Logik" TAB_VERB "%6.3" "" COMPU_TAB_REF B_TRUE /end COMPU_METHOD
/begin COMPU_VTAB B_TRUE "boolsche Zustände, positive Logik" TAB_VERB 2 0 "----" 1 "TRUE" /end COMPU_VTAB
/begin COMPU_METHOD dez "1 : 1 Umrechnug (dez/hex)" RAT_FUNC "%6.2" "" COEFFS 0 1 0 0 0 1 /end COMPU_METHOD
/begin COMPU_METHOD fak_sb_b1 "" RAT_FUNC "%6.4" "-" COEFFS 0 256 0 0 0 2 /end COMPU_METHOD
/begin COMPU_METHOD fak_ub_b0p25 "" RAT_FUNC "%10.7" "-" COEFFS 0 256 0 0 0 0.25 /end COMPU_METHOD
/begin COMPU_METHOD fak_ub_b1 "" RAT_FUNC "%6.4" "-" COEFFS 0 256 0 0 0 1 /end COMPU_METHOD
/begin COMPU_METHOD fak_ub_b2 "" RAT_FUNC "%6.4" "-" COEFFS 0 256 0 0 0 2 /end COMPU_METHOD
/begin COMPU_METHOD fak_ub_b4 "" RAT_FUNC "%6.4" "-" COEFFS 0 256 0 0 0 4 /end COMPU_METHOD
/begin COMPU_METHOD fak_ub_b64 "" RAT_FUNC "%6.3" "-" COEFFS 0 256 0 0 0 64 /end COMPU_METHOD
/begin COMPU_METHOD fak_ub_q0p01 "" RAT_FUNC "%6.4" "-" COEFFS 0 1 0 0 0 0.01 /end COMPU_METHOD
/begin COMPU_METHOD fak_uw_b0p5 "" RAT_FUNC "%8.7" "-" COEFFS 0 65536 0 0 0 0.5 /end COMPU_METHOD
/begin COMPU_METHOD fak_uw_b1 "" RAT_FUNC "%7.6" "-" COEFFS 0 65536 0 0 0 1 /end COMPU_METHOD
/begin COMPU_METHOD fak_uw_b16 "" RAT_FUNC "%6.5" "-" COEFFS 0 65536 0 0 0 16 /end COMPU_METHOD
/begin COMPU_METHOD fak_uw_b2 "" RAT_FUNC "%7.6" "-" COEFFS 0 65536 0 0 0 2 /end COMPU_METHOD
/begin COMPU_METHOD fak_uw_b4 "" RAT_FUNC "%7.6" "-" COEFFS 0 65536 0 0 0 4 /end COMPU_METHOD
/begin COMPU_METHOD freq_sw_b512 "" RAT_FUNC "%6.4" "1/s" COEFFS 0 65536 0 0 0 1024 /end COMPU_METHOD
/begin COMPU_METHOD mgrad_sw_b28p44 "" RAT_FUNC "%6.5" "g/s" COEFFS 0 230.4 0 0 0 0.2 /end COMPU_METHOD
/begin COMPU_METHOD mgrad_ub_b221p35 "" RAT_FUNC "%6.2" "mg/s" COEFFS 0 230.4 0 0 0 200 /end COMPU_METHOD
/begin COMPU_METHOD mgrad_uw_q0p0961 "" RAT_FUNC "%6.1" "mg/(V*s)" COEFFS 0 9805.82 0 0 0 102000 /end COMPU_METHOD
/begin COMPU_METHOD m_q0p00277 "" RAT_FUNC "%6.4" "g" COEFFS 0 360 0 0 0 1 /end COMPU_METHOD
/begin COMPU_METHOD m_q0p00355 "" RAT_FUNC "%6.4" "kg" COEFFS 0 1125 0 0 0 4 /end COMPU_METHOD
/begin COMPU_METHOD m_q0p1 "" RAT_FUNC "%6.3" "kg/h" COEFFS 0 10 0 0 0 1 /end COMPU_METHOD
/begin COMPU_METHOD m_sw_q0p1 "" RAT_FUNC "%6.3" "kg/h" COEFFS 0 1 0 0 0 0.1 /end COMPU_METHOD
/begin COMPU_METHOD m_ub_b1020 "" RAT_FUNC "%6.2" "kg/h" COEFFS 0 1 0 0 0 4 /end COMPU_METHOD
/begin COMPU_METHOD m_ub_b221p35 "" RAT_FUNC "%6.2" "mg" COEFFS 0 230.4 0 0 0 200 /end COMPU_METHOD
/begin COMPU_METHOD m_ub_q0p0444 "" RAT_FUNC "%6.4" "g" COEFFS 0 1 0 0 0 0.0444 /end COMPU_METHOD
/begin COMPU_METHOD m_uw_b6553p5 "" RAT_FUNC "%6.3" "kg/h" COEFFS 0 1 0 0 0 0.1 /end COMPU_METHOD
/begin COMPU_METHOD nmot_ub_q10 "" RAT_FUNC "%6.1" "U/min" COEFFS 0 1 0 0 0 10 /end COMPU_METHOD
/begin COMPU_METHOD nmot_ub_q40 "" RAT_FUNC "%6.1" "Upm" COEFFS 0 1 0 0 0 40 /end COMPU_METHOD
/begin COMPU_METHOD nmot_uw_q0p25 "" RAT_FUNC "%6.3" "U/min" COEFFS 0 1 0 0 0 0.25 /end COMPU_METHOD
/begin COMPU_METHOD p_sb_q10 "" RAT_FUNC "%6.1" "hPa" COEFFS 0 1 0 0 0 10 /end COMPU_METHOD
/begin COMPU_METHOD p_sw_q0p039 "" RAT_FUNC "%6.4" "hPa" COEFFS 0 256 0 0 0 10 /end COMPU_METHOD
/begin COMPU_METHOD p_ub_q10 "" RAT_FUNC "%6.1" "hPa" COEFFS 0 1 0 0 0 10 /end COMPU_METHOD
/begin COMPU_METHOD p_ub_q5 "" RAT_FUNC "%6.2" "hPa" COEFFS 0 1 0 0 0 5 /end COMPU_METHOD
/begin COMPU_METHOD p_uw_q0p039 "" RAT_FUNC "%6.4" "hPa" COEFFS 0 256 0 0 0 10 /end COMPU_METHOD
/begin COMPU_METHOD p_uw_q0p078 "" RAT_FUNC "%6.4" "hpa" COEFFS 0 256 0 0 0 20 /end COMPU_METHOD
/begin COMPU_METHOD relDK_q0p02441 "" RAT_FUNC "%6.4" "% DK" COEFFS 0 65536 0 0 0 1600 /end COMPU_METHOD
/begin COMPU_METHOD relDK_ub_b100 "" RAT_FUNC "%6.3" "% DK" COEFFS 0 255 0 0 0 100 /end COMPU_METHOD
/begin COMPU_METHOD rel_sb_q0p75 "" RAT_FUNC "%6.3" "%" COEFFS 0 1 0 0 0 0.75 /end COMPU_METHOD
/begin COMPU_METHOD rel_sw_b1536 "" RAT_FUNC "%6.4" "%" COEFFS 0 65536 0 0 0 3072 /end COMPU_METHOD
/begin COMPU_METHOD rel_sw_q0p0234 "" RAT_FUNC "%6.4" "%/seg" COEFFS 0 32 0 0 0 0.75 /end COMPU_METHOD
/begin COMPU_METHOD rel_ub_b99p6 "" RAT_FUNC "%6.3" "%" COEFFS 0 256 0 0 0 100 /end COMPU_METHOD
/begin COMPU_METHOD rel_ub_q0p75 "" RAT_FUNC "%6.3" "%" COEFFS 0 1 0 0 0 0.75 /end COMPU_METHOD
/begin COMPU_METHOD rel_uw_b100 "" RAT_FUNC "%6.4" "%" COEFFS 0 65536 0 0 0 100 /end COMPU_METHOD
/begin COMPU_METHOD rel_uw_b192 "" RAT_FUNC "%6.4" "%" COEFFS 0 65536 0 0 0 192 /end COMPU_METHOD
/begin COMPU_METHOD rel_uw_q0p0234 "" RAT_FUNC "%6.4" "%" COEFFS 0 32 0 0 0 0.75 /end COMPU_METHOD
/begin COMPU_METHOD r_q8 "" RAT_FUNC "%6.2" "Ohm" COEFFS 0 1 0 0 0 8 /end COMPU_METHOD
/begin COMPU_METHOD r_uw_q2 "" RAT_FUNC "%6.2" "Ohm" COEFFS 0 1 0 0 0 2 /end COMPU_METHOD
/begin COMPU_METHOD spgg_q0p52 "" RAT_FUNC "%6.3" "mV/ms" COEFFS 0 1 0 0 0 0.52 /end COMPU_METHOD
/begin COMPU_METHOD spg_q0p00039 "" RAT_FUNC "%6.5" "V" COEFFS 0 1 0 0 0 0.000390625 /end COMPU_METHOD
/begin COMPU_METHOD spg_q0p00488 "" RAT_FUNC "%6.4" "V" COEFFS 0 1024 0 0 0 5 /end COMPU_METHOD
/begin COMPU_METHOD spg_sb_q0p01043 "" RAT_FUNC "%6.4" "V" COEFFS 0 255 0 0 0 2.66 /end COMPU_METHOD
/begin COMPU_METHOD spg_ubatt "" RAT_FUNC "%6.4" "V" COEFFS 0 1 0 0 0 0.0704 /end COMPU_METHOD
/begin COMPU_METHOD spg_ub_b1p33 "" RAT_FUNC "%6.4" "V" COEFFS 0 255 0 0 0 1.33 /end COMPU_METHOD
/begin COMPU_METHOD spg_ub_b24 "" RAT_FUNC "%6.3" "1/V" COEFFS 0 1 0 0 0 0.09362 /end COMPU_METHOD
/begin COMPU_METHOD spg_ub_b5 "" RAT_FUNC "%6.4" "V" COEFFS 0 256 0 0 0 5 /end COMPU_METHOD
/begin COMPU_METHOD spg_ub_q0p0052 "" RAT_FUNC "%6.4" "V" COEFFS 0 255 0 0 0 1.33 /end COMPU_METHOD
/begin COMPU_METHOD spg_ub_q0p0052_o0p2 "" RAT_FUNC "%6.3" "V" COEFFS 0 255 51 0 0 1.33 /end COMPU_METHOD
/begin COMPU_METHOD spg_ub_q0p019 "" RAT_FUNC "%6.4" "V" COEFFS 0 256 0 0 0 5 /end COMPU_METHOD
/begin COMPU_METHOD spg_uw_b1280 "" RAT_FUNC "%6.4" "V" COEFFS 0 1000 0 0 0 19.5313 /end COMPU_METHOD
/begin COMPU_METHOD t100msxs_ub_b25p5 "" RAT_FUNC "%6.3" "s" COEFFS 0 1 0 0 0 0.1 /end COMPU_METHOD
/begin COMPU_METHOD t100msxs_uw_b6553p5 "" RAT_FUNC "%6.3" "s" COEFFS 0 1 0 0 0 0.1 /end COMPU_METHOD
/begin COMPU_METHOD t10msxs_ub_b2p55 "" RAT_FUNC "%6.4" "s" COEFFS 0 1 0 0 0 0.01 /end COMPU_METHOD
/begin COMPU_METHOD t10msxs_uw_b655p35 "" RAT_FUNC "%6.4" "s" COEFFS 0 1 0 0 0 0.01 /end COMPU_METHOD
/begin COMPU_METHOD t1sxs_ub_b255 "" RAT_FUNC "%6.2" "s" COEFFS 0 1 0 0 0 1 /end COMPU_METHOD
/begin COMPU_METHOD t1sxs_uw_b65535 "" RAT_FUNC "%6.2" "s" COEFFS 0 1 0 0 0 1 /end COMPU_METHOD
/begin COMPU_METHOD t1sxs_uw_q1 "" RAT_FUNC "%6.2" "s" COEFFS 0 1 0 0 0 1 /end COMPU_METHOD
/begin COMPU_METHOD t200msxs_ub_b51 "" RAT_FUNC "%6.3" "s" COEFFS 0 1 0 0 0 0.2 /end COMPU_METHOD
/begin COMPU_METHOD t20msxs_uw_b1310 "" RAT_FUNC "%6.4" "s" COEFFS 0 1 0 0 0 0.02 /end COMPU_METHOD
/begin COMPU_METHOD t20msxs_uw_q0p02 "" RAT_FUNC "%6.4" "s" COEFFS 0 1 0 0 0 0.02 /end COMPU_METHOD
/begin COMPU_METHOD t50msxs_ub_b12p75 "" RAT_FUNC "%6.4" "s" COEFFS 0 1 0 0 0 0.05 /end COMPU_METHOD
/begin COMPU_METHOD t50msxs_uw_b3276p75 "" RAT_FUNC "%6.4" "s" COEFFS 0 1 0 0 0 0.05 /end COMPU_METHOD
/begin COMPU_METHOD t50msxs_uw_b819p2 "" RAT_FUNC "%6.4" "s" COEFFS 0 1 0 0 0 0.0125 /end COMPU_METHOD
/begin COMPU_METHOD temp_q0p0234_o273 "" RAT_FUNC "%6.1" "Grad C" COEFFS 0 1 273.15 0 0 0.0234375 /end COMPU_METHOD
/begin COMPU_METHOD temp_sb_q0p75 "" RAT_FUNC "%6.3" "Grad C" COEFFS 0 1 0 0 0 0.75 /end COMPU_METHOD
/begin COMPU_METHOD temp_ub_q0p75 "" RAT_FUNC "%6.3" "Grad C" COEFFS 0 1 7.31383e-307 0 0 0.75 /end COMPU_METHOD
/begin COMPU_METHOD temp_ub_q0p75_o48 "" RAT_FUNC "%6.2" "Grad C" COEFFS 0 1 48 0 0 0.75 /end COMPU_METHOD
/begin COMPU_METHOD temp_ub_q5 "" RAT_FUNC "%6.2" "Grad C" COEFFS 0 1 0 0 0 5 /end COMPU_METHOD
/begin COMPU_METHOD temp_ub_q5_o50 "" RAT_FUNC "%6.2" "Grad C" COEFFS 0 1 50 0 0 5 /end COMPU_METHOD
/begin COMPU_METHOD tknockcon_sy "" RAT_FUNC "%8.7" "s" COEFFS 0 375000 0 0 0 1 /end COMPU_METHOD
/begin COMPU_METHOD tknockintgrad_sy "" RAT_FUNC "%6.3" "V/s" COEFFS 0 8.94855 0 0 0 1 /end COMPU_METHOD
/begin COMPU_METHOD t_q0p01 "" RAT_FUNC "%6.4" "s" COEFFS 0 100 0 0 0 1 /end COMPU_METHOD
/begin COMPU_METHOD t_q0p05 "" RAT_FUNC "%6.4" "s" COEFFS 0 100 0 0 0 5 /end COMPU_METHOD
/begin COMPU_METHOD t_q0p1 "" RAT_FUNC "%6.3" "s" COEFFS 0 10 0 0 0 1 /end COMPU_METHOD
/begin COMPU_METHOD vfzg_ub_q1p25 "" RAT_FUNC "%6.2" "km/h" COEFFS 0 1 0 0 0 1.25 /end COMPU_METHOD
/begin COMPU_METHOD zk100msxs_uw_b6553 "" RAT_FUNC "%12.4" "s" COEFFS 0 0 65536 0 10 0 /end COMPU_METHOD
/begin COMPU_METHOD zk10msxs_ub_b2p55 "" RAT_FUNC "%6.4" "s" COEFFS 0 0 255 0 100 0 /end COMPU_METHOD
/begin COMPU_METHOD zk200msxs_ub_b51p2 "" RAT_FUNC "%6.3" "s" COEFFS 0 0 255 0 5 0 /end COMPU_METHOD
/begin COMPU_METHOD zk50msxs_ub_b12p8 "" RAT_FUNC "%10.5" "s" COEFFS 0 0 128 0 10 0 /end COMPU_METHOD
/begin COMPU_METHOD zk50msxs_uw_b3276p8 "" RAT_FUNC "%12.4" "s" COEFFS 0 0 65536 0 20 0 /end COMPU_METHOD
/begin COMPU_METHOD default "" RAT_FUNC "%6.2" "" COEFFS 0 1 0 0 0 1 /end COMPU_METHOD
/begin RECORD_LAYOUT GklWSw FNC_VALUES 1 SWORD COLUMN_DIR DIRECT /end RECORD_LAYOUT
/begin RECORD_LAYOUT GklWUb FNC_VALUES 1 UBYTE COLUMN_DIR DIRECT /end RECORD_LAYOUT
/begin RECORD_LAYOUT GklWUw FNC_VALUES 1 UWORD COLUMN_DIR DIRECT /end RECORD_LAYOUT
/begin RECORD_LAYOUT KfAxUbAyUbSstxUbSstyUbWUb NO_AXIS_PTS_X 1 UBYTE NO_AXIS_PTS_Y 2 UBYTE AXIS_PTS_X 3 UBYTE INDEX_INCR DIRECT AXIS_PTS_Y 4 UBYTE INDEX_INCR DIRECT FNC_VALUES 5 UBYTE COLUMN_DIR DIRECT /end RECORD_LAYOUT
/begin RECORD_LAYOUT KfAxUbAyUbSstxUbSstyUwWUb NO_AXIS_PTS_X 1 UBYTE NO_AXIS_PTS_Y 2 UBYTE AXIS_PTS_X 3 UBYTE INDEX_INCR DIRECT AXIS_PTS_Y 4 UWORD INDEX_INCR DIRECT FNC_VALUES 5 UBYTE COLUMN_DIR DIRECT /end RECORD_LAYOUT
/begin RECORD_LAYOUT KfAxUbAyUbSstxUwSstyUbWUb NO_AXIS_PTS_X 1 UBYTE NO_AXIS_PTS_Y 2 UBYTE AXIS_PTS_X 3 UWORD INDEX_INCR DIRECT AXIS_PTS_Y 4 UBYTE INDEX_INCR DIRECT FNC_VALUES 5 UBYTE COLUMN_DIR DIRECT /end RECORD_LAYOUT
/begin RECORD_LAYOUT KfAxUwAyUwSstxUwSstyUwWSw NO_AXIS_PTS_X 1 UWORD NO_AXIS_PTS_Y 2 UWORD AXIS_PTS_X 3 UWORD INDEX_INCR DIRECT AXIS_PTS_Y 4 UWORD INDEX_INCR DIRECT FNC_VALUES 5 SWORD COLUMN_DIR DIRECT /end RECORD_LAYOUT
/begin RECORD_LAYOUT KfAxUwAyUwSstxUwSstyUwWUw NO_AXIS_PTS_X 1 UWORD NO_AXIS_PTS_Y 2 UWORD AXIS_PTS_X 3 UWORD INDEX_INCR DIRECT AXIS_PTS_Y 4 UWORD INDEX_INCR DIRECT FNC_VALUES 5 UWORD COLUMN_DIR DIRECT /end RECORD_LAYOUT
/begin RECORD_LAYOUT KlAUbSstSbWUb NO_AXIS_PTS_X 1 UBYTE AXIS_PTS_X 2 SBYTE INDEX_INCR DIRECT FNC_VALUES 3 UBYTE COLUMN_DIR DIRECT /end RECORD_LAYOUT
/begin RECORD_LAYOUT KlAUbSstUbWUb NO_AXIS_PTS_X 1 UBYTE AXIS_PTS_X 2 UBYTE INDEX_INCR DIRECT FNC_VALUES 3 UBYTE COLUMN_DIR DIRECT /end RECORD_LAYOUT
/begin RECORD_LAYOUT KlAUbSstUbWUw NO_AXIS_PTS_X 1 UBYTE AXIS_PTS_X 2 UBYTE INDEX_INCR DIRECT FNC_VALUES 3 UWORD COLUMN_DIR DIRECT /end RECORD_LAYOUT
/begin RECORD_LAYOUT KlAUbSstUwWUb NO_AXIS_PTS_X 1 UWORD AXIS_PTS_X 2 UWORD INDEX_INCR DIRECT FNC_VALUES 3 UBYTE COLUMN_DIR DIRECT /end RECORD_LAYOUT
/begin RECORD_LAYOUT KlAUbSstUwWUw NO_AXIS_PTS_X 1 UWORD AXIS_PTS_X 2 UWORD INDEX_INCR DIRECT FNC_VALUES 3 UWORD COLUMN_DIR DIRECT /end RECORD_LAYOUT
/begin RECORD_LAYOUT KlAUwSstUwWUw NO_AXIS_PTS_X 1 UWORD AXIS_PTS_X 2 UWORD INDEX_INCR DIRECT FNC_VALUES 3 UWORD COLUMN_DIR DIRECT /end RECORD_LAYOUT
/begin RECORD_LAYOUT KwbUb FNC_VALUES 1 UBYTE COLUMN_DIR DIRECT /end RECORD_LAYOUT
/begin RECORD_LAYOUT KwbUw FNC_VALUES 1 UWORD COLUMN_DIR DIRECT /end RECORD_LAYOUT
/begin RECORD_LAYOUT KwSb FNC_VALUES 1 SBYTE COLUMN_DIR DIRECT /end RECORD_LAYOUT
/begin RECORD_LAYOUT KwSw FNC_VALUES 1 SWORD COLUMN_DIR DIRECT /end RECORD_LAYOUT
/begin RECORD_LAYOUT KwUb FNC_VALUES 1 UBYTE COLUMN_DIR DIRECT /end RECORD_LAYOUT
/begin RECORD_LAYOUT KwUw FNC_VALUES 1 UWORD COLUMN_DIR DIRECT /end RECORD_LAYOUT
/begin RECORD_LAYOUT SstAUbSstUb NO_AXIS_PTS_X 1 UBYTE AXIS_PTS_X 2 UBYTE INDEX_INCR DIRECT /end RECORD_LAYOUT
/end MODULE
/end PROJECT
