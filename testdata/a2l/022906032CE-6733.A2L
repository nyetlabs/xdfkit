ASAP2_VERSION 1 3
/begin PROJECT S1103A_25G5_0 "S1103A"
/begin HEADER "" VERSION "S1103A_25G5_0" PROJECT_NO S1103A_25G5_0 /end HEADER
/begin MODULE DIM ""
/begin MOD_COMMON "" BYTE_ORDER MSB_LAST ALIGNMENT_BYTE 1 ALIGNMENT_WORD 2 ALIGNMENT_LONG 2 /end MOD_COMMON
/begin CHARACTERISTIC CDCAAA "" VAL_BLK 0x8E6944 KwbUw 65535.00 dez 0.00 65535.00 FORMAT "%8.2" NUMBER 4 /end CHARACTERISTIC
/begin CHARACTERISTIC CDCAKRE "" VAL_BLK 0x8E6954 KwbUw 65535.00 dez 0.00 65535.00 FORMAT "%8.2" NUMBER 4 /end CHARACTERISTIC
/begin CHARACTERISTIC CDCANWS "" VAL_BLK 0x8E695C KwbUw 65535.00 dez 0.00 65535.00 FORMAT "%8.2" NUMBER 4 /end CHARACTERISTIC
/begin CHARACTERISTIC CDCANWSE "" VAL_BLK 0x8E6964 KwbUw 65535.00 dez 0.00 65535.00 FORMAT "%8.2" NUMBER 4 /end CHARACTERISTIC
/begin CHARACTERISTIC CDCBKVP "" VAL_BLK 0x8E6974 KwbUw 65535.00 dez 0.00 65535.00 FORMAT "%8.2" NUMBER 4 /end CHARACTERISTIC
/begin CHARACTERISTIC CDCBKVPE "" VAL_BLK 0x8E697C KwbUw 65535.00 dez 0.00 65535.00 FORMAT "%8.2" NUMBER 4 /end CHARACTERISTIC
/begin CHARACTERISTIC CDCBM "" VAL_BLK 0x8E6984 KwbUw 65535.00 dez 0.00 65535.00 FORMAT "%8.2" NUMBER 4 /end CHARACTERISTIC
/begin CHARACTERISTIC CDCCIF "" VAL_BLK 0x8E69E4 KwbUw 65535.00 dez 0.00 65535.00 FORMAT "%8.2" NUMBER 4 /end CHARACTERISTIC
/begin CHARACTERISTIC CDCCINS "" VAL_BLK 0x8E69EC KwbUw 65535.00 dez 0.00 65535.00 FORMAT "%8.2" NUMBER 4 /end CHARACTERISTIC
/begin CHARACTERISTIC CDCCKLA "" VAL_BLK 0x8E69F4 KwbUw 65535.00 dez 0.00 65535.00 FORMAT "%8.2" NUMBER 4 /end CHARACTERISTIC
/begin CHARACTERISTIC CDCCLWS "" VAL_BLK 0x8E69FC KwbUw 65535.00 dez 0.00 65535.00 FORMAT "%8.2" NUMBER 4 /end CHARACTERISTIC
/begin CHARACTERISTIC CDCCTOG "" VAL_BLK 0x8E6A04 KwbUw 65535.00 dez 0.00 65535.00 FORMAT "%8.2" NUMBER 4 /end CHARACTERISTIC
/begin CHARACTERISTIC CDCCZAS "" VAL_BLK 0x8E6A0C KwbUw 65535.00 dez 0.00 65535.00 FORMAT "%8.2" NUMBER 4 /end CHARACTERISTIC
/begin CHARACTERISTIC CDCDK "" VAL_BLK 0x8E6A14 KwbUw 65535.00 dez 0.00 65535.00 FORMAT "%8.2" NUMBER 4 /end CHARACTERISTIC
/begin CHARACTERISTIC CDCDK1P "" VAL_BLK 0x8E6A1C KwbUw 65535.00 dez 0.00 65535.00 FORMAT "%8.2" NUMBER 4 /end CHARACTERISTIC
/begin CHARACTERISTIC CDCDK2P "" VAL_BLK 0x8E6A24 KwbUw 65535.00 dez 0.00 65535.00 FORMAT "%8.2" NUMBER 4 /end CHARACTERISTIC
/begin CHARACTERISTIC CDCDVEE "" VAL_BLK 0x8E6A44 KwbUw 65535.00 dez 0.00 65535.00 FORMAT "%8.2" NUMBER 4 /end CHARACTERISTIC
/begin CHARACTERISTIC CDCDVEF "" VAL_BLK 0x8E6A4C KwbUw 65535.00 dez 0.00 65535.00 FORMAT "%8.2" NUMBER 4 /end CHARACTERISTIC
/begin CHARACTERISTIC CDCDVEFO "" VAL_BLK 0x8E6A54 KwbUw 65535.00 dez 0.00 65535.00 FORMAT "%8.2" NUMBER 4 /end CHARACTERISTIC
/begin CHARACTERISTIC CDCDVEL "" VAL_BLK 0x8E6A5C KwbUw 65535.00 dez 0.00 65535.00 FORMAT "%8.2" NUMBER 4 /end CHARACTERISTIC
/begin CHARACTERISTIC CDCDVEN "" VAL_BLK 0x8E6A64 KwbUw 65535.00 dez 0.00 65535.00 FORMAT "%8.2" NUMBER 4 /end CHARACTERISTIC
/begin CHARACTERISTIC CDCDVER "" VAL_BLK 0x8E6A6C KwbUw 65535.00 dez 0.00 65535.00 FORMAT "%8.2" NUMBER 4 /end CHARACTERISTIC
/begin CHARACTERISTIC CDCDVET "" VAL_BLK 0x8E6A74 KwbUw 65535.00 dez 0.00 65535.00 FORMAT "%8.2" NUMBER 4 /end CHARACTERISTIC
/begin CHARACTERISTIC CDCDVEU "" VAL_BLK 0x8E6A7C KwbUw 65535.00 dez 0.00 65535.00 FORMAT "%8.2" NUMBER 4 /end CHARACTERISTIC
/begin CHARACTERISTIC CDCDVEUB "" VAL_BLK 0x8E6A84 KwbUw 65535.00 dez 0.00 65535.00 FORMAT "%8.2" NUMBER 4 /end CHARACTERISTIC
/begin CHARACTERISTIC CDCDVEUW "" VAL_BLK 0x8E6A8C KwbUw 65535.00 dez 0.00 65535.00 FORMAT "%8.2" NUMBER 4 /end CHARACTERISTIC
/begin CHARACTERISTIC CDCDVEV "" VAL_BLK 0x8E6A94 KwbUw 65535.00 dez 0.00 65535.00 FORMAT "%8.2" NUMBER 4 /end CHARACTERISTIC
/begin CHARACTERISTIC CDCDYLSU "" VAL_BLK 0x8E6A9C KwbUw 65535.00 dez 0.00 65535.00 FORMAT "%8.2" NUMBER 4 /end CHARACTERISTIC
/begin CHARACTERISTIC CDCDYLSU2 "" VAL_BLK 0x8E6AA4 KwbUw 65535.00 dez 0.00 65535.00 FORMAT "%8.2" NUMBER 4 /end CHARACTERISTIC
/begin CHARACTERISTIC CDCEGFE "" VAL_BLK 0x8E6AAC KwbUw 65535.00 dez 0.00 65535.00 FORMAT "%8.2" NUMBER 4 /end CHARACTERISTIC
/begin CHARACTERISTIC CDCENWS "" VAL_BLK 0x8E6ABC KwbUw 65535.00 dez 0.00 65535.00 FORMAT "%8.2" NUMBER 4 /end CHARACTERISTIC
/begin CHARACTERISTIC CDCENWSE "" VAL_BLK 0x8E6AC4 KwbUw 65535.00 dez 0.00 65535.00 FORMAT "%8.2" NUMBER 4 /end CHARACTERISTIC
/begin CHARACTERISTIC CDCEPCLE "" VAL_BLK 0x8E6ACC KwbUw 65535.00 dez 0.00 65535.00 FORMAT "%8.2" NUMBER 4 /end CHARACTERISTIC
/begin CHARACTERISTIC CDCEV1 "" VAL_BLK 0x8E6AD4 KwbUw 65535.00 dez 0.00 65535.00 FORMAT "%8.2" NUMBER 4 /end CHARACTERISTIC
/begin CHARACTERISTIC CDCEV2 "" VAL_BLK 0x8E6ADC KwbUw 65535.00 dez 0.00 65535.00 FORMAT "%8.2" NUMBER 4 /end CHARACTERISTIC
/begin CHARACTERISTIC CDCEV3 "" VAL_BLK 0x8E6AE4 KwbUw 65535.00 dez 0.00 65535.00 FORMAT "%8.2" NUMBER 4 /end CHARACTERISTIC
/begin CHARACTERISTIC CDCEV4 "" VAL_BLK 0x8E6AEC KwbUw 65535.00 dez 0.00 65535.00 FORMAT "%8.2" NUMBER 4 /end CHARACTERISTIC
/begin CHARACTERISTIC CDCEV5 "" VAL_BLK 0x8E6AF4 KwbUw 65535.00 dez 0.00 65535.00 FORMAT "%8.2" NUMBER 4 /end CHARACTERISTIC
/begin CHARACTERISTIC CDCEV6 "" VAL_BLK 0x8E6AFC KwbUw 65535.00 dez 0.00 65535.00 FORMAT "%8.2" NUMBER 4 /end CHARACTERISTIC
/begin CHARACTERISTIC CDCHELSU "" VAL_BLK 0x8E6B5C KwbUw 65535.00 dez 0.00 65535.00 FORMAT "%8.2" NUMBER 4 /end CHARACTERISTIC
/begin CHARACTERISTIC CDCHELSU2 "" VAL_BLK 0x8E6B64 KwbUw 65535.00 dez 0.00 65535.00 FORMAT "%8.2" NUMBER 4 /end CHARACTERISTIC
/begin CHARACTERISTIC CDCHSH "" VAL_BLK 0x8E6B74 KwbUw 65535.00 dez 0.00 65535.00 FORMAT "%8.2" NUMBER 4 /end CHARACTERISTIC
/begin CHARACTERISTIC CDCHSH2 "" VAL_BLK 0x8E6B7C KwbUw 65535.00 dez 0.00 65535.00 FORMAT "%8.2" NUMBER 4 /end CHARACTERISTIC
/begin CHARACTERISTIC CDCHSHE "" VAL_BLK 0x8E6B84 KwbUw 65535.00 dez 0.00 65535.00 FORMAT "%8.2" NUMBER 4 /end CHARACTERISTIC
/begin CHARACTERISTIC CDCHSHE2 "" VAL_BLK 0x8E6B8C KwbUw 65535.00 dez 0.00 65535.00 FORMAT "%8.2" NUMBER 4 /end CHARACTERISTIC
/begin CHARACTERISTIC CDCHSV "" VAL_BLK 0x8E6B94 KwbUw 65535.00 dez 0.00 65535.00 FORMAT "%8.2" NUMBER 4 /end CHARACTERISTIC
/begin CHARACTERISTIC CDCHSV2 "" VAL_BLK 0x8E6B9C KwbUw 65535.00 dez 0.00 65535.00 FORMAT "%8.2" NUMBER 4 /end CHARACTERISTIC
/begin CHARACTERISTIC CDCHSVE "" VAL_BLK 0x8E6BA4 KwbUw 65535.00 dez 0.00 65535.00 FORMAT "%8.2" NUMBER 4 /end CHARACTERISTIC
/begin CHARACTERISTIC CDCHSVE2 "" VAL_BLK 0x8E6BAC KwbUw 65535.00 dez 0.00 65535.00 FORMAT "%8.2" NUMBER 4 /end CHARACTERISTIC
/begin CHARACTERISTIC CDCICLSU "" VAL_BLK 0x8E6BB4 KwbUw 65535.00 dez 0.00 65535.00 FORMAT "%8.2" NUMBER 4 /end CHARACTERISTIC
/begin CHARACTERISTIC CDCICLSU2 "" VAL_BLK 0x8E6BBC KwbUw 65535.00 dez 0.00 65535.00 FORMAT "%8.2" NUMBER 4 /end CHARACTERISTIC
/begin CHARACTERISTIC CDCKPE "" VAL_BLK 0x8E6BD4 KwbUw 65535.00 dez 0.00 65535.00 FORMAT "%8.2" NUMBER 4 /end CHARACTERISTIC
/begin CHARACTERISTIC CDCLDPE "" VAL_BLK 0x8E6C6C KwbUw 65535.00 dez 0.00 65535.00 FORMAT "%8.2" NUMBER 4 /end CHARACTERISTIC
/begin CHARACTERISTIC CDCLSUIA "" VAL_BLK 0x8E6C9C KwbUw 65535.00 dez 0.00 65535.00 FORMAT "%8.2" NUMBER 4 /end CHARACTERISTIC
/begin CHARACTERISTIC CDCLSUIA2 "" VAL_BLK 0x8E6CA4 KwbUw 65535.00 dez 0.00 65535.00 FORMAT "%8.2" NUMBER 4 /end CHARACTERISTIC
/begin CHARACTERISTIC CDCLSUIP "" VAL_BLK 0x8E6CAC KwbUw 65535.00 dez 0.00 65535.00 FORMAT "%8.2" NUMBER 4 /end CHARACTERISTIC
/begin CHARACTERISTIC CDCLSUIP2 "" VAL_BLK 0x8E6CB4 KwbUw 65535.00 dez 0.00 65535.00 FORMAT "%8.2" NUMBER 4 /end CHARACTERISTIC
/begin CHARACTERISTIC CDCLSUKS "" VAL_BLK 0x8E6CBC KwbUw 65535.00 dez 0.00 65535.00 FORMAT "%8.2" NUMBER 4 /end CHARACTERISTIC
/begin CHARACTERISTIC CDCLSUKS2 "" VAL_BLK 0x8E6CC4 KwbUw 65535.00 dez 0.00 65535.00 FORMAT "%8.2" NUMBER 4 /end CHARACTERISTIC
/begin CHARACTERISTIC CDCLSUUN "" VAL_BLK 0x8E6CCC KwbUw 65535.00 dez 0.00 65535.00 FORMAT "%8.2" NUMBER 4 /end CHARACTERISTIC
/begin CHARACTERISTIC CDCLSUUN2 "" VAL_BLK 0x8E6CD4 KwbUw 65535.00 dez 0.00 65535.00 FORMAT "%8.2" NUMBER 4 /end CHARACTERISTIC
/begin CHARACTERISTIC CDCLSUVM "" VAL_BLK 0x8E6CDC KwbUw 65535.00 dez 0.00 65535.00 FORMAT "%8.2" NUMBER 4 /end CHARACTERISTIC
/begin CHARACTERISTIC CDCLSUVM2 "" VAL_BLK 0x8E6CE4 KwbUw 65535.00 dez 0.00 65535.00 FORMAT "%8.2" NUMBER 4 /end CHARACTERISTIC
/begin CHARACTERISTIC CDCLUES1E "" VAL_BLK 0x8E6D0C KwbUw 65535.00 dez 0.00 65535.00 FORMAT "%8.2" NUMBER 4 /end CHARACTERISTIC
/begin CHARACTERISTIC CDCN "" VAL_BLK 0x8E6D64 KwbUw 65535.00 dez 0.00 65535.00 FORMAT "%8.2" NUMBER 4 /end CHARACTERISTIC
/begin CHARACTERISTIC CDCSLPE "" VAL_BLK 0x8E6DE4 KwbUw 65535.00 dez 0.00 65535.00 FORMAT "%8.2" NUMBER 4 /end CHARACTERISTIC
/begin CHARACTERISTIC CDCSLVE "" VAL_BLK 0x8E6E0C KwbUw 65535.00 dez 0.00 65535.00 FORMAT "%8.2" NUMBER 4 /end CHARACTERISTIC
/begin CHARACTERISTIC CDCSUE "" VAL_BLK 0x8E6E14 KwbUw 65535.00 dez 0.00 65535.00 FORMAT "%8.2" NUMBER 4 /end CHARACTERISTIC
/begin CHARACTERISTIC CDCTEVE "" VAL_BLK 0x8E6E4C KwbUw 65535.00 dez 0.00 65535.00 FORMAT "%8.2" NUMBER 4 /end CHARACTERISTIC
/begin CHARACTERISTIC CDCZET1 "" VAL_BLK 0x8E6F0C KwbUw 65535.00 dez 0.00 65535.00 FORMAT "%8.2" NUMBER 4 /end CHARACTERISTIC
/begin CHARACTERISTIC CDCZET2 "" VAL_BLK 0x8E6F14 KwbUw 65535.00 dez 0.00 65535.00 FORMAT "%8.2" NUMBER 4 /end CHARACTERISTIC
/begin CHARACTERISTIC CDCZET3 "" VAL_BLK 0x8E6F1C KwbUw 65535.00 dez 0.00 65535.00 FORMAT "%8.2" NUMBER 4 /end CHARACTERISTIC
/begin CHARACTERISTIC CDCZET4 "" VAL_BLK 0x8E6F24 KwbUw 65535.00 dez 0.00 65535.00 FORMAT "%8.2" NUMBER 4 /end CHARACTERISTIC
/begin CHARACTERISTIC CDCZET5 "" VAL_BLK 0x8E6F2C KwbUw 65535.00 dez 0.00 65535.00 FORMAT "%8.2" NUMBER 4 /end CHARACTERISTIC
/begin CHARACTERISTIC CDCZET6 "" VAL_BLK 0x8E6F34 KwbUw 65535.00 dez 0.00 65535.00 FORMAT "%8.2" NUMBER 4 /end CHARACTERISTIC
/begin CHARACTERISTIC CDCZWPE "" VAL_BLK 0x8E6F3C KwbUw 65535.00 dez 0.00 65535.00 FORMAT "%8.2" NUMBER 4 /end CHARACTERISTIC
/begin CHARACTERISTIC CDCZZZ "" VAL_BLK 0x8E6F44 KwbUw 65535.00 dez 0.00 65535.00 FORMAT "%8.2" NUMBER 4 /end CHARACTERISTIC
/begin CHARACTERISTIC CDKAAA "" VAL_BLK 0x8E6F4C KwbUw 65535.00 dez 0.00 65535.00 FORMAT "%8.2" NUMBER 4 /end CHARACTERISTIC
/begin CHARACTERISTIC CDKAKRE "" VAL_BLK 0x8E6F5C KwbUw 65535.00 dez 0.00 65535.00 FORMAT "%8.2" NUMBER 4 /end CHARACTERISTIC
/begin CHARACTERISTIC CDKANWS "" VAL_BLK 0x8E6F64 KwbUw 65535.00 dez 0.00 65535.00 FORMAT "%8.2" NUMBER 4 /end CHARACTERISTIC
/begin CHARACTERISTIC CDKANWSE "" VAL_BLK 0x8E6F6C KwbUw 65535.00 dez 0.00 65535.00 FORMAT "%8.2" NUMBER 4 /end CHARACTERISTIC
/begin CHARACTERISTIC CDKBKVP "" VAL_BLK 0x8E6F7C KwbUw 65535.00 dez 0.00 65535.00 FORMAT "%8.2" NUMBER 4 /end CHARACTERISTIC
/begin CHARACTERISTIC CDKBKVPE "" VAL_BLK 0x8E6F84 KwbUw 65535.00 dez 0.00 65535.00 FORMAT "%8.2" NUMBER 4 /end CHARACTERISTIC
/begin CHARACTERISTIC CDKBM "" VAL_BLK 0x8E6F8C KwbUw 65535.00 dez 0.00 65535.00 FORMAT "%8.2" NUMBER 4 /end CHARACTERISTIC
/begin CHARACTERISTIC CDKCIF "" VAL_BLK 0x8E6FEC KwbUw 65535.00 dez 0.00 65535.00 FORMAT "%8.2" NUMBER 4 /end CHARACTERISTIC
/begin CHARACTERISTIC CDKCINS "" VAL_BLK 0x8E6FF4 KwbUw 65535.00 dez 0.00 65535.00 FORMAT "%8.2" NUMBER 4 /end CHARACTERISTIC
/begin CHARACTERISTIC CDKCKLA "" VAL_BLK 0x8E6FFC KwbUw 65535.00 dez 0.00 65535.00 FORMAT "%8.2" NUMBER 4 /end CHARACTERISTIC
/begin CHARACTERISTIC CDKCLWS "" VAL_BLK 0x8E7004 KwbUw 65535.00 dez 0.00 65535.00 FORMAT "%8.2" NUMBER 4 /end CHARACTERISTIC
/begin CHARACTERISTIC CDKCTOG "" VAL_BLK 0x8E700C KwbUw 65535.00 dez 0.00 65535.00 FORMAT "%8.2" NUMBER 4 /end CHARACTERISTIC
/begin CHARACTERISTIC CDKCZAS "" VAL_BLK 0x8E7014 KwbUw 65535.00 dez 0.00 65535.00 FORMAT "%8.2" NUMBER 4 /end CHARACTERISTIC
/begin CHARACTERISTIC CDKDK "" VAL_BLK 0x8E701C KwbUw 65535.00 dez 0.00 65535.00 FORMAT "%8.2" NUMBER 4 /end CHARACTERISTIC
/begin CHARACTERISTIC CDKDK1P "" VAL_BLK 0x8E7024 KwbUw 65535.00 dez 0.00 65535.00 FORMAT "%8.2" NUMBER 4 /end CHARACTERISTIC
/begin CHARACTERISTIC CDKDK2P "" VAL_BLK 0x8E702C KwbUw 65535.00 dez 0.00 65535.00 FORMAT "%8.2" NUMBER 4 /end CHARACTERISTIC
/begin CHARACTERISTIC CDKDVEE "" VAL_BLK 0x8E704C KwbUw 65535.00 dez 0.00 65535.00 FORMAT "%8.2" NUMBER 4 /end CHARACTERISTIC
/begin CHARACTERISTIC CDKDVEF "" VAL_BLK 0x8E7054 KwbUw 65535.00 dez 0.00 65535.00 FORMAT "%8.2" NUMBER 4 /end CHARACTERISTIC
/begin CHARACTERISTIC CDKDVEFO "" VAL_BLK 0x8E705C KwbUw 65535.00 dez 0.00 65535.00 FORMAT "%8.2" NUMBER 4 /end CHARACTERISTIC
/begin CHARACTERISTIC CDKDVEL "" VAL_BLK 0x8E7064 KwbUw 65535.00 dez 0.00 65535.00 FORMAT "%8.2" NUMBER 4 /end CHARACTERISTIC
/begin CHARACTERISTIC CDKDVEN "" VAL_BLK 0x8E706C KwbUw 65535.00 dez 0.00 65535.00 FORMAT "%8.2" NUMBER 4 /end CHARACTERISTIC
/begin CHARACTERISTIC CDKDVER "" VAL_BLK 0x8E7074 KwbUw 65535.00 dez 0.00 65535.00 FORMAT "%8.2" NUMBER 4 /end CHARACTERISTIC
/begin CHARACTERISTIC CDKDVET "" VAL_BLK 0x8E707C KwbUw 65535.00 dez 0.00 65535.00 FORMAT "%8.2" NUMBER 4 /end CHARACTERISTIC
/begin CHARACTERISTIC CDKDVEU "" VAL_BLK 0x8E7084 KwbUw 65535.00 dez 0.00 65535.00 FORMAT "%8.2" NUMBER 4 /end CHARACTERISTIC
/begin CHARACTERISTIC CDKDVEUB "" VAL_BLK 0x8E708C KwbUw 65535.00 dez 0.00 65535.00 FORMAT "%8.2" NUMBER 4 /end CHARACTERISTIC
/begin CHARACTERISTIC CDKDVEUW "" VAL_BLK 0x8E7094 KwbUw 65535.00 dez 0.00 65535.00 FORMAT "%8.2" NUMBER 4 /end CHARACTERISTIC
/begin CHARACTERISTIC CDKDVEV "" VAL_BLK 0x8E709C KwbUw 65535.00 dez 0.00 65535.00 FORMAT "%8.2" NUMBER 4 /end CHARACTERISTIC
/begin CHARACTERISTIC CDKDYLSU "" VAL_BLK 0x8E70A4 KwbUw 65535.00 dez 0.00 65535.00 FORMAT "%8.2" NUMBER 4 /end CHARACTERISTIC
/begin CHARACTERISTIC CDKDYLSU2 "" VAL_BLK 0x8E70AC KwbUw 65535.00 dez 0.00 65535.00 FORMAT "%8.2" NUMBER 4 /end CHARACTERISTIC
/begin CHARACTERISTIC CDKEGFE "" VAL_BLK 0x8E70B4 KwbUw 65535.00 dez 0.00 65535.00 FORMAT "%8.2" NUMBER 4 /end CHARACTERISTIC
/begin CHARACTERISTIC CDKENWS "" VAL_BLK 0x8E70C4 KwbUw 65535.00 dez 0.00 65535.00 FORMAT "%8.2" NUMBER 4 /end CHARACTERISTIC
/begin CHARACTERISTIC CDKENWSE "" VAL_BLK 0x8E70CC KwbUw 65535.00 dez 0.00 65535.00 FORMAT "%8.2" NUMBER 4 /end CHARACTERISTIC
/begin CHARACTERISTIC CDKEPCLE "" VAL_BLK 0x8E70D4 KwbUw 65535.00 dez 0.00 65535.00 FORMAT "%8.2" NUMBER 4 /end CHARACTERISTIC
/begin CHARACTERISTIC CDKEV1 "" VAL_BLK 0x8E70DC KwbUw 65535.00 dez 0.00 65535.00 FORMAT "%8.2" NUMBER 4 /end CHARACTERISTIC
/begin CHARACTERISTIC CDKEV2 "" VAL_BLK 0x8E70E4 KwbUw 65535.00 dez 0.00 65535.00 FORMAT "%8.2" NUMBER 4 /end CHARACTERISTIC
/begin CHARACTERISTIC CDKEV3 "" VAL_BLK 0x8E70EC KwbUw 65535.00 dez 0.00 65535.00 FORMAT "%8.2" NUMBER 4 /end CHARACTERISTIC
/begin CHARACTERISTIC CDKEV4 "" VAL_BLK 0x8E70F4 KwbUw 65535.00 dez 0.00 65535.00 FORMAT "%8.2" NUMBER 4 /end CHARACTERISTIC
/begin CHARACTERISTIC CDKEV5 "" VAL_BLK 0x8E70FC KwbUw 65535.00 dez 0.00 65535.00 FORMAT "%8.2" NUMBER 4 /end CHARACTERISTIC
/begin CHARACTERISTIC CDKEV6 "" VAL_BLK 0x8E7104 KwbUw 65535.00 dez 0.00 65535.00 FORMAT "%8.2" NUMBER 4 /end CHARACTERISTIC
/begin CHARACTERISTIC CDKHELSU "" VAL_BLK 0x8E7164 KwbUw 65535.00 dez 0.00 65535.00 FORMAT "%8.2" NUMBER 4 /end CHARACTERISTIC
/begin CHARACTERISTIC CDKHELSU2 "" VAL_BLK 0x8E716C KwbUw 65535.00 dez 0.00 65535.00 FORMAT "%8.2" NUMBER 4 /end CHARACTERISTIC
/begin CHARACTERISTIC CDKHSH "" VAL_BLK 0x8E717C KwbUw 65535.00 dez 0.00 65535.00 FORMAT "%8.2" NUMBER 4 /end CHARACTERISTIC
/begin CHARACTERISTIC CDKHSH2 "" VAL_BLK 0x8E7184 KwbUw 65535.00 dez 0.00 65535.00 FORMAT "%8.2" NUMBER 4 /end CHARACTERISTIC
/begin CHARACTERISTIC CDKHSHE "" VAL_BLK 0x8E718C KwbUw 65535.00 dez 0.00 65535.00 FORMAT "%8.2" NUMBER 4 /end CHARACTERISTIC
/begin CHARACTERISTIC CDKHSHE2 "" VAL_BLK 0x8E7194 KwbUw 65535.00 dez 0.00 65535.00 FORMAT "%8.2" NUMBER 4 /end CHARACTERISTIC
/begin CHARACTERISTIC CDKHSV "" VAL_BLK 0x8E719C KwbUw 65535.00 dez 0.00 65535.00 FORMAT "%8.2" NUMBER 4 /end CHARACTERISTIC
/begin CHARACTERISTIC CDKHSV2 "" VAL_BLK 0x8E71A4 KwbUw 65535.00 dez 0.00 65535.00 FORMAT "%8.2" NUMBER 4 /end CHARACTERISTIC
/begin CHARACTERISTIC CDKHSVE "" VAL_BLK 0x8E71AC KwbUw 65535.00 dez 0.00 65535.00 FORMAT "%8.2" NUMBER 4 /end CHARACTERISTIC
/begin CHARACTERISTIC CDKHSVE2 "" VAL_BLK 0x8E71B4 KwbUw 65535.00 dez 0.00 65535.00 FORMAT "%8.2" NUMBER 4 /end CHARACTERISTIC
/begin CHARACTERISTIC CDKICLSU "" VAL_BLK 0x8E71BC KwbUw 65535.00 dez 0.00 65535.00 FORMAT "%8.2" NUMBER 4 /end CHARACTERISTIC
/begin CHARACTERISTIC CDKICLSU2 "" VAL_BLK 0x8E71C4 KwbUw 65535.00 dez 0.00 65535.00 FORMAT "%8.2" NUMBER 4 /end CHARACTERISTIC
/begin CHARACTERISTIC CDKKPE "" VAL_BLK 0x8E71DC KwbUw 65535.00 dez 0.00 65535.00 FORMAT "%8.2" NUMBER 4 /end CHARACTERISTIC
/begin CHARACTERISTIC CDKLDPE "" VAL_BLK 0x8E7274 KwbUw 65535.00 dez 0.00 65535.00 FORMAT "%8.2" NUMBER 4 /end CHARACTERISTIC
/begin CHARACTERISTIC CDKLSUIA "" VAL_BLK 0x8E72A4 KwbUw 65535.00 dez 0.00 65535.00 FORMAT "%8.2" NUMBER 4 /end CHARACTERISTIC
/begin CHARACTERISTIC CDKLSUIA2 "" VAL_BLK 0x8E72AC KwbUw 65535.00 dez 0.00 65535.00 FORMAT "%8.2" NUMBER 4 /end CHARACTERISTIC
/begin CHARACTERISTIC CDKLSUIP "" VAL_BLK 0x8E72B4 KwbUw 65535.00 dez 0.00 65535.00 FORMAT "%8.2" NUMBER 4 /end CHARACTERISTIC
/begin CHARACTERISTIC CDKLSUIP2 "" VAL_BLK 0x8E72BC KwbUw 65535.00 dez 0.00 65535.00 FORMAT "%8.2" NUMBER 4 /end CHARACTERISTIC
/begin CHARACTERISTIC CDKLSUKS "" VAL_BLK 0x8E72C4 KwbUw 65535.00 dez 0.00 65535.00 FORMAT "%8.2" NUMBER 4 /end CHARACTERISTIC
/begin CHARACTERISTIC CDKLSUKS2 "" VAL_BLK 0x8E72CC KwbUw 65535.00 dez 0.00 65535.00 FORMAT "%8.2" NUMBER 4 /end CHARACTERISTIC
/begin CHARACTERISTIC CDKLSUUN "" VAL_BLK 0x8E72D4 KwbUw 65535.00 dez 0.00 65535.00 FORMAT "%8.2" NUMBER 4 /end CHARACTERISTIC
/begin CHARACTERISTIC CDKLSUUN2 "" VAL_BLK 0x8E72DC KwbUw 65535.00 dez 0.00 65535.00 FORMAT "%8.2" NUMBER 4 /end CHARACTERISTIC
/begin CHARACTERISTIC CDKLSUVM "" VAL_BLK 0x8E72E4 KwbUw 65535.00 dez 0.00 65535.00 FORMAT "%8.2" NUMBER 4 /end CHARACTERISTIC
/begin CHARACTERISTIC CDKLSUVM2 "" VAL_BLK 0x8E72EC KwbUw 65535.00 dez 0.00 65535.00 FORMAT "%8.2" NUMBER 4 /end CHARACTERISTIC
/begin CHARACTERISTIC CDKLUES1E "" VAL_BLK 0x8E7314 KwbUw 65535.00 dez 0.00 65535.00 FORMAT "%8.2" NUMBER 4 /end CHARACTERISTIC
/begin CHARACTERISTIC CDKN "" VAL_BLK 0x8E736C KwbUw 65535.00 dez 0.00 65535.00 FORMAT "%8.2" NUMBER 4 /end CHARACTERISTIC
/begin CHARACTERISTIC CDKSLPE "" VAL_BLK 0x8E73EC KwbUw 65535.00 dez 0.00 65535.00 FORMAT "%8.2" NUMBER 4 /end CHARACTERISTIC
/begin CHARACTERISTIC CDKSLVE "" VAL_BLK 0x8E7414 KwbUw 65535.00 dez 0.00 65535.00 FORMAT "%8.2" NUMBER 4 /end CHARACTERISTIC
/begin CHARACTERISTIC CDKSUE "" VAL_BLK 0x8E741C KwbUw 65535.00 dez 0.00 65535.00 FORMAT "%8.2" NUMBER 4 /end CHARACTERISTIC
/begin CHARACTERISTIC CDKTEVE "" VAL_BLK 0x8E7454 KwbUw 65535.00 dez 0.00 65535.00 FORMAT "%8.2" NUMBER 4 /end CHARACTERISTIC
/begin CHARACTERISTIC CDKZET1 "" VAL_BLK 0x8E7514 KwbUw 65535.00 dez 0.00 65535.00 FORMAT "%8.2" NUMBER 4 /end CHARACTERISTIC
/begin CHARACTERISTIC CDKZET2 "" VAL_BLK 0x8E751C KwbUw 65535.00 dez 0.00 65535.00 FORMAT "%8.2" NUMBER 4 /end CHARACTERISTIC
/begin CHARACTERISTIC CDKZET3 "" VAL_BLK 0x8E7524 KwbUw 65535.00 dez 0.00 65535.00 FORMAT "%8.2" NUMBER 4 /end CHARACTERISTIC
/begin CHARACTERISTIC CDKZET4 "" VAL_BLK 0x8E752C KwbUw 65535.00 dez 0.00 65535.00 FORMAT "%8.2" NUMBER 4 /end CHARACTERISTIC
/begin CHARACTERISTIC CDKZET5 "" VAL_BLK 0x8E7534 KwbUw 65535.00 dez 0.00 65535.00 FORMAT "%8.2" NUMBER 4 /end CHARACTERISTIC
/begin CHARACTERISTIC CDKZET6 "" VAL_BLK 0x8E753C KwbUw 65535.00 dez 0.00 65535.00 FORMAT "%8.2" NUMBER 4 /end CHARACTERISTIC
/begin CHARACTERISTIC CDKZWPE "" VAL_BLK 0x8E7544 KwbUw 65535.00 dez 0.00 65535.00 FORMAT "%8.2" NUMBER 4 /end CHARACTERISTIC
/begin CHARACTERISTIC CDKZZZ "" VAL_BLK 0x8E754C KwbUw 65535.00 dez 0.00 65535.00 FORMAT "%8.2" NUMBER 4 /end CHARACTERISTIC
/begin CHARACTERISTIC CDTAAA "" VALUE 0x8E7554 KwUw 65535.00 dez 0.00 65535.00 FORMAT "%8.2" /end CHARACTERISTIC
/begin CHARACTERISTIC CDTAKRE "" VALUE 0x8E7558 KwUw 65535.00 dez 0.00 65535.00 FORMAT "%8.2" /end CHARACTERISTIC
/begin CHARACTERISTIC CDTANWS "" VALUE 0x8E755A KwUw 65535.00 dez 0.00 65535.00 FORMAT "%8.2" /end CHARACTERISTIC
/begin CHARACTERISTIC CDTANWSE "" VALUE 0x8E755C KwUw 65535.00 dez 0.00 65535.00 FORMAT "%8.2" /end CHARACTERISTIC
/begin CHARACTERISTIC CDTBKVP "" VALUE 0x8E7560 KwUw 65535.00 dez 0.00 65535.00 FORMAT "%8.2" /end CHARACTERISTIC
/begin CHARACTERISTIC CDTBKVPE "" VALUE 0x8E7562 KwUw 65535.00 dez 0.00 65535.00 FORMAT "%8.2" /end CHARACTERISTIC
/begin CHARACTERISTIC CDTBM "" VALUE 0x8E7564 KwUw 65535.00 dez 0.00 65535.00 FORMAT "%8.2" /end CHARACTERISTIC
/begin CHARACTERISTIC CDTCIF "" VALUE 0x8E757C KwUw 65535.00 dez 0.00 65535.00 FORMAT "%8.2" /end CHARACTERISTIC
/begin CHARACTERISTIC CDTCINS "" VALUE 0x8E757E KwUw 65535.00 dez 0.00 65535.00 FORMAT "%8.2" /end CHARACTERISTIC
/begin CHARACTERISTIC CDTCKLA "" VALUE 0x8E7580 KwUw 65535.00 dez 0.00 65535.00 FORMAT "%8.2" /end CHARACTERISTIC
/begin CHARACTERISTIC CDTCLWS "" VALUE 0x8E7582 KwUw 65535.00 dez 0.00 65535.00 FORMAT "%8.2" /end CHARACTERISTIC
/begin CHARACTERISTIC CDTCTOG "" VALUE 0x8E7584 KwUw 65535.00 dez 0.00 65535.00 FORMAT "%8.2" /end CHARACTERISTIC
/begin CHARACTERISTIC CDTCZAS "" VALUE 0x8E7586 KwUw 65535.00 dez 0.00 65535.00 FORMAT "%8.2" /end CHARACTERISTIC
/begin CHARACTERISTIC CDTDK "" VALUE 0x8E7588 KwUw 65535.00 dez 0.00 65535.00 FORMAT "%8.2" /end CHARACTERISTIC
/begin CHARACTERISTIC CDTDK1P "" VALUE 0x8E758A KwUw 65535.00 dez 0.00 65535.00 FORMAT "%8.2" /end CHARACTERISTIC
/begin CHARACTERISTIC CDTDK2P "" VALUE 0x8E758C KwUw 65535.00 dez 0.00 65535.00 FORMAT "%8.2" /end CHARACTERISTIC
/begin CHARACTERISTIC CDTDVEE "" VALUE 0x8E7594 KwUw 65535.00 dez 0.00 65535.00 FORMAT "%8.2" /end CHARACTERISTIC
/begin CHARACTERISTIC CDTDVEF "" VALUE 0x8E7596 KwUw 65535.00 dez 0.00 65535.00 FORMAT "%8.2" /end CHARACTERISTIC
/begin CHARACTERISTIC CDTDVEFO "" VALUE 0x8E7598 KwUw 65535.00 dez 0.00 65535.00 FORMAT "%8.2" /end CHARACTERISTIC
/begin CHARACTERISTIC CDTDVEL "" VALUE 0x8E759A KwUw 65535.00 dez 0.00 65535.00 FORMAT "%8.2" /end CHARACTERISTIC
/begin CHARACTERISTIC CDTDVEN "" VALUE 0x8E759C KwUw 65535.00 dez 0.00 65535.00 FORMAT "%8.2" /end CHARACTERISTIC
/begin CHARACTERISTIC CDTDVER "" VALUE 0x8E759E KwUw 65535.00 dez 0.00 65535.00 FORMAT "%8.2" /end CHARACTERISTIC
/begin CHARACTERISTIC CDTDVET "" VALUE 0x8E75A0 KwUw 65535.00 dez 0.00 65535.00 FORMAT "%8.2" /end CHARACTERISTIC
/begin CHARACTERISTIC CDTDVEU "" VALUE 0x8E75A2 KwUw 65535.00 dez 0.00 65535.00 FORMAT "%8.2" /end CHARACTERISTIC
/begin CHARACTERISTIC CDTDVEUB "" VALUE 0x8E75A4 KwUw 65535.00 dez 0.00 65535.00 FORMAT "%8.2" /end CHARACTERISTIC
/begin CHARACTERISTIC CDTDVEUW "" VALUE 0x8E75A6 KwUw 65535.00 dez 0.00 65535.00 FORMAT "%8.2" /end CHARACTERISTIC
/begin CHARACTERISTIC CDTDVEV "" VALUE 0x8E75A8 KwUw 65535.00 dez 0.00 65535.00 FORMAT "%8.2" /end CHARACTERISTIC
/begin CHARACTERISTIC CDTDYLSU "" VALUE 0x8E75AA KwUw 65535.00 dez 0.00 65535.00 FORMAT "%8.2" /end CHARACTERISTIC
/begin CHARACTERISTIC CDTDYLSU2 "" VALUE 0x8E75AC KwUw 65535.00 dez 0.00 65535.00 FORMAT "%8.2" /end CHARACTERISTIC
/begin CHARACTERISTIC CDTEGFE "" VALUE 0x8E75AE KwUw 65535.00 dez 0.00 65535.00 FORMAT "%8.2" /end CHARACTERISTIC
/begin CHARACTERISTIC CDTENWS "" VALUE 0x8E75B2 KwUw 65535.00 dez 0.00 65535.00 FORMAT "%8.2" /end CHARACTERISTIC
/begin CHARACTERISTIC CDTENWSE "" VALUE 0x8E75B4 KwUw 65535.00 dez 0.00 65535.00 FORMAT "%8.2" /end CHARACTERISTIC
/begin CHARACTERISTIC CDTEPCLE "" VALUE 0x8E75B6 KwUw 65535.00 dez 0.00 65535.00 FORMAT "%8.2" /end CHARACTERISTIC
/begin CHARACTERISTIC CDTEV1 "" VALUE 0x8E75B8 KwUw 65535.00 dez 0.00 65535.00 FORMAT "%8.2" /end CHARACTERISTIC
/begin CHARACTERISTIC CDTEV2 "" VALUE 0x8E75BA KwUw 65535.00 dez 0.00 65535.00 FORMAT "%8.2" /end CHARACTERISTIC
/begin CHARACTERISTIC CDTEV3 "" VALUE 0x8E75BC KwUw 65535.00 dez 0.00 65535.00 FORMAT "%8.2" /end CHARACTERISTIC
/begin CHARACTERISTIC CDTEV4 "" VALUE 0x8E75BE KwUw 65535.00 dez 0.00 65535.00 FORMAT "%8.2" /end CHARACTERISTIC
/begin CHARACTERISTIC CDTEV5 "" VALUE 0x8E75C0 KwUw 65535.00 dez 0.00 65535.00 FORMAT "%8.2" /end CHARACTERISTIC
/begin CHARACTERISTIC CDTEV6 "" VALUE 0x8E75C2 KwUw 65535.00 dez 0.00 65535.00 FORMAT "%8.2" /end CHARACTERISTIC
/begin CHARACTERISTIC CDTHELSU "" VALUE 0x8E75DA KwUw 65535.00 dez 0.00 65535.00 FORMAT "%8.2" /end CHARACTERISTIC
/begin CHARACTERISTIC CDTHELSU2 "" VALUE 0x8E75DC KwUw 65535.00 dez 0.00 65535.00 FORMAT "%8.2" /end CHARACTERISTIC
/begin CHARACTERISTIC CDTHSH "" VALUE 0x8E75E0 KwUw 65535.00 dez 0.00 65535.00 FORMAT "%8.2" /end CHARACTERISTIC
/begin CHARACTERISTIC CDTHSH2 "" VALUE 0x8E75E2 KwUw 65535.00 dez 0.00 65535.00 FORMAT "%8.2" /end CHARACTERISTIC
/begin CHARACTERISTIC CDTHSHE "" VALUE 0x8E75E4 KwUw 65535.00 dez 0.00 65535.00 FORMAT "%8.2" /end CHARACTERISTIC
/begin CHARACTERISTIC CDTHSHE2 "" VALUE 0x8E75E6 KwUw 65535.00 dez 0.00 65535.00 FORMAT "%8.2" /end CHARACTERISTIC
/begin CHARACTERISTIC CDTHSV "" VALUE 0x8E75E8 KwUw 65535.00 dez 0.00 65535.00 FORMAT "%8.2" /end CHARACTERISTIC
/begin CHARACTERISTIC CDTHSV2 "" VALUE 0x8E75EA KwUw 65535.00 dez 0.00 65535.00 FORMAT "%8.2" /end CHARACTERISTIC
/begin CHARACTERISTIC CDTHSVE "" VALUE 0x8E75EC KwUw 65535.00 dez 0.00 65535.00 FORMAT "%8.2" /end CHARACTERISTIC
/begin CHARACTERISTIC CDTHSVE2 "" VALUE 0x8E75EE KwUw 65535.00 dez 0.00 65535.00 FORMAT "%8.2" /end CHARACTERISTIC
/begin CHARACTERISTIC CDTICLSU "" VALUE 0x8E75F0 KwUw 65535.00 dez 0.00 65535.00 FORMAT "%8.2" /end CHARACTERISTIC
/begin CHARACTERISTIC CDTICLSU2 "" VALUE 0x8E75F2 KwUw 65535.00 dez 0.00 65535.00 FORMAT "%8.2" /end CHARACTERISTIC
/begin CHARACTERISTIC CDTKPE "" VALUE 0x8E75F8 KwUw 65535.00 dez 0.00 65535.00 FORMAT "%8.2" /end CHARACTERISTIC
/begin CHARACTERISTIC CDTLDPE "" VALUE 0x8E761E KwUw 65535.00 dez 0.00 65535.00 FORMAT "%8.2" /end CHARACTERISTIC
/begin CHARACTERISTIC CDTLSUIA "" VALUE 0x8E762A KwUw 65535.00 dez 0.00 65535.00 FORMAT "%8.2" /end CHARACTERISTIC
/begin CHARACTERISTIC CDTLSUIA2 "" VALUE 0x8E762C KwUw 65535.00 dez 0.00 65535.00 FORMAT "%8.2" /end CHARACTERISTIC
/begin CHARACTERISTIC CDTLSUIP "" VALUE 0x8E762E KwUw 65535.00 dez 0.00 65535.00 FORMAT "%8.2" /end CHARACTERISTIC
/begin CHARACTERISTIC CDTLSUIP2 "" VALUE 0x8E7630 KwUw 65535.00 dez 0.00 65535.00 FORMAT "%8.2" /end CHARACTERISTIC
/begin CHARACTERISTIC CDTLSUKS "" VALUE 0x8E7632 KwUw 65535.00 dez 0.00 65535.00 FORMAT "%8.2" /end CHARACTERISTIC
/begin CHARACTERISTIC CDTLSUKS2 "" VALUE 0x8E7634 KwUw 65535.00 dez 0.00 65535.00 FORMAT "%8.2" /end CHARACTERISTIC
/begin CHARACTERISTIC CDTLSUUN "" VALUE 0x8E7636 KwUw 65535.00 dez 0.00 65535.00 FORMAT "%8.2" /end CHARACTERISTIC
/begin CHARACTERISTIC CDTLSUUN2 "" VALUE 0x8E7638 KwUw 65535.00 dez 0.00 65535.00 FORMAT "%8.2" /end CHARACTERISTIC
/begin CHARACTERISTIC CDTLSUVM "" VALUE 0x8E763A KwUw 65535.00 dez 0.00 65535.00 FORMAT "%8.2" /end CHARACTERISTIC
/begin CHARACTERISTIC CDTLSUVM2 "" VALUE 0x8E763C KwUw 65535.00 dez 0.00 65535.00 FORMAT "%8.2" /end CHARACTERISTIC
/begin CHARACTERISTIC CDTLUES1E "" VALUE 0x8E7646 KwUw 65535.00 dez 0.00 65535.00 FORMAT "%8.2" /end CHARACTERISTIC
/begin CHARACTERISTIC CDTN "" VALUE 0x8E765C KwUw 65535.00 dez 0.00 65535.00 FORMAT "%8.2" /end CHARACTERISTIC
/begin CHARACTERISTIC CDTSLPE "" VALUE 0x8E767C KwUw 65535.00 dez 0.00 65535.00 FORMAT "%8.2" /end CHARACTERISTIC
/begin CHARACTERISTIC CDTSLVE "" VALUE 0x8E7686 KwUw 65535.00 dez 0.00 65535.00 FORMAT "%8.2" /end CHARACTERISTIC
/begin CHARACTERISTIC CDTSUE "" VALUE 0x8E7688 KwUw 65535.00 dez 0.00 65535.00 FORMAT "%8.2" /end CHARACTERISTIC
/begin CHARACTERISTIC CDTTEVE "" VALUE 0x8E7696 KwUw 65535.00 dez 0.00 65535.00 FORMAT "%8.2" /end CHARACTERISTIC
/begin CHARACTERISTIC CDTZET1 "" VALUE 0x8E76C6 KwUw 65535.00 dez 0.00 65535.00 FORMAT "%8.2" /end CHARACTERISTIC
/begin CHARACTERISTIC CDTZET2 "" VALUE 0x8E76C8 KwUw 65535.00 dez 0.00 65535.00 FORMAT "%8.2" /end CHARACTERISTIC
/begin CHARACTERISTIC CDTZET3 "" VALUE 0x8E76CA KwUw 65535.00 dez 0.00 65535.00 FORMAT "%8.2" /end CHARACTERISTIC
/begin CHARACTERISTIC CDTZET4 "" VALUE 0x8E76CC KwUw 65535.00 dez 0.00 65535.00 FORMAT "%8.2" /end CHARACTERISTIC
/begin CHARACTERISTIC CDTZET5 "" VALUE 0x8E76CE KwUw 65535.00 dez 0.00 65535.00 FORMAT "%8.2" /end CHARACTERISTIC
/begin CHARACTERISTIC CDTZET6 "" VALUE 0x8E76D0 KwUw 65535.00 dez 0.00 65535.00 FORMAT "%8.2" /end CHARACTERISTIC
/begin CHARACTERISTIC CDTZWPE "" VALUE 0x8E76D2 KwUw 65535.00 dez 0.00 65535.00 FORMAT "%8.2" /end CHARACTERISTIC
/begin CHARACTERISTIC CDTZZZ "" VALUE 0x8E76D4 KwUw 65535.00 dez 0.00 65535.00 FORMAT "%8.2" /end CHARACTERISTIC
/begin CHARACTERISTIC CLAAAA "" VALUE 0x8E05EB KwUb 255.0 dez 0.00 255.0 FORMAT "%5.1" /end CHARACTERISTIC
/begin CHARACTERISTIC CLAAKRE "" VALUE 0x8E05ED KwUb 255.0 dez 0.00 255.0 FORMAT "%5.1" /end CHARACTERISTIC
/begin CHARACTERISTIC CLAANWS "" VALUE 0x8E05EE KwUb 255.0 dez 0.00 255.0 FORMAT "%5.1" /end CHARACTERISTIC
/begin CHARACTERISTIC CLAANWSE "" VALUE 0x8E05EF KwUb 255.0 dez 0.00 255.0 FORMAT "%5.1" /end CHARACTERISTIC
/begin CHARACTERISTIC CLABKVP "" VALUE 0x8E05F1 KwUb 255.0 dez 0.00 255.0 FORMAT "%5.1" /end CHARACTERISTIC
/begin CHARACTERISTIC CLABKVPE "" VALUE 0x8E05F2 KwUb 255.0 dez 0.00 255.0 FORMAT "%5.1" /end CHARACTERISTIC
/begin CHARACTERISTIC CLABM "" VALUE 0x8E05F3 KwUb 255.0 dez 0.00 255.0 FORMAT "%5.1" /end CHARACTERISTIC
/begin CHARACTERISTIC CLACIF "" VALUE 0x8E05FF KwUb 255.0 dez 0.00 255.0 FORMAT "%5.1" /end CHARACTERISTIC
/begin CHARACTERISTIC CLACINS "" VALUE 0x8E0600 KwUb 255.0 dez 0.00 255.0 FORMAT "%5.1" /end CHARACTERISTIC
/begin CHARACTERISTIC CLACKLA "" VALUE 0x8E0601 KwUb 255.0 dez 0.00 255.0 FORMAT "%5.1" /end CHARACTERISTIC
/begin CHARACTERISTIC CLACLWS "" VALUE 0x8E0602 KwUb 255.0 dez 0.00 255.0 FORMAT "%5.1" /end CHARACTERISTIC
/begin CHARACTERISTIC CLACTOG "" VALUE 0x8E0603 KwUb 255.0 dez 0.00 255.0 FORMAT "%5.1" /end CHARACTERISTIC
/begin CHARACTERISTIC CLACZAS "" VALUE 0x8E0604 KwUb 255.0 dez 0.00 255.0 FORMAT "%5.1" /end CHARACTERISTIC
/begin CHARACTERISTIC CLADK "" VALUE 0x8E0605 KwUb 255.0 dez 0.00 255.0 FORMAT "%5.1" /end CHARACTERISTIC
/begin CHARACTERISTIC CLADK1P "" VALUE 0x8E0606 KwUb 255.0 dez 0.00 255.0 FORMAT "%5.1" /end CHARACTERISTIC
/begin CHARACTERISTIC CLADK2P "" VALUE 0x8E0607 KwUb 255.0 dez 0.00 255.0 FORMAT "%5.1" /end CHARACTERISTIC
/begin CHARACTERISTIC CLADVEE "" VALUE 0x8E060B KwUb 255.0 dez 0.00 255.0 FORMAT "%5.1" /end CHARACTERISTIC
/begin CHARACTERISTIC CLADVEF "" VALUE 0x8E060C KwUb 255.0 dez 0.00 255.0 FORMAT "%5.1" /end CHARACTERISTIC
/begin CHARACTERISTIC CLADVEFO "" VALUE 0x8E060D KwUb 255.0 dez 0.00 255.0 FORMAT "%5.1" /end CHARACTERISTIC
/begin CHARACTERISTIC CLADVEL "" VALUE 0x8E060E KwUb 255.0 dez 0.00 255.0 FORMAT "%5.1" /end CHARACTERISTIC
/begin CHARACTERISTIC CLADVEN "" VALUE 0x8E060F KwUb 255.0 dez 0.00 255.0 FORMAT "%5.1" /end CHARACTERISTIC
/begin CHARACTERISTIC CLADVER "" VALUE 0x8E0610 KwUb 255.0 dez 0.00 255.0 FORMAT "%5.1" /end CHARACTERISTIC
/begin CHARACTERISTIC CLADVET "" VALUE 0x8E0611 KwUb 255.0 dez 0.00 255.0 FORMAT "%5.1" /end CHARACTERISTIC
/begin CHARACTERISTIC CLADVEU "" VALUE 0x8E0612 KwUb 255.0 dez 0.00 255.0 FORMAT "%5.1" /end CHARACTERISTIC
/begin CHARACTERISTIC CLADVEUB "" VALUE 0x8E0613 KwUb 255.0 dez 0.00 255.0 FORMAT "%5.1" /end CHARACTERISTIC
/begin CHARACTERISTIC CLADVEUW "" VALUE 0x8E0614 KwUb 255.0 dez 0.00 255.0 FORMAT "%5.1" /end CHARACTERISTIC
/begin CHARACTERISTIC CLADVEV "" VALUE 0x8E0615 KwUb 255.0 dez 0.00 255.0 FORMAT "%5.1" /end CHARACTERISTIC
/begin CHARACTERISTIC CLADYLSU "" VALUE 0x8E0616 KwUb 255.0 dez 0.00 255.0 FORMAT "%5.1" /end CHARACTERISTIC
/begin CHARACTERISTIC CLADYLSU2 "" VALUE 0x8E0617 KwUb 255.0 dez 0.00 255.0 FORMAT "%5.1" /end CHARACTERISTIC
/begin CHARACTERISTIC CLAEGFE "" VALUE 0x8E0618 KwUb 255.0 dez 0.00 255.0 FORMAT "%5.1" /end CHARACTERISTIC
/begin CHARACTERISTIC CLAENWS "" VALUE 0x8E061A KwUb 255.0 dez 0.00 255.0 FORMAT "%5.1" /end CHARACTERISTIC
/begin CHARACTERISTIC CLAENWSE "" VALUE 0x8E061B KwUb 255.0 dez 0.00 255.0 FORMAT "%5.1" /end CHARACTERISTIC
/begin CHARACTERISTIC CLAEPCLE "" VALUE 0x8E061C KwUb 255.0 dez 0.00 255.0 FORMAT "%5.1" /end CHARACTERISTIC
/begin CHARACTERISTIC CLAEV1 "" VALUE 0x8E061D KwUb 255.0 dez 0.00 255.0 FORMAT "%5.1" /end CHARACTERISTIC
/begin CHARACTERISTIC CLAEV2 "" VALUE 0x8E061E KwUb 255.0 dez 0.00 255.0 FORMAT "%5.1" /end CHARACTERISTIC
/begin CHARACTERISTIC CLAEV3 "" VALUE 0x8E061F KwUb 255.0 dez 0.00 255.0 FORMAT "%5.1" /end CHARACTERISTIC
/begin CHARACTERISTIC CLAEV4 "" VALUE 0x8E0620 KwUb 255.0 dez 0.00 255.0 FORMAT "%5.1" /end CHARACTERISTIC
/begin CHARACTERISTIC CLAEV5 "" VALUE 0x8E0621 KwUb 255.0 dez 0.00 255.0 FORMAT "%5.1" /end CHARACTERISTIC
/begin CHARACTERISTIC CLAEV6 "" VALUE 0x8E0622 KwUb 255.0 dez 0.00 255.0 FORMAT "%5.1" /end CHARACTERISTIC
/begin CHARACTERISTIC CLAHELSU "" VALUE 0x8E062E KwUb 255.0 dez 0.00 255.0 FORMAT "%5.1" /end CHARACTERISTIC
/begin CHARACTERISTIC CLAHELSU2 "" VALUE 0x8E062F KwUb 255.0 dez 0.00 255.0 FORMAT "%5.1" /end CHARACTERISTIC
/begin CHARACTERISTIC CLAHSH "" VALUE 0x8E0631 KwUb 255.0 dez 0.00 255.0 FORMAT "%5.1" /end CHARACTERISTIC
/begin CHARACTERISTIC CLAHSH2 "" VALUE 0x8E0632 KwUb 255.0 dez 0.00 255.0 FORMAT "%5.1" /end CHARACTERISTIC
/begin CHARACTERISTIC CLAHSHE "" VALUE 0x8E0633 KwUb 255.0 dez 0.00 255.0 FORMAT "%5.1" /end CHARACTERISTIC
/begin CHARACTERISTIC CLAHSHE2 "" VALUE 0x8E0634 KwUb 255.0 dez 0.00 255.0 FORMAT "%5.1" /end CHARACTERISTIC
/begin CHARACTERISTIC CLAHSV "" VALUE 0x8E0635 KwUb 255.0 dez 0.00 255.0 FORMAT "%5.1" /end CHARACTERISTIC
/begin CHARACTERISTIC CLAHSV2 "" VALUE 0x8E0636 KwUb 255.0 dez 0.00 255.0 FORMAT "%5.1" /end CHARACTERISTIC
/begin CHARACTERISTIC CLAHSVE "" VALUE 0x8E0637 KwUb 255.0 dez 0.00 255.0 FORMAT "%5.1" /end CHARACTERISTIC
/begin CHARACTERISTIC CLAHSVE2 "" VALUE 0x8E0638 KwUb 255.0 dez 0.00 255.0 FORMAT "%5.1" /end CHARACTERISTIC
/begin CHARACTERISTIC CLAICLSU "" VALUE 0x8E0639 KwUb 255.0 dez 0.00 255.0 FORMAT "%5.1" /end CHARACTERISTIC
/begin CHARACTERISTIC CLAICLSU2 "" VALUE 0x8E063A KwUb 255.0 dez 0.00 255.0 FORMAT "%5.1" /end CHARACTERISTIC
/begin CHARACTERISTIC CLAKPE "" VALUE 0x8E063D KwUb 255.0 dez 0.00 255.0 FORMAT "%5.1" /end CHARACTERISTIC
/begin CHARACTERISTIC CLALDPE "" VALUE 0x8E0650 KwUb 255.0 dez 0.00 255.0 FORMAT "%5.1" /end CHARACTERISTIC
/begin CHARACTERISTIC CLALSUIA "" VALUE 0x8E0656 KwUb 255.0 dez 0.00 255.0 FORMAT "%5.1" /end CHARACTERISTIC
/begin CHARACTERISTIC CLALSUIA2 "" VALUE 0x8E0657 KwUb 255.0 dez 0.00 255.0 FORMAT "%5.1" /end CHARACTERISTIC
/begin CHARACTERISTIC CLALSUIP "" VALUE 0x8E0658 KwUb 255.0 dez 0.00 255.0 FORMAT "%5.1" /end CHARACTERISTIC
/begin CHARACTERISTIC CLALSUIP2 "" VALUE 0x8E0659 KwUb 255.0 dez 0.00 255.0 FORMAT "%5.1" /end CHARACTERISTIC
/begin CHARACTERISTIC CLALSUKS "" VALUE 0x8E065A KwUb 255.0 dez 0.00 255.0 FORMAT "%5.1" /end CHARACTERISTIC
/begin CHARACTERISTIC CLALSUKS2 "" VALUE 0x8E065B KwUb 255.0 dez 0.00 255.0 FORMAT "%5.1" /end CHARACTERISTIC
/begin CHARACTERISTIC CLALSUUN "" VALUE 0x8E065C KwUb 255.0 dez 0.00 255.0 FORMAT "%5.1" /end CHARACTERISTIC
/begin CHARACTERISTIC CLALSUUN2 "" VALUE 0x8E065D KwUb 255.0 dez 0.00 255.0 FORMAT "%5.1" /end CHARACTERISTIC
/begin CHARACTERISTIC CLALSUVM "" VALUE 0x8E065E KwUb 255.0 dez 0.00 255.0 FORMAT "%5.1" /end CHARACTERISTIC
/begin CHARACTERISTIC CLALSUVM2 "" VALUE 0x8E065F KwUb 255.0 dez 0.00 255.0 FORMAT "%5.1" /end CHARACTERISTIC
/begin CHARACTERISTIC CLALUES1E "" VALUE 0x8E0664 KwUb 255.0 dez 0.00 255.0 FORMAT "%5.1" /end CHARACTERISTIC
/begin CHARACTERISTIC CLAN "" VALUE 0x8E066F KwUb 255.0 dez 0.00 255.0 FORMAT "%5.1" /end CHARACTERISTIC
/begin CHARACTERISTIC CLASLPE "" VALUE 0x8E067F KwUb 255.0 dez 0.00 255.0 FORMAT "%5.1" /end CHARACTERISTIC
/begin CHARACTERISTIC CLASLVE "" VALUE 0x8E0684 KwUb 255.0 dez 0.00 255.0 FORMAT "%5.1" /end CHARACTERISTIC
/begin CHARACTERISTIC CLASUE "" VALUE 0x8E0685 KwUb 255.0 dez 0.00 255.0 FORMAT "%5.1" /end CHARACTERISTIC
/begin CHARACTERISTIC CLATEVE "" VALUE 0x8E068C KwUb 255.0 dez 0.00 255.0 FORMAT "%5.1" /end CHARACTERISTIC
/begin CHARACTERISTIC CLAZET1 "" VALUE 0x8E06A4 KwUb 255.0 dez 0.00 255.0 FORMAT "%5.1" /end CHARACTERISTIC
/begin CHARACTERISTIC CLAZET2 "" VALUE 0x8E06A5 KwUb 255.0 dez 0.00 255.0 FORMAT "%5.1" /end CHARACTERISTIC
/begin CHARACTERISTIC CLAZET3 "" VALUE 0x8E06A6 KwUb 255.0 dez 0.00 255.0 FORMAT "%5.1" /end CHARACTERISTIC
/begin CHARACTERISTIC CLAZET4 "" VALUE 0x8E06A7 KwUb 255.0 dez 0.00 255.0 FORMAT "%5.1" /end CHARACTERISTIC
/begin CHARACTERISTIC CLAZET5 "" VALUE 0x8E06A8 KwUb 255.0 dez 0.00 255.0 FORMAT "%5.1" /end CHARACTERISTIC
/begin CHARACTERISTIC CLAZET6 "" VALUE 0x8E06A9 KwUb 255.0 dez 0.00 255.0 FORMAT "%5.1" /end CHARACTERISTIC
/begin CHARACTERISTIC CLAZWPE "" VALUE 0x8E06AA KwUb 255.0 dez 0.00 255.0 FORMAT "%5.1" /end CHARACTERISTIC
/begin CHARACTERISTIC CLAZZZ "" VALUE 0x8E06AB KwUb 255.0 dez 0.00 255.0 FORMAT "%5.1" /end CHARACTERISTIC
/begin CHARACTERISTIC FFTAAA "" VAL_BLK 0x8E06AC KwbUb 255.0 dez 0.00 255.0 FORMAT "%5.1" NUMBER 2 /end CHARACTERISTIC
/begin CHARACTERISTIC FFTAKRE "" VAL_BLK 0x8E06B0 KwbUb 255.0 dez 0.00 255.0 FORMAT "%5.1" NUMBER 2 /end CHARACTERISTIC
/begin CHARACTERISTIC FFTANWS "" VAL_BLK 0x8E06B2 KwbUb 255.0 dez 0.00 255.0 FORMAT "%5.1" NUMBER 2 /end CHARACTERISTIC
/begin CHARACTERISTIC FFTANWSE "" VAL_BLK 0x8E06B4 KwbUb 255.0 dez 0.00 255.0 FORMAT "%5.1" NUMBER 2 /end CHARACTERISTIC
/begin CHARACTERISTIC FFTBKVP "" VAL_BLK 0x8E06B8 KwbUb 255.0 dez 0.00 255.0 FORMAT "%5.1" NUMBER 2 /end CHARACTERISTIC
/begin CHARACTERISTIC FFTBKVPE "" VAL_BLK 0x8E06BA KwbUb 255.0 dez 0.00 255.0 FORMAT "%5.1" NUMBER 2 /end CHARACTERISTIC
/begin CHARACTERISTIC FFTBM "" VAL_BLK 0x8E06BC KwbUb 255.0 dez 0.00 255.0 FORMAT "%5.1" NUMBER 2 /end CHARACTERISTIC
/begin CHARACTERISTIC FFTCIF "" VAL_BLK 0x8E06D4 KwbUb 255.0 dez 0.00 255.0 FORMAT "%5.1" NUMBER 2 /end CHARACTERISTIC
/begin CHARACTERISTIC FFTCINS "" VAL_BLK 0x8E06D6 KwbUb 255.0 dez 0.00 255.0 FORMAT "%5.1" NUMBER 2 /end CHARACTERISTIC
/begin CHARACTERISTIC FFTCKLA "" VAL_BLK 0x8E06D8 KwbUb 255.0 dez 0.00 255.0 FORMAT "%5.1" NUMBER 2 /end CHARACTERISTIC
/begin CHARACTERISTIC FFTCLWS "" VAL_BLK 0x8E06DA KwbUb 255.0 dez 0.00 255.0 FORMAT "%5.1" NUMBER 2 /end CHARACTERISTIC
/begin CHARACTERISTIC FFTCTOG "" VAL_BLK 0x8E06DC KwbUb 255.0 dez 0.00 255.0 FORMAT "%5.1" NUMBER 2 /end CHARACTERISTIC
/begin CHARACTERISTIC FFTCZAS "" VAL_BLK 0x8E06DE KwbUb 255.0 dez 0.00 255.0 FORMAT "%5.1" NUMBER 2 /end CHARACTERISTIC
/begin CHARACTERISTIC FFTDK "" VAL_BLK 0x8E06E0 KwbUb 255.0 dez 0.00 255.0 FORMAT "%5.1" NUMBER 2 /end CHARACTERISTIC
/begin CHARACTERISTIC FFTDK1P "" VAL_BLK 0x8E06E2 KwbUb 255.0 dez 0.00 255.0 FORMAT "%5.1" NUMBER 2 /end CHARACTERISTIC
/begin CHARACTERISTIC FFTDK2P "" VAL_BLK 0x8E06E4 KwbUb 255.0 dez 0.00 255.0 FORMAT "%5.1" NUMBER 2 /end CHARACTERISTIC
/begin CHARACTERISTIC FFTDVEE "" VAL_BLK 0x8E06EC KwbUb 255.0 dez 0.00 255.0 FORMAT "%5.1" NUMBER 2 /end CHARACTERISTIC
/begin CHARACTERISTIC FFTDVEF "" VAL_BLK 0x8E06EE KwbUb 255.0 dez 0.00 255.0 FORMAT "%5.1" NUMBER 2 /end CHARACTERISTIC
/begin CHARACTERISTIC FFTDVEFO "" VAL_BLK 0x8E06F0 KwbUb 255.0 dez 0.00 255.0 FORMAT "%5.1" NUMBER 2 /end CHARACTERISTIC
/begin CHARACTERISTIC FFTDVEL "" VAL_BLK 0x8E06F2 KwbUb 255.0 dez 0.00 255.0 FORMAT "%5.1" NUMBER 2 /end CHARACTERISTIC
/begin CHARACTERISTIC FFTDVEN "" VAL_BLK 0x8E06F4 KwbUb 255.0 dez 0.00 255.0 FORMAT "%5.1" NUMBER 2 /end CHARACTERISTIC
/begin CHARACTERISTIC FFTDVER "" VAL_BLK 0x8E06F6 KwbUb 255.0 dez 0.00 255.0 FORMAT "%5.1" NUMBER 2 /end CHARACTERISTIC
/begin CHARACTERISTIC FFTDVET "" VAL_BLK 0x8E06F8 KwbUb 255.0 dez 0.00 255.0 FORMAT "%5.1" NUMBER 2 /end CHARACTERISTIC
/begin CHARACTERISTIC FFTDVEU "" VAL_BLK 0x8E06FA KwbUb 255.0 dez 0.00 255.0 FORMAT "%5.1" NUMBER 2 /end CHARACTERISTIC
/begin CHARACTERISTIC FFTDVEUB "" VAL_BLK 0x8E06FC KwbUb 255.0 dez 0.00 255.0 FORMAT "%5.1" NUMBER 2 /end CHARACTERISTIC
/begin CHARACTERISTIC FFTDVEUW "" VAL_BLK 0x8E06FE KwbUb 255.0 dez 0.00 255.0 FORMAT "%5.1" NUMBER 2 /end CHARACTERISTIC
/begin CHARACTERISTIC FFTDVEV "" VAL_BLK 0x8E0700 KwbUb 255.0 dez 0.00 255.0 FORMAT "%5.1" NUMBER 2 /end CHARACTERISTIC
/begin CHARACTERISTIC FFTDYLSU "" VAL_BLK 0x8E0702 KwbUb 255.0 dez 0.00 255.0 FORMAT "%5.1" NUMBER 2 /end CHARACTERISTIC
/begin CHARACTERISTIC FFTDYLSU2 "" VAL_BLK 0x8E0704 KwbUb 255.0 dez 0.00 255.0 FORMAT "%5.1" NUMBER 2 /end CHARACTERISTIC
/begin CHARACTERISTIC FFTEGFE "" VAL_BLK 0x8E0706 KwbUb 255.0 dez 0.00 255.0 FORMAT "%5.1" NUMBER 2 /end CHARACTERISTIC
/begin CHARACTERISTIC FFTENWS "" VAL_BLK 0x8E070A KwbUb 255.0 dez 0.00 255.0 FORMAT "%5.1" NUMBER 2 /end CHARACTERISTIC
/begin CHARACTERISTIC FFTENWSE "" VAL_BLK 0x8E070C KwbUb 255.0 dez 0.00 255.0 FORMAT "%5.1" NUMBER 2 /end CHARACTERISTIC
/begin CHARACTERISTIC FFTEPCLE "" VAL_BLK 0x8E070E KwbUb 255.0 dez 0.00 255.0 FORMAT "%5.1" NUMBER 2 /end CHARACTERISTIC
/begin CHARACTERISTIC FFTEV1 "" VAL_BLK 0x8E0710 KwbUb 255.0 dez 0.00 255.0 FORMAT "%5.1" NUMBER 2 /end CHARACTERISTIC
/begin CHARACTERISTIC FFTEV2 "" VAL_BLK 0x8E0712 KwbUb 255.0 dez 0.00 255.0 FORMAT "%5.1" NUMBER 2 /end CHARACTERISTIC
/begin CHARACTERISTIC FFTEV3 "" VAL_BLK 0x8E0714 KwbUb 255.0 dez 0.00 255.0 FORMAT "%5.1" NUMBER 2 /end CHARACTERISTIC
/begin CHARACTERISTIC FFTEV4 "" VAL_BLK 0x8E0716 KwbUb 255.0 dez 0.00 255.0 FORMAT "%5.1" NUMBER 2 /end CHARACTERISTIC
/begin CHARACTERISTIC FFTEV5 "" VAL_BLK 0x8E0718 KwbUb 255.0 dez 0.00 255.0 FORMAT "%5.1" NUMBER 2 /end CHARACTERISTIC
/begin CHARACTERISTIC FFTEV6 "" VAL_BLK 0x8E071A KwbUb 255.0 dez 0.00 255.0 FORMAT "%5.1" NUMBER 2 /end CHARACTERISTIC
/begin CHARACTERISTIC FFTHELSU "" VAL_BLK 0x8E0732 KwbUb 255.0 dez 0.00 255.0 FORMAT "%5.1" NUMBER 2 /end CHARACTERISTIC
/begin CHARACTERISTIC FFTHELSU2 "" VAL_BLK 0x8E0734 KwbUb 255.0 dez 0.00 255.0 FORMAT "%5.1" NUMBER 2 /end CHARACTERISTIC
/begin CHARACTERISTIC FFTHSH "" VAL_BLK 0x8E0738 KwbUb 255.0 dez 0.00 255.0 FORMAT "%5.1" NUMBER 2 /end CHARACTERISTIC
/begin CHARACTERISTIC FFTHSH2 "" VAL_BLK 0x8E073A KwbUb 255.0 dez 0.00 255.0 FORMAT "%5.1" NUMBER 2 /end CHARACTERISTIC
/begin CHARACTERISTIC FFTHSHE "" VAL_BLK 0x8E073C KwbUb 255.0 dez 0.00 255.0 FORMAT "%5.1" NUMBER 2 /end CHARACTERISTIC
/begin CHARACTERISTIC FFTHSHE2 "" VAL_BLK 0x8E073E KwbUb 255.0 dez 0.00 255.0 FORMAT "%5.1" NUMBER 2 /end CHARACTERISTIC
/begin CHARACTERISTIC FFTHSV "" VAL_BLK 0x8E0740 KwbUb 255.0 dez 0.00 255.0 FORMAT "%5.1" NUMBER 2 /end CHARACTERISTIC
/begin CHARACTERISTIC FFTHSV2 "" VAL_BLK 0x8E0742 KwbUb 255.0 dez 0.00 255.0 FORMAT "%5.1" NUMBER 2 /end CHARACTERISTIC
/begin CHARACTERISTIC FFTHSVE "" VAL_BLK 0x8E0744 KwbUb 255.0 dez 0.00 255.0 FORMAT "%5.1" NUMBER 2 /end CHARACTERISTIC
/begin CHARACTERISTIC FFTHSVE2 "" VAL_BLK 0x8E0746 KwbUb 255.0 dez 0.00 255.0 FORMAT "%5.1" NUMBER 2 /end CHARACTERISTIC
/begin CHARACTERISTIC FFTICLSU "" VAL_BLK 0x8E0748 KwbUb 255.0 dez 0.00 255.0 FORMAT "%5.1" NUMBER 2 /end CHARACTERISTIC
/begin CHARACTERISTIC FFTICLSU2 "" VAL_BLK 0x8E074A KwbUb 255.0 dez 0.00 255.0 FORMAT "%5.1" NUMBER 2 /end CHARACTERISTIC
/begin CHARACTERISTIC FFTKPE "" VAL_BLK 0x8E0750 KwbUb 255.0 dez 0.00 255.0 FORMAT "%5.1" NUMBER 2 /end CHARACTERISTIC
/begin CHARACTERISTIC FFTLDPE "" VAL_BLK 0x8E0776 KwbUb 255.0 dez 0.00 255.0 FORMAT "%5.1" NUMBER 2 /end CHARACTERISTIC
/begin CHARACTERISTIC FFTLSUIA "" VAL_BLK 0x8E0782 KwbUb 255.0 dez 0.00 255.0 FORMAT "%5.1" NUMBER 2 /end CHARACTERISTIC
/begin CHARACTERISTIC FFTLSUIA2 "" VAL_BLK 0x8E0784 KwbUb 255.0 dez 0.00 255.0 FORMAT "%5.1" NUMBER 2 /end CHARACTERISTIC
/begin CHARACTERISTIC FFTLSUIP "" VAL_BLK 0x8E0786 KwbUb 255.0 dez 0.00 255.0 FORMAT "%5.1" NUMBER 2 /end CHARACTERISTIC
/begin CHARACTERISTIC FFTLSUIP2 "" VAL_BLK 0x8E0788 KwbUb 255.0 dez 0.00 255.0 FORMAT "%5.1" NUMBER 2 /end CHARACTERISTIC
/begin CHARACTERISTIC FFTLSUKS "" VAL_BLK 0x8E078A KwbUb 255.0 dez 0.00 255.0 FORMAT "%5.1" NUMBER 2 /end CHARACTERISTIC
/begin CHARACTERISTIC FFTLSUKS2 "" VAL_BLK 0x8E078C KwbUb 255.0 dez 0.00 255.0 FORMAT "%5.1" NUMBER 2 /end CHARACTERISTIC
/begin CHARACTERISTIC FFTLSUUN "" VAL_BLK 0x8E078E KwbUb 255.0 dez 0.00 255.0 FORMAT "%5.1" NUMBER 2 /end CHARACTERISTIC
/begin CHARACTERISTIC FFTLSUUN2 "" VAL_BLK 0x8E0790 KwbUb 255.0 dez 0.00 255.0 FORMAT "%5.1" NUMBER 2 /end CHARACTERISTIC
/begin CHARACTERISTIC FFTLSUVM "" VAL_BLK 0x8E0792 KwbUb 255.0 dez 0.00 255.0 FORMAT "%5.1" NUMBER 2 /end CHARACTERISTIC
/begin CHARACTERISTIC FFTLSUVM2 "" VAL_BLK 0x8E0794 KwbUb 255.0 dez 0.00 255.0 FORMAT "%5.1" NUMBER 2 /end CHARACTERISTIC
/begin CHARACTERISTIC FFTLUES1E "" VAL_BLK 0x8E079E KwbUb 255.0 dez 0.00 255.0 FORMAT "%5.1" NUMBER 2 /end CHARACTERISTIC
/begin CHARACTERISTIC FFTN "" VAL_BLK 0x8E07B4 KwbUb 255.0 dez 0.00 255.0 FORMAT "%5.1" NUMBER 2 /end CHARACTERISTIC
/begin CHARACTERISTIC FFTSLPE "" VAL_BLK 0x8E07D4 KwbUb 255.0 dez 0.00 255.0 FORMAT "%5.1" NUMBER 2 /end CHARACTERISTIC
/begin CHARACTERISTIC FFTSLVE "" VAL_BLK 0x8E07DE KwbUb 255.0 dez 0.00 255.0 FORMAT "%5.1" NUMBER 2 /end CHARACTERISTIC
/begin CHARACTERISTIC FFTSUE "" VAL_BLK 0x8E07E0 KwbUb 255.0 dez 0.00 255.0 FORMAT "%5.1" NUMBER 2 /end CHARACTERISTIC
/begin CHARACTERISTIC FFTTEVE "" VAL_BLK 0x8E07EE KwbUb 255.0 dez 0.00 255.0 FORMAT "%5.1" NUMBER 2 /end CHARACTERISTIC
/begin CHARACTERISTIC FFTZET1 "" VAL_BLK 0x8E081E KwbUb 255.0 dez 0.00 255.0 FORMAT "%5.1" NUMBER 2 /end CHARACTERISTIC
/begin CHARACTERISTIC FFTZET2 "" VAL_BLK 0x8E0820 KwbUb 255.0 dez 0.00 255.0 FORMAT "%5.1" NUMBER 2 /end CHARACTERISTIC
/begin CHARACTERISTIC FFTZET3 "" VAL_BLK 0x8E0822 KwbUb 255.0 dez 0.00 255.0 FORMAT "%5.1" NUMBER 2 /end CHARACTERISTIC
/begin CHARACTERISTIC FFTZET4 "" VAL_BLK 0x8E0824 KwbUb 255.0 dez 0.00 255.0 FORMAT "%5.1" NUMBER 2 /end CHARACTERISTIC
/begin CHARACTERISTIC FFTZET5 "" VAL_BLK 0x8E0826 KwbUb 255.0 dez 0.00 255.0 FORMAT "%5.1" NUMBER 2 /end CHARACTERISTIC
/begin CHARACTERISTIC FFTZET6 "" VAL_BLK 0x8E0828 KwbUb 255.0 dez 0.00 255.0 FORMAT "%5.1" NUMBER 2 /end CHARACTERISTIC
/begin CHARACTERISTIC FFTZWPE "" VAL_BLK 0x8E082A KwbUb 255.0 dez 0.00 255.0 FORMAT "%5.1" NUMBER 2 /end CHARACTERISTIC
/begin CHARACTERISTIC FFTZZZ "" VAL_BLK 0x8E082C KwbUb 255.0 dez 0.00 255.0 FORMAT "%5.1" NUMBER 2 /end CHARACTERISTIC
/begin CHARACTERISTIC TSFAAA "" VALUE 0x8E082E KwUb 255.0 dez 0.00 255.0 FORMAT "%5.1" /end CHARACTERISTIC
/begin CHARACTERISTIC TSFAKRE "" VALUE 0x8E0830 KwUb 255.0 dez 0.00 255.0 FORMAT "%5.1" /end CHARACTERISTIC
/begin CHARACTERISTIC TSFANWS "" VALUE 0x8E0831 KwUb 255.0 dez 0.00 255.0 FORMAT "%5.1" /end CHARACTERISTIC
/begin CHARACTERISTIC TSFANWSE "" VALUE 0x8E0832 KwUb 255.0 dez 0.00 255.0 FORMAT "%5.1" /end CHARACTERISTIC
/begin CHARACTERISTIC TSFBKVP "" VALUE 0x8E0834 KwUb 255.0 dez 0.00 255.0 FORMAT "%5.1" /end CHARACTERISTIC
/begin CHARACTERISTIC TSFBKVPE "" VALUE 0x8E0835 KwUb 255.0 dez 0.00 255.0 FORMAT "%5.1" /end CHARACTERISTIC
/begin CHARACTERISTIC TSFBM "" VALUE 0x8E0836 KwUb 255.0 dez 0.00 255.0 FORMAT "%5.1" /end CHARACTERISTIC
/begin CHARACTERISTIC TSFCIF "" VALUE 0x8E0842 KwUb 255.0 dez 0.00 255.0 FORMAT "%5.1" /end CHARACTERISTIC
/begin CHARACTERISTIC TSFCINS "" VALUE 0x8E0843 KwUb 255.0 dez 0.00 255.0 FORMAT "%5.1" /end CHARACTERISTIC
/begin CHARACTERISTIC TSFCKLA "" VALUE 0x8E0844 KwUb 255.0 dez 0.00 255.0 FORMAT "%5.1" /end CHARACTERISTIC
/begin CHARACTERISTIC TSFCLWS "" VALUE 0x8E0845 KwUb 255.0 dez 0.00 255.0 FORMAT "%5.1" /end CHARACTERISTIC
/begin CHARACTERISTIC TSFCTOG "" VALUE 0x8E0846 KwUb 255.0 dez 0.00 255.0 FORMAT "%5.1" /end CHARACTERISTIC
/begin CHARACTERISTIC TSFCZAS "" VALUE 0x8E0847 KwUb 255.0 dez 0.00 255.0 FORMAT "%5.1" /end CHARACTERISTIC
/begin CHARACTERISTIC TSFDK "" VALUE 0x8E0848 KwUb 255.0 dez 0.00 255.0 FORMAT "%5.1" /end CHARACTERISTIC
/begin CHARACTERISTIC TSFDK1P "" VALUE 0x8E0849 KwUb 255.0 dez 0.00 255.0 FORMAT "%5.1" /end CHARACTERISTIC
/begin CHARACTERISTIC TSFDK2P "" VALUE 0x8E084A KwUb 255.0 dez 0.00 255.0 FORMAT "%5.1" /end CHARACTERISTIC
/begin CHARACTERISTIC TSFDVEE "" VALUE 0x8E084E KwUb 255.0 dez 0.00 255.0 FORMAT "%5.1" /end CHARACTERISTIC
/begin CHARACTERISTIC TSFDVEF "" VALUE 0x8E084F KwUb 255.0 dez 0.00 255.0 FORMAT "%5.1" /end CHARACTERISTIC
/begin CHARACTERISTIC TSFDVEFO "" VALUE 0x8E0850 KwUb 255.0 dez 0.00 255.0 FORMAT "%5.1" /end CHARACTERISTIC
/begin CHARACTERISTIC TSFDVEL "" VALUE 0x8E0851 KwUb 255.0 dez 0.00 255.0 FORMAT "%5.1" /end CHARACTERISTIC
/begin CHARACTERISTIC TSFDVEN "" VALUE 0x8E0852 KwUb 255.0 dez 0.00 255.0 FORMAT "%5.1" /end CHARACTERISTIC
/begin CHARACTERISTIC TSFDVER "" VALUE 0x8E0853 KwUb 255.0 dez 0.00 255.0 FORMAT "%5.1" /end CHARACTERISTIC
/begin CHARACTERISTIC TSFDVET "" VALUE 0x8E0854 KwUb 255.0 dez 0.00 255.0 FORMAT "%5.1" /end CHARACTERISTIC
/begin CHARACTERISTIC TSFDVEU "" VALUE 0x8E0855 KwUb 255.0 dez 0.00 255.0 FORMAT "%5.1" /end CHARACTERISTIC
/begin CHARACTERISTIC TSFDVEUB "" VALUE 0x8E0856 KwUb 255.0 dez 0.00 255.0 FORMAT "%5.1" /end CHARACTERISTIC
/begin CHARACTERISTIC TSFDVEUW "" VALUE 0x8E0857 KwUb 255.0 dez 0.00 255.0 FORMAT "%5.1" /end CHARACTERISTIC
/begin CHARACTERISTIC TSFDVEV "" VALUE 0x8E0858 KwUb 255.0 dez 0.00 255.0 FORMAT "%5.1" /end CHARACTERISTIC
/begin CHARACTERISTIC TSFDYLSU "" VALUE 0x8E0859 KwUb 255.0 dez 0.00 255.0 FORMAT "%5.1" /end CHARACTERISTIC
/begin CHARACTERISTIC TSFDYLSU2 "" VALUE 0x8E085A KwUb 255.0 dez 0.00 255.0 FORMAT "%5.1" /end CHARACTERISTIC
/begin CHARACTERISTIC TSFEGFE "" VALUE 0x8E085B KwUb 255.0 dez 0.00 255.0 FORMAT "%5.1" /end CHARACTERISTIC
/begin CHARACTERISTIC TSFENWS "" VALUE 0x8E085D KwUb 255.0 dez 0.00 255.0 FORMAT "%5.1" /end CHARACTERISTIC
/begin CHARACTERISTIC TSFENWSE "" VALUE 0x8E085E KwUb 255.0 dez 0.00 255.0 FORMAT "%5.1" /end CHARACTERISTIC
/begin CHARACTERISTIC TSFEPCLE "" VALUE 0x8E085F KwUb 255.0 dez 0.00 255.0 FORMAT "%5.1" /end CHARACTERISTIC
/begin CHARACTERISTIC TSFEV1 "" VALUE 0x8E0860 KwUb 255.0 dez 0.00 255.0 FORMAT "%5.1" /end CHARACTERISTIC
/begin CHARACTERISTIC TSFEV2 "" VALUE 0x8E0861 KwUb 255.0 dez 0.00 255.0 FORMAT "%5.1" /end CHARACTERISTIC
/begin CHARACTERISTIC TSFEV3 "" VALUE 0x8E0862 KwUb 255.0 dez 0.00 255.0 FORMAT "%5.1" /end CHARACTERISTIC
/begin CHARACTERISTIC TSFEV4 "" VALUE 0x8E0863 KwUb 255.0 dez 0.00 255.0 FORMAT "%5.1" /end CHARACTERISTIC
/begin CHARACTERISTIC TSFEV5 "" VALUE 0x8E0864 KwUb 255.0 dez 0.00 255.0 FORMAT "%5.1" /end CHARACTERISTIC
/begin CHARACTERISTIC TSFEV6 "" VALUE 0x8E0865 KwUb 255.0 dez 0.00 255.0 FORMAT "%5.1" /end CHARACTERISTIC
/begin CHARACTERISTIC TSFHELSU "" VALUE 0x8E0871 KwUb 255.0 dez 0.00 255.0 FORMAT "%5.1" /end CHARACTERISTIC
/begin CHARACTERISTIC TSFHELSU2 "" VALUE 0x8E0872 KwUb 255.0 dez 0.00 255.0 FORMAT "%5.1" /end CHARACTERISTIC
/begin CHARACTERISTIC TSFHSH "" VALUE 0x8E0874 KwUb 255.0 dez 0.00 255.0 FORMAT "%5.1" /end CHARACTERISTIC
/begin CHARACTERISTIC TSFHSH2 "" VALUE 0x8E0875 KwUb 255.0 dez 0.00 255.0 FORMAT "%5.1" /end CHARACTERISTIC
/begin CHARACTERISTIC TSFHSHE "" VALUE 0x8E0876 KwUb 255.0 dez 0.00 255.0 FORMAT "%5.1" /end CHARACTERISTIC
/begin CHARACTERISTIC TSFHSHE2 "" VALUE 0x8E0877 KwUb 255.0 dez 0.00 255.0 FORMAT "%5.1" /end CHARACTERISTIC
/begin CHARACTERISTIC TSFHSV "" VALUE 0x8E0878 KwUb 255.0 dez 0.00 255.0 FORMAT "%5.1" /end CHARACTERISTIC
/begin CHARACTERISTIC TSFHSV2 "" VALUE 0x8E0879 KwUb 255.0 dez 0.00 255.0 FORMAT "%5.1" /end CHARACTERISTIC
/begin CHARACTERISTIC TSFHSVE "" VALUE 0x8E087A KwUb 255.0 dez 0.00 255.0 FORMAT "%5.1" /end CHARACTERISTIC
/begin CHARACTERISTIC TSFHSVE2 "" VALUE 0x8E087B KwUb 255.0 dez 0.00 255.0 FORMAT "%5.1" /end CHARACTERISTIC
/begin CHARACTERISTIC TSFICLSU "" VALUE 0x8E087C KwUb 255.0 dez 0.00 255.0 FORMAT "%5.1" /end CHARACTERISTIC
/begin CHARACTERISTIC TSFICLSU2 "" VALUE 0x8E087D KwUb 255.0 dez 0.00 255.0 FORMAT "%5.1" /end CHARACTERISTIC
/begin CHARACTERISTIC TSFKPE "" VALUE 0x8E0880 KwUb 255.0 dez 0.00 255.0 FORMAT "%5.1" /end CHARACTERISTIC
/begin CHARACTERISTIC TSFLDPE "" VALUE 0x8E0893 KwUb 255.0 dez 0.00 255.0 FORMAT "%5.1" /end CHARACTERISTIC
/begin CHARACTERISTIC TSFLSUIA "" VALUE 0x8E0899 KwUb 255.0 dez 0.00 255.0 FORMAT "%5.1" /end CHARACTERISTIC
/begin CHARACTERISTIC TSFLSUIA2 "" VALUE 0x8E089A KwUb 255.0 dez 0.00 255.0 FORMAT "%5.1" /end CHARACTERISTIC
/begin CHARACTERISTIC TSFLSUIP "" VALUE 0x8E089B KwUb 255.0 dez 0.00 255.0 FORMAT "%5.1" /end CHARACTERISTIC
/begin CHARACTERISTIC TSFLSUIP2 "" VALUE 0x8E089C KwUb 255.0 dez 0.00 255.0 FORMAT "%5.1" /end CHARACTERISTIC
/begin CHARACTERISTIC TSFLSUKS "" VALUE 0x8E089D KwUb 255.0 dez 0.00 255.0 FORMAT "%5.1" /end CHARACTERISTIC
/begin CHARACTERISTIC TSFLSUKS2 "" VALUE 0x8E089E KwUb 255.0 dez 0.00 255.0 FORMAT "%5.1" /end CHARACTERISTIC
/begin CHARACTERISTIC TSFLSUUN "" VALUE 0x8E089F KwUb 255.0 dez 0.00 255.0 FORMAT "%5.1" /end CHARACTERISTIC
/begin CHARACTERISTIC TSFLSUUN2 "" VALUE 0x8E08A0 KwUb 255.0 dez 0.00 255.0 FORMAT "%5.1" /end CHARACTERISTIC
/begin CHARACTERISTIC TSFLSUVM "" VALUE 0x8E08A1 KwUb 255.0 dez 0.00 255.0 FORMAT "%5.1" /end CHARACTERISTIC
/begin CHARACTERISTIC TSFLSUVM2 "" VALUE 0x8E08A2 KwUb 255.0 dez 0.00 255.0 FORMAT "%5.1" /end CHARACTERISTIC
/begin CHARACTERISTIC TSFLUES1E "" VALUE 0x8E08A7 KwUb 255.0 dez 0.00 255.0 FORMAT "%5.1" /end CHARACTERISTIC
/begin CHARACTERISTIC TSFN "" VALUE 0x8E08B2 KwUb 255.0 dez 0.00 255.0 FORMAT "%5.1" /end CHARACTERISTIC
/begin CHARACTERISTIC TSFSLPE "" VALUE 0x8E08C2 KwUb 255.0 dez 0.00 255.0 FORMAT "%5.1" /end CHARACTERISTIC
/begin CHARACTERISTIC TSFSLVE "" VALUE 0x8E08C7 KwUb 255.0 dez 0.00 255.0 FORMAT "%5.1" /end CHARACTERISTIC
/begin CHARACTERISTIC TSFSUE "" VALUE 0x8E08C8 KwUb 255.0 dez 0.00 255.0 FORMAT "%5.1" /end CHARACTERISTIC
/begin CHARACTERISTIC TSFTEVE "" VALUE 0x8E08CF KwUb 255.0 dez 0.00 255.0 FORMAT "%5.1" /end CHARACTERISTIC
/begin CHARACTERISTIC TSFZET1 "" VALUE 0x8E08E7 KwUb 255.0 dez 0.00 255.0 FORMAT "%5.1" /end CHARACTERISTIC
/begin CHARACTERISTIC TSFZET2 "" VALUE 0x8E08E8 KwUb 255.0 dez 0.00 255.0 FORMAT "%5.1" /end CHARACTERISTIC
/begin CHARACTERISTIC TSFZET3 "" VALUE 0x8E08E9 KwUb 255.0 dez 0.00 255.0 FORMAT "%5.1" /end CHARACTERISTIC
/begin CHARACTERISTIC TSFZET4 "" VALUE 0x8E08EA KwUb 255.0 dez 0.00 255.0 FORMAT "%5.1" /end CHARACTERISTIC
/begin CHARACTERISTIC TSFZET5 "" VALUE 0x8E08EB KwUb 255.0 dez 0.00 255.0 FORMAT "%5.1" /end CHARACTERISTIC
/begin CHARACTERISTIC TSFZET6 "" VALUE 0x8E08EC KwUb 255.0 dez 0.00 255.0 FORMAT "%5.1" /end CHARACTERISTIC
/begin CHARACTERISTIC TSFZWPE "" VALUE 0x8E08ED KwUb 255.0 dez 0.00 255.0 FORMAT "%5.1" /end CHARACTERISTIC
/begin CHARACTERISTIC TSFZZZ "" VALUE 0x8E08EE KwUb 255.0 dez 0.00 255.0 FORMAT "%5.1" /end CHARACTERISTIC
/begin MEASUREMENT B_avcif "" UWORD B_TRUE 1 100 0.00 1.00000000000 BIT_MASK 0x1000 FORMAT "%13.11" ECU_ADDRESS 0x382D58 /end MEASUREMENT
/begin MEASUREMENT B_avcins "" UWORD B_TRUE 1 100 0.00 1.00000000000 BIT_MASK 0x1000 FORMAT "%13.11" ECU_ADDRESS 0x382D5A /end MEASUREMENT
/begin MEASUREMENT B_avckla "" UWORD B_TRUE 1 100 0.00 1.00000000000 BIT_MASK 0x1000 FORMAT "%13.11" ECU_ADDRESS 0x382D5C /end MEASUREMENT
/begin MEASUREMENT B_avclws "" UWORD B_TRUE 1 100 0.00 1.00000000000 BIT_MASK 0x1000 FORMAT "%13.11" ECU_ADDRESS 0x382D5E /end MEASUREMENT
/begin MEASUREMENT B_avctog "" UWORD B_TRUE 1 100 0.00 1.00000000000 BIT_MASK 0x1000 FORMAT "%13.11" ECU_ADDRESS 0x382D60 /end MEASUREMENT
/begin MEASUREMENT B_avczas "" UWORD B_TRUE 1 100 0.00 1.00000000000 BIT_MASK 0x1000 FORMAT "%13.11" ECU_ADDRESS 0x382D62 /end MEASUREMENT
/begin MEASUREMENT B_beakre "" UWORD B_TRUE 1 100 0.00 1.00000000000 BIT_MASK 0x20 FORMAT "%13.11" ECU_ADDRESS 0x382D34 /end MEASUREMENT
/begin MEASUREMENT B_beanws "" UWORD B_TRUE 1 100 0.00 1.00000000000 BIT_MASK 0x20 FORMAT "%13.11" ECU_ADDRESS 0x382D36 /end MEASUREMENT
/begin MEASUREMENT B_beanwse "" UWORD B_TRUE 1 100 0.00 1.00000000000 BIT_MASK 0x20 FORMAT "%13.11" ECU_ADDRESS 0x382D38 /end MEASUREMENT
/begin MEASUREMENT B_bebkvp "" UWORD B_TRUE 1 100 0.00 1.00000000000 BIT_MASK 0x20 FORMAT "%13.11" ECU_ADDRESS 0x382D3C /end MEASUREMENT
/begin MEASUREMENT B_bebkvpe "" UWORD B_TRUE 1 100 0.00 1.00000000000 BIT_MASK 0x20 FORMAT "%13.11" ECU_ADDRESS 0x382D3E /end MEASUREMENT
/begin MEASUREMENT B_bebm "" UWORD B_TRUE 1 100 0.00 1.00000000000 BIT_MASK 0x20 FORMAT "%13.11" ECU_ADDRESS 0x382D40 /end MEASUREMENT
/begin MEASUREMENT B_becif "" UWORD B_TRUE 1 100 0.00 1.00000000000 BIT_MASK 0x20 FORMAT "%13.11" ECU_ADDRESS 0x382D58 /end MEASUREMENT
/begin MEASUREMENT B_becins "" UWORD B_TRUE 1 100 0.00 1.00000000000 BIT_MASK 0x20 FORMAT "%13.11" ECU_ADDRESS 0x382D5A /end MEASUREMENT
/begin MEASUREMENT B_beckla "" UWORD B_TRUE 1 100 0.00 1.00000000000 BIT_MASK 0x20 FORMAT "%13.11" ECU_ADDRESS 0x382D5C /end MEASUREMENT
/begin MEASUREMENT B_beclws "" UWORD B_TRUE 1 100 0.00 1.00000000000 BIT_MASK 0x20 FORMAT "%13.11" ECU_ADDRESS 0x382D5E /end MEASUREMENT
/begin MEASUREMENT B_bectog "" UWORD B_TRUE 1 100 0.00 1.00000000000 BIT_MASK 0x20 FORMAT "%13.11" ECU_ADDRESS 0x382D60 /end MEASUREMENT
/begin MEASUREMENT B_beczas "" UWORD B_TRUE 1 100 0.00 1.00000000000 BIT_MASK 0x20 FORMAT "%13.11" ECU_ADDRESS 0x382D62 /end MEASUREMENT
/begin MEASUREMENT B_bedk "" UWORD B_TRUE 1 100 0.00 1.00000000000 BIT_MASK 0x20 FORMAT "%13.11" ECU_ADDRESS 0x382D64 /end MEASUREMENT
/begin MEASUREMENT B_bedk1p "" UWORD B_TRUE 1 100 0.00 1.00000000000 BIT_MASK 0x20 FORMAT "%13.11" ECU_ADDRESS 0x382D66 /end MEASUREMENT
/begin MEASUREMENT B_bedk2p "" UWORD B_TRUE 1 100 0.00 1.00000000000 BIT_MASK 0x20 FORMAT "%13.11" ECU_ADDRESS 0x382D68 /end MEASUREMENT
/begin MEASUREMENT B_bedvee "" UWORD B_TRUE 1 100 0.00 1.00000000000 BIT_MASK 0x20 FORMAT "%13.11" ECU_ADDRESS 0x382D70 /end MEASUREMENT
/begin MEASUREMENT B_bedvef "" UWORD B_TRUE 1 100 0.00 1.00000000000 BIT_MASK 0x20 FORMAT "%13.11" ECU_ADDRESS 0x382D72 /end MEASUREMENT
/begin MEASUREMENT B_bedvefo "" UWORD B_TRUE 1 100 0.00 1.00000000000 BIT_MASK 0x20 FORMAT "%13.11" ECU_ADDRESS 0x382D74 /end MEASUREMENT
/begin MEASUREMENT B_bedvel "" UWORD B_TRUE 1 100 0.00 1.00000000000 BIT_MASK 0x20 FORMAT "%13.11" ECU_ADDRESS 0x382D76 /end MEASUREMENT
/begin MEASUREMENT B_bedven "" UWORD B_TRUE 1 100 0.00 1.00000000000 BIT_MASK 0x20 FORMAT "%13.11" ECU_ADDRESS 0x382D78 /end MEASUREMENT
/begin MEASUREMENT B_bedver "" UWORD B_TRUE 1 100 0.00 1.00000000000 BIT_MASK 0x20 FORMAT "%13.11" ECU_ADDRESS 0x382D7A /end MEASUREMENT
/begin MEASUREMENT B_bedvet "" UWORD B_TRUE 1 100 0.00 1.00000000000 BIT_MASK 0x20 FORMAT "%13.11" ECU_ADDRESS 0x382D7C /end MEASUREMENT
/begin MEASUREMENT B_bedveu "" UWORD B_TRUE 1 100 0.00 1.00000000000 BIT_MASK 0x20 FORMAT "%13.11" ECU_ADDRESS 0x382D7E /end MEASUREMENT
/begin MEASUREMENT B_bedveub "" UWORD B_TRUE 1 100 0.00 1.00000000000 BIT_MASK 0x20 FORMAT "%13.11" ECU_ADDRESS 0x382D80 /end MEASUREMENT
/begin MEASUREMENT B_bedveuw "" UWORD B_TRUE 1 100 0.00 1.00000000000 BIT_MASK 0x20 FORMAT "%13.11" ECU_ADDRESS 0x382D82 /end MEASUREMENT
/begin MEASUREMENT B_bedvev "" UWORD B_TRUE 1 100 0.00 1.00000000000 BIT_MASK 0x20 FORMAT "%13.11" ECU_ADDRESS 0x382D84 /end MEASUREMENT
/begin MEASUREMENT B_bedylsu "" UWORD B_TRUE 1 100 0.00 1.00000000000 BIT_MASK 0x20 FORMAT "%13.11" ECU_ADDRESS 0x382D86 /end MEASUREMENT
/begin MEASUREMENT B_bedylsu2 "" UWORD B_TRUE 1 100 0.00 1.00000000000 BIT_MASK 0x20 FORMAT "%13.11" ECU_ADDRESS 0x382D88 /end MEASUREMENT
/begin MEASUREMENT B_beegfe "" UWORD B_TRUE 1 100 0.00 1.00000000000 BIT_MASK 0x20 FORMAT "%13.11" ECU_ADDRESS 0x382D8A /end MEASUREMENT
/begin MEASUREMENT B_beenws "" UWORD B_TRUE 1 100 0.00 1.00000000000 BIT_MASK 0x20 FORMAT "%13.11" ECU_ADDRESS 0x382D8E /end MEASUREMENT
/begin MEASUREMENT B_beenwse "" UWORD B_TRUE 1 100 0.00 1.00000000000 BIT_MASK 0x20 FORMAT "%13.11" ECU_ADDRESS 0x382D90 /end MEASUREMENT
/begin MEASUREMENT B_beepcle "" UWORD B_TRUE 1 100 0.00 1.00000000000 BIT_MASK 0x20 FORMAT "%13.11" ECU_ADDRESS 0x382D92 /end MEASUREMENT
/begin MEASUREMENT B_beev1 "" UWORD B_TRUE 1 100 0.00 1.00000000000 BIT_MASK 0x20 FORMAT "%13.11" ECU_ADDRESS 0x382D94 /end MEASUREMENT
/begin MEASUREMENT B_beev2 "" UWORD B_TRUE 1 100 0.00 1.00000000000 BIT_MASK 0x20 FORMAT "%13.11" ECU_ADDRESS 0x382D96 /end MEASUREMENT
/begin MEASUREMENT B_beev3 "" UWORD B_TRUE 1 100 0.00 1.00000000000 BIT_MASK 0x20 FORMAT "%13.11" ECU_ADDRESS 0x382D98 /end MEASUREMENT
/begin MEASUREMENT B_beev4 "" UWORD B_TRUE 1 100 0.00 1.00000000000 BIT_MASK 0x20 FORMAT "%13.11" ECU_ADDRESS 0x382D9A /end MEASUREMENT
/begin MEASUREMENT B_beev5 "" UWORD B_TRUE 1 100 0.00 1.00000000000 BIT_MASK 0x20 FORMAT "%13.11" ECU_ADDRESS 0x382D9C /end MEASUREMENT
/begin MEASUREMENT B_beev6 "" UWORD B_TRUE 1 100 0.00 1.00000000000 BIT_MASK 0x20 FORMAT "%13.11" ECU_ADDRESS 0x382D9E /end MEASUREMENT
/begin MEASUREMENT B_behelsu "" UWORD B_TRUE 1 100 0.00 1.00000000000 BIT_MASK 0x20 FORMAT "%13.11" ECU_ADDRESS 0x382DB6 /end MEASUREMENT
/begin MEASUREMENT B_behelsu2 "" UWORD B_TRUE 1 100 0.00 1.00000000000 BIT_MASK 0x20 FORMAT "%13.11" ECU_ADDRESS 0x382DB8 /end MEASUREMENT
/begin MEASUREMENT B_behsh "" UWORD B_TRUE 1 100 0.00 1.00000000000 BIT_MASK 0x20 FORMAT "%13.11" ECU_ADDRESS 0x382DBC /end MEASUREMENT
/begin MEASUREMENT B_behsh2 "" UWORD B_TRUE 1 100 0.00 1.00000000000 BIT_MASK 0x20 FORMAT "%13.11" ECU_ADDRESS 0x382DBE /end MEASUREMENT
/begin MEASUREMENT B_behshe "" UWORD B_TRUE 1 100 0.00 1.00000000000 BIT_MASK 0x20 FORMAT "%13.11" ECU_ADDRESS 0x382DC0 /end MEASUREMENT
/begin MEASUREMENT B_behshe2 "" UWORD B_TRUE 1 100 0.00 1.00000000000 BIT_MASK 0x20 FORMAT "%13.11" ECU_ADDRESS 0x382DC2 /end MEASUREMENT
/begin MEASUREMENT B_behsv "" UWORD B_TRUE 1 100 0.00 1.00000000000 BIT_MASK 0x20 FORMAT "%13.11" ECU_ADDRESS 0x382DC4 /end MEASUREMENT
/begin MEASUREMENT B_behsv2 "" UWORD B_TRUE 1 100 0.00 1.00000000000 BIT_MASK 0x20 FORMAT "%13.11" ECU_ADDRESS 0x382DC6 /end MEASUREMENT
/begin MEASUREMENT B_behsve "" UWORD B_TRUE 1 100 0.00 1.00000000000 BIT_MASK 0x20 FORMAT "%13.11" ECU_ADDRESS 0x382DC8 /end MEASUREMENT
/begin MEASUREMENT B_behsve2 "" UWORD B_TRUE 1 100 0.00 1.00000000000 BIT_MASK 0x20 FORMAT "%13.11" ECU_ADDRESS 0x382DCA /end MEASUREMENT
/begin MEASUREMENT B_beiclsu "" UWORD B_TRUE 1 100 0.00 1.00000000000 BIT_MASK 0x20 FORMAT "%13.11" ECU_ADDRESS 0x382DCC /end MEASUREMENT
/begin MEASUREMENT B_beiclsu2 "" UWORD B_TRUE 1 100 0.00 1.00000000000 BIT_MASK 0x20 FORMAT "%13.11" ECU_ADDRESS 0x382DCE /end MEASUREMENT
/begin MEASUREMENT B_bekpe "" UWORD B_TRUE 1 100 0.00 1.00000000000 BIT_MASK 0x20 FORMAT "%13.11" ECU_ADDRESS 0x382DD4 /end MEASUREMENT
/begin MEASUREMENT B_beldpe "" UWORD B_TRUE 1 100 0.00 1.00000000000 BIT_MASK 0x20 FORMAT "%13.11" ECU_ADDRESS 0x382DFA /end MEASUREMENT
/begin MEASUREMENT B_belsuia "" UWORD B_TRUE 1 100 0.00 1.00000000000 BIT_MASK 0x20 FORMAT "%13.11" ECU_ADDRESS 0x382E06 /end MEASUREMENT
/begin MEASUREMENT B_belsuia2 "" UWORD B_TRUE 1 100 0.00 1.00000000000 BIT_MASK 0x20 FORMAT "%13.11" ECU_ADDRESS 0x382E08 /end MEASUREMENT
/begin MEASUREMENT B_belsuip "" UWORD B_TRUE 1 100 0.00 1.00000000000 BIT_MASK 0x20 FORMAT "%13.11" ECU_ADDRESS 0x382E0A /end MEASUREMENT
/begin MEASUREMENT B_belsuip2 "" UWORD B_TRUE 1 100 0.00 1.00000000000 BIT_MASK 0x20 FORMAT "%13.11" ECU_ADDRESS 0x382E0C /end MEASUREMENT
/begin MEASUREMENT B_belsuks "" UWORD B_TRUE 1 100 0.00 1.00000000000 BIT_MASK 0x20 FORMAT "%13.11" ECU_ADDRESS 0x382E0E /end MEASUREMENT
/begin MEASUREMENT B_belsuks2 "" UWORD B_TRUE 1 100 0.00 1.00000000000 BIT_MASK 0x20 FORMAT "%13.11" ECU_ADDRESS 0x382E10 /end MEASUREMENT
/begin MEASUREMENT B_belsuun "" UWORD B_TRUE 1 100 0.00 1.00000000000 BIT_MASK 0x20 FORMAT "%13.11" ECU_ADDRESS 0x382E12 /end MEASUREMENT
/begin MEASUREMENT B_belsuun2 "" UWORD B_TRUE 1 100 0.00 1.00000000000 BIT_MASK 0x20 FORMAT "%13.11" ECU_ADDRESS 0x382E14 /end MEASUREMENT
/begin MEASUREMENT B_belsuvm "" UWORD B_TRUE 1 100 0.00 1.00000000000 BIT_MASK 0x20 FORMAT "%13.11" ECU_ADDRESS 0x382E16 /end MEASUREMENT
/begin MEASUREMENT B_belsuvm2 "" UWORD B_TRUE 1 100 0.00 1.00000000000 BIT_MASK 0x20 FORMAT "%13.11" ECU_ADDRESS 0x382E18 /end MEASUREMENT
/begin MEASUREMENT B_belues1e "" UWORD B_TRUE 1 100 0.00 1.00000000000 BIT_MASK 0x20 FORMAT "%13.11" ECU_ADDRESS 0x382E22 /end MEASUREMENT
/begin MEASUREMENT B_ben "" UWORD B_TRUE 1 100 0.00 1.00000000000 BIT_MASK 0x20 FORMAT "%13.11" ECU_ADDRESS 0x382E38 /end MEASUREMENT
/begin MEASUREMENT B_beslpe "" UWORD B_TRUE 1 100 0.00 1.00000000000 BIT_MASK 0x20 FORMAT "%13.11" ECU_ADDRESS 0x382E58 /end MEASUREMENT
/begin MEASUREMENT B_beslve "" UWORD B_TRUE 1 100 0.00 1.00000000000 BIT_MASK 0x20 FORMAT "%13.11" ECU_ADDRESS 0x382E62 /end MEASUREMENT
/begin MEASUREMENT B_besue "" UWORD B_TRUE 1 100 0.00 1.00000000000 BIT_MASK 0x20 FORMAT "%13.11" ECU_ADDRESS 0x382E64 /end MEASUREMENT
/begin MEASUREMENT B_beteve "" UWORD B_TRUE 1 100 0.00 1.00000000000 BIT_MASK 0x20 FORMAT "%13.11" ECU_ADDRESS 0x382E72 /end MEASUREMENT
/begin MEASUREMENT B_bezet1 "" UWORD B_TRUE 1 100 0.00 1.00000000000 BIT_MASK 0x20 FORMAT "%13.11" ECU_ADDRESS 0x382EA2 /end MEASUREMENT
/begin MEASUREMENT B_bezet2 "" UWORD B_TRUE 1 100 0.00 1.00000000000 BIT_MASK 0x20 FORMAT "%13.11" ECU_ADDRESS 0x382EA4 /end MEASUREMENT
/begin MEASUREMENT B_bezet3 "" UWORD B_TRUE 1 100 0.00 1.00000000000 BIT_MASK 0x20 FORMAT "%13.11" ECU_ADDRESS 0x382EA6 /end MEASUREMENT
/begin MEASUREMENT B_bezet4 "" UWORD B_TRUE 1 100 0.00 1.00000000000 BIT_MASK 0x20 FORMAT "%13.11" ECU_ADDRESS 0x382EA8 /end MEASUREMENT
/begin MEASUREMENT B_bezet5 "" UWORD B_TRUE 1 100 0.00 1.00000000000 BIT_MASK 0x20 FORMAT "%13.11" ECU_ADDRESS 0x382EAA /end MEASUREMENT
/begin MEASUREMENT B_bezet6 "" UWORD B_TRUE 1 100 0.00 1.00000000000 BIT_MASK 0x20 FORMAT "%13.11" ECU_ADDRESS 0x382EAC /end MEASUREMENT
/begin MEASUREMENT B_bezwpe "" UWORD B_TRUE 1 100 0.00 1.00000000000 BIT_MASK 0x20 FORMAT "%13.11" ECU_ADDRESS 0x382EAE /end MEASUREMENT
/begin MEASUREMENT B_bkakre "" UWORD B_TRUE 1 100 0.00 1.00000000000 BIT_MASK 0x40 FORMAT "%13.11" ECU_ADDRESS 0x382D34 /end MEASUREMENT
/begin MEASUREMENT B_bkanws "" UWORD B_TRUE 1 100 0.00 1.00000000000 BIT_MASK 0x40 FORMAT "%13.11" ECU_ADDRESS 0x382D36 /end MEASUREMENT
/begin MEASUREMENT B_bkanwse "" UWORD B_TRUE 1 100 0.00 1.00000000000 BIT_MASK 0x40 FORMAT "%13.11" ECU_ADDRESS 0x382D38 /end MEASUREMENT
/begin MEASUREMENT B_bkbkvp "" UWORD B_TRUE 1 100 0.00 1.00000000000 BIT_MASK 0x40 FORMAT "%13.11" ECU_ADDRESS 0x382D3C /end MEASUREMENT
/begin MEASUREMENT B_bkbkvpe "" UWORD B_TRUE 1 100 0.00 1.00000000000 BIT_MASK 0x40 FORMAT "%13.11" ECU_ADDRESS 0x382D3E /end MEASUREMENT
/begin MEASUREMENT B_bkbm "" UWORD B_TRUE 1 100 0.00 1.00000000000 BIT_MASK 0x40 FORMAT "%13.11" ECU_ADDRESS 0x382D40 /end MEASUREMENT
/begin MEASUREMENT B_bkcif "" UWORD B_TRUE 1 100 0.00 1.00000000000 BIT_MASK 0x40 FORMAT "%13.11" ECU_ADDRESS 0x382D58 /end MEASUREMENT
/begin MEASUREMENT B_bkcins "" UWORD B_TRUE 1 100 0.00 1.00000000000 BIT_MASK 0x40 FORMAT "%13.11" ECU_ADDRESS 0x382D5A /end MEASUREMENT
/begin MEASUREMENT B_bkckla "" UWORD B_TRUE 1 100 0.00 1.00000000000 BIT_MASK 0x40 FORMAT "%13.11" ECU_ADDRESS 0x382D5C /end MEASUREMENT
/begin MEASUREMENT B_bkclws "" UWORD B_TRUE 1 100 0.00 1.00000000000 BIT_MASK 0x40 FORMAT "%13.11" ECU_ADDRESS 0x382D5E /end MEASUREMENT
/begin MEASUREMENT B_bkctog "" UWORD B_TRUE 1 100 0.00 1.00000000000 BIT_MASK 0x40 FORMAT "%13.11" ECU_ADDRESS 0x382D60 /end MEASUREMENT
/begin MEASUREMENT B_bkczas "" UWORD B_TRUE 1 100 0.00 1.00000000000 BIT_MASK 0x40 FORMAT "%13.11" ECU_ADDRESS 0x382D62 /end MEASUREMENT
/begin MEASUREMENT B_bkdk "" UWORD B_TRUE 1 100 0.00 1.00000000000 BIT_MASK 0x40 FORMAT "%13.11" ECU_ADDRESS 0x382D64 /end MEASUREMENT
/begin MEASUREMENT B_bkdk1p "" UWORD B_TRUE 1 100 0.00 1.00000000000 BIT_MASK 0x40 FORMAT "%13.11" ECU_ADDRESS 0x382D66 /end MEASUREMENT
/begin MEASUREMENT B_bkdk2p "" UWORD B_TRUE 1 100 0.00 1.00000000000 BIT_MASK 0x40 FORMAT "%13.11" ECU_ADDRESS 0x382D68 /end MEASUREMENT
/begin MEASUREMENT B_bkdvee "" UWORD B_TRUE 1 100 0.00 1.00000000000 BIT_MASK 0x40 FORMAT "%13.11" ECU_ADDRESS 0x382D70 /end MEASUREMENT
/begin MEASUREMENT B_bkdvef "" UWORD B_TRUE 1 100 0.00 1.00000000000 BIT_MASK 0x40 FORMAT "%13.11" ECU_ADDRESS 0x382D72 /end MEASUREMENT
/begin MEASUREMENT B_bkdvefo "" UWORD B_TRUE 1 100 0.00 1.00000000000 BIT_MASK 0x40 FORMAT "%13.11" ECU_ADDRESS 0x382D74 /end MEASUREMENT
/begin MEASUREMENT B_bkdvel "" UWORD B_TRUE 1 100 0.00 1.00000000000 BIT_MASK 0x40 FORMAT "%13.11" ECU_ADDRESS 0x382D76 /end MEASUREMENT
/begin MEASUREMENT B_bkdven "" UWORD B_TRUE 1 100 0.00 1.00000000000 BIT_MASK 0x40 FORMAT "%13.11" ECU_ADDRESS 0x382D78 /end MEASUREMENT
/begin MEASUREMENT B_bkdver "" UWORD B_TRUE 1 100 0.00 1.00000000000 BIT_MASK 0x40 FORMAT "%13.11" ECU_ADDRESS 0x382D7A /end MEASUREMENT
/begin MEASUREMENT B_bkdvet "" UWORD B_TRUE 1 100 0.00 1.00000000000 BIT_MASK 0x40 FORMAT "%13.11" ECU_ADDRESS 0x382D7C /end MEASUREMENT
/begin MEASUREMENT B_bkdveu "" UWORD B_TRUE 1 100 0.00 1.00000000000 BIT_MASK 0x40 FORMAT "%13.11" ECU_ADDRESS 0x382D7E /end MEASUREMENT
/begin MEASUREMENT B_bkdveub "" UWORD B_TRUE 1 100 0.00 1.00000000000 BIT_MASK 0x40 FORMAT "%13.11" ECU_ADDRESS 0x382D80 /end MEASUREMENT
/begin MEASUREMENT B_bkdveuw "" UWORD B_TRUE 1 100 0.00 1.00000000000 BIT_MASK 0x40 FORMAT "%13.11" ECU_ADDRESS 0x382D82 /end MEASUREMENT
/begin MEASUREMENT B_bkdvev "" UWORD B_TRUE 1 100 0.00 1.00000000000 BIT_MASK 0x40 FORMAT "%13.11" ECU_ADDRESS 0x382D84 /end MEASUREMENT
/begin MEASUREMENT B_bkdylsu "" UWORD B_TRUE 1 100 0.00 1.00000000000 BIT_MASK 0x40 FORMAT "%13.11" ECU_ADDRESS 0x382D86 /end MEASUREMENT
/begin MEASUREMENT B_bkdylsu2 "" UWORD B_TRUE 1 100 0.00 1.00000000000 BIT_MASK 0x40 FORMAT "%13.11" ECU_ADDRESS 0x382D88 /end MEASUREMENT
/begin MEASUREMENT B_bkegfe "" UWORD B_TRUE 1 100 0.00 1.00000000000 BIT_MASK 0x40 FORMAT "%13.11" ECU_ADDRESS 0x382D8A /end MEASUREMENT
/begin MEASUREMENT B_bkenws "" UWORD B_TRUE 1 100 0.00 1.00000000000 BIT_MASK 0x40 FORMAT "%13.11" ECU_ADDRESS 0x382D8E /end MEASUREMENT
/begin MEASUREMENT B_bkenwse "" UWORD B_TRUE 1 100 0.00 1.00000000000 BIT_MASK 0x40 FORMAT "%13.11" ECU_ADDRESS 0x382D90 /end MEASUREMENT
/begin MEASUREMENT B_bkepcle "" UWORD B_TRUE 1 100 0.00 1.00000000000 BIT_MASK 0x40 FORMAT "%13.11" ECU_ADDRESS 0x382D92 /end MEASUREMENT
/begin MEASUREMENT B_bkev1 "" UWORD B_TRUE 1 100 0.00 1.00000000000 BIT_MASK 0x40 FORMAT "%13.11" ECU_ADDRESS 0x382D94 /end MEASUREMENT
/begin MEASUREMENT B_bkev2 "" UWORD B_TRUE 1 100 0.00 1.00000000000 BIT_MASK 0x40 FORMAT "%13.11" ECU_ADDRESS 0x382D96 /end MEASUREMENT
/begin MEASUREMENT B_bkev3 "" UWORD B_TRUE 1 100 0.00 1.00000000000 BIT_MASK 0x40 FORMAT "%13.11" ECU_ADDRESS 0x382D98 /end MEASUREMENT
/begin MEASUREMENT B_bkev4 "" UWORD B_TRUE 1 100 0.00 1.00000000000 BIT_MASK 0x40 FORMAT "%13.11" ECU_ADDRESS 0x382D9A /end MEASUREMENT
/begin MEASUREMENT B_bkev5 "" UWORD B_TRUE 1 100 0.00 1.00000000000 BIT_MASK 0x40 FORMAT "%13.11" ECU_ADDRESS 0x382D9C /end MEASUREMENT
/begin MEASUREMENT B_bkev6 "" UWORD B_TRUE 1 100 0.00 1.00000000000 BIT_MASK 0x40 FORMAT "%13.11" ECU_ADDRESS 0x382D9E /end MEASUREMENT
/begin MEASUREMENT B_bkhelsu "" UWORD B_TRUE 1 100 0.00 1.00000000000 BIT_MASK 0x40 FORMAT "%13.11" ECU_ADDRESS 0x382DB6 /end MEASUREMENT
/begin MEASUREMENT B_bkhelsu2 "" UWORD B_TRUE 1 100 0.00 1.00000000000 BIT_MASK 0x40 FORMAT "%13.11" ECU_ADDRESS 0x382DB8 /end MEASUREMENT
/begin MEASUREMENT B_bkhsh "" UWORD B_TRUE 1 100 0.00 1.00000000000 BIT_MASK 0x40 FORMAT "%13.11" ECU_ADDRESS 0x382DBC /end MEASUREMENT
/begin MEASUREMENT B_bkhsh2 "" UWORD B_TRUE 1 100 0.00 1.00000000000 BIT_MASK 0x40 FORMAT "%13.11" ECU_ADDRESS 0x382DBE /end MEASUREMENT
/begin MEASUREMENT B_bkhshe "" UWORD B_TRUE 1 100 0.00 1.00000000000 BIT_MASK 0x40 FORMAT "%13.11" ECU_ADDRESS 0x382DC0 /end MEASUREMENT
/begin MEASUREMENT B_bkhshe2 "" UWORD B_TRUE 1 100 0.00 1.00000000000 BIT_MASK 0x40 FORMAT "%13.11" ECU_ADDRESS 0x382DC2 /end MEASUREMENT
/begin MEASUREMENT B_bkhsv "" UWORD B_TRUE 1 100 0.00 1.00000000000 BIT_MASK 0x40 FORMAT "%13.11" ECU_ADDRESS 0x382DC4 /end MEASUREMENT
/begin MEASUREMENT B_bkhsv2 "" UWORD B_TRUE 1 100 0.00 1.00000000000 BIT_MASK 0x40 FORMAT "%13.11" ECU_ADDRESS 0x382DC6 /end MEASUREMENT
/begin MEASUREMENT B_bkhsve "" UWORD B_TRUE 1 100 0.00 1.00000000000 BIT_MASK 0x40 FORMAT "%13.11" ECU_ADDRESS 0x382DC8 /end MEASUREMENT
/begin MEASUREMENT B_bkhsve2 "" UWORD B_TRUE 1 100 0.00 1.00000000000 BIT_MASK 0x40 FORMAT "%13.11" ECU_ADDRESS 0x382DCA /end MEASUREMENT
/begin MEASUREMENT B_bkiclsu "" UWORD B_TRUE 1 100 0.00 1.00000000000 BIT_MASK 0x40 FORMAT "%13.11" ECU_ADDRESS 0x382DCC /end MEASUREMENT
/begin MEASUREMENT B_bkiclsu2 "" UWORD B_TRUE 1 100 0.00 1.00000000000 BIT_MASK 0x40 FORMAT "%13.11" ECU_ADDRESS 0x382DCE /end MEASUREMENT
/begin MEASUREMENT B_bkkpe "" UWORD B_TRUE 1 100 0.00 1.00000000000 BIT_MASK 0x40 FORMAT "%13.11" ECU_ADDRESS 0x382DD4 /end MEASUREMENT
/begin MEASUREMENT B_bkldpe "" UWORD B_TRUE 1 100 0.00 1.00000000000 BIT_MASK 0x40 FORMAT "%13.11" ECU_ADDRESS 0x382DFA /end MEASUREMENT
/begin MEASUREMENT B_bklsuia "" UWORD B_TRUE 1 100 0.00 1.00000000000 BIT_MASK 0x40 FORMAT "%13.11" ECU_ADDRESS 0x382E06 /end MEASUREMENT
/begin MEASUREMENT B_bklsuia2 "" UWORD B_TRUE 1 100 0.00 1.00000000000 BIT_MASK 0x40 FORMAT "%13.11" ECU_ADDRESS 0x382E08 /end MEASUREMENT
/begin MEASUREMENT B_bklsuip "" UWORD B_TRUE 1 100 0.00 1.00000000000 BIT_MASK 0x40 FORMAT "%13.11" ECU_ADDRESS 0x382E0A /end MEASUREMENT
/begin MEASUREMENT B_bklsuip2 "" UWORD B_TRUE 1 100 0.00 1.00000000000 BIT_MASK 0x40 FORMAT "%13.11" ECU_ADDRESS 0x382E0C /end MEASUREMENT
/begin MEASUREMENT B_bklsuks "" UWORD B_TRUE 1 100 0.00 1.00000000000 BIT_MASK 0x40 FORMAT "%13.11" ECU_ADDRESS 0x382E0E /end MEASUREMENT
/begin MEASUREMENT B_bklsuks2 "" UWORD B_TRUE 1 100 0.00 1.00000000000 BIT_MASK 0x40 FORMAT "%13.11" ECU_ADDRESS 0x382E10 /end MEASUREMENT
/begin MEASUREMENT B_bklsuun "" UWORD B_TRUE 1 100 0.00 1.00000000000 BIT_MASK 0x40 FORMAT "%13.11" ECU_ADDRESS 0x382E12 /end MEASUREMENT
/begin MEASUREMENT B_bklsuun2 "" UWORD B_TRUE 1 100 0.00 1.00000000000 BIT_MASK 0x40 FORMAT "%13.11" ECU_ADDRESS 0x382E14 /end MEASUREMENT
/begin MEASUREMENT B_bklsuvm "" UWORD B_TRUE 1 100 0.00 1.00000000000 BIT_MASK 0x40 FORMAT "%13.11" ECU_ADDRESS 0x382E16 /end MEASUREMENT
/begin MEASUREMENT B_bklsuvm2 "" UWORD B_TRUE 1 100 0.00 1.00000000000 BIT_MASK 0x40 FORMAT "%13.11" ECU_ADDRESS 0x382E18 /end MEASUREMENT
/begin MEASUREMENT B_bklues1e "" UWORD B_TRUE 1 100 0.00 1.00000000000 BIT_MASK 0x40 FORMAT "%13.11" ECU_ADDRESS 0x382E22 /end MEASUREMENT
/begin MEASUREMENT B_bkn "" UWORD B_TRUE 1 100 0.00 1.00000000000 BIT_MASK 0x40 FORMAT "%13.11" ECU_ADDRESS 0x382E38 /end MEASUREMENT
/begin MEASUREMENT B_bkslpe "" UWORD B_TRUE 1 100 0.00 1.00000000000 BIT_MASK 0x40 FORMAT "%13.11" ECU_ADDRESS 0x382E58 /end MEASUREMENT
/begin MEASUREMENT B_bkslve "" UWORD B_TRUE 1 100 0.00 1.00000000000 BIT_MASK 0x40 FORMAT "%13.11" ECU_ADDRESS 0x382E62 /end MEASUREMENT
/begin MEASUREMENT B_bksue "" UWORD B_TRUE 1 100 0.00 1.00000000000 BIT_MASK 0x40 FORMAT "%13.11" ECU_ADDRESS 0x382E64 /end MEASUREMENT
/begin MEASUREMENT B_bkteve "" UWORD B_TRUE 1 100 0.00 1.00000000000 BIT_MASK 0x40 FORMAT "%13.11" ECU_ADDRESS 0x382E72 /end MEASUREMENT
/begin MEASUREMENT B_bkzet1 "" UWORD B_TRUE 1 100 0.00 1.00000000000 BIT_MASK 0x40 FORMAT "%13.11" ECU_ADDRESS 0x382EA2 /end MEASUREMENT
/begin MEASUREMENT B_bkzet2 "" UWORD B_TRUE 1 100 0.00 1.00000000000 BIT_MASK 0x40 FORMAT "%13.11" ECU_ADDRESS 0x382EA4 /end MEASUREMENT
/begin MEASUREMENT B_bkzet3 "" UWORD B_TRUE 1 100 0.00 1.00000000000 BIT_MASK 0x40 FORMAT "%13.11" ECU_ADDRESS 0x382EA6 /end MEASUREMENT
/begin MEASUREMENT B_bkzet4 "" UWORD B_TRUE 1 100 0.00 1.00000000000 BIT_MASK 0x40 FORMAT "%13.11" ECU_ADDRESS 0x382EA8 /end MEASUREMENT
/begin MEASUREMENT B_bkzet5 "" UWORD B_TRUE 1 100 0.00 1.00000000000 BIT_MASK 0x40 FORMAT "%13.11" ECU_ADDRESS 0x382EAA /end MEASUREMENT
/begin MEASUREMENT B_bkzet6 "" UWORD B_TRUE 1 100 0.00 1.00000000000 BIT_MASK 0x40 FORMAT "%13.11" ECU_ADDRESS 0x382EAC /end MEASUREMENT
/begin MEASUREMENT B_bkzwpe "" UWORD B_TRUE 1 100 0.00 1.00000000000 BIT_MASK 0x40 FORMAT "%13.11" ECU_ADDRESS 0x382EAE /end MEASUREMENT
/begin MEASUREMENT B_clakre "" UWORD B_TRUE 1 100 0.00 1.00000000000 BIT_MASK 0x80 FORMAT "%13.11" ECU_ADDRESS 0x382D34 /end MEASUREMENT
/begin MEASUREMENT B_clanws "" UWORD B_TRUE 1 100 0.00 1.00000000000 BIT_MASK 0x80 FORMAT "%13.11" ECU_ADDRESS 0x382D36 /end MEASUREMENT
/begin MEASUREMENT B_clanwse "" UWORD B_TRUE 1 100 0.00 1.00000000000 BIT_MASK 0x80 FORMAT "%13.11" ECU_ADDRESS 0x382D38 /end MEASUREMENT
/begin MEASUREMENT B_clbkvp "" UWORD B_TRUE 1 100 0.00 1.00000000000 BIT_MASK 0x80 FORMAT "%13.11" ECU_ADDRESS 0x382D3C /end MEASUREMENT
/begin MEASUREMENT B_clbkvpe "" UWORD B_TRUE 1 100 0.00 1.00000000000 BIT_MASK 0x80 FORMAT "%13.11" ECU_ADDRESS 0x382D3E /end MEASUREMENT
/begin MEASUREMENT B_clbm "" UWORD B_TRUE 1 100 0.00 1.00000000000 BIT_MASK 0x80 FORMAT "%13.11" ECU_ADDRESS 0x382D40 /end MEASUREMENT
/begin MEASUREMENT B_clcif "" UWORD B_TRUE 1 100 0.00 1.00000000000 BIT_MASK 0x80 FORMAT "%13.11" ECU_ADDRESS 0x382D58 /end MEASUREMENT
/begin MEASUREMENT B_clcins "" UWORD B_TRUE 1 100 0.00 1.00000000000 BIT_MASK 0x80 FORMAT "%13.11" ECU_ADDRESS 0x382D5A /end MEASUREMENT
/begin MEASUREMENT B_clckla "" UWORD B_TRUE 1 100 0.00 1.00000000000 BIT_MASK 0x80 FORMAT "%13.11" ECU_ADDRESS 0x382D5C /end MEASUREMENT
/begin MEASUREMENT B_clclws "" UWORD B_TRUE 1 100 0.00 1.00000000000 BIT_MASK 0x80 FORMAT "%13.11" ECU_ADDRESS 0x382D5E /end MEASUREMENT
/begin MEASUREMENT B_clctog "" UWORD B_TRUE 1 100 0.00 1.00000000000 BIT_MASK 0x80 FORMAT "%13.11" ECU_ADDRESS 0x382D60 /end MEASUREMENT
/begin MEASUREMENT B_clczas "" UWORD B_TRUE 1 100 0.00 1.00000000000 BIT_MASK 0x80 FORMAT "%13.11" ECU_ADDRESS 0x382D62 /end MEASUREMENT
/begin MEASUREMENT B_cldk "" UWORD B_TRUE 1 100 0.00 1.00000000000 BIT_MASK 0x80 FORMAT "%13.11" ECU_ADDRESS 0x382D64 /end MEASUREMENT
/begin MEASUREMENT B_cldk1p "" UWORD B_TRUE 1 100 0.00 1.00000000000 BIT_MASK 0x80 FORMAT "%13.11" ECU_ADDRESS 0x382D66 /end MEASUREMENT
/begin MEASUREMENT B_cldk2p "" UWORD B_TRUE 1 100 0.00 1.00000000000 BIT_MASK 0x80 FORMAT "%13.11" ECU_ADDRESS 0x382D68 /end MEASUREMENT
/begin MEASUREMENT B_cldvee "" UWORD B_TRUE 1 100 0.00 1.00000000000 BIT_MASK 0x80 FORMAT "%13.11" ECU_ADDRESS 0x382D70 /end MEASUREMENT
/begin MEASUREMENT B_cldvef "" UWORD B_TRUE 1 100 0.00 1.00000000000 BIT_MASK 0x80 FORMAT "%13.11" ECU_ADDRESS 0x382D72 /end MEASUREMENT
/begin MEASUREMENT B_cldvefo "" UWORD B_TRUE 1 100 0.00 1.00000000000 BIT_MASK 0x80 FORMAT "%13.11" ECU_ADDRESS 0x382D74 /end MEASUREMENT
/begin MEASUREMENT B_cldvel "" UWORD B_TRUE 1 100 0.00 1.00000000000 BIT_MASK 0x80 FORMAT "%13.11" ECU_ADDRESS 0x382D76 /end MEASUREMENT
/begin MEASUREMENT B_cldven "" UWORD B_TRUE 1 100 0.00 1.00000000000 BIT_MASK 0x80 FORMAT "%13.11" ECU_ADDRESS 0x382D78 /end MEASUREMENT
/begin MEASUREMENT B_cldver "" UWORD B_TRUE 1 100 0.00 1.00000000000 BIT_MASK 0x80 FORMAT "%13.11" ECU_ADDRESS 0x382D7A /end MEASUREMENT
/begin MEASUREMENT B_cldvet "" UWORD B_TRUE 1 100 0.00 1.00000000000 BIT_MASK 0x80 FORMAT "%13.11" ECU_ADDRESS 0x382D7C /end MEASUREMENT
/begin MEASUREMENT B_cldveu "" UWORD B_TRUE 1 100 0.00 1.00000000000 BIT_MASK 0x80 FORMAT "%13.11" ECU_ADDRESS 0x382D7E /end MEASUREMENT
/begin MEASUREMENT B_cldveub "" UWORD B_TRUE 1 100 0.00 1.00000000000 BIT_MASK 0x80 FORMAT "%13.11" ECU_ADDRESS 0x382D80 /end MEASUREMENT
/begin MEASUREMENT B_cldveuw "" UWORD B_TRUE 1 100 0.00 1.00000000000 BIT_MASK 0x80 FORMAT "%13.11" ECU_ADDRESS 0x382D82 /end MEASUREMENT
/begin MEASUREMENT B_cldvev "" UWORD B_TRUE 1 100 0.00 1.00000000000 BIT_MASK 0x80 FORMAT "%13.11" ECU_ADDRESS 0x382D84 /end MEASUREMENT
/begin MEASUREMENT B_cldylsu "" UWORD B_TRUE 1 100 0.00 1.00000000000 BIT_MASK 0x80 FORMAT "%13.11" ECU_ADDRESS 0x382D86 /end MEASUREMENT
/begin MEASUREMENT B_cldylsu2 "" UWORD B_TRUE 1 100 0.00 1.00000000000 BIT_MASK 0x80 FORMAT "%13.11" ECU_ADDRESS 0x382D88 /end MEASUREMENT
/begin MEASUREMENT B_clegfe "" UWORD B_TRUE 1 100 0.00 1.00000000000 BIT_MASK 0x80 FORMAT "%13.11" ECU_ADDRESS 0x382D8A /end MEASUREMENT
/begin MEASUREMENT B_clenws "" UWORD B_TRUE 1 100 0.00 1.00000000000 BIT_MASK 0x80 FORMAT "%13.11" ECU_ADDRESS 0x382D8E /end MEASUREMENT
/begin MEASUREMENT B_clenwse "" UWORD B_TRUE 1 100 0.00 1.00000000000 BIT_MASK 0x80 FORMAT "%13.11" ECU_ADDRESS 0x382D90 /end MEASUREMENT
/begin MEASUREMENT B_clepcle "" UWORD B_TRUE 1 100 0.00 1.00000000000 BIT_MASK 0x80 FORMAT "%13.11" ECU_ADDRESS 0x382D92 /end MEASUREMENT
/begin MEASUREMENT B_clev1 "" UWORD B_TRUE 1 100 0.00 1.00000000000 BIT_MASK 0x80 FORMAT "%13.11" ECU_ADDRESS 0x382D94 /end MEASUREMENT
/begin MEASUREMENT B_clev2 "" UWORD B_TRUE 1 100 0.00 1.00000000000 BIT_MASK 0x80 FORMAT "%13.11" ECU_ADDRESS 0x382D96 /end MEASUREMENT
/begin MEASUREMENT B_clev3 "" UWORD B_TRUE 1 100 0.00 1.00000000000 BIT_MASK 0x80 FORMAT "%13.11" ECU_ADDRESS 0x382D98 /end MEASUREMENT
/begin MEASUREMENT B_clev4 "" UWORD B_TRUE 1 100 0.00 1.00000000000 BIT_MASK 0x80 FORMAT "%13.11" ECU_ADDRESS 0x382D9A /end MEASUREMENT
/begin MEASUREMENT B_clev5 "" UWORD B_TRUE 1 100 0.00 1.00000000000 BIT_MASK 0x80 FORMAT "%13.11" ECU_ADDRESS 0x382D9C /end MEASUREMENT
/begin MEASUREMENT B_clev6 "" UWORD B_TRUE 1 100 0.00 1.00000000000 BIT_MASK 0x80 FORMAT "%13.11" ECU_ADDRESS 0x382D9E /end MEASUREMENT
/begin MEASUREMENT B_clhelsu "" UWORD B_TRUE 1 100 0.00 1.00000000000 BIT_MASK 0x80 FORMAT "%13.11" ECU_ADDRESS 0x382DB6 /end MEASUREMENT
/begin MEASUREMENT B_clhelsu2 "" UWORD B_TRUE 1 100 0.00 1.00000000000 BIT_MASK 0x80 FORMAT "%13.11" ECU_ADDRESS 0x382DB8 /end MEASUREMENT
/begin MEASUREMENT B_clhsh "" UWORD B_TRUE 1 100 0.00 1.00000000000 BIT_MASK 0x80 FORMAT "%13.11" ECU_ADDRESS 0x382DBC /end MEASUREMENT
/begin MEASUREMENT B_clhsh2 "" UWORD B_TRUE 1 100 0.00 1.00000000000 BIT_MASK 0x80 FORMAT "%13.11" ECU_ADDRESS 0x382DBE /end MEASUREMENT
/begin MEASUREMENT B_clhshe "" UWORD B_TRUE 1 100 0.00 1.00000000000 BIT_MASK 0x80 FORMAT "%13.11" ECU_ADDRESS 0x382DC0 /end MEASUREMENT
/begin MEASUREMENT B_clhshe2 "" UWORD B_TRUE 1 100 0.00 1.00000000000 BIT_MASK 0x80 FORMAT "%13.11" ECU_ADDRESS 0x382DC2 /end MEASUREMENT
/begin MEASUREMENT B_clhsv "" UWORD B_TRUE 1 100 0.00 1.00000000000 BIT_MASK 0x80 FORMAT "%13.11" ECU_ADDRESS 0x382DC4 /end MEASUREMENT
/begin MEASUREMENT B_clhsv2 "" UWORD B_TRUE 1 100 0.00 1.00000000000 BIT_MASK 0x80 FORMAT "%13.11" ECU_ADDRESS 0x382DC6 /end MEASUREMENT
/begin MEASUREMENT B_clhsve "" UWORD B_TRUE 1 100 0.00 1.00000000000 BIT_MASK 0x80 FORMAT "%13.11" ECU_ADDRESS 0x382DC8 /end MEASUREMENT
/begin MEASUREMENT B_clhsve2 "" UWORD B_TRUE 1 100 0.00 1.00000000000 BIT_MASK 0x80 FORMAT "%13.11" ECU_ADDRESS 0x382DCA /end MEASUREMENT
/begin MEASUREMENT B_cliclsu "" UWORD B_TRUE 1 100 0.00 1.00000000000 BIT_MASK 0x80 FORMAT "%13.11" ECU_ADDRESS 0x382DCC /end MEASUREMENT
/begin MEASUREMENT B_cliclsu2 "" UWORD B_TRUE 1 100 0.00 1.00000000000 BIT_MASK 0x80 FORMAT "%13.11" ECU_ADDRESS 0x382DCE /end MEASUREMENT
/begin MEASUREMENT B_clkpe "" UWORD B_TRUE 1 100 0.00 1.00000000000 BIT_MASK 0x80 FORMAT "%13.11" ECU_ADDRESS 0x382DD4 /end MEASUREMENT
/begin MEASUREMENT B_clldpe "" UWORD B_TRUE 1 100 0.00 1.00000000000 BIT_MASK 0x80 FORMAT "%13.11" ECU_ADDRESS 0x382DFA /end MEASUREMENT
/begin MEASUREMENT B_cllsuia "" UWORD B_TRUE 1 100 0.00 1.00000000000 BIT_MASK 0x80 FORMAT "%13.11" ECU_ADDRESS 0x382E06 /end MEASUREMENT
/begin MEASUREMENT B_cllsuia2 "" UWORD B_TRUE 1 100 0.00 1.00000000000 BIT_MASK 0x80 FORMAT "%13.11" ECU_ADDRESS 0x382E08 /end MEASUREMENT
/begin MEASUREMENT B_cllsuip "" UWORD B_TRUE 1 100 0.00 1.00000000000 BIT_MASK 0x80 FORMAT "%13.11" ECU_ADDRESS 0x382E0A /end MEASUREMENT
/begin MEASUREMENT B_cllsuip2 "" UWORD B_TRUE 1 100 0.00 1.00000000000 BIT_MASK 0x80 FORMAT "%13.11" ECU_ADDRESS 0x382E0C /end MEASUREMENT
/begin MEASUREMENT B_cllsuks "" UWORD B_TRUE 1 100 0.00 1.00000000000 BIT_MASK 0x80 FORMAT "%13.11" ECU_ADDRESS 0x382E0E /end MEASUREMENT
/begin MEASUREMENT B_cllsuks2 "" UWORD B_TRUE 1 100 0.00 1.00000000000 BIT_MASK 0x80 FORMAT "%13.11" ECU_ADDRESS 0x382E10 /end MEASUREMENT
/begin MEASUREMENT B_cllsuun "" UWORD B_TRUE 1 100 0.00 1.00000000000 BIT_MASK 0x80 FORMAT "%13.11" ECU_ADDRESS 0x382E12 /end MEASUREMENT
/begin MEASUREMENT B_cllsuun2 "" UWORD B_TRUE 1 100 0.00 1.00000000000 BIT_MASK 0x80 FORMAT "%13.11" ECU_ADDRESS 0x382E14 /end MEASUREMENT
/begin MEASUREMENT B_cllsuvm "" UWORD B_TRUE 1 100 0.00 1.00000000000 BIT_MASK 0x80 FORMAT "%13.11" ECU_ADDRESS 0x382E16 /end MEASUREMENT
/begin MEASUREMENT B_cllsuvm2 "" UWORD B_TRUE 1 100 0.00 1.00000000000 BIT_MASK 0x80 FORMAT "%13.11" ECU_ADDRESS 0x382E18 /end MEASUREMENT
/begin MEASUREMENT B_cllues1e "" UWORD B_TRUE 1 100 0.00 1.00000000000 BIT_MASK 0x80 FORMAT "%13.11" ECU_ADDRESS 0x382E22 /end MEASUREMENT
/begin MEASUREMENT B_cln "" UWORD B_TRUE 1 100 0.00 1.00000000000 BIT_MASK 0x80 FORMAT "%13.11" ECU_ADDRESS 0x382E38 /end MEASUREMENT
/begin MEASUREMENT B_clslpe "" UWORD B_TRUE 1 100 0.00 1.00000000000 BIT_MASK 0x80 FORMAT "%13.11" ECU_ADDRESS 0x382E58 /end MEASUREMENT
/begin MEASUREMENT B_clslve "" UWORD B_TRUE 1 100 0.00 1.00000000000 BIT_MASK 0x80 FORMAT "%13.11" ECU_ADDRESS 0x382E62 /end MEASUREMENT
/begin MEASUREMENT B_clsue "" UWORD B_TRUE 1 100 0.00 1.00000000000 BIT_MASK 0x80 FORMAT "%13.11" ECU_ADDRESS 0x382E64 /end MEASUREMENT
/begin MEASUREMENT B_clteve "" UWORD B_TRUE 1 100 0.00 1.00000000000 BIT_MASK 0x80 FORMAT "%13.11" ECU_ADDRESS 0x382E72 /end MEASUREMENT
/begin MEASUREMENT B_clzet1 "" UWORD B_TRUE 1 100 0.00 1.00000000000 BIT_MASK 0x80 FORMAT "%13.11" ECU_ADDRESS 0x382EA2 /end MEASUREMENT
/begin MEASUREMENT B_clzet2 "" UWORD B_TRUE 1 100 0.00 1.00000000000 BIT_MASK 0x80 FORMAT "%13.11" ECU_ADDRESS 0x382EA4 /end MEASUREMENT
/begin MEASUREMENT B_clzet3 "" UWORD B_TRUE 1 100 0.00 1.00000000000 BIT_MASK 0x80 FORMAT "%13.11" ECU_ADDRESS 0x382EA6 /end MEASUREMENT
/begin MEASUREMENT B_clzet4 "" UWORD B_TRUE 1 100 0.00 1.00000000000 BIT_MASK 0x80 FORMAT "%13.11" ECU_ADDRESS 0x382EA8 /end MEASUREMENT
/begin MEASUREMENT B_clzet5 "" UWORD B_TRUE 1 100 0.00 1.00000000000 BIT_MASK 0x80 FORMAT "%13.11" ECU_ADDRESS 0x382EAA /end MEASUREMENT
/begin MEASUREMENT B_clzet6 "" UWORD B_TRUE 1 100 0.00 1.00000000000 BIT_MASK 0x80 FORMAT "%13.11" ECU_ADDRESS 0x382EAC /end MEASUREMENT
/begin MEASUREMENT B_clzwpe "" UWORD B_TRUE 1 100 0.00 1.00000000000 BIT_MASK 0x80 FORMAT "%13.11" ECU_ADDRESS 0x382EAE /end MEASUREMENT
/begin MEASUREMENT B_ftakre "" UWORD B_TRUE 1 100 0.00 1.00000000000 BIT_MASK 0x10 FORMAT "%13.11" ECU_ADDRESS 0x382D34 /end MEASUREMENT
/begin MEASUREMENT B_ftanws "" UWORD B_TRUE 1 100 0.00 1.00000000000 BIT_MASK 0x10 FORMAT "%13.11" ECU_ADDRESS 0x382D36 /end MEASUREMENT
/begin MEASUREMENT B_ftanwse "" UWORD B_TRUE 1 100 0.00 1.00000000000 BIT_MASK 0x10 FORMAT "%13.11" ECU_ADDRESS 0x382D38 /end MEASUREMENT
/begin MEASUREMENT B_ftbkvp "" UWORD B_TRUE 1 100 0.00 1.00000000000 BIT_MASK 0x10 FORMAT "%13.11" ECU_ADDRESS 0x382D3C /end MEASUREMENT
/begin MEASUREMENT B_ftbkvpe "" UWORD B_TRUE 1 100 0.00 1.00000000000 BIT_MASK 0x10 FORMAT "%13.11" ECU_ADDRESS 0x382D3E /end MEASUREMENT
/begin MEASUREMENT B_ftbm "" UWORD B_TRUE 1 100 0.00 1.00000000000 BIT_MASK 0x10 FORMAT "%13.11" ECU_ADDRESS 0x382D40 /end MEASUREMENT
/begin MEASUREMENT B_ftcif "" UWORD B_TRUE 1 100 0.00 1.00000000000 BIT_MASK 0x10 FORMAT "%13.11" ECU_ADDRESS 0x382D58 /end MEASUREMENT
/begin MEASUREMENT B_ftcins "" UWORD B_TRUE 1 100 0.00 1.00000000000 BIT_MASK 0x10 FORMAT "%13.11" ECU_ADDRESS 0x382D5A /end MEASUREMENT
/begin MEASUREMENT B_ftckla "" UWORD B_TRUE 1 100 0.00 1.00000000000 BIT_MASK 0x10 FORMAT "%13.11" ECU_ADDRESS 0x382D5C /end MEASUREMENT
/begin MEASUREMENT B_ftclws "" UWORD B_TRUE 1 100 0.00 1.00000000000 BIT_MASK 0x10 FORMAT "%13.11" ECU_ADDRESS 0x382D5E /end MEASUREMENT
/begin MEASUREMENT B_ftctog "" UWORD B_TRUE 1 100 0.00 1.00000000000 BIT_MASK 0x10 FORMAT "%13.11" ECU_ADDRESS 0x382D60 /end MEASUREMENT
/begin MEASUREMENT B_ftczas "" UWORD B_TRUE 1 100 0.00 1.00000000000 BIT_MASK 0x10 FORMAT "%13.11" ECU_ADDRESS 0x382D62 /end MEASUREMENT
/begin MEASUREMENT B_ftdk "" UWORD B_TRUE 1 100 0.00 1.00000000000 BIT_MASK 0x10 FORMAT "%13.11" ECU_ADDRESS 0x382D64 /end MEASUREMENT
/begin MEASUREMENT B_ftdk1p "" UWORD B_TRUE 1 100 0.00 1.00000000000 BIT_MASK 0x10 FORMAT "%13.11" ECU_ADDRESS 0x382D66 /end MEASUREMENT
/begin MEASUREMENT B_ftdk2p "" UWORD B_TRUE 1 100 0.00 1.00000000000 BIT_MASK 0x10 FORMAT "%13.11" ECU_ADDRESS 0x382D68 /end MEASUREMENT
/begin MEASUREMENT B_ftdvee "" UWORD B_TRUE 1 100 0.00 1.00000000000 BIT_MASK 0x10 FORMAT "%13.11" ECU_ADDRESS 0x382D70 /end MEASUREMENT
/begin MEASUREMENT B_ftdvef "" UWORD B_TRUE 1 100 0.00 1.00000000000 BIT_MASK 0x10 FORMAT "%13.11" ECU_ADDRESS 0x382D72 /end MEASUREMENT
/begin MEASUREMENT B_ftdvefo "" UWORD B_TRUE 1 100 0.00 1.00000000000 BIT_MASK 0x10 FORMAT "%13.11" ECU_ADDRESS 0x382D74 /end MEASUREMENT
/begin MEASUREMENT B_ftdvel "" UWORD B_TRUE 1 100 0.00 1.00000000000 BIT_MASK 0x10 FORMAT "%13.11" ECU_ADDRESS 0x382D76 /end MEASUREMENT
/begin MEASUREMENT B_ftdven "" UWORD B_TRUE 1 100 0.00 1.00000000000 BIT_MASK 0x10 FORMAT "%13.11" ECU_ADDRESS 0x382D78 /end MEASUREMENT
/begin MEASUREMENT B_ftdver "" UWORD B_TRUE 1 100 0.00 1.00000000000 BIT_MASK 0x10 FORMAT "%13.11" ECU_ADDRESS 0x382D7A /end MEASUREMENT
/begin MEASUREMENT B_ftdvet "" UWORD B_TRUE 1 100 0.00 1.00000000000 BIT_MASK 0x10 FORMAT "%13.11" ECU_ADDRESS 0x382D7C /end MEASUREMENT
/begin MEASUREMENT B_ftdveu "" UWORD B_TRUE 1 100 0.00 1.00000000000 BIT_MASK 0x10 FORMAT "%13.11" ECU_ADDRESS 0x382D7E /end MEASUREMENT
/begin MEASUREMENT B_ftdveub "" UWORD B_TRUE 1 100 0.00 1.00000000000 BIT_MASK 0x10 FORMAT "%13.11" ECU_ADDRESS 0x382D80 /end MEASUREMENT
/begin MEASUREMENT B_ftdveuw "" UWORD B_TRUE 1 100 0.00 1.00000000000 BIT_MASK 0x10 FORMAT "%13.11" ECU_ADDRESS 0x382D82 /end MEASUREMENT
/begin MEASUREMENT B_ftdvev "" UWORD B_TRUE 1 100 0.00 1.00000000000 BIT_MASK 0x10 FORMAT "%13.11" ECU_ADDRESS 0x382D84 /end MEASUREMENT
/begin MEASUREMENT B_ftdylsu "" UWORD B_TRUE 1 100 0.00 1.00000000000 BIT_MASK 0x10 FORMAT "%13.11" ECU_ADDRESS 0x382D86 /end MEASUREMENT
/begin MEASUREMENT B_ftdylsu2 "" UWORD B_TRUE 1 100 0.00 1.00000000000 BIT_MASK 0x10 FORMAT "%13.11" ECU_ADDRESS 0x382D88 /end MEASUREMENT
/begin MEASUREMENT B_ftegfe "" UWORD B_TRUE 1 100 0.00 1.00000000000 BIT_MASK 0x10 FORMAT "%13.11" ECU_ADDRESS 0x382D8A /end MEASUREMENT
/begin MEASUREMENT B_ftenws "" UWORD B_TRUE 1 100 0.00 1.00000000000 BIT_MASK 0x10 FORMAT "%13.11" ECU_ADDRESS 0x382D8E /end MEASUREMENT
/begin MEASUREMENT B_ftenwse "" UWORD B_TRUE 1 100 0.00 1.00000000000 BIT_MASK 0x10 FORMAT "%13.11" ECU_ADDRESS 0x382D90 /end MEASUREMENT
/begin MEASUREMENT B_ftepcle "" UWORD B_TRUE 1 100 0.00 1.00000000000 BIT_MASK 0x10 FORMAT "%13.11" ECU_ADDRESS 0x382D92 /end MEASUREMENT
/begin MEASUREMENT B_ftev1 "" UWORD B_TRUE 1 100 0.00 1.00000000000 BIT_MASK 0x10 FORMAT "%13.11" ECU_ADDRESS 0x382D94 /end MEASUREMENT
/begin MEASUREMENT B_ftev2 "" UWORD B_TRUE 1 100 0.00 1.00000000000 BIT_MASK 0x10 FORMAT "%13.11" ECU_ADDRESS 0x382D96 /end MEASUREMENT
/begin MEASUREMENT B_ftev3 "" UWORD B_TRUE 1 100 0.00 1.00000000000 BIT_MASK 0x10 FORMAT "%13.11" ECU_ADDRESS 0x382D98 /end MEASUREMENT
/begin MEASUREMENT B_ftev4 "" UWORD B_TRUE 1 100 0.00 1.00000000000 BIT_MASK 0x10 FORMAT "%13.11" ECU_ADDRESS 0x382D9A /end MEASUREMENT
/begin MEASUREMENT B_ftev5 "" UWORD B_TRUE 1 100 0.00 1.00000000000 BIT_MASK 0x10 FORMAT "%13.11" ECU_ADDRESS 0x382D9C /end MEASUREMENT
/begin MEASUREMENT B_ftev6 "" UWORD B_TRUE 1 100 0.00 1.00000000000 BIT_MASK 0x10 FORMAT "%13.11" ECU_ADDRESS 0x382D9E /end MEASUREMENT
/begin MEASUREMENT B_fthelsu "" UWORD B_TRUE 1 100 0.00 1.00000000000 BIT_MASK 0x10 FORMAT "%13.11" ECU_ADDRESS 0x382DB6 /end MEASUREMENT
/begin MEASUREMENT B_fthelsu2 "" UWORD B_TRUE 1 100 0.00 1.00000000000 BIT_MASK 0x10 FORMAT "%13.11" ECU_ADDRESS 0x382DB8 /end MEASUREMENT
/begin MEASUREMENT B_fthsh "" UWORD B_TRUE 1 100 0.00 1.00000000000 BIT_MASK 0x10 FORMAT "%13.11" ECU_ADDRESS 0x382DBC /end MEASUREMENT
/begin MEASUREMENT B_fthsh2 "" UWORD B_TRUE 1 100 0.00 1.00000000000 BIT_MASK 0x10 FORMAT "%13.11" ECU_ADDRESS 0x382DBE /end MEASUREMENT
/begin MEASUREMENT B_fthshe "" UWORD B_TRUE 1 100 0.00 1.00000000000 BIT_MASK 0x10 FORMAT "%13.11" ECU_ADDRESS 0x382DC0 /end MEASUREMENT
/begin MEASUREMENT B_fthshe2 "" UWORD B_TRUE 1 100 0.00 1.00000000000 BIT_MASK 0x10 FORMAT "%13.11" ECU_ADDRESS 0x382DC2 /end MEASUREMENT
/begin MEASUREMENT B_fthsv "" UWORD B_TRUE 1 100 0.00 1.00000000000 BIT_MASK 0x10 FORMAT "%13.11" ECU_ADDRESS 0x382DC4 /end MEASUREMENT
/begin MEASUREMENT B_fthsv2 "" UWORD B_TRUE 1 100 0.00 1.00000000000 BIT_MASK 0x10 FORMAT "%13.11" ECU_ADDRESS 0x382DC6 /end MEASUREMENT
/begin MEASUREMENT B_fthsve "" UWORD B_TRUE 1 100 0.00 1.00000000000 BIT_MASK 0x10 FORMAT "%13.11" ECU_ADDRESS 0x382DC8 /end MEASUREMENT
/begin MEASUREMENT B_fthsve2 "" UWORD B_TRUE 1 100 0.00 1.00000000000 BIT_MASK 0x10 FORMAT "%13.11" ECU_ADDRESS 0x382DCA /end MEASUREMENT
/begin MEASUREMENT B_fticlsu "" UWORD B_TRUE 1 100 0.00 1.00000000000 BIT_MASK 0x10 FORMAT "%13.11" ECU_ADDRESS 0x382DCC /end MEASUREMENT
/begin MEASUREMENT B_fticlsu2 "" UWORD B_TRUE 1 100 0.00 1.00000000000 BIT_MASK 0x10 FORMAT "%13.11" ECU_ADDRESS 0x382DCE /end MEASUREMENT
/begin MEASUREMENT B_ftkpe "" UWORD B_TRUE 1 100 0.00 1.00000000000 BIT_MASK 0x10 FORMAT "%13.11" ECU_ADDRESS 0x382DD4 /end MEASUREMENT
/begin MEASUREMENT B_ftldpe "" UWORD B_TRUE 1 100 0.00 1.00000000000 BIT_MASK 0x10 FORMAT "%13.11" ECU_ADDRESS 0x382DFA /end MEASUREMENT
/begin MEASUREMENT B_ftlsuia "" UWORD B_TRUE 1 100 0.00 1.00000000000 BIT_MASK 0x10 FORMAT "%13.11" ECU_ADDRESS 0x382E06 /end MEASUREMENT
/begin MEASUREMENT B_ftlsuia2 "" UWORD B_TRUE 1 100 0.00 1.00000000000 BIT_MASK 0x10 FORMAT "%13.11" ECU_ADDRESS 0x382E08 /end MEASUREMENT
/begin MEASUREMENT B_ftlsuip "" UWORD B_TRUE 1 100 0.00 1.00000000000 BIT_MASK 0x10 FORMAT "%13.11" ECU_ADDRESS 0x382E0A /end MEASUREMENT
/begin MEASUREMENT B_ftlsuip2 "" UWORD B_TRUE 1 100 0.00 1.00000000000 BIT_MASK 0x10 FORMAT "%13.11" ECU_ADDRESS 0x382E0C /end MEASUREMENT
/begin MEASUREMENT B_ftlsuks "" UWORD B_TRUE 1 100 0.00 1.00000000000 BIT_MASK 0x10 FORMAT "%13.11" ECU_ADDRESS 0x382E0E /end MEASUREMENT
/begin MEASUREMENT B_ftlsuks2 "" UWORD B_TRUE 1 100 0.00 1.00000000000 BIT_MASK 0x10 FORMAT "%13.11" ECU_ADDRESS 0x382E10 /end MEASUREMENT
/begin MEASUREMENT B_ftlsuun "" UWORD B_TRUE 1 100 0.00 1.00000000000 BIT_MASK 0x10 FORMAT "%13.11" ECU_ADDRESS 0x382E12 /end MEASUREMENT
/begin MEASUREMENT B_ftlsuun2 "" UWORD B_TRUE 1 100 0.00 1.00000000000 BIT_MASK 0x10 FORMAT "%13.11" ECU_ADDRESS 0x382E14 /end MEASUREMENT
/begin MEASUREMENT B_ftlsuvm "" UWORD B_TRUE 1 100 0.00 1.00000000000 BIT_MASK 0x10 FORMAT "%13.11" ECU_ADDRESS 0x382E16 /end MEASUREMENT
/begin MEASUREMENT B_ftlsuvm2 "" UWORD B_TRUE 1 100 0.00 1.00000000000 BIT_MASK 0x10 FORMAT "%13.11" ECU_ADDRESS 0x382E18 /end MEASUREMENT
/begin MEASUREMENT B_ftlues1e "" UWORD B_TRUE 1 100 0.00 1.00000000000 BIT_MASK 0x10 FORMAT "%13.11" ECU_ADDRESS 0x382E22 /end MEASUREMENT
/begin MEASUREMENT B_ftn "" UWORD B_TRUE 1 100 0.00 1.00000000000 BIT_MASK 0x10 FORMAT "%13.11" ECU_ADDRESS 0x382E38 /end MEASUREMENT
/begin MEASUREMENT B_ftslpe "" UWORD B_TRUE 1 100 0.00 1.00000000000 BIT_MASK 0x10 FORMAT "%13.11" ECU_ADDRESS 0x382E58 /end MEASUREMENT
/begin MEASUREMENT B_ftslve "" UWORD B_TRUE 1 100 0.00 1.00000000000 BIT_MASK 0x10 FORMAT "%13.11" ECU_ADDRESS 0x382E62 /end MEASUREMENT
/begin MEASUREMENT B_ftsue "" UWORD B_TRUE 1 100 0.00 1.00000000000 BIT_MASK 0x10 FORMAT "%13.11" ECU_ADDRESS 0x382E64 /end MEASUREMENT
/begin MEASUREMENT B_ftteve "" UWORD B_TRUE 1 100 0.00 1.00000000000 BIT_MASK 0x10 FORMAT "%13.11" ECU_ADDRESS 0x382E72 /end MEASUREMENT
/begin MEASUREMENT B_ftzet1 "" UWORD B_TRUE 1 100 0.00 1.00000000000 BIT_MASK 0x10 FORMAT "%13.11" ECU_ADDRESS 0x382EA2 /end MEASUREMENT
/begin MEASUREMENT B_ftzet2 "" UWORD B_TRUE 1 100 0.00 1.00000000000 BIT_MASK 0x10 FORMAT "%13.11" ECU_ADDRESS 0x382EA4 /end MEASUREMENT
/begin MEASUREMENT B_ftzet3 "" UWORD B_TRUE 1 100 0.00 1.00000000000 BIT_MASK 0x10 FORMAT "%13.11" ECU_ADDRESS 0x382EA6 /end MEASUREMENT
/begin MEASUREMENT B_ftzet4 "" UWORD B_TRUE 1 100 0.00 1.00000000000 BIT_MASK 0x10 FORMAT "%13.11" ECU_ADDRESS 0x382EA8 /end MEASUREMENT
/begin MEASUREMENT B_ftzet5 "" UWORD B_TRUE 1 100 0.00 1.00000000000 BIT_MASK 0x10 FORMAT "%13.11" ECU_ADDRESS 0x382EAA /end MEASUREMENT
/begin MEASUREMENT B_ftzet6 "" UWORD B_TRUE 1 100 0.00 1.00000000000 BIT_MASK 0x10 FORMAT "%13.11" ECU_ADDRESS 0x382EAC /end MEASUREMENT
/begin MEASUREMENT B_ftzwpe "" UWORD B_TRUE 1 100 0.00 1.00000000000 BIT_MASK 0x10 FORMAT "%13.11" ECU_ADDRESS 0x382EAE /end MEASUREMENT
/begin MEASUREMENT B_mnakre "" UWORD B_TRUE 1 100 0.00 1.00000000000 BIT_MASK 0x200 FORMAT "%13.11" ECU_ADDRESS 0x382D34 /end MEASUREMENT
/begin MEASUREMENT B_mnanws "" UWORD B_TRUE 1 100 0.00 1.00000000000 BIT_MASK 0x200 FORMAT "%13.11" ECU_ADDRESS 0x382D36 /end MEASUREMENT
/begin MEASUREMENT B_mnanwse "" UWORD B_TRUE 1 100 0.00 1.00000000000 BIT_MASK 0x200 FORMAT "%13.11" ECU_ADDRESS 0x382D38 /end MEASUREMENT
/begin MEASUREMENT B_mnbkvp "" UWORD B_TRUE 1 100 0.00 1.00000000000 BIT_MASK 0x200 FORMAT "%13.11" ECU_ADDRESS 0x382D3C /end MEASUREMENT
/begin MEASUREMENT B_mnbkvpe "" UWORD B_TRUE 1 100 0.00 1.00000000000 BIT_MASK 0x200 FORMAT "%13.11" ECU_ADDRESS 0x382D3E /end MEASUREMENT
/begin MEASUREMENT B_mnbm "" UWORD B_TRUE 1 100 0.00 1.00000000000 BIT_MASK 0x200 FORMAT "%13.11" ECU_ADDRESS 0x382D40 /end MEASUREMENT
/begin MEASUREMENT B_mncif "" UWORD B_TRUE 1 100 0.00 1.00000000000 BIT_MASK 0x200 FORMAT "%13.11" ECU_ADDRESS 0x382D58 /end MEASUREMENT
/begin MEASUREMENT B_mncins "" UWORD B_TRUE 1 100 0.00 1.00000000000 BIT_MASK 0x200 FORMAT "%13.11" ECU_ADDRESS 0x382D5A /end MEASUREMENT
/begin MEASUREMENT B_mnckla "" UWORD B_TRUE 1 100 0.00 1.00000000000 BIT_MASK 0x200 FORMAT "%13.11" ECU_ADDRESS 0x382D5C /end MEASUREMENT
/begin MEASUREMENT B_mnclws "" UWORD B_TRUE 1 100 0.00 1.00000000000 BIT_MASK 0x200 FORMAT "%13.11" ECU_ADDRESS 0x382D5E /end MEASUREMENT
/begin MEASUREMENT B_mnctog "" UWORD B_TRUE 1 100 0.00 1.00000000000 BIT_MASK 0x200 FORMAT "%13.11" ECU_ADDRESS 0x382D60 /end MEASUREMENT
/begin MEASUREMENT B_mnczas "" UWORD B_TRUE 1 100 0.00 1.00000000000 BIT_MASK 0x200 FORMAT "%13.11" ECU_ADDRESS 0x382D62 /end MEASUREMENT
/begin MEASUREMENT B_mndk "" UWORD B_TRUE 1 100 0.00 1.00000000000 BIT_MASK 0x200 FORMAT "%13.11" ECU_ADDRESS 0x382D64 /end MEASUREMENT
/begin MEASUREMENT B_mndk1p "" UWORD B_TRUE 1 100 0.00 1.00000000000 BIT_MASK 0x200 FORMAT "%13.11" ECU_ADDRESS 0x382D66 /end MEASUREMENT
/begin MEASUREMENT B_mndk2p "" UWORD B_TRUE 1 100 0.00 1.00000000000 BIT_MASK 0x200 FORMAT "%13.11" ECU_ADDRESS 0x382D68 /end MEASUREMENT
/begin MEASUREMENT B_mndvee "" UWORD B_TRUE 1 100 0.00 1.00000000000 BIT_MASK 0x200 FORMAT "%13.11" ECU_ADDRESS 0x382D70 /end MEASUREMENT
/begin MEASUREMENT B_mndvef "" UWORD B_TRUE 1 100 0.00 1.00000000000 BIT_MASK 0x200 FORMAT "%13.11" ECU_ADDRESS 0x382D72 /end MEASUREMENT
/begin MEASUREMENT B_mndvefo "" UWORD B_TRUE 1 100 0.00 1.00000000000 BIT_MASK 0x200 FORMAT "%13.11" ECU_ADDRESS 0x382D74 /end MEASUREMENT
/begin MEASUREMENT B_mndvel "" UWORD B_TRUE 1 100 0.00 1.00000000000 BIT_MASK 0x200 FORMAT "%13.11" ECU_ADDRESS 0x382D76 /end MEASUREMENT
/begin MEASUREMENT B_mndven "" UWORD B_TRUE 1 100 0.00 1.00000000000 BIT_MASK 0x200 FORMAT "%13.11" ECU_ADDRESS 0x382D78 /end MEASUREMENT
/begin MEASUREMENT B_mndver "" UWORD B_TRUE 1 100 0.00 1.00000000000 BIT_MASK 0x200 FORMAT "%13.11" ECU_ADDRESS 0x382D7A /end MEASUREMENT
/begin MEASUREMENT B_mndvet "" UWORD B_TRUE 1 100 0.00 1.00000000000 BIT_MASK 0x200 FORMAT "%13.11" ECU_ADDRESS 0x382D7C /end MEASUREMENT
/begin MEASUREMENT B_mndveu "" UWORD B_TRUE 1 100 0.00 1.00000000000 BIT_MASK 0x200 FORMAT "%13.11" ECU_ADDRESS 0x382D7E /end MEASUREMENT
/begin MEASUREMENT B_mndveub "" UWORD B_TRUE 1 100 0.00 1.00000000000 BIT_MASK 0x200 FORMAT "%13.11" ECU_ADDRESS 0x382D80 /end MEASUREMENT
/begin MEASUREMENT B_mndveuw "" UWORD B_TRUE 1 100 0.00 1.00000000000 BIT_MASK 0x200 FORMAT "%13.11" ECU_ADDRESS 0x382D82 /end MEASUREMENT
/begin MEASUREMENT B_mndvev "" UWORD B_TRUE 1 100 0.00 1.00000000000 BIT_MASK 0x200 FORMAT "%13.11" ECU_ADDRESS 0x382D84 /end MEASUREMENT
/begin MEASUREMENT B_mndylsu "" UWORD B_TRUE 1 100 0.00 1.00000000000 BIT_MASK 0x200 FORMAT "%13.11" ECU_ADDRESS 0x382D86 /end MEASUREMENT
/begin MEASUREMENT B_mndylsu2 "" UWORD B_TRUE 1 100 0.00 1.00000000000 BIT_MASK 0x200 FORMAT "%13.11" ECU_ADDRESS 0x382D88 /end MEASUREMENT
/begin MEASUREMENT B_mnegfe "" UWORD B_TRUE 1 100 0.00 1.00000000000 BIT_MASK 0x200 FORMAT "%13.11" ECU_ADDRESS 0x382D8A /end MEASUREMENT
/begin MEASUREMENT B_mnenws "" UWORD B_TRUE 1 100 0.00 1.00000000000 BIT_MASK 0x200 FORMAT "%13.11" ECU_ADDRESS 0x382D8E /end MEASUREMENT
/begin MEASUREMENT B_mnenwse "" UWORD B_TRUE 1 100 0.00 1.00000000000 BIT_MASK 0x200 FORMAT "%13.11" ECU_ADDRESS 0x382D90 /end MEASUREMENT
/begin MEASUREMENT B_mnepcle "" UWORD B_TRUE 1 100 0.00 1.00000000000 BIT_MASK 0x200 FORMAT "%13.11" ECU_ADDRESS 0x382D92 /end MEASUREMENT
/begin MEASUREMENT B_mnev1 "" UWORD B_TRUE 1 100 0.00 1.00000000000 BIT_MASK 0x200 FORMAT "%13.11" ECU_ADDRESS 0x382D94 /end MEASUREMENT
/begin MEASUREMENT B_mnev2 "" UWORD B_TRUE 1 100 0.00 1.00000000000 BIT_MASK 0x200 FORMAT "%13.11" ECU_ADDRESS 0x382D96 /end MEASUREMENT
/begin MEASUREMENT B_mnev3 "" UWORD B_TRUE 1 100 0.00 1.00000000000 BIT_MASK 0x200 FORMAT "%13.11" ECU_ADDRESS 0x382D98 /end MEASUREMENT
/begin MEASUREMENT B_mnev4 "" UWORD B_TRUE 1 100 0.00 1.00000000000 BIT_MASK 0x200 FORMAT "%13.11" ECU_ADDRESS 0x382D9A /end MEASUREMENT
/begin MEASUREMENT B_mnev5 "" UWORD B_TRUE 1 100 0.00 1.00000000000 BIT_MASK 0x200 FORMAT "%13.11" ECU_ADDRESS 0x382D9C /end MEASUREMENT
/begin MEASUREMENT B_mnev6 "" UWORD B_TRUE 1 100 0.00 1.00000000000 BIT_MASK 0x200 FORMAT "%13.11" ECU_ADDRESS 0x382D9E /end MEASUREMENT
/begin MEASUREMENT B_mnhelsu "" UWORD B_TRUE 1 100 0.00 1.00000000000 BIT_MASK 0x200 FORMAT "%13.11" ECU_ADDRESS 0x382DB6 /end MEASUREMENT
/begin MEASUREMENT B_mnhelsu2 "" UWORD B_TRUE 1 100 0.00 1.00000000000 BIT_MASK 0x200 FORMAT "%13.11" ECU_ADDRESS 0x382DB8 /end MEASUREMENT
/begin MEASUREMENT B_mnhsh "" UWORD B_TRUE 1 100 0.00 1.00000000000 BIT_MASK 0x200 FORMAT "%13.11" ECU_ADDRESS 0x382DBC /end MEASUREMENT
/begin MEASUREMENT B_mnhsh2 "" UWORD B_TRUE 1 100 0.00 1.00000000000 BIT_MASK 0x200 FORMAT "%13.11" ECU_ADDRESS 0x382DBE /end MEASUREMENT
/begin MEASUREMENT B_mnhshe "" UWORD B_TRUE 1 100 0.00 1.00000000000 BIT_MASK 0x200 FORMAT "%13.11" ECU_ADDRESS 0x382DC0 /end MEASUREMENT
/begin MEASUREMENT B_mnhshe2 "" UWORD B_TRUE 1 100 0.00 1.00000000000 BIT_MASK 0x200 FORMAT "%13.11" ECU_ADDRESS 0x382DC2 /end MEASUREMENT
/begin MEASUREMENT B_mnhsv "" UWORD B_TRUE 1 100 0.00 1.00000000000 BIT_MASK 0x200 FORMAT "%13.11" ECU_ADDRESS 0x382DC4 /end MEASUREMENT
/begin MEASUREMENT B_mnhsv2 "" UWORD B_TRUE 1 100 0.00 1.00000000000 BIT_MASK 0x200 FORMAT "%13.11" ECU_ADDRESS 0x382DC6 /end MEASUREMENT
/begin MEASUREMENT B_mnhsve "" UWORD B_TRUE 1 100 0.00 1.00000000000 BIT_MASK 0x200 FORMAT "%13.11" ECU_ADDRESS 0x382DC8 /end MEASUREMENT
/begin MEASUREMENT B_mnhsve2 "" UWORD B_TRUE 1 100 0.00 1.00000000000 BIT_MASK 0x200 FORMAT "%13.11" ECU_ADDRESS 0x382DCA /end MEASUREMENT
/begin MEASUREMENT B_mniclsu "" UWORD B_TRUE 1 100 0.00 1.00000000000 BIT_MASK 0x200 FORMAT "%13.11" ECU_ADDRESS 0x382DCC /end MEASUREMENT
/begin MEASUREMENT B_mniclsu2 "" UWORD B_TRUE 1 100 0.00 1.00000000000 BIT_MASK 0x200 FORMAT "%13.11" ECU_ADDRESS 0x382DCE /end MEASUREMENT
/begin MEASUREMENT B_mnkpe "" UWORD B_TRUE 1 100 0.00 1.00000000000 BIT_MASK 0x200 FORMAT "%13.11" ECU_ADDRESS 0x382DD4 /end MEASUREMENT
/begin MEASUREMENT B_mnldpe "" UWORD B_TRUE 1 100 0.00 1.00000000000 BIT_MASK 0x200 FORMAT "%13.11" ECU_ADDRESS 0x382DFA /end MEASUREMENT
/begin MEASUREMENT B_mnlsuia "" UWORD B_TRUE 1 100 0.00 1.00000000000 BIT_MASK 0x200 FORMAT "%13.11" ECU_ADDRESS 0x382E06 /end MEASUREMENT
/begin MEASUREMENT B_mnlsuia2 "" UWORD B_TRUE 1 100 0.00 1.00000000000 BIT_MASK 0x200 FORMAT "%13.11" ECU_ADDRESS 0x382E08 /end MEASUREMENT
/begin MEASUREMENT B_mnlsuip "" UWORD B_TRUE 1 100 0.00 1.00000000000 BIT_MASK 0x200 FORMAT "%13.11" ECU_ADDRESS 0x382E0A /end MEASUREMENT
/begin MEASUREMENT B_mnlsuip2 "" UWORD B_TRUE 1 100 0.00 1.00000000000 BIT_MASK 0x200 FORMAT "%13.11" ECU_ADDRESS 0x382E0C /end MEASUREMENT
/begin MEASUREMENT B_mnlsuks "" UWORD B_TRUE 1 100 0.00 1.00000000000 BIT_MASK 0x200 FORMAT "%13.11" ECU_ADDRESS 0x382E0E /end MEASUREMENT
/begin MEASUREMENT B_mnlsuks2 "" UWORD B_TRUE 1 100 0.00 1.00000000000 BIT_MASK 0x200 FORMAT "%13.11" ECU_ADDRESS 0x382E10 /end MEASUREMENT
/begin MEASUREMENT B_mnlsuun "" UWORD B_TRUE 1 100 0.00 1.00000000000 BIT_MASK 0x200 FORMAT "%13.11" ECU_ADDRESS 0x382E12 /end MEASUREMENT
/begin MEASUREMENT B_mnlsuun2 "" UWORD B_TRUE 1 100 0.00 1.00000000000 BIT_MASK 0x200 FORMAT "%13.11" ECU_ADDRESS 0x382E14 /end MEASUREMENT
/begin MEASUREMENT B_mnlsuvm "" UWORD B_TRUE 1 100 0.00 1.00000000000 BIT_MASK 0x200 FORMAT "%13.11" ECU_ADDRESS 0x382E16 /end MEASUREMENT
/begin MEASUREMENT B_mnlsuvm2 "" UWORD B_TRUE 1 100 0.00 1.00000000000 BIT_MASK 0x200 FORMAT "%13.11" ECU_ADDRESS 0x382E18 /end MEASUREMENT
/begin MEASUREMENT B_mnlues1e "" UWORD B_TRUE 1 100 0.00 1.00000000000 BIT_MASK 0x200 FORMAT "%13.11" ECU_ADDRESS 0x382E22 /end MEASUREMENT
/begin MEASUREMENT B_mnn "" UWORD B_TRUE 1 100 0.00 1.00000000000 BIT_MASK 0x200 FORMAT "%13.11" ECU_ADDRESS 0x382E38 /end MEASUREMENT
/begin MEASUREMENT B_mnslpe "" UWORD B_TRUE 1 100 0.00 1.00000000000 BIT_MASK 0x200 FORMAT "%13.11" ECU_ADDRESS 0x382E58 /end MEASUREMENT
/begin MEASUREMENT B_mnslve "" UWORD B_TRUE 1 100 0.00 1.00000000000 BIT_MASK 0x200 FORMAT "%13.11" ECU_ADDRESS 0x382E62 /end MEASUREMENT
/begin MEASUREMENT B_mnsue "" UWORD B_TRUE 1 100 0.00 1.00000000000 BIT_MASK 0x200 FORMAT "%13.11" ECU_ADDRESS 0x382E64 /end MEASUREMENT
/begin MEASUREMENT B_mnteve "" UWORD B_TRUE 1 100 0.00 1.00000000000 BIT_MASK 0x200 FORMAT "%13.11" ECU_ADDRESS 0x382E72 /end MEASUREMENT
/begin MEASUREMENT B_mnzet1 "" UWORD B_TRUE 1 100 0.00 1.00000000000 BIT_MASK 0x200 FORMAT "%13.11" ECU_ADDRESS 0x382EA2 /end MEASUREMENT
/begin MEASUREMENT B_mnzet2 "" UWORD B_TRUE 1 100 0.00 1.00000000000 BIT_MASK 0x200 FORMAT "%13.11" ECU_ADDRESS 0x382EA4 /end MEASUREMENT
/begin MEASUREMENT B_mnzet3 "" UWORD B_TRUE 1 100 0.00 1.00000000000 BIT_MASK 0x200 FORMAT "%13.11" ECU_ADDRESS 0x382EA6 /end MEASUREMENT
/begin MEASUREMENT B_mnzet4 "" UWORD B_TRUE 1 100 0.00 1.00000000000 BIT_MASK 0x200 FORMAT "%13.11" ECU_ADDRESS 0x382EA8 /end MEASUREMENT
/begin MEASUREMENT B_mnzet5 "" UWORD B_TRUE 1 100 0.00 1.00000000000 BIT_MASK 0x200 FORMAT "%13.11" ECU_ADDRESS 0x382EAA /end MEASUREMENT
/begin MEASUREMENT B_mnzet6 "" UWORD B_TRUE 1 100 0.00 1.00000000000 BIT_MASK 0x200 FORMAT "%13.11" ECU_ADDRESS 0x382EAC /end MEASUREMENT
/begin MEASUREMENT B_mnzwpe "" UWORD B_TRUE 1 100 0.00 1.00000000000 BIT_MASK 0x200 FORMAT "%13.11" ECU_ADDRESS 0x382EAE /end MEASUREMENT
/begin MEASUREMENT B_mxakre "" UWORD B_TRUE 1 100 0.00 1.00000000000 BIT_MASK 0x100 FORMAT "%13.11" ECU_ADDRESS 0x382D34 /end MEASUREMENT
/begin MEASUREMENT B_mxanws "" UWORD B_TRUE 1 100 0.00 1.00000000000 BIT_MASK 0x100 FORMAT "%13.11" ECU_ADDRESS 0x382D36 /end MEASUREMENT
/begin MEASUREMENT B_mxanwse "" UWORD B_TRUE 1 100 0.00 1.00000000000 BIT_MASK 0x100 FORMAT "%13.11" ECU_ADDRESS 0x382D38 /end MEASUREMENT
/begin MEASUREMENT B_mxbkvp "" UWORD B_TRUE 1 100 0.00 1.00000000000 BIT_MASK 0x100 FORMAT "%13.11" ECU_ADDRESS 0x382D3C /end MEASUREMENT
/begin MEASUREMENT B_mxbkvpe "" UWORD B_TRUE 1 100 0.00 1.00000000000 BIT_MASK 0x100 FORMAT "%13.11" ECU_ADDRESS 0x382D3E /end MEASUREMENT
/begin MEASUREMENT B_mxbm "" UWORD B_TRUE 1 100 0.00 1.00000000000 BIT_MASK 0x100 FORMAT "%13.11" ECU_ADDRESS 0x382D40 /end MEASUREMENT
/begin MEASUREMENT B_mxcif "" UWORD B_TRUE 1 100 0.00 1.00000000000 BIT_MASK 0x100 FORMAT "%13.11" ECU_ADDRESS 0x382D58 /end MEASUREMENT
/begin MEASUREMENT B_mxcins "" UWORD B_TRUE 1 100 0.00 1.00000000000 BIT_MASK 0x100 FORMAT "%13.11" ECU_ADDRESS 0x382D5A /end MEASUREMENT
/begin MEASUREMENT B_mxckla "" UWORD B_TRUE 1 100 0.00 1.00000000000 BIT_MASK 0x100 FORMAT "%13.11" ECU_ADDRESS 0x382D5C /end MEASUREMENT
/begin MEASUREMENT B_mxclws "" UWORD B_TRUE 1 100 0.00 1.00000000000 BIT_MASK 0x100 FORMAT "%13.11" ECU_ADDRESS 0x382D5E /end MEASUREMENT
/begin MEASUREMENT B_mxctog "" UWORD B_TRUE 1 100 0.00 1.00000000000 BIT_MASK 0x100 FORMAT "%13.11" ECU_ADDRESS 0x382D60 /end MEASUREMENT
/begin MEASUREMENT B_mxczas "" UWORD B_TRUE 1 100 0.00 1.00000000000 BIT_MASK 0x100 FORMAT "%13.11" ECU_ADDRESS 0x382D62 /end MEASUREMENT
/begin MEASUREMENT B_mxdk "" UWORD B_TRUE 1 100 0.00 1.00000000000 BIT_MASK 0x100 FORMAT "%13.11" ECU_ADDRESS 0x382D64 /end MEASUREMENT
/begin MEASUREMENT B_mxdk1p "" UWORD B_TRUE 1 100 0.00 1.00000000000 BIT_MASK 0x100 FORMAT "%13.11" ECU_ADDRESS 0x382D66 /end MEASUREMENT
/begin MEASUREMENT B_mxdk2p "" UWORD B_TRUE 1 100 0.00 1.00000000000 BIT_MASK 0x100 FORMAT "%13.11" ECU_ADDRESS 0x382D68 /end MEASUREMENT
/begin MEASUREMENT B_mxdvee "" UWORD B_TRUE 1 100 0.00 1.00000000000 BIT_MASK 0x100 FORMAT "%13.11" ECU_ADDRESS 0x382D70 /end MEASUREMENT
/begin MEASUREMENT B_mxdvef "" UWORD B_TRUE 1 100 0.00 1.00000000000 BIT_MASK 0x100 FORMAT "%13.11" ECU_ADDRESS 0x382D72 /end MEASUREMENT
/begin MEASUREMENT B_mxdvefo "" UWORD B_TRUE 1 100 0.00 1.00000000000 BIT_MASK 0x100 FORMAT "%13.11" ECU_ADDRESS 0x382D74 /end MEASUREMENT
/begin MEASUREMENT B_mxdvel "" UWORD B_TRUE 1 100 0.00 1.00000000000 BIT_MASK 0x100 FORMAT "%13.11" ECU_ADDRESS 0x382D76 /end MEASUREMENT
/begin MEASUREMENT B_mxdven "" UWORD B_TRUE 1 100 0.00 1.00000000000 BIT_MASK 0x100 FORMAT "%13.11" ECU_ADDRESS 0x382D78 /end MEASUREMENT
/begin MEASUREMENT B_mxdver "" UWORD B_TRUE 1 100 0.00 1.00000000000 BIT_MASK 0x100 FORMAT "%13.11" ECU_ADDRESS 0x382D7A /end MEASUREMENT
/begin MEASUREMENT B_mxdvet "" UWORD B_TRUE 1 100 0.00 1.00000000000 BIT_MASK 0x100 FORMAT "%13.11" ECU_ADDRESS 0x382D7C /end MEASUREMENT
/begin MEASUREMENT B_mxdveu "" UWORD B_TRUE 1 100 0.00 1.00000000000 BIT_MASK 0x100 FORMAT "%13.11" ECU_ADDRESS 0x382D7E /end MEASUREMENT
/begin MEASUREMENT B_mxdveub "" UWORD B_TRUE 1 100 0.00 1.00000000000 BIT_MASK 0x100 FORMAT "%13.11" ECU_ADDRESS 0x382D80 /end MEASUREMENT
/begin MEASUREMENT B_mxdveuw "" UWORD B_TRUE 1 100 0.00 1.00000000000 BIT_MASK 0x100 FORMAT "%13.11" ECU_ADDRESS 0x382D82 /end MEASUREMENT
/begin MEASUREMENT B_mxdvev "" UWORD B_TRUE 1 100 0.00 1.00000000000 BIT_MASK 0x100 FORMAT "%13.11" ECU_ADDRESS 0x382D84 /end MEASUREMENT
/begin MEASUREMENT B_mxdylsu "" UWORD B_TRUE 1 100 0.00 1.00000000000 BIT_MASK 0x100 FORMAT "%13.11" ECU_ADDRESS 0x382D86 /end MEASUREMENT
/begin MEASUREMENT B_mxdylsu2 "" UWORD B_TRUE 1 100 0.00 1.00000000000 BIT_MASK 0x100 FORMAT "%13.11" ECU_ADDRESS 0x382D88 /end MEASUREMENT
/begin MEASUREMENT B_mxegfe "" UWORD B_TRUE 1 100 0.00 1.00000000000 BIT_MASK 0x100 FORMAT "%13.11" ECU_ADDRESS 0x382D8A /end MEASUREMENT
/begin MEASUREMENT B_mxenws "" UWORD B_TRUE 1 100 0.00 1.00000000000 BIT_MASK 0x100 FORMAT "%13.11" ECU_ADDRESS 0x382D8E /end MEASUREMENT
/begin MEASUREMENT B_mxenwse "" UWORD B_TRUE 1 100 0.00 1.00000000000 BIT_MASK 0x100 FORMAT "%13.11" ECU_ADDRESS 0x382D90 /end MEASUREMENT
/begin MEASUREMENT B_mxepcle "" UWORD B_TRUE 1 100 0.00 1.00000000000 BIT_MASK 0x100 FORMAT "%13.11" ECU_ADDRESS 0x382D92 /end MEASUREMENT
/begin MEASUREMENT B_mxev1 "" UWORD B_TRUE 1 100 0.00 1.00000000000 BIT_MASK 0x100 FORMAT "%13.11" ECU_ADDRESS 0x382D94 /end MEASUREMENT
/begin MEASUREMENT B_mxev2 "" UWORD B_TRUE 1 100 0.00 1.00000000000 BIT_MASK 0x100 FORMAT "%13.11" ECU_ADDRESS 0x382D96 /end MEASUREMENT
/begin MEASUREMENT B_mxev3 "" UWORD B_TRUE 1 100 0.00 1.00000000000 BIT_MASK 0x100 FORMAT "%13.11" ECU_ADDRESS 0x382D98 /end MEASUREMENT
/begin MEASUREMENT B_mxev4 "" UWORD B_TRUE 1 100 0.00 1.00000000000 BIT_MASK 0x100 FORMAT "%13.11" ECU_ADDRESS 0x382D9A /end MEASUREMENT
/begin MEASUREMENT B_mxev5 "" UWORD B_TRUE 1 100 0.00 1.00000000000 BIT_MASK 0x100 FORMAT "%13.11" ECU_ADDRESS 0x382D9C /end MEASUREMENT
/begin MEASUREMENT B_mxev6 "" UWORD B_TRUE 1 100 0.00 1.00000000000 BIT_MASK 0x100 FORMAT "%13.11" ECU_ADDRESS 0x382D9E /end MEASUREMENT
/begin MEASUREMENT B_mxhelsu "" UWORD B_TRUE 1 100 0.00 1.00000000000 BIT_MASK 0x100 FORMAT "%13.11" ECU_ADDRESS 0x382DB6 /end MEASUREMENT
/begin MEASUREMENT B_mxhelsu2 "" UWORD B_TRUE 1 100 0.00 1.00000000000 BIT_MASK 0x100 FORMAT "%13.11" ECU_ADDRESS 0x382DB8 /end MEASUREMENT
/begin MEASUREMENT B_mxhsh "" UWORD B_TRUE 1 100 0.00 1.00000000000 BIT_MASK 0x100 FORMAT "%13.11" ECU_ADDRESS 0x382DBC /end MEASUREMENT
/begin MEASUREMENT B_mxhsh2 "" UWORD B_TRUE 1 100 0.00 1.00000000000 BIT_MASK 0x100 FORMAT "%13.11" ECU_ADDRESS 0x382DBE /end MEASUREMENT
/begin MEASUREMENT B_mxhshe "" UWORD B_TRUE 1 100 0.00 1.00000000000 BIT_MASK 0x100 FORMAT "%13.11" ECU_ADDRESS 0x382DC0 /end MEASUREMENT
/begin MEASUREMENT B_mxhshe2 "" UWORD B_TRUE 1 100 0.00 1.00000000000 BIT_MASK 0x100 FORMAT "%13.11" ECU_ADDRESS 0x382DC2 /end MEASUREMENT
/begin MEASUREMENT B_mxhsv "" UWORD B_TRUE 1 100 0.00 1.00000000000 BIT_MASK 0x100 FORMAT "%13.11" ECU_ADDRESS 0x382DC4 /end MEASUREMENT
/begin MEASUREMENT B_mxhsv2 "" UWORD B_TRUE 1 100 0.00 1.00000000000 BIT_MASK 0x100 FORMAT "%13.11" ECU_ADDRESS 0x382DC6 /end MEASUREMENT
/begin MEASUREMENT B_mxhsve "" UWORD B_TRUE 1 100 0.00 1.00000000000 BIT_MASK 0x100 FORMAT "%13.11" ECU_ADDRESS 0x382DC8 /end MEASUREMENT
/begin MEASUREMENT B_mxhsve2 "" UWORD B_TRUE 1 100 0.00 1.00000000000 BIT_MASK 0x100 FORMAT "%13.11" ECU_ADDRESS 0x382DCA /end MEASUREMENT
/begin MEASUREMENT B_mxiclsu "" UWORD B_TRUE 1 100 0.00 1.00000000000 BIT_MASK 0x100 FORMAT "%13.11" ECU_ADDRESS 0x382DCC /end MEASUREMENT
/begin MEASUREMENT B_mxiclsu2 "" UWORD B_TRUE 1 100 0.00 1.00000000000 BIT_MASK 0x100 FORMAT "%13.11" ECU_ADDRESS 0x382DCE /end MEASUREMENT
/begin MEASUREMENT B_mxkpe "" UWORD B_TRUE 1 100 0.00 1.00000000000 BIT_MASK 0x100 FORMAT "%13.11" ECU_ADDRESS 0x382DD4 /end MEASUREMENT
/begin MEASUREMENT B_mxldpe "" UWORD B_TRUE 1 100 0.00 1.00000000000 BIT_MASK 0x100 FORMAT "%13.11" ECU_ADDRESS 0x382DFA /end MEASUREMENT
/begin MEASUREMENT B_mxlsuia "" UWORD B_TRUE 1 100 0.00 1.00000000000 BIT_MASK 0x100 FORMAT "%13.11" ECU_ADDRESS 0x382E06 /end MEASUREMENT
/begin MEASUREMENT B_mxlsuia2 "" UWORD B_TRUE 1 100 0.00 1.00000000000 BIT_MASK 0x100 FORMAT "%13.11" ECU_ADDRESS 0x382E08 /end MEASUREMENT
/begin MEASUREMENT B_mxlsuip "" UWORD B_TRUE 1 100 0.00 1.00000000000 BIT_MASK 0x100 FORMAT "%13.11" ECU_ADDRESS 0x382E0A /end MEASUREMENT
/begin MEASUREMENT B_mxlsuip2 "" UWORD B_TRUE 1 100 0.00 1.00000000000 BIT_MASK 0x100 FORMAT "%13.11" ECU_ADDRESS 0x382E0C /end MEASUREMENT
/begin MEASUREMENT B_mxlsuks "" UWORD B_TRUE 1 100 0.00 1.00000000000 BIT_MASK 0x100 FORMAT "%13.11" ECU_ADDRESS 0x382E0E /end MEASUREMENT
/begin MEASUREMENT B_mxlsuks2 "" UWORD B_TRUE 1 100 0.00 1.00000000000 BIT_MASK 0x100 FORMAT "%13.11" ECU_ADDRESS 0x382E10 /end MEASUREMENT
/begin MEASUREMENT B_mxlsuun "" UWORD B_TRUE 1 100 0.00 1.00000000000 BIT_MASK 0x100 FORMAT "%13.11" ECU_ADDRESS 0x382E12 /end MEASUREMENT
/begin MEASUREMENT B_mxlsuun2 "" UWORD B_TRUE 1 100 0.00 1.00000000000 BIT_MASK 0x100 FORMAT "%13.11" ECU_ADDRESS 0x382E14 /end MEASUREMENT
/begin MEASUREMENT B_mxlsuvm "" UWORD B_TRUE 1 100 0.00 1.00000000000 BIT_MASK 0x100 FORMAT "%13.11" ECU_ADDRESS 0x382E16 /end MEASUREMENT
/begin MEASUREMENT B_mxlsuvm2 "" UWORD B_TRUE 1 100 0.00 1.00000000000 BIT_MASK 0x100 FORMAT "%13.11" ECU_ADDRESS 0x382E18 /end MEASUREMENT
/begin MEASUREMENT B_mxlues1e "" UWORD B_TRUE 1 100 0.00 1.00000000000 BIT_MASK 0x100 FORMAT "%13.11" ECU_ADDRESS 0x382E22 /end MEASUREMENT
/begin MEASUREMENT B_mxn "" UWORD B_TRUE 1 100 0.00 1.00000000000 BIT_MASK 0x100 FORMAT "%13.11" ECU_ADDRESS 0x382E38 /end MEASUREMENT
/begin MEASUREMENT B_mxslpe "" UWORD B_TRUE 1 100 0.00 1.00000000000 BIT_MASK 0x100 FORMAT "%13.11" ECU_ADDRESS 0x382E58 /end MEASUREMENT
/begin MEASUREMENT B_mxslve "" UWORD B_TRUE 1 100 0.00 1.00000000000 BIT_MASK 0x100 FORMAT "%13.11" ECU_ADDRESS 0x382E62 /end MEASUREMENT
/begin MEASUREMENT B_mxsue "" UWORD B_TRUE 1 100 0.00 1.00000000000 BIT_MASK 0x100 FORMAT "%13.11" ECU_ADDRESS 0x382E64 /end MEASUREMENT
/begin MEASUREMENT B_mxteve "" UWORD B_TRUE 1 100 0.00 1.00000000000 BIT_MASK 0x100 FORMAT "%13.11" ECU_ADDRESS 0x382E72 /end MEASUREMENT
/begin MEASUREMENT B_mxzet1 "" UWORD B_TRUE 1 100 0.00 1.00000000000 BIT_MASK 0x100 FORMAT "%13.11" ECU_ADDRESS 0x382EA2 /end MEASUREMENT
/begin MEASUREMENT B_mxzet2 "" UWORD B_TRUE 1 100 0.00 1.00000000000 BIT_MASK 0x100 FORMAT "%13.11" ECU_ADDRESS 0x382EA4 /end MEASUREMENT
/begin MEASUREMENT B_mxzet3 "" UWORD B_TRUE 1 100 0.00 1.00000000000 BIT_MASK 0x100 FORMAT "%13.11" ECU_ADDRESS 0x382EA6 /end MEASUREMENT
/begin MEASUREMENT B_mxzet4 "" UWORD B_TRUE 1 100 0.00 1.00000000000 BIT_MASK 0x100 FORMAT "%13.11" ECU_ADDRESS 0x382EA8 /end MEASUREMENT
/begin MEASUREMENT B_mxzet5 "" UWORD B_TRUE 1 100 0.00 1.00000000000 BIT_MASK 0x100 FORMAT "%13.11" ECU_ADDRESS 0x382EAA /end MEASUREMENT
/begin MEASUREMENT B_mxzet6 "" UWORD B_TRUE 1 100 0.00 1.00000000000 BIT_MASK 0x100 FORMAT "%13.11" ECU_ADDRESS 0x382EAC /end MEASUREMENT
/begin MEASUREMENT B_mxzwpe "" UWORD B_TRUE 1 100 0.00 1.00000000000 BIT_MASK 0x100 FORMAT "%13.11" ECU_ADDRESS 0x382EAE /end MEASUREMENT
/begin MEASUREMENT B_npakre "" UWORD B_TRUE 1 100 0.00 1.00000000000 BIT_MASK 0x800 FORMAT "%13.11" ECU_ADDRESS 0x382D34 /end MEASUREMENT
/begin MEASUREMENT B_npanws "" UWORD B_TRUE 1 100 0.00 1.00000000000 BIT_MASK 0x800 FORMAT "%13.11" ECU_ADDRESS 0x382D36 /end MEASUREMENT
/begin MEASUREMENT B_npanwse "" UWORD B_TRUE 1 100 0.00 1.00000000000 BIT_MASK 0x800 FORMAT "%13.11" ECU_ADDRESS 0x382D38 /end MEASUREMENT
/begin MEASUREMENT B_npbkvp "" UWORD B_TRUE 1 100 0.00 1.00000000000 BIT_MASK 0x800 FORMAT "%13.11" ECU_ADDRESS 0x382D3C /end MEASUREMENT
/begin MEASUREMENT B_npbkvpe "" UWORD B_TRUE 1 100 0.00 1.00000000000 BIT_MASK 0x800 FORMAT "%13.11" ECU_ADDRESS 0x382D3E /end MEASUREMENT
/begin MEASUREMENT B_npbm "" UWORD B_TRUE 1 100 0.00 1.00000000000 BIT_MASK 0x800 FORMAT "%13.11" ECU_ADDRESS 0x382D40 /end MEASUREMENT
/begin MEASUREMENT B_npcif "" UWORD B_TRUE 1 100 0.00 1.00000000000 BIT_MASK 0x800 FORMAT "%13.11" ECU_ADDRESS 0x382D58 /end MEASUREMENT
/begin MEASUREMENT B_npcins "" UWORD B_TRUE 1 100 0.00 1.00000000000 BIT_MASK 0x800 FORMAT "%13.11" ECU_ADDRESS 0x382D5A /end MEASUREMENT
/begin MEASUREMENT B_npckla "" UWORD B_TRUE 1 100 0.00 1.00000000000 BIT_MASK 0x800 FORMAT "%13.11" ECU_ADDRESS 0x382D5C /end MEASUREMENT
/begin MEASUREMENT B_npclws "" UWORD B_TRUE 1 100 0.00 1.00000000000 BIT_MASK 0x800 FORMAT "%13.11" ECU_ADDRESS 0x382D5E /end MEASUREMENT
/begin MEASUREMENT B_npctog "" UWORD B_TRUE 1 100 0.00 1.00000000000 BIT_MASK 0x800 FORMAT "%13.11" ECU_ADDRESS 0x382D60 /end MEASUREMENT
/begin MEASUREMENT B_npczas "" UWORD B_TRUE 1 100 0.00 1.00000000000 BIT_MASK 0x800 FORMAT "%13.11" ECU_ADDRESS 0x382D62 /end MEASUREMENT
/begin MEASUREMENT B_npdk "" UWORD B_TRUE 1 100 0.00 1.00000000000 BIT_MASK 0x800 FORMAT "%13.11" ECU_ADDRESS 0x382D64 /end MEASUREMENT
/begin MEASUREMENT B_npdk1p "" UWORD B_TRUE 1 100 0.00 1.00000000000 BIT_MASK 0x800 FORMAT "%13.11" ECU_ADDRESS 0x382D66 /end MEASUREMENT
/begin MEASUREMENT B_npdk2p "" UWORD B_TRUE 1 100 0.00 1.00000000000 BIT_MASK 0x800 FORMAT "%13.11" ECU_ADDRESS 0x382D68 /end MEASUREMENT
/begin MEASUREMENT B_npdvee "" UWORD B_TRUE 1 100 0.00 1.00000000000 BIT_MASK 0x800 FORMAT "%13.11" ECU_ADDRESS 0x382D70 /end MEASUREMENT
/begin MEASUREMENT B_npdvef "" UWORD B_TRUE 1 100 0.00 1.00000000000 BIT_MASK 0x800 FORMAT "%13.11" ECU_ADDRESS 0x382D72 /end MEASUREMENT
/begin MEASUREMENT B_npdvefo "" UWORD B_TRUE 1 100 0.00 1.00000000000 BIT_MASK 0x800 FORMAT "%13.11" ECU_ADDRESS 0x382D74 /end MEASUREMENT
/begin MEASUREMENT B_npdvel "" UWORD B_TRUE 1 100 0.00 1.00000000000 BIT_MASK 0x800 FORMAT "%13.11" ECU_ADDRESS 0x382D76 /end MEASUREMENT
/begin MEASUREMENT B_npdven "" UWORD B_TRUE 1 100 0.00 1.00000000000 BIT_MASK 0x800 FORMAT "%13.11" ECU_ADDRESS 0x382D78 /end MEASUREMENT
/begin MEASUREMENT B_npdver "" UWORD B_TRUE 1 100 0.00 1.00000000000 BIT_MASK 0x800 FORMAT "%13.11" ECU_ADDRESS 0x382D7A /end MEASUREMENT
/begin MEASUREMENT B_npdvet "" UWORD B_TRUE 1 100 0.00 1.00000000000 BIT_MASK 0x800 FORMAT "%13.11" ECU_ADDRESS 0x382D7C /end MEASUREMENT
/begin MEASUREMENT B_npdveu "" UWORD B_TRUE 1 100 0.00 1.00000000000 BIT_MASK 0x800 FORMAT "%13.11" ECU_ADDRESS 0x382D7E /end MEASUREMENT
/begin MEASUREMENT B_npdveub "" UWORD B_TRUE 1 100 0.00 1.00000000000 BIT_MASK 0x800 FORMAT "%13.11" ECU_ADDRESS 0x382D80 /end MEASUREMENT
/begin MEASUREMENT B_npdveuw "" UWORD B_TRUE 1 100 0.00 1.00000000000 BIT_MASK 0x800 FORMAT "%13.11" ECU_ADDRESS 0x382D82 /end MEASUREMENT
/begin MEASUREMENT B_npdvev "" UWORD B_TRUE 1 100 0.00 1.00000000000 BIT_MASK 0x800 FORMAT "%13.11" ECU_ADDRESS 0x382D84 /end MEASUREMENT
/begin MEASUREMENT B_npdylsu "" UWORD B_TRUE 1 100 0.00 1.00000000000 BIT_MASK 0x800 FORMAT "%13.11" ECU_ADDRESS 0x382D86 /end MEASUREMENT
/begin MEASUREMENT B_npdylsu2 "" UWORD B_TRUE 1 100 0.00 1.00000000000 BIT_MASK 0x800 FORMAT "%13.11" ECU_ADDRESS 0x382D88 /end MEASUREMENT
/begin MEASUREMENT B_npegfe "" UWORD B_TRUE 1 100 0.00 1.00000000000 BIT_MASK 0x800 FORMAT "%13.11" ECU_ADDRESS 0x382D8A /end MEASUREMENT
/begin MEASUREMENT B_npenws "" UWORD B_TRUE 1 100 0.00 1.00000000000 BIT_MASK 0x800 FORMAT "%13.11" ECU_ADDRESS 0x382D8E /end MEASUREMENT
/begin MEASUREMENT B_npenwse "" UWORD B_TRUE 1 100 0.00 1.00000000000 BIT_MASK 0x800 FORMAT "%13.11" ECU_ADDRESS 0x382D90 /end MEASUREMENT
/begin MEASUREMENT B_npepcle "" UWORD B_TRUE 1 100 0.00 1.00000000000 BIT_MASK 0x800 FORMAT "%13.11" ECU_ADDRESS 0x382D92 /end MEASUREMENT
/begin MEASUREMENT B_npev1 "" UWORD B_TRUE 1 100 0.00 1.00000000000 BIT_MASK 0x800 FORMAT "%13.11" ECU_ADDRESS 0x382D94 /end MEASUREMENT
/begin MEASUREMENT B_npev2 "" UWORD B_TRUE 1 100 0.00 1.00000000000 BIT_MASK 0x800 FORMAT "%13.11" ECU_ADDRESS 0x382D96 /end MEASUREMENT
/begin MEASUREMENT B_npev3 "" UWORD B_TRUE 1 100 0.00 1.00000000000 BIT_MASK 0x800 FORMAT "%13.11" ECU_ADDRESS 0x382D98 /end MEASUREMENT
/begin MEASUREMENT B_npev4 "" UWORD B_TRUE 1 100 0.00 1.00000000000 BIT_MASK 0x800 FORMAT "%13.11" ECU_ADDRESS 0x382D9A /end MEASUREMENT
/begin MEASUREMENT B_npev5 "" UWORD B_TRUE 1 100 0.00 1.00000000000 BIT_MASK 0x800 FORMAT "%13.11" ECU_ADDRESS 0x382D9C /end MEASUREMENT
/begin MEASUREMENT B_npev6 "" UWORD B_TRUE 1 100 0.00 1.00000000000 BIT_MASK 0x800 FORMAT "%13.11" ECU_ADDRESS 0x382D9E /end MEASUREMENT
/begin MEASUREMENT B_nphelsu "" UWORD B_TRUE 1 100 0.00 1.00000000000 BIT_MASK 0x800 FORMAT "%13.11" ECU_ADDRESS 0x382DB6 /end MEASUREMENT
/begin MEASUREMENT B_nphelsu2 "" UWORD B_TRUE 1 100 0.00 1.00000000000 BIT_MASK 0x800 FORMAT "%13.11" ECU_ADDRESS 0x382DB8 /end MEASUREMENT
/begin MEASUREMENT B_nphsh "" UWORD B_TRUE 1 100 0.00 1.00000000000 BIT_MASK 0x800 FORMAT "%13.11" ECU_ADDRESS 0x382DBC /end MEASUREMENT
/begin MEASUREMENT B_nphsh2 "" UWORD B_TRUE 1 100 0.00 1.00000000000 BIT_MASK 0x800 FORMAT "%13.11" ECU_ADDRESS 0x382DBE /end MEASUREMENT
/begin MEASUREMENT B_nphshe "" UWORD B_TRUE 1 100 0.00 1.00000000000 BIT_MASK 0x800 FORMAT "%13.11" ECU_ADDRESS 0x382DC0 /end MEASUREMENT
/begin MEASUREMENT B_nphshe2 "" UWORD B_TRUE 1 100 0.00 1.00000000000 BIT_MASK 0x800 FORMAT "%13.11" ECU_ADDRESS 0x382DC2 /end MEASUREMENT
/begin MEASUREMENT B_nphsv "" UWORD B_TRUE 1 100 0.00 1.00000000000 BIT_MASK 0x800 FORMAT "%13.11" ECU_ADDRESS 0x382DC4 /end MEASUREMENT
/begin MEASUREMENT B_nphsv2 "" UWORD B_TRUE 1 100 0.00 1.00000000000 BIT_MASK 0x800 FORMAT "%13.11" ECU_ADDRESS 0x382DC6 /end MEASUREMENT
/begin MEASUREMENT B_nphsve "" UWORD B_TRUE 1 100 0.00 1.00000000000 BIT_MASK 0x800 FORMAT "%13.11" ECU_ADDRESS 0x382DC8 /end MEASUREMENT
/begin MEASUREMENT B_nphsve2 "" UWORD B_TRUE 1 100 0.00 1.00000000000 BIT_MASK 0x800 FORMAT "%13.11" ECU_ADDRESS 0x382DCA /end MEASUREMENT
/begin MEASUREMENT B_npiclsu "" UWORD B_TRUE 1 100 0.00 1.00000000000 BIT_MASK 0x800 FORMAT "%13.11" ECU_ADDRESS 0x382DCC /end MEASUREMENT
/begin MEASUREMENT B_npiclsu2 "" UWORD B_TRUE 1 100 0.00 1.00000000000 BIT_MASK 0x800 FORMAT "%13.11" ECU_ADDRESS 0x382DCE /end MEASUREMENT
/begin MEASUREMENT B_npkpe "" UWORD B_TRUE 1 100 0.00 1.00000000000 BIT_MASK 0x800 FORMAT "%13.11" ECU_ADDRESS 0x382DD4 /end MEASUREMENT
/begin MEASUREMENT B_npldpe "" UWORD B_TRUE 1 100 0.00 1.00000000000 BIT_MASK 0x800 FORMAT "%13.11" ECU_ADDRESS 0x382DFA /end MEASUREMENT
/begin MEASUREMENT B_nplsuia "" UWORD B_TRUE 1 100 0.00 1.00000000000 BIT_MASK 0x800 FORMAT "%13.11" ECU_ADDRESS 0x382E06 /end MEASUREMENT
/begin MEASUREMENT B_nplsuia2 "" UWORD B_TRUE 1 100 0.00 1.00000000000 BIT_MASK 0x800 FORMAT "%13.11" ECU_ADDRESS 0x382E08 /end MEASUREMENT
/begin MEASUREMENT B_nplsuip "" UWORD B_TRUE 1 100 0.00 1.00000000000 BIT_MASK 0x800 FORMAT "%13.11" ECU_ADDRESS 0x382E0A /end MEASUREMENT
/begin MEASUREMENT B_nplsuip2 "" UWORD B_TRUE 1 100 0.00 1.00000000000 BIT_MASK 0x800 FORMAT "%13.11" ECU_ADDRESS 0x382E0C /end MEASUREMENT
/begin MEASUREMENT B_nplsuks "" UWORD B_TRUE 1 100 0.00 1.00000000000 BIT_MASK 0x800 FORMAT "%13.11" ECU_ADDRESS 0x382E0E /end MEASUREMENT
/begin MEASUREMENT B_nplsuks2 "" UWORD B_TRUE 1 100 0.00 1.00000000000 BIT_MASK 0x800 FORMAT "%13.11" ECU_ADDRESS 0x382E10 /end MEASUREMENT
/begin MEASUREMENT B_nplsuun "" UWORD B_TRUE 1 100 0.00 1.00000000000 BIT_MASK 0x800 FORMAT "%13.11" ECU_ADDRESS 0x382E12 /end MEASUREMENT
/begin MEASUREMENT B_nplsuun2 "" UWORD B_TRUE 1 100 0.00 1.00000000000 BIT_MASK 0x800 FORMAT "%13.11" ECU_ADDRESS 0x382E14 /end MEASUREMENT
/begin MEASUREMENT B_nplsuvm "" UWORD B_TRUE 1 100 0.00 1.00000000000 BIT_MASK 0x800 FORMAT "%13.11" ECU_ADDRESS 0x382E16 /end MEASUREMENT
/begin MEASUREMENT B_nplsuvm2 "" UWORD B_TRUE 1 100 0.00 1.00000000000 BIT_MASK 0x800 FORMAT "%13.11" ECU_ADDRESS 0x382E18 /end MEASUREMENT
/begin MEASUREMENT B_nplues1e "" UWORD B_TRUE 1 100 0.00 1.00000000000 BIT_MASK 0x800 FORMAT "%13.11" ECU_ADDRESS 0x382E22 /end MEASUREMENT
/begin MEASUREMENT B_npn "" UWORD B_TRUE 1 100 0.00 1.00000000000 BIT_MASK 0x800 FORMAT "%13.11" ECU_ADDRESS 0x382E38 /end MEASUREMENT
/begin MEASUREMENT B_npslpe "" UWORD B_TRUE 1 100 0.00 1.00000000000 BIT_MASK 0x800 FORMAT "%13.11" ECU_ADDRESS 0x382E58 /end MEASUREMENT
/begin MEASUREMENT B_npslve "" UWORD B_TRUE 1 100 0.00 1.00000000000 BIT_MASK 0x800 FORMAT "%13.11" ECU_ADDRESS 0x382E62 /end MEASUREMENT
/begin MEASUREMENT B_npsue "" UWORD B_TRUE 1 100 0.00 1.00000000000 BIT_MASK 0x800 FORMAT "%13.11" ECU_ADDRESS 0x382E64 /end MEASUREMENT
/begin MEASUREMENT B_npteve "" UWORD B_TRUE 1 100 0.00 1.00000000000 BIT_MASK 0x800 FORMAT "%13.11" ECU_ADDRESS 0x382E72 /end MEASUREMENT
/begin MEASUREMENT B_npzet1 "" UWORD B_TRUE 1 100 0.00 1.00000000000 BIT_MASK 0x800 FORMAT "%13.11" ECU_ADDRESS 0x382EA2 /end MEASUREMENT
/begin MEASUREMENT B_npzet2 "" UWORD B_TRUE 1 100 0.00 1.00000000000 BIT_MASK 0x800 FORMAT "%13.11" ECU_ADDRESS 0x382EA4 /end MEASUREMENT
/begin MEASUREMENT B_npzet3 "" UWORD B_TRUE 1 100 0.00 1.00000000000 BIT_MASK 0x800 FORMAT "%13.11" ECU_ADDRESS 0x382EA6 /end MEASUREMENT
/begin MEASUREMENT B_npzet4 "" UWORD B_TRUE 1 100 0.00 1.00000000000 BIT_MASK 0x800 FORMAT "%13.11" ECU_ADDRESS 0x382EA8 /end MEASUREMENT
/begin MEASUREMENT B_npzet5 "" UWORD B_TRUE 1 100 0.00 1.00000000000 BIT_MASK 0x800 FORMAT "%13.11" ECU_ADDRESS 0x382EAA /end MEASUREMENT
/begin MEASUREMENT B_npzet6 "" UWORD B_TRUE 1 100 0.00 1.00000000000 BIT_MASK 0x800 FORMAT "%13.11" ECU_ADDRESS 0x382EAC /end MEASUREMENT
/begin MEASUREMENT B_npzwpe "" UWORD B_TRUE 1 100 0.00 1.00000000000 BIT_MASK 0x800 FORMAT "%13.11" ECU_ADDRESS 0x382EAE /end MEASUREMENT
/begin MEASUREMENT B_pycif "" UWORD B_TRUE 1 100 0.00 1.00000000000 BIT_MASK 0x2000 FORMAT "%13.11" ECU_ADDRESS 0x382D58 /end MEASUREMENT
/begin MEASUREMENT B_pycins "" UWORD B_TRUE 1 100 0.00 1.00000000000 BIT_MASK 0x2000 FORMAT "%13.11" ECU_ADDRESS 0x382D5A /end MEASUREMENT
/begin MEASUREMENT B_pyckla "" UWORD B_TRUE 1 100 0.00 1.00000000000 BIT_MASK 0x2000 FORMAT "%13.11" ECU_ADDRESS 0x382D5C /end MEASUREMENT
/begin MEASUREMENT B_pyclws "" UWORD B_TRUE 1 100 0.00 1.00000000000 BIT_MASK 0x2000 FORMAT "%13.11" ECU_ADDRESS 0x382D5E /end MEASUREMENT
/begin MEASUREMENT B_pyctog "" UWORD B_TRUE 1 100 0.00 1.00000000000 BIT_MASK 0x2000 FORMAT "%13.11" ECU_ADDRESS 0x382D60 /end MEASUREMENT
/begin MEASUREMENT B_pyczas "" UWORD B_TRUE 1 100 0.00 1.00000000000 BIT_MASK 0x2000 FORMAT "%13.11" ECU_ADDRESS 0x382D62 /end MEASUREMENT
/begin MEASUREMENT B_sccif "" UWORD B_TRUE 1 100 0.00 1.00000000000 BIT_MASK 0x4000 FORMAT "%13.11" ECU_ADDRESS 0x382D58 /end MEASUREMENT
/begin MEASUREMENT B_sccins "" UWORD B_TRUE 1 100 0.00 1.00000000000 BIT_MASK 0x4000 FORMAT "%13.11" ECU_ADDRESS 0x382D5A /end MEASUREMENT
/begin MEASUREMENT B_scckla "" UWORD B_TRUE 1 100 0.00 1.00000000000 BIT_MASK 0x4000 FORMAT "%13.11" ECU_ADDRESS 0x382D5C /end MEASUREMENT
/begin MEASUREMENT B_scclws "" UWORD B_TRUE 1 100 0.00 1.00000000000 BIT_MASK 0x4000 FORMAT "%13.11" ECU_ADDRESS 0x382D5E /end MEASUREMENT
/begin MEASUREMENT B_scctog "" UWORD B_TRUE 1 100 0.00 1.00000000000 BIT_MASK 0x4000 FORMAT "%13.11" ECU_ADDRESS 0x382D60 /end MEASUREMENT
/begin MEASUREMENT B_scczas "" UWORD B_TRUE 1 100 0.00 1.00000000000 BIT_MASK 0x4000 FORMAT "%13.11" ECU_ADDRESS 0x382D62 /end MEASUREMENT
/begin MEASUREMENT B_siakre "" UWORD B_TRUE 1 100 0.00 1.00000000000 BIT_MASK 0x400 FORMAT "%13.11" ECU_ADDRESS 0x382D34 /end MEASUREMENT
/begin MEASUREMENT B_sianws "" UWORD B_TRUE 1 100 0.00 1.00000000000 BIT_MASK 0x400 FORMAT "%13.11" ECU_ADDRESS 0x382D36 /end MEASUREMENT
/begin MEASUREMENT B_sianwse "" UWORD B_TRUE 1 100 0.00 1.00000000000 BIT_MASK 0x400 FORMAT "%13.11" ECU_ADDRESS 0x382D38 /end MEASUREMENT
/begin MEASUREMENT B_sibkvp "" UWORD B_TRUE 1 100 0.00 1.00000000000 BIT_MASK 0x400 FORMAT "%13.11" ECU_ADDRESS 0x382D3C /end MEASUREMENT
/begin MEASUREMENT B_sibkvpe "" UWORD B_TRUE 1 100 0.00 1.00000000000 BIT_MASK 0x400 FORMAT "%13.11" ECU_ADDRESS 0x382D3E /end MEASUREMENT
/begin MEASUREMENT B_sibm "" UWORD B_TRUE 1 100 0.00 1.00000000000 BIT_MASK 0x400 FORMAT "%13.11" ECU_ADDRESS 0x382D40 /end MEASUREMENT
/begin MEASUREMENT B_sicif "" UWORD B_TRUE 1 100 0.00 1.00000000000 BIT_MASK 0x400 FORMAT "%13.11" ECU_ADDRESS 0x382D58 /end MEASUREMENT
/begin MEASUREMENT B_sicins "" UWORD B_TRUE 1 100 0.00 1.00000000000 BIT_MASK 0x400 FORMAT "%13.11" ECU_ADDRESS 0x382D5A /end MEASUREMENT
/begin MEASUREMENT B_sickla "" UWORD B_TRUE 1 100 0.00 1.00000000000 BIT_MASK 0x400 FORMAT "%13.11" ECU_ADDRESS 0x382D5C /end MEASUREMENT
/begin MEASUREMENT B_siclws "" UWORD B_TRUE 1 100 0.00 1.00000000000 BIT_MASK 0x400 FORMAT "%13.11" ECU_ADDRESS 0x382D5E /end MEASUREMENT
/begin MEASUREMENT B_sictog "" UWORD B_TRUE 1 100 0.00 1.00000000000 BIT_MASK 0x400 FORMAT "%13.11" ECU_ADDRESS 0x382D60 /end MEASUREMENT
/begin MEASUREMENT B_siczas "" UWORD B_TRUE 1 100 0.00 1.00000000000 BIT_MASK 0x400 FORMAT "%13.11" ECU_ADDRESS 0x382D62 /end MEASUREMENT
/begin MEASUREMENT B_sidk "" UWORD B_TRUE 1 100 0.00 1.00000000000 BIT_MASK 0x400 FORMAT "%13.11" ECU_ADDRESS 0x382D64 /end MEASUREMENT
/begin MEASUREMENT B_sidk1p "" UWORD B_TRUE 1 100 0.00 1.00000000000 BIT_MASK 0x400 FORMAT "%13.11" ECU_ADDRESS 0x382D66 /end MEASUREMENT
/begin MEASUREMENT B_sidk2p "" UWORD B_TRUE 1 100 0.00 1.00000000000 BIT_MASK 0x400 FORMAT "%13.11" ECU_ADDRESS 0x382D68 /end MEASUREMENT
/begin MEASUREMENT B_sidvee "" UWORD B_TRUE 1 100 0.00 1.00000000000 BIT_MASK 0x400 FORMAT "%13.11" ECU_ADDRESS 0x382D70 /end MEASUREMENT
/begin MEASUREMENT B_sidvef "" UWORD B_TRUE 1 100 0.00 1.00000000000 BIT_MASK 0x400 FORMAT "%13.11" ECU_ADDRESS 0x382D72 /end MEASUREMENT
/begin MEASUREMENT B_sidvefo "" UWORD B_TRUE 1 100 0.00 1.00000000000 BIT_MASK 0x400 FORMAT "%13.11" ECU_ADDRESS 0x382D74 /end MEASUREMENT
/begin MEASUREMENT B_sidvel "" UWORD B_TRUE 1 100 0.00 1.00000000000 BIT_MASK 0x400 FORMAT "%13.11" ECU_ADDRESS 0x382D76 /end MEASUREMENT
/begin MEASUREMENT B_sidven "" UWORD B_TRUE 1 100 0.00 1.00000000000 BIT_MASK 0x400 FORMAT "%13.11" ECU_ADDRESS 0x382D78 /end MEASUREMENT
/begin MEASUREMENT B_sidver "" UWORD B_TRUE 1 100 0.00 1.00000000000 BIT_MASK 0x400 FORMAT "%13.11" ECU_ADDRESS 0x382D7A /end MEASUREMENT
/begin MEASUREMENT B_sidvet "" UWORD B_TRUE 1 100 0.00 1.00000000000 BIT_MASK 0x400 FORMAT "%13.11" ECU_ADDRESS 0x382D7C /end MEASUREMENT
/begin MEASUREMENT B_sidveu "" UWORD B_TRUE 1 100 0.00 1.00000000000 BIT_MASK 0x400 FORMAT "%13.11" ECU_ADDRESS 0x382D7E /end MEASUREMENT
/begin MEASUREMENT B_sidveub "" UWORD B_TRUE 1 100 0.00 1.00000000000 BIT_MASK 0x400 FORMAT "%13.11" ECU_ADDRESS 0x382D80 /end MEASUREMENT
/begin MEASUREMENT B_sidveuw "" UWORD B_TRUE 1 100 0.00 1.00000000000 BIT_MASK 0x400 FORMAT "%13.11" ECU_ADDRESS 0x382D82 /end MEASUREMENT
/begin MEASUREMENT B_sidvev "" UWORD B_TRUE 1 100 0.00 1.00000000000 BIT_MASK 0x400 FORMAT "%13.11" ECU_ADDRESS 0x382D84 /end MEASUREMENT
/begin MEASUREMENT B_sidylsu "" UWORD B_TRUE 1 100 0.00 1.00000000000 BIT_MASK 0x400 FORMAT "%13.11" ECU_ADDRESS 0x382D86 /end MEASUREMENT
/begin MEASUREMENT B_sidylsu2 "" UWORD B_TRUE 1 100 0.00 1.00000000000 BIT_MASK 0x400 FORMAT "%13.11" ECU_ADDRESS 0x382D88 /end MEASUREMENT
/begin MEASUREMENT B_sienws "" UWORD B_TRUE 1 100 0.00 1.00000000000 BIT_MASK 0x400 FORMAT "%13.11" ECU_ADDRESS 0x382D8E /end MEASUREMENT
/begin MEASUREMENT B_sienwse "" UWORD B_TRUE 1 100 0.00 1.00000000000 BIT_MASK 0x400 FORMAT "%13.11" ECU_ADDRESS 0x382D90 /end MEASUREMENT
/begin MEASUREMENT B_siepcle "" UWORD B_TRUE 1 100 0.00 1.00000000000 BIT_MASK 0x400 FORMAT "%13.11" ECU_ADDRESS 0x382D92 /end MEASUREMENT
/begin MEASUREMENT B_siev1 "" UWORD B_TRUE 1 100 0.00 1.00000000000 BIT_MASK 0x400 FORMAT "%13.11" ECU_ADDRESS 0x382D94 /end MEASUREMENT
/begin MEASUREMENT B_siev2 "" UWORD B_TRUE 1 100 0.00 1.00000000000 BIT_MASK 0x400 FORMAT "%13.11" ECU_ADDRESS 0x382D96 /end MEASUREMENT
/begin MEASUREMENT B_siev3 "" UWORD B_TRUE 1 100 0.00 1.00000000000 BIT_MASK 0x400 FORMAT "%13.11" ECU_ADDRESS 0x382D98 /end MEASUREMENT
/begin MEASUREMENT B_siev4 "" UWORD B_TRUE 1 100 0.00 1.00000000000 BIT_MASK 0x400 FORMAT "%13.11" ECU_ADDRESS 0x382D9A /end MEASUREMENT
/begin MEASUREMENT B_siev5 "" UWORD B_TRUE 1 100 0.00 1.00000000000 BIT_MASK 0x400 FORMAT "%13.11" ECU_ADDRESS 0x382D9C /end MEASUREMENT
/begin MEASUREMENT B_siev6 "" UWORD B_TRUE 1 100 0.00 1.00000000000 BIT_MASK 0x400 FORMAT "%13.11" ECU_ADDRESS 0x382D9E /end MEASUREMENT
/begin MEASUREMENT B_sihelsu "" UWORD B_TRUE 1 100 0.00 1.00000000000 BIT_MASK 0x400 FORMAT "%13.11" ECU_ADDRESS 0x382DB6 /end MEASUREMENT
/begin MEASUREMENT B_sihelsu2 "" UWORD B_TRUE 1 100 0.00 1.00000000000 BIT_MASK 0x400 FORMAT "%13.11" ECU_ADDRESS 0x382DB8 /end MEASUREMENT
/begin MEASUREMENT B_sihsh "" UWORD B_TRUE 1 100 0.00 1.00000000000 BIT_MASK 0x400 FORMAT "%13.11" ECU_ADDRESS 0x382DBC /end MEASUREMENT
/begin MEASUREMENT B_sihsh2 "" UWORD B_TRUE 1 100 0.00 1.00000000000 BIT_MASK 0x400 FORMAT "%13.11" ECU_ADDRESS 0x382DBE /end MEASUREMENT
/begin MEASUREMENT B_sihshe "" UWORD B_TRUE 1 100 0.00 1.00000000000 BIT_MASK 0x400 FORMAT "%13.11" ECU_ADDRESS 0x382DC0 /end MEASUREMENT
/begin MEASUREMENT B_sihshe2 "" UWORD B_TRUE 1 100 0.00 1.00000000000 BIT_MASK 0x400 FORMAT "%13.11" ECU_ADDRESS 0x382DC2 /end MEASUREMENT
/begin MEASUREMENT B_sihsv "" UWORD B_TRUE 1 100 0.00 1.00000000000 BIT_MASK 0x400 FORMAT "%13.11" ECU_ADDRESS 0x382DC4 /end MEASUREMENT
/begin MEASUREMENT B_sihsv2 "" UWORD B_TRUE 1 100 0.00 1.00000000000 BIT_MASK 0x400 FORMAT "%13.11" ECU_ADDRESS 0x382DC6 /end MEASUREMENT
/begin MEASUREMENT B_sihsve "" UWORD B_TRUE 1 100 0.00 1.00000000000 BIT_MASK 0x400 FORMAT "%13.11" ECU_ADDRESS 0x382DC8 /end MEASUREMENT
/begin MEASUREMENT B_sihsve2 "" UWORD B_TRUE 1 100 0.00 1.00000000000 BIT_MASK 0x400 FORMAT "%13.11" ECU_ADDRESS 0x382DCA /end MEASUREMENT
/begin MEASUREMENT B_siiclsu "" UWORD B_TRUE 1 100 0.00 1.00000000000 BIT_MASK 0x400 FORMAT "%13.11" ECU_ADDRESS 0x382DCC /end MEASUREMENT
/begin MEASUREMENT B_siiclsu2 "" UWORD B_TRUE 1 100 0.00 1.00000000000 BIT_MASK 0x400 FORMAT "%13.11" ECU_ADDRESS 0x382DCE /end MEASUREMENT
/begin MEASUREMENT B_sikpe "" UWORD B_TRUE 1 100 0.00 1.00000000000 BIT_MASK 0x400 FORMAT "%13.11" ECU_ADDRESS 0x382DD4 /end MEASUREMENT
/begin MEASUREMENT B_sildpe "" UWORD B_TRUE 1 100 0.00 1.00000000000 BIT_MASK 0x400 FORMAT "%13.11" ECU_ADDRESS 0x382DFA /end MEASUREMENT
/begin MEASUREMENT B_silsuia "" UWORD B_TRUE 1 100 0.00 1.00000000000 BIT_MASK 0x400 FORMAT "%13.11" ECU_ADDRESS 0x382E06 /end MEASUREMENT
/begin MEASUREMENT B_silsuia2 "" UWORD B_TRUE 1 100 0.00 1.00000000000 BIT_MASK 0x400 FORMAT "%13.11" ECU_ADDRESS 0x382E08 /end MEASUREMENT
/begin MEASUREMENT B_silsuip "" UWORD B_TRUE 1 100 0.00 1.00000000000 BIT_MASK 0x400 FORMAT "%13.11" ECU_ADDRESS 0x382E0A /end MEASUREMENT
/begin MEASUREMENT B_silsuip2 "" UWORD B_TRUE 1 100 0.00 1.00000000000 BIT_MASK 0x400 FORMAT "%13.11" ECU_ADDRESS 0x382E0C /end MEASUREMENT
/begin MEASUREMENT B_silsuks "" UWORD B_TRUE 1 100 0.00 1.00000000000 BIT_MASK 0x400 FORMAT "%13.11" ECU_ADDRESS 0x382E0E /end MEASUREMENT
/begin MEASUREMENT B_silsuks2 "" UWORD B_TRUE 1 100 0.00 1.00000000000 BIT_MASK 0x400 FORMAT "%13.11" ECU_ADDRESS 0x382E10 /end MEASUREMENT
/begin MEASUREMENT B_silsuun "" UWORD B_TRUE 1 100 0.00 1.00000000000 BIT_MASK 0x400 FORMAT "%13.11" ECU_ADDRESS 0x382E12 /end MEASUREMENT
/begin MEASUREMENT B_silsuun2 "" UWORD B_TRUE 1 100 0.00 1.00000000000 BIT_MASK 0x400 FORMAT "%13.11" ECU_ADDRESS 0x382E14 /end MEASUREMENT
/begin MEASUREMENT B_silsuvm "" UWORD B_TRUE 1 100 0.00 1.00000000000 BIT_MASK 0x400 FORMAT "%13.11" ECU_ADDRESS 0x382E16 /end MEASUREMENT
/begin MEASUREMENT B_silsuvm2 "" UWORD B_TRUE 1 100 0.00 1.00000000000 BIT_MASK 0x400 FORMAT "%13.11" ECU_ADDRESS 0x382E18 /end MEASUREMENT
/begin MEASUREMENT B_silues1e "" UWORD B_TRUE 1 100 0.00 1.00000000000 BIT_MASK 0x400 FORMAT "%13.11" ECU_ADDRESS 0x382E22 /end MEASUREMENT
/begin MEASUREMENT B_sin "" UWORD B_TRUE 1 100 0.00 1.00000000000 BIT_MASK 0x400 FORMAT "%13.11" ECU_ADDRESS 0x382E38 /end MEASUREMENT
/begin MEASUREMENT B_sislpe "" UWORD B_TRUE 1 100 0.00 1.00000000000 BIT_MASK 0x400 FORMAT "%13.11" ECU_ADDRESS 0x382E58 /end MEASUREMENT
/begin MEASUREMENT B_sislve "" UWORD B_TRUE 1 100 0.00 1.00000000000 BIT_MASK 0x400 FORMAT "%13.11" ECU_ADDRESS 0x382E62 /end MEASUREMENT
/begin MEASUREMENT B_sisue "" UWORD B_TRUE 1 100 0.00 1.00000000000 BIT_MASK 0x400 FORMAT "%13.11" ECU_ADDRESS 0x382E64 /end MEASUREMENT
/begin MEASUREMENT B_siteve "" UWORD B_TRUE 1 100 0.00 1.00000000000 BIT_MASK 0x400 FORMAT "%13.11" ECU_ADDRESS 0x382E72 /end MEASUREMENT
/begin MEASUREMENT B_sizet1 "" UWORD B_TRUE 1 100 0.00 1.00000000000 BIT_MASK 0x400 FORMAT "%13.11" ECU_ADDRESS 0x382EA2 /end MEASUREMENT
/begin MEASUREMENT B_sizet2 "" UWORD B_TRUE 1 100 0.00 1.00000000000 BIT_MASK 0x400 FORMAT "%13.11" ECU_ADDRESS 0x382EA4 /end MEASUREMENT
/begin MEASUREMENT B_sizet3 "" UWORD B_TRUE 1 100 0.00 1.00000000000 BIT_MASK 0x400 FORMAT "%13.11" ECU_ADDRESS 0x382EA6 /end MEASUREMENT
/begin MEASUREMENT B_sizet4 "" UWORD B_TRUE 1 100 0.00 1.00000000000 BIT_MASK 0x400 FORMAT "%13.11" ECU_ADDRESS 0x382EA8 /end MEASUREMENT
/begin MEASUREMENT B_sizet5 "" UWORD B_TRUE 1 100 0.00 1.00000000000 BIT_MASK 0x400 FORMAT "%13.11" ECU_ADDRESS 0x382EAA /end MEASUREMENT
/begin MEASUREMENT B_sizet6 "" UWORD B_TRUE 1 100 0.00 1.00000000000 BIT_MASK 0x400 FORMAT "%13.11" ECU_ADDRESS 0x382EAC /end MEASUREMENT
/begin MEASUREMENT B_sizwpe "" UWORD B_TRUE 1 100 0.00 1.00000000000 BIT_MASK 0x400 FORMAT "%13.11" ECU_ADDRESS 0x382EAE /end MEASUREMENT
/begin MEASUREMENT E_aaa "" UWORD B_TRUE 1 100 0.00 1.00000000000 BIT_MASK 0x1 FORMAT "%13.11" ECU_ADDRESS 0x382D30 /end MEASUREMENT
/begin MEASUREMENT E_akre "" UWORD B_TRUE 1 100 0.00 1.00000000000 BIT_MASK 0x1 FORMAT "%13.11" ECU_ADDRESS 0x382D34 /end MEASUREMENT
/begin MEASUREMENT E_anws "" UWORD B_TRUE 1 100 0.00 1.00000000000 BIT_MASK 0x1 FORMAT "%13.11" ECU_ADDRESS 0x382D36 /end MEASUREMENT
/begin MEASUREMENT E_anwse "" UWORD B_TRUE 1 100 0.00 1.00000000000 BIT_MASK 0x1 FORMAT "%13.11" ECU_ADDRESS 0x382D38 /end MEASUREMENT
/begin MEASUREMENT E_bkvp "" UWORD B_TRUE 1 100 0.00 1.00000000000 BIT_MASK 0x1 FORMAT "%13.11" ECU_ADDRESS 0x382D3C /end MEASUREMENT
/begin MEASUREMENT E_bkvpe "" UWORD B_TRUE 1 100 0.00 1.00000000000 BIT_MASK 0x1 FORMAT "%13.11" ECU_ADDRESS 0x382D3E /end MEASUREMENT
/begin MEASUREMENT E_bm "" UWORD B_TRUE 1 100 0.00 1.00000000000 BIT_MASK 0x1 FORMAT "%13.11" ECU_ADDRESS 0x382D40 /end MEASUREMENT
/begin MEASUREMENT E_cif "" UWORD B_TRUE 1 100 0.00 1.00000000000 BIT_MASK 0x1 FORMAT "%13.11" ECU_ADDRESS 0x382D58 /end MEASUREMENT
/begin MEASUREMENT E_cins "" UWORD B_TRUE 1 100 0.00 1.00000000000 BIT_MASK 0x1 FORMAT "%13.11" ECU_ADDRESS 0x382D5A /end MEASUREMENT
/begin MEASUREMENT E_ckla "" UWORD B_TRUE 1 100 0.00 1.00000000000 BIT_MASK 0x1 FORMAT "%13.11" ECU_ADDRESS 0x382D5C /end MEASUREMENT
/begin MEASUREMENT E_clws "" UWORD B_TRUE 1 100 0.00 1.00000000000 BIT_MASK 0x1 FORMAT "%13.11" ECU_ADDRESS 0x382D5E /end MEASUREMENT
/begin MEASUREMENT E_ctog "" UWORD B_TRUE 1 100 0.00 1.00000000000 BIT_MASK 0x1 FORMAT "%13.11" ECU_ADDRESS 0x382D60 /end MEASUREMENT
/begin MEASUREMENT E_czas "" UWORD B_TRUE 1 100 0.00 1.00000000000 BIT_MASK 0x1 FORMAT "%13.11" ECU_ADDRESS 0x382D62 /end MEASUREMENT
/begin MEASUREMENT E_dk "" UWORD B_TRUE 1 100 0.00 1.00000000000 BIT_MASK 0x1 FORMAT "%13.11" ECU_ADDRESS 0x382D64 /end MEASUREMENT
/begin MEASUREMENT E_dk1p "" UWORD B_TRUE 1 100 0.00 1.00000000000 BIT_MASK 0x1 FORMAT "%13.11" ECU_ADDRESS 0x382D66 /end MEASUREMENT
/begin MEASUREMENT E_dk2p "" UWORD B_TRUE 1 100 0.00 1.00000000000 BIT_MASK 0x1 FORMAT "%13.11" ECU_ADDRESS 0x382D68 /end MEASUREMENT
/begin MEASUREMENT E_dvee "" UWORD B_TRUE 1 100 0.00 1.00000000000 BIT_MASK 0x1 FORMAT "%13.11" ECU_ADDRESS 0x382D70 /end MEASUREMENT
/begin MEASUREMENT E_dvef "" UWORD B_TRUE 1 100 0.00 1.00000000000 BIT_MASK 0x1 FORMAT "%13.11" ECU_ADDRESS 0x382D72 /end MEASUREMENT
/begin MEASUREMENT E_dvefo "" UWORD B_TRUE 1 100 0.00 1.00000000000 BIT_MASK 0x1 FORMAT "%13.11" ECU_ADDRESS 0x382D74 /end MEASUREMENT
/begin MEASUREMENT E_dvel "" UWORD B_TRUE 1 100 0.00 1.00000000000 BIT_MASK 0x1 FORMAT "%13.11" ECU_ADDRESS 0x382D76 /end MEASUREMENT
/begin MEASUREMENT E_dven "" UWORD B_TRUE 1 100 0.00 1.00000000000 BIT_MASK 0x1 FORMAT "%13.11" ECU_ADDRESS 0x382D78 /end MEASUREMENT
/begin MEASUREMENT E_dver "" UWORD B_TRUE 1 100 0.00 1.00000000000 BIT_MASK 0x1 FORMAT "%13.11" ECU_ADDRESS 0x382D7A /end MEASUREMENT
/begin MEASUREMENT E_dvet "" UWORD B_TRUE 1 100 0.00 1.00000000000 BIT_MASK 0x1 FORMAT "%13.11" ECU_ADDRESS 0x382D7C /end MEASUREMENT
/begin MEASUREMENT E_dveu "" UWORD B_TRUE 1 100 0.00 1.00000000000 BIT_MASK 0x1 FORMAT "%13.11" ECU_ADDRESS 0x382D7E /end MEASUREMENT
/begin MEASUREMENT E_dveub "" UWORD B_TRUE 1 100 0.00 1.00000000000 BIT_MASK 0x1 FORMAT "%13.11" ECU_ADDRESS 0x382D80 /end MEASUREMENT
/begin MEASUREMENT E_dveuw "" UWORD B_TRUE 1 100 0.00 1.00000000000 BIT_MASK 0x1 FORMAT "%13.11" ECU_ADDRESS 0x382D82 /end MEASUREMENT
/begin MEASUREMENT E_dvev "" UWORD B_TRUE 1 100 0.00 1.00000000000 BIT_MASK 0x1 FORMAT "%13.11" ECU_ADDRESS 0x382D84 /end MEASUREMENT
/begin MEASUREMENT E_dylsu "" UWORD B_TRUE 1 100 0.00 1.00000000000 BIT_MASK 0x1 FORMAT "%13.11" ECU_ADDRESS 0x382D86 /end MEASUREMENT
/begin MEASUREMENT E_dylsu2 "" UWORD B_TRUE 1 100 0.00 1.00000000000 BIT_MASK 0x1 FORMAT "%13.11" ECU_ADDRESS 0x382D88 /end MEASUREMENT
/begin MEASUREMENT E_egfe "" UWORD B_TRUE 1 100 0.00 1.00000000000 BIT_MASK 0x1 FORMAT "%13.11" ECU_ADDRESS 0x382D8A /end MEASUREMENT
/begin MEASUREMENT E_enws "" UWORD B_TRUE 1 100 0.00 1.00000000000 BIT_MASK 0x1 FORMAT "%13.11" ECU_ADDRESS 0x382D8E /end MEASUREMENT
/begin MEASUREMENT E_enwse "" UWORD B_TRUE 1 100 0.00 1.00000000000 BIT_MASK 0x1 FORMAT "%13.11" ECU_ADDRESS 0x382D90 /end MEASUREMENT
/begin MEASUREMENT E_epcle "" UWORD B_TRUE 1 100 0.00 1.00000000000 BIT_MASK 0x1 FORMAT "%13.11" ECU_ADDRESS 0x382D92 /end MEASUREMENT
/begin MEASUREMENT E_ev1 "" UWORD B_TRUE 1 100 0.00 1.00000000000 BIT_MASK 0x1 FORMAT "%13.11" ECU_ADDRESS 0x382D94 /end MEASUREMENT
/begin MEASUREMENT E_ev2 "" UWORD B_TRUE 1 100 0.00 1.00000000000 BIT_MASK 0x1 FORMAT "%13.11" ECU_ADDRESS 0x382D96 /end MEASUREMENT
/begin MEASUREMENT E_ev3 "" UWORD B_TRUE 1 100 0.00 1.00000000000 BIT_MASK 0x1 FORMAT "%13.11" ECU_ADDRESS 0x382D98 /end MEASUREMENT
/begin MEASUREMENT E_ev4 "" UWORD B_TRUE 1 100 0.00 1.00000000000 BIT_MASK 0x1 FORMAT "%13.11" ECU_ADDRESS 0x382D9A /end MEASUREMENT
/begin MEASUREMENT E_ev5 "" UWORD B_TRUE 1 100 0.00 1.00000000000 BIT_MASK 0x1 FORMAT "%13.11" ECU_ADDRESS 0x382D9C /end MEASUREMENT
/begin MEASUREMENT E_ev6 "" UWORD B_TRUE 1 100 0.00 1.00000000000 BIT_MASK 0x1 FORMAT "%13.11" ECU_ADDRESS 0x382D9E /end MEASUREMENT
/begin MEASUREMENT E_helsu "" UWORD B_TRUE 1 100 0.00 1.00000000000 BIT_MASK 0x1 FORMAT "%13.11" ECU_ADDRESS 0x382DB6 /end MEASUREMENT
/begin MEASUREMENT E_helsu2 "" UWORD B_TRUE 1 100 0.00 1.00000000000 BIT_MASK 0x1 FORMAT "%13.11" ECU_ADDRESS 0x382DB8 /end MEASUREMENT
/begin MEASUREMENT E_hsh "" UWORD B_TRUE 1 100 0.00 1.00000000000 BIT_MASK 0x1 FORMAT "%13.11" ECU_ADDRESS 0x382DBC /end MEASUREMENT
/begin MEASUREMENT E_hsh2 "" UWORD B_TRUE 1 100 0.00 1.00000000000 BIT_MASK 0x1 FORMAT "%13.11" ECU_ADDRESS 0x382DBE /end MEASUREMENT
/begin MEASUREMENT E_hshe "" UWORD B_TRUE 1 100 0.00 1.00000000000 BIT_MASK 0x1 FORMAT "%13.11" ECU_ADDRESS 0x382DC0 /end MEASUREMENT
/begin MEASUREMENT E_hshe2 "" UWORD B_TRUE 1 100 0.00 1.00000000000 BIT_MASK 0x1 FORMAT "%13.11" ECU_ADDRESS 0x382DC2 /end MEASUREMENT
/begin MEASUREMENT E_hsv "" UWORD B_TRUE 1 100 0.00 1.00000000000 BIT_MASK 0x1 FORMAT "%13.11" ECU_ADDRESS 0x382DC4 /end MEASUREMENT
/begin MEASUREMENT E_hsv2 "" UWORD B_TRUE 1 100 0.00 1.00000000000 BIT_MASK 0x1 FORMAT "%13.11" ECU_ADDRESS 0x382DC6 /end MEASUREMENT
/begin MEASUREMENT E_hsve "" UWORD B_TRUE 1 100 0.00 1.00000000000 BIT_MASK 0x1 FORMAT "%13.11" ECU_ADDRESS 0x382DC8 /end MEASUREMENT
/begin MEASUREMENT E_hsve2 "" UWORD B_TRUE 1 100 0.00 1.00000000000 BIT_MASK 0x1 FORMAT "%13.11" ECU_ADDRESS 0x382DCA /end MEASUREMENT
/begin MEASUREMENT E_iclsu "" UWORD B_TRUE 1 100 0.00 1.00000000000 BIT_MASK 0x1 FORMAT "%13.11" ECU_ADDRESS 0x382DCC /end MEASUREMENT
/begin MEASUREMENT E_iclsu2 "" UWORD B_TRUE 1 100 0.00 1.00000000000 BIT_MASK 0x1 FORMAT "%13.11" ECU_ADDRESS 0x382DCE /end MEASUREMENT
/begin MEASUREMENT E_kpe "" UWORD B_TRUE 1 100 0.00 1.00000000000 BIT_MASK 0x1 FORMAT "%13.11" ECU_ADDRESS 0x382DD4 /end MEASUREMENT
/begin MEASUREMENT E_ldpe "" UWORD B_TRUE 1 100 0.00 1.00000000000 BIT_MASK 0x1 FORMAT "%13.11" ECU_ADDRESS 0x382DFA /end MEASUREMENT
/begin MEASUREMENT E_lsuia "" UWORD B_TRUE 1 100 0.00 1.00000000000 BIT_MASK 0x1 FORMAT "%13.11" ECU_ADDRESS 0x382E06 /end MEASUREMENT
/begin MEASUREMENT E_lsuia2 "" UWORD B_TRUE 1 100 0.00 1.00000000000 BIT_MASK 0x1 FORMAT "%13.11" ECU_ADDRESS 0x382E08 /end MEASUREMENT
/begin MEASUREMENT E_lsuip "" UWORD B_TRUE 1 100 0.00 1.00000000000 BIT_MASK 0x1 FORMAT "%13.11" ECU_ADDRESS 0x382E0A /end MEASUREMENT
/begin MEASUREMENT E_lsuip2 "" UWORD B_TRUE 1 100 0.00 1.00000000000 BIT_MASK 0x1 FORMAT "%13.11" ECU_ADDRESS 0x382E0C /end MEASUREMENT
/begin MEASUREMENT E_lsuks "" UWORD B_TRUE 1 100 0.00 1.00000000000 BIT_MASK 0x1 FORMAT "%13.11" ECU_ADDRESS 0x382E0E /end MEASUREMENT
/begin MEASUREMENT E_lsuks2 "" UWORD B_TRUE 1 100 0.00 1.00000000000 BIT_MASK 0x1 FORMAT "%13.11" ECU_ADDRESS 0x382E10 /end MEASUREMENT
/begin MEASUREMENT E_lsuun "" UWORD B_TRUE 1 100 0.00 1.00000000000 BIT_MASK 0x1 FORMAT "%13.11" ECU_ADDRESS 0x382E12 /end MEASUREMENT
/begin MEASUREMENT E_lsuun2 "" UWORD B_TRUE 1 100 0.00 1.00000000000 BIT_MASK 0x1 FORMAT "%13.11" ECU_ADDRESS 0x382E14 /end MEASUREMENT
/begin MEASUREMENT E_lsuvm "" UWORD B_TRUE 1 100 0.00 1.00000000000 BIT_MASK 0x1 FORMAT "%13.11" ECU_ADDRESS 0x382E16 /end MEASUREMENT
/begin MEASUREMENT E_lsuvm2 "" UWORD B_TRUE 1 100 0.00 1.00000000000 BIT_MASK 0x1 FORMAT "%13.11" ECU_ADDRESS 0x382E18 /end MEASUREMENT
/begin MEASUREMENT E_lues1e "" UWORD B_TRUE 1 100 0.00 1.00000000000 BIT_MASK 0x1 FORMAT "%13.11" ECU_ADDRESS 0x382E22 /end MEASUREMENT
/begin MEASUREMENT E_n "" UWORD B_TRUE 1 100 0.00 1.00000000000 BIT_MASK 0x1 FORMAT "%13.11" ECU_ADDRESS 0x382E38 /end MEASUREMENT
/begin MEASUREMENT E_slpe "" UWORD B_TRUE 1 100 0.00 1.00000000000 BIT_MASK 0x1 FORMAT "%13.11" ECU_ADDRESS 0x382E58 /end MEASUREMENT
/begin MEASUREMENT E_slve "" UWORD B_TRUE 1 100 0.00 1.00000000000 BIT_MASK 0x1 FORMAT "%13.11" ECU_ADDRESS 0x382E62 /end MEASUREMENT
/begin MEASUREMENT E_sue "" UWORD B_TRUE 1 100 0.00 1.00000000000 BIT_MASK 0x1 FORMAT "%13.11" ECU_ADDRESS 0x382E64 /end MEASUREMENT
/begin MEASUREMENT E_teve "" UWORD B_TRUE 1 100 0.00 1.00000000000 BIT_MASK 0x1 FORMAT "%13.11" ECU_ADDRESS 0x382E72 /end MEASUREMENT
/begin MEASUREMENT E_zet1 "" UWORD B_TRUE 1 100 0.00 1.00000000000 BIT_MASK 0x1 FORMAT "%13.11" ECU_ADDRESS 0x382EA2 /end MEASUREMENT
/begin MEASUREMENT E_zet2 "" UWORD B_TRUE 1 100 0.00 1.00000000000 BIT_MASK 0x1 FORMAT "%13.11" ECU_ADDRESS 0x382EA4 /end MEASUREMENT
/begin MEASUREMENT E_zet3 "" UWORD B_TRUE 1 100 0.00 1.00000000000 BIT_MASK 0x1 FORMAT "%13.11" ECU_ADDRESS 0x382EA6 /end MEASUREMENT
/begin MEASUREMENT E_zet4 "" UWORD B_TRUE 1 100 0.00 1.00000000000 BIT_MASK 0x1 FORMAT "%13.11" ECU_ADDRESS 0x382EA8 /end MEASUREMENT
/begin MEASUREMENT E_zet5 "" UWORD B_TRUE 1 100 0.00 1.00000000000 BIT_MASK 0x1 FORMAT "%13.11" ECU_ADDRESS 0x382EAA /end MEASUREMENT
/begin MEASUREMENT E_zet6 "" UWORD B_TRUE 1 100 0.00 1.00000000000 BIT_MASK 0x1 FORMAT "%13.11" ECU_ADDRESS 0x382EAC /end MEASUREMENT
/begin MEASUREMENT E_zwpe "" UWORD B_TRUE 1 100 0.00 1.00000000000 BIT_MASK 0x1 FORMAT "%13.11" ECU_ADDRESS 0x382EAE /end MEASUREMENT
/begin MEASUREMENT sfpaaa "" UWORD dez 1 100 0.00 65535.00 FORMAT "%8.2" ECU_ADDRESS 0x382D30 /end MEASUREMENT
/begin MEASUREMENT sfpakre "" UWORD default 1 100 0.00 65535.00 FORMAT "%8.2" ECU_ADDRESS 0x382D34 /end MEASUREMENT
/begin MEASUREMENT sfpanws "" UWORD dez 1 100 0.00 65535.00 FORMAT "%8.2" ECU_ADDRESS 0x382D36 /end MEASUREMENT
/begin MEASUREMENT sfpanwse "" UWORD default 1 100 0.00 65535.00 FORMAT "%8.2" ECU_ADDRESS 0x382D38 /end MEASUREMENT
/begin MEASUREMENT sfpbkvp "" UWORD default 1 100 0.00 65535.00 FORMAT "%8.2" ECU_ADDRESS 0x382D3C /end MEASUREMENT
/begin MEASUREMENT sfpbkvpe "" UWORD default 1 100 0.00 65535.00 FORMAT "%8.2" ECU_ADDRESS 0x382D3E /end MEASUREMENT
/begin MEASUREMENT sfpbm "" UWORD dez 1 100 0.00 65535.00 FORMAT "%8.2" ECU_ADDRESS 0x382D40 /end MEASUREMENT
/begin MEASUREMENT sfpcif "" UWORD dez 1 100 0.00 65535.00 FORMAT "%8.2" ECU_ADDRESS 0x382D58 /end MEASUREMENT
/begin MEASUREMENT sfpcins "" UWORD dez 1 100 0.00 65535.00 FORMAT "%8.2" ECU_ADDRESS 0x382D5A /end MEASUREMENT
/begin MEASUREMENT sfpckla "" UWORD dez 1 100 0.00 65535.00 FORMAT "%8.2" ECU_ADDRESS 0x382D5C /end MEASUREMENT
/begin MEASUREMENT sfpclws "" UWORD dez 1 100 0.00 65535.00 FORMAT "%8.2" ECU_ADDRESS 0x382D5E /end MEASUREMENT
/begin MEASUREMENT sfpctog "" UWORD dez 1 100 0.00 65535.00 FORMAT "%8.2" ECU_ADDRESS 0x382D60 /end MEASUREMENT
/begin MEASUREMENT sfpczas "" UWORD dez 1 100 0.00 65535.00 FORMAT "%8.2" ECU_ADDRESS 0x382D62 /end MEASUREMENT
/begin MEASUREMENT sfpdk "" UWORD dez 1 100 0.00 65535.00 FORMAT "%8.2" ECU_ADDRESS 0x382D64 /end MEASUREMENT
/begin MEASUREMENT sfpdk1p "" UWORD dez 1 100 0.00 65535.00 FORMAT "%8.2" ECU_ADDRESS 0x382D66 /end MEASUREMENT
/begin MEASUREMENT sfpdk2p "" UWORD dez 1 100 0.00 65535.00 FORMAT "%8.2" ECU_ADDRESS 0x382D68 /end MEASUREMENT
/begin MEASUREMENT sfpdvee "" UWORD dez 1 100 0.00 65535.00 FORMAT "%8.2" ECU_ADDRESS 0x382D70 /end MEASUREMENT
/begin MEASUREMENT sfpdvef "" UWORD dez 1 100 0.00 65535.00 FORMAT "%8.2" ECU_ADDRESS 0x382D72 /end MEASUREMENT
/begin MEASUREMENT sfpdvefo "" UWORD dez 1 100 0.00 65535.00 FORMAT "%8.2" ECU_ADDRESS 0x382D74 /end MEASUREMENT
/begin MEASUREMENT sfpdvel "" UWORD dez 1 100 0.00 65535.00 FORMAT "%8.2" ECU_ADDRESS 0x382D76 /end MEASUREMENT
/begin MEASUREMENT sfpdven "" UWORD dez 1 100 0.00 65535.00 FORMAT "%8.2" ECU_ADDRESS 0x382D78 /end MEASUREMENT
/begin MEASUREMENT sfpdver "" UWORD dez 1 100 0.00 65535.00 FORMAT "%8.2" ECU_ADDRESS 0x382D7A /end MEASUREMENT
/begin MEASUREMENT sfpdvet "" UWORD dez 1 100 0.00 65535.00 FORMAT "%8.2" ECU_ADDRESS 0x382D7C /end MEASUREMENT
/begin MEASUREMENT sfpdveu "" UWORD dez 1 100 0.00 65535.00 FORMAT "%8.2" ECU_ADDRESS 0x382D7E /end MEASUREMENT
/begin MEASUREMENT sfpdveub "" UWORD dez 1 100 0.00 65535.00 FORMAT "%8.2" ECU_ADDRESS 0x382D80 /end MEASUREMENT
/begin MEASUREMENT sfpdveuw "" UWORD dez 1 100 0.00 65535.00 FORMAT "%8.2" ECU_ADDRESS 0x382D82 /end MEASUREMENT
/begin MEASUREMENT sfpdvev "" UWORD dez 1 100 0.00 65535.00 FORMAT "%8.2" ECU_ADDRESS 0x382D84 /end MEASUREMENT
/begin MEASUREMENT sfpdylsu "" UWORD default 1 100 0.00 65535.00 FORMAT "%8.2" ECU_ADDRESS 0x382D86 /end MEASUREMENT
/begin MEASUREMENT sfpdylsu2 "" UWORD default 1 100 0.00 65535.00 FORMAT "%8.2" ECU_ADDRESS 0x382D88 /end MEASUREMENT
/begin MEASUREMENT sfpegfe "" UWORD default 1 100 0.00 65535.00 FORMAT "%8.2" ECU_ADDRESS 0x382D8A /end MEASUREMENT
/begin MEASUREMENT sfpenws "" UWORD dez 1 100 0.00 65535.00 FORMAT "%8.2" ECU_ADDRESS 0x382D8E /end MEASUREMENT
/begin MEASUREMENT sfpenwse "" UWORD default 1 100 0.00 65535.00 FORMAT "%8.2" ECU_ADDRESS 0x382D90 /end MEASUREMENT
/begin MEASUREMENT sfpepcle "" UWORD default 1 100 0.00 65535.00 FORMAT "%8.2" ECU_ADDRESS 0x382D92 /end MEASUREMENT
/begin MEASUREMENT sfpev1 "" UWORD default 1 100 0.00 65535.00 FORMAT "%8.2" ECU_ADDRESS 0x382D94 /end MEASUREMENT
/begin MEASUREMENT sfpev2 "" UWORD default 1 100 0.00 65535.00 FORMAT "%8.2" ECU_ADDRESS 0x382D96 /end MEASUREMENT
/begin MEASUREMENT sfpev3 "" UWORD default 1 100 0.00 65535.00 FORMAT "%8.2" ECU_ADDRESS 0x382D98 /end MEASUREMENT
/begin MEASUREMENT sfpev4 "" UWORD default 1 100 0.00 65535.00 FORMAT "%8.2" ECU_ADDRESS 0x382D9A /end MEASUREMENT
/begin MEASUREMENT sfpev5 "" UWORD default 1 100 0.00 65535.00 FORMAT "%8.2" ECU_ADDRESS 0x382D9C /end MEASUREMENT
/begin MEASUREMENT sfpev6 "" UWORD default 1 100 0.00 65535.00 FORMAT "%8.2" ECU_ADDRESS 0x382D9E /end MEASUREMENT
/begin MEASUREMENT sfphelsu "" UWORD default 1 100 0.00 65535.00 FORMAT "%8.2" ECU_ADDRESS 0x382DB6 /end MEASUREMENT
/begin MEASUREMENT sfphelsu2 "" UWORD default 1 100 0.00 65535.00 FORMAT "%8.2" ECU_ADDRESS 0x382DB8 /end MEASUREMENT
/begin MEASUREMENT sfphsh "" UWORD dez 1 100 0.00 65535.00 FORMAT "%8.2" ECU_ADDRESS 0x382DBC /end MEASUREMENT
/begin MEASUREMENT sfphsh2 "" UWORD dez 1 100 0.00 65535.00 FORMAT "%8.2" ECU_ADDRESS 0x382DBE /end MEASUREMENT
/begin MEASUREMENT sfphshe "" UWORD default 1 100 0.00 65535.00 FORMAT "%8.2" ECU_ADDRESS 0x382DC0 /end MEASUREMENT
/begin MEASUREMENT sfphshe2 "" UWORD default 1 100 0.00 65535.00 FORMAT "%8.2" ECU_ADDRESS 0x382DC2 /end MEASUREMENT
/begin MEASUREMENT sfphsv "" UWORD default 1 100 0.00 65535.00 FORMAT "%8.2" ECU_ADDRESS 0x382DC4 /end MEASUREMENT
/begin MEASUREMENT sfphsv2 "" UWORD default 1 100 0.00 65535.00 FORMAT "%8.2" ECU_ADDRESS 0x382DC6 /end MEASUREMENT
/begin MEASUREMENT sfphsve "" UWORD default 1 100 0.00 65535.00 FORMAT "%8.2" ECU_ADDRESS 0x382DC8 /end MEASUREMENT
/begin MEASUREMENT sfphsve2 "" UWORD default 1 100 0.00 65535.00 FORMAT "%8.2" ECU_ADDRESS 0x382DCA /end MEASUREMENT
/begin MEASUREMENT sfpiclsu "" UWORD dez 1 100 0.00 65535.00 FORMAT "%8.2" ECU_ADDRESS 0x382DCC /end MEASUREMENT
/begin MEASUREMENT sfpiclsu2 "" UWORD dez 1 100 0.00 65535.00 FORMAT "%8.2" ECU_ADDRESS 0x382DCE /end MEASUREMENT
/begin MEASUREMENT sfpkpe "" UWORD default 1 100 0.00 65535.00 FORMAT "%8.2" ECU_ADDRESS 0x382DD4 /end MEASUREMENT
/begin MEASUREMENT sfpldpe "" UWORD default 1 100 0.00 65535.00 FORMAT "%8.2" ECU_ADDRESS 0x382DFA /end MEASUREMENT
/begin MEASUREMENT sfplsuia "" UWORD dez 1 100 0.00 65535.00 FORMAT "%8.2" ECU_ADDRESS 0x382E06 /end MEASUREMENT
/begin MEASUREMENT sfplsuia2 "" UWORD dez 1 100 0.00 65535.00 FORMAT "%8.2" ECU_ADDRESS 0x382E08 /end MEASUREMENT
/begin MEASUREMENT sfplsuip "" UWORD dez 1 100 0.00 65535.00 FORMAT "%8.2" ECU_ADDRESS 0x382E0A /end MEASUREMENT
/begin MEASUREMENT sfplsuip2 "" UWORD dez 1 100 0.00 65535.00 FORMAT "%8.2" ECU_ADDRESS 0x382E0C /end MEASUREMENT
/begin MEASUREMENT sfplsuks "" UWORD dez 1 100 0.00 65535.00 FORMAT "%8.2" ECU_ADDRESS 0x382E0E /end MEASUREMENT
/begin MEASUREMENT sfplsuks2 "" UWORD dez 1 100 0.00 65535.00 FORMAT "%8.2" ECU_ADDRESS 0x382E10 /end MEASUREMENT
/begin MEASUREMENT sfplsuun "" UWORD dez 1 100 0.00 65535.00 FORMAT "%8.2" ECU_ADDRESS 0x382E12 /end MEASUREMENT
/begin MEASUREMENT sfplsuun2 "" UWORD dez 1 100 0.00 65535.00 FORMAT "%8.2" ECU_ADDRESS 0x382E14 /end MEASUREMENT
/begin MEASUREMENT sfplsuvm "" UWORD dez 1 100 0.00 65535.00 FORMAT "%8.2" ECU_ADDRESS 0x382E16 /end MEASUREMENT
/begin MEASUREMENT sfplsuvm2 "" UWORD dez 1 100 0.00 65535.00 FORMAT "%8.2" ECU_ADDRESS 0x382E18 /end MEASUREMENT
/begin MEASUREMENT sfplues1e "" UWORD default 1 100 0.00 65535.00 FORMAT "%8.2" ECU_ADDRESS 0x382E22 /end MEASUREMENT
/begin MEASUREMENT sfpn "" UWORD dez 1 100 0.00 65535.00 FORMAT "%8.2" ECU_ADDRESS 0x382E38 /end MEASUREMENT
/begin MEASUREMENT sfpslpe "" UWORD default 1 100 0.00 65535.00 FORMAT "%8.2" ECU_ADDRESS 0x382E58 /end MEASUREMENT
/begin MEASUREMENT sfpslve "" UWORD default 1 100 0.00 65535.00 FORMAT "%8.2" ECU_ADDRESS 0x382E62 /end MEASUREMENT
/begin MEASUREMENT sfpsue "" UWORD default 1 100 0.00 65535.00 FORMAT "%8.2" ECU_ADDRESS 0x382E64 /end MEASUREMENT
/begin MEASUREMENT sfpteve "" UWORD default 1 100 0.00 65535.00 FORMAT "%8.2" ECU_ADDRESS 0x382E72 /end MEASUREMENT
/begin MEASUREMENT sfpzet1 "" UWORD default 1 100 0.00 65535.00 FORMAT "%8.2" ECU_ADDRESS 0x382EA2 /end MEASUREMENT
/begin MEASUREMENT sfpzet2 "" UWORD default 1 100 0.00 65535.00 FORMAT "%8.2" ECU_ADDRESS 0x382EA4 /end MEASUREMENT
/begin MEASUREMENT sfpzet3 "" UWORD default 1 100 0.00 65535.00 FORMAT "%8.2" ECU_ADDRESS 0x382EA6 /end MEASUREMENT
/begin MEASUREMENT sfpzet4 "" UWORD default 1 100 0.00 65535.00 FORMAT "%8.2" ECU_ADDRESS 0x382EA8 /end MEASUREMENT
/begin MEASUREMENT sfpzet5 "" UWORD default 1 100 0.00 65535.00 FORMAT "%8.2" ECU_ADDRESS 0x382EAA /end MEASUREMENT
/begin MEASUREMENT sfpzet6 "" UWORD default 1 100 0.00 65535.00 FORMAT "%8.2" ECU_ADDRESS 0x382EAC /end MEASUREMENT
/begin MEASUREMENT sfpzwpe "" UWORD default 1 100 0.00 65535.00 FORMAT "%8.2" ECU_ADDRESS 0x382EAE /end MEASUREMENT
/begin MEASUREMENT sfpzzz "" UWORD dez 1 100 0.00 65535.00 FORMAT "%8.2" ECU_ADDRESS 0x382EB0 /end MEASUREMENT
/begin MEASUREMENT TYP_akre "" UWORD B_TRUE 1 100 0.00 1.00000000000 BIT_MASK 0xf00 FORMAT "%13.11" ECU_ADDRESS 0x382D34 /end MEASUREMENT
/begin MEASUREMENT TYP_anws "" UWORD B_TRUE 1 100 0.00 1.00000000000 BIT_MASK 0xf00 FORMAT "%13.11" ECU_ADDRESS 0x382D36 /end MEASUREMENT
/begin MEASUREMENT TYP_anwse "" UWORD B_TRUE 1 100 0.00 1.00000000000 BIT_MASK 0xf00 FORMAT "%13.11" ECU_ADDRESS 0x382D38 /end MEASUREMENT
/begin MEASUREMENT TYP_bkvp "" UWORD B_TRUE 1 100 0.00 1.00000000000 BIT_MASK 0xf00 FORMAT "%13.11" ECU_ADDRESS 0x382D3C /end MEASUREMENT
/begin MEASUREMENT TYP_bkvpe "" UWORD B_TRUE 1 100 0.00 1.00000000000 BIT_MASK 0xf00 FORMAT "%13.11" ECU_ADDRESS 0x382D3E /end MEASUREMENT
/begin MEASUREMENT TYP_bm "" UWORD B_TRUE 1 100 0.00 1.00000000000 BIT_MASK 0xf00 FORMAT "%13.11" ECU_ADDRESS 0x382D40 /end MEASUREMENT
/begin MEASUREMENT TYP_cif "" UWORD B_TRUE 1 100 0.00 1.00000000000 BIT_MASK 0xf00 FORMAT "%13.11" ECU_ADDRESS 0x382D58 /end MEASUREMENT
/begin MEASUREMENT TYP_cins "" UWORD B_TRUE 1 100 0.00 1.00000000000 BIT_MASK 0xf00 FORMAT "%13.11" ECU_ADDRESS 0x382D5A /end MEASUREMENT
/begin MEASUREMENT TYP_ckla "" UWORD B_TRUE 1 100 0.00 1.00000000000 BIT_MASK 0xf00 FORMAT "%13.11" ECU_ADDRESS 0x382D5C /end MEASUREMENT
/begin MEASUREMENT TYP_clws "" UWORD B_TRUE 1 100 0.00 1.00000000000 BIT_MASK 0xf00 FORMAT "%13.11" ECU_ADDRESS 0x382D5E /end MEASUREMENT
/begin MEASUREMENT TYP_ctog "" UWORD B_TRUE 1 100 0.00 1.00000000000 BIT_MASK 0xf00 FORMAT "%13.11" ECU_ADDRESS 0x382D60 /end MEASUREMENT
/begin MEASUREMENT TYP_czas "" UWORD B_TRUE 1 100 0.00 1.00000000000 BIT_MASK 0xf00 FORMAT "%13.11" ECU_ADDRESS 0x382D62 /end MEASUREMENT
/begin MEASUREMENT TYP_dk "" UWORD B_TRUE 1 100 0.00 1.00000000000 BIT_MASK 0xf00 FORMAT "%13.11" ECU_ADDRESS 0x382D64 /end MEASUREMENT
/begin MEASUREMENT TYP_dk1p "" UWORD B_TRUE 1 100 0.00 1.00000000000 BIT_MASK 0xf00 FORMAT "%13.11" ECU_ADDRESS 0x382D66 /end MEASUREMENT
/begin MEASUREMENT TYP_dk2p "" UWORD B_TRUE 1 100 0.00 1.00000000000 BIT_MASK 0xf00 FORMAT "%13.11" ECU_ADDRESS 0x382D68 /end MEASUREMENT
/begin MEASUREMENT TYP_dvee "" UWORD B_TRUE 1 100 0.00 1.00000000000 BIT_MASK 0xf00 FORMAT "%13.11" ECU_ADDRESS 0x382D70 /end MEASUREMENT
/begin MEASUREMENT TYP_dvef "" UWORD B_TRUE 1 100 0.00 1.00000000000 BIT_MASK 0xf00 FORMAT "%13.11" ECU_ADDRESS 0x382D72 /end MEASUREMENT
/begin MEASUREMENT TYP_dvefo "" UWORD B_TRUE 1 100 0.00 1.00000000000 BIT_MASK 0xf00 FORMAT "%13.11" ECU_ADDRESS 0x382D74 /end MEASUREMENT
/begin MEASUREMENT TYP_dvel "" UWORD B_TRUE 1 100 0.00 1.00000000000 BIT_MASK 0xf00 FORMAT "%13.11" ECU_ADDRESS 0x382D76 /end MEASUREMENT
/begin MEASUREMENT TYP_dven "" UWORD B_TRUE 1 100 0.00 1.00000000000 BIT_MASK 0xf00 FORMAT "%13.11" ECU_ADDRESS 0x382D78 /end MEASUREMENT
/begin MEASUREMENT TYP_dver "" UWORD B_TRUE 1 100 0.00 1.00000000000 BIT_MASK 0xf00 FORMAT "%13.11" ECU_ADDRESS 0x382D7A /end MEASUREMENT
/begin MEASUREMENT TYP_dvet "" UWORD B_TRUE 1 100 0.00 1.00000000000 BIT_MASK 0xf00 FORMAT "%13.11" ECU_ADDRESS 0x382D7C /end MEASUREMENT
/begin MEASUREMENT TYP_dveu "" UWORD B_TRUE 1 100 0.00 1.00000000000 BIT_MASK 0xf00 FORMAT "%13.11" ECU_ADDRESS 0x382D7E /end MEASUREMENT
/begin MEASUREMENT TYP_dveub "" UWORD B_TRUE 1 100 0.00 1.00000000000 BIT_MASK 0xf00 FORMAT "%13.11" ECU_ADDRESS 0x382D80 /end MEASUREMENT
/begin MEASUREMENT TYP_dveuw "" UWORD B_TRUE 1 100 0.00 1.00000000000 BIT_MASK 0xf00 FORMAT "%13.11" ECU_ADDRESS 0x382D82 /end MEASUREMENT
/begin MEASUREMENT TYP_dvev "" UWORD B_TRUE 1 100 0.00 1.00000000000 BIT_MASK 0xf00 FORMAT "%13.11" ECU_ADDRESS 0x382D84 /end MEASUREMENT
/begin MEASUREMENT TYP_dylsu "" UWORD B_TRUE 1 100 0.00 1.00000000000 BIT_MASK 0xf00 FORMAT "%13.11" ECU_ADDRESS 0x382D86 /end MEASUREMENT
/begin MEASUREMENT TYP_dylsu2 "" UWORD B_TRUE 1 100 0.00 1.00000000000 BIT_MASK 0xf00 FORMAT "%13.11" ECU_ADDRESS 0x382D88 /end MEASUREMENT
/begin MEASUREMENT TYP_egfe "" UWORD B_TRUE 1 100 0.00 1.00000000000 BIT_MASK 0xf00 FORMAT "%13.11" ECU_ADDRESS 0x382D8A /end MEASUREMENT
/begin MEASUREMENT TYP_enws "" UWORD B_TRUE 1 100 0.00 1.00000000000 BIT_MASK 0xf00 FORMAT "%13.11" ECU_ADDRESS 0x382D8E /end MEASUREMENT
/begin MEASUREMENT TYP_enwse "" UWORD B_TRUE 1 100 0.00 1.00000000000 BIT_MASK 0xf00 FORMAT "%13.11" ECU_ADDRESS 0x382D90 /end MEASUREMENT
/begin MEASUREMENT TYP_epcle "" UWORD B_TRUE 1 100 0.00 1.00000000000 BIT_MASK 0xf00 FORMAT "%13.11" ECU_ADDRESS 0x382D92 /end MEASUREMENT
/begin MEASUREMENT TYP_ev1 "" UWORD B_TRUE 1 100 0.00 1.00000000000 BIT_MASK 0xf00 FORMAT "%13.11" ECU_ADDRESS 0x382D94 /end MEASUREMENT
/begin MEASUREMENT TYP_ev2 "" UWORD B_TRUE 1 100 0.00 1.00000000000 BIT_MASK 0xf00 FORMAT "%13.11" ECU_ADDRESS 0x382D96 /end MEASUREMENT
/begin MEASUREMENT TYP_ev3 "" UWORD B_TRUE 1 100 0.00 1.00000000000 BIT_MASK 0xf00 FORMAT "%13.11" ECU_ADDRESS 0x382D98 /end MEASUREMENT
/begin MEASUREMENT TYP_ev4 "" UWORD B_TRUE 1 100 0.00 1.00000000000 BIT_MASK 0xf00 FORMAT "%13.11" ECU_ADDRESS 0x382D9A /end MEASUREMENT
/begin MEASUREMENT TYP_ev5 "" UWORD B_TRUE 1 100 0.00 1.00000000000 BIT_MASK 0xf00 FORMAT "%13.11" ECU_ADDRESS 0x382D9C /end MEASUREMENT
/begin MEASUREMENT TYP_ev6 "" UWORD B_TRUE 1 100 0.00 1.00000000000 BIT_MASK 0xf00 FORMAT "%13.11" ECU_ADDRESS 0x382D9E /end MEASUREMENT
/begin MEASUREMENT TYP_helsu "" UWORD B_TRUE 1 100 0.00 1.00000000000 BIT_MASK 0xf00 FORMAT "%13.11" ECU_ADDRESS 0x382DB6 /end MEASUREMENT
/begin MEASUREMENT TYP_helsu2 "" UWORD B_TRUE 1 100 0.00 1.00000000000 BIT_MASK 0xf00 FORMAT "%13.11" ECU_ADDRESS 0x382DB8 /end MEASUREMENT
/begin MEASUREMENT TYP_hsh "" UWORD B_TRUE 1 100 0.00 1.00000000000 BIT_MASK 0xf00 FORMAT "%13.11" ECU_ADDRESS 0x382DBC /end MEASUREMENT
/begin MEASUREMENT TYP_hsh2 "" UWORD B_TRUE 1 100 0.00 1.00000000000 BIT_MASK 0xf00 FORMAT "%13.11" ECU_ADDRESS 0x382DBE /end MEASUREMENT
/begin MEASUREMENT TYP_hshe "" UWORD B_TRUE 1 100 0.00 1.00000000000 BIT_MASK 0xf00 FORMAT "%13.11" ECU_ADDRESS 0x382DC0 /end MEASUREMENT
/begin MEASUREMENT TYP_hshe2 "" UWORD B_TRUE 1 100 0.00 1.00000000000 BIT_MASK 0xf00 FORMAT "%13.11" ECU_ADDRESS 0x382DC2 /end MEASUREMENT
/begin MEASUREMENT TYP_hsv "" UWORD B_TRUE 1 100 0.00 1.00000000000 BIT_MASK 0xf00 FORMAT "%13.11" ECU_ADDRESS 0x382DC4 /end MEASUREMENT
/begin MEASUREMENT TYP_hsv2 "" UWORD B_TRUE 1 100 0.00 1.00000000000 BIT_MASK 0xf00 FORMAT "%13.11" ECU_ADDRESS 0x382DC6 /end MEASUREMENT
/begin MEASUREMENT TYP_hsve "" UWORD B_TRUE 1 100 0.00 1.00000000000 BIT_MASK 0xf00 FORMAT "%13.11" ECU_ADDRESS 0x382DC8 /end MEASUREMENT
/begin MEASUREMENT TYP_hsve2 "" UWORD B_TRUE 1 100 0.00 1.00000000000 BIT_MASK 0xf00 FORMAT "%13.11" ECU_ADDRESS 0x382DCA /end MEASUREMENT
/begin MEASUREMENT TYP_iclsu "" UWORD B_TRUE 1 100 0.00 1.00000000000 BIT_MASK 0xf00 FORMAT "%13.11" ECU_ADDRESS 0x382DCC /end MEASUREMENT
/begin MEASUREMENT TYP_iclsu2 "" UWORD B_TRUE 1 100 0.00 1.00000000000 BIT_MASK 0xf00 FORMAT "%13.11" ECU_ADDRESS 0x382DCE /end MEASUREMENT
/begin MEASUREMENT TYP_kpe "" UWORD B_TRUE 1 100 0.00 1.00000000000 BIT_MASK 0xf00 FORMAT "%13.11" ECU_ADDRESS 0x382DD4 /end MEASUREMENT
/begin MEASUREMENT TYP_ldpe "" UWORD B_TRUE 1 100 0.00 1.00000000000 BIT_MASK 0xf00 FORMAT "%13.11" ECU_ADDRESS 0x382DFA /end MEASUREMENT
/begin MEASUREMENT TYP_lsuia "" UWORD B_TRUE 1 100 0.00 1.00000000000 BIT_MASK 0xf00 FORMAT "%13.11" ECU_ADDRESS 0x382E06 /end MEASUREMENT
/begin MEASUREMENT TYP_lsuia2 "" UWORD B_TRUE 1 100 0.00 1.00000000000 BIT_MASK 0xf00 FORMAT "%13.11" ECU_ADDRESS 0x382E08 /end MEASUREMENT
/begin MEASUREMENT TYP_lsuip "" UWORD B_TRUE 1 100 0.00 1.00000000000 BIT_MASK 0xf00 FORMAT "%13.11" ECU_ADDRESS 0x382E0A /end MEASUREMENT
/begin MEASUREMENT TYP_lsuip2 "" UWORD B_TRUE 1 100 0.00 1.00000000000 BIT_MASK 0xf00 FORMAT "%13.11" ECU_ADDRESS 0x382E0C /end MEASUREMENT
/begin MEASUREMENT TYP_lsuks "" UWORD B_TRUE 1 100 0.00 1.00000000000 BIT_MASK 0xf00 FORMAT "%13.11" ECU_ADDRESS 0x382E0E /end MEASUREMENT
/begin MEASUREMENT TYP_lsuks2 "" UWORD B_TRUE 1 100 0.00 1.00000000000 BIT_MASK 0xf00 FORMAT "%13.11" ECU_ADDRESS 0x382E10 /end MEASUREMENT
/begin MEASUREMENT TYP_lsuun "" UWORD B_TRUE 1 100 0.00 1.00000000000 BIT_MASK 0xf00 FORMAT "%13.11" ECU_ADDRESS 0x382E12 /end MEASUREMENT
/begin MEASUREMENT TYP_lsuun2 "" UWORD B_TRUE 1 100 0.00 1.00000000000 BIT_MASK 0xf00 FORMAT "%13.11" ECU_ADDRESS 0x382E14 /end MEASUREMENT
/begin MEASUREMENT TYP_lsuvm "" UWORD B_TRUE 1 100 0.00 1.00000000000 BIT_MASK 0xf00 FORMAT "%13.11" ECU_ADDRESS 0x382E16 /end MEASUREMENT
/begin MEASUREMENT TYP_lsuvm2 "" UWORD B_TRUE 1 100 0.00 1.00000000000 BIT_MASK 0xf00 FORMAT "%13.11" ECU_ADDRESS 0x382E18 /end MEASUREMENT
/begin MEASUREMENT TYP_lues1e "" UWORD B_TRUE 1 100 0.00 1.00000000000 BIT_MASK 0xf00 FORMAT "%13.11" ECU_ADDRESS 0x382E22 /end MEASUREMENT
/begin MEASUREMENT TYP_n "" UWORD B_TRUE 1 100 0.00 1.00000000000 BIT_MASK 0xf00 FORMAT "%13.11" ECU_ADDRESS 0x382E38 /end MEASUREMENT
/begin MEASUREMENT TYP_slpe "" UWORD B_TRUE 1 100 0.00 1.00000000000 BIT_MASK 0xf00 FORMAT "%13.11" ECU_ADDRESS 0x382E58 /end MEASUREMENT
/begin MEASUREMENT TYP_slve "" UWORD B_TRUE 1 100 0.00 1.00000000000 BIT_MASK 0xf00 FORMAT "%13.11" ECU_ADDRESS 0x382E62 /end MEASUREMENT
/begin MEASUREMENT TYP_sue "" UWORD B_TRUE 1 100 0.00 1.00000000000 BIT_MASK 0xf00 FORMAT "%13.11" ECU_ADDRESS 0x382E64 /end MEASUREMENT
/begin MEASUREMENT TYP_teve "" UWORD B_TRUE 1 100 0.00 1.00000000000 BIT_MASK 0xf00 FORMAT "%13.11" ECU_ADDRESS 0x382E72 /end MEASUREMENT
/begin MEASUREMENT TYP_zet1 "" UWORD B_TRUE 1 100 0.00 1.00000000000 BIT_MASK 0xf00 FORMAT "%13.11" ECU_ADDRESS 0x382EA2 /end MEASUREMENT
/begin MEASUREMENT TYP_zet2 "" UWORD B_TRUE 1 100 0.00 1.00000000000 BIT_MASK 0xf00 FORMAT "%13.11" ECU_ADDRESS 0x382EA4 /end MEASUREMENT
/begin MEASUREMENT TYP_zet3 "" UWORD B_TRUE 1 100 0.00 1.00000000000 BIT_MASK 0xf00 FORMAT "%13.11" ECU_ADDRESS 0x382EA6 /end MEASUREMENT
/begin MEASUREMENT TYP_zet4 "" UWORD B_TRUE 1 100 0.00 1.00000000000 BIT_MASK 0xf00 FORMAT "%13.11" ECU_ADDRESS 0x382EA8 /end MEASUREMENT
/begin MEASUREMENT TYP_zet5 "" UWORD B_TRUE 1 100 0.00 1.00000000000 BIT_MASK 0xf00 FORMAT "%13.11" ECU_ADDRESS 0x382EAA /end MEASUREMENT
/begin MEASUREMENT TYP_zet6 "" UWORD B_TRUE 1 100 0.00 1.00000000000 BIT_MASK 0xf00 FORMAT "%13.11" ECU_ADDRESS 0x382EAC /end MEASUREMENT
/begin MEASUREMENT TYP_zwpe "" UWORD B_TRUE 1 100 0.00 1.00000000000 BIT_MASK 0xf00 FORMAT "%13.11" ECU_ADDRESS 0x382EAE /end MEASUREMENT
/begin MEASUREMENT Z_aaa "" UWORD B_TRUE 1 100 0.00 1.00000000000 BIT_MASK 0x2 FORMAT "%13.11" ECU_ADDRESS 0x382D30 /end MEASUREMENT
/begin MEASUREMENT Z_akre "" UWORD B_TRUE 1 100 0.00 1.00000000000 BIT_MASK 0x2 FORMAT "%13.11" ECU_ADDRESS 0x382D34 /end MEASUREMENT
/begin MEASUREMENT Z_anws "" UWORD B_TRUE 1 100 0.00 1.00000000000 BIT_MASK 0x2 FORMAT "%13.11" ECU_ADDRESS 0x382D36 /end MEASUREMENT
/begin MEASUREMENT Z_anwse "" UWORD B_TRUE 1 100 0.00 1.00000000000 BIT_MASK 0x2 FORMAT "%13.11" ECU_ADDRESS 0x382D38 /end MEASUREMENT
/begin MEASUREMENT Z_bkvp "" UWORD B_TRUE 1 100 0.00 1.00000000000 BIT_MASK 0x2 FORMAT "%13.11" ECU_ADDRESS 0x382D3C /end MEASUREMENT
/begin MEASUREMENT Z_bkvpe "" UWORD B_TRUE 1 100 0.00 1.00000000000 BIT_MASK 0x2 FORMAT "%13.11" ECU_ADDRESS 0x382D3E /end MEASUREMENT
/begin MEASUREMENT Z_bm "" UWORD B_TRUE 1 100 0.00 1.00000000000 BIT_MASK 0x2 FORMAT "%13.11" ECU_ADDRESS 0x382D40 /end MEASUREMENT
/begin MEASUREMENT Z_cif "" UWORD B_TRUE 1 100 0.00 1.00000000000 BIT_MASK 0x2 FORMAT "%13.11" ECU_ADDRESS 0x382D58 /end MEASUREMENT
/begin MEASUREMENT Z_cins "" UWORD B_TRUE 1 100 0.00 1.00000000000 BIT_MASK 0x2 FORMAT "%13.11" ECU_ADDRESS 0x382D5A /end MEASUREMENT
/begin MEASUREMENT Z_ckla "" UWORD B_TRUE 1 100 0.00 1.00000000000 BIT_MASK 0x2 FORMAT "%13.11" ECU_ADDRESS 0x382D5C /end MEASUREMENT
/begin MEASUREMENT Z_clws "" UWORD B_TRUE 1 100 0.00 1.00000000000 BIT_MASK 0x2 FORMAT "%13.11" ECU_ADDRESS 0x382D5E /end MEASUREMENT
/begin MEASUREMENT Z_ctog "" UWORD B_TRUE 1 100 0.00 1.00000000000 BIT_MASK 0x2 FORMAT "%13.11" ECU_ADDRESS 0x382D60 /end MEASUREMENT
/begin MEASUREMENT Z_czas "" UWORD B_TRUE 1 100 0.00 1.00000000000 BIT_MASK 0x2 FORMAT "%13.11" ECU_ADDRESS 0x382D62 /end MEASUREMENT
/begin MEASUREMENT Z_dk "" UWORD B_TRUE 1 100 0.00 1.00000000000 BIT_MASK 0x2 FORMAT "%13.11" ECU_ADDRESS 0x382D64 /end MEASUREMENT
/begin MEASUREMENT Z_dk1p "" UWORD B_TRUE 1 100 0.00 1.00000000000 BIT_MASK 0x2 FORMAT "%13.11" ECU_ADDRESS 0x382D66 /end MEASUREMENT
/begin MEASUREMENT Z_dk2p "" UWORD B_TRUE 1 100 0.00 1.00000000000 BIT_MASK 0x2 FORMAT "%13.11" ECU_ADDRESS 0x382D68 /end MEASUREMENT
/begin MEASUREMENT Z_dvee "" UWORD B_TRUE 1 100 0.00 1.00000000000 BIT_MASK 0x2 FORMAT "%13.11" ECU_ADDRESS 0x382D70 /end MEASUREMENT
/begin MEASUREMENT Z_dvef "" UWORD B_TRUE 1 100 0.00 1.00000000000 BIT_MASK 0x2 FORMAT "%13.11" ECU_ADDRESS 0x382D72 /end MEASUREMENT
/begin MEASUREMENT Z_dvefo "" UWORD B_TRUE 1 100 0.00 1.00000000000 BIT_MASK 0x2 FORMAT "%13.11" ECU_ADDRESS 0x382D74 /end MEASUREMENT
/begin MEASUREMENT Z_dvel "" UWORD B_TRUE 1 100 0.00 1.00000000000 BIT_MASK 0x2 FORMAT "%13.11" ECU_ADDRESS 0x382D76 /end MEASUREMENT
/begin MEASUREMENT Z_dven "" UWORD B_TRUE 1 100 0.00 1.00000000000 BIT_MASK 0x2 FORMAT "%13.11" ECU_ADDRESS 0x382D78 /end MEASUREMENT
/begin MEASUREMENT Z_dver "" UWORD B_TRUE 1 100 0.00 1.00000000000 BIT_MASK 0x2 FORMAT "%13.11" ECU_ADDRESS 0x382D7A /end MEASUREMENT
/begin MEASUREMENT Z_dvet "" UWORD B_TRUE 1 100 0.00 1.00000000000 BIT_MASK 0x2 FORMAT "%13.11" ECU_ADDRESS 0x382D7C /end MEASUREMENT
/begin MEASUREMENT Z_dveu "" UWORD B_TRUE 1 100 0.00 1.00000000000 BIT_MASK 0x2 FORMAT "%13.11" ECU_ADDRESS 0x382D7E /end MEASUREMENT
/begin MEASUREMENT Z_dveub "" UWORD B_TRUE 1 100 0.00 1.00000000000 BIT_MASK 0x2 FORMAT "%13.11" ECU_ADDRESS 0x382D80 /end MEASUREMENT
/begin MEASUREMENT Z_dveuw "" UWORD B_TRUE 1 100 0.00 1.00000000000 BIT_MASK 0x2 FORMAT "%13.11" ECU_ADDRESS 0x382D82 /end MEASUREMENT
/begin MEASUREMENT Z_dvev "" UWORD B_TRUE 1 100 0.00 1.00000000000 BIT_MASK 0x2 FORMAT "%13.11" ECU_ADDRESS 0x382D84 /end MEASUREMENT
/begin MEASUREMENT Z_dylsu "" UWORD B_TRUE 1 100 0.00 1.00000000000 BIT_MASK 0x2 FORMAT "%13.11" ECU_ADDRESS 0x382D86 /end MEASUREMENT
/begin MEASUREMENT Z_dylsu2 "" UWORD B_TRUE 1 100 0.00 1.00000000000 BIT_MASK 0x2 FORMAT "%13.11" ECU_ADDRESS 0x382D88 /end MEASUREMENT
/begin MEASUREMENT Z_egfe "" UWORD B_TRUE 1 100 0.00 1.00000000000 BIT_MASK 0x2 FORMAT "%13.11" ECU_ADDRESS 0x382D8A /end MEASUREMENT
/begin MEASUREMENT Z_enws "" UWORD B_TRUE 1 100 0.00 1.00000000000 BIT_MASK 0x2 FORMAT "%13.11" ECU_ADDRESS 0x382D8E /end MEASUREMENT
/begin MEASUREMENT Z_enwse "" UWORD B_TRUE 1 100 0.00 1.00000000000 BIT_MASK 0x2 FORMAT "%13.11" ECU_ADDRESS 0x382D90 /end MEASUREMENT
/begin MEASUREMENT Z_epcle "" UWORD B_TRUE 1 100 0.00 1.00000000000 BIT_MASK 0x2 FORMAT "%13.11" ECU_ADDRESS 0x382D92 /end MEASUREMENT
/begin MEASUREMENT Z_ev1 "" UWORD B_TRUE 1 100 0.00 1.00000000000 BIT_MASK 0x2 FORMAT "%13.11" ECU_ADDRESS 0x382D94 /end MEASUREMENT
/begin MEASUREMENT Z_ev2 "" UWORD B_TRUE 1 100 0.00 1.00000000000 BIT_MASK 0x2 FORMAT "%13.11" ECU_ADDRESS 0x382D96 /end MEASUREMENT
/begin MEASUREMENT Z_ev3 "" UWORD B_TRUE 1 100 0.00 1.00000000000 BIT_MASK 0x2 FORMAT "%13.11" ECU_ADDRESS 0x382D98 /end MEASUREMENT
/begin MEASUREMENT Z_ev4 "" UWORD B_TRUE 1 100 0.00 1.00000000000 BIT_MASK 0x2 FORMAT "%13.11" ECU_ADDRESS 0x382D9A /end MEASUREMENT
/begin MEASUREMENT Z_ev5 "" UWORD B_TRUE 1 100 0.00 1.00000000000 BIT_MASK 0x2 FORMAT "%13.11" ECU_ADDRESS 0x382D9C /end MEASUREMENT
/begin MEASUREMENT Z_ev6 "" UWORD B_TRUE 1 100 0.00 1.00000000000 BIT_MASK 0x2 FORMAT "%13.11" ECU_ADDRESS 0x382D9E /end MEASUREMENT
/begin MEASUREMENT Z_helsu "" UWORD B_TRUE 1 100 0.00 1.00000000000 BIT_MASK 0x2 FORMAT "%13.11" ECU_ADDRESS 0x382DB6 /end MEASUREMENT
/begin MEASUREMENT Z_helsu2 "" UWORD B_TRUE 1 100 0.00 1.00000000000 BIT_MASK 0x2 FORMAT "%13.11" ECU_ADDRESS 0x382DB8 /end MEASUREMENT
/begin MEASUREMENT Z_hsh "" UWORD B_TRUE 1 100 0.00 1.00000000000 BIT_MASK 0x2 FORMAT "%13.11" ECU_ADDRESS 0x382DBC /end MEASUREMENT
/begin MEASUREMENT Z_hsh2 "" UWORD B_TRUE 1 100 0.00 1.00000000000 BIT_MASK 0x2 FORMAT "%13.11" ECU_ADDRESS 0x382DBE /end MEASUREMENT
/begin MEASUREMENT Z_hshe "" UWORD B_TRUE 1 100 0.00 1.00000000000 BIT_MASK 0x2 FORMAT "%13.11" ECU_ADDRESS 0x382DC0 /end MEASUREMENT
/begin MEASUREMENT Z_hshe2 "" UWORD B_TRUE 1 100 0.00 1.00000000000 BIT_MASK 0x2 FORMAT "%13.11" ECU_ADDRESS 0x382DC2 /end MEASUREMENT
/begin MEASUREMENT Z_hsv "" UWORD B_TRUE 1 100 0.00 1.00000000000 BIT_MASK 0x2 FORMAT "%13.11" ECU_ADDRESS 0x382DC4 /end MEASUREMENT
/begin MEASUREMENT Z_hsv2 "" UWORD B_TRUE 1 100 0.00 1.00000000000 BIT_MASK 0x2 FORMAT "%13.11" ECU_ADDRESS 0x382DC6 /end MEASUREMENT
/begin MEASUREMENT Z_hsve "" UWORD B_TRUE 1 100 0.00 1.00000000000 BIT_MASK 0x2 FORMAT "%13.11" ECU_ADDRESS 0x382DC8 /end MEASUREMENT
/begin MEASUREMENT Z_hsve2 "" UWORD B_TRUE 1 100 0.00 1.00000000000 BIT_MASK 0x2 FORMAT "%13.11" ECU_ADDRESS 0x382DCA /end MEASUREMENT
/begin MEASUREMENT Z_iclsu "" UWORD B_TRUE 1 100 0.00 1.00000000000 BIT_MASK 0x2 FORMAT "%13.11" ECU_ADDRESS 0x382DCC /end MEASUREMENT
/begin MEASUREMENT Z_iclsu2 "" UWORD B_TRUE 1 100 0.00 1.00000000000 BIT_MASK 0x2 FORMAT "%13.11" ECU_ADDRESS 0x382DCE /end MEASUREMENT
/begin MEASUREMENT Z_kpe "" UWORD B_TRUE 1 100 0.00 1.00000000000 BIT_MASK 0x2 FORMAT "%13.11" ECU_ADDRESS 0x382DD4 /end MEASUREMENT
/begin MEASUREMENT Z_ldpe "" UWORD B_TRUE 1 100 0.00 1.00000000000 BIT_MASK 0x2 FORMAT "%13.11" ECU_ADDRESS 0x382DFA /end MEASUREMENT
/begin MEASUREMENT Z_lsuia "" UWORD B_TRUE 1 100 0.00 1.00000000000 BIT_MASK 0x2 FORMAT "%13.11" ECU_ADDRESS 0x382E06 /end MEASUREMENT
/begin MEASUREMENT Z_lsuia2 "" UWORD B_TRUE 1 100 0.00 1.00000000000 BIT_MASK 0x2 FORMAT "%13.11" ECU_ADDRESS 0x382E08 /end MEASUREMENT
/begin MEASUREMENT Z_lsuip "" UWORD B_TRUE 1 100 0.00 1.00000000000 BIT_MASK 0x2 FORMAT "%13.11" ECU_ADDRESS 0x382E0A /end MEASUREMENT
/begin MEASUREMENT Z_lsuip2 "" UWORD B_TRUE 1 100 0.00 1.00000000000 BIT_MASK 0x2 FORMAT "%13.11" ECU_ADDRESS 0x382E0C /end MEASUREMENT
/begin MEASUREMENT Z_lsuks "" UWORD B_TRUE 1 100 0.00 1.00000000000 BIT_MASK 0x2 FORMAT "%13.11" ECU_ADDRESS 0x382E0E /end MEASUREMENT
/begin MEASUREMENT Z_lsuks2 "" UWORD B_TRUE 1 100 0.00 1.00000000000 BIT_MASK 0x2 FORMAT "%13.11" ECU_ADDRESS 0x382E10 /end MEASUREMENT
/begin MEASUREMENT Z_lsuun "" UWORD B_TRUE 1 100 0.00 1.00000000000 BIT_MASK 0x2 FORMAT "%13.11" ECU_ADDRESS 0x382E12 /end MEASUREMENT
/begin MEASUREMENT Z_lsuun2 "" UWORD B_TRUE 1 100 0.00 1.00000000000 BIT_MASK 0x2 FORMAT "%13.11" ECU_ADDRESS 0x382E14 /end MEASUREMENT
/begin MEASUREMENT Z_lsuvm "" UWORD B_TRUE 1 100 0.00 1.00000000000 BIT_MASK 0x2 FORMAT "%13.11" ECU_ADDRESS 0x382E16 /end MEASUREMENT
/begin MEASUREMENT Z_lsuvm2 "" UWORD B_TRUE 1 100 0.00 1.00000000000 BIT_MASK 0x2 FORMAT "%13.11" ECU_ADDRESS 0x382E18 /end MEASUREMENT
/begin MEASUREMENT Z_lues1e "" UWORD B_TRUE 1 100 0.00 1.00000000000 BIT_MASK 0x2 FORMAT "%13.11" ECU_ADDRESS 0x382E22 /end MEASUREMENT
/begin MEASUREMENT Z_n "" UWORD B_TRUE 1 100 0.00 1.00000000000 BIT_MASK 0x2 FORMAT "%13.11" ECU_ADDRESS 0x382E38 /end MEASUREMENT
/begin MEASUREMENT Z_slpe "" UWORD B_TRUE 1 100 0.00 1.00000000000 BIT_MASK 0x2 FORMAT "%13.11" ECU_ADDRESS 0x382E58 /end MEASUREMENT
/begin MEASUREMENT Z_slve "" UWORD B_TRUE 1 100 0.00 1.00000000000 BIT_MASK 0x2 FORMAT "%13.11" ECU_ADDRESS 0x382E62 /end MEASUREMENT
/begin MEASUREMENT Z_sue "" UWORD B_TRUE 1 100 0.00 1.00000000000 BIT_MASK 0x2 FORMAT "%13.11" ECU_ADDRESS 0x382E64 /end MEASUREMENT
/begin MEASUREMENT Z_teve "" UWORD B_TRUE 1 100 0.00 1.00000000000 BIT_MASK 0x2 FORMAT "%13.11" ECU_ADDRESS 0x382E72 /end MEASUREMENT
/begin MEASUREMENT Z_zet1 "" UWORD B_TRUE 1 100 0.00 1.00000000000 BIT_MASK 0x2 FORMAT "%13.11" ECU_ADDRESS 0x382EA2 /end MEASUREMENT
/begin MEASUREMENT Z_zet2 "" UWORD B_TRUE 1 100 0.00 1.00000000000 BIT_MASK 0x2 FORMAT "%13.11" ECU_ADDRESS 0x382EA4 /end MEASUREMENT
/begin MEASUREMENT Z_zet3 "" UWORD B_TRUE 1 100 0.00 1.00000000000 BIT_MASK 0x2 FORMAT "%13.11" ECU_ADDRESS 0x382EA6 /end MEASUREMENT
/begin MEASUREMENT Z_zet4 "" UWORD B_TRUE 1 100 0.00 1.00000000000 BIT_MASK 0x2 FORMAT "%13.11" ECU_ADDRESS 0x382EA8 /end MEASUREMENT
/begin MEASUREMENT Z_zet5 "" UWORD B_TRUE 1 100 0.00 1.00000000000 BIT_MASK 0x2 FORMAT "%13.11" ECU_ADDRESS 0x382EAA /end MEASUREMENT
/begin MEASUREMENT Z_zet6 "" UWORD B_TRUE 1 100 0.00 1.00000000000 BIT_MASK 0x2 FORMAT "%13.11" ECU_ADDRESS 0x382EAC /end MEASUREMENT
/begin MEASUREMENT Z_zwpe "" UWORD B_TRUE 1 100 0.00 1.00000000000 BIT_MASK 0x2 FORMAT "%13.11" ECU_ADDRESS 0x382EAE /end MEASUREMENT
/begin FUNCTION DFPM_CIF "" /begin DEF_CHARACTERISTIC CDCCIF CDKCIF CDTCIF CLACIF FFTCIF TSFCIF /end DEF_CHARACTERISTIC
 /begin OUT_MEASUREMENT B_avcif B_becif B_bkcif B_clcif B_ftcif B_mncif B_mxcif B_npcif B_pycif B_sccif B_sicif E_cif sfpcif TYP_cif Z_cif /end OUT_MEASUREMENT
/end FUNCTION
/begin FUNCTION DFPM_CINS "" /begin DEF_CHARACTERISTIC CDCCINS CDKCINS CDTCINS CLACINS FFTCINS TSFCINS /end DEF_CHARACTERISTIC
 /begin OUT_MEASUREMENT B_avcins B_becins B_bkcins B_clcins B_ftcins B_mncins B_mxcins B_npcins B_pycins B_sccins B_sicins E_cins sfpcins TYP_cins Z_cins /end OUT_MEASUREMENT
/end FUNCTION
/begin FUNCTION DFPM_CKLA "" /begin DEF_CHARACTERISTIC CDCCKLA CDKCKLA CDTCKLA CLACKLA FFTCKLA TSFCKLA /end DEF_CHARACTERISTIC
 /begin OUT_MEASUREMENT B_avckla B_beckla B_bkckla B_clckla B_ftckla B_mnckla B_mxckla B_npckla B_pyckla B_scckla B_sickla E_ckla sfpckla TYP_ckla Z_ckla /end OUT_MEASUREMENT
/end FUNCTION
/begin FUNCTION DFPM_CLWS "" /begin DEF_CHARACTERISTIC CDCCLWS CDKCLWS CDTCLWS CLACLWS FFTCLWS TSFCLWS /end DEF_CHARACTERISTIC
 /begin OUT_MEASUREMENT B_avclws B_beclws B_bkclws B_clclws B_ftclws B_mnclws B_mxclws B_npclws B_pyclws B_scclws B_siclws E_clws sfpclws TYP_clws Z_clws /end OUT_MEASUREMENT
/end FUNCTION
/begin FUNCTION DFPM_CNIV "" /end FUNCTION
/begin FUNCTION DFPM_CTOG "" /begin DEF_CHARACTERISTIC CDCCTOG CDKCTOG CDTCTOG CLACTOG FFTCTOG TSFCTOG /end DEF_CHARACTERISTIC
 /begin OUT_MEASUREMENT B_avctog B_bectog B_bkctog B_clctog B_ftctog B_mnctog B_mxctog B_npctog B_pyctog B_scctog B_sictog E_ctog sfpctog TYP_ctog Z_ctog /end OUT_MEASUREMENT
/end FUNCTION
/begin FUNCTION DFPM_CZAS "" /begin DEF_CHARACTERISTIC CDCCZAS CDKCZAS CDTCZAS CLACZAS FFTCZAS TSFCZAS /end DEF_CHARACTERISTIC
 /begin OUT_MEASUREMENT B_avczas B_beczas B_bkczas B_clczas B_ftczas B_mnczas B_mxczas B_npczas B_pyczas B_scczas B_siczas E_czas sfpczas TYP_czas Z_czas /end OUT_MEASUREMENT
/end FUNCTION
/begin FUNCTION DFPM_DANWS "" /begin DEF_CHARACTERISTIC CDCANWS CDKANWS CDTANWS CLAANWS FFTANWS TSFANWS /end DEF_CHARACTERISTIC
 /begin OUT_MEASUREMENT B_beanws B_bkanws B_clanws B_ftanws B_mnanws B_mxanws B_npanws B_sianws E_anws sfpanws TYP_anws Z_anws /end OUT_MEASUREMENT
/end FUNCTION
/begin FUNCTION DFPM_DAT "" /end FUNCTION
/begin FUNCTION DFPM_DBKVP "" /begin DEF_CHARACTERISTIC CDCBKVP CDKBKVP CDTBKVP CLABKVP FFTBKVP TSFBKVP /end DEF_CHARACTERISTIC
 /begin OUT_MEASUREMENT B_bebkvp B_bkbkvp B_clbkvp B_ftbkvp B_mnbkvp B_mxbkvp B_npbkvp B_sibkvp E_bkvp sfpbkvp TYP_bkvp Z_bkvp /end OUT_MEASUREMENT
/end FUNCTION
/begin FUNCTION DFPM_DDG ""
 /begin DEF_CHARACTERISTIC CDCBM CDCN CDKBM CDKN CDTBM CDTN CLABM CLAN FFTBM FFTN TSFBM TSFN /end DEF_CHARACTERISTIC
 /begin OUT_MEASUREMENT B_bebm B_ben B_bkbm B_bkn B_clbm B_cln B_ftbm B_ftn B_mnbm B_mnn B_mxbm B_mxn B_npbm B_npn B_sibm B_sin E_bm E_n sfpbm sfpn TYP_bm TYP_n Z_bm Z_n /end OUT_MEASUREMENT
/end FUNCTION
/begin FUNCTION DFPM_DDVE ""
 /begin DEF_CHARACTERISTIC CDCDK CDCDK1P CDCDK2P CDCDVEE CDCDVEF CDCDVEFO CDCDVEL CDCDVEN CDCDVER CDCDVET CDCDVEU CDCDVEUB CDCDVEUW CDCDVEV CDKDK CDKDK1P CDKDK2P CDKDVEE CDKDVEF CDKDVEFO CDKDVEL CDKDVEN CDKDVER CDKDVET CDKDVEU CDKDVEUB CDKDVEUW CDKDVEV CDTDK CDTDK1P CDTDK2P CDTDVEE CDTDVEF CDTDVEFO CDTDVEL CDTDVEN CDTDVER CDTDVET CDTDVEU CDTDVEUB CDTDVEUW CDTDVEV CLADK CLADK1P CLADK2P CLADVEE CLADVEF CLADVEFO CLADVEL CLADVEN CLADVER CLADVET CLADVEU CLADVEUB CLADVEUW CLADVEV FFTDK FFTDK1P FFTDK2P FFTDVEE FFTDVEF FFTDVEFO FFTDVEL FFTDVEN FFTDVER FFTDVET FFTDVEU FFTDVEUB FFTDVEUW FFTDVEV TSFDK TSFDK1P TSFDK2P TSFDVEE TSFDVEF TSFDVEFO TSFDVEL TSFDVEN TSFDVER TSFDVET TSFDVEU TSFDVEUB TSFDVEUW TSFDVEV /end DEF_CHARACTERISTIC
 /begin OUT_MEASUREMENT B_bedk B_bedk1p B_bedk2p B_bedvee B_bedvef B_bedvefo B_bedvel B_bedven B_bedver B_bedvet B_bedveu B_bedveub B_bedveuw B_bedvev B_bkdk B_bkdk1p B_bkdk2p B_bkdvee B_bkdvef B_bkdvefo B_bkdvel B_bkdven B_bkdver B_bkdvet B_bkdveu B_bkdveub B_bkdveuw B_bkdvev B_cldk B_cldk1p B_cldk2p B_cldvee B_cldvef B_cldvefo B_cldvel B_cldven B_cldver B_cldvet B_cldveu B_cldveub B_cldveuw B_cldvev B_ftdk B_ftdk1p B_ftdk2p B_ftdvee B_ftdvef B_ftdvefo B_ftdvel B_ftdven B_ftdver B_ftdvet B_ftdveu B_ftdveub B_ftdveuw B_ftdvev B_mndk B_mndk1p B_mndk2p B_mndvee B_mndvef B_mndvefo B_mndvel B_mndven B_mndver B_mndvet B_mndveu B_mndveub B_mndveuw B_mndvev B_mxdk B_mxdk1p B_mxdk2p B_mxdvee B_mxdvef B_mxdvefo B_mxdvel B_mxdven B_mxdver B_mxdvet B_mxdveu B_mxdveub B_mxdveuw B_mxdvev B_npdk B_npdk1p B_npdk2p B_npdvee B_npdvef B_npdvefo B_npdvel B_npdven B_npdver B_npdvet B_npdveu B_npdveub B_npdveuw B_npdvev B_sidk B_sidk1p B_sidk2p B_sidvee B_sidvef B_sidvefo B_sidvel B_sidven B_sidver B_sidvet B_sidveu B_sidveub B_sidveuw B_sidvev E_dk E_dk1p E_dk2p E_dvee E_dvef E_dvefo E_dvel E_dven E_dver E_dvet E_dveu E_dveub E_dveuw E_dvev sfpdk sfpdk1p sfpdk2p sfpdvee sfpdvef sfpdvefo sfpdvel sfpdven sfpdver sfpdvet sfpdveu sfpdveub sfpdveuw sfpdvev TYP_dk TYP_dk1p TYP_dk2p TYP_dvee TYP_dvef TYP_dvefo TYP_dvel TYP_dven TYP_dver TYP_dvet TYP_dveu TYP_dveub TYP_dveuw TYP_dvev Z_dk Z_dk1p Z_dk2p Z_dvee Z_dvef Z_dvefo Z_dvel Z_dven Z_dver Z_dvet Z_dveu Z_dveub Z_dveuw Z_dvev /end OUT_MEASUREMENT
/end FUNCTION
/begin FUNCTION DFPM_DDYLSU ""
 /begin DEF_CHARACTERISTIC CDCDYLSU CDCDYLSU2 CDKDYLSU CDKDYLSU2 CDTDYLSU CDTDYLSU2 CLADYLSU CLADYLSU2 FFTDYLSU FFTDYLSU2 TSFDYLSU TSFDYLSU2 /end DEF_CHARACTERISTIC
 /begin OUT_MEASUREMENT B_bedylsu B_bedylsu2 B_bkdylsu B_bkdylsu2 B_cldylsu B_cldylsu2 B_ftdylsu B_ftdylsu2 B_mndylsu B_mndylsu2 B_mxdylsu B_mxdylsu2 B_npdylsu B_npdylsu2 B_sidylsu B_sidylsu2 E_dylsu E_dylsu2 sfpdylsu sfpdylsu2 TYP_dylsu TYP_dylsu2 Z_dylsu Z_dylsu2 /end OUT_MEASUREMENT
/end FUNCTION
/begin FUNCTION DFPM_DEGFE "" /begin DEF_CHARACTERISTIC CDCEGFE CDKEGFE CDTEGFE CLAEGFE FFTEGFE TSFEGFE /end DEF_CHARACTERISTIC
 /begin OUT_MEASUREMENT B_beegfe B_bkegfe B_clegfe B_ftegfe B_mnegfe B_mxegfe B_npegfe E_egfe sfpegfe TYP_egfe Z_egfe /end OUT_MEASUREMENT
/end FUNCTION
/begin FUNCTION DFPM_DEKON ""
 /begin DEF_CHARACTERISTIC CDCAKRE CDCANWSE CDCBKVPE CDCENWSE CDCEPCLE CDCEV1 CDCEV2 CDCEV3 CDCEV4 CDCEV5 CDCEV6 CDCHSHE CDCHSHE2 CDCKPE CDCLDPE CDCLUES1E CDCSLPE CDCSLVE CDCSUE CDCTEVE CDCZET1 CDCZET2 CDCZET3 CDCZET4 CDCZET5 CDCZET6 CDCZWPE CDKAKRE CDKANWSE CDKBKVPE CDKENWSE CDKEPCLE CDKEV1 CDKEV2 CDKEV3 CDKEV4 CDKEV5 CDKEV6 CDKHSHE CDKHSHE2 CDKKPE CDKLDPE CDKLUES1E CDKSLPE CDKSLVE CDKSUE CDKTEVE CDKZET1 CDKZET2 CDKZET3 CDKZET4 CDKZET5 CDKZET6 CDKZWPE CDTAKRE CDTANWSE CDTBKVPE CDTENWSE CDTEPCLE CDTEV1 CDTEV2 CDTEV3 CDTEV4 CDTEV5 CDTEV6 CDTHSHE CDTHSHE2 CDTKPE CDTLDPE CDTLUES1E CDTSLPE CDTSLVE CDTSUE CDTTEVE CDTZET1 CDTZET2 CDTZET3 CDTZET4 CDTZET5 CDTZET6 CDTZWPE CLAAKRE CLAANWSE CLABKVPE CLAENWSE CLAEPCLE CLAEV1 CLAEV2 CLAEV3 CLAEV4 CLAEV5 CLAEV6 CLAHSHE CLAHSHE2 CLAKPE CLALDPE CLALUES1E CLASLPE CLASLVE CLASUE CLATEVE CLAZET1 CLAZET2 CLAZET3 CLAZET4 CLAZET5 CLAZET6 CLAZWPE FFTAKRE FFTANWSE FFTBKVPE FFTENWSE FFTEPCLE FFTEV1 FFTEV2 FFTEV3 FFTEV4 FFTEV5 FFTEV6 FFTHSHE FFTHSHE2 FFTKPE FFTLDPE FFTLUES1E FFTSLPE FFTSLVE FFTSUE FFTTEVE FFTZET1 FFTZET2 FFTZET3 FFTZET4 FFTZET5 FFTZET6 FFTZWPE TSFAKRE TSFANWSE TSFBKVPE TSFENWSE TSFEPCLE TSFEV1 TSFEV2 TSFEV3 TSFEV4 TSFEV5 TSFEV6 TSFHSHE TSFHSHE2 TSFKPE TSFLDPE TSFLUES1E TSFSLPE TSFSLVE TSFSUE TSFTEVE TSFZET1 TSFZET2 TSFZET3 TSFZET4 TSFZET5 TSFZET6 TSFZWPE /end DEF_CHARACTERISTIC
 /begin OUT_MEASUREMENT B_beakre B_beanwse B_bebkvpe B_beenwse B_beepcle B_beev1 B_beev2 B_beev3 B_beev4 B_beev5 B_beev6 B_behshe B_behshe2 B_bekpe B_beldpe B_belues1e B_beslpe B_beslve B_besue B_beteve B_bezet1 B_bezet2 B_bezet3 B_bezet4 B_bezet5 B_bezet6 B_bezwpe B_bkakre B_bkanwse B_bkbkvpe B_bkenwse B_bkepcle B_bkev1 B_bkev2 B_bkev3 B_bkev4 B_bkev5 B_bkev6 B_bkhshe B_bkhshe2 B_bkkpe B_bkldpe B_bklues1e B_bkslpe B_bkslve B_bksue B_bkteve B_bkzet1 B_bkzet2 B_bkzet3 B_bkzet4 B_bkzet5 B_bkzet6 B_bkzwpe B_clakre B_clanwse B_clbkvpe B_clenwse B_clepcle B_clev1 B_clev2 B_clev3 B_clev4 B_clev5 B_clev6 B_clhshe B_clhshe2 B_clkpe B_clldpe B_cllues1e B_clslpe B_clslve B_clsue B_clteve B_clzet1 B_clzet2 B_clzet3 B_clzet4 B_clzet5 B_clzet6 B_clzwpe B_ftakre B_ftanwse B_ftbkvpe B_ftenwse B_ftepcle B_ftev1 B_ftev2 B_ftev3 B_ftev4 B_ftev5 B_ftev6 B_fthshe B_fthshe2 B_ftkpe B_ftldpe B_ftlues1e B_ftslpe B_ftslve B_ftsue B_ftteve B_ftzet1 B_ftzet2 B_ftzet3 B_ftzet4 B_ftzet5 B_ftzet6 B_ftzwpe B_mnakre B_mnanwse B_mnbkvpe B_mnenwse B_mnepcle B_mnev1 B_mnev2 B_mnev3 B_mnev4 B_mnev5 B_mnev6 B_mnhshe B_mnhshe2 B_mnkpe B_mnldpe B_mnlues1e B_mnslpe B_mnslve B_mnsue B_mnteve B_mnzet1 B_mnzet2 B_mnzet3 B_mnzet4 B_mnzet5 B_mnzet6 B_mnzwpe B_mxakre B_mxanwse B_mxbkvpe B_mxenwse B_mxepcle B_mxev1 B_mxev2 B_mxev3 B_mxev4 B_mxev5 B_mxev6 B_mxhshe B_mxhshe2 B_mxkpe B_mxldpe B_mxlues1e B_mxslpe B_mxslve B_mxsue B_mxteve B_mxzet1 B_mxzet2 B_mxzet3 B_mxzet4 B_mxzet5 B_mxzet6 B_mxzwpe B_npakre B_npanwse B_npbkvpe B_npenwse B_npepcle B_npev1 B_npev2 B_npev3 B_npev4 B_npev5 B_npev6 B_nphshe B_nphshe2 B_npkpe B_npldpe B_nplues1e B_npslpe B_npslve B_npsue B_npteve B_npzet1 B_npzet2 B_npzet3 B_npzet4 B_npzet5 B_npzet6 B_npzwpe B_siakre B_sianwse B_sibkvpe B_sienwse B_siepcle B_siev1 B_siev2 B_siev3 B_siev4 B_siev5 B_siev6 B_sihshe B_sihshe2 B_sikpe B_sildpe B_silues1e B_sislpe B_sislve B_sisue B_siteve B_sizet1 B_sizet2 B_sizet3 B_sizet4 B_sizet5 B_sizet6 B_sizwpe E_akre E_anwse E_bkvpe E_enwse E_epcle E_ev1 E_ev2 E_ev3 E_ev4 E_ev5 E_ev6 E_hshe E_hshe2 E_kpe E_ldpe E_lues1e E_slpe E_slve E_sue E_teve E_zet1 E_zet2 E_zet3 E_zet4 E_zet5 E_zet6 E_zwpe sfpakre sfpanwse sfpbkvpe sfpenwse sfpepcle sfpev1 sfpev2 sfpev3 sfpev4 sfpev5 sfpev6 sfphshe sfphshe2 sfpkpe sfpldpe sfplues1e sfpslpe sfpslve sfpsue sfpteve sfpzet1 sfpzet2 sfpzet3 sfpzet4 sfpzet5 sfpzet6 sfpzwpe TYP_akre TYP_anwse TYP_bkvpe TYP_enwse TYP_epcle TYP_ev1 TYP_ev2 TYP_ev3 TYP_ev4 TYP_ev5 TYP_ev6 TYP_hshe TYP_hshe2 TYP_kpe TYP_ldpe TYP_lues1e TYP_slpe TYP_slve TYP_sue TYP_teve TYP_zet1 TYP_zet2 TYP_zet3 TYP_zet4 TYP_zet5 TYP_zet6 TYP_zwpe Z_akre Z_anwse Z_bkvpe Z_enwse Z_epcle Z_ev1 Z_ev2 Z_ev3 Z_ev4 Z_ev5 Z_ev6 Z_hshe Z_hshe2 Z_kpe Z_ldpe Z_lues1e Z_slpe Z_slve Z_sue Z_teve Z_zet1 Z_zet2 Z_zet3 Z_zet4 Z_zet5 Z_zet6 Z_zwpe /end OUT_MEASUREMENT
/end FUNCTION
/begin FUNCTION DFPM_DENWS "" /begin DEF_CHARACTERISTIC CDCENWS CDKENWS CDTENWS CLAENWS FFTENWS TSFENWS /end DEF_CHARACTERISTIC
 /begin OUT_MEASUREMENT B_beenws B_bkenws B_clenws B_ftenws B_mnenws B_mxenws B_npenws B_sienws E_enws sfpenws TYP_enws Z_enws /end OUT_MEASUREMENT
/end FUNCTION
/begin FUNCTION DFPM_DFPM ""
 /begin DEF_CHARACTERISTIC CDCAAA CDCZZZ CDKAAA CDKZZZ CDTAAA CDTZZZ CLAAAA CLAZZZ FFTAAA FFTZZZ TSFAAA TSFZZZ /end DEF_CHARACTERISTIC
 /begin OUT_MEASUREMENT E_aaa sfpaaa sfpzzz Z_aaa /end OUT_MEASUREMENT
/end FUNCTION
/begin FUNCTION DFPM_DHELSU ""
 /begin DEF_CHARACTERISTIC CDCHELSU CDCHELSU2 CDKHELSU CDKHELSU2 CDTHELSU CDTHELSU2 CLAHELSU CLAHELSU2 FFTHELSU FFTHELSU2 TSFHELSU TSFHELSU2 /end DEF_CHARACTERISTIC
 /begin OUT_MEASUREMENT B_behelsu B_behelsu2 B_bkhelsu B_bkhelsu2 B_clhelsu B_clhelsu2 B_fthelsu B_fthelsu2 B_mnhelsu B_mnhelsu2 B_mxhelsu B_mxhelsu2 B_nphelsu B_nphelsu2 B_sihelsu B_sihelsu2 E_helsu E_helsu2 sfphelsu sfphelsu2 TYP_helsu TYP_helsu2 Z_helsu Z_helsu2 /end OUT_MEASUREMENT
/end FUNCTION
/begin FUNCTION DFPM_DHFM "" /end FUNCTION
/begin FUNCTION DFPM_DHLSHK ""
 /begin DEF_CHARACTERISTIC CDCHSH CDCHSH2 CDKHSH CDKHSH2 CDTHSH CDTHSH2 CLAHSH CLAHSH2 FFTHSH FFTHSH2 TSFHSH TSFHSH2 /end DEF_CHARACTERISTIC
 /begin OUT_MEASUREMENT B_behsh B_behsh2 B_bkhsh B_bkhsh2 B_clhsh B_clhsh2 B_fthsh B_fthsh2 B_mnhsh B_mnhsh2 B_mxhsh B_mxhsh2 B_nphsh B_nphsh2 B_sihsh B_sihsh2 E_hsh E_hsh2 sfphsh sfphsh2 TYP_hsh TYP_hsh2 Z_hsh Z_hsh2 /end OUT_MEASUREMENT
/end FUNCTION
/begin FUNCTION DFPM_DHRLSU ""
 /begin DEF_CHARACTERISTIC CDCHSV CDCHSV2 CDKHSV CDKHSV2 CDTHSV CDTHSV2 CLAHSV CLAHSV2 FFTHSV FFTHSV2 TSFHSV TSFHSV2 /end DEF_CHARACTERISTIC
 /begin OUT_MEASUREMENT B_behsv B_behsv2 B_bkhsv B_bkhsv2 B_clhsv B_clhsv2 B_fthsv B_fthsv2 B_mnhsv B_mnhsv2 B_mxhsv B_mxhsv2 B_nphsv B_nphsv2 B_sihsv B_sihsv2 E_hsv E_hsv2 sfphsv sfphsv2 TYP_hsv TYP_hsv2 Z_hsv Z_hsv2 /end OUT_MEASUREMENT
/end FUNCTION
/begin FUNCTION DFPM_DHRLSUE ""
 /begin DEF_CHARACTERISTIC CDCHSVE CDCHSVE2 CDKHSVE CDKHSVE2 CDTHSVE CDTHSVE2 CLAHSVE CLAHSVE2 FFTHSVE FFTHSVE2 TSFHSVE TSFHSVE2 /end DEF_CHARACTERISTIC
 /begin OUT_MEASUREMENT B_behsve B_behsve2 B_bkhsve B_bkhsve2 B_clhsve B_clhsve2 B_fthsve B_fthsve2 B_mnhsve B_mnhsve2 B_mxhsve B_mxhsve2 B_nphsve B_nphsve2 B_sihsve B_sihsve2 E_hsve E_hsve2 sfphsve sfphsve2 TYP_hsve TYP_hsve2 Z_hsve Z_hsve2 /end OUT_MEASUREMENT
/end FUNCTION
/begin FUNCTION DFPM_DICLSU ""
 /begin DEF_CHARACTERISTIC CDCICLSU CDCICLSU2 CDCLSUIA CDCLSUIA2 CDCLSUIP CDCLSUIP2 CDCLSUKS CDCLSUKS2 CDCLSUUN CDCLSUUN2 CDCLSUVM CDCLSUVM2 CDKICLSU CDKICLSU2 CDKLSUIA CDKLSUIA2 CDKLSUIP CDKLSUIP2 CDKLSUKS CDKLSUKS2 CDKLSUUN CDKLSUUN2 CDKLSUVM CDKLSUVM2 CDTICLSU CDTICLSU2 CDTLSUIA CDTLSUIA2 CDTLSUIP CDTLSUIP2 CDTLSUKS CDTLSUKS2 CDTLSUUN CDTLSUUN2 CDTLSUVM CDTLSUVM2 CLAICLSU CLAICLSU2 CLALSUIA CLALSUIA2 CLALSUIP CLALSUIP2 CLALSUKS CLALSUKS2 CLALSUUN CLALSUUN2 CLALSUVM CLALSUVM2 FFTICLSU FFTICLSU2 FFTLSUIA FFTLSUIA2 FFTLSUIP FFTLSUIP2 FFTLSUKS FFTLSUKS2 FFTLSUUN FFTLSUUN2 FFTLSUVM FFTLSUVM2 TSFICLSU TSFICLSU2 TSFLSUIA TSFLSUIA2 TSFLSUIP TSFLSUIP2 TSFLSUKS TSFLSUKS2 TSFLSUUN TSFLSUUN2 TSFLSUVM TSFLSUVM2 /end DEF_CHARACTERISTIC
 /begin OUT_MEASUREMENT B_beiclsu B_beiclsu2 B_belsuia B_belsuia2 B_belsuip B_belsuip2 B_belsuks B_belsuks2 B_belsuun B_belsuun2 B_belsuvm B_belsuvm2 B_bkiclsu B_bkiclsu2 B_bklsuia B_bklsuia2 B_bklsuip B_bklsuip2 B_bklsuks B_bklsuks2 B_bklsuun B_bklsuun2 B_bklsuvm B_bklsuvm2 B_cliclsu B_cliclsu2 B_cllsuia B_cllsuia2 B_cllsuip B_cllsuip2 B_cllsuks B_cllsuks2 B_cllsuun B_cllsuun2 B_cllsuvm B_cllsuvm2 B_fticlsu B_fticlsu2 B_ftlsuia B_ftlsuia2 B_ftlsuip B_ftlsuip2 B_ftlsuks B_ftlsuks2 B_ftlsuun B_ftlsuun2 B_ftlsuvm B_ftlsuvm2 B_mniclsu B_mniclsu2 B_mnlsuia B_mnlsuia2 B_mnlsuip B_mnlsuip2 B_mnlsuks B_mnlsuks2 B_mnlsuun B_mnlsuun2 B_mnlsuvm B_mnlsuvm2 B_mxiclsu B_mxiclsu2 B_mxlsuia B_mxlsuia2 B_mxlsuip B_mxlsuip2 B_mxlsuks B_mxlsuks2 B_mxlsuun B_mxlsuun2 B_mxlsuvm B_mxlsuvm2 B_npiclsu B_npiclsu2 B_nplsuia B_nplsuia2 B_nplsuip B_nplsuip2 B_nplsuks B_nplsuks2 B_nplsuun B_nplsuun2 B_nplsuvm B_nplsuvm2 B_siiclsu B_siiclsu2 B_silsuia B_silsuia2 B_silsuip B_silsuip2 B_silsuks B_silsuks2 B_silsuun B_silsuun2 B_silsuvm B_silsuvm2 E_iclsu E_iclsu2 E_lsuia E_lsuia2 E_lsuip E_lsuip2 E_lsuks E_lsuks2 E_lsuun E_lsuun2 E_lsuvm E_lsuvm2 sfpiclsu sfpiclsu2 sfplsuia sfplsuia2 sfplsuip sfplsuip2 sfplsuks sfplsuks2 sfplsuun sfplsuun2 sfplsuvm sfplsuvm2 TYP_iclsu TYP_iclsu2 TYP_lsuia TYP_lsuia2 TYP_lsuip TYP_lsuip2 TYP_lsuks TYP_lsuks2 TYP_lsuun TYP_lsuun2 TYP_lsuvm TYP_lsuvm2 Z_iclsu Z_iclsu2 Z_lsuia Z_lsuia2 Z_lsuip Z_lsuip2 Z_lsuks Z_lsuks2 Z_lsuun Z_lsuun2 Z_lsuvm Z_lsuvm2 /end OUT_MEASUREMENT
/end FUNCTION
/begin COMPU_METHOD B_TRUE "" TAB_VERB "%6.3" "" COMPU_TAB_REF B_TRUE /end COMPU_METHOD
/begin COMPU_VTAB B_TRUE "" TAB_VERB 2 0 "----" 1 "TRUE" /end COMPU_VTAB
/begin COMPU_METHOD dez "" RAT_FUNC "%6.2" "" COEFFS 0 1 0 0 0 1 /end COMPU_METHOD
/begin COMPU_METHOD default "" RAT_FUNC "%6.2" "" COEFFS 0 1 0 0 0 1 /end COMPU_METHOD
/begin RECORD_LAYOUT KwbUb FNC_VALUES 1 UBYTE COLUMN_DIR DIRECT /end RECORD_LAYOUT
/begin RECORD_LAYOUT KwbUw FNC_VALUES 1 UWORD COLUMN_DIR DIRECT /end RECORD_LAYOUT
/begin RECORD_LAYOUT KwUb FNC_VALUES 1 UBYTE COLUMN_DIR DIRECT /end RECORD_LAYOUT
/begin RECORD_LAYOUT KwUw FNC_VALUES 1 UWORD COLUMN_DIR DIRECT /end RECORD_LAYOUT
/end MODULE
/end PROJECT
