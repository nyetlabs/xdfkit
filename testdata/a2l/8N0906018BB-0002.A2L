ASAP2_VERSION 1 3
/begin PROJECT X505R_24d1_0 "4019.XX"
/begin HEADER "" VERSION "X505R_24d1_0" PROJECT_NO X505R_24d1_0 /end HEADER
/begin MODULE DIM ""
/begin MOD_COMMON "" BYTE_ORDER MSB_LAST ALIGNMENT_BYTE 1 ALIGNMENT_WORD 2 ALIGNMENT_LONG 2 /end MOD_COMMON
/begin CHARACTERISTIC ADCC_T_UM "Fehlerzeit bei zueinander unplausiblen ADC-Werten für sp1s" VALUE 0x814212 KwUb 2.550 t10msxs_ub_b2p55 0.00 2.550 FORMAT "%5.3" /end CHARACTERISTIC
/begin CHARACTERISTIC ADRONLOGIN "Logincode zum Aktivieren ADR" VALUE 0x815A6C KwUw 65535.00 dez 0.00 65535.00 FORMAT "%8.2" /end CHARACTERISTIC
/begin CHARACTERISTIC AGR_AOG "oberer Grenzwert Anpassung AGR-Rate" VALUE 0x8111FF KwUb 1.992 fak_ub_b2 0.00 1.992 FORMAT "%5.3" /end CHARACTERISTIC
/begin CHARACTERISTIC AGR_AUG "unterer Grenzwert Anpassung AGR-Rate" VALUE 0x811200 KwUb 1.992 fak_ub_b2 0.00 1.992 FORMAT "%5.3" /end CHARACTERISTIC
/begin CHARACTERISTIC ASRL_DAT_UC "" VAL_BLK 0x8117D9 KwbUb 99.61 rel_ub_q0p3906 0.00 99.61 FORMAT "%5.2" NUMBER 16 /end CHARACTERISTIC
/begin CHARACTERISTIC ASRS_DAT_UC "" VAL_BLK 0x8117E9 KwbUb 99.61 rel_ub_q0p3906 0.00 99.61 FORMAT "%5.2" NUMBER 16 /end CHARACTERISTIC
/begin CHARACTERISTIC AUSC_A_UM "zulässige Anzahl von Prüfungen auf nicht angezogenes Hauptrelais in %UMAUSC" VALUE 0x816B28 KwUw 65530.00 dez 5.000000 65535.00 FORMAT "%8.2" /end CHARACTERISTIC
/begin CHARACTERISTIC AUSGH_T_UM "Heilungszeit für Fehler in der zyklischen RAM-Prüfung der Funktionsüberwachung" VALUE 0x814216 KwUb 10200.0 t40ms_ub_b10200 0.00 10200.0 FORMAT "%7.1" /end CHARACTERISTIC
/begin CHARACTERISTIC AUSG_T_UM "Fehlertoleranzschwelle für zyklische RAM-Prüfung in der Funktionsüberwachung" VALUE 0x814217 KwUb 255.0 dezsub1 1.000 256.0 FORMAT "%5.1" /end CHARACTERISTIC
/begin CHARACTERISTIC AUSZH_T_UM "Heilungszeit für Fehler in der zyklischen ROM-Prüfung der Funktionsüberwachung" VALUE 0x814218 KwUb 10200.0 t40ms_ub_b10200 0.00 10200.0 FORMAT "%7.1" /end CHARACTERISTIC
/begin CHARACTERISTIC AUSZ_T_UM "Fehlertoleranzschwelle für zyklische ROM-Prüfung in der Funktionsüberwachung" VALUE 0x814219 KwUb 255.0 dezsub1 1.000 256.0 FORMAT "%5.1" /end CHARACTERISTIC
/begin CHARACTERISTIC BACC_T_UM "Fehlerentprellung: Fehler in Botschaftsabsicherung der ACC-Botschaft" VALUE 0x814003 KwUb 10200.0 t40ms_ub_b10200 0.00 10200.0 FORMAT "%7.1" /end CHARACTERISTIC
/begin CHARACTERISTIC BFGR_DAT_UC "" VAL_BLK 0x8117F9 KwbUb 255.0 dez 0.00 255.0 FORMAT "%5.1" NUMBER 16 /end CHARACTERISTIC
/begin CHARACTERISTIC BGRA_T_UM "Fehlerentprellung: Botschaftsfehler GRA" VALUE 0x814006 KwUb 10200.0 t40ms_ub_b10200 0.00 10200.0 FORMAT "%7.1" /end CHARACTERISTIC
/begin CHARACTERISTIC BNOMSR_DAT_UC "" VAL_BLK 0x811809 KwbUb 255.0 dez 0.00 255.0 FORMAT "%5.1" NUMBER 16 /end CHARACTERISTIC
/begin CHARACTERISTIC BRACC_T_UM "Entprellzeit für betätigte Bremse in der Funktionsüberwachung für ACC" VALUE 0x814007 KwUb 10200.0 t40ms_ub_b10200 0.00 10200.0 FORMAT "%7.1" /end CHARACTERISTIC
/begin CHARACTERISTIC BREMS_T_UM "Entprellzeit für betätigte Bremse in der Funktionsüberwachung" VALUE 0x814008 KwUb 10200.0 t40ms_ub_b10200 0.00 10200.0 FORMAT "%7.1" /end CHARACTERISTIC
/begin CHARACTERISTIC BRESP_T_UM "Entprellzeit für betätigte Bremse in der Funktionsüberw. (ext. Bremseingriff)" VALUE 0x814009 KwUb 10200.0 t40ms_ub_b10200 0.00 10200.0 FORMAT "%7.1" /end CHARACTERISTIC
/begin CHARACTERISTIC BZMSRA_DAT_UC "" VAL_BLK 0x811819 KwbUb 255.0 dez 0.00 255.0 FORMAT "%5.1" NUMBER 16 /end CHARACTERISTIC
/begin CHARACTERISTIC BZMSR_DAT_UC "" VAL_BLK 0x811829 KwbUb 255.0 dez 0.00 255.0 FORMAT "%5.1" NUMBER 16 /end CHARACTERISTIC
/begin CHARACTERISTIC BZ_MSR_UM "" VALUE 0x814077 KwUb 255.0 dez 0.00 255.0 FORMAT "%5.1" /end CHARACTERISTIC
/begin CHARACTERISTIC BZ_ST_DAT_UC "" VAL_BLK 0x811839 KwbUb 255.0 dez 0.00 255.0 FORMAT "%5.1" NUMBER 16 /end CHARACTERISTIC
/begin CHARACTERISTIC CBIT_DAT_UC "" VAL_BLK 0x811849 KwbUb 255.0 dez 0.00 255.0 FORMAT "%5.1" NUMBER 16 /end CHARACTERISTIC
/begin CHARACTERISTIC CMSR_DAT_UC "" VAL_BLK 0x811859 KwbUb 99.61 rel_ub_q0p3906 0.00 99.61 FORMAT "%5.2" NUMBER 16 /end CHARACTERISTIC
/begin CHARACTERISTIC CNSDEF "Codewort für Solldrehzahlumschaltung (Defaultwert)" VALUE 0x811201 KwUb 255.0 dez 0.00 255.0 FORMAT "%5.1" /end CHARACTERISTIC
/begin CHARACTERISTIC CNS_AOG "oberer Grenzwert Anpassung Codewort LL-Solldrehzahl-Umsch." VALUE 0x811202 KwUb 255.0 dez 0.00 255.0 FORMAT "%5.1" /end CHARACTERISTIC
/begin CHARACTERISTIC CNS_AUG "unterer Grenzwert Anpassung Codewort LL-Solldrehzahl-Umsch." VALUE 0x811203 KwUb 255.0 dez 0.00 255.0 FORMAT "%5.1" /end CHARACTERISTIC
/begin CHARACTERISTIC CWFA107 "Codewort Kurztripanforderungen Anzeigegruppe 107" VALUE 0x81E128 KwUw 65535.00 dez 0.00 65535.00 FORMAT "%8.2" /end CHARACTERISTIC
/begin CHARACTERISTIC CWFA107A "Ergänzung Codewort Kurztripanforderungen Anzeigegruppe 107" VALUE 0x81E12A KwUw 65535.00 dez 0.00 65535.00 FORMAT "%8.2" /end CHARACTERISTIC
/begin CHARACTERISTIC CWFA108 "Codewort Kurztripanforderungen Anzeigegruppe 108" VALUE 0x81E12C KwUw 65535.00 dez 0.00 65535.00 FORMAT "%8.2" /end CHARACTERISTIC
/begin CHARACTERISTIC CWFA108A "Ergänzung Codewort Kurztripanforderungen Anzeigegruppe 108" VALUE 0x81E12E KwUw 65535.00 dez 0.00 65535.00 FORMAT "%8.2" /end CHARACTERISTIC
/begin CHARACTERISTIC CWFA109 "Codewort Kurztripanforderungen Anzeigegruppe 109" VALUE 0x81E130 KwUw 65535.00 dez 0.00 65535.00 FORMAT "%8.2" /end CHARACTERISTIC
/begin CHARACTERISTIC CWFA109A "Ergänzung Codewort Kurztripanforderungen Anzeigegruppe 109" VALUE 0x81E132 KwUw 65535.00 dez 0.00 65535.00 FORMAT "%8.2" /end CHARACTERISTIC
/begin CHARACTERISTIC CWFA130 "Codewort Kurztripanforderungen Anzeigegruppe 130" VALUE 0x81E134 KwUw 65535.00 dez 0.00 65535.00 FORMAT "%8.2" /end CHARACTERISTIC
/begin CHARACTERISTIC CWFA130A "Ergänzung Codewort Kurztripanforderungen Anzeigegruppe 130" VALUE 0x81E136 KwUw 65535.00 dez 0.00 65535.00 FORMAT "%8.2" /end CHARACTERISTIC
/begin CHARACTERISTIC CWFA140 "Codewort Kurztripanforderungen Anzeigegruppe 140" VALUE 0x81E138 KwUw 65535.00 dez 0.00 65535.00 FORMAT "%8.2" /end CHARACTERISTIC
/begin CHARACTERISTIC CWFA140A "Ergänzung Codewort Kurztripanforderungen Anzeigegruppe 140" VALUE 0x81E13A KwUw 65535.00 dez 0.00 65535.00 FORMAT "%8.2" /end CHARACTERISTIC
/begin CHARACTERISTIC CWFA145 "Codewort Kurztripanforderungen Anzeigegruppe 145" VALUE 0x81E13C KwUw 65535.00 dez 0.00 65535.00 FORMAT "%8.2" /end CHARACTERISTIC
/begin CHARACTERISTIC CWFA145A "Ergänzung Codewort Kurztripanforderungen Anzeigegruppe 145" VALUE 0x81E13E KwUw 65535.00 dez 0.00 65535.00 FORMAT "%8.2" /end CHARACTERISTIC
/begin CHARACTERISTIC CWFA146 "Codewort Kurztripanforderungen Anzeigegruppe 146" VALUE 0x81E140 KwUw 65535.00 dez 0.00 65535.00 FORMAT "%8.2" /end CHARACTERISTIC
/begin CHARACTERISTIC CWFA146A "Ergänzung Codewort Kurztripanforderungen Anzeigegruppe 146" VALUE 0x81E142 KwUw 65535.00 dez 0.00 65535.00 FORMAT "%8.2" /end CHARACTERISTIC
/begin CHARACTERISTIC CWFA146B "Ergänzung Codewort B Kurztripanforderungen Anzeigegruppe 146" VALUE 0x81E144 KwUw 65535.00 dez 0.00 65535.00 FORMAT "%8.2" /end CHARACTERISTIC
/begin CHARACTERISTIC CWFA147 "Codewort Kurztripanforderungen Anzeigegruppe 147" VALUE 0x81E146 KwUw 65535.00 dez 0.00 65535.00 FORMAT "%8.2" /end CHARACTERISTIC
/begin CHARACTERISTIC CWFA147A "Ergänzung Codewort Kurztripanforderungen Anzeigegruppe 147" VALUE 0x81E148 KwUw 65535.00 dez 0.00 65535.00 FORMAT "%8.2" /end CHARACTERISTIC
/begin CHARACTERISTIC CWFA147B "Ergänzung Codewort B Kurztripanforderungen Anzeigegruppe 147" VALUE 0x81E14A KwUw 65535.00 dez 0.00 65535.00 FORMAT "%8.2" /end CHARACTERISTIC
/begin CHARACTERISTIC CWFA148 "Codewort Kurztripanforderungen Anzeigegruppe 148" VALUE 0x81E14C KwUw 65535.00 dez 0.00 65535.00 FORMAT "%8.2" /end CHARACTERISTIC
/begin CHARACTERISTIC CWFA148A "Ergänzung Codewort Kurztripanforderungen Anzeigegruppe 148" VALUE 0x81E14E KwUw 65535.00 dez 0.00 65535.00 FORMAT "%8.2" /end CHARACTERISTIC
/begin CHARACTERISTIC CWFA148B "Ergänzung Codewort B Kurztripanforderungen Anzeigegruppe 148" VALUE 0x81E150 KwUw 65535.00 dez 0.00 65535.00 FORMAT "%8.2" /end CHARACTERISTIC
/begin CHARACTERISTIC CWFA149 "Codewort Kurztripanforderungen Anzeigegruppe 149" VALUE 0x81E152 KwUw 65535.00 dez 0.00 65535.00 FORMAT "%8.2" /end CHARACTERISTIC
/begin CHARACTERISTIC CWFA149A "Ergänzung Codewort Kurztripanforderungen Anzeigegruppe 149" VALUE 0x81E154 KwUw 65535.00 dez 0.00 65535.00 FORMAT "%8.2" /end CHARACTERISTIC
/begin CHARACTERISTIC CWFA149B "Ergänzung Codewort B Kurztripanforderungen Anzeigegruppe 149" VALUE 0x81E156 KwUw 65535.00 dez 0.00 65535.00 FORMAT "%8.2" /end CHARACTERISTIC
/begin CHARACTERISTIC CWFA152 "Codewort Kurztripanforderungen Anzeigegruppe 152" VALUE 0x81E158 KwUw 65535.00 dez 0.00 65535.00 FORMAT "%8.2" /end CHARACTERISTIC
/begin CHARACTERISTIC CWFA152A "Ergänzung Codewort Kurztripanforderungen Anzeigegruppe 152" VALUE 0x81E15A KwUw 65535.00 dez 0.00 65535.00 FORMAT "%8.2" /end CHARACTERISTIC
/begin CHARACTERISTIC CWFA152B "Ergänzung Codewort B Kurztripanforderungen Anzeigegruppe 152" VALUE 0x81E15C KwUw 65535.00 dez 0.00 65535.00 FORMAT "%8.2" /end CHARACTERISTIC
/begin CHARACTERISTIC CWFA162 "Codewort Kurztripanforderungen Anzeigegruppe 162" VALUE 0x81E15E KwUw 65535.00 dez 0.00 65535.00 FORMAT "%8.2" /end CHARACTERISTIC
/begin CHARACTERISTIC CWFA162A "Ergänzung Codewort Kurztripanforderungen Anzeigegruppe 162" VALUE 0x81E160 KwUw 65535.00 dez 0.00 65535.00 FORMAT "%8.2" /end CHARACTERISTIC
/begin CHARACTERISTIC CWFA163 "Codewort Kurztripanforderungen Anzeigegruppe 163" VALUE 0x81E162 KwUw 65535.00 dez 0.00 65535.00 FORMAT "%8.2" /end CHARACTERISTIC
/begin CHARACTERISTIC CWFA163A "Ergänzung Codewort Kurztripanforderungen Anzeigegruppe 163" VALUE 0x81E164 KwUw 65535.00 dez 0.00 65535.00 FORMAT "%8.2" /end CHARACTERISTIC
/begin CHARACTERISTIC CWFA166 "Codewort Kurztripanforderungen Anzeigegruppe 166" VALUE 0x81E166 KwUw 65535.00 dez 0.00 65535.00 FORMAT "%8.2" /end CHARACTERISTIC
/begin CHARACTERISTIC CWFA166A "Ergänzung Codewort Kurztripanforderungen Anzeigegruppe 166" VALUE 0x81E168 KwUw 65535.00 dez 0.00 65535.00 FORMAT "%8.2" /end CHARACTERISTIC
/begin CHARACTERISTIC CWFA166B "Ergänzung Codewort B Kurztripanforderungen Anzeigegruppe 166" VALUE 0x81E16A KwUw 65535.00 dez 0.00 65535.00 FORMAT "%8.2" /end CHARACTERISTIC
/begin CHARACTERISTIC CWFA167 "Codewort Kurztripanforderungen Anzeigegruppe 167" VALUE 0x81E16C KwUw 65535.00 dez 0.00 65535.00 FORMAT "%8.2" /end CHARACTERISTIC
/begin CHARACTERISTIC CWFA167A "Ergänzung Codewort Kurztripanforderungen Anzeigegruppe 167" VALUE 0x81E16E KwUw 65535.00 dez 0.00 65535.00 FORMAT "%8.2" /end CHARACTERISTIC
/begin CHARACTERISTIC CWFA167B "Ergänzung Codewort B Kurztripanforderungen Anzeigegruppe 167" VALUE 0x81E170 KwUw 65535.00 dez 0.00 65535.00 FORMAT "%8.2" /end CHARACTERISTIC
/begin CHARACTERISTIC CWFA168 "Codewort Kurztripanforderungen Anzeigegruppe 168" VALUE 0x81E172 KwUw 65535.00 dez 0.00 65535.00 FORMAT "%8.2" /end CHARACTERISTIC
/begin CHARACTERISTIC CWFA168A "Ergänzung Codewort Kurztripanforderungen Anzeigegruppe 168" VALUE 0x81E174 KwUw 65535.00 dez 0.00 65535.00 FORMAT "%8.2" /end CHARACTERISTIC
/begin CHARACTERISTIC CWFA168B "Ergänzung Codewort B Kurztripanforderungen Anzeigegruppe 168" VALUE 0x81E176 KwUw 65535.00 dez 0.00 65535.00 FORMAT "%8.2" /end CHARACTERISTIC
/begin CHARACTERISTIC CWFA190 "Codewort Kurztripanforderungen Anzeigegruppe 190" VALUE 0x81E178 KwUw 65535.00 dez 0.00 65535.00 FORMAT "%8.2" /end CHARACTERISTIC
/begin CHARACTERISTIC CWFA190A "Ergänzung Codewort Kurztripanforderungen Anzeigegruppe 190" VALUE 0x81E17A KwUw 65535.00 dez 0.00 65535.00 FORMAT "%8.2" /end CHARACTERISTIC
/begin CHARACTERISTIC CWFA190B "Ergänzung Codewort B Kurztripanforderungen Anzeigegruppe 190" VALUE 0x81E17C KwUw 65535.00 dez 0.00 65535.00 FORMAT "%8.2" /end CHARACTERISTIC
/begin CHARACTERISTIC CWFA191 "Codewort Kurztripanforderungen Anzeigegruppe 191" VALUE 0x81E17E KwUw 65535.00 dez 0.00 65535.00 FORMAT "%8.2" /end CHARACTERISTIC
/begin CHARACTERISTIC CWFA191A "Ergänzung Codewort Kurztripanforderungen Anzeigegruppe 191" VALUE 0x81E180 KwUw 65535.00 dez 0.00 65535.00 FORMAT "%8.2" /end CHARACTERISTIC
/begin CHARACTERISTIC CWFA191B "Ergänzung Codewort B Kurztripanforderungen Anzeigegruppe 191" VALUE 0x81E182 KwUw 65535.00 dez 0.00 65535.00 FORMAT "%8.2" /end CHARACTERISTIC
/begin CHARACTERISTIC CWFA192 "Codewort Kurztripanforderungen Anzeigegruppe 192" VALUE 0x81E184 KwUw 65535.00 dez 0.00 65535.00 FORMAT "%8.2" /end CHARACTERISTIC
/begin CHARACTERISTIC CWFA192A "Ergänzung Codewort Kurztripanforderungen Anzeigegruppe 192" VALUE 0x81E186 KwUw 65535.00 dez 0.00 65535.00 FORMAT "%8.2" /end CHARACTERISTIC
/begin CHARACTERISTIC CWFA192B "Ergänzung Codewort B Kurztripanforderungen Anzeigegruppe 192" VALUE 0x81E188 KwUw 65535.00 dez 0.00 65535.00 FORMAT "%8.2" /end CHARACTERISTIC
/begin CHARACTERISTIC CWFA193 "Codewort Kurztripanforderungen Anzeigegruppe 193" VALUE 0x81E18A KwUw 65535.00 dez 0.00 65535.00 FORMAT "%8.2" /end CHARACTERISTIC
/begin CHARACTERISTIC CWFA193A "Ergänzung Codewort Kurztripanforderungen Anzeigegruppe 193" VALUE 0x81E18C KwUw 65535.00 dez 0.00 65535.00 FORMAT "%8.2" /end CHARACTERISTIC
/begin CHARACTERISTIC CWFA193B "Ergänzung Codewort B Kurztripanforderungen Anzeigegruppe 193" VALUE 0x81E18E KwUw 65535.00 dez 0.00 65535.00 FORMAT "%8.2" /end CHARACTERISTIC
/begin CHARACTERISTIC CWFA194 "Codewort Kurztripanforderungen Anzeigegruppe 194" VALUE 0x81E190 KwUw 65535.00 dez 0.00 65535.00 FORMAT "%8.2" /end CHARACTERISTIC
/begin CHARACTERISTIC CWFA194A "Ergänzung Codewort Kurztripanforderungen Anzeigegruppe 194" VALUE 0x81E192 KwUw 65535.00 dez 0.00 65535.00 FORMAT "%8.2" /end CHARACTERISTIC
/begin CHARACTERISTIC CWFA194B "Ergänzung Codewort B Kurztripanforderungen Anzeigegruppe 194" VALUE 0x81E194 KwUw 65535.00 dez 0.00 65535.00 FORMAT "%8.2" /end CHARACTERISTIC
/begin CHARACTERISTIC CWFA195 "Codewort Kurztripanforderungen Anzeigegruppe 195" VALUE 0x81E196 KwUw 65535.00 dez 0.00 65535.00 FORMAT "%8.2" /end CHARACTERISTIC
/begin CHARACTERISTIC CWFA195A "Ergänzung Codewort Kurztripanforderungen Anzeigegruppe 195" VALUE 0x81E198 KwUw 65535.00 dez 0.00 65535.00 FORMAT "%8.2" /end CHARACTERISTIC
/begin CHARACTERISTIC CWFA195B "Ergänzung Codewort B Kurztripanforderungen Anzeigegruppe 195" VALUE 0x81E19A KwUw 65535.00 dez 0.00 65535.00 FORMAT "%8.2" /end CHARACTERISTIC
/begin CHARACTERISTIC CWFA196 "Codewort Kurztripanforderungen Anzeigegruppe 196" VALUE 0x81E19C KwUw 65535.00 dez 0.00 65535.00 FORMAT "%8.2" /end CHARACTERISTIC
/begin CHARACTERISTIC CWFA196A "Ergänzung Codewort Kurztripanforderungen Anzeigegruppe 196" VALUE 0x81E19E KwUw 65535.00 dez 0.00 65535.00 FORMAT "%8.2" /end CHARACTERISTIC
/begin CHARACTERISTIC CWFA196B "Ergänzung Codewort B Kurztripanforderungen Anzeigegruppe 196" VALUE 0x81E1A0 KwUw 65535.00 dez 0.00 65535.00 FORMAT "%8.2" /end CHARACTERISTIC
/begin CHARACTERISTIC CWFA197 "Codewort Kurztripanforderungen Anzeigegruppe 197" VALUE 0x81E1A2 KwUw 65535.00 dez 0.00 65535.00 FORMAT "%8.2" /end CHARACTERISTIC
/begin CHARACTERISTIC CWFA197A "Ergänzung Codewort Kurztripanforderungen Anzeigegruppe 197" VALUE 0x81E1A4 KwUw 65535.00 dez 0.00 65535.00 FORMAT "%8.2" /end CHARACTERISTIC
/begin CHARACTERISTIC CWFA197B "Ergänzung Codewort B Kurztripanforderungen Anzeigegruppe 197" VALUE 0x81E1A6 KwUw 65535.00 dez 0.00 65535.00 FORMAT "%8.2" /end CHARACTERISTIC
/begin CHARACTERISTIC CWFA198 "Codewort Kurztripanforderungen Anzeigegruppe 198" VALUE 0x81E1A8 KwUw 65535.00 dez 0.00 65535.00 FORMAT "%8.2" /end CHARACTERISTIC
/begin CHARACTERISTIC CWFA198A "Ergänzung Codewort Kurztripanforderungen Anzeigegruppe 198" VALUE 0x81E1AA KwUw 65535.00 dez 0.00 65535.00 FORMAT "%8.2" /end CHARACTERISTIC
/begin CHARACTERISTIC CWFA198B "Ergänzung Codewort B Kurztripanforderungen Anzeigegruppe 198" VALUE 0x81E1AC KwUw 65535.00 dez 0.00 65535.00 FORMAT "%8.2" /end CHARACTERISTIC
/begin CHARACTERISTIC CWFA199 "Codewort Kurztripanforderungen Anzeigegruppe 199" VALUE 0x81E1AE KwUw 65535.00 dez 0.00 65535.00 FORMAT "%8.2" /end CHARACTERISTIC
/begin CHARACTERISTIC CWFA199A "Ergänzung Codewort Kurztripanforderungen Anzeigegruppe 199" VALUE 0x81E1B0 KwUw 65535.00 dez 0.00 65535.00 FORMAT "%8.2" /end CHARACTERISTIC
/begin CHARACTERISTIC CWFA199B "Ergänzung Codewort B Kurztripanforderungen Anzeigegruppe 199" VALUE 0x81E1B2 KwUw 65535.00 dez 0.00 65535.00 FORMAT "%8.2" /end CHARACTERISTIC
/begin CHARACTERISTIC CWFA201 "Codewort Kurztripanforderung Anzeigegruppe 201" VALUE 0x81E1B4 KwUw 65535.00 dez 0.00 65535.00 FORMAT "%8.2" /end CHARACTERISTIC
/begin CHARACTERISTIC CWFA201A "Ergänzung Codewort Kurztripanforderungen Anzeigegruppe 201" VALUE 0x81E1B6 KwUw 65535.00 dez 0.00 65535.00 FORMAT "%8.2" /end CHARACTERISTIC
/begin CHARACTERISTIC CWFA201B "Ergänzung Codewort B Kurztripanforderungen Anzeigegruppe 201" VALUE 0x81E1B8 KwUw 65535.00 dez 0.00 65535.00 FORMAT "%8.2" /end CHARACTERISTIC
/begin CHARACTERISTIC CWFA202 "Codewort Kurztripanforderung Anzeigegruppe 202" VALUE 0x81E1BA KwUw 65535.00 dez 0.00 65535.00 FORMAT "%8.2" /end CHARACTERISTIC
/begin CHARACTERISTIC CWFA202A "Ergänzung Codewort Kurztripanforderungen Anzeigegruppe 202" VALUE 0x81E1BC KwUw 65535.00 dez 0.00 65535.00 FORMAT "%8.2" /end CHARACTERISTIC
/begin CHARACTERISTIC CWFA202B "Ergänzung Codewort B Kurztripanforderungen Anzeigegruppe 202" VALUE 0x81E1BE KwUw 65535.00 dez 0.00 65535.00 FORMAT "%8.2" /end CHARACTERISTIC
/begin CHARACTERISTIC CWFA203 "Codewort Kurztripanforderung Anzeigegruppe 203" VALUE 0x81E1C0 KwUw 65535.00 dez 0.00 65535.00 FORMAT "%8.2" /end CHARACTERISTIC
/begin CHARACTERISTIC CWFA203A "Ergänzung Codewort Kurztripanforderungen Anzeigegruppe 203" VALUE 0x81E1C2 KwUw 65535.00 dez 0.00 65535.00 FORMAT "%8.2" /end CHARACTERISTIC
/begin CHARACTERISTIC CWFA203B "Ergänzung Codewort B Kurztripanforderungen Anzeigegruppe 203" VALUE 0x81E1C4 KwUw 65535.00 dez 0.00 65535.00 FORMAT "%8.2" /end CHARACTERISTIC
/begin CHARACTERISTIC CWFA204 "Codewort Kurztripanforderung Anzeigegruppe 204" VALUE 0x81E1C6 KwUw 65535.00 dez 0.00 65535.00 FORMAT "%8.2" /end CHARACTERISTIC
/begin CHARACTERISTIC CWFA204A "Ergänzung Codewort Kurztripanforderungen Anzeigegruppe 204" VALUE 0x81E1C8 KwUw 65535.00 dez 0.00 65535.00 FORMAT "%8.2" /end CHARACTERISTIC
/begin CHARACTERISTIC CWFA204B "Ergänzung Codewort B Kurztripanforderungen Anzeigegruppe 204" VALUE 0x81E1CA KwUw 65535.00 dez 0.00 65535.00 FORMAT "%8.2" /end CHARACTERISTIC
/begin CHARACTERISTIC CWFA205 "Codewort Kurztripanforderung Anzeigegruppe 205" VALUE 0x81E1CC KwUw 65535.00 dez 0.00 65535.00 FORMAT "%8.2" /end CHARACTERISTIC
/begin CHARACTERISTIC CWFA205A "Ergänzung Codewort Kurztripanforderungen Anzeigegruppe 205" VALUE 0x81E1CE KwUw 65535.00 dez 0.00 65535.00 FORMAT "%8.2" /end CHARACTERISTIC
/begin CHARACTERISTIC CWFA205B "Ergänzung Codewort B Kurztripanforderungen Anzeigegruppe 205" VALUE 0x81E1D0 KwUw 65535.00 dez 0.00 65535.00 FORMAT "%8.2" /end CHARACTERISTIC
/begin CHARACTERISTIC CWFA206 "Codewort Kurztripanforderung Anzeigegruppe 206" VALUE 0x81E1D2 KwUw 65535.00 dez 0.00 65535.00 FORMAT "%8.2" /end CHARACTERISTIC
/begin CHARACTERISTIC CWFA206A "Ergänzung Codewort Kurztripanforderungen Anzeigegruppe 206" VALUE 0x81E1D4 KwUw 65535.00 dez 0.00 65535.00 FORMAT "%8.2" /end CHARACTERISTIC
/begin CHARACTERISTIC CWFA206B "Ergänzung Codewort B Kurztripanforderungen Anzeigegruppe 206" VALUE 0x81E1D6 KwUw 65535.00 dez 0.00 65535.00 FORMAT "%8.2" /end CHARACTERISTIC
/begin CHARACTERISTIC CWFA207 "Codewort Kurztripanforderung Anzeigegruppe 207" VALUE 0x81E1D8 KwUw 65535.00 dez 0.00 65535.00 FORMAT "%8.2" /end CHARACTERISTIC
/begin CHARACTERISTIC CWFA207A "Ergänzung Codewort Kurztripanforderungen Anzeigegruppe 207" VALUE 0x81E1DA KwUw 65535.00 dez 0.00 65535.00 FORMAT "%8.2" /end CHARACTERISTIC
/begin CHARACTERISTIC CWFA207B "Ergänzung Codewort B Kurztripanforderungen Anzeigegruppe 207" VALUE 0x81E1DC KwUw 65535.00 dez 0.00 65535.00 FORMAT "%8.2" /end CHARACTERISTIC
/begin CHARACTERISTIC CWFA208 "Codewort Kurztripanforderung Anzeigegruppe 208" VALUE 0x81E1DE KwUw 65535.00 dez 0.00 65535.00 FORMAT "%8.2" /end CHARACTERISTIC
/begin CHARACTERISTIC CWFA208A "Ergänzung Codewort Kurztripanforderungen Anzeigegruppe 208" VALUE 0x81E1E0 KwUw 65535.00 dez 0.00 65535.00 FORMAT "%8.2" /end CHARACTERISTIC
/begin CHARACTERISTIC CWFA208B "Ergänzung Codewort B Kurztripanforderungen Anzeigegruppe 208" VALUE 0x81E1E2 KwUw 65535.00 dez 0.00 65535.00 FORMAT "%8.2" /end CHARACTERISTIC
/begin CHARACTERISTIC CWFA209 "Codewort Kurztripanforderung Anzeigegruppe 209" VALUE 0x81E1E4 KwUw 65535.00 dez 0.00 65535.00 FORMAT "%8.2" /end CHARACTERISTIC
/begin CHARACTERISTIC CWFA209A "Ergänzung Codewort Kurztripanforderungen Anzeigegruppe 209" VALUE 0x81E1E6 KwUw 65535.00 dez 0.00 65535.00 FORMAT "%8.2" /end CHARACTERISTIC
/begin CHARACTERISTIC CWFA209B "Ergänzung Codewort B Kurztripanforderungen Anzeigegruppe 209" VALUE 0x81E1E8 KwUw 65535.00 dez 0.00 65535.00 FORMAT "%8.2" /end CHARACTERISTIC
/begin CHARACTERISTIC CWFA210 "Codewort Kurztripanforderung Anzeigegruppe 210" VALUE 0x81E1EA KwUw 65535.00 dez 0.00 65535.00 FORMAT "%8.2" /end CHARACTERISTIC
/begin CHARACTERISTIC CWFA210A "Ergänzung Codewort Kurztripanforderungen Anzeigegruppe 210" VALUE 0x81E1EC KwUw 65535.00 dez 0.00 65535.00 FORMAT "%8.2" /end CHARACTERISTIC
/begin CHARACTERISTIC CWFA210B "Ergänzung Codewort B Kurztripanforderungen Anzeigegruppe 210" VALUE 0x81E1EE KwUw 65535.00 dez 0.00 65535.00 FORMAT "%8.2" /end CHARACTERISTIC
/begin CHARACTERISTIC CWFA211 "Codewort Kurztripanforderung Anzeigegruppe 211" VALUE 0x81E1F0 KwUw 65535.00 dez 0.00 65535.00 FORMAT "%8.2" /end CHARACTERISTIC
/begin CHARACTERISTIC CWFA211A "Ergänzung Codewort Kurztripanforderungen Anzeigegruppe 211" VALUE 0x81E1F2 KwUw 65535.00 dez 0.00 65535.00 FORMAT "%8.2" /end CHARACTERISTIC
/begin CHARACTERISTIC CWFA211B "Ergänzung Codewort B Kurztripanforderungen Anzeigegruppe 211" VALUE 0x81E1F4 KwUw 65535.00 dez 0.00 65535.00 FORMAT "%8.2" /end CHARACTERISTIC
/begin CHARACTERISTIC CWFA212 "Codewort Kurztripanforderung Anzeigegruppe 212" VALUE 0x81E1F6 KwUw 65535.00 dez 0.00 65535.00 FORMAT "%8.2" /end CHARACTERISTIC
/begin CHARACTERISTIC CWFA212A "Ergänzung Codewort Kurztripanforderungen Anzeigegruppe 212" VALUE 0x81E1F8 KwUw 65535.00 dez 0.00 65535.00 FORMAT "%8.2" /end CHARACTERISTIC
/begin CHARACTERISTIC CWFA212B "Ergänzung Codewort B Kurztripanforderungen Anzeigegruppe 212" VALUE 0x81E1FA KwUw 65535.00 dez 0.00 65535.00 FORMAT "%8.2" /end CHARACTERISTIC
/begin CHARACTERISTIC CWFA213 "Codewort Kurtripanforderung Anzeigegruppe 213" VALUE 0x81E1FC KwUw 65535.00 dez 0.00 65535.00 FORMAT "%8.2" /end CHARACTERISTIC
/begin CHARACTERISTIC CWFA213A "Ergänzung Codewort Kurztripanforderungen Anzeigegruppe 213" VALUE 0x81E1FE KwUw 65535.00 dez 0.00 65535.00 FORMAT "%8.2" /end CHARACTERISTIC
/begin CHARACTERISTIC CWFA213B "Ergänzung Codewort B Kurztripanforderungen Anzeigegruppe 213" VALUE 0x81E200 KwUw 65535.00 dez 0.00 65535.00 FORMAT "%8.2" /end CHARACTERISTIC
/begin CHARACTERISTIC CWFA214 "Codewort Kurztripanforderung Anzeigegruppe 214" VALUE 0x81E202 KwUw 65535.00 dez 0.00 65535.00 FORMAT "%8.2" /end CHARACTERISTIC
/begin CHARACTERISTIC CWFA214A "Ergänzung Codewort Kurztripanforderungen Anzeigegruppe 214" VALUE 0x81E204 KwUw 65535.00 dez 0.00 65535.00 FORMAT "%8.2" /end CHARACTERISTIC
/begin CHARACTERISTIC CWFA214B "Ergänzung Codewort B Kurztripanforderungen Anzeigegruppe 214" VALUE 0x81E206 KwUw 65535.00 dez 0.00 65535.00 FORMAT "%8.2" /end CHARACTERISTIC
/begin CHARACTERISTIC CWFA215 "Codewort Kurztripanforderung Anzeigegruppe 215" VALUE 0x81E208 KwUw 65535.00 dez 0.00 65535.00 FORMAT "%8.2" /end CHARACTERISTIC
/begin CHARACTERISTIC CWFA215A "Ergänzung Codewort Kurztripanforderungen Anzeigegruppe 215" VALUE 0x81E20A KwUw 65535.00 dez 0.00 65535.00 FORMAT "%8.2" /end CHARACTERISTIC
/begin CHARACTERISTIC CWFA215B "Ergänzung Codewort B Kurztripanforderungen Anzeigegruppe 215" VALUE 0x81E20C KwUw 65535.00 dez 0.00 65535.00 FORMAT "%8.2" /end CHARACTERISTIC
/begin CHARACTERISTIC CWFA216 "Codewort Kurztripanforderung Anzeigegruppe 216" VALUE 0x81E20E KwUw 65535.00 dez 0.00 65535.00 FORMAT "%8.2" /end CHARACTERISTIC
/begin CHARACTERISTIC CWFA216A "Ergänzung Codewort Kurztripanforderungen Anzeigegruppe 216" VALUE 0x81E210 KwUw 65535.00 dez 0.00 65535.00 FORMAT "%8.2" /end CHARACTERISTIC
/begin CHARACTERISTIC CWFA216B "Ergänzung Codewort B Kurztripanforderungen Anzeigegruppe 216" VALUE 0x81E212 KwUw 65535.00 dez 0.00 65535.00 FORMAT "%8.2" /end CHARACTERISTIC
/begin CHARACTERISTIC CWFA217 "Codewort Kurztripanforderung Anzeigegruppe 217" VALUE 0x81E214 KwUw 65535.00 dez 0.00 65535.00 FORMAT "%8.2" /end CHARACTERISTIC
/begin CHARACTERISTIC CWFA217A "Ergänzung Codewort Kurztripanforderungen Anzeigegruppe 217" VALUE 0x81E216 KwUw 65535.00 dez 0.00 65535.00 FORMAT "%8.2" /end CHARACTERISTIC
/begin CHARACTERISTIC CWFA217B "Ergänzung Codewort B Kurztripanforderungen Anzeigegruppe 217" VALUE 0x81E218 KwUw 65535.00 dez 0.00 65535.00 FORMAT "%8.2" /end CHARACTERISTIC
/begin CHARACTERISTIC CWFA218 "Codewort Kurztripanforderung Anzeigegruppe 218" VALUE 0x81E21A KwUw 65535.00 dez 0.00 65535.00 FORMAT "%8.2" /end CHARACTERISTIC
/begin CHARACTERISTIC CWFA218A "Ergänzung Codewort Kurztripanforderungen Anzeigegruppe 218" VALUE 0x81E21C KwUw 65535.00 dez 0.00 65535.00 FORMAT "%8.2" /end CHARACTERISTIC
/begin CHARACTERISTIC CWFA218B "Ergänzung Codewort B Kurztripanforderungen Anzeigegruppe 218" VALUE 0x81E21E KwUw 65535.00 dez 0.00 65535.00 FORMAT "%8.2" /end CHARACTERISTIC
/begin CHARACTERISTIC CWFA219 "Codewort Kurztripanforderung Anzeigegruppe 219" VALUE 0x81E220 KwUw 65535.00 dez 0.00 65535.00 FORMAT "%8.2" /end CHARACTERISTIC
/begin CHARACTERISTIC CWFA219A "Ergänzung Codewort Kurztripanforderungen Anzeigegruppe 219" VALUE 0x81E222 KwUw 65535.00 dez 0.00 65535.00 FORMAT "%8.2" /end CHARACTERISTIC
/begin CHARACTERISTIC CWFA219B "Ergänzung Codewort B Kurztripanforderungen Anzeigegruppe 219" VALUE 0x81E224 KwUw 65535.00 dez 0.00 65535.00 FORMAT "%8.2" /end CHARACTERISTIC
/begin CHARACTERISTIC CWFA220 "Codewort Kurztripanforderung Anzeigegruppe 220" VALUE 0x81E226 KwUw 65535.00 dez 0.00 65535.00 FORMAT "%8.2" /end CHARACTERISTIC
/begin CHARACTERISTIC CWFA220A "Ergänzung Codewort Kurztripanforderung Anzeigegruppe 220A" VALUE 0x81E228 KwUw 65535.00 dez 0.00 65535.00 FORMAT "%8.2" /end CHARACTERISTIC
/begin CHARACTERISTIC CWFA220B "Ergänzung Codewort B Kurztripanforderungen Anzeigegruppe 220" VALUE 0x81E22A KwUw 65535.00 dez 0.00 65535.00 FORMAT "%8.2" /end CHARACTERISTIC
/begin CHARACTERISTIC CWFA221 "Codewort Kurztripanforderung Anzeigegruppe 221" VALUE 0x81E22C KwUw 65535.00 dez 0.00 65535.00 FORMAT "%8.2" /end CHARACTERISTIC
/begin CHARACTERISTIC CWFA221A "Ergänzung Codewort Kurztripanforderung Anzeigegruppe 2221A" VALUE 0x81E22E KwUw 65535.00 dez 0.00 65535.00 FORMAT "%8.2" /end CHARACTERISTIC
/begin CHARACTERISTIC CWFA221B "Ergänzung Codewort B Kurztripanforderungen Anzeigegruppe 221" VALUE 0x81E230 KwUw 65535.00 dez 0.00 65535.00 FORMAT "%8.2" /end CHARACTERISTIC
/begin CHARACTERISTIC CWFA222 "Codewort Kurztripanforderung Anzeigegruppe 222" VALUE 0x81E232 KwUw 65535.00 dez 0.00 65535.00 FORMAT "%8.2" /end CHARACTERISTIC
/begin CHARACTERISTIC CWFA222A "Ergänzung Codewort Kurztripanforderung Anzeigegruppe 222A" VALUE 0x81E234 KwUw 65535.00 dez 0.00 65535.00 FORMAT "%8.2" /end CHARACTERISTIC
/begin CHARACTERISTIC CWFA222B "Ergänzung Codewort B Kurztripanforderungen Anzeigegruppe 222" VALUE 0x81E236 KwUw 65535.00 dez 0.00 65535.00 FORMAT "%8.2" /end CHARACTERISTIC
/begin CHARACTERISTIC CWFA223 "Codewort Kurztripanforderung Anzeigegruppe 223" VALUE 0x81E238 KwUw 65535.00 dez 0.00 65535.00 FORMAT "%8.2" /end CHARACTERISTIC
/begin CHARACTERISTIC CWFA223A "Ergänzung Codewort Kurztripanforderung Anzeigegruppe 223A" VALUE 0x81E23A KwUw 65535.00 dez 0.00 65535.00 FORMAT "%8.2" /end CHARACTERISTIC
/begin CHARACTERISTIC CWFA223B "Ergänzung Codewort B Kurztripanforderungen Anzeigegruppe 223" VALUE 0x81E23C KwUw 65535.00 dez 0.00 65535.00 FORMAT "%8.2" /end CHARACTERISTIC
/begin CHARACTERISTIC CWFA224 "Codewort Kurztripanforderung Anzeigegruppe 224" VALUE 0x81E23E KwUw 65535.00 dez 0.00 65535.00 FORMAT "%8.2" /end CHARACTERISTIC
/begin CHARACTERISTIC CWFA224A "Ergänzung Codewort Kurztripanforderung Anzeigegruppe 224A" VALUE 0x81E240 KwUw 65535.00 dez 0.00 65535.00 FORMAT "%8.2" /end CHARACTERISTIC
/begin CHARACTERISTIC CWFA224B "Ergänzung Codewort B Kurztripanforderungen Anzeigegruppe 224" VALUE 0x81E242 KwUw 65535.00 dez 0.00 65535.00 FORMAT "%8.2" /end CHARACTERISTIC
/begin CHARACTERISTIC CWFA225 "Codewort Kurztripanforderung Anzeigegruppe 225" VALUE 0x81E244 KwUw 65535.00 dez 0.00 65535.00 FORMAT "%8.2" /end CHARACTERISTIC
/begin CHARACTERISTIC CWFA225A "Ergänzung Codewort Kurztripanforderung Anzeigegruppe 225A" VALUE 0x81E246 KwUw 65535.00 dez 0.00 65535.00 FORMAT "%8.2" /end CHARACTERISTIC
/begin CHARACTERISTIC CWFA225B "Ergänzung Codewort B Kurztripanforderungen Anzeigegruppe 225" VALUE 0x81E248 KwUw 65535.00 dez 0.00 65535.00 FORMAT "%8.2" /end CHARACTERISTIC
/begin CHARACTERISTIC CWFA226 "Codewort Kurztripanforderung Anzeigegruppe 226" VALUE 0x81E24A KwUw 65535.00 dez 0.00 65535.00 FORMAT "%8.2" /end CHARACTERISTIC
/begin CHARACTERISTIC CWFA226A "Ergänzung Codewort Kurztripanforderung Anzeigegruppe 226A" VALUE 0x81E24C KwUw 65535.00 dez 0.00 65535.00 FORMAT "%8.2" /end CHARACTERISTIC
/begin CHARACTERISTIC CWFA226B "Ergänzung Codewort B Kurztripanforderungen Anzeigegruppe 226" VALUE 0x81E24E KwUw 65535.00 dez 0.00 65535.00 FORMAT "%8.2" /end CHARACTERISTIC
/begin CHARACTERISTIC CWFA227 "Codewort Kurztripanforderung Anzeigegruppe 227" VALUE 0x81E250 KwUw 65535.00 dez 0.00 65535.00 FORMAT "%8.2" /end CHARACTERISTIC
/begin CHARACTERISTIC CWFA227A "Ergänzung Codewort Kurztripanforderung Anzeigegruppe 227A" VALUE 0x81E252 KwUw 65535.00 dez 0.00 65535.00 FORMAT "%8.2" /end CHARACTERISTIC
/begin CHARACTERISTIC CWFA227B "Ergänzung Codewort B Kurztripanforderungen Anzeigegruppe 227" VALUE 0x81E254 KwUw 65535.00 dez 0.00 65535.00 FORMAT "%8.2" /end CHARACTERISTIC
/begin CHARACTERISTIC CWFA228 "Codewort Kurztripanforderung Anzeigegruppe 228" VALUE 0x81E256 KwUw 65535.00 dez 0.00 65535.00 FORMAT "%8.2" /end CHARACTERISTIC
/begin CHARACTERISTIC CWFA228A "Ergänzung Codewort Kurztripanforderung Anzeigegruppe 228A" VALUE 0x81E258 KwUw 65535.00 dez 0.00 65535.00 FORMAT "%8.2" /end CHARACTERISTIC
/begin CHARACTERISTIC CWFA228B "Ergänzung Codewort B Kurztripanforderungen Anzeigegruppe 228" VALUE 0x81E25A KwUw 65535.00 dez 0.00 65535.00 FORMAT "%8.2" /end CHARACTERISTIC
/begin CHARACTERISTIC CWFA229 "Codewort Kurztripanforderung Anzeigegruppe 229" VALUE 0x81E25C KwUw 65535.00 dez 0.00 65535.00 FORMAT "%8.2" /end CHARACTERISTIC
/begin CHARACTERISTIC CWFA229A "Ergänzung Codewort Kurztripanforderung Anzeigegruppe 229A" VALUE 0x81E25E KwUw 65535.00 dez 0.00 65535.00 FORMAT "%8.2" /end CHARACTERISTIC
/begin CHARACTERISTIC CWFA229B "Ergänzung Codewort B Kurztripanforderungen Anzeigegruppe 229" VALUE 0x81E260 KwUw 65535.00 dez 0.00 65535.00 FORMAT "%8.2" /end CHARACTERISTIC
/begin CHARACTERISTIC CWFA230 "Codewort Kurztripanforderung Anzeigegruppe 230" VALUE 0x81E262 KwUw 65535.00 dez 0.00 65535.00 FORMAT "%8.2" /end CHARACTERISTIC
/begin CHARACTERISTIC CWFA230A "Ergänzung Codewort Kurztripanforderung Anzeigegruppe 230A" VALUE 0x81E264 KwUw 65535.00 dez 0.00 65535.00 FORMAT "%8.2" /end CHARACTERISTIC
/begin CHARACTERISTIC CWFA230B "Ergänzung Codewort B Kurztripanforderungen Anzeigegruppe 230" VALUE 0x81E266 KwUw 65535.00 dez 0.00 65535.00 FORMAT "%8.2" /end CHARACTERISTIC
/begin CHARACTERISTIC CWFA231 "Codewort Kurztripanforderung Anzeigegruppe 231" VALUE 0x81E268 KwUw 65535.00 dez 0.00 65535.00 FORMAT "%8.2" /end CHARACTERISTIC
/begin CHARACTERISTIC CWFA231A "Ergänzung Codewort Kurztripanforderung Anzeigegruppe 231A" VALUE 0x81E26A KwUw 65535.00 dez 0.00 65535.00 FORMAT "%8.2" /end CHARACTERISTIC
/begin CHARACTERISTIC CWFA231B "Ergänzung Codewort B Kurztripanforderungen Anzeigegruppe 231" VALUE 0x81E26C KwUw 65535.00 dez 0.00 65535.00 FORMAT "%8.2" /end CHARACTERISTIC
/begin CHARACTERISTIC CWFA232 "Codewort Kurztripanforderung Anzeigegruppe 232" VALUE 0x81E26E KwUw 65535.00 dez 0.00 65535.00 FORMAT "%8.2" /end CHARACTERISTIC
/begin CHARACTERISTIC CWFA232A "Ergänzung Codewort Kurztripanforderung Anzeigegruppe 232A" VALUE 0x81E270 KwUw 65535.00 dez 0.00 65535.00 FORMAT "%8.2" /end CHARACTERISTIC
/begin CHARACTERISTIC CWFA232B "Ergänzung Codewort B Kurztripanforderungen Anzeigegruppe 232" VALUE 0x81E272 KwUw 65535.00 dez 0.00 65535.00 FORMAT "%8.2" /end CHARACTERISTIC
/begin CHARACTERISTIC CWFA233 "Codewort Kurztripanforderung Anzeigegruppe 233" VALUE 0x81E274 KwUw 65535.00 dez 0.00 65535.00 FORMAT "%8.2" /end CHARACTERISTIC
/begin CHARACTERISTIC CWFA233A "Ergänzung Codewort Kurztripanforderung Anzeigegruppe 233A" VALUE 0x81E276 KwUw 65535.00 dez 0.00 65535.00 FORMAT "%8.2" /end CHARACTERISTIC
/begin CHARACTERISTIC CWFA233B "Ergänzung Codewort B Kurztripanforderungen Anzeigegruppe 233" VALUE 0x81E278 KwUw 65535.00 dez 0.00 65535.00 FORMAT "%8.2" /end CHARACTERISTIC
/begin CHARACTERISTIC CWFA234 "Codewort Kurztripanforderung Anzeigegruppe 234" VALUE 0x81E27A KwUw 65535.00 dez 0.00 65535.00 FORMAT "%8.2" /end CHARACTERISTIC
/begin CHARACTERISTIC CWFA234A "Ergänzung Codewort Kurztripanforderung Anzeigegruppe 234A" VALUE 0x81E27C KwUw 65535.00 dez 0.00 65535.00 FORMAT "%8.2" /end CHARACTERISTIC
/begin CHARACTERISTIC CWFA234B "Ergänzung Codewort B Kurztripanforderungen Anzeigegruppe 234" VALUE 0x81E27E KwUw 65535.00 dez 0.00 65535.00 FORMAT "%8.2" /end CHARACTERISTIC
/begin CHARACTERISTIC CWFA235 "Codewort Kurztripanforderung Anzeigegruppe 235" VALUE 0x81E280 KwUw 65535.00 dez 0.00 65535.00 FORMAT "%8.2" /end CHARACTERISTIC
/begin CHARACTERISTIC CWFA235A "Ergänzung Codewort Kurztripanforderung Anzeigegruppe 235A" VALUE 0x81E282 KwUw 65535.00 dez 0.00 65535.00 FORMAT "%8.2" /end CHARACTERISTIC
/begin CHARACTERISTIC CWFA235B "Ergänzung Codewort B Kurztripanforderungen Anzeigegruppe 235" VALUE 0x81E284 KwUw 65535.00 dez 0.00 65535.00 FORMAT "%8.2" /end CHARACTERISTIC
/begin CHARACTERISTIC CWFA236 "Codewort Kurztripanforderung Anzeigegruppe 236" VALUE 0x81E286 KwUw 65535.00 dez 0.00 65535.00 FORMAT "%8.2" /end CHARACTERISTIC
/begin CHARACTERISTIC CWFA236A "Ergänzung Codewort Kurztripanforderung Anzeigegruppe 236A" VALUE 0x81E288 KwUw 65535.00 dez 0.00 65535.00 FORMAT "%8.2" /end CHARACTERISTIC
/begin CHARACTERISTIC CWFA236B "Ergänzung Codewort B Kurztripanforderungen Anzeigegruppe 236" VALUE 0x81E28A KwUw 65535.00 dez 0.00 65535.00 FORMAT "%8.2" /end CHARACTERISTIC
/begin CHARACTERISTIC CWFA237 "Codewort Kurztripanforderung Anzeigegruppe 237" VALUE 0x81E28C KwUw 65535.00 dez 0.00 65535.00 FORMAT "%8.2" /end CHARACTERISTIC
/begin CHARACTERISTIC CWFA237A "Ergänzung Codewort Kurztripanforderung Anzeigegruppe 237A" VALUE 0x81E28E KwUw 65535.00 dez 0.00 65535.00 FORMAT "%8.2" /end CHARACTERISTIC
/begin CHARACTERISTIC CWFA237B "Ergänzung Codewort B Kurztripanforderungen Anzeigegruppe 237" VALUE 0x81E290 KwUw 65535.00 dez 0.00 65535.00 FORMAT "%8.2" /end CHARACTERISTIC
/begin CHARACTERISTIC CWFA238 "Codewort Kurztripanforderung Anzeigegruppe 238" VALUE 0x81E292 KwUw 65535.00 dez 0.00 65535.00 FORMAT "%8.2" /end CHARACTERISTIC
/begin CHARACTERISTIC CWFA238A "Ergänzung Codewort Kurztripanforderung Anzeigegruppe 238A" VALUE 0x81E294 KwUw 65535.00 dez 0.00 65535.00 FORMAT "%8.2" /end CHARACTERISTIC
/begin CHARACTERISTIC CWFA238B "Ergänzung Codewort B Kurztripanforderungen Anzeigegruppe 238" VALUE 0x81E296 KwUw 65535.00 dez 0.00 65535.00 FORMAT "%8.2" /end CHARACTERISTIC
/begin CHARACTERISTIC CWFA239 "Codewort Kurztripanforderung Anzeigegruppe 239" VALUE 0x81E298 KwUw 65535.00 dez 0.00 65535.00 FORMAT "%8.2" /end CHARACTERISTIC
/begin CHARACTERISTIC CWFA239A "Ergänzung Codewort Kurztripanforderung Anzeigegruppe 239A" VALUE 0x81E29A KwUw 65535.00 dez 0.00 65535.00 FORMAT "%8.2" /end CHARACTERISTIC
/begin CHARACTERISTIC CWFA239B "Ergänzung Codewort B Kurztripanforderungen Anzeigegruppe 239" VALUE 0x81E29C KwUw 65535.00 dez 0.00 65535.00 FORMAT "%8.2" /end CHARACTERISTIC
/begin CHARACTERISTIC CWFA240 "Codewort Kurztripanforderung Anzeigegruppe 240" VALUE 0x81E29E KwUw 65535.00 dez 0.00 65535.00 FORMAT "%8.2" /end CHARACTERISTIC
/begin CHARACTERISTIC CWFA240A "Ergänzung Codewort Kurztripanforderung Anzeigegruppe 240A" VALUE 0x81E2A0 KwUw 65535.00 dez 0.00 65535.00 FORMAT "%8.2" /end CHARACTERISTIC
/begin CHARACTERISTIC CWFA240B "Ergänzung Codewort B Kurztripanforderungen Anzeigegruppe 240" VALUE 0x81E2A2 KwUw 65535.00 dez 0.00 65535.00 FORMAT "%8.2" /end CHARACTERISTIC
/begin CHARACTERISTIC CWFA241 "Codewort Kurztripanforderung Anzeigegruppe 241" VALUE 0x81E2A4 KwUw 65535.00 dez 0.00 65535.00 FORMAT "%8.2" /end CHARACTERISTIC
/begin CHARACTERISTIC CWFA241A "Ergänzung Codewort Kurztripanforderung Anzeigegruppe 241A" VALUE 0x81E2A6 KwUw 65535.00 dez 0.00 65535.00 FORMAT "%8.2" /end CHARACTERISTIC
/begin CHARACTERISTIC CWFA241B "Ergänzung Codewort B Kurztripanforderungen Anzeigegruppe 241" VALUE 0x81E2A8 KwUw 65535.00 dez 0.00 65535.00 FORMAT "%8.2" /end CHARACTERISTIC
/begin CHARACTERISTIC CWFA242 "Codewort Kurztripanforderung Anzeigegruppe 242" VALUE 0x81E2AA KwUw 65535.00 dez 0.00 65535.00 FORMAT "%8.2" /end CHARACTERISTIC
/begin CHARACTERISTIC CWFA242A "Ergänzung Codewort Kurztripanforderung Anzeigegruppe 242A" VALUE 0x81E2AC KwUw 65535.00 dez 0.00 65535.00 FORMAT "%8.2" /end CHARACTERISTIC
/begin CHARACTERISTIC CWFA242B "Ergänzung Codewort B Kurztripanforderungen Anzeigegruppe 242" VALUE 0x81E2AE KwUw 65535.00 dez 0.00 65535.00 FORMAT "%8.2" /end CHARACTERISTIC
/begin CHARACTERISTIC CWFA243 "Codewort Kurztripanforderung Anzeigegruppe 243" VALUE 0x81E2B0 KwUw 65535.00 dez 0.00 65535.00 FORMAT "%8.2" /end CHARACTERISTIC
/begin CHARACTERISTIC CWFA243A "Ergänzung Codewort Kurztripanforderung Anzeigegruppe 243A" VALUE 0x81E2B2 KwUw 65535.00 dez 0.00 65535.00 FORMAT "%8.2" /end CHARACTERISTIC
/begin CHARACTERISTIC CWFA243B "Ergänzung Codewort B Kurztripanforderungen Anzeigegruppe 243" VALUE 0x81E2B4 KwUw 65535.00 dez 0.00 65535.00 FORMAT "%8.2" /end CHARACTERISTIC
/begin CHARACTERISTIC CWFA244 "Codewort Kurztripanforderung Anzeigegruppe 244" VALUE 0x81E2B6 KwUw 65535.00 dez 0.00 65535.00 FORMAT "%8.2" /end CHARACTERISTIC
/begin CHARACTERISTIC CWFA244A "Ergänzung Codewort Kurztripanforderung Anzeigegruppe 244A" VALUE 0x81E2B8 KwUw 65535.00 dez 0.00 65535.00 FORMAT "%8.2" /end CHARACTERISTIC
/begin CHARACTERISTIC CWFA244B "Ergänzung Codewort B Kurztripanforderungen Anzeigegruppe 244" VALUE 0x81E2BA KwUw 65535.00 dez 0.00 65535.00 FORMAT "%8.2" /end CHARACTERISTIC
/begin CHARACTERISTIC CWFA245 "Codewort Kurztripanforderung Anzeigegruppe 245" VALUE 0x81E2BC KwUw 65535.00 dez 0.00 65535.00 FORMAT "%8.2" /end CHARACTERISTIC
/begin CHARACTERISTIC CWFA245A "Ergänzung Codewort Kurztripanforderung Anzeigegruppe 245A" VALUE 0x81E2BE KwUw 65535.00 dez 0.00 65535.00 FORMAT "%8.2" /end CHARACTERISTIC
/begin CHARACTERISTIC CWFA245B "Ergänzung Codewort B Kurztripanforderungen Anzeigegruppe 245" VALUE 0x81E2C0 KwUw 65535.00 dez 0.00 65535.00 FORMAT "%8.2" /end CHARACTERISTIC
/begin CHARACTERISTIC CWFA246 "Codewort Kurztripanforderung Anzeigegruppe 246" VALUE 0x81E2C2 KwUw 65535.00 dez 0.00 65535.00 FORMAT "%8.2" /end CHARACTERISTIC
/begin CHARACTERISTIC CWFA246A "Ergänzung Codewort Kurztripanforderung Anzeigegruppe 246A" VALUE 0x81E2C4 KwUw 65535.00 dez 0.00 65535.00 FORMAT "%8.2" /end CHARACTERISTIC
/begin CHARACTERISTIC CWFA246B "Ergänzung Codewort B Kurztripanforderungen Anzeigegruppe 246" VALUE 0x81E2C6 KwUw 65535.00 dez 0.00 65535.00 FORMAT "%8.2" /end CHARACTERISTIC
/begin CHARACTERISTIC CWFA247 "Codewort Kurztripanforderung Anzeigegruppe 247" VALUE 0x81E2C8 KwUw 65535.00 dez 0.00 65535.00 FORMAT "%8.2" /end CHARACTERISTIC
/begin CHARACTERISTIC CWFA247A "Ergänzung Codewort Kurztripanforderung Anzeigegruppe 247A" VALUE 0x81E2CA KwUw 65535.00 dez 0.00 65535.00 FORMAT "%8.2" /end CHARACTERISTIC
/begin CHARACTERISTIC CWFA247B "Ergänzung Codewort B Kurztripanforderungen Anzeigegruppe 247" VALUE 0x81E2CC KwUw 65535.00 dez 0.00 65535.00 FORMAT "%8.2" /end CHARACTERISTIC
/begin CHARACTERISTIC CWFA248 "Codewort Kurztripanforderung Anzeigegruppe 248" VALUE 0x81E2CE KwUw 65535.00 dez 0.00 65535.00 FORMAT "%8.2" /end CHARACTERISTIC
/begin CHARACTERISTIC CWFA248A "Ergänzung Codewort Kurztripanforderung Anzeigegruppe 248A" VALUE 0x81E2D0 KwUw 65535.00 dez 0.00 65535.00 FORMAT "%8.2" /end CHARACTERISTIC
/begin CHARACTERISTIC CWFA248B "Ergänzung Codewort B Kurztripanforderungen Anzeigegruppe 248" VALUE 0x81E2D2 KwUw 65535.00 dez 0.00 65535.00 FORMAT "%8.2" /end CHARACTERISTIC
/begin CHARACTERISTIC CWFA249 "Codewort Kurztripanforderung Anzeigegruppe 249" VALUE 0x81E2D4 KwUw 65535.00 dez 0.00 65535.00 FORMAT "%8.2" /end CHARACTERISTIC
/begin CHARACTERISTIC CWFA249A "Ergänzung Codewort Kurztripanforderung Anzeigegruppe 249A" VALUE 0x81E2D6 KwUw 65535.00 dez 0.00 65535.00 FORMAT "%8.2" /end CHARACTERISTIC
/begin CHARACTERISTIC CWFA249B "Ergänzung Codewort B Kurztripanforderungen Anzeigegruppe 249" VALUE 0x81E2D8 KwUw 65535.00 dez 0.00 65535.00 FORMAT "%8.2" /end CHARACTERISTIC
/begin CHARACTERISTIC CWFA250 "Codewort Kurztripanforderung Anzeigegruppe 250" VALUE 0x81E2DA KwUw 65535.00 dez 0.00 65535.00 FORMAT "%8.2" /end CHARACTERISTIC
/begin CHARACTERISTIC CWFA250A "Ergänzung Codewort Kurztripanforderung Anzeigegruppe 250A" VALUE 0x81E2DC KwUw 65535.00 dez 0.00 65535.00 FORMAT "%8.2" /end CHARACTERISTIC
/begin CHARACTERISTIC CWFA250B "Ergänzung Codewort B Kurztripanforderungen Anzeigegruppe 250" VALUE 0x81E2DE KwUw 65535.00 dez 0.00 65535.00 FORMAT "%8.2" /end CHARACTERISTIC
/begin CHARACTERISTIC CWFA251 "Codewort Kurztripanforderung Anzeigegruppe 251" VALUE 0x81E2E0 KwUw 65535.00 dez 0.00 65535.00 FORMAT "%8.2" /end CHARACTERISTIC
/begin CHARACTERISTIC CWFA251A "Ergänzung Codewort Kurztripanforderung Anzeigegruppe 251A" VALUE 0x81E2E2 KwUw 65535.00 dez 0.00 65535.00 FORMAT "%8.2" /end CHARACTERISTIC
/begin CHARACTERISTIC CWFA251B "Ergänzung Codewort B Kurztripanforderungen Anzeigegruppe 251" VALUE 0x81E2E4 KwUw 65535.00 dez 0.00 65535.00 FORMAT "%8.2" /end CHARACTERISTIC
/begin CHARACTERISTIC CWFA252 "Codewort Kurztripanforderung Anzeigegruppe 252" VALUE 0x81E2E6 KwUw 65535.00 dez 0.00 65535.00 FORMAT "%8.2" /end CHARACTERISTIC
/begin CHARACTERISTIC CWFA252A "Ergänzung Codewort Kurztripanforderung Anzeigegruppe 252A" VALUE 0x81E2E8 KwUw 65535.00 dez 0.00 65535.00 FORMAT "%8.2" /end CHARACTERISTIC
/begin CHARACTERISTIC CWFA252B "Ergänzung Codewort B Kurztripanforderungen Anzeigegruppe 252" VALUE 0x81E2EA KwUw 65535.00 dez 0.00 65535.00 FORMAT "%8.2" /end CHARACTERISTIC
/begin CHARACTERISTIC CWFA253 "Codewort Kurztripanforderung Anzeigegruppe 253" VALUE 0x81E2EC KwUw 65535.00 dez 0.00 65535.00 FORMAT "%8.2" /end CHARACTERISTIC
/begin CHARACTERISTIC CWFA253A "Ergänzung Codewort Kurztripanforderung Anzeigegruppe 253A" VALUE 0x81E2EE KwUw 65535.00 dez 0.00 65535.00 FORMAT "%8.2" /end CHARACTERISTIC
/begin CHARACTERISTIC CWFA253B "Ergänzung Codewort B Kurztripanforderungen Anzeigegruppe 253" VALUE 0x81E2F0 KwUw 65535.00 dez 0.00 65535.00 FORMAT "%8.2" /end CHARACTERISTIC
/begin CHARACTERISTIC CWFA254 "Codewort Kurztripanforderung Anzeigegruppe 254" VALUE 0x81E2F2 KwUw 65535.00 dez 0.00 65535.00 FORMAT "%8.2" /end CHARACTERISTIC
/begin CHARACTERISTIC CWFA254A "Ergänzung Codewort Kurztripanforderung Anzeigegruppe 254A" VALUE 0x81E2F4 KwUw 65535.00 dez 0.00 65535.00 FORMAT "%8.2" /end CHARACTERISTIC
/begin CHARACTERISTIC CWFA254B "Ergänzung Codewort B Kurztripanforderungen Anzeigegruppe 254" VALUE 0x81E2F6 KwUw 65535.00 dez 0.00 65535.00 FORMAT "%8.2" /end CHARACTERISTIC
/begin CHARACTERISTIC CWFA255 "Codewort Kurztripanforderung Anzeigegruppe 255" VALUE 0x81E2F8 KwUw 65535.00 dez 0.00 65535.00 FORMAT "%8.2" /end CHARACTERISTIC
/begin CHARACTERISTIC CWFA255A "Ergänzung Codewort Kurztripanforderung Anzeigegruppe 255A" VALUE 0x81E2FA KwUw 65535.00 dez 0.00 65535.00 FORMAT "%8.2" /end CHARACTERISTIC
/begin CHARACTERISTIC CWFA255B "Ergänzung Codewort B Kurztripanforderungen Anzeigegruppe 255" VALUE 0x81E2FC KwUw 65535.00 dez 0.00 65535.00 FORMAT "%8.2" /end CHARACTERISTIC
/begin CHARACTERISTIC CWFA28 "Codewort Kurztripanforderungen Anzeigegruppe 28" VALUE 0x81E2FE KwUw 65535.00 dez 0.00 65535.00 FORMAT "%8.2" /end CHARACTERISTIC
/begin CHARACTERISTIC CWFA28A "Ergänzung Codewort Kurztripanforderungen Anzeigegruppe 28" VALUE 0x81E300 KwUw 65535.00 dez 0.00 65535.00 FORMAT "%8.2" /end CHARACTERISTIC
/begin CHARACTERISTIC CWFA34 "Codewort Kurztripanforderungen Anzeigegruppe 34" VALUE 0x81E302 KwUw 65535.00 dez 0.00 65535.00 FORMAT "%8.2" /end CHARACTERISTIC
/begin CHARACTERISTIC CWFA34A "Ergänzung Codewort Kurztripanforderungen Anzeigegruppe 34" VALUE 0x81E304 KwUw 65535.00 dez 0.00 65535.00 FORMAT "%8.2" /end CHARACTERISTIC
/begin CHARACTERISTIC CWFA34B "Ergänzung Codewort B Kurztripanforderungen Anzeigegruppe 34" VALUE 0x81E306 KwUw 65535.00 dez 0.00 65535.00 FORMAT "%8.2" /end CHARACTERISTIC
/begin CHARACTERISTIC CWFA35 "Codewort Kurztripanforderungen Anzeigegruppe 35" VALUE 0x81E308 KwUw 65535.00 dez 0.00 65535.00 FORMAT "%8.2" /end CHARACTERISTIC
/begin CHARACTERISTIC CWFA35A "Ergänzung Codewort Kurztripanforderungen Anzeigegruppe 35" VALUE 0x81E30A KwUw 65535.00 dez 0.00 65535.00 FORMAT "%8.2" /end CHARACTERISTIC
/begin CHARACTERISTIC CWFA35B "Ergänzung Codewort B Kurztripanforderungen Anzeigegruppe 35" VALUE 0x81E30C KwUw 65535.00 dez 0.00 65535.00 FORMAT "%8.2" /end CHARACTERISTIC
/begin CHARACTERISTIC CWFA36 "Codewort Kurztripanforderungen Anzeigegruppe 36" VALUE 0x81E30E KwUw 65535.00 dez 0.00 65535.00 FORMAT "%8.2" /end CHARACTERISTIC
/begin CHARACTERISTIC CWFA36A "Ergänzung Codewort Kurztripanforderungen Anzeigegruppe 36" VALUE 0x81E310 KwUw 65535.00 dez 0.00 65535.00 FORMAT "%8.2" /end CHARACTERISTIC
/begin CHARACTERISTIC CWFA36B "Ergänzung Codewort B Kurztripanforderungen Anzeigegruppe 36" VALUE 0x81E312 KwUw 65535.00 dez 0.00 65535.00 FORMAT "%8.2" /end CHARACTERISTIC
/begin CHARACTERISTIC CWFA37 "Codewort Kurztripanforderungen Anzeigegruppe 37" VALUE 0x81E314 KwUw 65535.00 dez 0.00 65535.00 FORMAT "%8.2" /end CHARACTERISTIC
/begin CHARACTERISTIC CWFA37A "Ergänzung Codewort Kurztripanforderungen Anzeigegruppe 37" VALUE 0x81E316 KwUw 65535.00 dez 0.00 65535.00 FORMAT "%8.2" /end CHARACTERISTIC
/begin CHARACTERISTIC CWFA37B "Ergänzung Codewort B Kurztripanforderungen Anzeigegruppe 37" VALUE 0x81E318 KwUw 65535.00 dez 0.00 65535.00 FORMAT "%8.2" /end CHARACTERISTIC
/begin CHARACTERISTIC CWFA38 "Codewort Kurztripanforderungen Anzeigegruppe 38" VALUE 0x81E31A KwUw 65535.00 dez 0.00 65535.00 FORMAT "%8.2" /end CHARACTERISTIC
/begin CHARACTERISTIC CWFA38A "Ergänzung Codewort Kurztripanforderungen Anzeigegruppe 38" VALUE 0x81E31C KwUw 65535.00 dez 0.00 65535.00 FORMAT "%8.2" /end CHARACTERISTIC
/begin CHARACTERISTIC CWFA38B "Ergänzung Codewort B Kurztripanforderungen Anzeigegruppe 38" VALUE 0x81E31E KwUw 65535.00 dez 0.00 65535.00 FORMAT "%8.2" /end CHARACTERISTIC
/begin CHARACTERISTIC CWFA39 "Codewort Kurztripanforderungen Anzeigegruppe 39" VALUE 0x81E320 KwUw 65535.00 dez 0.00 65535.00 FORMAT "%8.2" /end CHARACTERISTIC
/begin CHARACTERISTIC CWFA39A "Ergänzung Codewort Kurztripanforderungen Anzeigegruppe 39" VALUE 0x81E322 KwUw 65535.00 dez 0.00 65535.00 FORMAT "%8.2" /end CHARACTERISTIC
/begin CHARACTERISTIC CWFA39B "Ergänzung Codewort B Kurztripanforderungen Anzeigegruppe 39" VALUE 0x81E324 KwUw 65535.00 dez 0.00 65535.00 FORMAT "%8.2" /end CHARACTERISTIC
/begin CHARACTERISTIC CWFA43 "Codewort Kurztripanforderungen Anzeigegruppe 43" VALUE 0x81E326 KwUw 65535.00 dez 0.00 65535.00 FORMAT "%8.2" /end CHARACTERISTIC
/begin CHARACTERISTIC CWFA43A "Ergänzung Codewort Kurztripanforderungen Anzeigegruppe 43" VALUE 0x81E328 KwUw 65535.00 dez 0.00 65535.00 FORMAT "%8.2" /end CHARACTERISTIC
/begin CHARACTERISTIC CWFA43B "Ergänzung Codewort B Kurztripanforderungen Anzeigegruppe 43" VALUE 0x81E32A KwUw 65535.00 dez 0.00 65535.00 FORMAT "%8.2" /end CHARACTERISTIC
/begin CHARACTERISTIC CWFA44 "Codewort Kurztripanforderungen Anzeigegruppe 44" VALUE 0x81E32C KwUw 65535.00 dez 0.00 65535.00 FORMAT "%8.2" /end CHARACTERISTIC
/begin CHARACTERISTIC CWFA44A "Ergänzung Codewort Kurztripanforderungen Anzeigegruppe 44" VALUE 0x81E32E KwUw 65535.00 dez 0.00 65535.00 FORMAT "%8.2" /end CHARACTERISTIC
/begin CHARACTERISTIC CWFA44B "Ergänzung Codewort B Kurztripanforderungen Anzeigegruppe 44" VALUE 0x81E330 KwUw 65535.00 dez 0.00 65535.00 FORMAT "%8.2" /end CHARACTERISTIC
/begin CHARACTERISTIC CWFA46 "Codewort Kurztripanforderungen Anzeigegruppe 46" VALUE 0x81E332 KwUw 65535.00 dez 0.00 65535.00 FORMAT "%8.2" /end CHARACTERISTIC
/begin CHARACTERISTIC CWFA46A "Ergänzung Codewort Kurztripanforderungen Anzeigegruppe 46" VALUE 0x81E334 KwUw 65535.00 dez 0.00 65535.00 FORMAT "%8.2" /end CHARACTERISTIC
/begin CHARACTERISTIC CWFA46B "Ergänzung Codewort B Kurztripanforderungen Anzeigegruppe 46" VALUE 0x81E336 KwUw 65535.00 dez 0.00 65535.00 FORMAT "%8.2" /end CHARACTERISTIC
/begin CHARACTERISTIC CWFA47 "Codewort Kurztripanforderungen Anzeigegruppe 47" VALUE 0x81E338 KwUw 65535.00 dez 0.00 65535.00 FORMAT "%8.2" /end CHARACTERISTIC
/begin CHARACTERISTIC CWFA47A "Ergänzung Codewort Kurztripanforderungen Anzeigegruppe 47" VALUE 0x81E33A KwUw 65535.00 dez 0.00 65535.00 FORMAT "%8.2" /end CHARACTERISTIC
/begin CHARACTERISTIC CWFA47B "Ergänzung Codewort B Kurztripanforderungen Anzeigegruppe 47" VALUE 0x81E33C KwUw 65535.00 dez 0.00 65535.00 FORMAT "%8.2" /end CHARACTERISTIC
/begin CHARACTERISTIC CWFA48 "Codewort Kurztripanforderungen Anzeigegruppe 48" VALUE 0x81E33E KwUw 65535.00 dez 0.00 65535.00 FORMAT "%8.2" /end CHARACTERISTIC
/begin CHARACTERISTIC CWFA48A "Ergänzung Codewort Kurztripanforderungen Anzeigegruppe 48" VALUE 0x81E340 KwUw 65535.00 dez 0.00 65535.00 FORMAT "%8.2" /end CHARACTERISTIC
/begin CHARACTERISTIC CWFA49 "Codewort Kurztripanforderungen Anzeigegruppe 49" VALUE 0x81E342 KwUw 65535.00 dez 0.00 65535.00 FORMAT "%8.2" /end CHARACTERISTIC
/begin CHARACTERISTIC CWFA49A "Ergänzung Codewort Kurztripanforderungen Anzeigegruppe 49" VALUE 0x81E344 KwUw 65535.00 dez 0.00 65535.00 FORMAT "%8.2" /end CHARACTERISTIC
/begin CHARACTERISTIC CWFA70 "Codewort Kurztripanforderungen Anzeigegruppe 70" VALUE 0x81E346 KwUw 65535.00 dez 0.00 65535.00 FORMAT "%8.2" /end CHARACTERISTIC
/begin CHARACTERISTIC CWFA70A "Ergänzung Codewort Kurztripanforderungen Anzeigegruppe 70" VALUE 0x81E348 KwUw 65535.00 dez 0.00 65535.00 FORMAT "%8.2" /end CHARACTERISTIC
/begin CHARACTERISTIC CWFA71 "Codewort Kurztripanforderungen Anzeigegruppe 71" VALUE 0x81E34A KwUw 65535.00 dez 0.00 65535.00 FORMAT "%8.2" /end CHARACTERISTIC
/begin CHARACTERISTIC CWFA71A "Ergänzung Codewort Kurztripanforderungen Anzeigegruppe 71" VALUE 0x81E34C KwUw 65535.00 dez 0.00 65535.00 FORMAT "%8.2" /end CHARACTERISTIC
/begin CHARACTERISTIC CWFA75 "Codewort Kurztripanforderungen Anzeigegruppe 75" VALUE 0x81E34E KwUw 65535.00 dez 0.00 65535.00 FORMAT "%8.2" /end CHARACTERISTIC
/begin CHARACTERISTIC CWFA75A "Ergänzung Codewort Kurztripanforderungen Anzeigegruppe 75" VALUE 0x81E350 KwUw 65535.00 dez 0.00 65535.00 FORMAT "%8.2" /end CHARACTERISTIC
/begin CHARACTERISTIC CWFA77 "Codewort Kurztripanforderungen Anzeigegruppe 77" VALUE 0x81E352 KwUw 65535.00 dez 0.00 65535.00 FORMAT "%8.2" /end CHARACTERISTIC
/begin CHARACTERISTIC CWFA77A "Ergänzung Codewort Kurztripanforderungen Anzeigegruppe 77" VALUE 0x81E354 KwUw 65535.00 dez 0.00 65535.00 FORMAT "%8.2" /end CHARACTERISTIC
/begin CHARACTERISTIC CWFA78 "Codewort Kurztripanforderungen Anzeigegruppe 78" VALUE 0x81E356 KwUw 65535.00 dez 0.00 65535.00 FORMAT "%8.2" /end CHARACTERISTIC
/begin CHARACTERISTIC CWFA78A "Ergänzung Codewort Kurztripanforderungen Anzeigegruppe 78" VALUE 0x81E358 KwUw 65535.00 dez 0.00 65535.00 FORMAT "%8.2" /end CHARACTERISTIC
/begin CHARACTERISTIC CWFA94 "Codewort Kurztripanforderungen Anzeigegruppe 94" VALUE 0x81E35A KwUw 65535.00 dez 0.00 65535.00 FORMAT "%8.2" /end CHARACTERISTIC
/begin CHARACTERISTIC CWFA94A "Ergänzung Codewort Kurztripanforderungen Anzeigegruppe 94" VALUE 0x81E35C KwUw 65535.00 dez 0.00 65535.00 FORMAT "%8.2" /end CHARACTERISTIC
/begin CHARACTERISTIC CWFA96 "Codewort Kurztripanforderungen Anzeigegruppe 96" VALUE 0x81E35E KwUw 65535.00 dez 0.00 65535.00 FORMAT "%8.2" /end CHARACTERISTIC
/begin CHARACTERISTIC CWFA96A "Ergänzung Codewort Kurztripanforderungen Anzeigegruppe 96" VALUE 0x81E360 KwUw 65535.00 dez 0.00 65535.00 FORMAT "%8.2" /end CHARACTERISTIC
/begin CHARACTERISTIC CWKUEKD "Codewort zur Konfiguration der Stellglieddiagnose Motorkühlung" VALUE 0x81E120 KwUw 65535.00 dez 0.00 65535.00 FORMAT "%8.2" /end CHARACTERISTIC
/begin CHARACTERISTIC CWSTAKD "Codewort zur Konfiguration der Stellglieddiagnose" VALUE 0x81E122 KwUw 65535.00 dez 0.00 65535.00 FORMAT "%8.2" /end CHARACTERISTIC
/begin CHARACTERISTIC CWSTAKD2 "Codewort 2 zur Konfiguration der Stellglieddiagnose" VALUE 0x81E124 KwUw 65535.00 dez 0.00 65535.00 FORMAT "%8.2" /end CHARACTERISTIC
/begin CHARACTERISTIC CWSTEVKD "Codewort zur Freigabe der Stellglieddiagnose Einspritzventile" VALUE 0x81E126 KwUw 65535.00 dez 0.00 65535.00 FORMAT "%8.2" /end CHARACTERISTIC
/begin CHARACTERISTIC CWTAF "Codewort für Testeranpassung: Anpassung frei" VALUE 0x81E362 KwUw 65535.00 dez 0.00 65535.00 FORMAT "%8.2" /end CHARACTERISTIC
/begin CHARACTERISTIC CWTAK "Codewort für Testeranpassung: Anpassung für Kundendienst" VALUE 0x81E364 KwUw 65535.00 dez 0.00 65535.00 FORMAT "%8.2" /end CHARACTERISTIC
/begin CHARACTERISTIC CWTAS "Codewort für Testeranpassung: Anpassung für Entwicklung" VALUE 0x81E366 KwUw 65535.00 dez 0.00 65535.00 FORMAT "%8.2" /end CHARACTERISTIC
/begin CHARACTERISTIC CWTEACFG "ausserordentliche Konfiguration der Tankentlüftung" VALUE 0x81A038 KwUb 255.0 dez 0.00 255.0 FORMAT "%5.1" /end CHARACTERISTIC
/begin CHARACTERISTIC DBACCMX_UM "Fehlerschwelle Botschaftszähler in ACC-Botschaft" VALUE 0x814004 KwUb 255.0 dez 0.00 255.0 FORMAT "%5.1" /end CHARACTERISTIC
/begin CHARACTERISTIC DBACC_T_UM "Fehlerentprellung:  Fehler in Botschaftszähler der ACC-Botschaft" VALUE 0x814005 KwUb 10200.0 t40ms_ub_b10200 0.00 10200.0 FORMAT "%7.1" /end CHARACTERISTIC
/begin CHARACTERISTIC DBGRAMX_UM "Fehlerschwelle Botschaftszähler in GRA-Botschaft" VALUE 0x81400A KwUb 255.0 dez 0.00 255.0 FORMAT "%5.1" /end CHARACTERISTIC
/begin CHARACTERISTIC DBGRA_T_UM "Fehlerentprellung Botschaftszähler in GRA-Botschaft" VALUE 0x81400B KwUb 10200.0 t40ms_ub_b10200 0.00 10200.0 FORMAT "%7.1" /end CHARACTERISTIC
/begin CHARACTERISTIC DBZ_MN_UM "kleinstes zulässiges Delta des Botschaftszählers" VALUE 0x814078 KwUb 255.0 dez 0.00 255.0 FORMAT "%5.1" /end CHARACTERISTIC
/begin CHARACTERISTIC DBZ_MX_UM "größtes zulässiges Delta des Botschaftszählers" VALUE 0x814079 KwUb 255.0 dez 0.00 255.0 FORMAT "%5.1" /end CHARACTERISTIC
/begin CHARACTERISTIC DFTEAHB "Schwelle Gemischanteil Tankentlüftung zum Setzen Bit ""Hohe Beladung""" VALUE 0x81A03B KwSb 1.992 fak_sb_b1 -1.000 0.9922 FORMAT "%5.3" /end CHARACTERISTIC
/begin CHARACTERISTIC DMSTES "Kennlinie maximale Zunahme Massenstrom Tankentlüftung" CURVE 0x817038 KlAUwSstUwWUw 3276.800 m_uw_q3p2 0.00 3276.800 FORMAT "%8.3"
 /begin AXIS_DESCR STD_AXIS mstesoll_w m_uw_b25p6 6 0.00 25.59961 FORMAT "%8.5" DEPOSIT ABSOLUTE /end AXIS_DESCR
/end CHARACTERISTIC
/begin CHARACTERISTIC DSTEMIN "Minimalwert für Weitertransport in Totzeitglied Gemischtransport" VALUE 0x817052 KwUw 0.9999695 fak_uw_b2 0.00 0.9999695 FORMAT "%9.7" /end CHARACTERISTIC
/begin CHARACTERISTIC DZW_AOG "oberer Grenzwert Anpassung Zündwinkel additiv" VALUE 0x811204 KwSb 191.3 zw_sb_q0p75 -96.00 95.25 FORMAT "%5.2" /end CHARACTERISTIC
/begin CHARACTERISTIC DZW_AUG "unterer Grenzwert Anpassung Zündwinkel additiv" VALUE 0x811205 KwSb 191.3 zw_sb_q0p75 -96.00 95.25 FORMAT "%5.2" /end CHARACTERISTIC
/begin CHARACTERISTIC EVZ_DAT_UC "" VAL_BLK 0x811869 KwbUb 255.0 dez 0.00 255.0 FORMAT "%5.1" NUMBER 16 /end CHARACTERISTIC
/begin CHARACTERISTIC FBA_AOG "oberer Grenzwert Anpassung Faktor BA" VALUE 0x811206 KwUb 1.992 fak_ub_b2 0.00 1.992 FORMAT "%5.3" /end CHARACTERISTIC
/begin CHARACTERISTIC FBA_AUG "unterer Grenzwert Anpassung Faktor BA" VALUE 0x811207 KwUb 1.992 fak_ub_b2 0.00 1.992 FORMAT "%5.3" /end CHARACTERISTIC
/begin CHARACTERISTIC FBTEB "Faktor Begrenzung Lerngeschwindigkeit für Beladung" CURVE 0x81A03C KlAUbSstUbWUb 0.9961 fak_ub_b1 0.00 0.9961
 /begin AXIS_DESCR STD_AXIS ftefvab fak_ub_b0p03125 6 0.00 0.03113 FORMAT "%7.5" DEPOSIT ABSOLUTE /end AXIS_DESCR
/end CHARACTERISTIC
/begin CHARACTERISTIC FBTEVA "Faktor ftefva-abhängige Lerngeschwindigkeit der Beladung" CURVE 0x81A049 KlAUbSstUbWUb 0.9961 fak_ub_b1 0.00 0.9961 /begin AXIS_DESCR STD_AXIS ftefva fak_ub_b0p5 6 0.00 0.4980 DEPOSIT ABSOLUTE /end AXIS_DESCR /end CHARACTERISTIC
/begin CHARACTERISTIC FBZBTEML "Bewertungsfaktor Integrationsgeschwindigkeit Beladungsfaktor" CURVE 0x81A056 KlAUbSstUbWUb 0.9961 fak_ub_b1 0.00 0.9961
 /begin AXIS_DESCR STD_AXIS abo dez 5 0.00 255.0 FORMAT "%5.1" DEPOSIT ABSOLUTE /end AXIS_DESCR
/end CHARACTERISTIC
/begin CHARACTERISTIC FETATEBN "Kennlinie für drehzahlabhängigen Sollwert des Motorwirkungsgrades" CURVE 0x81A061 KlAUbSstUbWUb 0.9961 fak_ub_b1 0.00 0.9961
 /begin AXIS_DESCR STD_AXIS nmot nmot_ub_q40 5 0.00 10200. FORMAT "%5.0" DEPOSIT ABSOLUTE /end AXIS_DESCR
/end CHARACTERISTIC
/begin CHARACTERISTIC FKATEB "Kennlinie Kraftstoffanteil Tankentlüftung abh. von te / TEMIN" CURVE 0x827F28 KlAUbSstUbWUb 0.9961 fak_ub_b1 0.00 0.9961
 /begin AXIS_DESCR STD_AXIS qtetemin fak_ub_b4 5 0.00 3.984 FORMAT "%5.3" DEPOSIT ABSOLUTE /end AXIS_DESCR
/end CHARACTERISTIC
/begin CHARACTERISTIC FLR_AOG "oberer Grenzwert Anpassung Lambdaregelung-TV-Verschiebung" VALUE 0x811208 KwSb 2.550 t10msxs_sb_q0p01 -1.280 1.270 FORMAT "%5.3" /end CHARACTERISTIC
/begin CHARACTERISTIC FLR_AUG "unterer Grenzwert Anpassung Lambdaregelung-TV-Verschiebung" VALUE 0x811209 KwSb 2.550 t10msxs_sb_q0p01 -1.280 1.270 FORMAT "%5.3" /end CHARACTERISTIC
/begin CHARACTERISTIC FNS_AOG "oberer Grenzwert Anpassung Faktor Nachstart" VALUE 0x81120A KwUb 1.992 fak_ub_b2 0.00 1.992 FORMAT "%5.3" /end CHARACTERISTIC
/begin CHARACTERISTIC FNS_AUG "unterer Grenzwert Anpassung Faktor Nachstart" VALUE 0x81120B KwUb 1.992 fak_ub_b2 0.00 1.992 FORMAT "%5.3" /end CHARACTERISTIC
/begin CHARACTERISTIC FQTEDL "Kennlinie Faktor für exponentielle Absteuerung Spülrate" CURVE 0x81A06C KlAUbSstUbWUb 1.992 fak_ub_b2 0.00 1.992 FORMAT "%5.3"
 /begin AXIS_DESCR STD_AXIS dmlftef fak_ub_b0p5 5 0.00 0.4980 DEPOSIT ABSOLUTE /end AXIS_DESCR
/end CHARACTERISTIC
/begin CHARACTERISTIC FQTEFR "Kennlinie stetige Grenzwertregelung (fr)" CURVE 0x827F34 KlAUbSstUbWSb 15.88 fak_sb_b16 0.00 15.88 FORMAT "%5.2"
 /begin AXIS_DESCR STD_AXIS frmxa fak_ub_b2 8 0.00 1.992 FORMAT "%5.3" DEPOSIT ABSOLUTE /end AXIS_DESCR
/end CHARACTERISTIC
/begin CHARACTERISTIC FQTEPT "Kennlinie Tankunterdruckbegrenzung" CURVE 0x827F46 KlAUbSstSbWSb 15.88 fak_sb_b16 0.00 15.88 FORMAT "%5.2"
 /begin AXIS_DESCR STD_AXIS pte p_sb_q0p25 6 -32.00 31.75 FORMAT "%5.2" DEPOSIT ABSOLUTE /end AXIS_DESCR
/end CHARACTERISTIC
/begin CHARACTERISTIC FQTEVA "Progression bei Spülratenaufsteuerung" CURVE 0x81A077 KlAUbSstUbWUb 15.94 fak_ub_b16 0.00 15.94 FORMAT "%5.2" /begin AXIS_DESCR STD_AXIS ftefva fak_ub_b0p5 6 0.00 0.4980 DEPOSIT ABSOLUTE /end AXIS_DESCR /end CHARACTERISTIC
/begin CHARACTERISTIC FRHB "fr-Schwelle für mögliches Rücksetzten Flip-Flop ""Hohe Beladung""" VALUE 0x81A084 KwUb 1.992 fak_ub_b2 0.00 1.992 FORMAT "%5.3" /end CHARACTERISTIC
/begin CHARACTERISTIC FRK_AOG "oberer Grenzwert Anpassung Faktor Grundanpassung" VALUE 0x81120C KwUb 0.4980 fak_ub_b1p25_o0p75 0.7500 1.248 FORMAT "%5.3" /end CHARACTERISTIC
/begin CHARACTERISTIC FRK_AUG "unterer Grenzwert Anpassung Faktor Grundanpassung" VALUE 0x81120D KwUb 0.4980 fak_ub_b1p25_o0p75 0.7500 1.248 FORMAT "%5.3" /end CHARACTERISTIC
/begin CHARACTERISTIC FSRFTEF "Faktor Steilheit Spülratenregelung in der Nähe des gewünschten Krafstoffanteils" VALUE 0x811EFF KwUb 59.75 fak_ub_b64 4.000 63.75 FORMAT "%5.2" /end CHARACTERISTIC
/begin CHARACTERISTIC FST_AOG "oberer Grenzwert Anpassung Faktor Start" VALUE 0x81120E KwUb 1.992 fak_ub_b2 0.00 1.992 FORMAT "%5.3" /end CHARACTERISTIC
/begin CHARACTERISTIC FST_AUG "unterer Grenzwert Anpassung Faktor Start" VALUE 0x81120F KwUb 1.992 fak_ub_b2 0.00 1.992 FORMAT "%5.3" /end CHARACTERISTIC
/begin CHARACTERISTIC FTEADAB "Schwelle Beladung für Abbruch TE-Phase" VALUE 0x81A085 KwSb 127.5 fak_sb_b64 -64.00 63.50 FORMAT "%5.2" /end CHARACTERISTIC
/begin CHARACTERISTIC FTEADMX "Maximalwert der Beladung des AKF's" VALUE 0x81A086 KwSb 127.5 fak_sb_b64 -64.00 63.50 FORMAT "%5.2" /end CHARACTERISTIC
/begin CHARACTERISTIC FTEFHB "Schwelle für Spülrate Tankentlüftung für Erkennung hohe Beladung" VALUE 0x81A087 KwUb 0.4980 fak_ub_b0p5 0.00 0.4980 /end CHARACTERISTIC
/begin CHARACTERISTIC FTEHB "Schwelle für Faktor Tankentlüftung für Erkennung hohe Beladung" VALUE 0x81A088 KwSb 127.5 fak_sb_b64 -64.00 63.50 FORMAT "%5.2" /end CHARACTERISTIC
/begin CHARACTERISTIC FTEINIX "Kennlinie Max. Spülrate abhängig vom Integral Massenstrom TE nach TE Stop" CURVE 0x81A089 KlAUbSstUbWUb 0.1992 fak_ub_b0p5 0.00 0.1992
 /begin AXIS_DESCR STD_AXIS imsteini m_ub_q0p0444 5 0.00 11.32 FORMAT "%5.2" DEPOSIT ABSOLUTE /end AXIS_DESCR
/end CHARACTERISTIC
/begin CHARACTERISTIC FUMRBRK "Faktor Umrechnung HC-Konzentration in Beladung ftead" VALUE 0x81A094 KwUb 31.88 fak_ub_b32 0.00 31.88 FORMAT "%5.2" /end CHARACTERISTIC
/begin CHARACTERISTIC FVA_AOG "oberer Grenzwert Anpassung Faktor VA" VALUE 0x811210 KwUb 1.992 fak_ub_b2 0.00 1.992 FORMAT "%5.3" /end CHARACTERISTIC
/begin CHARACTERISTIC FVA_AUG "unterer Grenzwert Anpassung Faktor VA" VALUE 0x811211 KwUb 1.992 fak_ub_b2 0.00 1.992 FORMAT "%5.3" /end CHARACTERISTIC
/begin CHARACTERISTIC FVERMN "Kennlinie Faktor Vermischung Regeneriergas Tankentlüftung mit Frischluft" CURVE 0x811F00 KlAUbSstUbWUb 0.9961 fak_ub_b1 0.00 0.9961
 /begin AXIS_DESCR STD_AXIS nmot nmot_ub_q40 6 0.00 10200. FORMAT "%5.0" DEPOSIT ABSOLUTE /end AXIS_DESCR
/end CHARACTERISTIC
/begin CHARACTERISTIC FVERZDYN "Dynamischer Faktor Verzögerung Regeneriergas zw. Drosselklappe, Einspritzventil" CURVE 0x817054 GklWUw 0.003905886 t_min_q5p96em8 0.00 0.003905886 FORMAT "%11.9"
 /begin AXIS_DESCR COM_AXIS qmsdyn fak_ub_b16 5 0.00 15.94 AXIS_PTS_REF SQM05TEUB /end AXIS_DESCR
/end CHARACTERISTIC
/begin CHARACTERISTIC FVRMDYN "dynamischer Faktor Vermischung Regeneriergas Tankentlüftung mit Frischluft" CURVE 0x811F0D GklWUb 7.969 fak_ub_b8 0.00 7.969 FORMAT "%5.3"
 /begin AXIS_DESCR COM_AXIS qmsdyn fak_ub_b16 5 0.00 15.94 AXIS_PTS_REF SQM05TEUB /end AXIS_DESCR
/end CHARACTERISTIC
/begin CHARACTERISTIC FWL_AOG "oberer Grenzwert Anpassung Faktor Warmlauf" VALUE 0x811212 KwUb 1.992 fak_ub_b2 0.00 1.992 FORMAT "%5.3" /end CHARACTERISTIC
/begin CHARACTERISTIC FWL_AUG "unterer Grenzwert Anpassung Faktor Warmlauf" VALUE 0x811213 KwUb 1.992 fak_ub_b2 0.00 1.992 FORMAT "%5.3" /end CHARACTERISTIC
/begin CHARACTERISTIC GRAOFLOGIN "Login-Code für GRA sperren" VALUE 0x815A6E KwUw 65535.00 dez 0.00 65535.00 FORMAT "%8.2" /end CHARACTERISTIC
/begin CHARACTERISTIC GRAONLOGIN "Login-Code für GRA freischalten" VALUE 0x815A70 KwUw 65535.00 dez 0.00 65535.00 FORMAT "%8.2" /end CHARACTERISTIC
/begin CHARACTERISTIC HLOFFLOGIN "Login-Code für Heißland deaktiv" VALUE 0x815A72 KwUw 65535.00 dez 0.00 65535.00 FORMAT "%8.2" /end CHARACTERISTIC
/begin CHARACTERISTIC HLONLOGIN "Login-Code für Heißland aktiv" VALUE 0x815A74 KwUw 65535.00 dez 0.00 65535.00 FORMAT "%8.2" /end CHARACTERISTIC
/begin CHARACTERISTIC IP1A_MX_UM "max. Spannung für DK-Istwert-Poti 1 am unteren Anschlag für die Funktionsüberw." VALUE 0x814016 KwUb 4.9805 spg_ub_q0p019 0.00 4.9805 /end CHARACTERISTIC
/begin CHARACTERISTIC IP2A_MN_UM "min. Spannung für DK-Istwert-Poti 2 am unteren Anschlag für die Funktionsüberw." VALUE 0x814017 KwUb 4.9805 spg_ub_q0p019 0.00 4.9805 /end CHARACTERISTIC
/begin CHARACTERISTIC IPA_T_UM "Fehlertoleranzzeit für unteren DK-Anschlag im ungültigen Bereich f. d. Fktüberw." VALUE 0x814018 KwUb 10200.0 t40ms_ub_b10200 0.00 10200.0 FORMAT "%7.1" /end CHARACTERISTIC
/begin CHARACTERISTIC KFETATE "Kennfeld gewünscher Wirkungsgrad bei Tankentlüftung bei Erreichen te = TEMIN" MAP 0x827F54 KfAxUwAyUwSstxSwSstyUwWUw 50.00000 rel_q0p00195 50.00000 100.0000 FORMAT "%8.4"
 /begin AXIS_DESCR STD_AXIS fteadf_w fak_q0p00195 3 -64.00000 63.99805 FORMAT "%8.5" DEPOSIT ABSOLUTE /end AXIS_DESCR
 /begin AXIS_DESCR STD_AXIS mifa_w rel_uw_b100 5 0.00 99.99847 FORMAT "%8.5" DEPOSIT ABSOLUTE /end AXIS_DESCR
/end CHARACTERISTIC
/begin CHARACTERISTIC KFFTEAN "Kennfeld Maximale Spülrate bei Notlauftankentlüftung" MAP 0x81A095 GkfWUb 0.1992 fak_ub_b0p5 0.00 0.1992
 /begin AXIS_DESCR COM_AXIS nmot nmot_ub_q40 10 0.00 10200. AXIS_PTS_REF SNM10TEUB /end AXIS_DESCR
 /begin AXIS_DESCR COM_AXIS wdkba relDK_ub_b100 10 0.00 100.0 AXIS_PTS_REF SDK10TEUB /end AXIS_DESCR
/end CHARACTERISTIC
/begin CHARACTERISTIC KFFTEAX "Kennfeld maximale Spülrate" MAP 0x81A0F9 KfAxUbAyUbSstxUbSstyUbWUb 0.1992 fak_ub_b0p5 0.00 0.1992
 /begin AXIS_DESCR STD_AXIS ml m_ub_b1020 5 0.00 1020. FORMAT "%5.0" DEPOSIT ABSOLUTE /end AXIS_DESCR
 /begin AXIS_DESCR STD_AXIS tans temp_ub_q0p75_o48 4 -48.00 143.3 FORMAT "%5.1" DEPOSIT ABSOLUTE /end AXIS_DESCR
/end CHARACTERISTIC
/begin CHARACTERISTIC KFMDZOF_UM "Kennfeld für Offset-Toleranz in Abhängigkeit vom zulässigen Moment" MAP 0x814131 GkfWUb 99.61 rel_ub_b99p6 0.00 99.61 FORMAT "%5.2"
 /begin AXIS_DESCR COM_AXIS mz_um rel_ub_b99p6 8 0.00 99.61 AXIS_PTS_REF MDV08_UM /end AXIS_DESCR
 /begin AXIS_DESCR COM_AXIS nmot_um nmot_ub_q40 8 0.00 10200. AXIS_PTS_REF NMV08_UM /end AXIS_DESCR
/end CHARACTERISTIC
/begin CHARACTERISTIC KFMI_UM "Kennfeld optimales Motormoment in der Funktionsüberwachung" MAP 0x8140A0 GkfWUb 99.61 rel_ub_b99p6 0.00 99.61 FORMAT "%5.2"
 /begin AXIS_DESCR COM_AXIS rl_um rel_ub_q0p75 8 0.00 191.3 AXIS_PTS_REF RLV08_UM /end AXIS_DESCR
 /begin AXIS_DESCR COM_AXIS nmot_um nmot_ub_q40 8 0.00 10200. AXIS_PTS_REF NZWV08_UM /end AXIS_DESCR
/end CHARACTERISTIC
/begin CHARACTERISTIC KFMPED_UM "Kennfeld für zulässiges Moment aus der Pedalstellung in der Funktionsüberwachg" MAP 0x814171 GkfWUb 99.61 rel_ub_b99p6 0.00 99.61 FORMAT "%5.2"
 /begin AXIS_DESCR COM_AXIS spsn_um spg_ub_q0p019 8 0.00 4.9805 AXIS_PTS_REF SPSNV08_UM /end AXIS_DESCR
 /begin AXIS_DESCR COM_AXIS nmot_um nmot_ub_q40 8 0.00 10200. AXIS_PTS_REF NMV08_UM /end AXIS_DESCR
/end CHARACTERISTIC
/begin CHARACTERISTIC KFMPNS_UM "Kennfeld für zul. Moment aus Pedalstellung bei kaltem Motor" MAP 0x8141B1 GkfWUb 99.61 rel_ub_b99p6 0.00 99.61 FORMAT "%5.2"
 /begin AXIS_DESCR COM_AXIS spsn_um spg_ub_q0p019 8 0.00 4.9805 AXIS_PTS_REF SPSNV08_UM /end AXIS_DESCR
 /begin AXIS_DESCR COM_AXIS nmot_um nmot_ub_q40 8 0.00 10200. AXIS_PTS_REF NMV08_UM /end AXIS_DESCR
/end CHARACTERISTIC
/begin CHARACTERISTIC KFQTE "Kennfeld Auf-/Absteuergeschwindigkeit der Sollspülrate Tankentlüftung" MAP 0x81A118 GkfWUb 0.0121593164 perio_ub_b0p012207 0.00 0.0121593164 FORMAT "%12.10" /begin AXIS_DESCR COM_AXIS ml m_ub_b1020 6 0.00 1020. AXIS_PTS_REF SML06TEUB /end AXIS_DESCR
 /begin AXIS_DESCR COM_AXIS frmit fak_ub_b2 5 0.00 1.992 AXIS_PTS_REF SFR05TEUB /end AXIS_DESCR
/end CHARACTERISTIC
/begin CHARACTERISTIC KFRLIP_UM "Kennfeld für rl - Berechnung aus Drosselklappenwinkel in der Funktionsüberwachg" MAP 0x814019 KfAxUbAyUbSstxUbSstyUbWUb 191.3 rel_ub_q0p75 0.00 191.3 FORMAT "%5.1"
 /begin AXIS_DESCR STD_AXIS ipsn_um spg_ub_q0p019 8 0.00 4.9805 DEPOSIT ABSOLUTE /end AXIS_DESCR
 /begin AXIS_DESCR STD_AXIS nmot_um nmot_ub_q40 8 0.00 10200. FORMAT "%5.0" DEPOSIT ABSOLUTE /end AXIS_DESCR
/end CHARACTERISTIC
/begin CHARACTERISTIC KFTADMS "dynamischer Bewertungsfaktor für das Absteuern des TEV" MAP 0x81705E KfAxUbAyUbSstxSbSstyUbWUb 1.992 fak_ub_b2 0.00 1.992 FORMAT "%5.3"
 /begin AXIS_DESCR STD_AXIS dmssginr fak_sb_b1 5 -1.000 0.9922 FORMAT "%5.3" DEPOSIT ABSOLUTE /end AXIS_DESCR
 /begin AXIS_DESCR STD_AXIS nmot nmot_ub_q40 4 0.00 10200. FORMAT "%5.0" DEPOSIT ABSOLUTE /end AXIS_DESCR
/end CHARACTERISTIC
/begin CHARACTERISTIC KFTATX "Kennfeld für maximales Tastverhältnis" MAP 0x81A136 KfAxUbAyUbSstxUbSstyUbWUb 99.61 rel_ub_b99p6 0.00 99.61 FORMAT "%5.2"
 /begin AXIS_DESCR STD_AXIS nmot nmot_ub_q40 10 0.00 10200. FORMAT "%5.0" DEPOSIT ABSOLUTE /end AXIS_DESCR
 /begin AXIS_DESCR STD_AXIS pspu fak_ub_b2 6 0.00 1.992 FORMAT "%5.3" DEPOSIT ABSOLUTE /end AXIS_DESCR
/end CHARACTERISTIC
/begin CHARACTERISTIC KFTEKA "Kennfeld Sollkraftstoffanteil bei Regenerierung" MAP 0x827F86 KfAxUbAyUbSstxUbSstyUbWSb 0.9922 fak_sb_b1 0.00 0.9922
 /begin AXIS_DESCR STD_AXIS nmot nmot_ub_q40 5 0.00 10200. FORMAT "%5.0" DEPOSIT ABSOLUTE /end AXIS_DESCR
 /begin AXIS_DESCR STD_AXIS rl rel_ub_q0p75 5 0.00 191.3 FORMAT "%5.1" DEPOSIT ABSOLUTE /end AXIS_DESCR
/end CHARACTERISTIC
/begin CHARACTERISTIC KFZW_UM "Kennfeld für optimalen Zündwinkel in der Funktionsüberwachung" MAP 0x8140E0 GkfWSb 191.3 zw_sb_q0p75 -96.00 95.25 FORMAT "%5.2"
 /begin AXIS_DESCR COM_AXIS rl_um rel_ub_q0p75 8 0.00 191.3 AXIS_PTS_REF RLV08_UM /end AXIS_DESCR
 /begin AXIS_DESCR COM_AXIS nmot_um nmot_ub_q40 8 0.00 10200. AXIS_PTS_REF NZWV08_UM /end AXIS_DESCR
/end CHARACTERISTIC
/begin CHARACTERISTIC KHCTEAMX "Maximalwert HC-Konzentration Regeneriergas Tankentlüftung(bei B_abor)" VALUE 0x81A184 KwSb 3.984 fak_sb_b2 -2.000 1.984 FORMAT "%5.3" /end CHARACTERISTIC
/begin CHARACTERISTIC KHCTEMN "Minimalwert HC-Konzentration Regeneriergas Tankentlüftung" VALUE 0x81A185 KwSb 3.984 fak_sb_b2 -2.000 1.984 FORMAT "%5.3" /end CHARACTERISTIC
/begin CHARACTERISTIC KHCTEMX "Maximalwert HC-Konzentration Regeneriergas Tankentlüftung" VALUE 0x81A186 KwSb 3.984 fak_sb_b2 -2.000 1.984 FORMAT "%5.3" /end CHARACTERISTIC
/begin CHARACTERISTIC KLETAZW_UM "ZW-Wirkungsgrad in Abhängigkeit von delta ZW in der Funktionsüberwachung" CURVE 0x814120 KlAUbSstUbWUb 127.5 rel_ub_b127p5 0.00 127.5 FORMAT "%5.1"
 /begin AXIS_DESCR STD_AXIS dzw_um zw_ub_q0p75 8 0.00 191.3 FORMAT "%5.1" DEPOSIT ABSOLUTE /end AXIS_DESCR
/end CHARACTERISTIC
/begin CHARACTERISTIC KLNPED_UM "pedalsollwertabh. Drehzahlbegrenzung in der DK-Antrieb-Ersatzfunktion, Fktsüberw" CURVE 0x8141FD KlAUbSstUbWUb 10200. nmot_ub_q40 0.00 10200. FORMAT "%5.0"
 /begin AXIS_DESCR STD_AXIS spsn_um spg_ub_q0p019 8 0.00 4.9805 DEPOSIT ABSOLUTE /end AXIS_DESCR
/end CHARACTERISTIC
/begin CHARACTERISTIC KLOGIN "Login-Code für Kundendienst" VALUE 0x815A76 KwUw 65535.00 dez 0.00 65535.00 FORMAT "%8.2" /end CHARACTERISTIC
/begin CHARACTERISTIC LAMTEMN "minimale Lambda-Schwelle, bei der die Tankentlüftung aktiv sein kann" VALUE 0x827F22 KwUw 15.99976 fak_uw_b16 0.00 15.99976 FORMAT "%8.5" /end CHARACTERISTIC
/begin CHARACTERISTIC LAMTEMX "maximale Lambda-Schwelle, bei der die Tankentlüftung aktiv sein kann" VALUE 0x827F24 KwUw 15.99976 fak_uw_b16 0.00 15.99976 FORMAT "%8.5" /end CHARACTERISTIC
/begin CHARACTERISTIC LUEN1LOGIN "Login-Code für Drehzahlfenster 1 aktiv (Lüftersteuerung)" VALUE 0x815A78 KwUw 65535.00 dez 0.00 65535.00 FORMAT "%8.2" /end CHARACTERISTIC
/begin CHARACTERISTIC LUEN2LOGIN "Login-Code für Drehzahlfenster 2 aktiv (Lüftersteuerung)" VALUE 0x815A7A KwUw 65535.00 dez 0.00 65535.00 FORMAT "%8.2" /end CHARACTERISTIC
/begin CHARACTERISTIC LUEN3LOGIN "Login-Code für Drehzahlfenster 3 aktiv (Lüftersteuerung)" VALUE 0x815A7C KwUw 65535.00 dez 0.00 65535.00 FORMAT "%8.2" /end CHARACTERISTIC
/begin CHARACTERISTIC MDR_AOG "oberer Grenzwert Anpassung Momentenreserve Leerlaufregelung" VALUE 0x811214 KwUb 24.90 rel_ub_b25 0.00 24.90 FORMAT "%5.2" /end CHARACTERISTIC
/begin CHARACTERISTIC MDR_AUG "unterer Grenzwert Anpassung Momentenreserve Leerlaufregelung" VALUE 0x811215 KwUb 24.90 rel_ub_b25 0.00 24.90 FORMAT "%5.2" /end CHARACTERISTIC
/begin AXIS_PTS MDV08_UM "Stützstellenverteilung für Moment in der Funktionsüberwachung" 0x8141F1 mz_um SstAUbSstUb 99.61 rel_ub_b99p6 8 0.00 99.61 FORMAT "%5.2" DEPOSIT ABSOLUTE /end AXIS_PTS
/begin CHARACTERISTIC MEBZA_DAT_UC "" VAL_BLK 0x811879 KwbUb 255.0 dez 0.00 255.0 FORMAT "%5.1" NUMBER 16 /end CHARACTERISTIC
/begin CHARACTERISTIC MECS_DAT_UC "" VAL_BLK 0x811889 KwbUb 255.0 dez 0.00 255.0 FORMAT "%5.1" NUMBER 16 /end CHARACTERISTIC
/begin CHARACTERISTIC MER_D1_UC "" VAL_BLK 0x811899 KwbUb 255.0 dez 0.00 255.0 FORMAT "%5.1" NUMBER 16 /end CHARACTERISTIC
/begin CHARACTERISTIC MER_D2_UC "" VAL_BLK 0x8118A9 KwbUb 255.0 dez 0.00 255.0 FORMAT "%5.1" NUMBER 16 /end CHARACTERISTIC
/begin CHARACTERISTIC MIFA_DAT_UC "" VAL_BLK 0x8118B9 KwbUb 99.61 rel_ub_q0p3906 0.00 99.61 FORMAT "%5.2" NUMBER 16 /end CHARACTERISTIC
/begin CHARACTERISTIC MSDKLMMN "minimaler Massenstrom über Drosselklappe in TE" VALUE 0x81707E KwUw 6553.500 m_uw_b6553p5 0.00 6553.500 FORMAT "%8.3" /end CHARACTERISTIC
/begin CHARACTERISTIC MSGS_DAT_UC "" VAL_BLK 0x8118C9 KwbUb 99.61 rel_ub_q0p3906 0.00 99.61 FORMAT "%5.2" NUMBER 16 /end CHARACTERISTIC
/begin CHARACTERISTIC MSPSN_DAT_UC "" VAL_BLK 0x8118D9 KwbUb 4.9805 spg_ub_q0p019 0.00 4.9805 NUMBER 16 /end CHARACTERISTIC
/begin CHARACTERISTIC MSRC_D_UC "" VAL_BLK 0x8118E9 KwbUb 255.0 dez 0.00 255.0 FORMAT "%5.1" NUMBER 16 /end CHARACTERISTIC
/begin CHARACTERISTIC MSRC_T_UM "Fehlerzeit für MSR-Eingriff-Überwachung der Funktionsüberwachung" VALUE 0x81407A KwUb 10200.0 t40ms_ub_b10200 0.00 10200.0 FORMAT "%7.1" /end CHARACTERISTIC
/begin CHARACTERISTIC MVER_D_UC "" VAL_BLK 0x8118F9 KwbUb 255.0 dez 0.00 255.0 FORMAT "%5.1" NUMBER 16 /end CHARACTERISTIC
/begin CHARACTERISTIC MVER_T_UM "Fehlerzeit beim Momentenvergleich in der Funktionsüberwachung" VALUE 0x8141FC KwUb 10200.0 t40ms_ub_b10200 0.00 10200.0 FORMAT "%7.1" /end CHARACTERISTIC
/begin CHARACTERISTIC MWNTKB "Meßwert lesen normiert Testerkommunikation" VAL_BLK 0x81E368 KwbUw 65535.00 dez 0.00 65535.00 FORMAT "%8.2" NUMBER 10 /end CHARACTERISTIC
/begin CHARACTERISTIC MWNTKB0 "Meßwert lesen normiert Testerkommunikation Block 0" VAL_BLK 0x81E37C KwbUw 65535.00 dez 0.00 65535.00 FORMAT "%8.2" NUMBER 36 /end CHARACTERISTIC
/begin CHARACTERISTIC MWNTKB1 "Meßwert lesen normiert Testerkommunikation Block 1" VAL_BLK 0x81E3C4 KwbUw 65535.00 dez 0.00 65535.00 FORMAT "%8.2" NUMBER 40 /end CHARACTERISTIC
/begin CHARACTERISTIC MWNTKB10 "Meßwert lesen normiert Testerkommunikation Block 10" VAL_BLK 0x81E414 KwbUw 65535.00 dez 0.00 65535.00 FORMAT "%8.2" NUMBER 40 /end CHARACTERISTIC
/begin CHARACTERISTIC MWNTKB11 "Meßwert lesen normiert Testerkommunikation Block 11" VAL_BLK 0x81E464 KwbUw 65535.00 dez 0.00 65535.00 FORMAT "%8.2" NUMBER 40 /end CHARACTERISTIC
/begin CHARACTERISTIC MWNTKB12 "Meßwert lesen normiert Testerkommunikation Block 12" VAL_BLK 0x81E4B4 KwbUw 65535.00 dez 0.00 65535.00 FORMAT "%8.2" NUMBER 40 /end CHARACTERISTIC
/begin CHARACTERISTIC MWNTKB13 "Meßwert lesen normiert Testerkommunikation Block 13" VAL_BLK 0x81E504 KwbUw 65535.00 dez 0.00 65535.00 FORMAT "%8.2" NUMBER 40 /end CHARACTERISTIC
/begin CHARACTERISTIC MWNTKB14 "Meßwert lesen normiert Testerkommunikation Block 14" VAL_BLK 0x81E554 KwbUw 65535.00 dez 0.00 65535.00 FORMAT "%8.2" NUMBER 40 /end CHARACTERISTIC
/begin CHARACTERISTIC MWNTKB15 "Meßwert lesen normiert Testerkommunikation Block 15" VAL_BLK 0x81E5A4 KwbUw 65535.00 dez 0.00 65535.00 FORMAT "%8.2" NUMBER 40 /end CHARACTERISTIC
/begin CHARACTERISTIC MWNTKB16 "Meßwert lesen normiert Testerkommunikation Block 16" VAL_BLK 0x81E5F4 KwbUw 65535.00 dez 0.00 65535.00 FORMAT "%8.2" NUMBER 40 /end CHARACTERISTIC
/begin CHARACTERISTIC MWNTKB17 "Meßwert lesen normiert Testerkommunikation Block 17" VAL_BLK 0x81E644 KwbUw 65535.00 dez 0.00 65535.00 FORMAT "%8.2" NUMBER 40 /end CHARACTERISTIC
/begin CHARACTERISTIC MWNTKB18 "Meßwert lesen normiert Testerkommunikation Block 18" VAL_BLK 0x81E694 KwbUw 65535.00 dez 0.00 65535.00 FORMAT "%8.2" NUMBER 40 /end CHARACTERISTIC
/begin CHARACTERISTIC MWNTKB190 "Meßwert lesen normiert Testerkommunikation Block 190" VAL_BLK 0x81E6E4 KwbUw 65535.00 dez 0.00 65535.00 FORMAT "%8.2" NUMBER 10 /end CHARACTERISTIC
/begin CHARACTERISTIC MWNTKB191 "Meßwert lesen normiert Testerkommunikation Block 191" VAL_BLK 0x81E6F8 KwbUw 65535.00 dez 0.00 65535.00 FORMAT "%8.2" NUMBER 10 /end CHARACTERISTIC
/begin CHARACTERISTIC MWNTKB192 "Meßwert lesen normiert Testerkommunikation Block 192" VAL_BLK 0x81E70C KwbUw 65535.00 dez 0.00 65535.00 FORMAT "%8.2" NUMBER 10 /end CHARACTERISTIC
/begin CHARACTERISTIC MWNTKB193 "Meßwert lesen normiert Testerkommunikation Block 193" VAL_BLK 0x81E720 KwbUw 65535.00 dez 0.00 65535.00 FORMAT "%8.2" NUMBER 10 /end CHARACTERISTIC
/begin CHARACTERISTIC MWNTKB194 "Meßwert lesen normiert Testerkommunikation Block 194" VAL_BLK 0x81E734 KwbUw 65535.00 dez 0.00 65535.00 FORMAT "%8.2" NUMBER 10 /end CHARACTERISTIC
/begin CHARACTERISTIC MWNTKB195 "Meßwert lesen normiert Testerkommunikation Block 195" VAL_BLK 0x81E748 KwbUw 65535.00 dez 0.00 65535.00 FORMAT "%8.2" NUMBER 10 /end CHARACTERISTIC
/begin CHARACTERISTIC MWNTKB196 "Meßwert lesen normiert Testerkommunikation Block 196" VAL_BLK 0x81E75C KwbUw 65535.00 dez 0.00 65535.00 FORMAT "%8.2" NUMBER 10 /end CHARACTERISTIC
/begin CHARACTERISTIC MWNTKB197 "Meßwert lesen normiert Testerkommunikation Block 197" VAL_BLK 0x81E770 KwbUw 65535.00 dez 0.00 65535.00 FORMAT "%8.2" NUMBER 10 /end CHARACTERISTIC
/begin CHARACTERISTIC MWNTKB198 "Meßwert lesen normiert Testerkommunikation Block 198" VAL_BLK 0x81E784 KwbUw 65535.00 dez 0.00 65535.00 FORMAT "%8.2" NUMBER 10 /end CHARACTERISTIC
/begin CHARACTERISTIC MWNTKB199 "Meßwert lesen normiert Testerkommunikation Block 199" VAL_BLK 0x81E798 KwbUw 65535.00 dez 0.00 65535.00 FORMAT "%8.2" NUMBER 10 /end CHARACTERISTIC
/begin CHARACTERISTIC MWNTKB2 "Meßwert lesen normiert Testerkommunikation Block 2" VAL_BLK 0x81E7AC KwbUw 65535.00 dez 0.00 65535.00 FORMAT "%8.2" NUMBER 40 /end CHARACTERISTIC
/begin CHARACTERISTIC MWNTKB20 "Meßwert lesen normiert Testerkommunikation Block 20" VAL_BLK 0x81E7FC KwbUw 65535.00 dez 0.00 65535.00 FORMAT "%8.2" NUMBER 40 /end CHARACTERISTIC
/begin CHARACTERISTIC MWNTKB21 "Meßwert lesen normiert Testerkommunikation Block 21" VAL_BLK 0x81E84C KwbUw 65535.00 dez 0.00 65535.00 FORMAT "%8.2" NUMBER 40 /end CHARACTERISTIC
/begin CHARACTERISTIC MWNTKB22 "Meßwert lesen normiert Testerkommunikation Block 22" VAL_BLK 0x81E89C KwbUw 65535.00 dez 0.00 65535.00 FORMAT "%8.2" NUMBER 40 /end CHARACTERISTIC
/begin CHARACTERISTIC MWNTKB23 "Meßwert lesen normiert Testerkommunikation Block 23" VAL_BLK 0x81E8EC KwbUw 65535.00 dez 0.00 65535.00 FORMAT "%8.2" NUMBER 40 /end CHARACTERISTIC
/begin CHARACTERISTIC MWNTKB24 "Meßwert lesen normiert Testerkommunikation Block 24" VAL_BLK 0x81E93C KwbUw 65535.00 dez 0.00 65535.00 FORMAT "%8.2" NUMBER 40 /end CHARACTERISTIC
/begin CHARACTERISTIC MWNTKB25 "Meßwert lesen normiert Testerkommunikation Block 25" VAL_BLK 0x81E98C KwbUw 65535.00 dez 0.00 65535.00 FORMAT "%8.2" NUMBER 24 /end CHARACTERISTIC
/begin CHARACTERISTIC MWNTKB3 "Meßwert lesen normiert Testerkommunikation Block 3" VAL_BLK 0x81E9BC KwbUw 65535.00 dez 0.00 65535.00 FORMAT "%8.2" NUMBER 40 /end CHARACTERISTIC
/begin CHARACTERISTIC MWNTKB4 "Meßwert lesen normiert Testerkommunikation Block 4" VAL_BLK 0x81EA0C KwbUw 65535.00 dez 0.00 65535.00 FORMAT "%8.2" NUMBER 40 /end CHARACTERISTIC
/begin CHARACTERISTIC MWNTKB5 "Meßwert lesen normiert Testerkommunikation Block 5" VAL_BLK 0x81EA5C KwbUw 65535.00 dez 0.00 65535.00 FORMAT "%8.2" NUMBER 40 /end CHARACTERISTIC
/begin CHARACTERISTIC MWNTKB6 "Meßwert lesen normiert Testerkommunikation Block 6" VAL_BLK 0x81EAAC KwbUw 65535.00 dez 0.00 65535.00 FORMAT "%8.2" NUMBER 40 /end CHARACTERISTIC
/begin CHARACTERISTIC MWNTKB7 "Meßwert lesen normiert Testerkommunikation Block 7" VAL_BLK 0x81EAFC KwbUw 65535.00 dez 0.00 65535.00 FORMAT "%8.2" NUMBER 40 /end CHARACTERISTIC
/begin CHARACTERISTIC MWNTKB8 "Meßwert lesen normiert Testerkommunikation Block 8" VAL_BLK 0x81EB4C KwbUw 65535.00 dez 0.00 65535.00 FORMAT "%8.2" NUMBER 40 /end CHARACTERISTIC
/begin CHARACTERISTIC MWNTKB9 "Meßwert lesen normiert Testerkommunikation Block 9" VAL_BLK 0x81EB9C KwbUw 65535.00 dez 0.00 65535.00 FORMAT "%8.2" NUMBER 40 /end CHARACTERISTIC
/begin CHARACTERISTIC MZFFIL_UM "Filter-Zeitkonstante für verzögertes Moment in der Funktionsüberwachung" VALUE 0x8141FA KwUb 10159.4 zk40ms_ub_b10200 40.6299 10200.0 FORMAT "%7.1" /end CHARACTERISTIC
/begin CHARACTERISTIC MZFPTR_DAT_UC "" VAL_BLK 0x811909 KwbUb 255.0 dez 0.00 255.0 FORMAT "%5.1" NUMBER 16 /end CHARACTERISTIC
/begin CHARACTERISTIC MZFREG_DAT_UC "" MAP 0x811919 KfWUb 255.0 dez 0.00 255.0 FORMAT "%5.1"
 /begin AXIS_DESCR FIX_AXIS x_uc dez 16 0.00 15.00 FORMAT "%5.2" FIX_AXIS_PAR 0 0 16 /end AXIS_DESCR
 /begin AXIS_DESCR FIX_AXIS y_uc dez 8 0.00 7.000 FORMAT "%5.3" FIX_AXIS_PAR 0 0 8 /end AXIS_DESCR
/end CHARACTERISTIC
/begin CHARACTERISTIC MZFTV_UM "Verzugszeit für zulässiges Moment mz_um in der Funktionsüberwachg" VALUE 0x8141FB KwUb 280.000 t40ms_ub_b10200 40.0000 320.000 FORMAT "%7.3" /end CHARACTERISTIC
/begin CHARACTERISTIC MZF_DAT_UC "" VAL_BLK 0x811999 KwbUb 99.61 rel_ub_q0p3906 0.00 99.61 FORMAT "%5.2" NUMBER 16 /end CHARACTERISTIC
/begin CHARACTERISTIC MZL_DAT_UC "" VAL_BLK 0x8119A9 KwbUb 0.3891 rel_ub_q0p00153 0.00 0.3891 NUMBER 16 /end CHARACTERISTIC
/begin CHARACTERISTIC NC_T_UM "Fehlertoleranzzeit für Motordrehzahlüberwachung für Funktionsüberwachung" VALUE 0x81400C KwUb 10200.0 t40ms_ub_b10200 0.00 10200.0 FORMAT "%7.1" /end CHARACTERISTIC
/begin CHARACTERISTIC NDIF_UM "erlaubte Differenz zwischen nmot und nz_um in der Funktionsüberwachung" VALUE 0x81400D KwUb 10200. nmot_ub_q40 0.00 10200. FORMAT "%5.0" /end CHARACTERISTIC
/begin CHARACTERISTIC NFLAGS_D_UC "" VAL_BLK 0x8119B9 KwbUb 255.0 dez 0.00 255.0 FORMAT "%5.1" NUMBER 16 /end CHARACTERISTIC
/begin CHARACTERISTIC NLS_AOG "oberer Grenzwert Anpassung LL-Solldrehzahl" VALUE 0x811216 KwSb 2550. nmot_q10 -1280. 1270. FORMAT "%5.0" /end CHARACTERISTIC
/begin CHARACTERISTIC NLS_AUG "unterer Grenzwert Anpassung LL-Solldrehzahl" VALUE 0x811217 KwSb 2550. nmot_q10 -1280. 1270. FORMAT "%5.0" /end CHARACTERISTIC
/begin CHARACTERISTIC NMIN_UM "minimale Drehzahl für Motordrehzahlüberwachung der Funktionsüberwachung" VALUE 0x81400E KwUb 9680. nmot_ub_q40 520.0 10200. FORMAT "%5.0" /end CHARACTERISTIC
/begin CHARACTERISTIC NMOT_DAT_UC "" VAL_BLK 0x8119C9 KwbUb 10200. nmot_ub_q40 0.00 10200. FORMAT "%5.0" NUMBER 16 /end CHARACTERISTIC
/begin AXIS_PTS NMV08_UC "Stützstellenverteilung für Motordrehzahl im Befehlstest" 0x811A7F nmot_uc SstAUbSstUb 10200. nmot_ub_q40 8 0.00 10200. FORMAT "%5.0" DEPOSIT ABSOLUTE /end AXIS_PTS
/begin AXIS_PTS NMV08_UM "Stützstellenverteilung für Motordrehzahl in der Funktionsüberwachung" 0x81407C nmot_um SstAUbSstUb 10200. nmot_ub_q40 8 0.00 10200. FORMAT "%5.0" DEPOSIT ABSOLUTE /end AXIS_PTS
/begin CHARACTERISTIC NOASR_UM "Inaktivmaske für ASR" VALUE 0x81407B KwUb 99.61 rel_ub_q0p3906 0.00 99.61 FORMAT "%5.2" /end CHARACTERISTIC
/begin CHARACTERISTIC NOREA_UM "Kennung zur Anforderung kein Motorbetrieb möglich aus %UFREAC der Funktionsüberw" VALUE 0x81420E KwUb 255.0 dez 0.00 255.0 FORMAT "%5.1" /end CHARACTERISTIC
/begin CHARACTERISTIC NRLIP_UM "Motordrehzahl-Schwelle für den rl/rlip-Vergleich in der Funktionsüberwachg" VALUE 0x81406B KwUb 10200. nmot_ub_q40 0.00 10200. FORMAT "%5.0" /end CHARACTERISTIC
/begin CHARACTERISTIC NSC_T_UM "Nachstartüberwachungszeit für die Funktionsüberwachung" VALUE 0x814220 KwUw 2621.400 t40msxs_uw_q0p04 0.00 2621.400 FORMAT "%8.3" /end CHARACTERISTIC
/begin CHARACTERISTIC NSOF_T_UM "Entprellzeit für Abschaltung der Nachstartaufweitung" VALUE 0x81400F KwUb 10200.0 t40ms_ub_b10200 0.00 10200.0 FORMAT "%7.1" /end CHARACTERISTIC
/begin CHARACTERISTIC NVERZMN "minimale Drehzahl für Verzögerung" VALUE 0x817080 KwUw 16383.75 nmot_uw_q0p25 0.00 16383.75 FORMAT "%8.2" /end CHARACTERISTIC
/begin AXIS_PTS NZWV08_UC "" 0x811A88 nmot_uc SstAUbSstUb 10200. nmot_ub_q40 8 0.00 10200. FORMAT "%5.0" DEPOSIT ABSOLUTE /end AXIS_PTS
/begin AXIS_PTS NZWV08_UM "" 0x814085 nmot_um SstAUbSstUb 10200. nmot_ub_q40 8 0.00 10200. FORMAT "%5.0" DEPOSIT ABSOLUTE /end AXIS_PTS
/begin CHARACTERISTIC N_START_UM "Motordrehzahlschwelle für Unterdrehzahl-Ausstieg für die Fkt.-Überwachung" VALUE 0x814010 KwUb 10200. nmot_ub_q40 0.00 10200. FORMAT "%5.0" /end CHARACTERISTIC
/begin CHARACTERISTIC N_STEND_UM "Motordrehzahlschwelle für Startende in der Fkt.-Überwachung" VALUE 0x814011 KwUb 10200. nmot_ub_q40 0.00 10200. FORMAT "%5.0" /end CHARACTERISTIC
/begin CHARACTERISTIC REAC_D1_UC "" VAL_BLK 0x8119D9 KwbUb 255.0 dez 0.00 255.0 FORMAT "%5.1" NUMBER 16 /end CHARACTERISTIC
/begin CHARACTERISTIC REAC_D2_UC "" VAL_BLK 0x8119E9 KwbUb 255.0 dez 0.00 255.0 FORMAT "%5.1" NUMBER 16 /end CHARACTERISTIC
/begin CHARACTERISTIC REAC_T1_UM "Fehlerzeit bei der Funktions-Fehlerreaktionsüberwachung in der Funktionsüberw." VALUE 0x81420F KwUb 10200.0 t40ms_ub_b10200 0.00 10200.0 FORMAT "%7.1" /end CHARACTERISTIC
/begin CHARACTERISTIC REAC_T2_UM "Fehlerzeit bei der Funktionsüberwachungs-Fehlerreaktionsüberwachung" VALUE 0x814210 KwUb 10200.0 t40ms_ub_b10200 0.00 10200.0 FORMAT "%7.1" /end CHARACTERISTIC
/begin CHARACTERISTIC RFLAGS_D_UC "" VAL_BLK 0x8119F9 KwbUb 255.0 dez 0.00 255.0 FORMAT "%5.1" NUMBER 16 /end CHARACTERISTIC
/begin CHARACTERISTIC RLC_T_UM "Fehlertoleranzzeit für den rl-Vergleich mit der Funktion in der Funktionsüberw." VALUE 0x81406C KwUb 10200.0 t40ms_ub_b10200 0.00 10200.0 FORMAT "%7.1" /end CHARACTERISTIC
/begin CHARACTERISTIC RLIPFIL_UM "Filter-Zeitkonstante für verzögerte Lastinfo rlipt_um in d. Funktionsüberwachung" VALUE 0x81406D KwUb 10159.4 zk40ms_ub_b10200 40.6299 10200.0 FORMAT "%7.1" /end CHARACTERISTIC
/begin CHARACTERISTIC RLIPTV_UM "Verzugszeit für Lastinformation rlip_um in der Funktionsüberwachung" VALUE 0x81406E KwUb 320.000 t40ms_ub_b10200 0.00 320.000 FORMAT "%7.3" /end CHARACTERISTIC
/begin CHARACTERISTIC RLIP_T_UM "Fehlertoleranzzeit für den rl/rlip-Vergleich in der Funktionsüberwachg" VALUE 0x81406F KwUb 10200.0 t40ms_ub_b10200 0.00 10200.0 FORMAT "%7.1" /end CHARACTERISTIC
/begin AXIS_PTS RLV08_UC "Stutzstellenverteilung für Lastinfo im Befehlstest" 0x811A91 rl_uc SstAUbSstUb 191.3 rel_ub_q0p75 8 0.00 191.3 FORMAT "%5.1" DEPOSIT ABSOLUTE /end AXIS_PTS
/begin AXIS_PTS RLV08_UM "Stutzstellenverteilung für Lastinfo in der Funktionsüberwachung" 0x81408E rl_um SstAUbSstUb 191.3 rel_ub_q0p75 8 0.00 191.3 FORMAT "%5.1" DEPOSIT ABSOLUTE /end AXIS_PTS
/begin CHARACTERISTIC RLX_AOG "oberer Grenzwert Anpassung maximaler Ladedruck" VALUE 0x811218 KwUb 0.9961 fak_ub_b1 0.00 0.9961 /end CHARACTERISTIC
/begin CHARACTERISTIC RLX_AUG "unterer Grenzwert Anpassung maximaler Ladedruck" VALUE 0x811219 KwUb 0.9961 fak_ub_b1 0.00 0.9961 /end CHARACTERISTIC
/begin CHARACTERISTIC RL_BO_UM "Offset für Toleranzgerade f(rl_um) für rlipf_um in der Funktionsüberwachung" VALUE 0x814070 KwUb 191.3 rel_ub_q0p75 0.00 191.3 FORMAT "%5.1" /end CHARACTERISTIC
/begin CHARACTERISTIC RL_DAT_UC "" VAL_BLK 0x811A09 KwbUb 191.3 rel_ub_q0p75 0.00 191.3 FORMAT "%5.1" NUMBER 16 /end CHARACTERISTIC
/begin CHARACTERISTIC RL_MO_UM "Steigung für Toleranzgerade f(rl_um) für rlipf_um in der Funktionsüberwachung" VALUE 0x814071 KwUb 255.0 dez 0.00 255.0 FORMAT "%5.1" /end CHARACTERISTIC
/begin CHARACTERISTIC RST_TV_UM "Kennung zur Anforderung eines Reset-Tastverhältnisses aus der Funktionsüberwach." VALUE 0x814000 KwUb 255.0 dez 0.00 255.0 FORMAT "%5.1" /end CHARACTERISTIC
/begin AXIS_PTS SDK10TEUB "wdkba abhängige Stützstellen (Anzahl 10)" 0x8181C6 wdkba SstAUbSstUb 100.0 relDK_ub_b100 10 0.00 100.0 FORMAT "%5.1" DEPOSIT ABSOLUTE /end AXIS_PTS
/begin CHARACTERISTIC SFLAGS_D_UC "" VAL_BLK 0x811A19 KwbUb 255.0 dez 0.00 255.0 FORMAT "%5.1" NUMBER 16 /end CHARACTERISTIC
/begin AXIS_PTS SFR05TEUB "frmit abhängige Stützstellen (Anzahl 5)" 0x8181D8 frmit SstAUbSstUb 1.992 fak_ub_b2 5 0.00 1.992 FORMAT "%5.3" DEPOSIT ABSOLUTE /end AXIS_PTS
/begin CHARACTERISTIC SGIDB1 "BOSCH-Hardwarenummer" ASCII 0x81121A KwbUb 255.0 KennText 0.00 255.0 FORMAT "%5.1" NUMBER 12 /end CHARACTERISTIC
/begin CHARACTERISTIC SGIDB2 "BOSCH-Softwarenummer" ASCII 0x811226 KwbUb 255.0 KennText 0.00 255.0 FORMAT "%5.1" NUMBER 20 /end CHARACTERISTIC
/begin CHARACTERISTIC SGIDB3 "Kunden-Teilenummer" ASCII 0x81123A KwbUb 255.0 KennText 0.00 255.0 FORMAT "%5.1" NUMBER 4 /end CHARACTERISTIC
/begin CHARACTERISTIC SGSC_D_UC "" VAL_BLK 0x811A29 KwbUb 255.0 dez 0.00 255.0 FORMAT "%5.1" NUMBER 16 /end CHARACTERISTIC
/begin CHARACTERISTIC SKA_DRHZ_UM "" VALUE 0x814211 KwUb 10200. nmot_ub_q40 0.00 10200. FORMAT "%5.0" /end CHARACTERISTIC
/begin CHARACTERISTIC SLOGIN "Login-Code für Entwicklung" VALUE 0x815A7E KwUw 65535.00 dez 0.00 65535.00 FORMAT "%8.2" /end CHARACTERISTIC
/begin AXIS_PTS SML06TEUB "ml abhängige Stützstellen (Anzahl 6)" 0x8181EA ml SstAUbSstUb 1020. m_ub_b1020 6 0.00 1020. FORMAT "%5.0" DEPOSIT ABSOLUTE /end AXIS_PTS
/begin AXIS_PTS SNM10TEUB "nmot abhängige Stützstellen (Anzahl 10)" 0x81823F nmot SstAUbSstUb 10200. nmot_ub_q40 10 0.00 10200. FORMAT "%5.0" DEPOSIT ABSOLUTE /end AXIS_PTS
/begin CHARACTERISTIC SP12LL_UM "maximale Differenz zwischen SP1S und SP2S unterhalb der Vollgas-Schwelle" VALUE 0x814072 KwUb 4.9805 spg_ub_q0p019 0.00 4.9805 /end CHARACTERISTIC
/begin CHARACTERISTIC SP12VG_UM "maximale Differenz zwischen SP1S und SP2S oberhalb der Vollgas-Schwelle" VALUE 0x814073 KwUb 4.9805 spg_ub_q0p019 0.00 4.9805 /end CHARACTERISTIC
/begin CHARACTERISTIC SP1ADC_DIF "max. Diff. zw. Sollwertpoti1 & Sollwertpoti1 vom Überw.Modul im stationären Fall" VALUE 0x814213 KwUb 4.9805 spg_ub_q0p019 0.00 4.9805 /end CHARACTERISTIC
/begin CHARACTERISTIC SP1_STAT "Bandbreite für die Erkennung auf sp1s stationär" VALUE 0x814214 KwUb 4.9805 spg_ub_q0p019 0.00 4.9805 /end CHARACTERISTIC
/begin CHARACTERISTIC SP1_STAT_T "Zeit für die Erkennung auf sp1s stationär" VALUE 0x814215 KwUb 2.550 t10msxs_ub_b2p55 0.00 2.550 FORMAT "%5.3" /end CHARACTERISTIC
/begin CHARACTERISTIC SPSC_MINUC "" VALUE 0x811A39 KwUb 4.9805 spg_ub_q0p019 0.00 4.9805 /end CHARACTERISTIC
/begin CHARACTERISTIC SPSC_MIN_UM "" VALUE 0x814074 KwUb 4.9805 spg_ub_q0p019 0.00 4.9805 /end CHARACTERISTIC
/begin CHARACTERISTIC SPSC_T_UM "Fehlerzeit bei zueinander unplausiblen Sollwerten in der Funktionsüberwachung" VALUE 0x814075 KwUb 10200.0 t40ms_ub_b10200 0.00 10200.0 FORMAT "%7.1" /end CHARACTERISTIC
/begin AXIS_PTS SPSNV08_UC "Stützstellenverteilung für Pedalwert im Befehlstest" 0x811A9A spsn_uc SstAUbSstUb 4.9805 spg_ub_q0p019 8 0.00 4.9805 DEPOSIT ABSOLUTE /end AXIS_PTS
/begin AXIS_PTS SPSNV08_UM "Stützstellenverteilung für Pedalwert in der Funktionsüberwachung" 0x814097 spsn_um SstAUbSstUb 4.9805 spg_ub_q0p019 8 0.00 4.9805 DEPOSIT ABSOLUTE /end AXIS_PTS
/begin CHARACTERISTIC SPSN_DAT_UC "" VAL_BLK 0x811A3A KwbUb 4.9805 spg_ub_q0p019 0.00 4.9805 NUMBER 16 /end CHARACTERISTIC
/begin CHARACTERISTIC SPSVG_UM "Vollgas-Sollwert-Schwelle zur Umschaltung der maximalen Differenz SP1S-SP2S" VALUE 0x814076 KwUb 4.9805 spg_ub_q0p019 0.00 4.9805 /end CHARACTERISTIC
/begin AXIS_PTS SQM05TEUB "Luftmassenquotient-abhängige Stützstellen (Anzahl =5)" 0x8100D6 qmsdyn SstAUbSstUb 15.94 fak_ub_b16 5 0.00 15.94 FORMAT "%5.2" DEPOSIT ABSOLUTE /end AXIS_PTS
/begin CHARACTERISTIC TANSMN_UM "Ansauglufttemperaturschwelle zur Nachstartaufweitung in der Fkt.-Überwachung" VALUE 0x814012 KwUb 191.3 temp_ub_q0p75_o48 -48.00 143.3 FORMAT "%5.1" /end CHARACTERISTIC
/begin CHARACTERISTIC TFLAGS_D_UC "" VAL_BLK 0x811A4A KwbUb 255.0 dez 0.00 255.0 FORMAT "%5.1" NUMBER 16 /end CHARACTERISTIC
/begin CHARACTERISTIC TFTEINI "Zeit für Erkennung TE Stop" VALUE 0x817082 KwUw 6553.500 t100msxs_uw_b6553p5 0.00 6553.500 FORMAT "%8.3" /end CHARACTERISTIC
/begin CHARACTERISTIC TKMWLMW "Testkanal für %TKMWL Messwert" VALUE 0x81123E KwUb 255.0 dez 0.00 255.0 FORMAT "%5.1" /end CHARACTERISTIC
/begin CHARACTERISTIC TKMWLNA "Testkanal für %TKMWL Normanzeigenummer" VALUE 0x81123F KwUb 255.0 dez 0.00 255.0 FORMAT "%5.1" /end CHARACTERISTIC
/begin CHARACTERISTIC TKMWLNW "Testkanal für %TKMWL Normierwert" VALUE 0x811240 KwUb 255.0 dez 0.00 255.0 FORMAT "%5.1" /end CHARACTERISTIC
/begin CHARACTERISTIC TMNSMN_UM "Motortemperaturschwelle für die Nachstartaufweitung in der FKT.-Überwachung" VALUE 0x814013 KwUb 191.3 temp_ub_q0p75_o48 -48.00 143.3 FORMAT "%5.1" /end CHARACTERISTIC
/begin CHARACTERISTIC TMSTTE "Starttemperaturschwelle, bei der die TE sofort aktiv werden kann" VALUE 0x81A039 KwUb 191.3 temp_ub_q0p75_o48 -48.00 143.3 FORMAT "%5.1" /end CHARACTERISTIC
/begin CHARACTERISTIC TMTE "TMOT - Schwelle für Tankentlüftung" VALUE 0x81A03A KwUb 191.3 temp_ub_q0p75_o48 -48.00 143.3 FORMAT "%5.1" /end CHARACTERISTIC
/begin CHARACTERISTIC TQTEAB "Zeit für Absteuerung Spülrate Tankentlüftung" VALUE 0x811F12 KwUb 81.28 t20msxs_ub_q0p32 0.3200 81.60 FORMAT "%5.2" /end CHARACTERISTIC
/begin CHARACTERISTIC TQTEDAB "Zeit für schnelle Absteuerung Spülrate Tankentlüftung" VALUE 0x811F13 KwUb 81.28 t20msxs_ub_q0p32 0.3200 81.60 FORMAT "%5.2" /end CHARACTERISTIC
/begin CHARACTERISTIC TTEAUS "Zeit nach Start bis TEB aktiv wird" VALUE 0x827F26 KwUw 195.0000 t100msxs_uw_q100 5.000000 200.0000 FORMAT "%8.4" /end CHARACTERISTIC
/begin CHARACTERISTIC TVAGRFTE "Verzögerungszeit für Freigabe der AGR nach einer Sperrung" VALUE 0x81A187 KwUb 25.50 t100msxs_ub_b25p5 0.00 25.50 FORMAT "%5.2" /end CHARACTERISTIC
/begin CHARACTERISTIC TVSATEM "Verzögerungszeit für TEV zu nach SA-Bereitschaft" CURVE 0x811F14 KlAUbSstUbWUb 5.100 t20msxs_ub_b5p1 0.00 5.100 FORMAT "%5.3"
 /begin AXIS_DESCR STD_AXIS tmot temp_ub_q0p75_o48 6 -48.00 143.3 FORMAT "%5.1" DEPOSIT ABSOLUTE /end AXIS_DESCR
/end CHARACTERISTIC
/begin CHARACTERISTIC TZTOL_UM "Toleranz zwischen Zeit- und Zahnzählererfassung in Timerinkrementen" VALUE 0x81421E KwUw 65535.00 dez 0.00 65535.00 FORMAT "%8.2" /end CHARACTERISTIC
/begin CHARACTERISTIC UMECRST_TV_UM "" VALUE 0x814001 KwUb 255.0 dez 0.00 255.0 FORMAT "%5.1" /end CHARACTERISTIC
/begin CHARACTERISTIC UMRST_TV_UM "" VALUE 0x814002 KwUb 255.0 dez 0.00 255.0 FORMAT "%5.1" /end CHARACTERISTIC
/begin CHARACTERISTIC VARDEF "Default Variante für Variantencodierung" VALUE 0x815A80 KwUw 32767.00 dez 0.00 32767.00 FORMAT "%8.2" /end CHARACTERISTIC
/begin CHARACTERISTIC VFZG_DAT_UC "" VAL_BLK 0x816B34 KwbUw 511.9922 vfzg_uw_q0p00781 0.00 511.9922 FORMAT "%8.4" NUMBER 16 /end CHARACTERISTIC
/begin CHARACTERISTIC VMIN_UM "Minimalgeschwindigkeit für FGR-Betrieb in der Funktionsüberwachung" VALUE 0x814222 KwUw 511.9922 vfzg_uw_q0p00781 0.00 511.9922 FORMAT "%8.4" /end CHARACTERISTIC
/begin CHARACTERISTIC VVR_AOG "oberer Grenzwert Anpassung V-Verriegelung" VALUE 0x811241 KwSb 255.0 vfzg_q1p0 -128.0 127.0 FORMAT "%5.1" /end CHARACTERISTIC
/begin CHARACTERISTIC VVR_AUG "unterer Grenzwert Anpassung V-Verriegelung" VALUE 0x811242 KwSb 255.0 vfzg_q1p0 -128.0 127.0 FORMAT "%5.1" /end CHARACTERISTIC
/begin CHARACTERISTIC WAIT_T_UM "Wartezeit für Reset-Tastverhältnis aus der Funktionsüberwachung" VALUE 0x81421C KwUw 8332.629 t_wdt_high 0.00 8332.629 FORMAT "%8.3" /end CHARACTERISTIC
/begin CHARACTERISTIC ZBTEML "Integrationsgeschwindigkeit Beladungsfaktor" CURVE 0x81A188 GklWUb 6.101 perio_ub_b6p125 0.00 6.101 FORMAT "%5.3" /begin AXIS_DESCR COM_AXIS ml m_ub_b1020 6 0.00 1020. AXIS_PTS_REF SML06TEUB /end AXIS_DESCR /end CHARACTERISTIC
/begin CHARACTERISTIC ZETATE "Rampensteilheit für Veränderung Motorwirkungsgrad durch Tankentlüftung" VALUE 0x827FAC KwUw 1279.590 rgrad_uw_b1280 0.3906250 1279.980 FORMAT "%8.3" /end CHARACTERISTIC
/begin CHARACTERISTIC ZFLAGS_D_UC "" VAL_BLK 0x811A5A KwbUb 255.0 dez 0.00 255.0 FORMAT "%5.1" NUMBER 16 /end CHARACTERISTIC
/begin CHARACTERISTIC ZKFTEAD "Zeitkonstante gefilteter Faktor Beladung Spülstrom bei Tankentlüftung" VALUE 0x827FAE KwUw 6553.4999985 zk100msxs_uw_b6553 0.10000152590 6553.6000000 FORMAT "%12.7" /end CHARACTERISTIC
/begin CHARACTERISTIC ZMLTE "Zeitkonstante für ml-Filter in beladungsabh. Tankentlüftung" VALUE 0x827FB0 KwUw 6553.4999985 zk100msxs_uw_b655 0.10000152590 6553.6000000 FORMAT "%12.7" /end CHARACTERISTIC
/begin CHARACTERISTIC ZMSSGIN "Filterzeitkonstante für Berechnung der relativen Änderung von mssgin_w" VALUE 0x81A18E KwUb 25.4996 zk100msxs_ub_b25p5 0.100392 25.6000 FORMAT "%7.4" /end CHARACTERISTIC
/begin CHARACTERISTIC ZWC_T_UM "Fehlertoleranzzeit der Zündwinkelüberwachung in der Funktionsüberw." VALUE 0x814014 KwUb 255.0 dez 0.00 255.0 FORMAT "%5.1" /end CHARACTERISTIC
/begin CHARACTERISTIC ZWOUT_DAT_UC "" VAL_BLK 0x811A6A KwbUb 191.3 zw_sb_q0p75 0.00 191.3 FORMAT "%5.1" NUMBER 16 /end CHARACTERISTIC
/begin CHARACTERISTIC ZYLANZ_UM "Zylinderzahl für die Zündwinkelüberwachung in der Funktionsüberw." VALUE 0x814015 KwUb 255.0 dez 0.00 255.0 FORMAT "%5.1" /end CHARACTERISTIC
/begin MEASUREMENT adcc_c_um "Fehlerzähler bei zueinander unplausiblen ADC-Werten für sp1s" UBYTE t10msxs_ub_b2p55 1 100 0 2.55 FORMAT "%5.3" ECU_ADDRESS 0x38084D /end MEASUREMENT
/begin MEASUREMENT auscf_c_um "Fehlerzähler im DauerRAM für nicht angezogenes Hauptrelais (Diagnose) in %UMAUSC" UWORD dez 1 100 0 65535 FORMAT "%8.2" ECU_ADDRESS 0x383AB0 /end MEASUREMENT
/begin MEASUREMENT ausc_c_um "Prüfungszähler im DauerRAM für nicht angezogenes Hauptrelais im Abschaltpfadtest" UWORD dez 1 100 0 65535 FORMAT "%8.2" ECU_ADDRESS 0x383AB2 /end MEASUREMENT
/begin MEASUREMENT ausgh_c_um "Heilungszähler für Fehler in der zyklischen RAM-Prüfung der Funktionsüberwachung" UBYTE t40ms_ub_b10200 1 100 0 10200 FORMAT "%7.1" ECU_ADDRESS 0x380852 /end MEASUREMENT
/begin MEASUREMENT ausg_c_um "Fehlerzähler für zyklische RAM-Prüfung in der Funktionsüberwachung" UBYTE dezsub1 1 100 1 256 FORMAT "%5.1" ECU_ADDRESS 0x380853 /end MEASUREMENT
/begin MEASUREMENT auszh_c_um "Heilungszähler für Fehler in der zyklischen ROM-Prüfung der Funktionsüberwachung" UBYTE t40ms_ub_b10200 1 100 0 10200 FORMAT "%7.1" ECU_ADDRESS 0x380854 /end MEASUREMENT
/begin MEASUREMENT ausz_c_um "Fehlerzähler für zyklische ROM-Prüfung in der Funktionsüberwachung" UBYTE dezsub1 1 100 1 256 FORMAT "%5.1" ECU_ADDRESS 0x380855 /end MEASUREMENT
/begin MEASUREMENT b2acc_um "" UBYTE dez 1 100 0 255 FORMAT "%5.1" ECU_ADDRESS 0x38080A /end MEASUREMENT
/begin MEASUREMENT b2gra_um "" UBYTE dez 1 100 0 255 FORMAT "%5.1" ECU_ADDRESS 0x380810 /end MEASUREMENT
/begin MEASUREMENT b3gra_um "" UBYTE dez 1 100 0 255 FORMAT "%5.1" ECU_ADDRESS 0x380811 /end MEASUREMENT
/begin MEASUREMENT bacc_c_um "Fehlerzähler: Botschaftsabsicherung ACC-Botschaft" UBYTE t40ms_ub_b10200 1 100 0 10200 FORMAT "%7.1" ECU_ADDRESS 0x38080B /end MEASUREMENT
/begin MEASUREMENT bgra_c_um "Fehlerzähler: Botschaftsabsicherung GRA-Botschaft" UBYTE t40ms_ub_b10200 1 100 0 10200 FORMAT "%7.1" ECU_ADDRESS 0x380812 /end MEASUREMENT
/begin MEASUREMENT bracc_c_um "Entprellzähler für betätigte Bremse in der Funktionsüberwachung" UBYTE t40ms_ub_b10200 1 100 0 10200 FORMAT "%7.1" ECU_ADDRESS 0x380813 /end MEASUREMENT
/begin MEASUREMENT brems_c_um "Entprellzähler für betätigte Bremse in der Funktionsüberwachung" UBYTE t40ms_ub_b10200 1 100 0 10200 FORMAT "%7.1" ECU_ADDRESS 0x380814 /end MEASUREMENT
/begin MEASUREMENT bresp_c_um "Entprellzähler für betätigte Bremse" UBYTE t40ms_ub_b10200 1 100 0 10200 FORMAT "%7.1" ECU_ADDRESS 0x380815 /end MEASUREMENT
/begin MEASUREMENT bzacc_a_um "Botschaftszähler (alter Wert) der ACC-Canbotschaft in der Überwachung" UBYTE dez 1 100 0 255 FORMAT "%5.1" ECU_ADDRESS 0x38080C /end MEASUREMENT
/begin MEASUREMENT bzacc_um "Botschaftszähler der ACC-Canbotschaft in der Überwachung" UBYTE dez 1 100 0 255 FORMAT "%5.1" ECU_ADDRESS 0x38080D /end MEASUREMENT
/begin MEASUREMENT bzgra_a_um "Botschaftszähler (alter Wert) der GRA-Canbotschaft in der Überwachung" UBYTE dez 1 100 0 255 FORMAT "%5.1" ECU_ADDRESS 0x380816 /end MEASUREMENT
/begin MEASUREMENT bzgra_um "Botschaftszähler der GRA-Canbotschaft in der Überwachung" UBYTE dez 1 100 0 255 FORMAT "%5.1" ECU_ADDRESS 0x380817 /end MEASUREMENT
/begin MEASUREMENT bzmsr_a_uc "" UBYTE dez 1 100 0 255 FORMAT "%5.1" ECU_ADDRESS 0x380B4B /end MEASUREMENT
/begin MEASUREMENT bzmsr_a_um "alter MSR-Botschaftszähler" UBYTE dez 1 100 0 255 FORMAT "%5.1" ECU_ADDRESS 0x380836 /end MEASUREMENT
/begin MEASUREMENT bz_msr_uc "" UBYTE dez 1 100 0 255 FORMAT "%5.1" ECU_ADDRESS 0x380B4C /end MEASUREMENT
/begin MEASUREMENT B_acc "Bedingung: ACC-Steuergerät vorhanden" UWORD B_TRUE 1 100 0 1 BIT_MASK 0x8 FORMAT "%13.11" ECU_ADDRESS 0xFD76 /end MEASUREMENT
/begin MEASUREMENT B_accen "Bedingung ADR über Login freigeschaltet" UWORD B_TRUE 1 100 0 1 BIT_MASK 0x10 FORMAT "%13.11" ECU_ADDRESS 0xFD76 /end MEASUREMENT
/begin MEASUREMENT B_accen_um "ACC-Einschaltung gültig in der Funktionsüberwachung" UBYTE B_TRUE 1 100 0 1 BIT_MASK 0x80 FORMAT "%13.11" ECU_ADDRESS 0x380804 /end MEASUREMENT
/begin MEASUREMENT B_acce_um "Fehlerinformation bzgl. ACC aus der ACC-Canbotschaft in der Überwachung" UBYTE B_TRUE 1 100 0 1 BIT_MASK 0x10 FORMAT "%13.11" ECU_ADDRESS 0x38080A /end MEASUREMENT
/begin MEASUREMENT B_accof_um "" UBYTE B_TRUE 1 100 0 1 BIT_MASK 0x40 FORMAT "%13.11" ECU_ADDRESS 0x380804 /end MEASUREMENT
/begin MEASUREMENT B_agrste "Bedingung AGR von Tankentlüftung gesperrt" UWORD B_TRUE 1 100 0 1 BIT_MASK 0x800 FORMAT "%13.11" ECU_ADDRESS 0xFD9C /end MEASUREMENT
/begin MEASUREMENT B_anschlag "" UWORD B_TRUE 1 100 0 1 BIT_MASK 0x4 FORMAT "%13.11" ECU_ADDRESS 0xFD06 /end MEASUREMENT
/begin MEASUREMENT B_bacce_um "Fehler in ACC-Botschaft in der Funktionsüberwachung" UWORD B_TRUE 1 100 0 1 BIT_MASK 0x100 FORMAT "%13.11" ECU_ADDRESS 0xFD92 /end MEASUREMENT
/begin MEASUREMENT B_bgrae_um "Fehler in GRA-Botschaft in der Funktionsüberwachung" UWORD B_TRUE 1 100 0 1 BIT_MASK 0x400 FORMAT "%13.11" ECU_ADDRESS 0xFD92 /end MEASUREMENT
/begin MEASUREMENT B_brems_um "Bedingung Bremse getreten für die Funktionsüberwachung" UBYTE B_TRUE 1 100 0 1 BIT_MASK 0x1 FORMAT "%13.11" ECU_ADDRESS 0x380803 /end MEASUREMENT
/begin MEASUREMENT B_brfgr_um "Bedingung Bremse getreten für die Funktionsüberwachung" UBYTE B_TRUE 1 100 0 1 BIT_MASK 0x2 FORMAT "%13.11" ECU_ADDRESS 0x380804 /end MEASUREMENT
/begin MEASUREMENT B_bsl_um "erkannter Low-Pegel am FGR-Bedienhebelschalter Beschleunigen in Funktionsüberw." UBYTE B_TRUE 1 100 0 1 BIT_MASK 0x10 FORMAT "%13.11" ECU_ADDRESS 0x380803 /end MEASUREMENT
/begin MEASUREMENT B_craus "Ausgewertet durch LREB: Werkstattbit zum Stillegen LR" UWORD B_TRUE 1 100 0 1 BIT_MASK 0x20 FORMAT "%13.11" ECU_ADDRESS 0xFD76 /end MEASUREMENT
/begin MEASUREMENT B_dcdis_c_um "" UBYTE B_TRUE 1 100 0 1 BIT_MASK 0x1 FORMAT "%13.11" ECU_ADDRESS 0x380805 /end MEASUREMENT
/begin MEASUREMENT B_dcdis_um "Fehlerreaktions-Info der Funktionsüberwachung (Abschaltung der DK-Steller-ES)" UBYTE B_TRUE 1 100 0 1 BIT_MASK 0x1 FORMAT "%13.11" ECU_ADDRESS 0x380802 /end MEASUREMENT
/begin MEASUREMENT B_fa "Bedingung Funktionsanforderung allgemein" UWORD B_TRUE 1 100 0 1 BIT_MASK 0x40 FORMAT "%13.11" ECU_ADDRESS 0xFD76 /end MEASUREMENT
/begin MEASUREMENT B_faa "Bedingung Funktionsanforderung automatischer Testablauf" UWORD B_TRUE 1 100 0 1 BIT_MASK 0x80 FORMAT "%13.11" ECU_ADDRESS 0xFD76 /end MEASUREMENT
/begin MEASUREMENT B_faadagl "Bedingung externe Anforderung der Adaption Lagesensor" UWORD B_TRUE 1 100 0 1 BIT_MASK 0x100 FORMAT "%13.11" ECU_ADDRESS 0xFD76 /end MEASUREMENT
/begin MEASUREMENT B_faadkl "Bedingung Funktionsanforderung Adaption AGR-Drosselklappe" UWORD B_TRUE 1 100 0 1 BIT_MASK 0x200 FORMAT "%13.11" ECU_ADDRESS 0xFD76 /end MEASUREMENT
/begin MEASUREMENT B_faagr "Bedingung Funktionsanforderung AGR und Diagnose für Kurztest" UWORD B_TRUE 1 100 0 1 BIT_MASK 0x400 FORMAT "%13.11" ECU_ADDRESS 0xFD76 /end MEASUREMENT
/begin MEASUREMENT B_faam "Anforderung allgemeine Momentenreserve Kurztrip" UWORD B_TRUE 1 100 0 1 BIT_MASK 0x800 FORMAT "%13.11" ECU_ADDRESS 0xFD76 /end MEASUREMENT
/begin MEASUREMENT B_faan "Bedingung Funktionsanforderung Allgemeine Drehzahlerhöhung" UWORD B_TRUE 1 100 0 1 BIT_MASK 0x1000 FORMAT "%13.11" ECU_ADDRESS 0xFD76 /end MEASUREMENT
/begin MEASUREMENT B_faatlb "Bedingung Funktionsanforderung ATL-Bypass" UWORD B_TRUE 1 100 0 1 BIT_MASK 0x2000 FORMAT "%13.11" ECU_ADDRESS 0xFD76 /end MEASUREMENT
/begin MEASUREMENT B_faatm "Bedingung Funktionsanforderung kurze Taupunktendezeiten" UWORD B_TRUE 1 100 0 1 BIT_MASK 0x4000 FORMAT "%13.11" ECU_ADDRESS 0xFD76 /end MEASUREMENT
/begin MEASUREMENT B_fabks "aus %TKMWL: Bedingung Funktionsanforderung BKS" UWORD B_TRUE 1 100 0 1 BIT_MASK 0x8000 FORMAT "%13.11" ECU_ADDRESS 0xFD76 /end MEASUREMENT
/begin MEASUREMENT B_fabkv "Bedingung: Funktionsanforderung Bremskraftverstärker" UWORD B_TRUE 1 100 0 1 BIT_MASK 0x1 FORMAT "%13.11" ECU_ADDRESS 0xFD78 /end MEASUREMENT
/begin MEASUREMENT B_fadesu "Bedingung Funktionsanforderung NOx-Kat Desulfatierung" UWORD B_TRUE 1 100 0 1 BIT_MASK 0x2 FORMAT "%13.11" ECU_ADDRESS 0xFD78 /end MEASUREMENT
/begin MEASUREMENT B_fadylsu "Bedingung Funktionsanforderung Dynamikdiagnose der LSU" UWORD B_TRUE 1 100 0 1 BIT_MASK 0x4 FORMAT "%13.11" ECU_ADDRESS 0xFD78 /end MEASUREMENT
/begin MEASUREMENT B_fadylsu2 "Bedingung Funktionsanforderung Dynamikdiagnose der LSU, Bank2" UWORD B_TRUE 1 100 0 1 BIT_MASK 0x8 FORMAT "%13.11" ECU_ADDRESS 0xFD78 /end MEASUREMENT
/begin MEASUREMENT B_faevz "Bedingung Zylinderausblendung durch Tester" UWORD B_TRUE 1 100 0 1 BIT_MASK 0x10 FORMAT "%13.11" ECU_ADDRESS 0xFD78 /end MEASUREMENT
/begin MEASUREMENT B_faezla "Bedingung : Funktionsanforderung DEZLA" UWORD B_TRUE 1 100 0 1 BIT_MASK 0x20 FORMAT "%13.11" ECU_ADDRESS 0xFD78 /end MEASUREMENT
/begin MEASUREMENT B_fafrst "Funktionsanforderung Kurztest" UWORD B_TRUE 1 100 0 1 BIT_MASK 0x40 FORMAT "%13.11" ECU_ADDRESS 0xFD78 /end MEASUREMENT
/begin MEASUREMENT B_fahsh "Bedingung Funktionsanforderung Diagnose Heizung Hinterkat-Lambdasonde" UWORD B_TRUE 1 100 0 1 BIT_MASK 0x80 FORMAT "%13.11" ECU_ADDRESS 0xFD78 /end MEASUREMENT
/begin MEASUREMENT B_fakat "Bedingung Funktionsanforderung Katalysatorüberwachung" UWORD B_TRUE 1 100 0 1 BIT_MASK 0x100 FORMAT "%13.11" ECU_ADDRESS 0xFD78 /end MEASUREMENT
/begin MEASUREMENT B_fakat2 "Bedingung Funktionanforderung Katalysatorüberwachung (Stereo 2.Bank)" UWORD B_TRUE 1 100 0 1 BIT_MASK 0x200 FORMAT "%13.11" ECU_ADDRESS 0xFD78 /end MEASUREMENT
/begin MEASUREMENT B_fakd "Bedingung Funktionsanforderung Kick-Down-Adaption" UWORD B_TRUE 1 100 0 1 BIT_MASK 0x400 FORMAT "%13.11" ECU_ADDRESS 0xFD78 /end MEASUREMENT
/begin MEASUREMENT B_fakmtr "Bedingung Funktionsanforderung Kühlmitteltemperaturreglung" UWORD B_TRUE 1 100 0 1 BIT_MASK 0x800 FORMAT "%13.11" ECU_ADDRESS 0xFD78 /end MEASUREMENT
/begin MEASUREMENT B_fakrs "Bedingung Funktionsanforderung Klopfsensordiagnose" UWORD B_TRUE 1 100 0 1 BIT_MASK 0x1000 FORMAT "%13.11" ECU_ADDRESS 0xFD78 /end MEASUREMENT
/begin MEASUREMENT B_fakth "Bedingung Funktionsanforderung thermische Katalysatordiagnose" UWORD B_TRUE 1 100 0 1 BIT_MASK 0x2000 FORMAT "%13.11" ECU_ADDRESS 0xFD78 /end MEASUREMENT
/begin MEASUREMENT B_fakth2 "Bedingung Funktionsanforderung thermische Katalysatordiagnose, Bank 2" UWORD B_TRUE 1 100 0 1 BIT_MASK 0x4000 FORMAT "%13.11" ECU_ADDRESS 0xFD78 /end MEASUREMENT
/begin MEASUREMENT B_fakvs "Funktionsaufforderung Diagnose Kraftstoffsystem für Schnelltest" UWORD B_TRUE 1 100 0 1 BIT_MASK 0x8000 FORMAT "%13.11" ECU_ADDRESS 0xFD78 /end MEASUREMENT
/begin MEASUREMENT B_falbk "Funktionsaufforderung Offsetlernen der LBK" UWORD B_TRUE 1 100 0 1 BIT_MASK 0x1 FORMAT "%13.11" ECU_ADDRESS 0xFD7A /end MEASUREMENT
/begin MEASUREMENT B_faldp "Bedingung Funktionsanforderung Leckdiagnosepumpe" UWORD B_TRUE 1 100 0 1 BIT_MASK 0x2 FORMAT "%13.11" ECU_ADDRESS 0xFD7A /end MEASUREMENT
/begin MEASUREMENT B_falr "Bedingung: Funktionsanforderung Lambdaregelung aus" UWORD B_TRUE 1 100 0 1 BIT_MASK 0x4 FORMAT "%13.11" ECU_ADDRESS 0xFD7A /end MEASUREMENT
/begin MEASUREMENT B_falra "Bedingung: Funktionsanforderung Lambdaregelung-Adaption" UWORD B_TRUE 1 100 0 1 BIT_MASK 0x8 FORMAT "%13.11" ECU_ADDRESS 0xFD7A /end MEASUREMENT
/begin MEASUREMENT B_falrsfk "Bedingung Funktionsanforderung LRFKEB" UWORD B_TRUE 1 100 0 1 BIT_MASK 0x10 FORMAT "%13.11" ECU_ADDRESS 0xFD7A /end MEASUREMENT
/begin MEASUREMENT B_falrshk "Bedingung Funktionsanforderung LRSHK" UWORD B_TRUE 1 100 0 1 BIT_MASK 0x20 FORMAT "%13.11" ECU_ADDRESS 0xFD7A /end MEASUREMENT
/begin MEASUREMENT B_falrshk2 "Bedingung Funktionsanforderung LRSHK Bank 2" UWORD B_TRUE 1 100 0 1 BIT_MASK 0x40 FORMAT "%13.11" ECU_ADDRESS 0xFD7A /end MEASUREMENT
/begin MEASUREMENT B_falsf "Bedingung Funktionsanforderung Lambda-Sonde hinter Front KAT" UWORD B_TRUE 1 100 0 1 BIT_MASK 0x80 FORMAT "%13.11" ECU_ADDRESS 0xFD7A /end MEASUREMENT
/begin MEASUREMENT B_falsf2 "Bedingung Funktionsanforderung Lambda-Sonde hinter Front KAT Bank2" UWORD B_TRUE 1 100 0 1 BIT_MASK 0x100 FORMAT "%13.11" ECU_ADDRESS 0xFD7A /end MEASUREMENT
/begin MEASUREMENT B_falsfhv "Bedingung-Funktionsanforderung Front/Hinter Hauptkat. LS Vertauschung diagnose" UWORD B_TRUE 1 100 0 1 BIT_MASK 0x200 FORMAT "%13.11" ECU_ADDRESS 0xFD7A /end MEASUREMENT
/begin MEASUREMENT B_falsfhv2 "" UWORD B_TRUE 1 100 0 1 BIT_MASK 0x400 FORMAT "%13.11" ECU_ADDRESS 0xFD7A /end MEASUREMENT
/begin MEASUREMENT B_falsh "Bedingung Funktionsanforderung Lambda-Sonde hinter KAT" UWORD B_TRUE 1 100 0 1 BIT_MASK 0x800 FORMAT "%13.11" ECU_ADDRESS 0xFD7A /end MEASUREMENT
/begin MEASUREMENT B_falshv "Bedingung Funktionsanforderung für Kurztrip Vertauschung Lambda-Sonde hinter KAT" UWORD B_TRUE 1 100 0 1 BIT_MASK 0x1000 FORMAT "%13.11" ECU_ADDRESS 0xFD7A /end MEASUREMENT
/begin MEASUREMENT B_falsv "Bedingung Funktionsanforderung Lambda-Sonde vor KAT" UWORD B_TRUE 1 100 0 1 BIT_MASK 0x2000 FORMAT "%13.11" ECU_ADDRESS 0xFD7A /end MEASUREMENT
/begin MEASUREMENT B_falsv2 "Bedingung Funktionsanforderung Lambda-Sonde vor KAT Bank2" UWORD B_TRUE 1 100 0 1 BIT_MASK 0x4000 FORMAT "%13.11" ECU_ADDRESS 0xFD7A /end MEASUREMENT
/begin MEASUREMENT B_falues "Bedingung Funktionsanforderung Lüfteransteuerung" UWORD B_TRUE 1 100 0 1 BIT_MASK 0x8000 FORMAT "%13.11" ECU_ADDRESS 0xFD7A /end MEASUREMENT
/begin MEASUREMENT B_falzsr "Bedingung Funktionsanforderung Diagnose Leck zum Saugrohr für Kurztest" UWORD B_TRUE 1 100 0 1 BIT_MASK 0x1 FORMAT "%13.11" ECU_ADDRESS 0xFD7C /end MEASUREMENT
/begin MEASUREMENT B_fan "Bedingung Funktionsanforderung Drehzahlerhöhung für Kurztrip" UWORD B_TRUE 1 100 0 1 BIT_MASK 0x2 FORMAT "%13.11" ECU_ADDRESS 0xFD7C /end MEASUREMENT
/begin MEASUREMENT B_fanohk "Bedingung Funktionsanforderung Diagnose NOx-Kat" UWORD B_TRUE 1 100 0 1 BIT_MASK 0x4 FORMAT "%13.11" ECU_ADDRESS 0xFD7C /end MEASUREMENT
/begin MEASUREMENT B_fanwkw "Bedingung Funktionsanforderung Nockenwellenstellung" UWORD B_TRUE 1 100 0 1 BIT_MASK 0x8 FORMAT "%13.11" ECU_ADDRESS 0xFD7C /end MEASUREMENT
/begin MEASUREMENT B_fanws "Bedingung Funktionsanforderung Diagnose Nockenwellensteuerung" UWORD B_TRUE 1 100 0 1 BIT_MASK 0x10 FORMAT "%13.11" ECU_ADDRESS 0xFD7C /end MEASUREMENT
/begin MEASUREMENT B_fanwsa "Bedingung Funktionsanforderung Diagnose Nockenwellensteuerung (Auslaß)" UWORD B_TRUE 1 100 0 1 BIT_MASK 0x20 FORMAT "%13.11" ECU_ADDRESS 0xFD7C /end MEASUREMENT
/begin MEASUREMENT B_fanwse "Bedingung Funktionsanforderung Diagnose Nockenwellensteuerung (Einlaßseitig)" UWORD B_TRUE 1 100 0 1 BIT_MASK 0x40 FORMAT "%13.11" ECU_ADDRESS 0xFD7C /end MEASUREMENT
/begin MEASUREMENT B_faobv "Bedingung Funktionsanforderung Overboost-Verbot" UWORD B_TRUE 1 100 0 1 BIT_MASK 0x80 FORMAT "%13.11" ECU_ADDRESS 0xFD7C /end MEASUREMENT
/begin MEASUREMENT B_fapllsu "Bedingung Funktionsanforderung Plausibilitätsdiagnose der LSU" UWORD B_TRUE 1 100 0 1 BIT_MASK 0x100 FORMAT "%13.11" ECU_ADDRESS 0xFD7C /end MEASUREMENT
/begin MEASUREMENT B_fapllsu2 "Bedingung Funktionsanforderung Plausibilitätsdiagnose der  LSU (Bank2)" UWORD B_TRUE 1 100 0 1 BIT_MASK 0x200 FORMAT "%13.11" ECU_ADDRESS 0xFD7C /end MEASUREMENT
/begin MEASUREMENT B_fasalsu "Bedingung: Funktionsanforderung Schubabgleich" UWORD B_TRUE 1 100 0 1 BIT_MASK 0x400 FORMAT "%13.11" ECU_ADDRESS 0xFD7C /end MEASUREMENT
/begin MEASUREMENT B_fasf "Bedingung Funktionsanforderung Schwingungsprüfung hinter Front KAT" UWORD B_TRUE 1 100 0 1 BIT_MASK 0x800 FORMAT "%13.11" ECU_ADDRESS 0xFD7C /end MEASUREMENT
/begin MEASUREMENT B_fasf2 "Bedingung Funktionsanforderung Schwingungsprüfung hinter Front KAT Bank2" UWORD B_TRUE 1 100 0 1 BIT_MASK 0x1000 FORMAT "%13.11" ECU_ADDRESS 0xFD7C /end MEASUREMENT
/begin MEASUREMENT B_fash "Bedingung Funktionsanforderung Schwingungsprüfung" UWORD B_TRUE 1 100 0 1 BIT_MASK 0x2000 FORMAT "%13.11" ECU_ADDRESS 0xFD7C /end MEASUREMENT
/begin MEASUREMENT B_fash2 "Bedingung Funktionsanforderung Schwingungsprüfung Bank2" UWORD B_TRUE 1 100 0 1 BIT_MASK 0x4000 FORMAT "%13.11" ECU_ADDRESS 0xFD7C /end MEASUREMENT
/begin MEASUREMENT B_fasls "Bedingung Funktionsanforderung Sekundärluftsystem" UWORD B_TRUE 1 100 0 1 BIT_MASK 0x8000 FORMAT "%13.11" ECU_ADDRESS 0xFD7C /end MEASUREMENT
/begin MEASUREMENT B_fates "Bedingung Funktionsanforderung Tankentlüftungssystem" UWORD B_TRUE 1 100 0 1 BIT_MASK 0x1 FORMAT "%13.11" ECU_ADDRESS 0xFD7E /end MEASUREMENT
/begin MEASUREMENT B_fatnv "Bedingung: Funktionsanforderung %DGGTNVK" UWORD B_TRUE 1 100 0 1 BIT_MASK 0x2 FORMAT "%13.11" ECU_ADDRESS 0xFD7E /end MEASUREMENT
/begin MEASUREMENT B_fatnv2 "Bedingung: Funktionsanforderung %DGGTNVK Bank 2" UWORD B_TRUE 1 100 0 1 BIT_MASK 0x4 FORMAT "%13.11" ECU_ADDRESS 0xFD7E /end MEASUREMENT
/begin MEASUREMENT B_fatp "Bedingung Funktionsanforderung TP-Überwachung" UWORD B_TRUE 1 100 0 1 BIT_MASK 0x8 FORMAT "%13.11" ECU_ADDRESS 0xFD7E /end MEASUREMENT
/begin MEASUREMENT B_fatp2 "Bedingung Funktionsanforderung TP-Überwachung Bank2" UWORD B_TRUE 1 100 0 1 BIT_MASK 0x10 FORMAT "%13.11" ECU_ADDRESS 0xFD7E /end MEASUREMENT
/begin MEASUREMENT B_fatv "Bedingung Funktionsanforderung TV-Überwachung" UWORD B_TRUE 1 100 0 1 BIT_MASK 0x20 FORMAT "%13.11" ECU_ADDRESS 0xFD7E /end MEASUREMENT
/begin MEASUREMENT B_fatv2 "Bedingung Funktionsanforderung TV-Überwachung Bank2" UWORD B_TRUE 1 100 0 1 BIT_MASK 0x40 FORMAT "%13.11" ECU_ADDRESS 0xFD7E /end MEASUREMENT
/begin MEASUREMENT B_fgrenold_um "" UBYTE B_TRUE 1 100 0 1 BIT_MASK 0x80 FORMAT "%13.11" ECU_ADDRESS 0x380803 /end MEASUREMENT
/begin MEASUREMENT B_fgren_um "FGR-/ACC-Einschaltung aus Bedienhebel gültig in der Funktionsüberwachung" UBYTE B_TRUE 1 100 0 1 BIT_MASK 0x4 FORMAT "%13.11" ECU_ADDRESS 0x380803 /end MEASUREMENT
/begin MEASUREMENT B_fgrfr_uc "FGR-/ACC-Momenteneingriff erlaubt im Befehlstest" UWORD B_TRUE 1 100 0 1 BIT_MASK 0x4000 FORMAT "%13.11" ECU_ADDRESS 0xFD94 /end MEASUREMENT
/begin MEASUREMENT B_fgron_um "" UBYTE B_TRUE 1 100 0 1 BIT_MASK 0x4 FORMAT "%13.11" ECU_ADDRESS 0x380804 /end MEASUREMENT
/begin MEASUREMENT B_fgrte "Bedingung FGR vom Tester freigegeben" UWORD B_TRUE 1 100 0 1 BIT_MASK 0x80 FORMAT "%13.11" ECU_ADDRESS 0xFD7E /end MEASUREMENT
/begin MEASUREMENT B_fgr_um "FGR-/ACC-Momenteneingriff in der Funktionsüberwachung erlaubt" UWORD B_TRUE 1 100 0 1 BIT_MASK 0x40 FORMAT "%13.11" ECU_ADDRESS 0xFD94 /end MEASUREMENT
/begin MEASUREMENT B_fgr_um_c "" UBYTE B_TRUE 1 100 0 1 BIT_MASK 0x2 FORMAT "%13.11" ECU_ADDRESS 0x380805 /end MEASUREMENT
/begin MEASUREMENT b_flags_um "Flag für Bitinformationen in der Funktionsüberwachung" UBYTE dez 1 100 0 255 FORMAT "%5.1" ECU_ADDRESS 0x380800 /end MEASUREMENT
/begin MEASUREMENT B_graat_um "Bedingung GRA-Tipschalter Aus betätigt in Funktionsüberwachung" UBYTE B_TRUE 1 100 0 1 BIT_MASK 0x2 FORMAT "%13.11" ECU_ADDRESS 0x380810 /end MEASUREMENT
/begin MEASUREMENT B_graen_um "Freigabe des FGR über GRA-Bedienhebel in der Überwachung" UWORD B_TRUE 1 100 0 1 BIT_MASK 0x800 FORMAT "%13.11" ECU_ADDRESS 0xFD92 /end MEASUREMENT
/begin MEASUREMENT B_grahe_um "Bedingung GRA-Bedienhebelfehler in Funktionsüberwachung" UBYTE B_TRUE 1 100 0 1 BIT_MASK 0x40 FORMAT "%13.11" ECU_ADDRESS 0x380810 /end MEASUREMENT
/begin MEASUREMENT B_grahs_um "Bedingung GRA-Hauptschalter betätigt in Funktionsüberwachung" UBYTE B_TRUE 1 100 0 1 BIT_MASK 0x1 FORMAT "%13.11" ECU_ADDRESS 0x380810 /end MEASUREMENT
/begin MEASUREMENT B_grase_um "Bedingung GRA-Tipschalter Setzen betätigt in Funktionsüberwachung" UBYTE B_TRUE 1 100 0 1 BIT_MASK 0x1 FORMAT "%13.11" ECU_ADDRESS 0x380811 /end MEASUREMENT
/begin MEASUREMENT B_gratd_um "Bedingung GRA-Tipschalter Tip-DOWN betätigt in Funktionsüberwachung" UBYTE B_TRUE 1 100 0 1 BIT_MASK 0x4 FORMAT "%13.11" ECU_ADDRESS 0x380810 /end MEASUREMENT
/begin MEASUREMENT B_gratu_um "Bedingung GRA-Tipschalter Tip-UP betätigt in Funktionsüberwachung" UBYTE B_TRUE 1 100 0 1 BIT_MASK 0x8 FORMAT "%13.11" ECU_ADDRESS 0x380810 /end MEASUREMENT
/begin MEASUREMENT B_grawa_um "Bedingung GRA-Tipschalter Wiederaufnahme betätigt in Funktionsüberwachung" UBYTE B_TRUE 1 100 0 1 BIT_MASK 0x2 FORMAT "%13.11" ECU_ADDRESS 0x380811 /end MEASUREMENT
/begin MEASUREMENT B_grdst "Bedingung Grundeinstellung" UWORD B_TRUE 1 100 0 1 BIT_MASK 0x100 FORMAT "%13.11" ECU_ADDRESS 0xFD7E /end MEASUREMENT
/begin MEASUREMENT B_gwrte "Bedingung fr-Grenzwertregelung Tankentlüftung aktiv" UWORD B_TRUE 1 100 0 1 BIT_MASK 0x1000 FORMAT "%13.11" ECU_ADDRESS 0xFD9C /end MEASUREMENT
/begin MEASUREMENT B_hlon "Bedingung Heißland aktiv" UWORD B_TRUE 1 100 0 1 BIT_MASK 0x200 FORMAT "%13.11" ECU_ADDRESS 0xFD7E /end MEASUREMENT
/begin MEASUREMENT B_i_ska "Funktions-Fehlerreaktion irreversible SKA (Sicherheits-Kraftstoffabschaltung)" UBYTE B_TRUE 1 100 0 1 BIT_MASK 0x4 FORMAT "%13.11" ECU_ADDRESS 0x380802 /end MEASUREMENT
/begin MEASUREMENT B_i_ska_um "Fehlerreaktion irrev. SKA (Sicherheitskraftstoffabschaltung) aus Fkt-Überwachung" UWORD B_TRUE 1 100 0 1 BIT_MASK 0x40 FORMAT "%13.11" ECU_ADDRESS 0xFD92 /end MEASUREMENT
/begin MEASUREMENT B_kkl_um "erkannter Low-Pegel am FGR-Bedienhebelschalter Kontrollkontakt in Funktionsüberw" UBYTE B_TRUE 1 100 0 1 BIT_MASK 0x40 FORMAT "%13.11" ECU_ADDRESS 0x380803 /end MEASUREMENT
/begin MEASUREMENT B_kstebf "Bedingung Kraftstofferstbefüllung" UWORD B_TRUE 1 100 0 1 BIT_MASK 0x400 FORMAT "%13.11" ECU_ADDRESS 0xFD7E /end MEASUREMENT
/begin MEASUREMENT B_ll_um "Bedingung Leerlauf für Ebene II" UBYTE B_TRUE 1 100 0 1 BIT_MASK 0x1 FORMAT "%13.11" ECU_ADDRESS 0x380800 /end MEASUREMENT
/begin MEASUREMENT B_lrar "Bedingung reduzierte Korrekturbereiche in der LRA" UWORD B_TRUE 1 100 0 1 BIT_MASK 0x2000 FORMAT "%13.11" ECU_ADDRESS 0xFD9C /end MEASUREMENT
/begin MEASUREMENT B_lrndia "Bedingung: DV-E-Adaption und Prüfungen per Diagnose-Tester aktivieren" UWORD B_TRUE 1 100 0 1 BIT_MASK 0x800 FORMAT "%13.11" ECU_ADDRESS 0xFD7E /end MEASUREMENT
/begin MEASUREMENT B_luef1 "Bedingung zur Aktivierung Drehzahlfenster 1 für Lüftersteuerung" UBYTE B_TRUE 1 100 0 1 BIT_MASK 0x1 FORMAT "%13.11" ECU_ADDRESS 0x384013 /end MEASUREMENT
/begin MEASUREMENT B_luef2 "Bedingung zur Aktivierung Drehzahlfenster 2 für Lüftersteuerung" UBYTE B_TRUE 1 100 0 1 BIT_MASK 0x2 FORMAT "%13.11" ECU_ADDRESS 0x384013 /end MEASUREMENT
/begin MEASUREMENT B_luef3 "Bedingung zur Aktivierung Drehzahlfenster 3 für Lüftersteuerung" UBYTE B_TRUE 1 100 0 1 BIT_MASK 0x4 FORMAT "%13.11" ECU_ADDRESS 0x384013 /end MEASUREMENT
/begin MEASUREMENT B_msthw_um "Bedingung Master-SG gemäß Codier-Pin für die Funktionsüberwachung" UBYTE B_TRUE 1 100 0 1 BIT_MASK 0x80 FORMAT "%13.11" ECU_ADDRESS 0x380805 /end MEASUREMENT
/begin MEASUREMENT B_mzns_c_um "" UBYTE B_TRUE 1 100 0 1 BIT_MASK 0x20 FORMAT "%13.11" ECU_ADDRESS 0x380805 /end MEASUREMENT
/begin MEASUREMENT B_mzns_um "Nachstartaufweitung des zuläsigen Moments in der Funktonsüberwachung aktiv" UWORD B_TRUE 1 100 0 1 BIT_MASK 0x2000 FORMAT "%13.11" ECU_ADDRESS 0xFD92 /end MEASUREMENT
/begin MEASUREMENT B_nkons_um "Bedingung MSR-Botschaft ist nicht konsistent" UWORD B_TRUE 1 100 0 1 BIT_MASK 0x80 FORMAT "%13.11" ECU_ADDRESS 0xFD94 /end MEASUREMENT
/begin MEASUREMENT B_nlh_um "Anforderung Notlauf  mit Lambda 1 aus Funktionsüberwachung" UBYTE B_TRUE 1 100 0 1 BIT_MASK 0x4 FORMAT "%13.11" ECU_ADDRESS 0x380800 /end MEASUREMENT
/begin MEASUREMENT B_noacc_um "Bedingung keine Übernahme des ACC-Momentes" UWORD B_TRUE 1 100 0 1 BIT_MASK 0x200 FORMAT "%13.11" ECU_ADDRESS 0xFD92 /end MEASUREMENT
/begin MEASUREMENT B_nobrs_um "Bremsenbotschaft in der Funktionsüberwachung nicht übernommen" UBYTE B_TRUE 1 100 0 1 BIT_MASK 0x80 FORMAT "%13.11" ECU_ADDRESS 0x380800 /end MEASUREMENT
/begin MEASUREMENT B_nome_c_um "" UBYTE B_TRUE 1 100 0 1 BIT_MASK 0x8 FORMAT "%13.11" ECU_ADDRESS 0x380805 /end MEASUREMENT
/begin MEASUREMENT B_nomsrfr_uc "" UWORD B_TRUE 1 100 0 1 BIT_MASK 0x8000 FORMAT "%13.11" ECU_ADDRESS 0xFD94 /end MEASUREMENT
/begin MEASUREMENT B_nomsr_um "MSR-Momentenvorgabe in der Funktionsüberwachung nicht übernommen" UWORD B_TRUE 1 100 0 1 BIT_MASK 0x100 FORMAT "%13.11" ECU_ADDRESS 0xFD94 /end MEASUREMENT
/begin MEASUREMENT B_nosgs_um "SGS-Momentenvorgabe in der Funktionsüberwachung nicht übernommen" UWORD B_TRUE 1 100 0 1 BIT_MASK 0x4000 FORMAT "%13.11" ECU_ADDRESS 0xFD92 /end MEASUREMENT
/begin MEASUREMENT B_notlu "Anforderung Notluftfahren aus der Funktion" UBYTE B_TRUE 1 100 0 1 BIT_MASK 0x8 FORMAT "%13.11" ECU_ADDRESS 0x380802 /end MEASUREMENT
/begin MEASUREMENT B_notst_um "" UBYTE B_TRUE 1 100 0 1 BIT_MASK 0x8 FORMAT "%13.11" ECU_ADDRESS 0x380800 /end MEASUREMENT
/begin MEASUREMENT B_nsakt_um "Nachstart aktiv für die Fkt.-Überwachung" UBYTE B_TRUE 1 100 0 1 BIT_MASK 0x4 FORMAT "%13.11" ECU_ADDRESS 0x380801 /end MEASUREMENT
/begin MEASUREMENT B_nsend_um "Nachstartüberwachungszeit abgelaufen für die Fkt.-Überwachung" UBYTE B_TRUE 1 100 0 1 BIT_MASK 0x1 FORMAT "%13.11" ECU_ADDRESS 0x380801 /end MEASUREMENT
/begin MEASUREMENT B_pwgnotum "= b_pwgnot_um Funktionsüberwachungs-Fehlerreaktion PWG-Leerlauf (= b_pwgnot_sr)" UWORD B_TRUE 1 100 0 1 BIT_MASK 0x10 FORMAT "%13.11" ECU_ADDRESS 0xFD94 /end MEASUREMENT
/begin MEASUREMENT B_qtedab "Bedingung schnelle Absteuerung der Spülrate" UWORD B_TRUE 1 100 0 1 BIT_MASK 0x40 FORMAT "%13.11" ECU_ADDRESS 0xFD9C /end MEASUREMENT
/begin MEASUREMENT B_res_um "" UBYTE B_TRUE 1 100 0 1 BIT_MASK 0x2 FORMAT "%13.11" ECU_ADDRESS 0x380803 /end MEASUREMENT
/begin MEASUREMENT B_rlc_um "Bedingung Überwachung auf Basis Luftmasse" UBYTE B_TRUE 1 100 0 1 BIT_MASK 0x2 FORMAT "%13.11" ECU_ADDRESS 0x380800 /end MEASUREMENT
/begin MEASUREMENT B_sersw "" UWORD B_TRUE 1 100 0 1 BIT_MASK 0x2000 FORMAT "%13.11" ECU_ADDRESS 0xFD90 /end MEASUREMENT
/begin MEASUREMENT B_tDelayEnd "" UWORD B_TRUE 1 100 0 1 BIT_MASK 0x4000 FORMAT "%13.11" ECU_ADDRESS 0xFD90 /end MEASUREMENT
/begin MEASUREMENT B_te "Bedingung Tankentlüftung" UWORD B_TRUE 1 100 0 1 BIT_MASK 0x80 FORMAT "%13.11" ECU_ADDRESS 0xFD9C /end MEASUREMENT
/begin MEASUREMENT B_teabb "Bedingung Tankentlüftung abbruchbereit" UWORD B_TRUE 1 100 0 1 BIT_MASK 0x4000 FORMAT "%13.11" ECU_ADDRESS 0xFD9C /end MEASUREMENT
/begin MEASUREMENT B_teakt "Bedingung Tankentlüftung aktiv (normaler Betrieb oder Notlauf)" UWORD B_TRUE 1 100 0 1 BIT_MASK 0x8000 FORMAT "%13.11" ECU_ADDRESS 0xFD9C /end MEASUREMENT
/begin MEASUREMENT B_tef "Bedingung Tankentlüftung prinzipiell freigegeben" UWORD B_TRUE 1 100 0 1 BIT_MASK 0x100 FORMAT "%13.11" ECU_ADDRESS 0xFD9C /end MEASUREMENT
/begin MEASUREMENT B_tehb "Bedingung Tankentlüftung mit hoher Beladung" UWORD B_TRUE 1 100 0 1 BIT_MASK 0x1 FORMAT "%13.11" ECU_ADDRESS 0xFD9E /end MEASUREMENT
/begin MEASUREMENT B_tehbx "Bedingung Beladungsintegrator ftead am Maximalanschlag" UWORD B_TRUE 1 100 0 1 BIT_MASK 0x2 FORMAT "%13.11" ECU_ADDRESS 0xFD9E /end MEASUREMENT
/begin MEASUREMENT B_tei "Bedingung Tankentlüftung funktionsintern" UWORD B_TRUE 1 100 0 1 BIT_MASK 0x200 FORMAT "%13.11" ECU_ADDRESS 0xFD9C /end MEASUREMENT
/begin MEASUREMENT B_ten "Bedingung Tankentlüftung im Notlaufbetrieb (ohne Lambdaregelung)" UWORD B_TRUE 1 100 0 1 BIT_MASK 0x400 FORMAT "%13.11" ECU_ADDRESS 0xFD9C /end MEASUREMENT
/begin MEASUREMENT B_tenmda "Notlauf TE beim Aussetzer" UBYTE B_TRUE 1 100 0 1 BIT_MASK 0x1 FORMAT "%13.11" ECU_ADDRESS 0x3848F5 /end MEASUREMENT
/begin MEASUREMENT B_timev_inc "" UWORD B_TRUE 1 100 0 1 BIT_MASK 0x200 FORMAT "%13.11" ECU_ADDRESS 0xFD06 /end MEASUREMENT
/begin MEASUREMENT B_timfast "EGAS: DFH Geschwindigkeit; Timer läuft schnell" UWORD B_TRUE 1 100 0 1 BIT_MASK 0x2 FORMAT "%13.11" ECU_ADDRESS 0xFD50 /end MEASUREMENT
/begin MEASUREMENT B_trev_inc "" UWORD B_TRUE 1 100 0 1 BIT_MASK 0x20 FORMAT "%13.11" ECU_ADDRESS 0xFD06 /end MEASUREMENT
/begin MEASUREMENT B_tuning "" UWORD B_TRUE 1 100 0 1 BIT_MASK 0x8000 FORMAT "%13.11" ECU_ADDRESS 0xFD90 /end MEASUREMENT
/begin MEASUREMENT B_ubska_c_um "" UBYTE B_TRUE 1 100 0 1 BIT_MASK 0x10 FORMAT "%13.11" ECU_ADDRESS 0x380805 /end MEASUREMENT
/begin MEASUREMENT B_ub_ska "Batteriespannung nicht o.k., Unterspannungsabschaltung aktiv" UBYTE B_TRUE 1 100 0 1 BIT_MASK 0x2 FORMAT "%13.11" ECU_ADDRESS 0x380802 /end MEASUREMENT
/begin MEASUREMENT B_vbmag_um "Verbot Magerbetrieb aus Überwachung" UWORD B_TRUE 1 100 0 1 BIT_MASK 0x400 FORMAT "%13.11" ECU_ADDRESS 0xFD94 /end MEASUREMENT
/begin MEASUREMENT B_vzl_um "erkannter Low-Pegel am FGR-Bedienhebelschalter Verzögern in der Funktionsüberw." UBYTE B_TRUE 1 100 0 1 BIT_MASK 0x8 FORMAT "%13.11" ECU_ADDRESS 0x380803 /end MEASUREMENT
/begin MEASUREMENT B_wal_um "erkannter Low-Pegel am FGR-Bedienhebelschalter Wiederaufnahme in Funktionsüberw." UBYTE B_TRUE 1 100 0 1 BIT_MASK 0x20 FORMAT "%13.11" ECU_ADDRESS 0x380803 /end MEASUREMENT
/begin MEASUREMENT ctr_hscmp "" UBYTE dez 1 100 0 255 FORMAT "%5.1" ECU_ADDRESS 0x380B3B /end MEASUREMENT
/begin MEASUREMENT dbacc_c_um "Fehlerzähler: Botschaftsabsicherung ACC-Botschaft (Alive)" UBYTE t40ms_ub_b10200 1 100 0 10200 FORMAT "%7.1" ECU_ADDRESS 0x38080E /end MEASUREMENT
/begin MEASUREMENT dbgra_c_um "Entprellzähler für Botschaftzählerüberwachung" UBYTE t40ms_ub_b10200 1 100 0 10200 FORMAT "%7.1" ECU_ADDRESS 0x380818 /end MEASUREMENT
/begin MEASUREMENT dftef_w "Eingang Integrator Spülrate" SWORD perio_sw_b1p562 1 100 -1.562 1.56195 FORMAT "%8.6" ECU_ADDRESS 0x382A7C /end MEASUREMENT
/begin MEASUREMENT dkatefrg "Abweichung Kraftstoffanteil Tankentlüftung bei Sollspülrate von Zielwert" SBYTE fak_sb_b1 1 100 -1 0.992188 FORMAT "%5.3" ECU_ADDRESS 0x380B89 /end MEASUREMENT
/begin MEASUREMENT dkhc_w "Eingang Integrator HC-Konzentration" SWORD perio_sw_b6p125 1 100 -6.125 6.12481 FORMAT "%8.6" ECU_ADDRESS 0x385372 /end MEASUREMENT
/begin MEASUREMENT dmlftef "Produkt Spülrate mal prozentuale Luftmassenänderung" UBYTE fak_ub_b0p5 1 100 0 0.498047 ECU_ADDRESS 0x380B8A /end MEASUREMENT
/begin MEASUREMENT dmssginr "relative Änderung des Massenstromes mssgin_w" SBYTE fak_sb_b1 1 100 -1 0.992188 FORMAT "%5.3" ECU_ADDRESS 0x380B8B /end MEASUREMENT
/begin MEASUREMENT dstert20_w "Normierte Weitertransportstrecke Regeneriergas im Saugrohr im 20ms-Raster" UWORD fak_uw_b2 1 100 0 1.99997 FORMAT "%8.6" ECU_ADDRESS 0x382A7E /end MEASUREMENT
/begin MEASUREMENT dzw_um "Delta Zündwinkel zwischen zwopt und zwout in der Funktionsüberwachung" UBYTE zw_ub_q0p75 1 100 0 191.25 FORMAT "%5.1" ECU_ADDRESS 0x380839 /end MEASUREMENT
/begin MEASUREMENT ei_adcc_um "irreversibles Fehlerbit bei der AD-Wandler-Überwachung" UWORD B_TRUE 1 100 0 1 BIT_MASK 0x2000 FORMAT "%13.11" ECU_ADDRESS 0xFD94 /end MEASUREMENT
/begin MEASUREMENT ei_ipa_um "irrev. Fehlerbit für unterer DK-Anschlag im ungültigen Bereich in der Fkt-Überw." UWORD B_TRUE 1 100 0 1 BIT_MASK 0x2 FORMAT "%13.11" ECU_ADDRESS 0xFD94 /end MEASUREMENT
/begin MEASUREMENT ei_msrc_um "irreversibles Fehlerbit bei der MSR-Überwachung der Funktionsüberwachung" UWORD B_TRUE 1 100 0 1 BIT_MASK 0x200 FORMAT "%13.11" ECU_ADDRESS 0xFD94 /end MEASUREMENT
/begin MEASUREMENT ei_mver_um "irreversibles Fehlerbit beim Momentenvergleich der Funktionsüberwachung" UWORD B_TRUE 1 100 0 1 BIT_MASK 0x800 FORMAT "%13.11" ECU_ADDRESS 0xFD94 /end MEASUREMENT
/begin MEASUREMENT ei_nc_um "irreversibles Fehlerbit beim Drehzahlvergleich der Funktionsüberwachung" UWORD B_TRUE 1 100 0 1 BIT_MASK 0x1000 FORMAT "%13.11" ECU_ADDRESS 0xFD92 /end MEASUREMENT
/begin MEASUREMENT ei_reac_um "irreversibles Fehlerbit der Fehlerreaktionsüberwachung der Funktionsüberwachung" UWORD B_TRUE 1 100 0 1 BIT_MASK 0x1000 FORMAT "%13.11" ECU_ADDRESS 0xFD94 /end MEASUREMENT
/begin MEASUREMENT ei_rlc_um "irreversibles Fehlerbit beim rl-Vergleich mit der Funktion in der Funktionsüberw" UWORD B_TRUE 1 100 0 1 BIT_MASK 0x4 FORMAT "%13.11" ECU_ADDRESS 0xFD94 /end MEASUREMENT
/begin MEASUREMENT ei_rlip_um "irreversibles Fehlerbit beim rl/rlip-Vergleich der Funktionsüberwachung" UWORD B_TRUE 1 100 0 1 BIT_MASK 0x8 FORMAT "%13.11" ECU_ADDRESS 0xFD94 /end MEASUREMENT
/begin MEASUREMENT ei_sgsc_um "irreversibles Fehlerbit bei der SGS-Überwachung der Funktionsüberwachung" UWORD B_TRUE 1 100 0 1 BIT_MASK 0x8000 FORMAT "%13.11" ECU_ADDRESS 0xFD92 /end MEASUREMENT
/begin MEASUREMENT ei_spsc_um "irreversibles Fehlerbit bei d. Sollwertplausibilisierung d. Funktionsüberwachung" UWORD B_TRUE 1 100 0 1 BIT_MASK 0x20 FORMAT "%13.11" ECU_ADDRESS 0xFD94 /end MEASUREMENT
/begin MEASUREMENT ei_ubr_um "irrev. Fehlerbit zur Anforderung Fehlereintrag Hauptrelais-Diagnose aus %UMAUSC" UWORD B_TRUE 1 100 0 1 BIT_MASK 0x20 FORMAT "%13.11" ECU_ADDRESS 0xFD92 /end MEASUREMENT
/begin MEASUREMENT ei_zwc_um "irreversibles Fehlerbit bei der Zündwinkelüberwachung der Funktionsüberwachung" UWORD B_TRUE 1 100 0 1 BIT_MASK 0x1 FORMAT "%13.11" ECU_ADDRESS 0xFD94 /end MEASUREMENT
/begin MEASUREMENT etate "Motorwirkungsgrad bei Tankentlüftung mit hoher Beladung" UBYTE rel_ub_b127p5 1 100 0 127.5 FORMAT "%5.1" ECU_ADDRESS 0x3848F6 /end MEASUREMENT
/begin MEASUREMENT etateint "Integrator Motrwirkungsgrad bei Tankentlüftung" UBYTE rel_ub_b127p5 1 100 0 127.5 FORMAT "%5.1" ECU_ADDRESS 0x3848F7 /end MEASUREMENT
/begin MEASUREMENT etatesol "beladungsabhängiger Soll-Motorwirkungsgrad bei Betrieb mit Tankentlüftung" UBYTE rel_ub_b127p5 1 100 0 127.5 FORMAT "%5.1" ECU_ADDRESS 0x3848F8 /end MEASUREMENT
/begin MEASUREMENT etazw_um "Ist-Zündwinkelwirkungsgrad in der Funktionsüberwachung" UBYTE rel_ub_b127p5 1 100 0 127.5 FORMAT "%5.1" ECU_ADDRESS 0x380B41 /end MEASUREMENT
/begin MEASUREMENT evz_aus_uc "Einspritzausblendmuster im Befehlstest" UBYTE dez 1 100 0 255 FORMAT "%5.1" ECU_ADDRESS 0x380B4D /end MEASUREMENT
/begin MEASUREMENT evz_aus_um "Einspritzausblendmuster in der Funktionsüberwachung" UBYTE dez 1 100 0 255 FORMAT "%5.1" ECU_ADDRESS 0x380807 /end MEASUREMENT
/begin MEASUREMENT fbetate "gewünschter Motorwirkungsgrad als f(nmot) bei TE zur Vermeidung von te <= TEMIN" UBYTE fak_ub_b1 1 100 0 0.996094 ECU_ADDRESS 0x3848F9 /end MEASUREMENT
/begin MEASUREMENT fbkate "Faktor Kraftstoffanteil Tankentlüftung abhängig von te / TEMIN" UBYTE fak_ub_b1 1 100 0 0.996094 ECU_ADDRESS 0x3848FA /end MEASUREMENT
/begin MEASUREMENT fgwrte "Eingriff Grenzwertregelung Tankentlüftung" SBYTE fak_sb_b16 1 100 -16 15.875 FORMAT "%5.2" ECU_ADDRESS 0x3848FB /end MEASUREMENT
/begin MEASUREMENT fkateapp "Faktor applizierter Krafstoffanteil Tankentlüftung" SBYTE fak_sb_b1 1 100 -1 0.992188 FORMAT "%5.3" ECU_ADDRESS 0x3848FC /end MEASUREMENT
/begin MEASUREMENT fkatefrg "Faktor Kraftstoffanteil Tankentlüftung bei Sollspülrate" SBYTE fak_sb_b1 1 100 -1 0.992188 FORMAT "%5.3" ECU_ADDRESS 0x380B8C /end MEASUREMENT
/begin MEASUREMENT fkatei "Faktor Kraftstoffanteil Tankentlüftung (aktueller Istwert)" SBYTE fak_sb_b1 1 100 -1 0.992188 FORMAT "%5.3" ECU_ADDRESS 0x380B8D /end MEASUREMENT
/begin MEASUREMENT fkates "Faktor Kraftstoffanteil Tankentlüftung (Sollwert)" SBYTE fak_sb_b1 1 100 -1 0.992188 FORMAT "%5.3" ECU_ADDRESS 0x3848FD /end MEASUREMENT
/begin MEASUREMENT fngwrte "Faktor Regelung Spülrate nach Grenzwertregeleingriff" SBYTE fak_sb_b16 1 100 -16 15.875 FORMAT "%5.2" ECU_ADDRESS 0x380B8E /end MEASUREMENT
/begin MEASUREMENT fregfte "Faktor Regelung Spülrate vor Grenzwertregeleingriff" SBYTE fak_sb_b16 1 100 -16 15.875 FORMAT "%5.2" ECU_ADDRESS 0x380B8F /end MEASUREMENT
/begin MEASUREMENT frmit "Bei Stereo-LR: Mittelwert des fr,fr2 oder bei Ausfall einer Bank: fr der i.O. Bk" UBYTE fak_ub_b2 1 100 0 1.99219 FORMAT "%5.3" ECU_ADDRESS 0x380B90 /end MEASUREMENT
/begin MEASUREMENT frmit_w "Mittelwert aus fr und fr2 (16 bit)" UWORD fak_uw_b2 1 100 0 1.99997 FORMAT "%8.6" ECU_ADDRESS 0x382A80 /end MEASUREMENT
/begin MEASUREMENT frmxa "fr-Max-Auschlag: Bei Stereo-LR: der fr, der am weitesten von 1.0 entfernt" UBYTE fak_ub_b2 1 100 0 1.99219 FORMAT "%5.3" ECU_ADDRESS 0x380B91 /end MEASUREMENT
/begin MEASUREMENT frmxaold_w "Mittelwert Lambdaregler - alter Wert (16 bit)" UWORD fak_uw_b2 1 100 0 1.99997 FORMAT "%8.6" ECU_ADDRESS 0x382A82 /end MEASUREMENT
/begin MEASUREMENT frmxa_w "fr-Max-Ausschlag: Bei Stereo LR der fr, der am weitesten von 1.0 weg (16 bit)" UWORD fak_uw_b2 1 100 0 1.99997 FORMAT "%8.6" ECU_ADDRESS 0x382A84 /end MEASUREMENT
/begin MEASUREMENT ftadmste "Bewrtungsfaktor für Absteuern des TEV bei dynamischer Vorgänge" UBYTE fak_ub_b2 1 100 0 1.99219 FORMAT "%5.3" ECU_ADDRESS 0x380B92 /end MEASUREMENT
/begin MEASUREMENT fteadf "gefilteter Faktor Beladung Spülstrom bei Tankentlüftung" SBYTE fak_sb_q0p5 1 100 -64 63.5 FORMAT "%5.2" ECU_ADDRESS 0x3848FE /end MEASUREMENT
/begin MEASUREMENT fteadf_w "gefilteter Faktor Beladung Spülstrom bei Tankentlüftung (16 Bit)" SWORD fak_q0p00195 1 100 -64 63.998 FORMAT "%8.5" ECU_ADDRESS 0x385374 /end MEASUREMENT
/begin MEASUREMENT ftead_w "Beladung des Aktivkohlefilters" SWORD fak_sw_b64 1 100 -64 63.998 FORMAT "%8.5" ECU_ADDRESS 0x385376 /end MEASUREMENT
/begin MEASUREMENT ftefsold_w "Letzter Sollwert der Spülrate Tankentlüftung vor Absteuerung" UWORD fak_uw_b0p5 1 100 0 0.499992 FORMAT "%9.7" ECU_ADDRESS 0x382A86 /end MEASUREMENT
/begin MEASUREMENT ftefsoll_w "Sollwert der Spülrate Tankentlüftung" UWORD fak_uw_b0p5 1 100 0 0.499992 FORMAT "%9.7" ECU_ADDRESS 0x382A88 /end MEASUREMENT
/begin MEASUREMENT ftefva "Spülrate der Tankentlüftung" UBYTE fak_ub_b0p5 1 100 0 0.498047 ECU_ADDRESS 0x380B93 /end MEASUREMENT
/begin MEASUREMENT ftefvab "Begrenzungswert der Spülrate Tankentlüftung" UBYTE fak_ub_b0p03125 1 100 0 0.0311279 FORMAT "%7.5" ECU_ADDRESS 0x3848FF /end MEASUREMENT
/begin MEASUREMENT ftefvamx_w "max. Spülrate (Begrenzung absolut, 16 bit)" UWORD fak_uw_b0p5 1 100 0 0.499992 FORMAT "%9.7" ECU_ADDRESS 0x382A8A /end MEASUREMENT
/begin MEASUREMENT ftefva_w "Spülrate Tankentlüftung" UWORD fak_uw_b0p5 1 100 0 0.499992 FORMAT "%9.7" ECU_ADDRESS 0x382A8C /end MEASUREMENT
/begin MEASUREMENT fteml "Aufsteuergeschwindigkeit der Spülrate und des Massenstroms TEV" UBYTE perio_ub_b0p012207 1 100 0 0.0121593 FORMAT "%12.10" ECU_ADDRESS 0x384900 /end MEASUREMENT
/begin MEASUREMENT fvermte_w "Faktor Vermischung Regeneriergas im Saugrohr" UWORD fak_uw_b1 1 100 0 0.999985 FORMAT "%9.7" ECU_ADDRESS 0x382A8E /end MEASUREMENT
/begin MEASUREMENT imsteini "Integral Massenstrom TEV nach längerem TE-Stop" UBYTE m_ub_q0p0444 1 100 0 11.322 FORMAT "%5.2" ECU_ADDRESS 0x384901 /end MEASUREMENT
/begin MEASUREMENT ipa_c_um "Fehlerzähler für unterer DK-Anschlag im ungültigen Bereich f. d. Funktionsüberw." UBYTE t40ms_ub_b10200 1 100 0 10200 FORMAT "%7.1" ECU_ADDRESS 0x380820 /end MEASUREMENT
/begin MEASUREMENT ipsn_um "aktive DK-Istwertpoti-Info ohne unteren Anschlag für die Funktionsüberwachung" UBYTE spg_ub_q0p019 1 100 0 4.98047 ECU_ADDRESS 0x380821 /end MEASUREMENT
/begin MEASUREMENT khc_w "Adaptierte HC-Konzentration Regenerierstrom" SWORD fak_sw_b2 1 100 -2 1.99994 FORMAT "%8.6" ECU_ADDRESS 0x385378 /end MEASUREMENT
/begin MEASUREMENT kteev_w "Konzentration Regeneriergas im Saugrohr auf Höhe der Einspritzventile" UWORD fak_uw_b1 1 100 0 0.999985 FORMAT "%9.7" ECU_ADDRESS 0x382A90 /end MEASUREMENT
/begin MEASUREMENT ktetevvz_w "Konzentration Regeneriergas im Saugrohr verzögert" UWORD fak_uw_b1 1 100 0 0.999985 FORMAT "%9.7" ECU_ADDRESS 0x382A92 /end MEASUREMENT
/begin MEASUREMENT ktetev_w "Konzentration Regeneriergas im Saugrohr auf Höhe vom TEV" UWORD fak_uw_b1 1 100 0 0.999985 FORMAT "%9.7" ECU_ADDRESS 0x382A94 /end MEASUREMENT
/begin MEASUREMENT lokBits_Tebeb "" UBYTE dez 1 100 0 255 FORMAT "%5.1" ECU_ADDRESS 0x3848F5 /end MEASUREMENT
/begin MEASUREMENT mdif_w_um "Differenz zwischen zulässigem und Ist-Moment in der Funktionsüberwachung" SWORD rel_ub_q0p3906 1 100 -12800 12799.6 FORMAT "%8.2" ECU_ADDRESS 0x3828D6 /end MEASUREMENT
/begin MEASUREMENT mdst08_um "Stützstelle für Momenten-Info (MZ_UM) zur Ermittlung des Momenten-Offsets in FU" UWORD dez 1 100 0 65535 FORMAT "%8.2" ECU_ADDRESS 0x38086A /end MEASUREMENT
/begin MEASUREMENT mfgr_um "Momentenwunsch aus der Fahrgeschwindigkeitsregelung für die Funktionsüberwachung" UBYTE rel_ub_q0p3906 1 100 0 99.6094 FORMAT "%5.2" ECU_ADDRESS 0x380835 /end MEASUREMENT
/begin MEASUREMENT mifa_uc "FGR-/ACC- oder Fahrerwunschmoment der Funktion im Befehlstest" UBYTE rel_ub_q0p3906 1 100 0 99.6094 FORMAT "%5.2" ECU_ADDRESS 0x380B4E /end MEASUREMENT
/begin MEASUREMENT miopt_um "optimales indiziertes Moment in der Funktionsüberwachung" UBYTE rel_ub_b99p6 1 100 0 99.6094 FORMAT "%5.2" ECU_ADDRESS 0x380B42 /end MEASUREMENT
/begin MEASUREMENT mitebg_w "Momentvorgabe für Mindestfüllung Tankentlüftung" UWORD rel_uw_b100 1 100 0 99.9985 FORMAT "%8.5" ECU_ADDRESS 0x382A96 /end MEASUREMENT
/begin MEASUREMENT mi_um "Berechnetes Ist-Moment in der Funktionsüberwachung" UBYTE rel_ub_b99p6 1 100 0 99.6094 FORMAT "%5.2" ECU_ADDRESS 0x38083A /end MEASUREMENT
/begin MEASUREMENT mmsr_um "zulässiger MSR-Momentenwunsch für die Funktionsüberwachung" UBYTE rel_ub_q0p3906 1 100 0 99.6094 FORMAT "%5.2" ECU_ADDRESS 0x380837 /end MEASUREMENT
/begin MEASUREMENT mped_um "zulässiges indiziertes Moment aus Fahrpedal in der Funktionsüberwachung" UBYTE rel_ub_b99p6 1 100 0 99.6094 FORMAT "%5.2" ECU_ADDRESS 0x380B44 /end MEASUREMENT
/begin MEASUREMENT mracc_um "Momentenwunsch von ACC in Funktionsüberwachung" UBYTE rel_ub_q0p3906 1 100 0 99.6094 FORMAT "%5.2" ECU_ADDRESS 0x38080F /end MEASUREMENT
/begin MEASUREMENT msgs_um "Soll- Motormoment aus Getriebeüberwachung in der Funktionsüberwachung" UBYTE rel_ub_q0p3906 1 100 0 99.6094 FORMAT "%5.2" ECU_ADDRESS 0x38081D /end MEASUREMENT
/begin MEASUREMENT msrc_c_um "Fehlerzähler für MSR-Eingriff-Überwachung der Funktionsüberwachung" UBYTE t40ms_ub_b10200 1 100 0 10200 FORMAT "%7.1" ECU_ADDRESS 0x380838 /end MEASUREMENT
/begin MEASUREMENT mssginmn_w "Minmaler ins Saugrohr strömender Massenstrom (Drosselklappe + TEV)" UWORD m_uw_b6553p5 1 100 0 6553.5 FORMAT "%8.3" ECU_ADDRESS 0x382A98 /end MEASUREMENT
/begin MEASUREMENT mssgin_w "Ins Saugrohr strömender Massenstrom (Drosselklappe + TEV)" UWORD m_uw_b6553p5 1 100 0 6553.5 FORMAT "%8.3" ECU_ADDRESS 0x382A9A /end MEASUREMENT
/begin MEASUREMENT msteev_w "Massenstrom Regeneriergas auf Höhe Einspritzventil" UWORD m_uw_b25p6 1 100 0 25.5996 FORMAT "%8.5" ECU_ADDRESS 0x382A9C /end MEASUREMENT
/begin MEASUREMENT mstesmx_w "Maximal möglicher Sollmassenstrom Tankentlüftung" UWORD m_uw_b25p6 1 100 0 25.5996 FORMAT "%8.5" ECU_ADDRESS 0x382A9E /end MEASUREMENT
/begin MEASUREMENT mstesoll_w "Massenstrom Tankentlüftung ins Saugrohr, Sollwert" UWORD m_uw_b25p6 1 100 0 25.5996 FORMAT "%8.5" ECU_ADDRESS 0x382AA0 /end MEASUREMENT
/begin MEASUREMENT mver_c_um "Fehlerzähler für Momentenvergleich der Funktionsüberwachung" UBYTE t40ms_ub_b10200 1 100 0 10200 FORMAT "%7.1" ECU_ADDRESS 0x380848 /end MEASUREMENT
/begin MEASUREMENT mzfo_um "gefiltertes zulässiges Moment inclusive Offset in der Funktionsüberwachung" UBYTE rel_ub_q0p3906 1 100 0 99.6094 FORMAT "%5.2" ECU_ADDRESS 0x380849 /end MEASUREMENT
/begin MEASUREMENT mzf_low_um "Nachkommastellen für gefiltertes zulässiges Moment der Funktionsüberwachung" UBYTE rel_ub_q0p00153 1 100 0 0.389074 ECU_ADDRESS 0x38083D /end MEASUREMENT
/begin MEASUREMENT mzf_ptr_um "Zeiger des Registers mzf_reg_um" UBYTE dez 1 100 0 255 FORMAT "%5.1" ECU_ADDRESS 0x38083E /end MEASUREMENT
/begin MEASUREMENT mzf_reg_um "Register für zulässiges Moment zeitverzögert" UBYTE rel_ub_q0p3906 1 100 0 99.6094 FORMAT "%5.2" ARRAY_SIZE 8 ECU_ADDRESS 0x38083F /end MEASUREMENT
/begin MEASUREMENT mzf_um "gefiltertes zulässiges Moment der Funktionsüberwachung" UBYTE rel_ub_q0p3906 1 100 0 99.6094 FORMAT "%5.2" ECU_ADDRESS 0x380847 /end MEASUREMENT
/begin MEASUREMENT mzo_um "Toleranz-Offset fürs zulässige Moment in der Funktionsüberwachung" UBYTE rel_ub_b99p6 1 100 0 99.6094 FORMAT "%5.2" ECU_ADDRESS 0x38083B /end MEASUREMENT
/begin MEASUREMENT mz_um "resultierendes zulässiges Moment aus der Koordination der Funktionsüberwachung" UBYTE rel_ub_b99p6 1 100 0 99.6094 FORMAT "%5.2" ECU_ADDRESS 0x38083C /end MEASUREMENT
/begin MEASUREMENT nc_c_um "Fehlerzähler für Motordrehzahlvergleich für die Funktionsüberwachung" UBYTE t40ms_ub_b10200 1 100 0 10200 FORMAT "%7.1" ECU_ADDRESS 0x380819 /end MEASUREMENT
/begin MEASUREMENT nmot_uc "Motordrehzahl im Befehlstest" UBYTE nmot_ub_q40 1 100 0 10200 FORMAT "%5.0" ECU_ADDRESS 0x380B4F /end MEASUREMENT
/begin MEASUREMENT nmot_um "Motordrehzahl in der Funktionsüberwachung" UBYTE nmot_ub_q40 1 100 0 10200 FORMAT "%5.0" ECU_ADDRESS 0x38081A /end MEASUREMENT
/begin MEASUREMENT nmst08_uc "" UWORD dez 1 100 0 65535 FORMAT "%8.2" ECU_ADDRESS 0x3828F4 /end MEASUREMENT
/begin MEASUREMENT nmst08_um "Stützstelle für Motordrehzahl in der Funktionsüberwachung (NMOT_UM)" UWORD dez 1 100 0 65535 FORMAT "%8.2" ECU_ADDRESS 0x380862 /end MEASUREMENT
/begin MEASUREMENT nsc_c_um "Nachstart-Zeitzähler Nachstartaufweitung der FU" UWORD t40msxs_uw_q0p04 1 100 0 2621.4 FORMAT "%8.3" ECU_ADDRESS 0x380860 /end MEASUREMENT
/begin MEASUREMENT nska_um "Grenzdrehzahl bei aktiver Fehlerreaktion in der Funktionsüberwachung" UBYTE nmot_ub_q40 1 100 0 10200 FORMAT "%5.0" ECU_ADDRESS 0x38084A /end MEASUREMENT
/begin MEASUREMENT nsof_c_um "Zähler Entprellzeit für Abschaltung der Nachstartaufweitung" UBYTE t40ms_ub_b10200 1 100 0 10200 FORMAT "%7.1" ECU_ADDRESS 0x38081C /end MEASUREMENT
/begin MEASUREMENT nzwst08_uc "" UWORD dez 1 100 0 65535 FORMAT "%8.2" ECU_ADDRESS 0x3828F6 /end MEASUREMENT
/begin MEASUREMENT nzwst08_um "" UWORD dez 1 100 0 65535 FORMAT "%8.2" ECU_ADDRESS 0x380864 /end MEASUREMENT
/begin MEASUREMENT nz_um "Motordrehzahl aus Zahnzählerdifferenz pro Zeit in der Funktionsüberwachung" UBYTE nmot_ub_q40 1 100 0 10200 FORMAT "%5.0" ECU_ADDRESS 0x38081B /end MEASUREMENT
/begin MEASUREMENT n_flags_um "Byte für Nachstart-Bits der Funktionsüberwachung" UBYTE dez 1 100 0 255 FORMAT "%5.1" ECU_ADDRESS 0x380801 /end MEASUREMENT
/begin MEASUREMENT pspu "Quotient Saugrohrdruck Umgebungsdruck" UBYTE fak_ub_b2 1 100 0 1.99219 FORMAT "%5.3" ECU_ADDRESS 0x380B94 /end MEASUREMENT
/begin MEASUREMENT qmsdyn "Quotient aus ml_w und mssgin_w" UBYTE fak_ub_b16 1 100 0 15.9375 FORMAT "%5.2" ECU_ADDRESS 0x380B95 /end MEASUREMENT
/begin MEASUREMENT qtetemin "Quotient: te / TEMIN für BDE teh_w/teminh_w bzw. tes_w/temins" UBYTE fak_ub_b4 1 100 0 3.98438 FORMAT "%5.3" ECU_ADDRESS 0x380B96 /end MEASUREMENT
/begin MEASUREMENT ram_c_um "Fehlerzähler im Dauer-RAM für RAM-Konsistenz-Prüfung (Diagnose) in der Fkt-Überw" UBYTE dez 1 100 0 255 FORMAT "%5.1" ECU_ADDRESS 0x3831F4 /end MEASUREMENT
/begin MEASUREMENT reac_c1_um "Fehlerzähler 1 für Fehlerreaktionsüberwachung in Funktionsüberwachung" UBYTE t40ms_ub_b10200 1 100 0 10200 FORMAT "%7.1" ECU_ADDRESS 0x38084B /end MEASUREMENT
/begin MEASUREMENT reac_c2_um "Fehlerzähler 2 für Fehlerreaktionsüberwachung in Funktionsüberwachung" UBYTE t40ms_ub_b10200 1 100 0 10200 FORMAT "%7.1" ECU_ADDRESS 0x38084C /end MEASUREMENT
/begin MEASUREMENT reac_c_um "Fehlerzähler im Dauer-RAM für Fehlerreaktionsüberwachung (Diagnose) in der FU" UBYTE dez 1 100 0 255 FORMAT "%5.1" ECU_ADDRESS 0x3831F5 /end MEASUREMENT
/begin MEASUREMENT reset_indication_um "" UWORD dez 1 100 0 65535 FORMAT "%8.2" ECU_ADDRESS 0x383AB4 /end MEASUREMENT
/begin MEASUREMENT rkte_w "Relativer Gemischanteil Tankentlüftung" SWORD rel_sw_q0p0468 1 100 -1536 1535.95 FORMAT "%8.3" ECU_ADDRESS 0x382AA2 /end MEASUREMENT
/begin MEASUREMENT rlc_c_um "Fehlerzähler für rl-Vergleich mit der Funktion in der Funktionsüberwachung" UBYTE t40ms_ub_b10200 1 100 0 10200 FORMAT "%7.1" ECU_ADDRESS 0x380822 /end MEASUREMENT
/begin MEASUREMENT rlf_ptr_um "Pointer für Schieberegister des Lastfilters" UBYTE dez 1 100 0 255 FORMAT "%5.1" ECU_ADDRESS 0x380823 /end MEASUREMENT
/begin MEASUREMENT rlf_reg_um "" UBYTE rel_ub_q0p75 1 100 0 191.25 FORMAT "%5.1" ARRAY_SIZE 8 ECU_ADDRESS 0x380824 /end MEASUREMENT
/begin MEASUREMENT rlipf_low_um "" UBYTE rel_ub_q0p0029 1 100 0 0.74707 ECU_ADDRESS 0x38082C /end MEASUREMENT
/begin MEASUREMENT rlipf_um "relative Luftfüllung aus Nebenlastsignal hinter Tiefpaß in der Funktionsüberw." UBYTE rel_ub_q0p75 1 100 0 191.25 FORMAT "%5.1" ECU_ADDRESS 0x38082D /end MEASUREMENT
/begin MEASUREMENT rlip_c_um "Fehlerzähler für rl/rlip-Vergleich in der Funktionsüberwachung" UBYTE t40ms_ub_b10200 1 100 0 10200 FORMAT "%7.1" ECU_ADDRESS 0x38082E /end MEASUREMENT
/begin MEASUREMENT rlip_um "relative Luftfüllung aus Nebenlastsignal für die Funktionsüberwachung" UBYTE rel_ub_q0p75 1 100 0 191.25 FORMAT "%5.1" ECU_ADDRESS 0x38082F /end MEASUREMENT
/begin MEASUREMENT rlst08_uc "rlst08_um im Befehlstest" UWORD dez 1 100 0 65535 FORMAT "%8.2" ECU_ADDRESS 0x3828F8 /end MEASUREMENT
/begin MEASUREMENT rlst08_um "Stützstelle der SSV RLV08_UM" UWORD dez 1 100 0 65535 FORMAT "%8.2" ECU_ADDRESS 0x380866 /end MEASUREMENT
/begin MEASUREMENT rlteev_w "Relative Füllung verursacht durch Regeneriergas Tankentlüftung" UWORD rel_uw_b192 1 100 0 191.997 FORMAT "%8.4" ECU_ADDRESS 0x382AA4 /end MEASUREMENT
/begin MEASUREMENT rlzo_um "obere Toleranzgrenze für rl aus Nebenlastsignal in der Funktionsüberwachung" UBYTE rel_ub_q0p75 1 100 0 191.25 FORMAT "%5.1" ECU_ADDRESS 0x380B40 /end MEASUREMENT
/begin MEASUREMENT rl_uc "relative Luftfüllung im Befehlstest" UBYTE rel_ub_q0p75 1 100 0 191.25 FORMAT "%5.1" ECU_ADDRESS 0x380B50 /end MEASUREMENT
/begin MEASUREMENT rl_um "relative Luftfüllung in der Funktionsüberwachung" UBYTE rel_ub_q0p75 1 100 0 191.25 FORMAT "%5.1" ECU_ADDRESS 0x380830 /end MEASUREMENT
/begin MEASUREMENT rl_w_um "relative Luftfüllung (Word) in der Funktionsüberwachung" UWORD rel_uw_q0p0234 1 100 0 1535.98 FORMAT "%8.3" ECU_ADDRESS 0x3828A2 /end MEASUREMENT
/begin MEASUREMENT romErrPage "" UBYTE dez 1 100 0 255 FORMAT "%5.1" ECU_ADDRESS 0x3831F6 /end MEASUREMENT
/begin MEASUREMENT romz_c_um "Fehlerzähler im Dauer-RAM für ROM-Prüfung (Diagnose) in der Funktionsüberwachung" UBYTE dez 1 100 0 255 FORMAT "%5.1" ECU_ADDRESS 0x3831F7 /end MEASUREMENT
/begin MEASUREMENT rst_tv "Variable im Dauer-RAM zur Anforderung Reset-Tastverhältnis aus der Fkt-Überwach." UBYTE dez 1 100 0 255 FORMAT "%5.1" ECU_ADDRESS 0x3831F8 /end MEASUREMENT
/begin MEASUREMENT r_flags_um "Byte für Fehlerreaktions-Bits der Funktionsüberwachung" UBYTE dez 1 100 0 255 FORMAT "%5.1" ECU_ADDRESS 0x380802 /end MEASUREMENT
/begin MEASUREMENT sp1p_a_um "10ms alter Wert f. Sollwert-Poti 1 (PWG) vom Überwachungsmodul für den ADC-Test" UBYTE spg_ub_q0p019 1 100 0 4.98047 ECU_ADDRESS 0x38084E /end MEASUREMENT
/begin MEASUREMENT sp1p_st_um "Stationärzähler für Sollwertpoti 1 vom Überwachungsmodul" UBYTE t10msxs_ub_b2p55 1 100 0 2.55 FORMAT "%5.3" ECU_ADDRESS 0x38084F /end MEASUREMENT
/begin MEASUREMENT sp1s_a_um "10ms alter Wert f. Sollwert-Poti 1 (PWG) für die Funktionsüberwachung" UBYTE spg_ub_q0p019 1 100 0 4.98047 ECU_ADDRESS 0x380850 /end MEASUREMENT
/begin MEASUREMENT sp1s_st_um "Stationärzähler für Sollwertpoti 1" UBYTE t10msxs_ub_b2p55 1 100 0 2.55 FORMAT "%5.3" ECU_ADDRESS 0x380851 /end MEASUREMENT
/begin MEASUREMENT sp1s_um "aktueller Wert für Sollwert-Poti 1 (PWG) für die Funktionsüberwachung" UBYTE spg_ub_q0p019 1 100 0 4.98047 ECU_ADDRESS 0x380831 /end MEASUREMENT
/begin MEASUREMENT sp2s_um "aktueller Wert für Sollwert-Poti 2 (PWG) für die Funktionsüberwachung" UBYTE spg_ub_q0p0098 1 100 0 2.49023 FORMAT "%5.3" ECU_ADDRESS 0x380832 /end MEASUREMENT
/begin MEASUREMENT spsc_c_um "Fehlerzähler bei zueinander unplausiblen Sollwerten in der Funktionsüberwachung" UBYTE t40ms_ub_b10200 1 100 0 10200 FORMAT "%7.1" ECU_ADDRESS 0x380833 /end MEASUREMENT
/begin MEASUREMENT spsnst08_uc "" UWORD dez 1 100 0 65535 FORMAT "%8.2" ECU_ADDRESS 0x3828FA /end MEASUREMENT
/begin MEASUREMENT spsnst08_um "" UWORD dez 1 100 0 65535 FORMAT "%8.2" ECU_ADDRESS 0x380868 /end MEASUREMENT
/begin MEASUREMENT spsn_uc "Pedalwert (8 Bit) im Befehlstest" UBYTE spg_ub_q0p019 1 100 0 4.98047 ECU_ADDRESS 0x380B51 /end MEASUREMENT
/begin MEASUREMENT spsn_um "Pedalsollwert (8 Bit) in der Funktionsüberwachung" UBYTE spg_ub_q0p019 1 100 0 4.98047 ECU_ADDRESS 0x380834 /end MEASUREMENT
/begin MEASUREMENT srst_c_um "Zähler im Dauer-RAM für Software-Reset (Diagnose) aus der Funktionsüberwachung" UBYTE dez 1 100 0 255 FORMAT "%5.1" ECU_ADDRESS 0x3831F9 /end MEASUREMENT
/begin MEASUREMENT s_flags_um "Byte für Status-Bits der Funktionsüberwachung" UBYTE dez 1 100 0 255 FORMAT "%5.1" ECU_ADDRESS 0x380803 /end MEASUREMENT
/begin MEASUREMENT tahsom_w "Abgastemperatur an Sonde hinter Kat aus Modell" UWORD temp_q0p0234_o273 1 100 -273.15 1262.83 FORMAT "%8.3" ECU_ADDRESS 0x384A82 /end MEASUREMENT
/begin MEASUREMENT taikrm_w "Abgastemperatur im Krümmer (Zusammenführung aller Zylinder) aus Modell" UWORD temp_q0p0234_o273 1 100 -273.15 1262.83 FORMAT "%8.3" ECU_ADDRESS 0x384A84 /end MEASUREMENT
/begin MEASUREMENT talt_um "Timerwert des vorhergehenden Berechnungszeitpunkts im 40ms-Raster" UWORD dez 1 100 0 65535 FORMAT "%8.2" ECU_ADDRESS 0x380858 /end MEASUREMENT
/begin MEASUREMENT tanhkm_w "Abgastemperatur hinter Hauptkat aus Modell" UWORD temp_q0p0234_o273 1 100 -273.15 1262.83 FORMAT "%8.3" ECU_ADDRESS 0x384A86 /end MEASUREMENT
/begin MEASUREMENT tans_um "Ansaugluft-Temperatur in der Funktionsüberwachung" UBYTE temp_ub_q0p75_o48 1 100 -48 143.25 FORMAT "%5.1" ECU_ADDRESS 0x380808 /end MEASUREMENT
/begin MEASUREMENT tanvk_w "Abgastemperatur nach dem Vorkat" UWORD temp_q0p0234_o273 1 100 -273.15 1262.83 FORMAT "%8.3" ECU_ADDRESS 0x384A88 /end MEASUREMENT
/begin MEASUREMENT tatuk "Ansaugluft- oder Umgebungstemperatur, Ausgabe in Grad C, intern in Kelvin" UBYTE temp_q6_o273 1 100 -273.15 1256.85 FORMAT "%5.0" ECU_ADDRESS 0x384851 /end MEASUREMENT
/begin MEASUREMENT tatuk_w "Ansaugluft- oder Umgebungstemperatur, Ausgabe in Grad C, intern in Kelvin" UWORD temp_q0p0234_o273 1 100 -273.15 1262.83 FORMAT "%8.3" ECU_ADDRESS 0x384A8A /end MEASUREMENT
/begin MEASUREMENT tavrom_w "Abgastemperatur im Rohrstuck nach Krümmer modelliert" UWORD temp_q0p0234_o273 1 100 -273.15 1262.83 FORMAT "%8.3" ECU_ADDRESS 0x384A8C /end MEASUREMENT
/begin MEASUREMENT tavsom_w "Abgastemperatur an Sonde vor Kat aus Modell" UWORD temp_q0p0234_o273 1 100 -273.15 1262.83 FORMAT "%8.3" ECU_ADDRESS 0x384A8E /end MEASUREMENT
/begin MEASUREMENT tavvkm_w "Abgastemperatur vor Vorkat aus Modell" UWORD temp_q0p0234_o273 1 100 -273.15 1262.83 FORMAT "%8.3" ECU_ADDRESS 0x384A90 /end MEASUREMENT
/begin MEASUREMENT tcap_um "Timerwert des aktuellen Berechnungszeitpunkts im 40ms-Raster" UWORD dez 1 100 0 65535 FORMAT "%8.2" ECU_ADDRESS 0x38085A /end MEASUREMENT
/begin MEASUREMENT timevovCtr "" UWORD dez 1 100 0 65535 FORMAT "%8.2" ECU_ADDRESS 0xF7AE /end MEASUREMENT
/begin MEASUREMENT tmotk "Motor-Temperatur, Ausgabe in Grad C, intern in Kelvin" UBYTE temp_q6_o273 1 100 -273.15 1256.85 FORMAT "%5.0" ECU_ADDRESS 0x384852 /end MEASUREMENT
/begin MEASUREMENT tmotk_w "Motor-Temperatur, Ausgabe in Grad C, intern in Kelvin" UWORD temp_q0p0234_o273 1 100 -273.15 1262.83 FORMAT "%8.3" ECU_ADDRESS 0x384A92 /end MEASUREMENT
/begin MEASUREMENT tmot_um "Motor-Temperatur in der Funktionsüberwachung" UBYTE temp_ub_q0p75_o48 1 100 -48 143.25 FORMAT "%5.1" ECU_ADDRESS 0x380809 /end MEASUREMENT
/begin MEASUREMENT tn2 "Segmentzeit pro Zündung" UWORD tinjection_sy 1 100 0 174.76 FORMAT "%8.4" ECU_ADDRESS 0xF9A0 /end MEASUREMENT
/begin MEASUREMENT trevovCtr "" UWORD dez 1 100 0 65535 FORMAT "%8.2" ECU_ADDRESS 0xF7AC /end MEASUREMENT
/begin MEASUREMENT tun_det "" UBYTE dez 1 100 0 255 FORMAT "%5.1" ECU_ADDRESS 0x380B3C /end MEASUREMENT
/begin MEASUREMENT tun_errcode "" UBYTE dez 1 100 0 255 FORMAT "%5.1" ECU_ADDRESS 0x380B3D /end MEASUREMENT
/begin MEASUREMENT t_flags_um "Byte für Tempomat-Bits der Funktionsüberwachung" UBYTE dez 1 100 0 255 FORMAT "%5.1" ECU_ADDRESS 0x380804 /end MEASUREMENT
/begin MEASUREMENT uma2_res "Antwortbeitrag des Befehlstests" SWORD dez 1 100 -32768 32767 FORMAT "%8.2" ECU_ADDRESS 0x38284C /end MEASUREMENT
/begin MEASUREMENT umErrorCtrFr "" UBYTE dez 1 100 0 255 FORMAT "%5.1" ECU_ADDRESS 0x380B3E /end MEASUREMENT
/begin MEASUREMENT umrst_c_um "Zähler im Dauer-RAM für Software-Reset (Diagnose) aus %UMKOM" UBYTE dez 1 100 0 255 FORMAT "%5.1" ECU_ADDRESS 0x3831FA /end MEASUREMENT
/begin MEASUREMENT vfzg_uc "Fahrzeuggeschwindigkeit im Befehlstest" UWORD vfzg_uw_q0p00781 1 100 0 511.992 FORMAT "%8.4" ECU_ADDRESS 0x3828E6 /end MEASUREMENT
/begin MEASUREMENT vstagr "Anpassung AGR-Rate (Testerschnittstelle)" UBYTE fak_ub_b2 1 100 0 1.99219 FORMAT "%5.3" ECU_ADDRESS 0x380AE0 /end MEASUREMENT
/begin MEASUREMENT vstcns "Anpassung Codewort LL-Solldrehzahl-Umschaltung" UBYTE dez 1 100 0 255 FORMAT "%5.1" ECU_ADDRESS 0x380AE1 /end MEASUREMENT
/begin MEASUREMENT vstdzw "Anpassung Zündwinkel additiv" SBYTE zw_sb_q0p75 1 100 -96 95.25 FORMAT "%5.2" ECU_ADDRESS 0x380AE2 /end MEASUREMENT
/begin MEASUREMENT vstfba "Faktor Beschleunigungsanreicherung (Testerschnittstelle)" UBYTE fak_ub_b2 1 100 0 1.99219 FORMAT "%5.3" ECU_ADDRESS 0x380AE3 /end MEASUREMENT
/begin MEASUREMENT vstfns "Anpassung Faktor Nachstart (Testerschnittstelle)" UBYTE fak_ub_b2 1 100 0 1.99219 FORMAT "%5.3" ECU_ADDRESS 0x380AE4 /end MEASUREMENT
/begin MEASUREMENT vstfrk "Korrektur der relativen Kraftstoffmasse über Tester" UBYTE fak_ub_b1p25_o0p75 1 100 0.75 1.24805 FORMAT "%5.3" ECU_ADDRESS 0x380AE5 /end MEASUREMENT
/begin MEASUREMENT vstfst "Anpassung Faktor Start (Testerschnittstelle)" UBYTE fak_ub_b2 1 100 0 1.99219 FORMAT "%5.3" ECU_ADDRESS 0x380AE6 /end MEASUREMENT
/begin MEASUREMENT vstfva "Faktor Verzoegerungsabmagerung (Testerschnittstelle)" UBYTE fak_ub_b2 1 100 0 1.99219 FORMAT "%5.3" ECU_ADDRESS 0x380AE7 /end MEASUREMENT
/begin MEASUREMENT vstfwl "Anpassung Faktor Warmlauf (Testerschnittstelle)" UBYTE fak_ub_b2 1 100 0 1.99219 FORMAT "%5.3" ECU_ADDRESS 0x380AE8 /end MEASUREMENT
/begin MEASUREMENT vstlr "Anpassung tv-Zeit  (Testerschnittstelle)" SBYTE t10msxs_sb_q0p01 1 100 -1.28 1.27 FORMAT "%5.3" ECU_ADDRESS 0x380AE9 /end MEASUREMENT
/begin MEASUREMENT vstmdr "Anpassung Momentenreserve Leerlaufregelung (Testerschnitst.)" UBYTE rel_ub_b25 1 100 0 24.9023 FORMAT "%5.2" ECU_ADDRESS 0x380AEA /end MEASUREMENT
/begin MEASUREMENT vstnls "Anpassung LL-Solldrehzahl (Testerschittstelle)" SBYTE nmot_sb_q10 1 100 -1280 1270 FORMAT "%5.0" ECU_ADDRESS 0x380AEB /end MEASUREMENT
/begin MEASUREMENT vstrlx "Verstellgröße Maximalfüllung vom Tester" UBYTE fak_ub_b1 1 100 0 0.996094 ECU_ADDRESS 0x380AEC /end MEASUREMENT
/begin MEASUREMENT vstvvr "Erhöhung des Sollwerts der VMAX-Regelung über Werkstatt-Tester" SBYTE vfzg_q1p0 1 100 -128 127 FORMAT "%5.1" ECU_ADDRESS 0x380AED /end MEASUREMENT
/begin MEASUREMENT wri_c_um "Fehlerzähler im Dauer-RAM für RAM-Beschreibbarkeits-Prüfung (Diagnose) in der FU" UBYTE dez 1 100 0 255 FORMAT "%5.1" ECU_ADDRESS 0x3831FB /end MEASUREMENT
/begin MEASUREMENT x_uc "" UBYTE dez 1 100 0 255 FORMAT "%5.1" ECU_ADDRESS 0x380B52 /end MEASUREMENT
/begin MEASUREMENT y_uc "" UBYTE dez 1 100 0 255 FORMAT "%5.1" ECU_ADDRESS 0x380B53 /end MEASUREMENT
/begin MEASUREMENT zalt_um "Zahnzählerwert des vorhergehenden Berechnungszeitpunkts im 40ms-Raster" UWORD dez 1 100 0 65535 FORMAT "%8.2" ECU_ADDRESS 0x38085C /end MEASUREMENT
/begin MEASUREMENT zcap_um "Zahnzählerwert des aktuellen Berechnungszeitpunkts im 40ms-Raster" UWORD dez 1 100 0 65535 FORMAT "%8.2" ECU_ADDRESS 0x38085E /end MEASUREMENT
/begin MEASUREMENT zsync_um "Kennung für Synchronisation in der Funktionsüberwachung" UBYTE dez 1 100 0 255 FORMAT "%5.1" ECU_ADDRESS 0x380B3F /end MEASUREMENT
/begin MEASUREMENT zwc_c_um "Fehlerzähler für Zündwinkelüberwachung in der Funktionsüberwachung" UBYTE dez 1 100 0 255 FORMAT "%5.1" ECU_ADDRESS 0x38081E /end MEASUREMENT
/begin MEASUREMENT zwopt_um "optimaler Zündwinkel in der Funktionsüberwachung" SBYTE zw_sb_q0p75 1 100 -96 95.25 FORMAT "%5.2" ECU_ADDRESS 0x380B43 /end MEASUREMENT
/begin MEASUREMENT zwout_uc "Ausgabe-Zündwinkel im Befehlstest" SBYTE zw_sb_q0p75 1 100 -96 95.25 FORMAT "%5.2" ECU_ADDRESS 0x380B54 /end MEASUREMENT
/begin MEASUREMENT zwout_um "Ausgabe-Zündwinkel für die Funktionsüberwachung" SBYTE zw_sb_q0p75 1 100 -96 95.25 FORMAT "%5.2" ECU_ADDRESS 0x38081F /end MEASUREMENT
/begin MEASUREMENT zzylkr "Zylinderzähler der Klopfregelung" UBYTE dez 1 100 0 255 FORMAT "%5.1" ECU_ADDRESS 0xF7A0 /end MEASUREMENT
/begin MEASUREMENT z_flags_um "Byte für Status-Bits beim 2-SG-Konzept in der Funktionsüberwachung" UBYTE dez 1 100 0 255 FORMAT "%5.1" ECU_ADDRESS 0x380805 /end MEASUREMENT
/begin FUNCTION TEB "95.90     Tankentlüftung beladungsabhängig"
 /begin DEF_CHARACTERISTIC DFTEAHB DMSTES DSTEMIN FBTEB FBTEVA FBZBTEML FETATEBN FKATEB FQTEDL FQTEFR FQTEPT FQTEVA FRHB FSRFTEF FTEADAB FTEADMX FTEFHB FTEHB FTEINIX FUMRBRK FVERMN FVERZDYN FVRMDYN KFETATE KFFTEAN KFFTEAX KFQTE KFTADMS KFTATX KFTEKA KHCTEAMX KHCTEMN KHCTEMX MSDKLMMN NVERZMN TFTEINI TQTEAB TQTEDAB TVAGRFTE TVSATEM ZBTEML ZETATE ZKFTEAD ZMLTE ZMSSGIN /end DEF_CHARACTERISTIC
 /begin REF_CHARACTERISTIC KUMSRL SDK10TEUB SFR05TEUB SML06TEUB SNM10TEUB SQM05TEUB TEMIN /end REF_CHARACTERISTIC
 /begin IN_MEASUREMENT abo B_abor B_evloc B_frmax B_frmin B_lr B_nmot B_nswo1 B_qtedab B_sab B_te B_tef B_tei B_ten B_tep esst_sdk10teub esst_sfr05teub esst_sml06teub esst_snm10teub esst_sqm05teub frm_w mifa_w miopt_w ml mlsol_w ml_w msdkalm_w mste mstedte_w msteo_w mste_w nmot nmot_w ps_w pte pu rl tans te_w tmot wdkba /end IN_MEASUREMENT
 /begin OUT_MEASUREMENT B_agrste B_lrar B_teabb B_tehb B_tehbx etate fkatei frmit_w frmxa fteadf ftead_w ftefva_w mitebg_w mstesoll_w rkte_w /end OUT_MEASUREMENT
 /begin LOC_MEASUREMENT B_gwrte B_teakt dftef_w dkatefrg dkhc_w dmlftef dmssginr dstert20_w etateint etatesol fbetate fbkate fgwrte fkateapp fkatefrg fkates fngwrte fregfte frmit frmxaold_w frmxa_w ftadmste fteadf_w ftefsold_w ftefsoll_w ftefva ftefvab ftefvamx_w fteml fvermte_w imsteini khc_w kteev_w ktetevvz_w ktetev_w mssginmn_w mssgin_w msteev_w mstesmx_w pspu qmsdyn qtetemin rlteev_w /end LOC_MEASUREMENT
 /begin SUB_FUNCTION /end SUB_FUNCTION
/end FUNCTION
/begin FUNCTION TEBEB "4.140     Einschaltbedingungen Tankentlüftung" /begin DEF_CHARACTERISTIC CWTEACFG LAMTEMN LAMTEMX TMSTTE TMTE TTEAUS /end DEF_CHARACTERISTIC /begin REF_CHARACTERISTIC /end REF_CHARACTERISTIC
 /begin IN_MEASUREMENT B_atmtpa B_dldpte B_dllra B_dsls B_dteaa B_eobdlr B_fraoan B_ftedab B_lamka B_lamsdef B_ldpi B_lr B_lrasp B_lrssa B_m8te B_mdarv B_mlrsa B_sbbvk B_sls B_stend B_tep lamsons_w tateist_w tatesoll tmot tmst /end IN_MEASUREMENT
 /begin OUT_MEASUREMENT B_qtedab B_te B_tef B_tei B_ten /end OUT_MEASUREMENT
 /begin LOC_MEASUREMENT B_tenmda lokBits_Tebeb /end LOC_MEASUREMENT
 /begin SUB_FUNCTION /end SUB_FUNCTION
/end FUNCTION
/begin FUNCTION TEMPKON "3.40      Temperatur-Konvertermodul" /begin DEF_CHARACTERISTIC /end DEF_CHARACTERISTIC /begin REF_CHARACTERISTIC /end REF_CHARACTERISTIC /begin IN_MEASUREMENT tabgm_w tatu tikatm_w tkatm_w tmot /end IN_MEASUREMENT
 /begin OUT_MEASUREMENT tahsom_w taikrm_w tanhkm_w tanvk_w tatuk tatuk_w tavrom_w tavsom_w tavvkm_w tmotk tmotk_w /end OUT_MEASUREMENT
 /begin LOC_MEASUREMENT /end LOC_MEASUREMENT
 /begin SUB_FUNCTION /end SUB_FUNCTION
/end FUNCTION
/begin FUNCTION TIMEV_OV "" /begin DEF_CHARACTERISTIC /end DEF_CHARACTERISTIC /begin REF_CHARACTERISTIC /end REF_CHARACTERISTIC /begin IN_MEASUREMENT /end IN_MEASUREMENT /begin OUT_MEASUREMENT B_timev_inc timevovCtr /end OUT_MEASUREMENT /begin LOC_MEASUREMENT /end LOC_MEASUREMENT /begin SUB_FUNCTION /end SUB_FUNCTION /end FUNCTION
/begin FUNCTION TIMU "1.20      Timerumschaltung im Start bei Einspritzausgabe" /begin DEF_CHARACTERISTIC /end DEF_CHARACTERISTIC /begin REF_CHARACTERISTIC /end REF_CHARACTERISTIC
 /begin IN_MEASUREMENT B_stend B_ti_cha0 B_ti_cha1 B_ti_cha2 B_ti_cha3 B_ti_out0 B_ti_out1 B_ti_out2 B_ti_out3 B_ti_wai0 B_ti_wai1 B_ti_wai2 B_ti_wai3 cc_cha_0 cc_cha_1 cc_cha_2 cc_cha_3 ti_ev0 ti_ev1 ti_ev2 ti_ev3 tseghi tseg_w /end IN_MEASUREMENT
 /begin OUT_MEASUREMENT B_timfast tn2 /end OUT_MEASUREMENT
 /begin LOC_MEASUREMENT /end LOC_MEASUREMENT
 /begin SUB_FUNCTION /end SUB_FUNCTION
/end FUNCTION
/begin FUNCTION TKMWL "22.480    Testerkommunikation; Meßwerte lesen"
 /begin DEF_CHARACTERISTIC ADRONLOGIN AGR_AOG AGR_AUG CNSDEF CNS_AOG CNS_AUG CWFA107 CWFA107A CWFA108 CWFA108A CWFA109 CWFA109A CWFA130 CWFA130A CWFA140 CWFA140A CWFA145 CWFA145A CWFA146 CWFA146A CWFA146B CWFA147 CWFA147A CWFA147B CWFA148 CWFA148A CWFA148B CWFA149 CWFA149A CWFA149B CWFA152 CWFA152A CWFA152B CWFA162 CWFA162A CWFA163 CWFA163A CWFA166 CWFA166A CWFA166B CWFA167 CWFA167A CWFA167B CWFA168 CWFA168A CWFA168B CWFA190 CWFA190A CWFA190B CWFA191 CWFA191A CWFA191B CWFA192 CWFA192A CWFA192B CWFA193 CWFA193A CWFA193B CWFA194 CWFA194A CWFA194B CWFA195 CWFA195A CWFA195B CWFA196 CWFA196A CWFA196B CWFA197 CWFA197A CWFA197B CWFA198 CWFA198A CWFA198B CWFA199 CWFA199A CWFA199B CWFA201 CWFA201A CWFA201B CWFA202 CWFA202A CWFA202B CWFA203 CWFA203A CWFA203B CWFA204 CWFA204A CWFA204B CWFA205 CWFA205A CWFA205B CWFA206 CWFA206A CWFA206B CWFA207 CWFA207A CWFA207B CWFA208 CWFA208A CWFA208B CWFA209 CWFA209A CWFA209B CWFA210 CWFA210A CWFA210B CWFA211 CWFA211A CWFA211B CWFA212 CWFA212A CWFA212B CWFA213 CWFA213A CWFA213B CWFA214 CWFA214A CWFA214B CWFA215 CWFA215A CWFA215B CWFA216 CWFA216A CWFA216B CWFA217 CWFA217A CWFA217B CWFA218 CWFA218A CWFA218B CWFA219 CWFA219A CWFA219B CWFA220 CWFA220A CWFA220B CWFA221 CWFA221A CWFA221B CWFA222 CWFA222A CWFA222B CWFA223 CWFA223A CWFA223B CWFA224 CWFA224A CWFA224B CWFA225 CWFA225A CWFA225B CWFA226 CWFA226A CWFA226B CWFA227 CWFA227A CWFA227B CWFA228 CWFA228A CWFA228B CWFA229 CWFA229A CWFA229B CWFA230 CWFA230A CWFA230B CWFA231 CWFA231A CWFA231B CWFA232 CWFA232A CWFA232B CWFA233 CWFA233A CWFA233B CWFA234 CWFA234A CWFA234B CWFA235 CWFA235A CWFA235B CWFA236 CWFA236A CWFA236B CWFA237 CWFA237A CWFA237B CWFA238 CWFA238A CWFA238B CWFA239 CWFA239A CWFA239B CWFA240 CWFA240A CWFA240B CWFA241 CWFA241A CWFA241B CWFA242 CWFA242A CWFA242B CWFA243 CWFA243A CWFA243B CWFA244 CWFA244A CWFA244B CWFA245 CWFA245A CWFA245B CWFA246 CWFA246A CWFA246B CWFA247 CWFA247A CWFA247B CWFA248 CWFA248A CWFA248B CWFA249 CWFA249A CWFA249B CWFA250 CWFA250A CWFA250B CWFA251 CWFA251A CWFA251B CWFA252 CWFA252A CWFA252B CWFA253 CWFA253A CWFA253B CWFA254 CWFA254A CWFA254B CWFA255 CWFA255A CWFA255B CWFA28 CWFA28A CWFA34 CWFA34A CWFA34B CWFA35 CWFA35A CWFA35B CWFA36 CWFA36A CWFA36B CWFA37 CWFA37A CWFA37B CWFA38 CWFA38A CWFA38B CWFA39 CWFA39A CWFA39B CWFA43 CWFA43A CWFA43B CWFA44 CWFA44A CWFA44B CWFA46 CWFA46A CWFA46B CWFA47 CWFA47A CWFA47B CWFA48 CWFA48A CWFA49 CWFA49A CWFA70 CWFA70A CWFA71 CWFA71A CWFA75 CWFA75A CWFA77 CWFA77A CWFA78 CWFA78A CWFA94 CWFA94A CWFA96 CWFA96A CWTAF CWTAK CWTAS DZW_AOG DZW_AUG FBA_AOG FBA_AUG FLR_AOG FLR_AUG FNS_AOG FNS_AUG FRK_AOG FRK_AUG FST_AOG FST_AUG FVA_AOG FVA_AUG FWL_AOG FWL_AUG GRAOFLOGIN GRAONLOGIN HLOFFLOGIN HLONLOGIN KLOGIN LUEN1LOGIN LUEN2LOGIN LUEN3LOGIN MDR_AOG MDR_AUG MWNTKB MWNTKB0 MWNTKB1 MWNTKB10 MWNTKB11 MWNTKB12 MWNTKB13 MWNTKB14 MWNTKB15 MWNTKB16 MWNTKB17 MWNTKB18 MWNTKB190 MWNTKB191 MWNTKB192 MWNTKB193 MWNTKB194 MWNTKB195 MWNTKB196 MWNTKB197 MWNTKB198 MWNTKB199 MWNTKB2 MWNTKB20 MWNTKB21 MWNTKB22 MWNTKB23 MWNTKB24 MWNTKB25 MWNTKB3 MWNTKB4 MWNTKB5 MWNTKB6 MWNTKB7 MWNTKB8 MWNTKB9 NLS_AOG NLS_AUG RLX_AOG RLX_AUG SGIDB1 SGIDB2 SGIDB3 SLOGIN TKMWLMW TKMWLNA TKMWLNW VARDEF VVR_AOG VVR_AUG /end DEF_CHARACTERISTIC
 /begin REF_CHARACTERISTIC CWCANKBI CWCS CWGGFGRH CWGRABH CW_CAN_R_0___A CW_CAN_R_1___A CW_CAN_R_2___A CW_CAN_R_3___A KFFLTA KFOELKBI KVNPZ LRNVB_T MDNORM TKWFS TVLSUBM UHEMN UHEMX /end REF_CHARACTERISTIC
 /begin IN_MEASUREMENT abo aebkvpl_w afnmn afnmx afrlmn afrlmx ahkat ahkatn ahktki_w ahktnk akatbn anzdyn anzmsls_w anzumrl_w apedkt avdtev azwdh_w bbdcy bbwuc B_abgle B_adshs B_afklt B_afwrm B_airbag B_airbz B_aircan B_atmtpa B_atmtpk B_atr B_autget B_ba B_bbdthm B_bevab B_bkvnpler B_bkvp B_bkvpa B_bl B_bm B_br B_br2k B_brems B_brlmx B_bxf1 B_bxf2 B_bxf3 B_bxf4 B_bxf5 B_bxf6 B_bxf7 B_bxf8 B_bxf9 B_cankbi B_cdbkvp B_cddsbkv B_crcan B_dcvm B_dcvwdh B_ddylash B_dfrmoff B_dknolu B_dktakt B_dktb B_dktnr B_dktsb B_dktsp B_dkvsf B_dlahieg B_dlash B_dldp B_dllr B_dnwse B_drlmx B_ds B_dshen B_dsl B_dsl1 B_dsl2 B_dsl3 B_dsl4 B_dsl5 B_dslerr B_dslmab B_dslme B_dslmes B_dslo B_dsloab B_dsloe B_dsls B_dslset B_dsltab B_dteaa B_dteaab B_dteaam B_dteabu B_dteanfl B_dteendl B_dteenf B_dtelbm B_dtelbr B_dtelnm B_dtenam B_dtephm B_dtepm B_dteres B_dternm B_dtes B_dtest B_dtezam B_dthmbrk B_dthmtl B_dtmbh B_dushsch B_dylash B_dylsu B_dylsuav B_ebkvl B_edcvab B_edkvs B_ehfs B_ehlsu B_ehsh B_ekp B_elaof B_elsu B_endiml B_enlash B_entest B_epwmcs B_errofs B_etafix B_evloc B_falsu B_fasla B_faslarq B_fdbkvp B_fev1 B_fev10 B_fev11 B_fev12 B_fev13 B_fev2 B_fev3 B_fev4 B_fev5 B_fev6 B_fev7 B_fev8 B_fev9 B_fgratc B_fgren B_fgrhsc B_fgrsec B_fgrtdc B_fgrtuc B_fgrwac B_fkmsmn B_fkmsmx B_fkpvdk B_fkpvmn B_fkpvmx B_fofstp B_for11 B_for12 B_for13 B_for21 B_for22 B_for23 B_for31 B_for32 B_for33 B_for41 B_for42 B_for43 B_for51 B_for52 B_for53 B_for61 B_for62 B_for63 B_for71 B_for72 B_for73 B_for81 B_for82 B_for83 B_for_m B_fprakt B_fproe B_fprook B_fprordy B_fprovb B_fprrdy B_fprzab B_fprze B_fprzok B_fprzvb B_frao B_frau B_fraur B_frmax B_frmin B_fs B_furena B_fztafx B_gae B_gaefra B_gaeing B_gap B_gasp B_heatf B_helsu B_hfm B_hshe B_hsokh B_hsve B_imldthm B_kd B_kfzk B_kh B_khab B_khll B_khoab B_koe B_kosrc B_kpl B_kr B_krldy B_krndy B_kuppl B_lalgf B_lambts B_lamfas B_lamka B_lamlash B_lamnswl B_lamverg B_ldb B_ldob B_ldobsp B_ldp B_ldpi B_ldr B_lds B_ldsua B_ldsuad B_ldsuas B_ll B_llhzta B_lr B_lra B_lrar B_lrasp B_lrhk B_lrhkp B_lrka B_lrnakt B_lrnerf B_lrnrdy B_lrnvb B_lrnws B_lsahksp B_lshkpft B_lshkpmr B_lshswok B_lsuabgl B_lsufta B_lsuftb B_lsulone B_lsumra B_lsumrb B_lsumx B_lsuna B_lsupft B_lsupmr B_luft B_lustop B_madfk B_madfs B_madko B_madll B_maxflsu B_mdarv B_mdkat B_messe B_mibeg B_mil B_milabg B_milkat B_minflsu B_mldyn B_mlustest B_mnslspr B_mslmin B_msloff B_mslon B_mszsdkb B_mxslvpr B_nac B_nlpe B_nlperf B_nmot B_nowuc B_nphlsu B_nphsv B_nplflsh B_nplflsu B_nplsv B_npsna B_npvshns B_nwflade B_nwrpose B_nws B_nwse B_offmltw B_pdcvi B_pdcvn B_phad B_phade B_plenvh B_plra B_pwf B_rinh B_risigh B_rkam B_rkat B_rkatr B_rkaz B_rmsval B_sa B_sbbhk B_sbbvk B_sfsc B_sh_act B_sh_mvw B_sigflsh B_sigflsu B_sksc B_sl B_sla B_slar B_slas B_slkhof B_slpena B_slpoff B_slpofst B_slsinhi B_slsoab B_slsoff B_spsa B_steigm B_synph B_syserrk B_tabgbts B_tal B_talval B_te B_tehb B_teslash B_tevioi B_teviol B_teviop B_tevior B_teviot B_tevnio B_tkatbts B_trfash B_trip B_trkh B_trsah B_ttbmhh B_uhsig B_umae B_umauab B_ushkf B_ushkm B_ushsch B_vekat B_vl B_wnws0e B_ztafix cmibeg_w cserk ctrerf1 ctrzyf0 ctrzyf1 ctr_phade dcounte_w dcountz_w dcycnt dfrmoff_w dimldthm dimlezthm dkatakt_w dlahi_w dlahp_w dlamatr_w dlashkm_w dmdafmb dmdlfmb dmdsfmb_w dmletanf_w dmletan_w dmllri_w dmrlash_w dmvadfk_w dmvadfs_w dmvadko_w dmvadll_w dmvad_w dpbkvae_w dpbkvpa_w dpbkvppa_w drldkzu_w drlfue_w drlmaxo dtmabsta dtmbhb dtwiml_w dwkrz dwnwsp_w dwped dynlsu_w etazwbm facipkr_w fcmEnd fforn1 fho fkatei fkmsdks_w fkmsdk_w fkpvdkg_w fkpvdk_w flakh fldrrx_w fldrxl_w fldrxo_w flg_m fmdkh fmsla fmsndko_w fprstep_c fprtim_c fpvdk fradcv_w frao_w frau_w fra_w frkadcv_w frmfdif_w frmfref_w frmitf_w frmulti_w frmxaf_w frm_w frxt frxta_w fr_w ftead_w ftefsoll_w ftefva_w fukabak_w fukabaw_w fukavak_w fukavaw_w fzabgs_w fzabg_w fzmd gangi imlatm_w imlbbo imlkvs_w imllaka_w imlpr katbf katbfi_w katbfs katbshd_w kfoelkbi_nmot kldfpwm kmdp1km_w kmstmil_w kmst_w ksta0 ksta1 ksta2 kstaa kusvk_w kvakbi_w ladiff_w lambts_w lamelsh_w lamfa_w lamlash_w lamsbg_w lamsoni_w lamsons_w lamzak_w lbz ldimn_w ldimxak_w ldimxa_w ldimx_w ldrlms_w ldrlts_w ldtv ldtvm lrnstat lrnstep_c lrntim_c lrnvb_c lws_w m6smsl_w m6wmslv_w m6wmsl_w m6wthm_w mds_w mdverb mdverl_w miasrl_w miasrs_w miext_w mifab_w mifafu_w mifa_w miges_w migs_w miist_w milsol_w misol_w miszul_w mkolsc ml mldmn_w mldmx_w mldyn_w mlhfmm_w mlmdthm ml_w mrfa_w mrfgr_w mrped_w msabg_w msdk_w mshfm_w msl mslift mslt_w mslvt_w mslv_w msndko_w mspcv mstedtef_w nllkh nlp1tim nmot nmotll nmot_w nsol pbkv pbkvmod_w pbkv_w phlsnh pkodrc plsol ps_w pukorf_w pulscthld pu_w pvdk pvdkds_w pvdks_w ready rinh_w rinsh_w rkat_w rkaz_w rkrn_w rkte_w rk_w rl rldkofk_w rlmax_w rlmxko_w rlmx_w rlsol_w rlzuhfs_w rmsl rmslf rmslt rmstevuf_w rmstev_w simldthm simlezthm statgra S_fgrat S_fgrhs S_fgrsv S_fgrwb taats_w tabgbts_w tabgm tabgpr_w tabgss_w tabst_w tadtea tahsomf_w tahsom_w talsuf tamax tamb tambmin tamin tans tanslin tateout tats_w tavvkm_w tbdbkvp_w tc6ldpc tc6ldps tc6ldpw tdcvm_w tedtml tedub tephc te_w tikatm_w timrs timxth_w timx_w timzldp tispldpx_w tispldp_w ti_b1 tkatm tldppmw tmadb tmew tmki tmkic tmot tmotlin tmotlinst tmrw tmrwend tmst tnse_w tnst_w toffdthm_w tolc top_w tpfifo tpldptcx_w tpldptc_w tripkm tumc ub ubrsq ubsq udknlp1r udknlp2r udkp1asr_w udkp1_w udkp2asr_w udkp2_w uhsv upwg1_w upwg2_w upwkd_w ushfmxstg ushk ushkmxstg ushksteig usvkk_w uulsuv_w vdcve_w vdcvz_w vfil_w vfmdthm vfzg vfzroh_w vziel_w wdkba wdks wkrdya wkrm wkrma wkrmdy_w wkrmstat_w wnweos wnwe_w wnwim_w wnwise_w wnwi_ad_w wnwi_w wnwkor_w wnwkwas_w wnwse_w wnwsp_w wped_w wub wubr wuccnt zbezdldr zbezdthm zbeztafix zfzptafx zhklsu zlash_w zlkd zllptafx zwdynsh zwist zwout /end IN_MEASUREMENT
 /begin OUT_MEASUREMENT B_acc B_accen B_craus B_fa B_faa B_faadagl B_faadkl B_faagr B_faam B_faan B_faatlb B_faatm B_fabks B_fabkv B_fadesu B_fadylsu B_fadylsu2 B_faevz B_faezla B_fafrst B_fahsh B_fakat B_fakat2 B_fakd B_fakmtr B_fakrs B_fakth B_fakth2 B_fakvs B_falbk B_faldp B_falr B_falra B_falrsfk B_falrshk B_falrshk2 B_falsf B_falsf2 B_falsfhv B_falsfhv2 B_falsh B_falshv B_falsv B_falsv2 B_falues B_falzsr B_fan B_fanohk B_fanwkw B_fanws B_fanwsa B_fanwse B_faobv B_fapllsu B_fapllsu2 B_fasalsu B_fasf B_fasf2 B_fash B_fash2 B_fasls B_fates B_fatnv B_fatnv2 B_fatp B_fatp2 B_fatv B_fatv2 B_fgrte B_grdst B_hlon B_kstebf B_lrndia B_luef1 B_luef2 B_luef3 vstagr vstcns vstdzw vstfba vstfns vstfrk vstfst vstfva vstfwl vstlr vstmdr vstnls vstrlx vstvvr /end OUT_MEASUREMENT
 /begin LOC_MEASUREMENT /end LOC_MEASUREMENT
 /begin SUB_FUNCTION /end SUB_FUNCTION
/end FUNCTION
/begin FUNCTION TKSTA "3.130     Testerkommunikation; Stellgliedansteuerung" /begin DEF_CHARACTERISTIC CWKUEKD CWSTAKD CWSTAKD2 CWSTEVKD /end DEF_CHARACTERISTIC /begin REF_CHARACTERISTIC /end REF_CHARACTERISTIC /begin IN_MEASUREMENT B_cdbkvp B_slsfz nmot_w /end IN_MEASUREMENT /begin OUT_MEASUREMENT /end OUT_MEASUREMENT /begin LOC_MEASUREMENT /end LOC_MEASUREMENT /begin SUB_FUNCTION /end SUB_FUNCTION /end FUNCTION
/begin FUNCTION TN "3.20      Drehzahlmesser Signal" /begin DEF_CHARACTERISTIC /end DEF_CHARACTERISTIC /begin REF_CHARACTERISTIC /end REF_CHARACTERISTIC /begin IN_MEASUREMENT B_syn zzyl /end IN_MEASUREMENT /begin OUT_MEASUREMENT /end OUT_MEASUREMENT /begin LOC_MEASUREMENT /end LOC_MEASUREMENT /begin SUB_FUNCTION /end SUB_FUNCTION /end FUNCTION
/begin FUNCTION TNOT "" /begin DEF_CHARACTERISTIC /end DEF_CHARACTERISTIC /begin REF_CHARACTERISTIC /end REF_CHARACTERISTIC /begin IN_MEASUREMENT zzyl /end IN_MEASUREMENT /begin OUT_MEASUREMENT B_anschlag zzylkr /end OUT_MEASUREMENT /begin LOC_MEASUREMENT /end LOC_MEASUREMENT /begin SUB_FUNCTION /end SUB_FUNCTION /end FUNCTION
/begin FUNCTION TREV_OV "" /begin DEF_CHARACTERISTIC /end DEF_CHARACTERISTIC /begin REF_CHARACTERISTIC /end REF_CHARACTERISTIC /begin IN_MEASUREMENT /end IN_MEASUREMENT /begin OUT_MEASUREMENT B_trev_inc trevovCtr /end OUT_MEASUREMENT /begin LOC_MEASUREMENT /end LOC_MEASUREMENT /begin SUB_FUNCTION /end SUB_FUNCTION /end FUNCTION
/begin FUNCTION TUNING "Tuningschutz" /begin DEF_CHARACTERISTIC /end DEF_CHARACTERISTIC /begin REF_CHARACTERISTIC SGIDB5 /end REF_CHARACTERISTIC /begin IN_MEASUREMENT B_pwf /end IN_MEASUREMENT /begin OUT_MEASUREMENT /end OUT_MEASUREMENT /begin LOC_MEASUREMENT B_sersw B_tDelayEnd B_tuning ctr_hscmp tun_det tun_errcode /end LOC_MEASUREMENT /begin SUB_FUNCTION /end SUB_FUNCTION /end FUNCTION
/begin FUNCTION UFACCC "1.10      EGAS Überwachungskonzept: ACC Eingangssignalüberwachung der Funktionüberwachung" /begin DEF_CHARACTERISTIC BACC_T_UM DBACCMX_UM DBACC_T_UM /end DEF_CHARACTERISTIC /begin REF_CHARACTERISTIC /end REF_CHARACTERISTIC /begin IN_MEASUREMENT B_accab B_noacc_fr /end IN_MEASUREMENT /begin OUT_MEASUREMENT bzacc_um B_acce_um B_noacc_um mracc_um /end OUT_MEASUREMENT /begin LOC_MEASUREMENT b2acc_um bacc_c_um bzacc_a_um B_bacce_um dbacc_c_um /end LOC_MEASUREMENT /begin SUB_FUNCTION /end SUB_FUNCTION /end FUNCTION
/begin FUNCTION UFEING "13.10     EGAS Überwachungskonzept: Eingangssignalübernahme für Funktionsüberwachung" /begin DEF_CHARACTERISTIC /end DEF_CHARACTERISTIC /begin REF_CHARACTERISTIC /end REF_CHARACTERISTIC /begin IN_MEASUREMENT B_i_ska_fr B_notlu_fr B_ub_ok evz_austot tans tmot /end IN_MEASUREMENT /begin OUT_MEASUREMENT evz_aus_um tans_um tmot_um /end OUT_MEASUREMENT /begin LOC_MEASUREMENT /end LOC_MEASUREMENT /begin SUB_FUNCTION /end SUB_FUNCTION /end FUNCTION
/begin FUNCTION UFEINS "" /begin DEF_CHARACTERISTIC NMV08_UM NZWV08_UM RLV08_UM SPSNV08_UM /end DEF_CHARACTERISTIC /begin REF_CHARACTERISTIC /end REF_CHARACTERISTIC /begin IN_MEASUREMENT nmot_um rl_um spsn_um /end IN_MEASUREMENT /begin OUT_MEASUREMENT nmst08_um nzwst08_um rlst08_um spsnst08_um /end OUT_MEASUREMENT /begin LOC_MEASUREMENT /end LOC_MEASUREMENT /begin SUB_FUNCTION /end SUB_FUNCTION /end FUNCTION
/begin FUNCTION UFFGRC "5.10      EGAS Überwachungskonzept: FGR-Überwachung der Funktionsüberwachung" /begin DEF_CHARACTERISTIC VMIN_UM /end DEF_CHARACTERISTIC /begin REF_CHARACTERISTIC /end REF_CHARACTERISTIC /begin IN_MEASUREMENT B_fgr mifa vfzg_w /end IN_MEASUREMENT /begin OUT_MEASUREMENT B_fgr_um mfgr_um /end OUT_MEASUREMENT /begin LOC_MEASUREMENT /end LOC_MEASUREMENT /begin SUB_FUNCTION /end SUB_FUNCTION /end FUNCTION
/begin FUNCTION UFFGRE "14.20     EGAS Überwachungskonzept: FGR-Eingangsinfos für die Funktionsüberwachung"
 /begin DEF_CHARACTERISTIC BGRA_T_UM BRACC_T_UM BREMS_T_UM BRESP_T_UM DBGRAMX_UM DBGRA_T_UM /end DEF_CHARACTERISTIC
 /begin REF_CHARACTERISTIC CWGRABH /end REF_CHARACTERISTIC
 /begin IN_MEASUREMENT B_acc B_bkva B_bkvv B_fabr B_fgrab S_bls S_brs S_fgrat S_fgrhs S_fgrsv S_fgrwb /end IN_MEASUREMENT
 /begin OUT_MEASUREMENT B_bgrae_um /end OUT_MEASUREMENT
 /begin LOC_MEASUREMENT b2gra_um b3gra_um bgra_c_um bracc_c_um brems_c_um bresp_c_um bzgra_a_um bzgra_um B_graat_um B_graen_um B_grahe_um B_grahs_um B_grase_um B_gratd_um B_gratu_um B_grawa_um dbgra_c_um /end LOC_MEASUREMENT
 /begin SUB_FUNCTION /end SUB_FUNCTION
/end FUNCTION
/begin FUNCTION UFMIST "2.10      EGAS Überwachungskonzept: Ist-Moment der Funktionsüberwachung" /begin DEF_CHARACTERISTIC KFMI_UM KFZW_UM KLETAZW_UM /end DEF_CHARACTERISTIC /begin REF_CHARACTERISTIC NZWV08_UM RLV08_UM /end REF_CHARACTERISTIC /begin IN_MEASUREMENT nmot_um nzwst08_um rlst08_um rl_um zwout_um /end IN_MEASUREMENT /begin OUT_MEASUREMENT mi_um /end OUT_MEASUREMENT /begin LOC_MEASUREMENT dzw_um etazw_um miopt_um zwopt_um /end LOC_MEASUREMENT /begin SUB_FUNCTION /end SUB_FUNCTION /end FUNCTION
/begin FUNCTION UFMSRC "5.10      EGAS Überwachungskonzept: MSR-Eingriff-Überwachung für die Funktionsüberwachung" /begin DEF_CHARACTERISTIC BZ_MSR_UM DBZ_MN_UM DBZ_MX_UM MSRC_T_UM NOASR_UM /end DEF_CHARACTERISTIC /begin REF_CHARACTERISTIC /end REF_CHARACTERISTIC /begin IN_MEASUREMENT bz_msr B_nomsr_fr /end IN_MEASUREMENT /begin OUT_MEASUREMENT B_nkons_um B_nomsr_um ei_msrc_um mmsr_um /end OUT_MEASUREMENT /begin LOC_MEASUREMENT bzmsr_a_um msrc_c_um /end LOC_MEASUREMENT /begin SUB_FUNCTION /end SUB_FUNCTION /end FUNCTION
/begin FUNCTION UFMVER "2.10      EGAS Überwachungskonzept: Momentenvergleich der Funktionsüberwachung" /begin DEF_CHARACTERISTIC MVER_T_UM /end DEF_CHARACTERISTIC /begin REF_CHARACTERISTIC /end REF_CHARACTERISTIC /begin IN_MEASUREMENT B_i_ska_um mi_um mzf_um mzo_um /end IN_MEASUREMENT /begin OUT_MEASUREMENT /end OUT_MEASUREMENT /begin LOC_MEASUREMENT ei_mver_um mdif_w_um mver_c_um mzfo_um /end LOC_MEASUREMENT /begin SUB_FUNCTION /end SUB_FUNCTION /end FUNCTION
/begin FUNCTION UFMZF "1.10      EGAS Überwachungskonzept: Momentenfilter für die Funktionsüberwachung" /begin DEF_CHARACTERISTIC MZFFIL_UM MZFTV_UM /end DEF_CHARACTERISTIC /begin REF_CHARACTERISTIC /end REF_CHARACTERISTIC /begin IN_MEASUREMENT mz_um /end IN_MEASUREMENT /begin OUT_MEASUREMENT /end OUT_MEASUREMENT /begin LOC_MEASUREMENT mzf_low_um mzf_ptr_um mzf_reg_um mzf_um /end LOC_MEASUREMENT /begin SUB_FUNCTION /end SUB_FUNCTION /end FUNCTION
/begin FUNCTION UFMZUL "12.20     EGAS Überwachungskonzept: zulässiges Moment der Funktionsüberwachung" /begin DEF_CHARACTERISTIC KFMDZOF_UM KFMPED_UM KFMPNS_UM MDV08_UM /end DEF_CHARACTERISTIC /begin REF_CHARACTERISTIC NMV08_UM SPSNV08_UM /end REF_CHARACTERISTIC
 /begin IN_MEASUREMENT mfgr_um mmsr_um msgs_um nmot_um nmst08_um spsnst08_um spsn_um /end IN_MEASUREMENT
 /begin OUT_MEASUREMENT B_vbmag_um mdst08_um mzo_um mz_um /end OUT_MEASUREMENT
 /begin LOC_MEASUREMENT mped_um /end LOC_MEASUREMENT
 /begin SUB_FUNCTION /end SUB_FUNCTION
/end FUNCTION
/begin FUNCTION UFNC "3.20      EGAS Überwachungskonzept: N-Überwachung für die Funktionsüberwachung" /begin DEF_CHARACTERISTIC NC_T_UM NDIF_UM NMIN_UM TZTOL_UM /end DEF_CHARACTERISTIC /begin REF_CHARACTERISTIC /end REF_CHARACTERISTIC /begin IN_MEASUREMENT B_i_ska_um nmot /end IN_MEASUREMENT /begin OUT_MEASUREMENT /end OUT_MEASUREMENT
 /begin LOC_MEASUREMENT ei_nc_um nc_c_um nmot_um nz_um talt_um tcap_um zalt_um zcap_um zsync_um /end LOC_MEASUREMENT
 /begin SUB_FUNCTION /end SUB_FUNCTION
/end FUNCTION
/begin FUNCTION UFNSC "2.10      EGAS Überwachungskonzept: Nachstartüberwachung für die Funktionsüberwachung"
 /begin DEF_CHARACTERISTIC NSC_T_UM NSOF_T_UM N_START_UM N_STEND_UM TANSMN_UM TMNSMN_UM /end DEF_CHARACTERISTIC
 /begin REF_CHARACTERISTIC /end REF_CHARACTERISTIC
 /begin IN_MEASUREMENT nmot_um tans_um tmot_um /end IN_MEASUREMENT
 /begin OUT_MEASUREMENT B_mzns_um /end OUT_MEASUREMENT
 /begin LOC_MEASUREMENT nsc_c_um nsof_c_um /end LOC_MEASUREMENT
 /begin SUB_FUNCTION /end SUB_FUNCTION
/end FUNCTION
/begin FUNCTION UFREAC "4.31      EGAS Überwachungskonzept: Fehlerreaktionsüberw.d.Funktionsüberwachung" /begin DEF_CHARACTERISTIC KLNPED_UM NOREA_UM REAC_T1_UM REAC_T2_UM SKA_DRHZ_UM /end DEF_CHARACTERISTIC /begin REF_CHARACTERISTIC /end REF_CHARACTERISTIC /begin IN_MEASUREMENT B_i_ska_um evz_aus_um nmot_um spsn_um /end IN_MEASUREMENT /begin OUT_MEASUREMENT ei_reac_um /end OUT_MEASUREMENT /begin LOC_MEASUREMENT nska_um reac_c1_um reac_c2_um /end LOC_MEASUREMENT /begin SUB_FUNCTION /end SUB_FUNCTION /end FUNCTION
/begin FUNCTION UFRLC "5.10      EGAS Überwachungskonzept: Lastsignalüberw. für Funktionsüberwachung"
 /begin DEF_CHARACTERISTIC IP1A_MX_UM IP2A_MN_UM IPA_T_UM KFRLIP_UM NRLIP_UM RLC_T_UM RLIPFIL_UM RLIPTV_UM RLIP_T_UM RL_BO_UM RL_MO_UM /end DEF_CHARACTERISTIC
 /begin REF_CHARACTERISTIC /end REF_CHARACTERISTIC
 /begin IN_MEASUREMENT B_ehfs B_i_ska_um B_wdk2sel iUipoti1_w iUipoti2_w nmot_um rl rl_w udkp1a udkp2a /end IN_MEASUREMENT
 /begin OUT_MEASUREMENT ei_ipa_um ei_rlc_um ei_rlip_um rl_um /end OUT_MEASUREMENT
 /begin LOC_MEASUREMENT ipa_c_um ipsn_um rlc_c_um rlf_ptr_um rlf_reg_um rlipf_low_um rlipf_um rlip_c_um rlip_um rlzo_um rl_w_um /end LOC_MEASUREMENT
 /begin SUB_FUNCTION /end SUB_FUNCTION
/end FUNCTION
/begin FUNCTION UFSGSC "3.10      EGAS Überwachungskonzept: SGS-Eingriff-Überwachung für die Funktionsübersicht" /begin DEF_CHARACTERISTIC /end DEF_CHARACTERISTIC /begin REF_CHARACTERISTIC /end REF_CHARACTERISTIC /begin IN_MEASUREMENT /end IN_MEASUREMENT /begin OUT_MEASUREMENT B_nosgs_um ei_sgsc_um msgs_um /end OUT_MEASUREMENT /begin LOC_MEASUREMENT /end LOC_MEASUREMENT /begin SUB_FUNCTION /end SUB_FUNCTION /end FUNCTION
/begin FUNCTION UFSPSC "2.30      EGAS Überwachungskonzept: Pedal-Sollwert-Ü. für Funktionsüberwachung" /begin DEF_CHARACTERISTIC SP12LL_UM SP12VG_UM SPSC_MIN_UM SPSC_T_UM SPSVG_UM /end DEF_CHARACTERISTIC /begin REF_CHARACTERISTIC /end REF_CHARACTERISTIC
 /begin IN_MEASUREMENT B_i_ska_um B_pwgnotfr B_sp1s B_sp2s B_spsmin iUspoti1_w iUspoti2_w /end IN_MEASUREMENT
 /begin OUT_MEASUREMENT B_pwgnotum ei_spsc_um spsn_um /end OUT_MEASUREMENT
 /begin LOC_MEASUREMENT sp1s_um sp2s_um spsc_c_um /end LOC_MEASUREMENT
 /begin SUB_FUNCTION /end SUB_FUNCTION
/end FUNCTION
/begin FUNCTION UFURAM "" /begin DEF_CHARACTERISTIC RST_TV_UM UMECRST_TV_UM UMRST_TV_UM WAIT_T_UM /end DEF_CHARACTERISTIC /begin REF_CHARACTERISTIC /end REF_CHARACTERISTIC /begin IN_MEASUREMENT /end IN_MEASUREMENT
 /begin OUT_MEASUREMENT b_flags_um B_i_ska_um n_flags_um reac_c_um romz_c_um r_flags_um srst_c_um s_flags_um t_flags_um umrst_c_um wri_c_um z_flags_um /end OUT_MEASUREMENT
 /begin LOC_MEASUREMENT B_accen_um B_accof_um B_brems_um B_brfgr_um B_bsl_um B_dcdis_c_um B_dcdis_um B_fgrenold_um B_fgren_um B_fgron_um B_fgr_um_c B_i_ska B_kkl_um B_ll_um B_msthw_um B_mzns_c_um B_nlh_um B_nobrs_um B_nome_c_um B_notlu B_notst_um B_nsakt_um B_nsend_um B_res_um B_rlc_um B_ubska_c_um B_ub_ska B_vzl_um B_wal_um ram_c_um reset_indication_um romErrPage rst_tv /end LOC_MEASUREMENT
 /begin SUB_FUNCTION /end SUB_FUNCTION
/end FUNCTION
/begin FUNCTION UFZWC "2.20      EGAS Überwachungskonzept: ZW-Überwachung für Funktionsüberwachung" /begin DEF_CHARACTERISTIC ZWC_T_UM ZYLANZ_UM /end DEF_CHARACTERISTIC /begin REF_CHARACTERISTIC /end REF_CHARACTERISTIC /begin IN_MEASUREMENT B_i_ska_um zwout zwoutcpl /end IN_MEASUREMENT /begin OUT_MEASUREMENT ei_zwc_um zwout_um /end OUT_MEASUREMENT /begin LOC_MEASUREMENT zwc_c_um /end LOC_MEASUREMENT /begin SUB_FUNCTION /end SUB_FUNCTION /end FUNCTION
/begin FUNCTION UMKOM "7.20      EGAS Überwachungskonzept: Frage/Antwort-Kommunikation zw. UM und FR" /begin DEF_CHARACTERISTIC AUSC_A_UM /end DEF_CHARACTERISTIC /begin REF_CHARACTERISTIC /end REF_CHARACTERISTIC /begin IN_MEASUREMENT B_i_ska_um B_ubdve nmot /end IN_MEASUREMENT /begin OUT_MEASUREMENT auscf_c_um ei_ubr_um uma2_res umErrorCtrFr /end OUT_MEASUREMENT /begin LOC_MEASUREMENT ausc_c_um /end LOC_MEASUREMENT /begin SUB_FUNCTION /end SUB_FUNCTION /end FUNCTION
/begin FUNCTION URADCC "2.20      EGAS Überwachungskonzept: AD-Wandler-Test" /begin DEF_CHARACTERISTIC ADCC_T_UM SP1ADC_DIF SP1_STAT SP1_STAT_T /end DEF_CHARACTERISTIC /begin REF_CHARACTERISTIC /end REF_CHARACTERISTIC /begin IN_MEASUREMENT B_i_ska_fr B_i_ska_um B_notlu_fr B_pwgnotum iUspoti1_w /end IN_MEASUREMENT /begin OUT_MEASUREMENT ei_adcc_um /end OUT_MEASUREMENT /begin LOC_MEASUREMENT adcc_c_um sp1p_a_um sp1p_st_um sp1s_a_um sp1s_st_um /end LOC_MEASUREMENT /begin SUB_FUNCTION /end SUB_FUNCTION /end FUNCTION
/begin FUNCTION URAUSG "" /begin DEF_CHARACTERISTIC AUSGH_T_UM AUSG_T_UM AUSZH_T_UM AUSZ_T_UM /end DEF_CHARACTERISTIC /begin REF_CHARACTERISTIC /end REF_CHARACTERISTIC /begin IN_MEASUREMENT /end IN_MEASUREMENT /begin OUT_MEASUREMENT /end OUT_MEASUREMENT /begin LOC_MEASUREMENT ausgh_c_um ausg_c_um auszh_c_um ausz_c_um /end LOC_MEASUREMENT /begin SUB_FUNCTION /end SUB_FUNCTION /end FUNCTION
/begin FUNCTION URCAUS "" /begin DEF_CHARACTERISTIC /end DEF_CHARACTERISTIC /begin REF_CHARACTERISTIC /end REF_CHARACTERISTIC
 /begin IN_MEASUREMENT B_fgr_uc B_i_ska_uc B_nosgs_uc ei_msrc_uc ei_mver_uc ei_reac_uc ei_sgsc_uc mfgr_uc mi_uc mmsr_uc mped_uc msgs_uc mver_c_uc mzfo_uc reac_c1_uc reac_c2_uc uma2_res /end IN_MEASUREMENT
 /begin OUT_MEASUREMENT /end OUT_MEASUREMENT
 /begin LOC_MEASUREMENT /end LOC_MEASUREMENT
 /begin SUB_FUNCTION /end SUB_FUNCTION
/end FUNCTION
/begin FUNCTION URCEIN ""
 /begin DEF_CHARACTERISTIC ASRL_DAT_UC ASRS_DAT_UC BFGR_DAT_UC BNOMSR_DAT_UC BZMSRA_DAT_UC BZMSR_DAT_UC BZ_ST_DAT_UC CBIT_DAT_UC CMSR_DAT_UC EVZ_DAT_UC MEBZA_DAT_UC MECS_DAT_UC MER_D1_UC MER_D2_UC MIFA_DAT_UC MSGS_DAT_UC MSPSN_DAT_UC MSRC_D_UC MVER_D_UC MZFPTR_DAT_UC MZFREG_DAT_UC MZF_DAT_UC MZL_DAT_UC NFLAGS_D_UC NMOT_DAT_UC REAC_D1_UC REAC_D2_UC RFLAGS_D_UC RL_DAT_UC SFLAGS_D_UC SGSC_D_UC SPSC_MINUC SPSN_DAT_UC TFLAGS_D_UC VFZG_DAT_UC ZFLAGS_D_UC ZWOUT_DAT_UC /end DEF_CHARACTERISTIC
 /begin REF_CHARACTERISTIC /end REF_CHARACTERISTIC
 /begin IN_MEASUREMENT /end IN_MEASUREMENT
 /begin OUT_MEASUREMENT bzmsr_a_uc bz_msr_uc B_fgrfr_uc B_nomsrfr_uc evz_aus_uc mifa_uc nmot_uc rl_uc spsn_uc vfzg_uc zwout_uc /end OUT_MEASUREMENT
 /begin LOC_MEASUREMENT x_uc y_uc /end LOC_MEASUREMENT
 /begin SUB_FUNCTION /end SUB_FUNCTION
/end FUNCTION
/begin FUNCTION URCEINS "" /begin DEF_CHARACTERISTIC NMV08_UC NZWV08_UC RLV08_UC SPSNV08_UC /end DEF_CHARACTERISTIC /begin REF_CHARACTERISTIC /end REF_CHARACTERISTIC /begin IN_MEASUREMENT nmot_uc rl_uc spsn_uc /end IN_MEASUREMENT /begin OUT_MEASUREMENT nmst08_uc nzwst08_uc rlst08_uc spsnst08_uc /end OUT_MEASUREMENT /begin LOC_MEASUREMENT /end LOC_MEASUREMENT /begin SUB_FUNCTION /end SUB_FUNCTION /end FUNCTION
/begin COMPU_METHOD B_TRUE "boolsche Zustände, positive Logik" TAB_VERB "%6.3" "" COMPU_TAB_REF B_TRUE /end COMPU_METHOD
/begin COMPU_VTAB B_TRUE "boolsche Zustände, positive Logik" TAB_VERB 2 0 "----" 1 "TRUE" /end COMPU_VTAB
/begin COMPU_METHOD dez "1 : 1 Umrechnug (dez/hex)" RAT_FUNC "%6.2" "" COEFFS 0 1 0 0 0 1 /end COMPU_METHOD
/begin COMPU_METHOD dezsub1 "" RAT_FUNC "%6.2" "-" COEFFS 0 1 -1 0 0 1 /end COMPU_METHOD
/begin COMPU_METHOD fak_q0p00195 "" RAT_FUNC "%6.4" "-" COEFFS 0 65536 0 0 0 128 /end COMPU_METHOD
/begin COMPU_METHOD fak_sb_b1 "" RAT_FUNC "%6.4" "-" COEFFS 0 256 0 0 0 2 /end COMPU_METHOD
/begin COMPU_METHOD fak_sb_b16 "" RAT_FUNC "%6.3" "-" COEFFS 0 256 0 0 0 32 /end COMPU_METHOD
/begin COMPU_METHOD fak_sb_b2 "" RAT_FUNC "%6.4" "-" COEFFS 0 256 0 0 0 4 /end COMPU_METHOD
/begin COMPU_METHOD fak_sb_b64 "" RAT_FUNC "%6.3" "-" COEFFS 0 256 0 0 0 128 /end COMPU_METHOD
/begin COMPU_METHOD fak_sb_q0p5 "" RAT_FUNC "%6.3" "-" COEFFS 0 256 0 0 0 128 /end COMPU_METHOD
/begin COMPU_METHOD fak_sw_b2 "" RAT_FUNC "%7.6" "-" COEFFS 0 65536 0 0 0 4 /end COMPU_METHOD
/begin COMPU_METHOD fak_sw_b64 "" RAT_FUNC "%6.4" "-" COEFFS 0 65536 0 0 0 128 /end COMPU_METHOD
/begin COMPU_METHOD fak_ub_b0p03125 "" RAT_FUNC "%6.5" "-" COEFFS 0 256 0 0 0 0.03125 /end COMPU_METHOD
/begin COMPU_METHOD fak_ub_b0p5 "" RAT_FUNC "%6.4" "-" COEFFS 0 256 0 0 0 0.5 /end COMPU_METHOD
/begin COMPU_METHOD fak_ub_b1 "" RAT_FUNC "%6.4" "-" COEFFS 0 256 0 0 0 1 /end COMPU_METHOD
/begin COMPU_METHOD fak_ub_b16 "" RAT_FUNC "%6.4" "-" COEFFS 0 256 0 0 0 16 /end COMPU_METHOD
/begin COMPU_METHOD fak_ub_b1p25_o0p75 "" RAT_FUNC "%6.3" "-" COEFFS 0 1 -0.75 0 0 0.00195313 /end COMPU_METHOD
/begin COMPU_METHOD fak_ub_b2 "" RAT_FUNC "%6.4" "-" COEFFS 0 256 0 0 0 2 /end COMPU_METHOD
/begin COMPU_METHOD fak_ub_b32 "" RAT_FUNC "%6.3" "-" COEFFS 0 256 0 0 0 32 /end COMPU_METHOD
/begin COMPU_METHOD fak_ub_b4 "" RAT_FUNC "%6.4" "-" COEFFS 0 256 0 0 0 4 /end COMPU_METHOD
/begin COMPU_METHOD fak_ub_b64 "" RAT_FUNC "%6.3" "-" COEFFS 0 256 0 0 0 64 /end COMPU_METHOD
/begin COMPU_METHOD fak_ub_b8 "" RAT_FUNC "%6.4" "-" COEFFS 0 256 0 0 0 8 /end COMPU_METHOD
/begin COMPU_METHOD fak_uw_b0p5 "" RAT_FUNC "%8.7" "-" COEFFS 0 65536 0 0 0 0.5 /end COMPU_METHOD
/begin COMPU_METHOD fak_uw_b1 "" RAT_FUNC "%7.6" "-" COEFFS 0 65536 0 0 0 1 /end COMPU_METHOD
/begin COMPU_METHOD fak_uw_b16 "" RAT_FUNC "%6.5" "-" COEFFS 0 65536 0 0 0 16 /end COMPU_METHOD
/begin COMPU_METHOD fak_uw_b2 "" RAT_FUNC "%7.6" "-" COEFFS 0 65536 0 0 0 2 /end COMPU_METHOD
/begin COMPU_METHOD KennText "" RAT_FUNC "%6.2" "" COEFFS 0 1 0 0 0 1 /end COMPU_METHOD
/begin COMPU_METHOD m_ub_b1020 "" RAT_FUNC "%6.2" "kg/h" COEFFS 0 1 0 0 0 4 /end COMPU_METHOD
/begin COMPU_METHOD m_ub_q0p0444 "" RAT_FUNC "%6.4" "g" COEFFS 0 1 0 0 0 0.0444 /end COMPU_METHOD
/begin COMPU_METHOD m_uw_b25p6 "" RAT_FUNC "%6.5" "kg/h" COEFFS 0 65536 0 0 0 25.6 /end COMPU_METHOD
/begin COMPU_METHOD m_uw_b6553p5 "" RAT_FUNC "%6.3" "kg/h" COEFFS 0 1 0 0 0 0.1 /end COMPU_METHOD
/begin COMPU_METHOD m_uw_q3p2 "" RAT_FUNC "%6.2" "kg/h" COEFFS 0 1 0 0 0 3.2 /end COMPU_METHOD
/begin COMPU_METHOD nmot_q10 "" RAT_FUNC "%6.1" "" COEFFS 0 1 0 0 0 10 /end COMPU_METHOD
/begin COMPU_METHOD nmot_sb_q10 "" RAT_FUNC "%6.1" "U/min" COEFFS 0 1 0 0 0 10 /end COMPU_METHOD
/begin COMPU_METHOD nmot_ub_q40 "" RAT_FUNC "%6.1" "Upm" COEFFS 0 1 0 0 0 40 /end COMPU_METHOD
/begin COMPU_METHOD nmot_uw_q0p25 "" RAT_FUNC "%6.3" "U/min" COEFFS 0 1 0 0 0 0.25 /end COMPU_METHOD
/begin COMPU_METHOD perio_sw_b1p562 "" RAT_FUNC "%7.6" "1/s" COEFFS 0 65536 0 0 0 3.124 /end COMPU_METHOD
/begin COMPU_METHOD perio_sw_b6p125 "" RAT_FUNC "%6.5" "1/s" COEFFS 0 65536 0 0 0 12.25 /end COMPU_METHOD
/begin COMPU_METHOD perio_ub_b0p012207 "" RAT_FUNC "%10.8" "1/s" COEFFS 0 256 0 0 0 0.012207 /end COMPU_METHOD
/begin COMPU_METHOD perio_ub_b6p125 "" RAT_FUNC "%6.4" "1/s" COEFFS 0 256 0 0 0 6.125 /end COMPU_METHOD
/begin COMPU_METHOD p_sb_q0p25 "" RAT_FUNC "%6.3" "hPa" COEFFS 0 1 0 0 0 0.25 /end COMPU_METHOD
/begin COMPU_METHOD relDK_ub_b100 "" RAT_FUNC "%6.3" "% DK" COEFFS 0 255 0 0 0 100 /end COMPU_METHOD
/begin COMPU_METHOD rel_q0p00195 "" RAT_FUNC "%6.4" "%" COEFFS 0 65536 0 0 0 128 /end COMPU_METHOD
/begin COMPU_METHOD rel_sw_q0p0468 "" RAT_FUNC "%6.4" "%" COEFFS 0 65536 0 0 0 3072 /end COMPU_METHOD
/begin COMPU_METHOD rel_ub_b127p5 "" RAT_FUNC "%6.3" "%" COEFFS 0 2 0 0 0 1 /end COMPU_METHOD
/begin COMPU_METHOD rel_ub_b25 "" RAT_FUNC "%6.3" "%" COEFFS 0 256 0 0 0 25 /end COMPU_METHOD
/begin COMPU_METHOD rel_ub_b99p6 "" RAT_FUNC "%6.3" "%" COEFFS 0 256 0 0 0 100 /end COMPU_METHOD
/begin COMPU_METHOD rel_ub_q0p00153 "" RAT_FUNC "%6.4" "%" COEFFS 0 256 0 0 0 0.3906 /end COMPU_METHOD
/begin COMPU_METHOD rel_ub_q0p0029 "" RAT_FUNC "%6.4" "%" COEFFS 0 256 0 0 0 0.75 /end COMPU_METHOD
/begin COMPU_METHOD rel_ub_q0p3906 "" RAT_FUNC "%6.3" "%" COEFFS 0 256 0 0 0 100 /end COMPU_METHOD
/begin COMPU_METHOD rel_ub_q0p75 "" RAT_FUNC "%6.3" "%" COEFFS 0 1 0 0 0 0.75 /end COMPU_METHOD
/begin COMPU_METHOD rel_uw_b100 "" RAT_FUNC "%6.4" "%" COEFFS 0 65536 0 0 0 100 /end COMPU_METHOD
/begin COMPU_METHOD rel_uw_b192 "" RAT_FUNC "%6.4" "%" COEFFS 0 65536 0 0 0 192 /end COMPU_METHOD
/begin COMPU_METHOD rel_uw_q0p0234 "" RAT_FUNC "%6.4" "%" COEFFS 0 32 0 0 0 0.75 /end COMPU_METHOD
/begin COMPU_METHOD rgrad_uw_b1280 "" RAT_FUNC "%6.4" "%/s" COEFFS 0 65536 0 0 0 1280 /end COMPU_METHOD
/begin COMPU_METHOD spg_ub_q0p0098 "" RAT_FUNC "%6.4" "V" COEFFS 0 256 0 0 0 2.5 /end COMPU_METHOD
/begin COMPU_METHOD spg_ub_q0p019 "" RAT_FUNC "%6.4" "V" COEFFS 0 256 0 0 0 5 /end COMPU_METHOD
/begin COMPU_METHOD t100msxs_ub_b25p5 "" RAT_FUNC "%6.3" "s" COEFFS 0 1 0 0 0 0.1 /end COMPU_METHOD
/begin COMPU_METHOD t100msxs_uw_b6553p5 "" RAT_FUNC "%6.3" "s" COEFFS 0 1 0 0 0 0.1 /end COMPU_METHOD
/begin COMPU_METHOD t100msxs_uw_q100 "" RAT_FUNC "%6.3" "s" COEFFS 0 1 0 0 0 0.1 /end COMPU_METHOD
/begin COMPU_METHOD t10msxs_sb_q0p01 "" RAT_FUNC "%6.4" "s" COEFFS 0 1 0 0 0 0.01 /end COMPU_METHOD
/begin COMPU_METHOD t10msxs_ub_b2p55 "" RAT_FUNC "%6.4" "s" COEFFS 0 1 0 0 0 0.01 /end COMPU_METHOD
/begin COMPU_METHOD t20msxs_ub_b5p1 "" RAT_FUNC "%6.4" "s" COEFFS 0 1 0 0 0 0.02 /end COMPU_METHOD
/begin COMPU_METHOD t20msxs_ub_q0p32 "" RAT_FUNC "%6.3" "s" COEFFS 0 256 0 0 0 81.92 /end COMPU_METHOD
/begin COMPU_METHOD t40msxs_uw_q0p04 "" RAT_FUNC "%6.4" "s" COEFFS 0 1 0 0 0 0.04 /end COMPU_METHOD
/begin COMPU_METHOD t40ms_ub_b10200 "" RAT_FUNC "%7.2" "ms" COEFFS 0 1 0 0 0 40 /end COMPU_METHOD
/begin COMPU_METHOD temp_q0p0234_o273 "" RAT_FUNC "%6.1" "Grad C" COEFFS 0 1 273.15 0 0 0.0234375 /end COMPU_METHOD
/begin COMPU_METHOD temp_q6_o273 "" RAT_FUNC "%6.1" "Grad C" COEFFS 0 1 273.15 0 0 6 /end COMPU_METHOD
/begin COMPU_METHOD temp_ub_q0p75_o48 "" RAT_FUNC "%6.2" "Grad C" COEFFS 0 1 48 0 0 0.75 /end COMPU_METHOD
/begin COMPU_METHOD tinjection_sy "" RAT_FUNC "%6.4" "ms" COEFFS 0 375 0 0 0 1 /end COMPU_METHOD
/begin COMPU_METHOD t_min_q5p96em8 "" RAT_FUNC "%10.9" "Min" COEFFS 0 1 0 0 0 5.96e-008 /end COMPU_METHOD
/begin COMPU_METHOD t_wdt_high "" RAT_FUNC "%6.2" "ms" COEFFS 0 0.732422 0 0 0 1 /end COMPU_METHOD
/begin COMPU_METHOD vfzg_q1p0 "" RAT_FUNC "%6.2" "km/h" COEFFS 0 1 0 0 0 1 /end COMPU_METHOD
/begin COMPU_METHOD vfzg_uw_q0p00781 "" RAT_FUNC "%6.4" "km/h" COEFFS 0 1 0 0 0 0.0078125 /end COMPU_METHOD
/begin COMPU_METHOD zk100msxs_ub_b25p5 "" RAT_FUNC "%6.3" "s" COEFFS 0 0 256 0 10 0 /end COMPU_METHOD
/begin COMPU_METHOD zk100msxs_uw_b655 "" RAT_FUNC "%6.1" "s" COEFFS 0 0 65536 0 10 0 /end COMPU_METHOD
/begin COMPU_METHOD zk100msxs_uw_b6553 "" RAT_FUNC "%12.4" "s" COEFFS 0 0 65536 0 10 0 /end COMPU_METHOD
/begin COMPU_METHOD zk40ms_ub_b10200 "" RAT_FUNC "%6.1" "ms" COEFFS 0 0 10240 0 1 40 /end COMPU_METHOD
/begin COMPU_METHOD zw_sb_q0p75 "" RAT_FUNC "%6.3" "grad KW" COEFFS 0 255 0 0 0 191.25 /end COMPU_METHOD
/begin COMPU_METHOD zw_ub_q0p75 "" RAT_FUNC "%6.3" "Grad KW" COEFFS 0 255 0 0 0 191.25 /end COMPU_METHOD
/begin RECORD_LAYOUT GkfWSb FNC_VALUES 1 SBYTE COLUMN_DIR DIRECT /end RECORD_LAYOUT
/begin RECORD_LAYOUT GkfWUb FNC_VALUES 1 UBYTE COLUMN_DIR DIRECT /end RECORD_LAYOUT
/begin RECORD_LAYOUT GklWUb FNC_VALUES 1 UBYTE COLUMN_DIR DIRECT /end RECORD_LAYOUT
/begin RECORD_LAYOUT GklWUw FNC_VALUES 1 UWORD COLUMN_DIR DIRECT /end RECORD_LAYOUT
/begin RECORD_LAYOUT KfAxUbAyUbSstxSbSstyUbWUb NO_AXIS_PTS_X 1 UBYTE NO_AXIS_PTS_Y 2 UBYTE AXIS_PTS_X 3 SBYTE INDEX_INCR DIRECT AXIS_PTS_Y 4 UBYTE INDEX_INCR DIRECT FNC_VALUES 5 UBYTE COLUMN_DIR DIRECT /end RECORD_LAYOUT
/begin RECORD_LAYOUT KfAxUbAyUbSstxUbSstyUbWSb NO_AXIS_PTS_X 1 UBYTE NO_AXIS_PTS_Y 2 UBYTE AXIS_PTS_X 3 UBYTE INDEX_INCR DIRECT AXIS_PTS_Y 4 UBYTE INDEX_INCR DIRECT FNC_VALUES 5 SBYTE COLUMN_DIR DIRECT /end RECORD_LAYOUT
/begin RECORD_LAYOUT KfAxUbAyUbSstxUbSstyUbWUb NO_AXIS_PTS_X 1 UBYTE NO_AXIS_PTS_Y 2 UBYTE AXIS_PTS_X 3 UBYTE INDEX_INCR DIRECT AXIS_PTS_Y 4 UBYTE INDEX_INCR DIRECT FNC_VALUES 5 UBYTE COLUMN_DIR DIRECT /end RECORD_LAYOUT
/begin RECORD_LAYOUT KfAxUwAyUwSstxSwSstyUwWUw NO_AXIS_PTS_X 1 UWORD NO_AXIS_PTS_Y 2 UWORD AXIS_PTS_X 3 SWORD INDEX_INCR DIRECT AXIS_PTS_Y 4 UWORD INDEX_INCR DIRECT FNC_VALUES 5 UWORD COLUMN_DIR DIRECT /end RECORD_LAYOUT
/begin RECORD_LAYOUT KfWUb FNC_VALUES 1 UBYTE COLUMN_DIR DIRECT /end RECORD_LAYOUT
/begin RECORD_LAYOUT KlAUbSstSbWSb NO_AXIS_PTS_X 1 UBYTE AXIS_PTS_X 2 SBYTE INDEX_INCR DIRECT FNC_VALUES 3 SBYTE COLUMN_DIR DIRECT /end RECORD_LAYOUT
/begin RECORD_LAYOUT KlAUbSstUbWSb NO_AXIS_PTS_X 1 UBYTE AXIS_PTS_X 2 UBYTE INDEX_INCR DIRECT FNC_VALUES 3 SBYTE COLUMN_DIR DIRECT /end RECORD_LAYOUT
/begin RECORD_LAYOUT KlAUbSstUbWUb NO_AXIS_PTS_X 1 UBYTE AXIS_PTS_X 2 UBYTE INDEX_INCR DIRECT FNC_VALUES 3 UBYTE COLUMN_DIR DIRECT /end RECORD_LAYOUT
/begin RECORD_LAYOUT KlAUwSstUwWUw NO_AXIS_PTS_X 1 UWORD AXIS_PTS_X 2 UWORD INDEX_INCR DIRECT FNC_VALUES 3 UWORD COLUMN_DIR DIRECT /end RECORD_LAYOUT
/begin RECORD_LAYOUT KwbUb FNC_VALUES 1 UBYTE COLUMN_DIR DIRECT /end RECORD_LAYOUT
/begin RECORD_LAYOUT KwbUw FNC_VALUES 1 UWORD COLUMN_DIR DIRECT /end RECORD_LAYOUT
/begin RECORD_LAYOUT KwSb FNC_VALUES 1 SBYTE COLUMN_DIR DIRECT /end RECORD_LAYOUT
/begin RECORD_LAYOUT KwUb FNC_VALUES 1 UBYTE COLUMN_DIR DIRECT /end RECORD_LAYOUT
/begin RECORD_LAYOUT KwUw FNC_VALUES 1 UWORD COLUMN_DIR DIRECT /end RECORD_LAYOUT
/begin RECORD_LAYOUT SstAUbSstUb NO_AXIS_PTS_X 1 UBYTE AXIS_PTS_X 2 UBYTE INDEX_INCR DIRECT /end RECORD_LAYOUT
/end MODULE
/end PROJECT
