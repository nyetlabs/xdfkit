ASAP2_VERSION 1 3
/begin PROJECT X505R_24d1_0 "4019.XX"
/begin HEADER "" VERSION "X505R_24d1_0" PROJECT_NO X505R_24d1_0 /end HEADER
/begin MODULE DIM ""
/begin MOD_COMMON "" BYTE_ORDER MSB_LAST ALIGNMENT_BYTE 1 ALIGNMENT_WORD 2 ALIGNMENT_LONG 2 /end MOD_COMMON
/begin CHARACTERISTIC CNFKUPPL "Konfigurationsflag für die Auswertung des Kuplg.schalters in der LLR" VALUE 0x811295 KwUb 255.0 dez 0.00 255.0 FORMAT "%5.1" /end CHARACTERISTIC
/begin CHARACTERISTIC CNFLLRNS "Configurationsbyte für die LL-Solldrehzahlfreigabe" VALUE 0x819BA2 KwUb 255.0 dez 0.00 255.0 FORMAT "%5.1" /end CHARACTERISTIC
/begin CHARACTERISTIC CWCKBI "Codewort zum Empfang der CAN-Botschaft Kombi1" VALUE 0x81A6B9 KwUb 255.0 dez 0.00 255.0 FORMAT "%5.1" /end CHARACTERISTIC
/begin CHARACTERISTIC CWFAN "Codewort Drehzahlanforderung für Bandendetest" VALUE 0x819D91 KwUb 255.0 dez 0.00 255.0 FORMAT "%5.1" /end CHARACTERISTIC
/begin CHARACTERISTIC CWGALSV "Codewort für zurücksetzen von Adaptionswerte bei Error E_LSV" VALUE 0x818DE7 KwUb 255.0 dez 0.00 255.0 FORMAT "%5.1" /end CHARACTERISTIC
/begin CHARACTERISTIC CWKRLZFK "Codewort: Klopferkennung wird bei geführten Zylindern nicht abgeschaltet" VALUE 0x81982F KwUb 255.0 dez 0.00 255.0 FORMAT "%5.1" /end CHARACTERISTIC
/begin CHARACTERISTIC CWKRNLR "Codewort Notlauf KR bei Abfall eines von zwei KS" VALUE 0x819830 KwUb 255.0 dez 0.00 255.0 FORMAT "%5.1" /end CHARACTERISTIC
/begin CHARACTERISTIC CWKRRA "Codewort für die Funktion %KRRA" VALUE 0x819831 KwUb 255.0 dez 0.00 255.0 FORMAT "%5.1" /end CHARACTERISTIC
/begin CHARACTERISTIC CWKRREF "Codewort: Verhalten Referenzpegelnachführung bei Drehzahldynamik" VALUE 0x81968C KwUb 1.000 dez 0.00 1.000 FORMAT "%5.3" /end CHARACTERISTIC
/begin CHARACTERISTIC CWKUPPL "Codewort für Kupplung" VALUE 0x81141B KwUb 255.0 dez 0.00 255.0 FORMAT "%5.1" /end CHARACTERISTIC
/begin CHARACTERISTIC CWLAKH "Codewort für Funktion %LAKH" VALUE 0x819614 KwUb 255.0 dez 0.00 255.0 FORMAT "%5.1" /end CHARACTERISTIC
/begin CHARACTERISTIC CWLAMBTS "Codewort: Lambda Bauteileschutz" VALUE 0x81926E KwUb 255.0 dez 0.00 255.0 FORMAT "%5.1" /end CHARACTERISTIC
/begin CHARACTERISTIC CWLAMFAW "Codeword LAMFAW" VALUE 0x818FFE KwUb 255.0 dez 0.00 255.0 FORMAT "%5.1" /end CHARACTERISTIC
/begin CHARACTERISTIC CWLAMKH "Codewort Lambdakoordination bei Kat-heizen" VALUE 0x810E36 KwUb 255.0 dez 0.00 255.0 FORMAT "%5.1" /end CHARACTERISTIC
/begin CHARACTERISTIC CWLDIMX "Codewort für Applikationsverfahren KFLDIMX/KFLDIOPU" VALUE 0x819955 KwUb 255.0 dez 0.00 255.0 FORMAT "%5.1" /end CHARACTERISTIC
/begin CHARACTERISTIC CWLDRPLS "Codewort für %LDRPLS" VALUE 0x819954 KwUb 255.0 DEZ 0.00 255.0 FORMAT "%5.1" /end CHARACTERISTIC
/begin CHARACTERISTIC CWLLRPA "Codewort zur Auswahl des Parametersatzes des P-Anteils" VALUE 0x819C67 KwUb 255.0 dez 0.00 255.0 FORMAT "%5.1" /end CHARACTERISTIC
/begin CHARACTERISTIC CWNSTAT "Codewort zur nstat-Filterung" VALUE 0x811259 KwUb 255.0 dez 0.00 255.0 FORMAT "%5.1" /end CHARACTERISTIC
/begin CHARACTERISTIC CWREFI "Codewort: Neuinitialisierung von rkr mit REFINI bei Dynamik" VALUE 0x81968D KwUb 1.000 dez 0.00 1.000 FORMAT "%5.3" /end CHARACTERISTIC
/begin CHARACTERISTIC CWRLMX "Codeword für LDRLMX (Ladedruckregelung)" VALUE 0x819A1E KwUb 255.0 dez 0.00 255.0 FORMAT "%5.1" /end CHARACTERISTIC
/begin CHARACTERISTIC DLAMFAW "Schwellwert für Aktivierung Anfettung über Fahrerwunsch" VALUE 0x818FFF KwUb 1.992 fak_ub_b2 0.00 1.992 FORMAT "%5.3" /end CHARACTERISTIC
/begin CHARACTERISTIC DLAMOB "Delta Lambda bei Overboost" CURVE 0x819000 GklWUb 1.992 fak_ub_b2 0.00 1.992 FORMAT "%5.3"
 /begin AXIS_DESCR COM_AXIS nmot nmot_ub_q40 6 0.00 10200. AXIS_PTS_REF SNM06GKUB /end AXIS_DESCR
/end CHARACTERISTIC
/begin CHARACTERISTIC DLAMTANS "Lufttemperaturabhängige Anfettung" CURVE 0x81D0F6 KlAUbSstUbWSb 1.992 fak_sb_b1 -1.000 0.9922 FORMAT "%5.3"
 /begin AXIS_DESCR STD_AXIS tans temp_ub_q0p75_o48 4 -48.00 143.3 FORMAT "%5.1" DEPOSIT ABSOLUTE /end AXIS_DESCR
/end CHARACTERISTIC
/begin CHARACTERISTIC DLBTSF "Delta Lambdasoll für Bauteileschutz (gefiltert)" VALUE 0x81D22E KwUw 15.99976 fak_q0p000244 0.00 15.99976 FORMAT "%8.5" /end CHARACTERISTIC
/begin CHARACTERISTIC DMLLNGEZ "LLR: D-Verstärkung abh. von ngasf für Luftpfad" MAP 0x815FA6 KfAxUbAyUbSstxSwSstyUbWSw 199.9841 rel_q0p00305 -99.99360 99.99055 FORMAT "%8.5"
 /begin AXIS_DESCR STD_AXIS ngasf_w nmotg_sw_q0p39 6 -12800.16 12799.77 FORMAT "%8.2" DEPOSIT ABSOLUTE /end AXIS_DESCR
 /begin AXIS_DESCR STD_AXIS etazws rel_ub_b127p5 4 0.00 127.5 FORMAT "%5.1" DEPOSIT ABSOLUTE /end AXIS_DESCR
/end CHARACTERISTIC
/begin CHARACTERISTIC DMLLNGEZV "LLR: D-Verstärkung abh. von ngasf für Luftpfad" MAP 0x815FE8 KfAxUbAyUbSstxSwSstyUbWSw 199.9841 rel_q0p00305 -99.99360 99.99055 FORMAT "%8.5"
 /begin AXIS_DESCR STD_AXIS ngasf_w nmotg_sw_q0p39 6 -12800.16 12799.77 FORMAT "%8.2" DEPOSIT ABSOLUTE /end AXIS_DESCR
 /begin AXIS_DESCR STD_AXIS etazws rel_ub_b127p5 4 0.00 127.5 FORMAT "%5.1" DEPOSIT ABSOLUTE /end AXIS_DESCR
/end CHARACTERISTIC
/begin CHARACTERISTIC DMLLRLMNN "Untere Begrenzung für dmllrl" CURVE 0x8112B4 GklWSb 50.00 rel_sb_q0p39 -50.00 0.00 FORMAT "%5.2"
 /begin AXIS_DESCR COM_AXIS nmot_w nmot_uw_q0p25 6 0.00 16383.75 AXIS_PTS_REF SNM06LLUB /end AXIS_DESCR
/end CHARACTERISTIC
/begin CHARACTERISTIC DMLLRLMXN "Sicherheitskonzept: obere Begrenzung für dmllrl" CURVE 0x8112BA GklWUb 99.61 rel_ub_b99p6 0.00 99.61 FORMAT "%5.2"
 /begin AXIS_DESCR COM_AXIS nmot_w nmot_uw_q0p25 6 0.00 16383.75 AXIS_PTS_REF SNM06LLUB /end AXIS_DESCR
/end CHARACTERISTIC
/begin CHARACTERISTIC DMLLRMNN "Untere Begrenzung für dmllr_w" CURVE 0x8112C0 GklWSb 50.00 rel_sb_q0p39 -50.00 0.00 FORMAT "%5.2"
 /begin AXIS_DESCR COM_AXIS nmot_w nmot_uw_q0p25 6 0.00 16383.75 AXIS_PTS_REF SNM06LLUB /end AXIS_DESCR
/end CHARACTERISTIC
/begin CHARACTERISTIC DMLLRMNNK "Untere Begrenzung für dmllr_w im Kurztrip" CURVE 0x8112C6 GklWSb 50.00 rel_sb_q0p39 -50.00 0.00 FORMAT "%5.2"
 /begin AXIS_DESCR COM_AXIS nmot_w nmot_uw_q0p25 6 0.00 16383.75 AXIS_PTS_REF SNM06LLUB /end AXIS_DESCR
/end CHARACTERISTIC
/begin CHARACTERISTIC DMLLRMXN "Sicherheitskonzept: obere Begrenzung für dmllr" CURVE 0x8112CC GklWUb 99.61 rel_ub_b99p6 0.00 99.61 FORMAT "%5.2"
 /begin AXIS_DESCR COM_AXIS nmot_w nmot_uw_q0p25 6 0.00 16383.75 AXIS_PTS_REF SNM06LLUB /end AXIS_DESCR
/end CHARACTERISTIC
/begin CHARACTERISTIC DMLLRMXNK "Sicherheitskonzept: obere Begrenzung für dmllr im Kurztrip" CURVE 0x8112D2 GklWUb 99.61 rel_ub_b99p6 0.00 99.61 FORMAT "%5.2"
 /begin AXIS_DESCR COM_AXIS nmot_w nmot_uw_q0p25 6 0.00 16383.75 AXIS_PTS_REF SNM06LLUB /end AXIS_DESCR
/end CHARACTERISTIC
/begin CHARACTERISTIC DMRESLL "LLR: Abbaugeschwindigkeit der erhöhten Drehmomentreserve" VALUE 0x81141C KwUb 6.375 rel_ub_bn6p375 -6.375 0.00 FORMAT "%5.3" /end CHARACTERISTIC
/begin CHARACTERISTIC DNLLR "Drehzahlband oberhalb nstat für LLR-Freigabe" VALUE 0x811296 KwUb 2550. nmot_ub_q10 0.00 2550. FORMAT "%5.0" /end CHARACTERISTIC
/begin CHARACTERISTIC DNLLRES "LLR: Unterdrehzahlschwelle zur Erhöhung der Momentenreserve im LL" VALUE 0x81141D KwSb 2550. nmotd_sb_q10 -1280. 1270. FORMAT "%5.0" /end CHARACTERISTIC
/begin CHARACTERISTIC DNLLRIST "Überdrehzahlschwelle für Integratorreset" VALUE 0x8112D8 KwSb 2550. nmotd_sb_q10 -1280. 1270. FORMAT "%5.0" /end CHARACTERISTIC
/begin CHARACTERISTIC DNLLST "Drehzahlschwelle zum Deaktivieren der P-Verstärkung im Start" VALUE 0x8112D9 KwUb 255.0 nmot_q1 0.00 255.0 FORMAT "%5.1" /end CHARACTERISTIC
/begin CHARACTERISTIC DNMNI "Kleinstmöglicher Wert für dn beim I-Anteil" VALUE 0x8112DA KwSb 2550. nmotd_sb_q10 -1280. 1270. FORMAT "%5.0" /end CHARACTERISTIC
/begin CHARACTERISTIC DNSNFX "Offset zur Bestimmung der oberen Grenze für die Solldrehzahlnachführung" VALUE 0x819BA3 KwUb 2550. nmot_ub_q10 0.00 2550. FORMAT "%5.0" /end CHARACTERISTIC
/begin CHARACTERISTIC DRLKRSTMX "maximales drl im KR-stationär Betrieb" VALUE 0x815856 KwSw 767.9766 rel_sw_q0p0234 0.00 767.9766 FORMAT "%8.4" /end CHARACTERISTIC
/begin CHARACTERISTIC DTAHLL "Delta Ansauglufttemperatur für Abbruch erhöhte Solldrehzahl im Heiß-Leerlauf" VALUE 0x81125A KwUb 191.3 temp_ub_b191p25 0.00 191.3 FORMAT "%5.1" /end CHARACTERISTIC
/begin CHARACTERISTIC DTBTS "Temperaturhysterese für Bauteileschutz" VALUE 0x81D230 KwUw 1279.980 temp_uw_q0p0195 0.00 1279.980 FORMAT "%8.3" /end CHARACTERISTIC
/begin CHARACTERISTIC DTMHLL "Delta Motortemperatur für Abbruch erhöhte Solldrehzahl im Heiß-Leerlauf" VALUE 0x81125B KwUb 191.3 temp_ub_b191p25 0.00 191.3 FORMAT "%5.1" /end CHARACTERISTIC
/begin CHARACTERISTIC DVNG "LLR: D-Verstärkung abh. von ngfil bei stehendem Fahrzeug" CURVE 0x8112DB GklWUb 0.1245 rel_qn0p000488 -0.1245 0.00 FORMAT "%6.4"
 /begin AXIS_DESCR COM_AXIS ngfil nmotg_sb_q100 6 -12800. 12700. AXIS_PTS_REF SNG06LLSB /end AXIS_DESCR
/end CHARACTERISTIC
/begin CHARACTERISTIC DVNGV "LLR: D-Verstärkung abh. von ngfil bei roolendem Fahrzeug" CURVE 0x8112E1 GklWUb 0.1245 rel_qn0p000488 -0.1245 0.00 FORMAT "%6.4"
 /begin AXIS_DESCR COM_AXIS ngfil nmotg_sb_q100 6 -12800. 12700. AXIS_PTS_REF SNG06LLSB /end AXIS_DESCR
/end CHARACTERISTIC
/begin CHARACTERISTIC DWKRMSN "delta Winkel KR Abstand zur gemittelten Spätverstellung" CURVE 0x819832 GklWUb 191.3 zw_ub_qn0p75 -191.3 0.00 FORMAT "%5.1"
 /begin AXIS_DESCR COM_AXIS nmot nmot_ub_q40 16 0.00 10200. AXIS_PTS_REF SNM16KRUB /end AXIS_DESCR
/end CHARACTERISTIC
/begin CHARACTERISTIC ELDOB "Regelabweichungsschwelle für Start Zeitzähler LDR-Overboost activ" VALUE 0x8199B4 KwSb 1270. p_sb_q10 0.00 1270. FORMAT "%5.0" /end CHARACTERISTIC
/begin CHARACTERISTIC FBSTABGM "Faktor Bauteileschutz abhängig von model. Abgastemperatur" CURVE 0x81D232 KlAUwSstUwWUw 1.999969 fak_uw_b2 0.00 1.999969 FORMAT "%8.6"
 /begin AXIS_DESCR STD_AXIS tabgbts_w temp_uw_q0p0195_o50 4 -50.00000 1229.980 FORMAT "%8.3" DEPOSIT ABSOLUTE /end AXIS_DESCR
/end CHARACTERISTIC
/begin CHARACTERISTIC FBSTMOT "Offset Bauteileschutz abhängig von Motor-Temperatur" CURVE 0x81D244 KlAUbSstUbWSb 1.992 fak_sb_b1 -1.000 0.9922 FORMAT "%5.3"
 /begin AXIS_DESCR STD_AXIS tmot temp_ub_q0p75_o48 4 -48.00 143.3 FORMAT "%5.1" DEPOSIT ABSOLUTE /end AXIS_DESCR
/end CHARACTERISTIC
/begin CHARACTERISTIC FBZFRAT "Bewertungsfaktor für Integrationsgeschwindigkeit KFFRAT als f(abo)" CURVE 0x818DE8 KlAUbSstUbWUb 0.9961 fak_ub_b1 0.00 0.9961
 /begin AXIS_DESCR STD_AXIS abo dez 5 0.00 255.0 FORMAT "%5.1" DEPOSIT ABSOLUTE /end AXIS_DESCR
/end CHARACTERISTIC
/begin CHARACTERISTIC FDDN "LLR: Gewichtungsfaktor für D-Verstärkung" CURVE 0x8112E7 GklWUb 0.9961 fak_ub_b1 0.00 0.9961
 /begin AXIS_DESCR COM_AXIS dns nmotd_sb_q10 6 -1280. 1270. AXIS_PTS_REF SNS06LLSB /end AXIS_DESCR
/end CHARACTERISTIC
/begin CHARACTERISTIC FDNIKOR "Faktor für Korrektur auif I-Anteil über dn" VALUE 0x8112ED KwUb 1.992 fak_ub_b2 0.00 1.992 FORMAT "%5.3" /end CHARACTERISTIC
/begin CHARACTERISTIC FKEFMC "Korrekturfaktor für Klopferkennungsschwelle bei Filtermittenfrequenzumschaltung" VALUE 0x8111B7 KwUb 2.000 fak_ub_b16 0.00 2.000 FORMAT "%5.3" /end CHARACTERISTIC
/begin CHARACTERISTIC FKELDY "Korrekturfaktor für Klopferkennungsschwelle bei Lastdynamik" VALUE 0x8111B8 KwUb 2.000 fak_ub_b16 0.00 2.000 FORMAT "%5.3" /end CHARACTERISTIC
/begin CHARACTERISTIC FKENDY "Korrekturfaktor für Klopferkennungsschwelle bei Drehzahldynamik" VALUE 0x8111B9 KwUb 2.000 fak_ub_b16 0.00 2.000 FORMAT "%5.3" /end CHARACTERISTIC
/begin CHARACTERISTIC FKLDOBG_0_A "Korrekturfaktor für Delta rl im Overboostbetrieb" CURVE 0x8199B5 FklWUb 0.9961 fak_ub_b1 0.00 0.9961
 /begin AXIS_DESCR FIX_AXIS gangi dez 8 0.00 7.000 FORMAT "%5.3" FIX_AXIS_PAR 0 0 8 /end AXIS_DESCR
/end CHARACTERISTIC
/begin CHARACTERISTIC FKLDOBG_1_A "Korrekturfaktor für Delta rl im Overboostbetrieb" CURVE 0x8199BD FklWUb 0.9961 fak_ub_b1 0.00 0.9961
 /begin AXIS_DESCR FIX_AXIS gangi dez 8 0.00 7.000 FORMAT "%5.3" FIX_AXIS_PAR 0 0 8 /end AXIS_DESCR
/end CHARACTERISTIC
/begin CHARACTERISTIC FKLDOBG_2_A "Korrekturfaktor für Delta rl im Overboostbetrieb" CURVE 0x8199C5 FklWUb 0.9961 fak_ub_b1 0.00 0.9961
 /begin AXIS_DESCR FIX_AXIS gangi dez 8 0.00 7.000 FORMAT "%5.3" FIX_AXIS_PAR 0 0 8 /end AXIS_DESCR
/end CHARACTERISTIC
/begin CHARACTERISTIC FKLDOBG_3_A "Korrekturfaktor für Delta rl im Overboostbetrieb" CURVE 0x8199CD FklWUb 0.9961 fak_ub_b1 0.00 0.9961
 /begin AXIS_DESCR FIX_AXIS gangi dez 8 0.00 7.000 FORMAT "%5.3" FIX_AXIS_PAR 0 0 8 /end AXIS_DESCR
/end CHARACTERISTIC
/begin CHARACTERISTIC FKRFTPFMC "Korrekturfaktor des Tiefpaßverhaltens bei Umschaltung der Filtermittenfrequenz" VALUE 0x8111BA KwUb 0.5000 fak_ub_b2 0.5000 1.000 FORMAT "%5.3" /end CHARACTERISTIC
/begin CHARACTERISTIC FKRXTOL "Faktor zur Korrektur von rlmax bei hoher Motoröltemperatur" CURVE 0x81F0E4 KlAUbSstUbWUb 1.000 fak_ub_b2 0.00 1.000 FORMAT "%5.3"
 /begin AXIS_DESCR STD_AXIS toelldrlmx temp_ub_q1_o60 4 -60.00 195.0 FORMAT "%5.1" DEPOSIT ABSOLUTE /end AXIS_DESCR
/end CHARACTERISTIC
/begin CHARACTERISTIC FKVA "Konstanter Umrechnungsfaktor für Verbrauchsanzeige" VALUE 0x81A6BA KwUb 15.94 fak_ub_b16 0.00 15.94 FORMAT "%5.2" /end CHARACTERISTIC
/begin CHARACTERISTIC FNSNF "Faktor für Solldrehzahlnachführung" VALUE 0x819BA4 KwUb 0.9961 fak_ub_b1 0.00 0.9961 /end CHARACTERISTIC
/begin CHARACTERISTIC FNSSTKM "Faktor zur Wichtung der Solldrehzahl im Start bei Kat-Heizen" CURVE 0x819BA5 KlAUbSstUbWUb 1.992 fak_ub_b2 0.00 1.992 FORMAT "%5.3"
 /begin AXIS_DESCR STD_AXIS tmot temp_ub_q0p75_o48 6 -48.00 143.3 FORMAT "%5.1" DEPOSIT ABSOLUTE /end AXIS_DESCR
/end CHARACTERISTIC
/begin CHARACTERISTIC FNSSTM "Faktor zur Wichtung der Solldrehzahl im Start" CURVE 0x819BB2 KlAUbSstUbWUb 1.992 fak_ub_b2 0.00 1.992 FORMAT "%5.3"
 /begin AXIS_DESCR STD_AXIS tmot temp_ub_q0p75_o48 6 -48.00 143.3 FORMAT "%5.1" DEPOSIT ABSOLUTE /end AXIS_DESCR
/end CHARACTERISTIC
/begin CHARACTERISTIC FRAOMN "untere Begrenzung des Korrekturfaktors frao" VALUE 0x818DF3 KwUb 1.992 fak_ub_b2 0.00 1.992 FORMAT "%5.3" /end CHARACTERISTIC
/begin CHARACTERISTIC FRAOMX "obere Begrenzung des Korrekturfaktors frao" VALUE 0x818DF4 KwUb 1.992 fak_ub_b2 0.00 1.992 FORMAT "%5.3" /end CHARACTERISTIC
/begin CHARACTERISTIC FRAORN "untere reduzierte Schwelle des Korrekturfaktors frao" VALUE 0x818DF5 KwUb 1.992 fak_ub_b2 0.00 1.992 FORMAT "%5.3" /end CHARACTERISTIC
/begin CHARACTERISTIC FRAORX "obere reduzierte Schwelle des Korrekturfaktors frao" VALUE 0x818DF6 KwUb 1.992 fak_ub_b2 0.00 1.992 FORMAT "%5.3" /end CHARACTERISTIC
/begin CHARACTERISTIC FRATMN "untere Begrenzung des Korrekturfaktors frat" VALUE 0x818DF7 KwUb 1.992 fak_ub_b2 0.00 1.992 FORMAT "%5.3" /end CHARACTERISTIC
/begin CHARACTERISTIC FRATMX "obere Begrenzung des Korrekturfaktors frat" VALUE 0x818DF8 KwUb 1.992 fak_ub_b2 0.00 1.992 FORMAT "%5.3" /end CHARACTERISTIC
/begin CHARACTERISTIC FRAUMN "untere Begrenzung des Korrekturfaktors frau" VALUE 0x818DF9 KwUb 1.992 fak_ub_b2 0.00 1.992 FORMAT "%5.3" /end CHARACTERISTIC
/begin CHARACTERISTIC FRAUMX "obere Begrenzung des Korrekturfaktors frau" VALUE 0x818DFA KwUb 1.992 fak_ub_b2 0.00 1.992 FORMAT "%5.3" /end CHARACTERISTIC
/begin CHARACTERISTIC FRAURN "untere reduzierte Schwelle des Korrekturfaktors frau" VALUE 0x818DFB KwUb 1.992 fak_ub_b2 0.00 1.992 FORMAT "%5.3" /end CHARACTERISTIC
/begin CHARACTERISTIC FRAURX "obere reduzierte Schwelle des Korrekturfaktors frau" VALUE 0x818DFC KwUb 1.992 fak_ub_b2 0.00 1.992 FORMAT "%5.3" /end CHARACTERISTIC
/begin CHARACTERISTIC FTLDIA "Faktor für Entprellzeit Adaptionsfreigabe" VALUE 0x819956 KwUb 1.992 fak_ub_b2 0.00 1.992 FORMAT "%5.3" /end CHARACTERISTIC
/begin CHARACTERISTIC FTLDIAP "Faktor für Entprellzeit schnelle positive Nachführung" VALUE 0x819957 KwUb 1.992 fak_ub_b2 0.00 1.992 FORMAT "%5.3" /end CHARACTERISTIC
/begin CHARACTERISTIC GANGFAW "Gangschwelle für Deaktivierung Fahrerwunsch in der Höhe" VALUE 0x819006 KwUb 255.0 dez 0.00 255.0 FORMAT "%5.1" /end CHARACTERISTIC
/begin CHARACTERISTIC GANGIO "Istgangschwelle für Aktivierung von KFTARXB" VALUE 0x819A1F KwUb 255.0 dez 0.00 255.0 FORMAT "%5.1" /end CHARACTERISTIC
/begin CHARACTERISTIC GFDLDN "LLR: Gewichtungsfaktor für D-Verstärkung auf Luftpfad" CURVE 0x8112EE GklWUb 0.9961 rel_ub_b1p0 0.00 0.9961
 /begin AXIS_DESCR COM_AXIS dns nmotd_sb_q10 6 -1280. 1270. AXIS_PTS_REF SNS06LLSB /end AXIS_DESCR
/end CHARACTERISTIC
/begin CHARACTERISTIC GWPLDOB "Gradient Pedalwinkel zum Ausloesen des Overboost" VALUE 0x8199D5 KwUb 2000. rel_ub_q8 0.00 2000. FORMAT "%5.0" /end CHARACTERISTIC
/begin CHARACTERISTIC GWPLDU "Gradientenschwelle pedal für dynamische Freigabe Umluftventilsteuerung" VALUE 0x811243 KwSb 99.60 rel_sb_q0p39 -50.00 49.61 FORMAT "%5.2" /end CHARACTERISTIC
/begin CHARACTERISTIC GWPLDUR "Gradient Pedalwert für Reset LDR Umluftventilansteuerung dynamisch" VALUE 0x811244 KwSb 99.60 rel_sb_q0p39 -50.00 49.61 FORMAT "%5.2" /end CHARACTERISTIC
/begin CHARACTERISTIC HSLDSUA "Hysterese für stationäre Schubumluftventilansteuerung" VALUE 0x81EBEC KwUw 2559.961 p_uw_q0p039 0.00 2559.961 FORMAT "%8.3" /end CHARACTERISTIC
/begin CHARACTERISTIC HSSLDSUA "Hysterese zum Schließen der Turbo Umluftventile im Stationärpfad" VALUE 0x819953 KwUb 3.984 fak_ub_b4 0.00 3.984 FORMAT "%5.3" /end CHARACTERISTIC
/begin CHARACTERISTIC IMLLASKH "imlpr-Schwelle für Übergang auf Lambda-Abgas-Vorgabe" VALUE 0x819615 KwUb 0.9961 fak_ub_b1 0.00 0.9961 /end CHARACTERISTIC
/begin CHARACTERISTIC IVDNDTEH "I-Reglerparameter bei aktiver DTEV im Homogenbetrieb" CURVE 0x819C68 GklWUb 0.6076 rel_q0p002383 0.00 0.6076
 /begin AXIS_DESCR COM_AXIS dn_w nmot_sw_q0p25 10 -8192.000 8191.750 AXIS_PTS_REF SDN10LLSW /end AXIS_DESCR
/end CHARACTERISTIC
/begin CHARACTERISTIC IVDNHOM "I-Reglerparameter bei Homogenbetrieb" CURVE 0x819C72 GklWUb 0.6076 rel_q0p002383 0.00 0.6076
 /begin AXIS_DESCR COM_AXIS dn_w nmot_sw_q0p25 10 -8192.000 8191.750 AXIS_PTS_REF SDN10LLSW /end AXIS_DESCR
/end CHARACTERISTIC
/begin CHARACTERISTIC IVDNHOMV "I-Reglerparameter bei Homogenbetrieb und Kraftschluß" CURVE 0x819C7C GklWUb 0.6076 rel_q0p002383 0.00 0.6076
 /begin AXIS_DESCR COM_AXIS dn_w nmot_sw_q0p25 10 -8192.000 8191.750 AXIS_PTS_REF SDN10LLSW /end AXIS_DESCR
/end CHARACTERISTIC
/begin CHARACTERISTIC KD "BA Normierungsfaktor (DRIVE)" VALUE 0x81A6BB KwUb 255.0 dez 0.00 255.0 FORMAT "%5.1" /end CHARACTERISTIC
/begin CHARACTERISTIC KFDLBTS "Delta Lambdasoll für Bauteileschutz" MAP 0x81D24E KfAxUbAyUbSstxUbSstyUbWSb 1.000 fak_sb_b1 -1.000 0.00 FORMAT "%5.3"
 /begin AXIS_DESCR STD_AXIS detazwbs rel_ub_b127p5 8 0.00 127.5 FORMAT "%5.1" DEPOSIT ABSOLUTE /end AXIS_DESCR
 /begin AXIS_DESCR STD_AXIS nmot nmot_ub_q40 4 0.00 10200. FORMAT "%5.0" DEPOSIT ABSOLUTE /end AXIS_DESCR
/end CHARACTERISTIC
/begin CHARACTERISTIC KFFDLBTS "Faktor Delta Lambdasoll für Bauteileschutz" MAP 0x81926F GkfWUb 1.992 fak_ub_b2 0.00 1.992 FORMAT "%5.3"
 /begin AXIS_DESCR COM_AXIS rl_w rel_uw_q0p0234 12 0.00 1535.977 AXIS_PTS_REF SRL12GKUW /end AXIS_DESCR
 /begin AXIS_DESCR COM_AXIS nmot nmot_ub_q40 16 0.00 10200. AXIS_PTS_REF SNM16GKUB /end AXIS_DESCR
/end CHARACTERISTIC
/begin CHARACTERISTIC KFFKRXTM "Faktor zur Korrektur von rlmax bei hoher Motortemperatur" MAP 0x81F0ED KfAxUbAyUbSstxUbSstyUbWUb 1.000 fak_ub_b2 0.00 1.000 FORMAT "%5.3"
 /begin AXIS_DESCR STD_AXIS tmotldrlmx temp_ub_q0p75_o48 4 -48.00 143.3 FORMAT "%5.1" DEPOSIT ABSOLUTE /end AXIS_DESCR
 /begin AXIS_DESCR STD_AXIS vfzg vfzg_ub_q1p25 4 0.00 318.8 FORMAT "%5.1" DEPOSIT ABSOLUTE /end AXIS_DESCR
/end CHARACTERISTIC
/begin CHARACTERISTIC KFFLDEO "Faktor für Ladedruckeingriff auf Overboostwert durch KR" MAP 0x81F108 GkfWUw 0.9999847 fak_uw_b1 0.00 0.9999847 FORMAT "%9.7"
 /begin AXIS_DESCR COM_AXIS nmot_w nmot_uw_q0p25 8 0.00 16383.75 AXIS_PTS_REF SNM08LDUW /end AXIS_DESCR
 /begin AXIS_DESCR COM_AXIS wkrmsu_w zw_q0p1875 8 0.00 12287.81 AXIS_PTS_REF SWK208LDUW /end AXIS_DESCR
/end CHARACTERISTIC
/begin CHARACTERISTIC KFFLLDE "Faktor für langsamen Ladedruckeingriff auf rlmax durch KR" MAP 0x81F188 GkfWUw 1.000000 fak_uw_b2 0.00 1.000000 FORMAT "%8.6"
 /begin AXIS_DESCR COM_AXIS nmot_w nmot_uw_q0p25 8 0.00 16383.75 AXIS_PTS_REF SNM08LDUW /end AXIS_DESCR
 /begin AXIS_DESCR COM_AXIS wkrmstat_w zw_q0p1875 8 0.00 12287.81 AXIS_PTS_REF SWK08LDUW /end AXIS_DESCR
/end CHARACTERISTIC
/begin CHARACTERISTIC KFFSLDE "Faktor für schnellen LDR-Eingriff(Absenkung)" MAP 0x81F208 GkfWUw 1.000000 fak_uw_b2 0.00 1.000000 FORMAT "%8.6"
 /begin AXIS_DESCR COM_AXIS nmot_w nmot_uw_q0p25 8 0.00 16383.75 AXIS_PTS_REF SNM08LDUW /end AXIS_DESCR
 /begin AXIS_DESCR COM_AXIS wkrmdy_w zw_q0p1875 8 0.00 12287.81 AXIS_PTS_REF SWK108LDUW /end AXIS_DESCR
/end CHARACTERISTIC
/begin CHARACTERISTIC KFFWLLDE "Wichtungsfaktor für langsamen Ladedruckeingriff auf rlmax durch KR" MAP 0x81F288 GkfWUw 1.000000 fak_uw_b2 0.00 1.000000 FORMAT "%8.6"
 /begin AXIS_DESCR COM_AXIS tans temp_ub_q0p75_o48 8 -48.00 143.3 AXIS_PTS_REF STA08LDUB /end AXIS_DESCR
 /begin AXIS_DESCR COM_AXIS wkrmstat_w zw_q0p1875 8 0.00 12287.81 AXIS_PTS_REF SWK08LDUW /end AXIS_DESCR
/end CHARACTERISTIC
/begin CHARACTERISTIC KFKEF1 "Klopferkennungsfaktorkennfeld Zündung 1" MAP 0x81968E GkfWUb 15.94 fak_ub_b16 0.00 15.94 FORMAT "%5.2"
 /begin AXIS_DESCR COM_AXIS nmot nmot_ub_q40 16 0.00 10200. AXIS_PTS_REF SNM16KRUB /end AXIS_DESCR
 /begin AXIS_DESCR COM_AXIS rl rel_ub_q0p75 3 0.00 191.3 AXIS_PTS_REF SRL03KRUB /end AXIS_DESCR
/end CHARACTERISTIC
/begin CHARACTERISTIC KFKEF2 "Klopferkennungsfaktorkennfeld Zündung 2" MAP 0x8196BE GkfWUb 15.94 fak_ub_b16 0.00 15.94 FORMAT "%5.2"
 /begin AXIS_DESCR COM_AXIS nmot nmot_ub_q40 16 0.00 10200. AXIS_PTS_REF SNM16KRUB /end AXIS_DESCR
 /begin AXIS_DESCR COM_AXIS rl rel_ub_q0p75 3 0.00 191.3 AXIS_PTS_REF SRL03KRUB /end AXIS_DESCR
/end CHARACTERISTIC
/begin CHARACTERISTIC KFKEF3 "Klopferkennungsfaktorkennfeld Zündung 3" MAP 0x8196EE GkfWUb 15.94 fak_ub_b16 0.00 15.94 FORMAT "%5.2"
 /begin AXIS_DESCR COM_AXIS nmot nmot_ub_q40 16 0.00 10200. AXIS_PTS_REF SNM16KRUB /end AXIS_DESCR
 /begin AXIS_DESCR COM_AXIS rl rel_ub_q0p75 3 0.00 191.3 AXIS_PTS_REF SRL03KRUB /end AXIS_DESCR
/end CHARACTERISTIC
/begin CHARACTERISTIC KFKEF4 "Klopferkennungsfaktorkennfeld Zündung 4" MAP 0x81971E GkfWUb 15.94 fak_ub_b16 0.00 15.94 FORMAT "%5.2"
 /begin AXIS_DESCR COM_AXIS nmot nmot_ub_q40 16 0.00 10200. AXIS_PTS_REF SNM16KRUB /end AXIS_DESCR
 /begin AXIS_DESCR COM_AXIS rl rel_ub_q0p75 3 0.00 191.3 AXIS_PTS_REF SRL03KRUB /end AXIS_DESCR
/end CHARACTERISTIC
/begin CHARACTERISTIC KFKEF5 "Klopferkennungsfaktorkennfeld Zündung 5" MAP 0x81974E GkfWUb 15.94 fak_ub_b16 0.00 15.94 FORMAT "%5.2"
 /begin AXIS_DESCR COM_AXIS nmot nmot_ub_q40 16 0.00 10200. AXIS_PTS_REF SNM16KRUB /end AXIS_DESCR
 /begin AXIS_DESCR COM_AXIS rl rel_ub_q0p75 3 0.00 191.3 AXIS_PTS_REF SRL03KRUB /end AXIS_DESCR
/end CHARACTERISTIC
/begin CHARACTERISTIC KFKEF6 "Klopferkennungsfaktorkennfeld Zündung 6" MAP 0x81977E GkfWUb 15.94 fak_ub_b16 0.00 15.94 FORMAT "%5.2"
 /begin AXIS_DESCR COM_AXIS nmot nmot_ub_q40 16 0.00 10200. AXIS_PTS_REF SNM16KRUB /end AXIS_DESCR
 /begin AXIS_DESCR COM_AXIS rl rel_ub_q0p75 3 0.00 191.3 AXIS_PTS_REF SRL03KRUB /end AXIS_DESCR
/end CHARACTERISTIC
/begin CHARACTERISTIC KFKEF7 "Klopferkennungsfaktorkennfeld Zündung 7" MAP 0x8197AE GkfWUb 15.94 fak_ub_b16 0.00 15.94 FORMAT "%5.2"
 /begin AXIS_DESCR COM_AXIS nmot nmot_ub_q40 16 0.00 10200. AXIS_PTS_REF SNM16KRUB /end AXIS_DESCR
 /begin AXIS_DESCR COM_AXIS rl rel_ub_q0p75 3 0.00 191.3 AXIS_PTS_REF SRL03KRUB /end AXIS_DESCR
/end CHARACTERISTIC
/begin CHARACTERISTIC KFKEF8 "Klopferkennungsfaktorkennfeld Zündung 8" MAP 0x8197DE GkfWUb 15.94 fak_ub_b16 0.00 15.94 FORMAT "%5.2"
 /begin AXIS_DESCR COM_AXIS nmot nmot_ub_q40 16 0.00 10200. AXIS_PTS_REF SNM16KRUB /end AXIS_DESCR
 /begin AXIS_DESCR COM_AXIS rl rel_ub_q0p75 3 0.00 191.3 AXIS_PTS_REF SRL03KRUB /end AXIS_DESCR
/end CHARACTERISTIC
/begin CHARACTERISTIC KFLAFWL "Offset Lambda-Motor-Soll" MAP 0x819007 GkfWSb 1.992 fak_sb_b1 -1.000 0.9922 FORMAT "%5.3"
 /begin AXIS_DESCR COM_AXIS tmot temp_ub_q0p75_o48 8 -48.00 143.3 AXIS_PTS_REF STM08GKUB /end AXIS_DESCR
 /begin AXIS_DESCR COM_AXIS rl rel_ub_q0p75 6 0.00 191.3 AXIS_PTS_REF SRL06GKUB /end AXIS_DESCR
/end CHARACTERISTIC
/begin CHARACTERISTIC KFLAMKR "Wichtungsfaktor für Anfettung bei Zündwinkelspätverstellung" MAP 0x819037 GkfWUb 1.992 fak_ub_b2 0.00 1.992 FORMAT "%5.3"
 /begin AXIS_DESCR COM_AXIS nmot nmot_ub_q40 6 0.00 10200. AXIS_PTS_REF SNM06GKUB /end AXIS_DESCR
 /begin AXIS_DESCR COM_AXIS rl rel_ub_q0p75 6 0.00 191.3 AXIS_PTS_REF SRL06GKUB /end AXIS_DESCR
/end CHARACTERISTIC
/begin CHARACTERISTIC KFLAMKRL "Anfettung bei Zündwinkelspätverstellung" MAP 0x81905B GkfWUb 1.992 fak_ub_b2 0.00 1.992 FORMAT "%5.3"
 /begin AXIS_DESCR COM_AXIS dzwlamfaw zw_ub_qn0p75 6 -191.3 0.00 AXIS_PTS_REF SDZ06GKUB /end AXIS_DESCR
 /begin AXIS_DESCR COM_AXIS rl rel_ub_q0p75 6 0.00 191.3 AXIS_PTS_REF SRL06GKUB /end AXIS_DESCR
/end CHARACTERISTIC
/begin CHARACTERISTIC KFLANSKH "Kennfeld Lambda-Motor-Vorgabe bei Katheizen im Nachstart" MAP 0x81DB80 KfAxUbAyUbSstxUbSstyUwWUw 15.89990 fak_q0p000244 0.09985352 15.99976 FORMAT "%8.5"
 /begin AXIS_DESCR STD_AXIS tmst temp_ub_q0p75_o48 6 -48.00 143.3 FORMAT "%5.1" DEPOSIT ABSOLUTE /end AXIS_DESCR
 /begin AXIS_DESCR STD_AXIS anztib_w dez 12 0.00 65535.00 FORMAT "%8.2" DEPOSIT ABSOLUTE /end AXIS_DESCR
/end CHARACTERISTIC
/begin CHARACTERISTIC KFLASKH "Kennfeld Lambda-Abgas-Soll bei Katheizen" MAP 0x81DC30 KfAxUwAyUwSstxUwSstyUwWUw 15.99976 fak_q0p000244 0.00 15.99976 FORMAT "%8.5"
 /begin AXIS_DESCR STD_AXIS nmot_w nmot_uw_q0p25 8 0.00 16383.75 FORMAT "%8.2" DEPOSIT ABSOLUTE /end AXIS_DESCR
 /begin AXIS_DESCR STD_AXIS rl_w rel_uw_q0p0234 8 0.00 1535.977 FORMAT "%8.3" DEPOSIT ABSOLUTE /end AXIS_DESCR
/end CHARACTERISTIC
/begin CHARACTERISTIC KFLBTS "Lambdasoll für Bauteileschutz" MAP 0x81932F GkfWUb 1.992 fak_ub_b2 0.00 1.992 FORMAT "%5.3"
 /begin AXIS_DESCR COM_AXIS rl_w rel_uw_q0p0234 12 0.00 1535.977 AXIS_PTS_REF SRL12GKUW /end AXIS_DESCR
 /begin AXIS_DESCR COM_AXIS nmot nmot_ub_q40 16 0.00 10200. AXIS_PTS_REF SNM16GKUB /end AXIS_DESCR
/end CHARACTERISTIC
/begin CHARACTERISTIC KFLDHBN "LDR-Höhenbegrenzung (max. Verdichterdruckverhältnis)" MAP 0x81F308 KfAxUbAyUbSstxUbSstyUbWUb 3.984 fak_ub_b4 0.00 3.984 FORMAT "%5.3"
 /begin AXIS_DESCR STD_AXIS nmot nmot_ub_q40 8 0.00 10200. FORMAT "%5.0" DEPOSIT ABSOLUTE /end AXIS_DESCR
 /begin AXIS_DESCR STD_AXIS tsel temp_ub_q0p75_o48 8 -48.00 143.3 FORMAT "%5.1" DEPOSIT ABSOLUTE /end AXIS_DESCR
/end CHARACTERISTIC
/begin CHARACTERISTIC KFLDIMX "Kennfeld LDR I-Reglerbegrenzung" MAP 0x81EC16 GkfWUw 327.6750 tv_uw_q0p005 0.00 327.6750 FORMAT "%8.4"
 /begin AXIS_DESCR COM_AXIS nmot_w nmot_uw_q0p25 16 0.00 16383.75 AXIS_PTS_REF SNM16LDUW /end AXIS_DESCR
 /begin AXIS_DESCR COM_AXIS plsolr_w p_uw_q0p039 8 0.00 2559.961 AXIS_PTS_REF SPL08LDUW /end AXIS_DESCR
/end CHARACTERISTIC
/begin CHARACTERISTIC KFLDIOPU "Korrektur der TV-Werte durch Höheneinfluß" MAP 0x819958 GkfWUb 163.2 tv_ub_q0p64 0.00 163.2 FORMAT "%5.1"
 /begin AXIS_DESCR COM_AXIS nmot nmot_ub_q40 8 0.00 10200. AXIS_PTS_REF SNM08LDUB /end AXIS_DESCR
 /begin AXIS_DESCR COM_AXIS pu p_ub_q5 8 0.00 1275. AXIS_PTS_REF SPU08LDUB /end AXIS_DESCR
/end CHARACTERISTIC
/begin CHARACTERISTIC KFLDIWL "Korrektur LDR I-Begrenzung im Warmlauf" MAP 0x81ED16 KfAxUbAyUbSstxUbSstyUbWSb 163.2 tv_ub_q0p64 -81.92 81.28 FORMAT "%5.2"
 /begin AXIS_DESCR STD_AXIS tmst temp_ub_q0p75_o48 8 -48.00 143.3 FORMAT "%5.1" DEPOSIT ABSOLUTE /end AXIS_DESCR
 /begin AXIS_DESCR STD_AXIS imlatm m_ub_b23p3 8 0.00 23.21 FORMAT "%5.2" DEPOSIT ABSOLUTE /end AXIS_DESCR
/end CHARACTERISTIC
/begin CHARACTERISTIC KFLDRAPP "Kennfeld für LDR-Applikation ohne Md-Koordination" MAP 0x819A46 KfAxUbAyUbSstxUbSstyUbWUb 99.61 tv_ub_b100 0.00 99.61 FORMAT "%5.2"
 /begin AXIS_DESCR STD_AXIS nmot nmot_ub_q40 8 0.00 10200. FORMAT "%5.0" DEPOSIT ABSOLUTE /end AXIS_DESCR
 /begin AXIS_DESCR STD_AXIS wped relPED_ub_b100 8 0.00 100.0 FORMAT "%5.1" DEPOSIT ABSOLUTE /end AXIS_DESCR
/end CHARACTERISTIC
/begin CHARACTERISTIC KFLDRL "KF zur Linearisierung Ladedruck=f(TV)" MAP 0x81ED68 GkfWSw 327.6750 tv_sw_q0p005 -163.8400 163.8350 FORMAT "%8.4"
 /begin AXIS_DESCR COM_AXIS nmot_w nmot_uw_q0p25 16 0.00 16383.75 AXIS_PTS_REF SNM16LDUW /end AXIS_DESCR
 /begin AXIS_DESCR COM_AXIS ldtvr_w tv_sw_q0p005 10 -163.8400 163.8350 AXIS_PTS_REF STV10LDSW /end AXIS_DESCR
/end CHARACTERISTIC
/begin CHARACTERISTIC KFLDRQ0 "LDR-Regelparameter Q0" MAP 0x81EEA8 GkfWUw 3276.750 rel_uw_b3276p75 0.00 3276.750 FORMAT "%8.3"
 /begin AXIS_DESCR COM_AXIS nmot nmot_ub_q40 16 0.00 10200. AXIS_PTS_REF SNM16LDUB /end AXIS_DESCR
 /begin AXIS_DESCR COM_AXIS lde p_sb_q10 4 0.00 2550. AXIS_PTS_REF SLD04LDUB /end AXIS_DESCR
/end CHARACTERISTIC
/begin CHARACTERISTIC KFLDRQ1 "LDR-Reglerparameter Q1 (Integratorbeiwert)" MAP 0x81EF28 GkfWUw 3276.750 rel_uw_b3276p75 0.00 3276.750 FORMAT "%8.3"
 /begin AXIS_DESCR COM_AXIS nmot nmot_ub_q40 16 0.00 10200. AXIS_PTS_REF SNM16LDUB /end AXIS_DESCR
 /begin AXIS_DESCR COM_AXIS lde p_sb_q10 4 0.00 2550. AXIS_PTS_REF SLD04LDUB /end AXIS_DESCR
/end CHARACTERISTIC
/begin CHARACTERISTIC KFLDRQ2 "Kennfeld LDR-Reglerparameter Q2" MAP 0x81EFA8 GkfWUw 3276.750 rel_uw_b3276p75 0.00 3276.750 FORMAT "%8.3"
 /begin AXIS_DESCR COM_AXIS nmot nmot_ub_q40 16 0.00 10200. AXIS_PTS_REF SNM16LDUB /end AXIS_DESCR
 /begin AXIS_DESCR COM_AXIS lde p_sb_q10 4 0.00 2550. AXIS_PTS_REF SLD04LDUB /end AXIS_DESCR
/end CHARACTERISTIC
/begin CHARACTERISTIC KFLDRXO "Delta Füllung (rl) im Overboostbetrieb" MAP 0x8199D6 KfAxUbAyUbSstxUbSstyUbWUb 24.75 rel_ub_q0p75 0.00 24.75 FORMAT "%5.2"
 /begin AXIS_DESCR STD_AXIS nmot nmot_ub_q40 8 0.00 10200. FORMAT "%5.0" DEPOSIT ABSOLUTE /end AXIS_DESCR
 /begin AXIS_DESCR STD_AXIS tans temp_ub_q0p75_o48 4 -48.00 143.3 FORMAT "%5.1" DEPOSIT ABSOLUTE /end AXIS_DESCR
/end CHARACTERISTIC
/begin CHARACTERISTIC KFLMSKH_0_A "Kennfeld Lambda-Motor-Soll bei Katheizen" MAP 0x81DCD4 KfAxUwAyUwSstxUwSstyUwWUw 15.99976 fak_q0p000244 0.00 15.99976 FORMAT "%8.5"
 /begin AXIS_DESCR STD_AXIS nmot nmot_ub_q40 8 0.00 2621400. FORMAT "%8.0" DEPOSIT ABSOLUTE /end AXIS_DESCR
 /begin AXIS_DESCR STD_AXIS rl rel_ub_q0p75 8 0.00 49151.25 FORMAT "%8.2" DEPOSIT ABSOLUTE /end AXIS_DESCR
/end CHARACTERISTIC
/begin CHARACTERISTIC KFLMSKH_1_A "Kennfeld Lambda-Motor-Soll bei Katheizen" MAP 0x81DD78 KfAxUwAyUwSstxUwSstyUwWUw 15.99976 fak_q0p000244 0.00 15.99976 FORMAT "%8.5"
 /begin AXIS_DESCR STD_AXIS nmot nmot_ub_q40 8 0.00 2621400. FORMAT "%8.0" DEPOSIT ABSOLUTE /end AXIS_DESCR
 /begin AXIS_DESCR STD_AXIS rl rel_ub_q0p75 8 0.00 49151.25 FORMAT "%8.2" DEPOSIT ABSOLUTE /end AXIS_DESCR
/end CHARACTERISTIC
/begin CHARACTERISTIC KFMRES "LLR: Basis Momentenreserve im LL und ll-nahem Bereich" MAP 0x81141E GkfWUb 24.90 rel_ub_b24p9 0.00 24.90 FORMAT "%5.2"
 /begin AXIS_DESCR COM_AXIS nmot_w nmot_uw_q0p25 6 0.00 16383.75 AXIS_PTS_REF SNM06LLUB /end AXIS_DESCR
 /begin AXIS_DESCR COM_AXIS mifa_w rel_uw_b100 4 0.00 99.99847 AXIS_PTS_REF SMI04LLUB /end AXIS_DESCR
/end CHARACTERISTIC
/begin CHARACTERISTIC KFMRESK "LLR: Basis Momentenreserve im LL und ll-nahem Bereich,ausgekuppelt" MAP 0x811436 GkfWUb 24.90 rel_ub_b24p9 0.00 24.90 FORMAT "%5.2"
 /begin AXIS_DESCR COM_AXIS nmot_w nmot_uw_q0p25 6 0.00 16383.75 AXIS_PTS_REF SNM06LLUB /end AXIS_DESCR
 /begin AXIS_DESCR COM_AXIS mifa_w rel_uw_b100 4 0.00 99.99847 AXIS_PTS_REF SMI04LLUB /end AXIS_DESCR
/end CHARACTERISTIC
/begin CHARACTERISTIC KFMRESKH "Momentenreserve bei Kat.heizen" MAP 0x81144E GkfWUb 24.90 rel_ub_b24p9 0.00 24.90 FORMAT "%5.2"
 /begin AXIS_DESCR COM_AXIS dns nmotd_sb_q10 6 -1280. 1270. AXIS_PTS_REF SNS06LLSB /end AXIS_DESCR
 /begin AXIS_DESCR COM_AXIS tmot temp_ub_q0p75_o48 4 -48.00 143.3 AXIS_PTS_REF STM04SAUB /end AXIS_DESCR
/end CHARACTERISTIC
/begin CHARACTERISTIC KFMRESNL "Momentenreserve im nicht Leerlauf" MAP 0x811466 GkfWUb 24.90 rel_ub_b24p9 0.00 24.90 FORMAT "%5.2"
 /begin AXIS_DESCR COM_AXIS nmot_w nmot_uw_q0p25 6 0.00 16383.75 AXIS_PTS_REF SNM06LLUB /end AXIS_DESCR
 /begin AXIS_DESCR COM_AXIS mifa_w rel_uw_b100 4 0.00 99.99847 AXIS_PTS_REF SMI04LLUB /end AXIS_DESCR
/end CHARACTERISTIC
/begin CHARACTERISTIC KFMRESTA "Momentreserve abhängig von tans" MAP 0x81147E GkfWUb 24.90 rel_ub_b24p9 0.00 24.90 FORMAT "%5.2"
 /begin AXIS_DESCR COM_AXIS tans temp_ub_q0p75_o48 4 -48.00000 49103.25 AXIS_PTS_REF STA04LLUB /end AXIS_DESCR
 /begin AXIS_DESCR COM_AXIS mifa_w rel_uw_b100 4 0.00 99.99847 AXIS_PTS_REF SMI04LLUB /end AXIS_DESCR
/end CHARACTERISTIC
/begin CHARACTERISTIC KFNLLNST "Drehzahlverlauf nach Start" MAP 0x819BBF GkfWUb 2550. nmot_ub_q10 0.00 2550. FORMAT "%5.0"
 /begin AXIS_DESCR COM_AXIS tnst t1sxs_ub_b255 6 0.00 255.0 AXIS_PTS_REF STN06LLUB /end AXIS_DESCR
 /begin AXIS_DESCR COM_AXIS tmot temp_ub_q0p75_o48 6 -48.00 143.3 AXIS_PTS_REF STM06LLUB /end AXIS_DESCR
/end CHARACTERISTIC
/begin CHARACTERISTIC KFRAT "Füllungabhängige Integrationsteigung für FRAT" CURVE 0x81D058 KlAUbSstUbWUw 0.1999664 fak_uw_b5 0.00 0.1999664 FORMAT "%9.7"
 /begin AXIS_DESCR STD_AXIS dlrfrat fak_q0p0625 5 0.00 15.94 FORMAT "%5.2" DEPOSIT ABSOLUTE /end AXIS_DESCR
/end CHARACTERISTIC
/begin CHARACTERISTIC KFRBGOF "Offset für I-Anteilbegrenzung LDRPID" MAP 0x81F028 KfAxUbAyUbSstxSwSstyUbWSw 327.6750 tv_sw_q0p005 -163.8400 163.8350 FORMAT "%8.4"
 /begin AXIS_DESCR STD_AXIS ngfil nmotg_sb_q100 4 -12800.00 12700.00 FORMAT "%8.2" DEPOSIT ABSOLUTE /end AXIS_DESCR
 /begin AXIS_DESCR STD_AXIS nmot nmot_ub_q40 6 0.00 10200. FORMAT "%5.0" DEPOSIT ABSOLUTE /end AXIS_DESCR
/end CHARACTERISTIC
/begin CHARACTERISTIC KFSDLDSUA "Schwelle für dynamische Schubumluftventilsteuerung aktiv" MAP 0x815C12 KfAxUbAyUbSstxUwSstyUwWUw 2559.961 p_uw_q0p039 0.00 2559.961 FORMAT "%8.3"
 /begin AXIS_DESCR STD_AXIS nmot nmot_ub_q40 6 0.00 10200.00 FORMAT "%8.2" DEPOSIT ABSOLUTE /end AXIS_DESCR
 /begin AXIS_DESCR STD_AXIS plmaxa_w p_uw_q0p039 16 0.00 2559.961 FORMAT "%8.3" DEPOSIT ABSOLUTE /end AXIS_DESCR
/end CHARACTERISTIC
/begin CHARACTERISTIC KFTARX "Kennfeld Maximalfuellung Tans Korrekturfaktor" MAP 0x81F35A GkfWUw 1.999969 fak_uw_b2 0.00 1.999969 FORMAT "%8.6"
 /begin AXIS_DESCR COM_AXIS nmot_w nmot_uw_q0p25 12 0.00 16383.75 AXIS_PTS_REF SNM12LDUW /end AXIS_DESCR
 /begin AXIS_DESCR COM_AXIS tans temp_ub_q0p75_o48 10 -48.00 143.3 AXIS_PTS_REF STA10LDUB /end AXIS_DESCR
/end CHARACTERISTIC
/begin CHARACTERISTIC KFTARXB "Basiswerte Kennfeld Maximalfuellung Tans Korrekturfaktor" MAP 0x81F44A GkfWUw 1.999969 fak_uw_b2 0.00 1.999969 FORMAT "%8.6"
 /begin AXIS_DESCR COM_AXIS nmot_w nmot_uw_q0p25 12 0.00 16383.75 AXIS_PTS_REF SNM12LDUW /end AXIS_DESCR
 /begin AXIS_DESCR COM_AXIS tans temp_ub_q0p75_o48 10 -48.00 143.3 AXIS_PTS_REF STA10LDUB /end AXIS_DESCR
/end CHARACTERISTIC
/begin CHARACTERISTIC KFTARXZK "Kennfeld Maximalfuellung Tans Korrekturfaktor bei Dauerklopfen" MAP 0x81F53A GkfWUw 1.999969 fak_uw_b2 0.00 1.999969 FORMAT "%8.6"
 /begin AXIS_DESCR COM_AXIS nmot_w nmot_uw_q0p25 12 0.00 16383.75 AXIS_PTS_REF SNM12LDUW /end AXIS_DESCR
 /begin AXIS_DESCR COM_AXIS tans temp_ub_q0p75_o48 10 -48.00 143.3 AXIS_PTS_REF STA10LDUB /end AXIS_DESCR
/end CHARACTERISTIC
/begin CHARACTERISTIC KFTVLBTS "Verzögerungszeit Lambdasoll Bauteileschutz f(nmot,rl)" MAP 0x81D27C KfAxUbAyUbSstxUbSstyUwWUb 25.50 t100msxs_ub_b25p5 0.00 25.50 FORMAT "%5.2"
 /begin AXIS_DESCR STD_AXIS nmot nmot_ub_q40 12 0.00 10200. FORMAT "%5.0" DEPOSIT ABSOLUTE /end AXIS_DESCR
 /begin AXIS_DESCR STD_AXIS rl_w rel_uw_q0p0234 8 0.00 1535.977 FORMAT "%8.3" DEPOSIT ABSOLUTE /end AXIS_DESCR
/end CHARACTERISTIC
/begin CHARACTERISTIC KFTVLDRE "Kennfeld tastverhältnisersatzwert für LDR" MAP 0x819A98 KfAxUbAyUbSstxUbSstyUbWUb 99.61 tv_ub_b100 0.00 99.61 FORMAT "%5.2"
 /begin AXIS_DESCR STD_AXIS nmot nmot_ub_q40 8 0.00 10200. FORMAT "%5.0" DEPOSIT ABSOLUTE /end AXIS_DESCR
 /begin AXIS_DESCR STD_AXIS plsol p_ub_q10 4 0.00 2550. FORMAT "%5.0" DEPOSIT ABSOLUTE /end AXIS_DESCR
/end CHARACTERISTIC
/begin CHARACTERISTIC KFVPDKSD "Solldruckverhältnis DK im Dynamikbetrieb" MAP 0x815D10 GkfWUw 1.999969 fak_uw_b2 0.00 1.999969 FORMAT "%8.6"
 /begin AXIS_DESCR COM_AXIS nmot_w nmot_uw_q0p25 12 0.00 16383.75 AXIS_PTS_REF SNM12LDUW /end AXIS_DESCR
 /begin AXIS_DESCR COM_AXIS vpssplg_w fak_uw_b4 12 0.00 3.999939 AXIS_PTS_REF SVP12LDUW /end AXIS_DESCR
/end CHARACTERISTIC
/begin CHARACTERISTIC KFVPDKSE "Solldruckverhältnis DK im Stationärbetrieb" MAP 0x815E30 GkfWUw 1.999969 fak_uw_b2 0.00 1.999969 FORMAT "%8.6"
 /begin AXIS_DESCR COM_AXIS nmot_w nmot_uw_q0p25 12 0.00 16383.75 AXIS_PTS_REF SNM12LDUW /end AXIS_DESCR
 /begin AXIS_DESCR COM_AXIS vpssplg_w fak_uw_b4 12 0.00 3.999939 AXIS_PTS_REF SVP12LDUW /end AXIS_DESCR
/end CHARACTERISTIC
/begin CHARACTERISTIC KFZNSM "Zeitkonstante für Solldrehzahlabregelung" MAP 0x81125C GkfWUb 5.08000 zk20msxs_ub_b5p1 0.0200000 5.10000 FORMAT "%7.5"
 /begin AXIS_DESCR COM_AXIS tmot temp_ub_q0p75_o48 6 -48.00 143.3 AXIS_PTS_REF STM06LLUB /end AXIS_DESCR
 /begin AXIS_DESCR COM_AXIS dns nmotd_sb_q10 6 -1280. 1270. AXIS_PTS_REF SNS06LLSB /end AXIS_DESCR
/end CHARACTERISTIC
/begin CHARACTERISTIC KLDFOFF "Generatorlastausschaltenschwelle" VALUE 0x819BE3 KwUb 99.61 rel_ub_b99p6 0.00 99.61 FORMAT "%5.2" /end CHARACTERISTIC
/begin CHARACTERISTIC KLDFON "Generatorlasteinschaltenschwelle" VALUE 0x819BE4 KwUb 99.61 rel_ub_b99p6 0.00 99.61 FORMAT "%5.2" /end CHARACTERISTIC
/begin CHARACTERISTIC KLLAKHFH "Umgebungsdruckkorrektur Lambda Katheizen" CURVE 0x81DE1C KlAUwSstUwWUw 1.999969 fak_uw_b2 0.00 1.999969 FORMAT "%8.6"
 /begin AXIS_DESCR STD_AXIS fho_w fak_uw_b4 4 0.00 3.999939 FORMAT "%8.6" DEPOSIT ABSOLUTE /end AXIS_DESCR
/end CHARACTERISTIC
/begin CHARACTERISTIC KNSNF "Sperrband für Solldrehzahlnachführung" VALUE 0x819BE5 KwUb 2550. nmot_ub_q10 0.00 2550. FORMAT "%5.0" /end CHARACTERISTIC
/begin CHARACTERISTIC KRAL1N "Klopfregeladaption Lastbereich 1" CURVE 0x819842 GklWUb 191.3 rel_ub_q0p75 0.00 191.3 FORMAT "%5.1"
 /begin AXIS_DESCR COM_AXIS nmot nmot_ub_q40 16 0.00 10200. AXIS_PTS_REF SNM16KRUB /end AXIS_DESCR
/end CHARACTERISTIC
/begin CHARACTERISTIC KRAL2N "Klopfregeladaption Lastbereich 2" CURVE 0x819852 GklWUb 191.3 rel_ub_q0p75 0.00 191.3 FORMAT "%5.1"
 /begin AXIS_DESCR COM_AXIS nmot nmot_ub_q40 16 0.00 10200. AXIS_PTS_REF SNM16KRUB /end AXIS_DESCR
/end CHARACTERISTIC
/begin CHARACTERISTIC KRAL3N "Klopfregeladaption Lastbereich 3" CURVE 0x819862 GklWUb 191.3 rel_ub_q0p75 0.00 191.3 FORMAT "%5.1"
 /begin AXIS_DESCR COM_AXIS nmot nmot_ub_q40 16 0.00 10200. AXIS_PTS_REF SNM16KRUB /end AXIS_DESCR
/end CHARACTERISTIC
/begin CHARACTERISTIC KRALH "Klopfregeladaption Lasthysterese" VALUE 0x819872 KwUb 191.3 rel_ub_q0p75 0.00 191.3 FORMAT "%5.1" /end CHARACTERISTIC
/begin CHARACTERISTIC KRAN1 "Klopfregeladaption Drehzahlbereich, Stützstelle 1" VALUE 0x819873 KwUb 10200. nmot_ub_q40 0.00 10200. FORMAT "%5.0" /end CHARACTERISTIC
/begin CHARACTERISTIC KRAN2 "Klopfregeladaption Drehzahlbereich, Stützstelle 2" VALUE 0x819874 KwUb 10200. nmot_ub_q40 0.00 10200. FORMAT "%5.0" /end CHARACTERISTIC
/begin CHARACTERISTIC KRAN3 "Klopfregeladaption Drehzahlbereich, Stützstelle 3" VALUE 0x819875 KwUb 10200. nmot_ub_q40 0.00 10200. FORMAT "%5.0" /end CHARACTERISTIC
/begin CHARACTERISTIC KRAN4 "Klopfregeladaption Drehzahlbereich, Stützstelle 4" VALUE 0x819876 KwUb 10200. nmot_ub_q40 0.00 10200. FORMAT "%5.0" /end CHARACTERISTIC
/begin CHARACTERISTIC KRANH "Klopfregeladaption Drehzahlhysterese" VALUE 0x819877 KwUb 10200. nmot_ub_q40 0.00 10200. FORMAT "%5.0" /end CHARACTERISTIC
/begin CHARACTERISTIC KRDWA "Klopfregelung Differenz aktueller ZW zu Adaptionskennfeld" VALUE 0x8111C9 KwUb 191.3 zw_ub_q0p75 0.00 191.3 FORMAT "%5.1" /end CHARACTERISTIC
/begin CHARACTERISTIC KRDWAA "zulässiger ZW-Sprung nach früh bei Auslesen Adaptionswerte" VALUE 0x8111CA KwUb 191.3 zw_ub_qn0p75 -191.3 0.00 FORMAT "%5.1" /end CHARACTERISTIC
/begin CHARACTERISTIC KRDWKLA "Der SV-Lernbetrag für die KR-Adaption nach einem erkannten Klopfereignis" VALUE 0x8111CB KwUb 6.000 zw_ub_qn0p75 -6.000 0.00 FORMAT "%5.3" /end CHARACTERISTIC
/begin CHARACTERISTIC KRDWSA "Der FV-Lernbetrag für die KR-Adaption wenn wkra-wkr > KRDWA" VALUE 0x8111CC KwUb 6.000 zw_ub_q0p75 0.00 6.000 FORMAT "%5.3" /end CHARACTERISTIC
/begin CHARACTERISTIC KRDWSN "Klopfregelung delta - Winkel Sicherheit" CURVE 0x819878 GklWUb 191.3 zw_ub_qn0p75 -191.3 0.00 FORMAT "%5.1"
 /begin AXIS_DESCR COM_AXIS nmot nmot_ub_q40 16 0.00 10200. AXIS_PTS_REF SNM16KRUB /end AXIS_DESCR
/end CHARACTERISTIC
/begin CHARACTERISTIC KRFKLN "Spätverstellung pro Klopfereignis bei langsamer Frühverstellung" CURVE 0x819888 GklWUb 191.3 zw_ub_qn0p75 -191.3 0.00 FORMAT "%5.1"
 /begin AXIS_DESCR COM_AXIS nmot nmot_ub_q40 16 0.00 10200. AXIS_PTS_REF SNM16KRUB /end AXIS_DESCR
/end CHARACTERISTIC
/begin CHARACTERISTIC KRFKN "Spätverstellung pro Klopfereignis" CURVE 0x819898 GklWUb 191.3 zw_ub_qn0p75 -191.3 0.00 FORMAT "%5.1"
 /begin AXIS_DESCR COM_AXIS nmot nmot_ub_q40 16 0.00 10200. AXIS_PTS_REF SNM16KRUB /end AXIS_DESCR
/end CHARACTERISTIC
/begin CHARACTERISTIC KRFTP1 "Tiefpassverhalten normal" VALUE 0x8111BB KwUb 24.00 dez 8.000 32.00 FORMAT "%5.2" /end CHARACTERISTIC
/begin CHARACTERISTIC KRFTP2 "Tiefpassverhalten bei Drehzahldynamik" VALUE 0x8111BC KwUb 14.00 dez 2.000 16.00 FORMAT "%5.2" /end CHARACTERISTIC
/begin CHARACTERISTIC KRFTP3 "Tiefpassverhalten bei Lastdynamik" VALUE 0x8111BD KwUb 14.00 dez 2.000 16.00 FORMAT "%5.2" /end CHARACTERISTIC
/begin CHARACTERISTIC KRKFKS "Zuordnung der Kloperkennungskennlinie bei fehlender Zyl.-1-Erkennung" VALUE 0x8111BE KwUb 255.0 dez 0.00 255.0 FORMAT "%5.1" /end CHARACTERISTIC
/begin CHARACTERISTIC KRLVFN "Anz. Zünd./Zyl., Zeitangabe von Frühverst. zu Frühverst. (langsame Frühverst.)" CURVE 0x8198A8 GklWUb 254.0 dez 1.000 255.0 FORMAT "%5.1"
 /begin AXIS_DESCR COM_AXIS nmot nmot_ub_q40 16 0.00 10200. AXIS_PTS_REF SNM16KRUB /end AXIS_DESCR
/end CHARACTERISTIC
/begin CHARACTERISTIC KRMXN "maximale Spätverstellung" CURVE 0x8198B8 GklWUb 190.5 zw_ub_qn0p75 -191.3 -0.7500 FORMAT "%5.1"
 /begin AXIS_DESCR COM_AXIS nmot nmot_ub_q40 16 0.00 10200. AXIS_PTS_REF SNM16KRUB /end AXIS_DESCR
/end CHARACTERISTIC
/begin CHARACTERISTIC KRNLZ "Drehzahlschwelle, oberhalb der Führung durch Leitzylinder aktiv ist" VAL_BLK 0x8198C8 KwbUb 10200. nmot_ub_q40 0.00 10200. FORMAT "%5.0" NUMBER 8 /end CHARACTERISTIC
/begin CHARACTERISTIC KRVFN "Anz. Zünd./Zyl., bzw. Zeitangabe von Frühverst. zu Frühverst. (Stufenbreite-KR)" CURVE 0x8198D0 GklWUb 254.0 dez 1.000 255.0 FORMAT "%5.1"
 /begin AXIS_DESCR COM_AXIS nmot nmot_ub_q40 16 0.00 10200. AXIS_PTS_REF SNM16KRUB /end AXIS_DESCR
/end CHARACTERISTIC
/begin CHARACTERISTIC KRVFSN "Anzahl Zündungen/Zyl., oder Zeitangabe für schnelle Frühverstellung der KR" CURVE 0x8198E0 GklWUb 254.0 dez 1.000 255.0 FORMAT "%5.1"
 /begin AXIS_DESCR COM_AXIS nmot nmot_ub_q40 16 0.00 10200. AXIS_PTS_REF SNM16KRUB /end AXIS_DESCR
/end CHARACTERISTIC
/begin CHARACTERISTIC KRVST "Verstärkung nach Start" VALUE 0x8111BF KwUb 6.000 dez 0.00 6.000 FORMAT "%5.3" /end CHARACTERISTIC
/begin CHARACTERISTIC KRWKRAIN "Initialisierungswert für Adaptionswerte" VALUE 0x8111CD KwUb 191.3 zw_ub_qn0p75 -191.3 0.00 FORMAT "%5.1" /end CHARACTERISTIC
/begin CHARACTERISTIC KSZA "Anzahl Klopfsensoren" VALUE 0x8111C0 KwUb 3.000 dez 1.000 4.000 FORMAT "%5.3" /end CHARACTERISTIC
/begin CHARACTERISTIC KVB "Konstante für Verbrauchsanzeige" VALUE 0x81A6BC KwUb 777.0 m_ub_b780 0.00 777.0 FORMAT "%5.1" /end CHARACTERISTIC
/begin CHARACTERISTIC LAMFA "Lambda Fahrerwunsch" MAP 0x81D100 KfAxUbAyUbSstxUbSstyUwWUb 1.992 fak_ub_b2 0.00 1.992 FORMAT "%5.3"
 /begin AXIS_DESCR STD_AXIS nmot nmot_ub_q40 15 0.00 10200. FORMAT "%5.0" DEPOSIT ABSOLUTE /end AXIS_DESCR
 /begin AXIS_DESCR STD_AXIS mrfa_w rel_uw_b200 6 0.00 199.9969 FORMAT "%8.4" DEPOSIT ABSOLUTE /end AXIS_DESCR
/end CHARACTERISTIC
/begin CHARACTERISTIC LAMFAS "Sperre Lambda Fahrerwunsch" CURVE 0x81907F KlAUbSstUbWUb 0.9961 fak_ub_b1 0.00 0.9961
 /begin AXIS_DESCR STD_AXIS fho fak_ub_b4 6 0.00 3.984 FORMAT "%5.3" DEPOSIT ABSOLUTE /end AXIS_DESCR
/end CHARACTERISTIC
/begin CHARACTERISTIC LAMFLGSL "Lambda Motorlaufgrenze  fett bei Sekundärlufteinblasung" CURVE 0x818DC0 KlAUbSstUbWUb 1.992 fak_ub_b2 0.00 1.992 FORMAT "%5.3"
 /begin AXIS_DESCR STD_AXIS imlatm m_ub_b23p3 6 0.00 23.21 FORMAT "%5.2" DEPOSIT ABSOLUTE /end AXIS_DESCR
/end CHARACTERISTIC
/begin CHARACTERISTIC LAMLGFKT "Laufgrenze ""fett"" im Kurz Test" VALUE 0x818DCD KwUb 1.992 fak_ub_b2 0.00 1.992 FORMAT "%5.3" /end CHARACTERISTIC
/begin CHARACTERISTIC LAMLGFTM "Lambda Motorlaufgrenze fett" CURVE 0x818DCE GklWUb 1.992 fak_ub_b2 0.00 1.992 FORMAT "%5.3"
 /begin AXIS_DESCR COM_AXIS tmot temp_ub_q0p75_o48 12 -48.00 143.3 AXIS_PTS_REF STM12ESUB /end AXIS_DESCR
/end CHARACTERISTIC
/begin CHARACTERISTIC LAMLGMKT "Laufgrenze ""mager"" im Kurz Test" VALUE 0x818DDA KwUb 1.992 fak_ub_b2 0.00 1.992 FORMAT "%5.3" /end CHARACTERISTIC
/begin CHARACTERISTIC LAMLGMTM "Laufgrenze ""mager""" CURVE 0x818DDB GklWUb 1.992 fak_ub_b2 0.00 1.992 FORMAT "%5.3"
 /begin AXIS_DESCR COM_AXIS tmot temp_ub_q0p75_o48 12 -48.00 143.3 AXIS_PTS_REF STM12ESUB /end AXIS_DESCR
/end CHARACTERISTIC
/begin CHARACTERISTIC LAMLRAMN "minimale Lambda-Schwelle, bei der die Gemischadaption aktiv sein kann" VALUE 0x81BFEC KwUw 15.99976 fak_uw_b16 0.00 15.99976 FORMAT "%8.5" /end CHARACTERISTIC
/begin CHARACTERISTIC LAMLRAMX "maximale Lambda-Schwelle, bei der die Gemischadaption aktiv sein kann" VALUE 0x81BFEE KwUw 15.99976 fak_uw_b16 0.00 15.99976 FORMAT "%8.5" /end CHARACTERISTIC
/begin CHARACTERISTIC LAMRLMN "Lamdavorsteuerung bei rl < RLLAMMN zur Verbesserung der Brennbarkeit" VALUE 0x81908C KwUb 1.992 fak_ub_b2 0.00 1.992 FORMAT "%5.3" /end CHARACTERISTIC
/begin CHARACTERISTIC LAMSOSOF "Lambdasonde Soll Obergrenze für 1.0-Fenster" VALUE 0x815556 KwUw 15.99976 fak_uw_b16 0.00 15.99976 FORMAT "%8.5" /end CHARACTERISTIC
/begin CHARACTERISTIC LAMSOSUF "Lambdasonde Soll Untergrenze für 1.0-Fenster" VALUE 0x815558 KwUw 15.99976 fak_uw_b16 0.00 15.99976 FORMAT "%8.5" /end CHARACTERISTIC
/begin CHARACTERISTIC LASDSLA "Lambda-Abgas-Soll bei Sekundärluftadaption/Kurztest" CURVE 0x81DE2E KlAUwSstUwWUw 15.99976 fak_q0p000244 0.00 15.99976 FORMAT "%8.5"
 /begin AXIS_DESCR STD_AXIS ml_w m_uw_b6553p5 4 0.00 6553.500 FORMAT "%8.3" DEPOSIT ABSOLUTE /end AXIS_DESCR
/end CHARACTERISTIC
/begin CHARACTERISTIC LASOAB "Lambdasollwert bei Bankabschaltung" VALUE 0x810E37 KwUb 1.992 fak_ub_b2 0.00 1.992 FORMAT "%5.3" /end CHARACTERISTIC
/begin CHARACTERISTIC LASTMOT "Motortemp.-Korrektur von Lambda-Abgas-Soll" CURVE 0x819616 KlAUbSstUbWUb 1.992 fak_ub_b2 0.00 1.992 FORMAT "%5.3"
 /begin AXIS_DESCR STD_AXIS tmot temp_ub_q0p75_o48 4 -48.00 143.3 FORMAT "%5.1" DEPOSIT ABSOLUTE /end AXIS_DESCR
/end CHARACTERISTIC
/begin CHARACTERISTIC LBZO1 "Schwelle für lbz zur Solldrehzahlanhebung beim Verlassen des LL" VALUE 0x819BE6 KwUb 99.61 rel_ub_b99p6 0.00 99.61 FORMAT "%5.2" /end CHARACTERISTIC
/begin CHARACTERISTIC LBZO2 "Schwelle für lbz zur Solldrehzahlanhebung im Leerlauf" VALUE 0x819BE7 KwUb 99.61 rel_ub_b99p6 0.00 99.61 FORMAT "%5.2" /end CHARACTERISTIC
/begin CHARACTERISTIC LBZU "Schwelle für lbz zur Solldrehzahlabsenkung beim Verlassen des Leerlaufs" VALUE 0x819BE8 KwUb 99.61 rel_ub_b99p6 0.00 99.61 FORMAT "%5.2" /end CHARACTERISTIC
/begin CHARACTERISTIC LDAMN "Minimalwertbegrenzung der Adaption LDR I-Adaption" VALUE 0x81F068 KwSw 327.6750 tv_sw_q0p005 -163.8400 163.8350 FORMAT "%8.4" /end CHARACTERISTIC
/begin CHARACTERISTIC LDDIAN "Schrittweite pro Programmdurchlauf für negativ-Nachführung I-Begrenzung" VALUE 0x81F06A KwSw 327.6750 tv_sw_q0p005 -163.8400 163.8350 FORMAT "%8.4" /end CHARACTERISTIC
/begin CHARACTERISTIC LDDIAP "Schrittweite pro Programmdurchlauf für positiv-Nachführung I-Begrenzung" VALUE 0x81F06C KwSw 327.6750 tv_sw_q0p005 -163.8400 163.8350 FORMAT "%8.4" /end CHARACTERISTIC
/begin CHARACTERISTIC LDDIMNN "Sicherheitsabstand LDR I-Regler Begrenzung negativ" CURVE 0x81F06E GklWSw 327.6750 tv_sw_q0p005 -163.8400 163.8350 FORMAT "%8.4"
 /begin AXIS_DESCR COM_AXIS nmot_w nmot_uw_q0p25 8 0.00 16383.75 AXIS_PTS_REF SNM08LDUW /end AXIS_DESCR
/end CHARACTERISTIC
/begin CHARACTERISTIC LDDIMXN "Sicherheitsabstand LDR I-Regler Begrenzung" CURVE 0x81F07E GklWSw 327.6750 tv_sw_q0p005 -163.8400 163.8350 FORMAT "%8.4"
 /begin AXIS_DESCR COM_AXIS nmot_w nmot_uw_q0p25 8 0.00 16383.75 AXIS_PTS_REF SNM08LDUW /end AXIS_DESCR
/end CHARACTERISTIC
/begin CHARACTERISTIC LDEIAO "Obere Regelabweichungsschwelle für Negativ-Verstellung" VALUE 0x819998 KwSb 2550. p_sb_q10 -1280. 1270. FORMAT "%5.0" /end CHARACTERISTIC
/begin CHARACTERISTIC LDEIAP "Regelabweichungsschwelle für  Positiv Adaption I-Regler" VALUE 0x819999 KwSb 2550. p_sb_q10 -1280. 1270. FORMAT "%5.0" /end CHARACTERISTIC
/begin CHARACTERISTIC LDEIAPS "Regelabweichungsschwelle für schnelle Positiv-Nachführung" VALUE 0x81999A KwSb 2550. p_sb_q10 -1280. 1270. FORMAT "%5.0" /end CHARACTERISTIC
/begin CHARACTERISTIC LDEIAU "Untere Regelabweichungsschwelle für Negativ-Verstellung" VALUE 0x81999B KwSb 2550. p_sb_q10 -1280. 1270. FORMAT "%5.0" /end CHARACTERISTIC
/begin CHARACTERISTIC LDHIA "Hysterese für LDR I-Adaptionskennlinie" VALUE 0x81999C KwUb 10200. nmot_ub_q40 0.00 10200. FORMAT "%5.0" /end CHARACTERISTIC
/begin CHARACTERISTIC LDIATA "Korrektur I-Begrenzung LDR PID Rgler als Funktion von Tans" CURVE 0x81999D GklWSb 163.2 tv_ub_q0p64 -81.92 81.28 FORMAT "%5.2"
 /begin AXIS_DESCR COM_AXIS tans temp_ub_q0p75_o48 8 -48.00 143.3 AXIS_PTS_REF STA08LDUB /end AXIS_DESCR
/end CHARACTERISTIC
/begin CHARACTERISTIC LDMXNN "Begrenzung max. Nachführung LDR negativ für Regleradaption" VALUE 0x81F08E KwSw 163.8400 tv_sw_q0p005 -163.8400 0.00 FORMAT "%8.4" /end CHARACTERISTIC
/begin CHARACTERISTIC LDMXNP "Begrenzung max. Nachführung LDR Adaption positiv bei Bereichswechsel" VALUE 0x81F090 KwSw 163.8350 tv_sw_q0p005 0.00 163.8350 FORMAT "%8.4" /end CHARACTERISTIC
/begin CHARACTERISTIC LDORXN "Maximalfuellung LDR bei E_ldo (Überladefehler)" CURVE 0x819A20 GklWUb 191.3 rel_ub_q0p75 0.00 191.3 FORMAT "%5.1"
 /begin AXIS_DESCR COM_AXIS nmot nmot_ub_q40 8 0.00 10200. AXIS_PTS_REF SNM08LDUB /end AXIS_DESCR
/end CHARACTERISTIC
/begin CHARACTERISTIC LDPBN "LDR p-Begrenzung bei zu hoher Motortemperatur" CURVE 0x819A28 GklWUb 2550. p_ub_q10 0.00 2550. FORMAT "%5.0"
 /begin AXIS_DESCR COM_AXIS nmot nmot_ub_q40 8 0.00 10200. AXIS_PTS_REF SNM08LDUB /end AXIS_DESCR
/end CHARACTERISTIC
/begin CHARACTERISTIC LDRAPP "Festwert für LDR-Applikation ohne Md-Koordination" VALUE 0x819AC6 KwUb 99.61 tv_ub_b100 0.00 99.61 FORMAT "%5.2" /end CHARACTERISTIC
/begin CHARACTERISTIC LDRPBU "P-Regler Kennwert LDR back up Regler" VALUE 0x819AC7 KwUb 0.2621 tv_q0p001028 0.00 0.2621 /end CHARACTERISTIC
/begin CHARACTERISTIC LDRQ0S "Reglerparameter Q0 LDR-PID Regler im Stationärbetrieb" VALUE 0x81F092 KwUw 3276.750 rel_uw_b3276p75 0.00 3276.750 FORMAT "%8.3" /end CHARACTERISTIC
/begin CHARACTERISTIC LDRQ1ST "Reglerparameter Q1 PID-Regler im Stationärbetrieb (Integrationsbeiwert)" CURVE 0x81F094 GklWUw 3276.750 rel_uw_b3276p75 0.00 3276.750 FORMAT "%8.3"
 /begin AXIS_DESCR COM_AXIS nmot nmot_ub_q40 16 0.00 10200. AXIS_PTS_REF SNM16LDUB /end AXIS_DESCR
/end CHARACTERISTIC
/begin CHARACTERISTIC LDRVL "Vollast Erkennungsschwelle LDR" VALUE 0x8199A5 KwUb 99.61 rel_ub_b99p6 0.00 99.61 FORMAT "%5.2" /end CHARACTERISTIC
/begin CHARACTERISTIC LDRXN "Maximalfuellung LDR" CURVE 0x81F62A KlAUbSstUwWUw 1535.977 rel_uw_q0p0234 0.00 1535.977 FORMAT "%8.3"
 /begin AXIS_DESCR STD_AXIS nmot_w nmot_uw_q0p25 16 0.00 16383.75 FORMAT "%8.2" DEPOSIT ABSOLUTE /end AXIS_DESCR
/end CHARACTERISTIC
/begin CHARACTERISTIC LDRXNZK "Maximalfuellung LDR bei Dauerklopfen" CURVE 0x81F66C KlAUbSstUwWUw 1535.977 rel_uw_q0p0234 0.00 1535.977 FORMAT "%8.3"
 /begin AXIS_DESCR STD_AXIS nmot_w nmot_uw_q0p25 16 0.00 16383.75 FORMAT "%8.2" DEPOSIT ABSOLUTE /end AXIS_DESCR
/end CHARACTERISTIC
/begin CHARACTERISTIC LDUVRS "LDR Umluftventilsteuerung Reset vom Sollwert" VALUE 0x81EBEE KwUw 2559.961 p_uw_q0p039 0.00 2559.961 FORMAT "%8.3" /end CHARACTERISTIC
/begin CHARACTERISTIC LIMN "Untere Integratorbegrenzung bei stehendem Fahrzeug" VALUE 0x8112F4 KwUb 24.90 rel_ub_bn24p9 -24.90 0.00 FORMAT "%5.2" /end CHARACTERISTIC
/begin CHARACTERISTIC LIMNDLLR "Untere Integratorbegrenzung bei Diagnose Leerlaufregelung" VALUE 0x8112F5 KwUb 24.90 rel_ub_bn24p9 -24.90 0.00 FORMAT "%5.2" /end CHARACTERISTIC
/begin CHARACTERISTIC LIMNDTES "Untere Integratorbegrenzung bei DTES" VALUE 0x8112F6 KwUb 24.90 rel_ub_bn24p9 -24.90 0.00 FORMAT "%5.2" /end CHARACTERISTIC
/begin CHARACTERISTIC LIMNV "Untere Integratorbegrenzung bei rollendem Fahrzeug" VALUE 0x8112F7 KwUb 24.90 rel_ub_bn24p9 -24.90 0.00 FORMAT "%5.2" /end CHARACTERISTIC
/begin CHARACTERISTIC LIMXDNS "Obere Integratorbegrenzung bei stehendem Fahrzeug" CURVE 0x819C86 GklWUb 24.90 rel_ub_b24p9 0.00 24.90 FORMAT "%5.2"
 /begin AXIS_DESCR COM_AXIS dns nmotd_sb_q10 6 -1280. 1270. AXIS_PTS_REF SNS206LLSB /end AXIS_DESCR
/end CHARACTERISTIC
/begin CHARACTERISTIC LIMXVDNS "Obere Integratorbegrenzung bei rollendem Fahrzeug" CURVE 0x819C8C GklWUb 24.90 rel_ub_b24p9 0.00 24.90 FORMAT "%5.2"
 /begin AXIS_DESCR COM_AXIS dns nmotd_sb_q10 6 -1280. 1270. AXIS_PTS_REF SNS206LLSB /end AXIS_DESCR
/end CHARACTERISTIC
/begin CHARACTERISTIC LISTM "Wert des Leerlaufintegrators im Start" CURVE 0x819C92 GklWUb 24.90 rel_ub_b24p9 0.00 24.90 FORMAT "%5.2"
 /begin AXIS_DESCR COM_AXIS tmot temp_ub_q0p75_o48 6 -48.00 143.3 AXIS_PTS_REF STM06LLUB /end AXIS_DESCR
/end CHARACTERISTIC
/begin CHARACTERISTIC LKRAN "Lastschwelle Klopfregel-Adaption" CURVE 0x8198F0 GklWUb 191.3 rel_ub_q0p75 0.00 191.3 FORMAT "%5.1"
 /begin AXIS_DESCR COM_AXIS nmot nmot_ub_q40 16 0.00 10200. AXIS_PTS_REF SNM16KRUB /end AXIS_DESCR
/end CHARACTERISTIC
/begin CHARACTERISTIC LKRN "Lastschwelle Klopfregelung" CURVE 0x819900 GklWUb 191.3 rel_ub_q0p75 0.00 191.3 FORMAT "%5.1"
 /begin AXIS_DESCR COM_AXIS nmot nmot_ub_q40 16 0.00 10200. AXIS_PTS_REF SNM16KRUB /end AXIS_DESCR
/end CHARACTERISTIC
/begin CHARACTERISTIC LLRICNF "Configurationsbyte für LLR Integrator" VALUE 0x8112F8 KwUb 255.0 dez 0.00 255.0 FORMAT "%5.1" /end CHARACTERISTIC
/begin CHARACTERISTIC LMSTMOT "Motortemp.-Korrektur von Lambda-Motor-Soll" CURVE 0x81961F KlAUbSstUbWUb 1.992 fak_ub_b2 0.00 1.992 FORMAT "%5.3"
 /begin AXIS_DESCR STD_AXIS tmot temp_ub_q0p75_o48 4 -48.00 143.3 FORMAT "%5.1" DEPOSIT ABSOLUTE /end AXIS_DESCR
/end CHARACTERISTIC
/begin CHARACTERISTIC LZB1 "Leitzylinderzuordnung: Bank1 führt Bank2 bei Fehler KS 2" VAL_BLK 0x8111CE KwbUb 255.0 dez 0.00 255.0 FORMAT "%5.1" NUMBER 8 /end CHARACTERISTIC
/begin CHARACTERISTIC LZB2 "Leitzylinderzuordnung: Bank2 führt Bank1 bei Fehler KS 1" VAL_BLK 0x8111D6 KwbUb 255.0 dez 0.00 255.0 FORMAT "%5.1" NUMBER 8 /end CHARACTERISTIC
/begin CHARACTERISTIC LZFUER "Festwerteblock: Leitzylinderzuordnung" VAL_BLK 0x8111DE KwbUb 255.0 dez 0.00 255.0 FORMAT "%5.1" NUMBER 8 /end CHARACTERISTIC
/begin CHARACTERISTIC MLO1 "obere Luftmengenschwelle Bereich 1" VALUE 0x81D068 KwUw 6553.500 m_uw_b6553p5 0.00 6553.500 FORMAT "%8.3" /end CHARACTERISTIC
/begin CHARACTERISTIC MLO1AC "obere Luftmengenschwelle Bereich 1 mit Kompressor" VALUE 0x81D06A KwUw 6553.500 m_uw_b6553p5 0.00 6553.500 FORMAT "%8.3" /end CHARACTERISTIC
/begin CHARACTERISTIC MLO2 "obere Luftmengenschwelle Bereich 2" VALUE 0x81555A KwUw 6553.500 m_uw_b6553p5 0.00 6553.500 FORMAT "%8.3" /end CHARACTERISTIC
/begin CHARACTERISTIC MLO3 "obere Luftmengenschwelle Bereich 3" VALUE 0x81D06C KwUw 6553.500 m_uw_b6553p5 0.00 6553.500 FORMAT "%8.3" /end CHARACTERISTIC
/begin CHARACTERISTIC MLO3AC "obere Luftmengenschwelle Bereich 3 mit Kompressor" VALUE 0x81D06E KwUw 6553.500 m_uw_b6553p5 0.00 6553.500 FORMAT "%8.3" /end CHARACTERISTIC
/begin CHARACTERISTIC MLU2 "untere Luftmengenschwelle Bereich 2" VALUE 0x81D070 KwUw 6553.500 m_uw_b6553p5 0.00 6553.500 FORMAT "%8.3" /end CHARACTERISTIC
/begin CHARACTERISTIC MLU2AC "untere Luftmengenschwelle Bereich 2 mit Kompressor" VALUE 0x81D072 KwUw 6553.500 m_uw_b6553p5 0.00 6553.500 FORMAT "%8.3" /end CHARACTERISTIC
/begin CHARACTERISTIC MLU2FA "untere Luftmengenschwelle bei Funktionsanforderung B_faan Bereich 2" VALUE 0x81D074 KwUw 6553.500 m_uw_b6553p5 0.00 6553.500 FORMAT "%8.3" /end CHARACTERISTIC
/begin CHARACTERISTIC MLU4 "untere Luftmengenschwelle Bereich 4" VALUE 0x81555C KwUw 6553.500 m_uw_b6553p5 0.00 6553.500 FORMAT "%8.3" /end CHARACTERISTIC
/begin CHARACTERISTIC MLU4AC "untere Luftmengenschwelle Bereich 4 mit Kompressor" VALUE 0x81555E KwUw 6553.500 m_uw_b6553p5 0.00 6553.500 FORMAT "%8.3" /end CHARACTERISTIC
/begin CHARACTERISTIC MRESLL "LLR: Erhöhte Momentenreserve im LL nach Drehzahleinbruch" VALUE 0x81148E KwUb 24.90 rel_ub_b24p9 0.00 24.90 FORMAT "%5.2" /end CHARACTERISTIC
/begin CHARACTERISTIC MRESSL "Momentenreserve bei Servolenkung" VALUE 0x816060 KwUw 99.99847 rel_uw_b100 0.00 99.99847 FORMAT "%8.5" /end CHARACTERISTIC
/begin CHARACTERISTIC N0 "Umrechnungskonstante für Einrechnung Gemischkorrektur rkat" VALUE 0x810E38 KwUb 10200. nmot_ub_q40 0.00 10200. FORMAT "%5.0" /end CHARACTERISTIC
/begin CHARACTERISTIC NFHZ "Solldrehzahl bei eingeschalteter Frontscheibenheizung" VALUE 0x819BE9 KwUb 2550. nmot_ub_q10 0.00 2550. FORMAT "%5.0" /end CHARACTERISTIC
/begin CHARACTERISTIC NFHZFS "Solldrehzahl bei eingeschalteter Frontscheibenheizung und B_fs=1" VALUE 0x819BEA KwUb 2550. nmot_ub_q10 0.00 2550. FORMAT "%5.0" /end CHARACTERISTIC
/begin CHARACTERISTIC NFS2M "Solldrehzahl 2 Fahrstufenschalter ein" CURVE 0x819BEB GklWUb 2550. nmot_ub_q10 0.00 2550. FORMAT "%5.0"
 /begin AXIS_DESCR COM_AXIS tmot temp_ub_q0p75_o48 6 -48.00 143.3 AXIS_PTS_REF STM06LLUB /end AXIS_DESCR
/end CHARACTERISTIC
/begin CHARACTERISTIC NFSKLDF "Solldrehzahl bei Generatorlast aktiv und B_fs=1" VALUE 0x819BF1 KwUb 2550. nmot_ub_q10 0.00 2550. FORMAT "%5.0" /end CHARACTERISTIC
/begin CHARACTERISTIC NFSKO_0_A "Solldrehzahl für Klimaanlage bei B_fs=1" VALUE 0x81F970 KwUb 2550. nmot_ub_q10 0.00 2550. FORMAT "%5.0" /end CHARACTERISTIC
/begin CHARACTERISTIC NFSKO_1_A "Solldrehzahl für Klimaanlage bei B_fs=1" VALUE 0x81F971 KwUb 2550. nmot_ub_q10 0.00 2550. FORMAT "%5.0" /end CHARACTERISTIC
/begin CHARACTERISTIC NFSKS "Solldrehzahl für Kochschutz (Fahrstufe eingelegt)" VALUE 0x811280 KwUb 2550. nmot_ub_q10 0.00 2550. FORMAT "%5.0" /end CHARACTERISTIC
/begin CHARACTERISTIC NFSLPWG "Solldrehzahl bei Ausfall PWG-Signal bei B_fs=1" VALUE 0x811281 KwUb 2550. nmot_ub_q10 0.00 2550. FORMAT "%5.0" /end CHARACTERISTIC
/begin CHARACTERISTIC NFSM "Solldrehzahl Fahrstufenschalter ein" CURVE 0x819BF2 GklWUb 2550. nmot_ub_q10 0.00 2550. FORMAT "%5.0"
 /begin AXIS_DESCR COM_AXIS tmot temp_ub_q0p75_o48 6 -48.00 143.3 AXIS_PTS_REF STM06LLUB /end AXIS_DESCR
/end CHARACTERISTIC
/begin CHARACTERISTIC NFSMIN_0_A "Minimale zulässige Solldrehzahl bei eingelegter Fahrstufe" VALUE 0x81F972 KwUb 2550. nmot_ub_q10 0.00 2550. FORMAT "%5.0" /end CHARACTERISTIC
/begin CHARACTERISTIC NFSMIN_1_A "Minimale zulässige Solldrehzahl bei eingelegter Fahrstufe" VALUE 0x81F973 KwUb 2550. nmot_ub_q10 0.00 2550. FORMAT "%5.0" /end CHARACTERISTIC
/begin CHARACTERISTIC NFSNLDG "Soll-Drehzahlerhöhung bei Drehzahlgeber-Notlauf" VALUE 0x811282 KwUb 2550. nmot_ub_q10 0.00 2550. FORMAT "%5.0" /end CHARACTERISTIC
/begin CHARACTERISTIC NFSSL "Soll-Drehzahl bei Servolenkungsschalter aktiv und B_fs=1" VALUE 0x819BF8 KwUb 2550. nmot_ub_q10 0.00 2550. FORMAT "%5.0" /end CHARACTERISTIC
/begin CHARACTERISTIC NGKRSTMX "maximaler Drehzahlgradient im KR stationär Betrieb" VALUE 0x815858 KwSw 12799.77 nmotg_sw_q0p39 0.00 12799.77 FORMAT "%8.2" /end CHARACTERISTIC
/begin CHARACTERISTIC NGNSNF "Drehzahlgradientenschwelle zur Auslösung der Drehzahlnachführung" VALUE 0x811283 KwUb 25500. nmotg_ub_q100 0.00 25500. FORMAT "%5.0" /end CHARACTERISTIC
/begin CHARACTERISTIC NKLDF "Solldrehzahl bei Generatorlast aktiv" VALUE 0x819BF9 KwUb 2550. nmot_ub_q10 0.00 2550. FORMAT "%5.0" /end CHARACTERISTIC
/begin CHARACTERISTIC NKRAMAX "Drehzahl oberhalb der KR-Adaption gefreezt wird" VALUE 0x819910 KwUb 10200. nmot_ub_q40 0.00 10200. FORMAT "%5.0" /end CHARACTERISTIC
/begin CHARACTERISTIC NKRAMIN "Drehzahl unterhalb der KR-Adaption gefreezt wird" VALUE 0x819911 KwUb 10200. nmot_ub_q40 0.00 10200. FORMAT "%5.0" /end CHARACTERISTIC
/begin CHARACTERISTIC NKRF "Drehzahlschwelle für Klopfregelfreigabe" VALUE 0x819912 KwUb 10200. nmot_ub_q40 0.00 10200. FORMAT "%5.0" /end CHARACTERISTIC
/begin CHARACTERISTIC NKRMAX "Drehzahl oberhalb der KR gefreezt wird" VALUE 0x819913 KwUb 10200. nmot_ub_q40 0.00 10200. FORMAT "%5.0" /end CHARACTERISTIC
/begin CHARACTERISTIC NLDIAPU "Drehzahlschwelle für Adaption I-Begrenzung" CURVE 0x81F0B4 KlAUbSstUbWUb 10200. nmot_ub_q40 0.00 10200. FORMAT "%5.0"
 /begin AXIS_DESCR STD_AXIS pu p_ub_q5 2 0.00 1275. FORMAT "%5.0" DEPOSIT ABSOLUTE /end AXIS_DESCR
/end CHARACTERISTIC
/begin CHARACTERISTIC NLL2M_0_A "Solldrehzahl 2" CURVE 0x819BFA GklWUb 2550. nmot_ub_q10 0.00 2550. FORMAT "%5.0"
 /begin AXIS_DESCR COM_AXIS tmot temp_ub_q0p75_o48 6 -48.00 143.3 AXIS_PTS_REF STM06LLUB /end AXIS_DESCR
/end CHARACTERISTIC
/begin CHARACTERISTIC NLL2M_1_A "Solldrehzahl 2" CURVE 0x819C00 GklWUb 2550. nmot_ub_q10 0.00 2550. FORMAT "%5.0"
 /begin AXIS_DESCR COM_AXIS tmot temp_ub_q0p75_o48 6 -48.00 143.3 AXIS_PTS_REF STM06LLUB /end AXIS_DESCR
/end CHARACTERISTIC
/begin CHARACTERISTIC NLL2M_2_A "Solldrehzahl 2" CURVE 0x819C06 GklWUb 2550. nmot_ub_q10 0.00 2550. FORMAT "%5.0"
 /begin AXIS_DESCR COM_AXIS tmot temp_ub_q0p75_o48 6 -48.00 143.3 AXIS_PTS_REF STM06LLUB /end AXIS_DESCR
/end CHARACTERISTIC
/begin CHARACTERISTIC NLL2M_3_A "Solldrehzahl 2" CURVE 0x819C0C GklWUb 2550. nmot_ub_q10 0.00 2550. FORMAT "%5.0"
 /begin AXIS_DESCR COM_AXIS tmot temp_ub_q0p75_o48 6 -48.00 143.3 AXIS_PTS_REF STM06LLUB /end AXIS_DESCR
/end CHARACTERISTIC
/begin CHARACTERISTIC NLLCVTMXV "Begrenzung der Drehzahlvorgabe (CVT-Getriebe)" CURVE 0x819C12 KlAUbSstUbWUb 2550. nmot_ub_q10 0.00 2550. FORMAT "%5.0"
 /begin AXIS_DESCR STD_AXIS vfzg vfzg_ub_q1p25 8 0.00 318.8 FORMAT "%5.1" DEPOSIT ABSOLUTE /end AXIS_DESCR
/end CHARACTERISTIC
/begin CHARACTERISTIC NLLM_0_A "Solldrehzahl" CURVE 0x819C23 GklWUb 2550. nmot_ub_q10 0.00 2550. FORMAT "%5.0"
 /begin AXIS_DESCR COM_AXIS tmot temp_ub_q0p75_o48 6 -48.00 143.3 AXIS_PTS_REF STM06LLUB /end AXIS_DESCR
/end CHARACTERISTIC
/begin CHARACTERISTIC NLLM_1_A "Solldrehzahl" CURVE 0x819C29 GklWUb 2550. nmot_ub_q10 0.00 2550. FORMAT "%5.0"
 /begin AXIS_DESCR COM_AXIS tmot temp_ub_q0p75_o48 6 -48.00 143.3 AXIS_PTS_REF STM06LLUB /end AXIS_DESCR
/end CHARACTERISTIC
/begin CHARACTERISTIC NLLM_2_A "Solldrehzahl" CURVE 0x819C2F GklWUb 2550. nmot_ub_q10 0.00 2550. FORMAT "%5.0"
 /begin AXIS_DESCR COM_AXIS tmot temp_ub_q0p75_o48 6 -48.00 143.3 AXIS_PTS_REF STM06LLUB /end AXIS_DESCR
/end CHARACTERISTIC
/begin CHARACTERISTIC NLLM_3_A "Solldrehzahl" CURVE 0x819C35 GklWUb 2550. nmot_ub_q10 0.00 2550. FORMAT "%5.0"
 /begin AXIS_DESCR COM_AXIS tmot temp_ub_q0p75_o48 6 -48.00 143.3 AXIS_PTS_REF STM06LLUB /end AXIS_DESCR
/end CHARACTERISTIC
/begin CHARACTERISTIC NLLMIN_0_A "Minimale zulässige Solldrehzahl" VALUE 0x81F974 KwUb 2550. nmot_ub_q10 0.00 2550. FORMAT "%5.0" /end CHARACTERISTIC
/begin CHARACTERISTIC NLLMIN_1_A "Minimale zulässige Solldrehzahl" VALUE 0x81F975 KwUb 2550. nmot_ub_q10 0.00 2550. FORMAT "%5.0" /end CHARACTERISTIC
/begin CHARACTERISTIC NO1 "obere Drehzahlschwelle Bereich 1" VALUE 0x818DFD KwUb 10200. nmot_ub_q40 0.00 10200. FORMAT "%5.0" /end CHARACTERISTIC
/begin CHARACTERISTIC NO2 "obere Drehzahlschwelle Bereich 2" VALUE 0x818DFE KwUb 10200. nmot_ub_q40 0.00 10200. FORMAT "%5.0" /end CHARACTERISTIC
/begin CHARACTERISTIC NOLRA "Codewort für Adaptionsfreigabe" VALUE 0x818DFF KwUb 255.0 dez 0.00 255.0 FORMAT "%5.1" /end CHARACTERISTIC
/begin CHARACTERISTIC NRKAB "Mindestdrehzahl für Begrenzung Stelleingriff rkat bei niedrigen Drehzahlen" VALUE 0x810E39 KwUb 10200. nmot_ub_q40 0.00 10200. FORMAT "%5.0" /end CHARACTERISTIC
/begin CHARACTERISTIC NSAC_0_A "Solldrehzahl bei Klimaanlage ein (S_AC = 1)" VALUE 0x815FA2 KwUb 2550. nmot_ub_q10 0.00 2550. FORMAT "%5.0" /end CHARACTERISTIC
/begin CHARACTERISTIC NSAC_1_A "Solldrehzahl bei Klimaanlage ein (S_AC = 1)" VALUE 0x815FA3 KwUb 2550. nmot_ub_q10 0.00 2550. FORMAT "%5.0" /end CHARACTERISTIC
/begin CHARACTERISTIC NSACFS_0_A "Solldrehzahl bei Klimaanlage ein (S_AC = 1) und eingelegter Fahrstufe (S_fs=1)" VALUE 0x815FA4 KwUb 2550. nmot_ub_q10 0.00 2550. FORMAT "%5.0" /end CHARACTERISTIC
/begin CHARACTERISTIC NSACFS_1_A "Solldrehzahl bei Klimaanlage ein (S_AC = 1) und eingelegter Fahrstufe (S_fs=1)" VALUE 0x815FA5 KwUb 2550. nmot_ub_q10 0.00 2550. FORMAT "%5.0" /end CHARACTERISTIC
/begin CHARACTERISTIC NSHLL "Mindestsolldrehzahl bei Heiß-Leerlauf" VALUE 0x811284 KwUb 2550. nmot_ub_q10 0.00 2550. FORMAT "%5.0" /end CHARACTERISTIC
/begin CHARACTERISTIC NSKO_0_A "Solldrehzahl für Klimaanlage" VALUE 0x81F976 KwUb 2550. nmot_ub_q10 0.00 2550. FORMAT "%5.0" /end CHARACTERISTIC
/begin CHARACTERISTIC NSKO_1_A "Solldrehzahl für Klimaanlage" VALUE 0x81F977 KwUb 2550. nmot_ub_q10 0.00 2550. FORMAT "%5.0" /end CHARACTERISTIC
/begin CHARACTERISTIC NSKS "Solldrehzahl für Kochschutz" VALUE 0x811285 KwUb 2550. nmot_ub_q10 0.00 2550. FORMAT "%5.0" /end CHARACTERISTIC
/begin CHARACTERISTIC NSL "Solldrehzahl bei Servolenkung aktiv" VALUE 0x819C3B KwUb 2550. nmot_ub_q10 0.00 2550. FORMAT "%5.0" /end CHARACTERISTIC
/begin CHARACTERISTIC NSLBZFS "Solldrehzahl bei entladener Batterie bei B_fs=1" VALUE 0x819C3C KwUb 2550. nmot_ub_q10 0.00 2550. FORMAT "%5.0" /end CHARACTERISTIC
/begin CHARACTERISTIC NSLBZLL "Solldrehzahl bei entladener Batterie" VALUE 0x819C3D KwUb 2550. nmot_ub_q10 0.00 2550. FORMAT "%5.0" /end CHARACTERISTIC
/begin CHARACTERISTIC NSLBZS "Drehzahlschwelle zur Umschaltung der Solldrehzahl durch lbz" VALUE 0x819C3E KwUb 10200. nmot_ub_q40 0.00 10200. FORMAT "%5.0" /end CHARACTERISTIC
/begin CHARACTERISTIC NSLFAA "Leerlaufdrehzahl bei Bandendetest (bei allgemeiner Anforderung)" VALUE 0x819D92 KwUb 2550. nmot_ub_q10 0.00 2550. FORMAT "%5.0" /end CHARACTERISTIC
/begin CHARACTERISTIC NSLFAEZLA "Solldrehzahl bei Kurztrip Einzelzylinder-Lambda-Regelung" VALUE 0x819D93 KwUb 2550. nmot_ub_q10 0.00 2550. FORMAT "%5.0" /end CHARACTERISTIC
/begin CHARACTERISTIC NSLFAKAT_0_A "Solldrehzahl bei Kurztrip Katdiagnose" VALUE 0x81F9FC KwUb 2550. nmot_ub_q10 0.00 2550. FORMAT "%5.0" /end CHARACTERISTIC
/begin CHARACTERISTIC NSLFAKAT_1_A "Solldrehzahl bei Kurztrip Katdiagnose" VALUE 0x81F9FD KwUb 2550. nmot_ub_q10 0.00 2550. FORMAT "%5.0" /end CHARACTERISTIC
/begin CHARACTERISTIC NSLFAKRS "Solldrehzahl bei Kurztrip Klopfsensor" VALUE 0x819D94 KwUb 2550. nmot_ub_q10 0.00 2550. FORMAT "%5.0" /end CHARACTERISTIC
/begin CHARACTERISTIC NSLFALDP "Solldrehzahl bei Kurztrip Tankleckdiagnose" VALUE 0x819D95 KwUb 2550. nmot_ub_q10 0.00 2550. FORMAT "%5.0" /end CHARACTERISTIC
/begin CHARACTERISTIC NSLFALSV "Solldrehzahl bei Kurztrip Lambdasonde vor Kat" VALUE 0x819D96 KwUb 2550. nmot_ub_q10 0.00 2550. FORMAT "%5.0" /end CHARACTERISTIC
/begin CHARACTERISTIC NSLFASH "Solldrehzahl bei Kurztrip Schwingungsprüfung" VALUE 0x819D97 KwUb 2550. nmot_ub_q10 0.00 2550. FORMAT "%5.0" /end CHARACTERISTIC
/begin CHARACTERISTIC NSLFASHV "Solldrehzahl bei Kurztrip Sodenvertauscherkennung" VALUE 0x819D98 KwUb 2550. nmot_ub_q10 0.00 2550. FORMAT "%5.0" /end CHARACTERISTIC
/begin CHARACTERISTIC NSLFASKNO "Drehzahlanforderung für Kurztrip: Diagnose Speicherkat" VALUE 0x819D99 KwUb 2550. nmot_ub_q10 0.00 2550. FORMAT "%5.0" /end CHARACTERISTIC
/begin CHARACTERISTIC NSLFASLS "Solldrehzahl bei Kurztrip Sekundärluft" VALUE 0x819D9A KwUb 2550. nmot_ub_q10 0.00 2550. FORMAT "%5.0" /end CHARACTERISTIC
/begin CHARACTERISTIC NSLFATES "Solldrehzahl bei Kurztrip Tankentlüftung" VALUE 0x819D9B KwUb 2550. nmot_ub_q10 0.00 2550. FORMAT "%5.0" /end CHARACTERISTIC
/begin CHARACTERISTIC NSLFAWSA "Leerlaufdrehzahl bei Kurztrip Auslaß-NW" VALUE 0x819D9C KwUb 2550. nmot_ub_q10 0.00 2550. FORMAT "%5.0" /end CHARACTERISTIC
/begin CHARACTERISTIC NSLFAWSE "Leerlaufdrehzahl bei Kurztrip Einlaß-NW" VALUE 0x819D9D KwUb 2550. nmot_ub_q10 0.00 2550. FORMAT "%5.0" /end CHARACTERISTIC
/begin CHARACTERISTIC NSLKVS "Solldrehzahl bei Kurztrip Diagnose Kraftstoffversorgung" VALUE 0x819D9E KwUb 2550. nmot_ub_q10 0.00 2550. FORMAT "%5.0" /end CHARACTERISTIC
/begin CHARACTERISTIC NSLLSH "Solldrehzahl bei Kurztrip Lambdasonde hinter Kat" VALUE 0x819D9F KwUb 2550. nmot_ub_q10 0.00 2550. FORMAT "%5.0" /end CHARACTERISTIC
/begin CHARACTERISTIC NSLPP "Solldrehzahl abhängig vom Pumpendruck der Servolenkung" CURVE 0x819C3F KlAUbSstUbWUb 2550. nmot_ub_q10 0.00 2550. FORMAT "%5.0"
 /begin AXIS_DESCR STD_AXIS psl dez 4 0.00 255.0 FORMAT "%5.1" DEPOSIT ABSOLUTE /end AXIS_DESCR
/end CHARACTERISTIC
/begin CHARACTERISTIC NSLPPFS "Solldrehzahl abhängig vom Pumpendruck der Servolenkung bei B_fs=1" CURVE 0x819C48 KlAUbSstUbWUb 2550. nmot_ub_q10 0.00 2550. FORMAT "%5.0"
 /begin AXIS_DESCR STD_AXIS psl dez 4 0.00 255.0 FORMAT "%5.1" DEPOSIT ABSOLUTE /end AXIS_DESCR
/end CHARACTERISTIC
/begin CHARACTERISTIC NSLPWG "Solldrehzahl bei Ausfall PWG-Signale" VALUE 0x811286 KwUb 2550. nmot_ub_q10 0.00 2550. FORMAT "%5.0" /end CHARACTERISTIC
/begin CHARACTERISTIC NSNLDG "Soll-Drehzahlerhöhung bei Drehzahlgeber-Notlauf" VALUE 0x811287 KwUb 2550. nmot_ub_q10 0.00 2550. FORMAT "%5.0" /end CHARACTERISTIC
/begin CHARACTERISTIC NSNOT "Solldrehzahlanhebung bei Pedalfehler" VALUE 0x811288 KwUb 2550. nmot_ub_q10 0.00 2550. FORMAT "%5.0" /end CHARACTERISTIC
/begin CHARACTERISTIC NU2 "untere Drehzahlschwelle Bereich 2" VALUE 0x818E00 KwUb 10200. nmot_ub_q40 0.00 10200. FORMAT "%5.0" /end CHARACTERISTIC
/begin CHARACTERISTIC NU3 "untere Drehzahlschwelle Bereich 3" VALUE 0x818E01 KwUb 10200. nmot_ub_q40 0.00 10200. FORMAT "%5.0" /end CHARACTERISTIC
/begin CHARACTERISTIC NZHDTL "Drehzahlschwelle für Zeitzähler Heiß-Leerlauf dekrementieren abh. von TL" CURVE 0x819C51 KlAUbSstUbWUb 10200. nmot_ub_q40 0.00 10200. FORMAT "%5.0"
 /begin AXIS_DESCR STD_AXIS rl rel_ub_q0p75 4 0.00 191.3 FORMAT "%5.1" DEPOSIT ABSOLUTE /end AXIS_DESCR
/end CHARACTERISTIC
/begin CHARACTERISTIC NZHITL "Drehzahlschwelle für Zeitzähler Heiß-Leerlauf inkrementieren abh. von TL" CURVE 0x819C5A KlAUbSstUbWUb 10200. nmot_ub_q40 0.00 10200. FORMAT "%5.0"
 /begin AXIS_DESCR STD_AXIS rl rel_ub_q0p75 4 0.00 191.3 FORMAT "%5.1" DEPOSIT ABSOLUTE /end AXIS_DESCR
/end CHARACTERISTIC
/begin CHARACTERISTIC PIDLDSUA "Prädiktionsintervall für dynamische Schubumluftventilansteuerung" VALUE 0x811245 KwUb 63.75 fak_ub_b64 0.00 63.75 FORMAT "%5.2" /end CHARACTERISTIC
/begin CHARACTERISTIC PVDNHOM "P-Reglerparameter bei Homogenbetrieb" CURVE 0x8112F9 GklWUb 0.3891 fak_q0p00153 0.00 0.3891
 /begin AXIS_DESCR COM_AXIS dn_w nmot_sw_q0p25 10 -8192.000 8191.750 AXIS_PTS_REF SDN10LLSW /end AXIS_DESCR
/end CHARACTERISTIC
/begin CHARACTERISTIC PVDNHOMV "P-Reglerparamter bei Homogenbetrieb und Kraftschluß" CURVE 0x811303 GklWUb 0.3891 fak_q0p00153 0.00 0.3891
 /begin AXIS_DESCR COM_AXIS dn_w nmot_sw_q0p25 10 -8192.000 8191.750 AXIS_PTS_REF SDN10LLSW /end AXIS_DESCR
/end CHARACTERISTIC
/begin CHARACTERISTIC PVDNKH "Kennlinie P-Verstärkung bei Thermoreaktor" CURVE 0x81602A KlAUbSstSbWUb 0.3891 fak_q0p00153 0.00 0.3891
 /begin AXIS_DESCR STD_AXIS dns nmotd_sb_q10 10 -1280. 1270. FORMAT "%5.0" DEPOSIT ABSOLUTE /end AXIS_DESCR
/end CHARACTERISTIC
/begin CHARACTERISTIC PVDNST "Kennlinie P-Verstärkung bei Start" CURVE 0x81130D GklWUb 0.3891 fak_q0p00153 0.00 0.3891
 /begin AXIS_DESCR COM_AXIS dn_w nmot_sw_q0p25 10 -8192.000 8191.750 AXIS_PTS_REF SDN10LLSW /end AXIS_DESCR
/end CHARACTERISTIC
/begin CHARACTERISTIC PVLDNEZ "LLR: P-Verstärkung bei stehendem Fahrzeug (Luftanteil)" MAP 0x811317 GkfWUb 0.3891 fak_q0p00153 0.00 0.3891
 /begin AXIS_DESCR COM_AXIS dn_w nmot_sw_q0p25 10 -8192.000 8191.750 AXIS_PTS_REF SDN10LLSW /end AXIS_DESCR
 /begin AXIS_DESCR COM_AXIS etazws rel_ub_b127p5 4 0.00 127.5 AXIS_PTS_REF SEZ04LLUB /end AXIS_DESCR
/end CHARACTERISTIC
/begin CHARACTERISTIC PVLDNEZKH "P-Anteil der LLR auf dem Luftpfad bei Katheizen" MAP 0x81133F GkfWUb 0.3891 fak_q0p00153 0.00 0.3891
 /begin AXIS_DESCR COM_AXIS dn_w nmot_sw_q0p25 10 -8192.000 8191.750 AXIS_PTS_REF SDN10LLSW /end AXIS_DESCR
 /begin AXIS_DESCR COM_AXIS etazws rel_ub_b127p5 4 0.00 127.5 AXIS_PTS_REF SEZ04LLUB /end AXIS_DESCR
/end CHARACTERISTIC
/begin CHARACTERISTIC PVLDNEZV "LLR: P-Verstärkung bei stehendem Fahrzeug (Luftanteil)" MAP 0x811367 GkfWUb 0.3891 fak_q0p00153 0.00 0.3891
 /begin AXIS_DESCR COM_AXIS dn_w nmot_sw_q0p25 10 -8192.000 8191.750 AXIS_PTS_REF SDN10LLSW /end AXIS_DESCR
 /begin AXIS_DESCR COM_AXIS etazws rel_ub_b127p5 4 0.00 127.5 AXIS_PTS_REF SEZ04LLUB /end AXIS_DESCR
/end CHARACTERISTIC
/begin CHARACTERISTIC REFINI "Startwert Referenzpegel bei Klopfregelung aktiv" VALUE 0x8111C1 KwUb 0.7227 spg_ub_b5 0.2930 1.016 FORMAT "%5.3" /end CHARACTERISTIC
/begin CHARACTERISTIC RKATMN "untere Schwelle additive Korrektur pro Zeit" VALUE 0x81D076 KwSw 383.9941 rel_sw_b192 -192.0000 191.9941 FORMAT "%8.4" /end CHARACTERISTIC
/begin CHARACTERISTIC RKATMX "obere Schwelle additive Korrektur pro Zeit" VALUE 0x81D078 KwSw 383.9941 rel_sw_b192 -192.0000 191.9941 FORMAT "%8.4" /end CHARACTERISTIC
/begin CHARACTERISTIC RKATRN "reduzierte untere Schwelle additive Korrektur pro Zeit" VALUE 0x81D07A KwSw 383.9941 rel_sw_b192 -192.0000 191.9941 FORMAT "%8.4" /end CHARACTERISTIC
/begin CHARACTERISTIC RKATRX "reduzierte obere Schwelle additive Korrektur pro Zeit" VALUE 0x81D07C KwSw 383.9941 rel_sw_b192 -192.0000 191.9941 FORMAT "%8.4" /end CHARACTERISTIC
/begin CHARACTERISTIC RKAZMN "untere Schwelle additive Korrektur pro Zündung" VALUE 0x81D07E KwSw 383.9941 rel_sw_b192 -192.0000 191.9941 FORMAT "%8.4" /end CHARACTERISTIC
/begin CHARACTERISTIC RKAZMX "obere Schwelle additive Korrektur pro Zündung" VALUE 0x81D080 KwSw 383.9941 rel_sw_b192 -192.0000 191.9941 FORMAT "%8.4" /end CHARACTERISTIC
/begin CHARACTERISTIC RKAZRN "reduzierte untere Schwelle additive Korrektur pro Zündung" VALUE 0x81D082 KwSw 383.9941 rel_sw_b192 -192.0000 191.9941 FORMAT "%8.4" /end CHARACTERISTIC
/begin CHARACTERISTIC RKAZRX "reduzierte obere Schwelle additive Korrektur pro Zündung" VALUE 0x81D084 KwSw 383.9941 rel_sw_b192 -192.0000 191.9941 FORMAT "%8.4" /end CHARACTERISTIC
/begin CHARACTERISTIC RKRMX1N "Maximaler Referenzpegel für Klopferkennungsschwelle Zyl.-gruppe 1" CURVE 0x81980E GklWUb 317.5 spg_ub_b320 1.250 318.8 FORMAT "%5.1"
 /begin AXIS_DESCR COM_AXIS nmot nmot_ub_q40 16 0.00 10200. AXIS_PTS_REF SNM16KRUB /end AXIS_DESCR
/end CHARACTERISTIC
/begin CHARACTERISTIC RKRMX2N "Maximaler Referenzpegel für Klopferkennungsschwelle Zyl.-gruppe 2" CURVE 0x81981E GklWUb 317.5 spg_ub_b320 1.250 318.8 FORMAT "%5.1"
 /begin AXIS_DESCR COM_AXIS nmot nmot_ub_q40 16 0.00 10200. AXIS_PTS_REF SNM16KRUB /end AXIS_DESCR
/end CHARACTERISTIC
/begin CHARACTERISTIC RLKRLDA "Rl-Schwelle für langsamen LDR-Eingriff (Adaption)" CURVE 0x819A30 GklWUb 191.3 rel_ub_q0p75 0.00 191.3 FORMAT "%5.1"
 /begin AXIS_DESCR COM_AXIS nmot nmot_ub_q40 8 0.00 10200. AXIS_PTS_REF SNM08LDUB /end AXIS_DESCR
/end CHARACTERISTIC
/begin CHARACTERISTIC RLLAMMN "RL-min Schwelle zur Anfettung wegen Brennbarkeit" CURVE 0x81908D GklWUb 191.3 rel_ub_q0p75 0.00 191.3 FORMAT "%5.1"
 /begin AXIS_DESCR COM_AXIS nmot nmot_ub_q40 6 0.00 10200. AXIS_PTS_REF SNM06GKUB /end AXIS_DESCR
/end CHARACTERISTIC
/begin CHARACTERISTIC RLO2 "obere Lastschwelle Bereich 2" VALUE 0x818E02 KwUb 191.3 rel_ub_q0p75 0.00 191.3 FORMAT "%5.1" /end CHARACTERISTIC
/begin CHARACTERISTIC RLO3 "obere rl - Schwelle Bereich 3" VALUE 0x818E03 KwUb 191.3 rel_ub_q0p75 0.00 191.3 FORMAT "%5.1" /end CHARACTERISTIC
/begin CHARACTERISTIC RLO3AC "obere rl - Schwelle Bereich 3 mit kompressor" VALUE 0x818E04 KwUb 191.3 rel_ub_q0p75 0.00 191.3 FORMAT "%5.1" /end CHARACTERISTIC
/begin CHARACTERISTIC RLU2 "untere rl - Schwelle Bereich 2" VALUE 0x818E05 KwUb 191.3 rel_ub_q0p75 0.00 191.3 FORMAT "%5.1" /end CHARACTERISTIC
/begin CHARACTERISTIC RLU2AC "untere rl - Schwelle Bereich 2 mit Kompressor" VALUE 0x818E06 KwUb 191.3 rel_ub_q0p75 0.00 191.3 FORMAT "%5.1" /end CHARACTERISTIC
/begin CHARACTERISTIC RLU2FA "untere rl-Schwelle Bereich 2 bei Funktionsanforderung (B_falra)" VALUE 0x818E07 KwUb 191.3 rel_ub_q0p75 0.00 191.3 FORMAT "%5.1" /end CHARACTERISTIC
/begin CHARACTERISTIC RLU3 "untere rl - Schwelle Bereich 3" VALUE 0x818E08 KwUb 191.3 rel_ub_q0p75 0.00 191.3 FORMAT "%5.1" /end CHARACTERISTIC
/begin CHARACTERISTIC RLU4 "untere rl -Schwelle oberer multiplikativer Bereich" VALUE 0x818E09 KwUb 191.3 rel_ub_q0p75 0.00 191.3 FORMAT "%5.1" /end CHARACTERISTIC
/begin CHARACTERISTIC RLU4AC "untere rl -Schwelle oberer multiplikativer Bereich mit Kompressor" VALUE 0x818E0A KwUb 191.3 rel_ub_q0p75 0.00 191.3 FORMAT "%5.1" /end CHARACTERISTIC
/begin CHARACTERISTIC SDKSUA "wped Schwelle für dynamische Schubumluftventilsteuerung aktiv" CURVE 0x815D02 KlAUbSstUbWUb 100.0 relPED_ub_b100 0.00 100.0 FORMAT "%5.1"
 /begin AXIS_DESCR STD_AXIS nmot nmot_ub_q40 6 0.00 10200. FORMAT "%5.0" DEPOSIT ABSOLUTE /end AXIS_DESCR
/end CHARACTERISTIC
/begin AXIS_PTS SDN10LLSW "Stützstellenverteilung Addressierung Leerlaufregelparameter" 0x816040 dn_w SstASwSstSw 16383.75 nmot_sw_q0p25 10 -8192.000 8191.750 FORMAT "%8.3" DEPOSIT ABSOLUTE /end AXIS_PTS
/begin AXIS_PTS SDZ06GKUB "Stützstellen KFLAMKRL" 0x819093 dzwlamfaw SstAUbSstUb 191.3 zw_ub_qn0p75 6 -191.3 0.00 FORMAT "%5.1" DEPOSIT ABSOLUTE /end AXIS_PTS
/begin AXIS_PTS SEZ04LLUB "Stützstellenverteilung Zündwinkelwirkungsgrad für PD-Regler" 0x81138F etazws SstAUbSstUb 127.5 rel_ub_b127p5 4 0.00 127.5 FORMAT "%5.1" DEPOSIT ABSOLUTE /end AXIS_PTS
/begin AXIS_PTS SLD04LDUB "Stützstellenverteilung für Ladedruckregelung" 0x810070 lde SstAUbSstUb 2550. p_sb_q10 4 0.00 2550. FORMAT "%5.0" DEPOSIT ABSOLUTE /end AXIS_PTS
/begin AXIS_PTS SMI04LLUB "Stützstellenverteilung: ind. Moment für Momentenreserve" 0x81304A mifa_w SstAUwSstUw 99.99847 rel_uw_b100 4 0.00 99.99847 FORMAT "%8.5" DEPOSIT ABSOLUTE /end AXIS_PTS
/begin AXIS_PTS SNG06LLSB "Stützstellenverteilung Drehzahlgradient, 6 Sst." 0x810075 ngfil SstAUbSstSb 25500. nmotg_sb_q100 6 -12800. 12700. FORMAT "%5.0" DEPOSIT ABSOLUTE /end AXIS_PTS
/begin AXIS_PTS SNM06GKUB "Stützstellen KFLAMKR, DLAMOB" 0x818215 nmot SstAUbSstUb 10200. nmot_ub_q40 6 0.00 10200. FORMAT "%5.0" DEPOSIT ABSOLUTE /end AXIS_PTS
/begin AXIS_PTS SNM06LLUB "Sützstellenverteilung für Motordrehzahl" 0x813060 nmot_w SstAUwSstUw 16383.75 nmot_uw_q0p25 6 0.00 16383.75 FORMAT "%8.2" DEPOSIT ABSOLUTE /end AXIS_PTS
/begin AXIS_PTS SNM08LDUB "Stützstellenverteilung für Ladedruckregelung" 0x810085 nmot SstAUbSstUb 10200. nmot_ub_q40 8 0.00 10200. FORMAT "%5.0" DEPOSIT ABSOLUTE /end AXIS_PTS
/begin AXIS_PTS SNM08LDUW "Stützstellenverteilung für Ladedruckregelung" 0x81307E nmot_w SstAUwSstUw 16383.75 nmot_uw_q0p25 8 0.00 16383.75 FORMAT "%8.2" DEPOSIT ABSOLUTE /end AXIS_PTS
/begin AXIS_PTS SNM12LDUW "Stützstellenverteilung für Ladedruckregelung" 0x813090 nmot_w SstAUwSstUw 16383.75 nmot_uw_q0p25 12 0.00 16383.75 FORMAT "%8.2" DEPOSIT ABSOLUTE /end AXIS_PTS
/begin AXIS_PTS SNM16GKUB "Stützstellenverteilung Gemischkontrolle 16 nmot Stützstellen" 0x8193EF nmot SstAUbSstUb 10200. nmot_ub_q40 16 0.00 10200. FORMAT "%5.0" DEPOSIT ABSOLUTE /end AXIS_PTS
/begin AXIS_PTS SNM16KRUB "Stützstellenverteilung Drehzahl, 16 Sst." 0x81826C nmot SstAUbSstUb 10200. nmot_ub_q40 16 0.00 10200. FORMAT "%5.0" DEPOSIT ABSOLUTE /end AXIS_PTS
/begin AXIS_PTS SNM16LDUB "Stützstellenverteilung für Ladedruckregelung" 0x8100BC nmot SstAUbSstUb 10200. nmot_ub_q40 16 0.00 10200. FORMAT "%5.0" DEPOSIT ABSOLUTE /end AXIS_PTS
/begin AXIS_PTS SNM16LDUW "Stützstellenverteilung für Ladedruckregelung" 0x8130AA nmot_w SstAUwSstUw 16383.75 nmot_uw_q0p25 16 0.00 16383.75 FORMAT "%8.2" DEPOSIT ABSOLUTE /end AXIS_PTS
/begin AXIS_PTS SNS06LLSB "Stützstellenvert., Solldrehzahlabw., 06 Sst., LL-Regel." 0x811289 dns SstAUbSstSb 2550. nmotd_sb_q10 6 -1280. 1270. FORMAT "%5.0" DEPOSIT ABSOLUTE /end AXIS_PTS
/begin AXIS_PTS SNS206LLSB "" 0x811394 dns SstAUbSstSb 2550. nmotd_sb_q10 6 -1280. 1270. FORMAT "%5.0" DEPOSIT ABSOLUTE /end AXIS_PTS
/begin AXIS_PTS SPL08LDUW "Stützstellenverteilung für Ladedruckregelung" 0x81F0BA plsolr_w SstAUbSstUw 2559.961 p_uw_q0p039 8 0.00 2559.961 FORMAT "%8.3" DEPOSIT ABSOLUTE /end AXIS_PTS
/begin AXIS_PTS SPU08LDUB "Stützstellenverteilung für Ladedruckregelung" 0x8100CD pu SstAUbSstUb 1275. p_ub_q5 8 0.00 1275. FORMAT "%5.0" DEPOSIT ABSOLUTE /end AXIS_PTS
/begin CHARACTERISTIC SRKTEVS "Saugrohrkonstante bei Schließen des Tankentlüftungsventil" VALUE 0x81139B KwUb 5.080 t20msxs_ub_b5p1 0.02000 5.100 FORMAT "%5.3" /end CHARACTERISTIC
/begin AXIS_PTS SRL03KRUB "Stützstellenverteilung relative Füllung, 3 Sst." 0x81827D rl SstAUbSstUb 191.3 rel_ub_q0p75 3 0.00 191.3 FORMAT "%5.1" DEPOSIT ABSOLUTE /end AXIS_PTS
/begin AXIS_PTS SRL06GKUB "Stützstellen KFLAMKRL, KFLAFWL, KFLAMKR" 0x818286 rl SstAUbSstUb 191.3 rel_ub_q0p75 6 0.00 191.3 FORMAT "%5.1" DEPOSIT ABSOLUTE /end AXIS_PTS
/begin AXIS_PTS SRL12GKUW "Stützstellenverteilung Gemischkontrolle 12 rl_w Stützstellen" 0x81D2FA rl_w SstAUwSstUw 1535.977 rel_uw_q0p0234 12 0.00 1535.977 FORMAT "%8.3" DEPOSIT ABSOLUTE /end AXIS_PTS
/begin AXIS_PTS STA04LLUB "Stützstellenverteilung: tans für Momentenreserve" 0x81317C tans SstAUwSstUw 49151.25 temp_ub_q0p75_o48 4 -48.00000 49103.25 FORMAT "%8.2" DEPOSIT ABSOLUTE /end AXIS_PTS
/begin AXIS_PTS STA08LDUB "Stützstellenverteilung für Ladedruckregelung" 0x810104 tans SstAUbSstUb 191.3 temp_ub_q0p75_o48 8 -48.00 143.3 FORMAT "%5.1" DEPOSIT ABSOLUTE /end AXIS_PTS
/begin AXIS_PTS STA10LDUB "Stützstellenverteilung für Ladedruckregelung" 0x819A38 tans SstAUbSstUb 191.3 temp_ub_q0p75_o48 10 -48.00 143.3 FORMAT "%5.1" DEPOSIT ABSOLUTE /end AXIS_PTS
/begin CHARACTERISTIC STLDIA1 "Stützstelle1 für LDR Adaptionskennlinie" VALUE 0x8199A6 KwUb 10200. nmot_ub_q40 0.00 10200. FORMAT "%5.0" /end CHARACTERISTIC
/begin CHARACTERISTIC STLDIA2 "Stützstelle2 für LDR Adaptionskennlinie" VALUE 0x8199A7 KwUb 10200. nmot_ub_q40 0.00 10200. FORMAT "%5.0" /end CHARACTERISTIC
/begin CHARACTERISTIC STLDIA3 "Stützstelle3 für LDR Adaptionskennlinie" VALUE 0x8199A8 KwUb 10200. nmot_ub_q40 0.00 10200. FORMAT "%5.0" /end CHARACTERISTIC
/begin CHARACTERISTIC STLDIA4 "Stützstelle4 für LDR Adaptionskennlinie" VALUE 0x8199A9 KwUb 10200. nmot_ub_q40 0.00 10200. FORMAT "%5.0" /end CHARACTERISTIC
/begin AXIS_PTS STM04SAUB "Stützstellenverteilung Motortemperatur, 4 Sst." 0x81011F tmot SstAUbSstUb 191.3 temp_ub_q0p75_o48 4 -48.00 143.3 FORMAT "%5.1" DEPOSIT ABSOLUTE /end AXIS_PTS
/begin AXIS_PTS STM06LLUB "Stützstellenverteilung Motortemperatur, 6 Sst." 0x8182C5 tmot SstAUbSstUb 191.3 temp_ub_q0p75_o48 6 -48.00 143.3 FORMAT "%5.1" DEPOSIT ABSOLUTE /end AXIS_PTS
/begin AXIS_PTS STM08GKUB "8 Motortemperaturstützstellen für KFLAFWL" 0x8182D3 tmot SstAUbSstUb 191.3 temp_ub_q0p75_o48 8 -48.00 143.3 FORMAT "%5.1" DEPOSIT ABSOLUTE /end AXIS_PTS
/begin AXIS_PTS STM12ESUB "SST-Verteilung für die Motortemperatur tmot" 0x810136 tmot SstAUbSstUb 191.3 temp_ub_q0p75_o48 12 -48.00 143.3 FORMAT "%5.1" DEPOSIT ABSOLUTE /end AXIS_PTS
/begin AXIS_PTS STN06LLUB "Stützstellenverteilung: Zeit nach Start; für Drehzahlverlauf nach Start" 0x8182FA tnst SstAUbSstUb 255.0 t1sxs_ub_b255 6 0.00 255.0 FORMAT "%5.1" DEPOSIT ABSOLUTE /end AXIS_PTS
/begin AXIS_PTS STV10LDSW "Stützstellenverteilung für Ladedruckregelung" 0x81F0CC ldtvr_w SstAUbSstSw 327.6750 tv_sw_q0p005 10 -163.8400 163.8350 FORMAT "%8.4" DEPOSIT ABSOLUTE /end AXIS_PTS
/begin CHARACTERISTIC SVDLDUVS "Schwelle Verdichterdruckverhältnis für LDR Umluftventilsteuerung" CURVE 0x81EBF0 KlAUbSstUbWUb 3.984 fak_ub_b4 0.00 3.984 FORMAT "%5.3"
 /begin AXIS_DESCR STD_AXIS nmot nmot_ub_q40 16 0.00 10200. FORMAT "%5.0" DEPOSIT ABSOLUTE /end AXIS_DESCR
/end CHARACTERISTIC
/begin AXIS_PTS SVP12LDUW "Stützstellenverteilung für vpssplg bei LDR" 0x813186 vpssplg_w SstAUwSstUw 3.999939 fak_uw_b4 12 0.00 3.999939 FORMAT "%8.6" DEPOSIT ABSOLUTE /end AXIS_PTS
/begin AXIS_PTS SWK08LDUW "Stützstellenverteilung für Ladedruckregelung" 0x81F6AE wkrmstat_w SstAUbSstUw 12287.81 zw_q0p1875 8 0.00 12287.81 FORMAT "%8.2" DEPOSIT ABSOLUTE /end AXIS_PTS
/begin AXIS_PTS SWK108LDUW "Stützstellenverteilung für Ladedruckregelung" 0x81F6C0 wkrmdy_w SstAUbSstUw 12287.81 zw_q0p1875 8 0.00 12287.81 FORMAT "%8.2" DEPOSIT ABSOLUTE /end AXIS_PTS
/begin AXIS_PTS SWK208LDUW "Stützstellenverteilung für Ladedruckregelung" 0x81F6D2 wkrmsu_w SstAUbSstUw 12287.81 zw_q0p1875 8 0.00 12287.81 FORMAT "%8.2" DEPOSIT ABSOLUTE /end AXIS_PTS
/begin CHARACTERISTIC TABGBTS "Abgastemperaturschwelle für Bauteileschutz" VALUE 0x81D314 KwUw 1279.980 temp_uw_q0p0195_o50 -50.00000 1229.980 FORMAT "%8.3" /end CHARACTERISTIC
/begin CHARACTERISTIC TABLDOBN "Abregelzeit für LDR-Overboost" CURVE 0x819A04 GklWUb 12.7498039 zk50msxs_ub_b12p8 0.0501960784 12.8000000 FORMAT "%10.7"
 /begin AXIS_DESCR COM_AXIS nmot nmot_ub_q40 8 0.00 10200. AXIS_PTS_REF SNM08LDUB /end AXIS_DESCR
/end CHARACTERISTIC
/begin CHARACTERISTIC TAHLL "Ansauglufttemperaturschwelle für erhöhte Solldrehzahl im Heiß-Leerlauf" VALUE 0x811290 KwUb 191.3 temp_ub_q0p75_o48 -48.00 143.3 FORMAT "%5.1" /end CHARACTERISTIC
/begin CHARACTERISTIC TALDUVSE "Zeit bis zur Aktivierung LDR Umluftventilsteuerung nach Startende" VALUE 0x81EC12 KwUw 3276.750 t50msxs_uw_b3276p75 0.00 3276.750 FORMAT "%8.3" /end CHARACTERISTIC
/begin CHARACTERISTIC TANUVMN "Ansaugluft-Temperaturschwelle für Ansteuerung des Schubumluftventils" VALUE 0x811246 KwUb 191.3 temp_ub_q0p75_o48 -48.00 143.3 FORMAT "%5.1" /end CHARACTERISTIC
/begin CHARACTERISTIC TARA "Temperaturschwelle Ansaugluft" VALUE 0x811199 KwUb 191.3 temp_ub_q0p75_o48 -48.00 143.3 FORMAT "%5.1" /end CHARACTERISTIC
/begin CHARACTERISTIC TDLAMBTS "einmalige Verzögerungszeit für Freigabe Lambda-Bauteileschutz" VALUE 0x81D316 KwUw 6553.500 t100msxs_uw_b6553p5 0.00 6553.500 FORMAT "%8.3" /end CHARACTERISTIC
/begin CHARACTERISTIC TDMRESLL "Sperrzeit für die erhöhte Momentenreserve nach dem Start" VALUE 0x819CD6 KwUb 51.00 t200msxs_ub_b51 0.00 51.00 FORMAT "%5.2" /end CHARACTERISTIC
/begin CHARACTERISTIC TDPDK "Zeitkonstante Abregelung für Faktor fmvp_w" VALUE 0x815F50 KwUw 655.34999985 zk10msxs_uw_b655 0.010000152590 655.36000000 FORMAT "%12.8" /end CHARACTERISTIC
/begin CHARACTERISTIC TGAALTWR "Zeit Zeitkonstante fürs Rücksetzen  der Gemischkorrektur auf letzten Tripwert" VALUE 0x81D086 KwUw 4.999924 zk200msxs_uw_b5 0.00 4.999924 FORMAT "%8.6" /end CHARACTERISTIC
/begin CHARACTERISTIC THLDUVD "Haltezeit LDR Umluftventilsteuerung dynamisch" VALUE 0x81EC14 KwUw 3276.750 t50msxs_uw_b3276p75 0.00 3276.750 FORMAT "%8.3" /end CHARACTERISTIC
/begin CHARACTERISTIC TIKATBTS "Temperaturschwelle im Kat für Bauteileschutz" VALUE 0x81D318 KwUw 1279.980 temp_uw_q0p0195_o50 -50.00000 1229.980 FORMAT "%8.3" /end CHARACTERISTIC
/begin CHARACTERISTIC TKATBTS "Kat-Temperaturschwelle für Bauteileschutz" VALUE 0x81D31A KwUw 1279.980 temp_uw_q0p0195_o50 -50.00000 1229.980 FORMAT "%8.3" /end CHARACTERISTIC
/begin CHARACTERISTIC TKFTARX "Verzögerungszeit frxta" VALUE 0x81F6E4 KwUw 3276.7499992 zk50msxs_uw_b3276p8 0.050000762951 3276.8000000 FORMAT "%12.7" /end CHARACTERISTIC
/begin CHARACTERISTIC TLAFA "Vezögerungszeit bis Lambda Fahrerwunsch aktiv" VALUE 0x81909A KwUb 25.50 t100msxs_ub_b25p5 0.00 25.50 FORMAT "%5.2" /end CHARACTERISTIC
/begin CHARACTERISTIC TLAMFAS "Vezögerungszeit bis Lambda Fahrerwunsch in der Höhe aktiv" VALUE 0x81D178 KwUw 65535.00 t1sxs_uw_q1 0.00 65535.00 FORMAT "%8.2" /end CHARACTERISTIC
/begin CHARACTERISTIC TLDIAN "Entprellzeit für Nachführung I-Adaption negativ" VALUE 0x8199AA KwUb 12.75 t50msxs_ub_b12p75 0.00 12.75 FORMAT "%5.2" /end CHARACTERISTIC
/begin CHARACTERISTIC TLDIAPN "Entprellzeit für Nachführung I-Adaption positiv" CURVE 0x8199AB GklWUb 12.75 t50msxs_ub_b12p75 0.00 12.75 FORMAT "%5.2"
 /begin AXIS_DESCR COM_AXIS nmot nmot_ub_q40 8 0.00 10200. AXIS_PTS_REF SNM08LDUB /end AXIS_DESCR
/end CHARACTERISTIC
/begin CHARACTERISTIC TLDOBAN "Zeit für LDR-Overboost aktiv" CURVE 0x819A0C GklWUb 255.0 t1sxs_ub_b255 0.00 255.0 FORMAT "%5.1"
 /begin AXIS_DESCR COM_AXIS nmot nmot_ub_q40 8 0.00 10200. AXIS_PTS_REF SNM08LDUB /end AXIS_DESCR
/end CHARACTERISTIC
/begin CHARACTERISTIC TLDOBN "Sperrzeit für LDR-Overboost" CURVE 0x819A14 GklWUb 12.75 t50msxs_ub_b12p75 0.00 12.75 FORMAT "%5.2"
 /begin AXIS_DESCR COM_AXIS nmot nmot_ub_q40 8 0.00 10200. AXIS_PTS_REF SNM08LDUB /end AXIS_DESCR
/end CHARACTERISTIC
/begin CHARACTERISTIC TLKRLDAB "Zeitkonstante für langsame LDR-Absenkung" CURVE 0x81F6E6 GklWUw 3276.7499992 zk50msxs_uw_b3276p8 0.050000762951 3276.8000000 FORMAT "%12.7"
 /begin AXIS_DESCR COM_AXIS nmot_w nmot_uw_q0p25 8 0.00 16383.75 AXIS_PTS_REF SNM08LDUW /end AXIS_DESCR
/end CHARACTERISTIC
/begin CHARACTERISTIC TLKRLDAU "Zeitkonstante für langsame LDR-Aufregelung" CURVE 0x81F6F6 GklWUw 3276.7499992 zk50msxs_uw_b3276p8 0.050000762951 3276.8000000 FORMAT "%12.7"
 /begin AXIS_DESCR COM_AXIS nmot_w nmot_uw_q0p25 8 0.00 16383.75 AXIS_PTS_REF SNM08LDUW /end AXIS_DESCR
/end CHARACTERISTIC
/begin CHARACTERISTIC TMEWRAA "Einschalttemperatur LRA bezogen auf die modellierte Motortemperatur" VALUE 0x81909E KwUb 191.3 temp_ub_q0p75_o48 -48.00 143.3 FORMAT "%5.1" /end CHARACTERISTIC
/begin CHARACTERISTIC TMFRATMN "minimale Temperatur bei der ftklra_w = 1 ist" VALUE 0x818E0B KwUb 191.3 temp_ub_q0p75_o48 -48.00 143.3 FORMAT "%5.1" /end CHARACTERISTIC
/begin CHARACTERISTIC TMFRATUB "untere Temperaturschwelle  bei der ftklra_w Konstant bleibt" VALUE 0x818E0C KwUb 191.3 temp_ub_q0p75_o48 -48.00 143.3 FORMAT "%5.1" /end CHARACTERISTIC
/begin CHARACTERISTIC TMHLL "Motortemperaturschwelle für erhöhte Solldrehzahl im Heiß-Leerlauf" VALUE 0x811291 KwUb 191.3 temp_ub_q0p75_o48 -48.00 143.3 FORMAT "%5.1" /end CHARACTERISTIC
/begin CHARACTERISTIC TMKR "Motortemperaturschwelle für Klopfregelung aktiv" VALUE 0x819914 KwUb 191.3 temp_ub_q0p75_o48 -48.00 143.3 FORMAT "%5.1" /end CHARACTERISTIC
/begin CHARACTERISTIC TMKRA "Motortemperaturschwelle für adaptive Klopfregelung" VALUE 0x819915 KwUb 191.3 temp_ub_q0p75_o48 -48.00 143.3 FORMAT "%5.1" /end CHARACTERISTIC
/begin CHARACTERISTIC TMKRAS "Temperaturschwelle für Freigabe Schreibzugriffe auf Adaptions-KF" VALUE 0x819916 KwUb 191.3 temp_ub_q0p75_o48 -48.00 143.3 FORMAT "%5.1" /end CHARACTERISTIC
/begin CHARACTERISTIC TMLLX "Kochschutzschwelle" VALUE 0x819C63 KwUb 191.3 temp_ub_q0p75_o48 -48.00 143.3 FORMAT "%5.1" /end CHARACTERISTIC
/begin CHARACTERISTIC TMRAA "Einschalttemperatur LRA" VALUE 0x81909F KwUb 191.3 temp_ub_q0p75_o48 -48.00 143.3 FORMAT "%5.1" /end CHARACTERISTIC
/begin CHARACTERISTIC TMRZHLL "Motortemperaturschwelle für Reset des Zeitzählers für Heiß-Leerlauf" VALUE 0x811292 KwUb 191.3 temp_ub_q0p75_o48 -48.00 143.3 FORMAT "%5.1" /end CHARACTERISTIC
/begin CHARACTERISTIC TMSTFWMN "minimale Motorstarttemperatur für Deaktivierung Fahrerwunsch in der Höhe" VALUE 0x81909B KwUb 191.3 temp_ub_q0p75_o48 -48.00 143.3 FORMAT "%5.1" /end CHARACTERISTIC
/begin CHARACTERISTIC TMSTFWMX "maximale Motorstarttemperatur für Deaktivierung Fahrerwunsch in der Höhe" VALUE 0x81909C KwUb 191.3 temp_ub_q0p75_o48 -48.00 143.3 FORMAT "%5.1" /end CHARACTERISTIC
/begin CHARACTERISTIC TNSLFA "Filterzeitkonstante für nslfa" VALUE 0x819DA0 KwUb 5.08000 zk20msxs_ub_b5p1 0.0200000 5.10000 FORMAT "%7.5" /end CHARACTERISTIC
/begin CHARACTERISTIC TNSTFWMN "minimale Zeit nach Start für Deaktivierung Fahrerwunsch in der Höhe" VALUE 0x81D17A KwUw 655.3500 t10msxs_uw_b655p35 0.00 655.3500 FORMAT "%8.4" /end CHARACTERISTIC
/begin CHARACTERISTIC TNSTFWMX "maximale Zeit nach Start für Deaktivierung Fahrerwunsch in der Höhe" VALUE 0x81D17C KwUw 655.3500 t10msxs_uw_b655p35 0.00 655.3500 FORMAT "%8.4" /end CHARACTERISTIC
/begin CHARACTERISTIC TOELMX "Oeltemperaturschwelle fuer Motorschutz bei Getriebenotlauf" VALUE 0x819A43 KwUb 255.0 temp_ub_q1_o60 -60.00 195.0 FORMAT "%5.1" /end CHARACTERISTIC
/begin CHARACTERISTIC TOLEWRLMX "Ersatzwert Öltemperatur bei fehlerhafter CAN-Botschaft" VALUE 0x819A44 KwUb 255.0 temp_ub_q1_o60 -60.00 195.0 FORMAT "%5.1" /end CHARACTERISTIC
/begin CHARACTERISTIC TSKRLDAB "Zeitkonstante für schnelle LDR-Absenkung" CURVE 0x81F706 GklWUw 3276.7499992 zk50msxs_uw_b3276p8 0.050000762951 3276.8000000 FORMAT "%12.7"
 /begin AXIS_DESCR COM_AXIS nmot_w nmot_uw_q0p25 8 0.00 16383.75 AXIS_PTS_REF SNM08LDUW /end AXIS_DESCR
/end CHARACTERISTIC
/begin CHARACTERISTIC TSKRLDAU "Zeitkonstante für schnelle LDR-Aufregelung" CURVE 0x81F716 GklWUw 3276.7499992 zk50msxs_uw_b3276p8 0.050000762951 3276.8000000 FORMAT "%12.7"
 /begin AXIS_DESCR COM_AXIS nmot_w nmot_uw_q0p25 8 0.00 16383.75 AXIS_PTS_REF SNM08LDUW /end AXIS_DESCR
/end CHARACTERISTIC
/begin CHARACTERISTIC TSTLDOBA "Maximalzeit bis Start Overboost Aktiv Zeit" VALUE 0x819A1C KwUb 255.0 t1sxs_ub_b255 0.00 255.0 FORMAT "%5.1" /end CHARACTERISTIC
/begin CHARACTERISTIC TVDK "Verzögerungszeit nach Schließen der Drosselklappe" VALUE 0x811297 KwUb 5.100 t20msxs_ub_b5p1 0.00 5.100 FORMAT "%5.3" /end CHARACTERISTIC
/begin CHARACTERISTIC TVKRSTAT "Verzögerungszeit KR stationär Betrieb" VALUE 0x8111E6 KwUb 25.50 t100msxs_ub_b25p5 0.00 25.50 FORMAT "%5.2" /end CHARACTERISTIC
/begin CHARACTERISTIC TVKUPPL "Verzögerungszeit für die Information des Kupplungsschalter" VALUE 0x811298 KwUb 5.100 t20msxs_ub_b5p1 0.00 5.100 FORMAT "%5.3" /end CHARACTERISTIC
/begin CHARACTERISTIC TVLDMN "Untere Tastverhältnisbegrenzung für LDR" VALUE 0x819AC8 KwUb 99.61 tv_ub_b100 0.00 99.61 FORMAT "%5.2" /end CHARACTERISTIC
/begin CHARACTERISTIC TVLDMX "Obere Tastverhältnisbegrenzung für LDR" VALUE 0x81F0E2 KwSw 327.6750 tv_sw_q0p005 -163.8400 163.8350 FORMAT "%8.4" /end CHARACTERISTIC
/begin CHARACTERISTIC TVLDOBSO "Verzögerungszeit für Abbruch Haltephase" VALUE 0x819A1D KwUb 12.75 t50msxs_ub_b12p75 0.00 12.75 FORMAT "%5.2" /end CHARACTERISTIC
/begin CHARACTERISTIC TVLISTU "Verbotszeit für negativen Integratoranteil nach Start" VALUE 0x81139C KwUb 5.100 t20msxs_ub_b5p1 0.00 5.100 FORMAT "%5.3" /end CHARACTERISTIC
/begin CHARACTERISTIC TVLLRI "Verzögerungszeit für Freigabe I-Anteil nach Start" CURVE 0x811299 KlAUbSstUbWUb 5.100 t20msxs_ub_b5p1 0.00 5.100 FORMAT "%5.3"
 /begin AXIS_DESCR STD_AXIS tmot temp_ub_q0p75_o48 6 -48.00 143.3 FORMAT "%5.1" DEPOSIT ABSOLUTE /end AXIS_DESCR
/end CHARACTERISTIC
/begin CHARACTERISTIC TVLLRPD "Maximale Verzögerungszeit für Freigabe PD-Anteil nach Start" CURVE 0x8112A6 KlAUbSstUbWUb 5.100 t20msxs_ub_b5p1 0.00 5.100 FORMAT "%5.3"
 /begin AXIS_DESCR STD_AXIS tmot temp_ub_q0p75_o48 6 -48.00 143.3 FORMAT "%5.1" DEPOSIT ABSOLUTE /end AXIS_DESCR
/end CHARACTERISTIC
/begin CHARACTERISTIC TVLLRPST "Zeitverzögerung nach Start zum Deaktivieren der P-Verstärkung im Start" VALUE 0x81139D KwUb 51.00 t200msxs_ub_b51 0.00 51.00 FORMAT "%5.2" /end CHARACTERISTIC
/begin CHARACTERISTIC TVLRA "Verzögerungszeit für Aktivierung Gemischadaption nach Lambdaregelung aktiv" VALUE 0x8190A0 KwUb 25.40 t100msxs_ub_b25p5 0.1000 25.50 FORMAT "%5.2" /end CHARACTERISTIC
/begin CHARACTERISTIC TVPKH "Zeitverzögerung: P-Verstärkung bei Katheizen aktiv" VALUE 0x816056 KwUw 13107.00 t200msxs_uw_q0p2 0.00 13107.00 FORMAT "%8.2" /end CHARACTERISTIC
/begin CHARACTERISTIC TVRESLL "Haltezeit für die erhöhte Momentenrerserve nach Drehzahleinbruch" VALUE 0x819CD7 KwUb 51.00 t200msxs_ub_b51 0.00 51.00 FORMAT "%5.2" /end CHARACTERISTIC
/begin CHARACTERISTIC UEFKTGETU "untere Schwelle  fktget für Aktivierung von KFTARXB" VALUE 0x819A45 KwUb 25.50 uefktget_ub_b25p4 0.00 25.50 FORMAT "%5.2" /end CHARACTERISTIC
/begin CHARACTERISTIC UMDYLDR "Umschaltschwelle Dynamik LDR" VALUE 0x8199B3 KwSb 2550. p_sb_q10 -1280. 1270. FORMAT "%5.0" /end CHARACTERISTIC
/begin CHARACTERISTIC VANF "Geschwindigkeitsschwelle für Anfahrhilfe" VALUE 0x81148F KwUb 318.8 vfzg_ub_q1p25 0.00 318.8 FORMAT "%5.1" /end CHARACTERISTIC
/begin CHARACTERISTIC VLLR "Fahrzeuggeschwindigkeitsschwelle für Leerlaufregelung" VALUE 0x8112B3 KwUb 318.8 vfzg_ub_q1p25 0.00 318.8 FORMAT "%5.1" /end CHARACTERISTIC
/begin CHARACTERISTIC VSL "Fahrzeuggeschwindigkeitsschwelle für Kompensation Servolenkung" VALUE 0x819C64 KwUb 318.8 vfzg_ub_q1p25 0.00 318.8 FORMAT "%5.1" /end CHARACTERISTIC
/begin CHARACTERISTIC WDKARN "DK-Winkel-Schwelle für Gemischadaption aktiv" CURVE 0x8190A1 KlAUbSstUbWUb 100.0 relDK_ub_b100 0.00 100.0 FORMAT "%5.1"
 /begin AXIS_DESCR STD_AXIS nmot nmot_ub_q40 10 0.00 10200. FORMAT "%5.0" DEPOSIT ABSOLUTE /end AXIS_DESCR
/end CHARACTERISTIC
/begin CHARACTERISTIC WFAN "Schwellwert für Fahrpedalwinkel bei Bandendetest" VALUE 0x819DA1 KwUb 100.0 relPED_ub_b100 0.00 100.0 FORMAT "%5.1" /end CHARACTERISTIC
/begin CHARACTERISTIC WKRLZOF "Festwerteblock: ZW-Offset für geführte Zylinder" VAL_BLK 0x8111E7 KwbUb 191.3 zw_ub_qn0p75 -191.3 0.00 FORMAT "%5.1" NUMBER 8 /end CHARACTERISTIC
/begin CHARACTERISTIC WKRLZOFEKS "ZW-Offset für geführte Zylinder bei KS-Fehler" VALUE 0x8111EF KwUb 191.3 zw_ub_qn0p75 -191.3 0.00 FORMAT "%5.1" /end CHARACTERISTIC
/begin CHARACTERISTIC ZDLBTS "Zeitkonstante Delta Lambda Bauteileschutz" VALUE 0x81D31C KwUw 6553.4999985 zk100msxs_uw_b6553 0.10000152590 6553.6000000 FORMAT "%12.7" /end CHARACTERISTIC
/begin CHARACTERISTIC ZFLASKH "Zeitkonstante für Übergang auf Lambda-Abgas-Vorgabe" VALUE 0x819628 KwUb 25.4996 zk100msxs_ub_b25p5 0.100392 25.6000 FORMAT "%7.4" /end CHARACTERISTIC
/begin CHARACTERISTIC ZFLLRPL "Zeitkonstante: Aufregeln des P-Anteils auf dem Luftpfad" VALUE 0x81139E KwUb 5.08000 zk20msxs_ub_b5p1 0.0200000 5.10000 FORMAT "%7.5" /end CHARACTERISTIC
/begin CHARACTERISTIC ZHLLA "Zeitzähler-Schwelle für Abbruch erhöhte Solldrehzahl im Heiß-Leerlauf" VALUE 0x811293 KwUb 255.0 t1sxs_ub_b255 0.00 255.0 FORMAT "%5.1" /end CHARACTERISTIC
/begin CHARACTERISTIC ZHLLE "Zeitzähler-Schwelle für erhöhte Solldrehzahl im Heiß-Leerlauf" VALUE 0x811294 KwUb 255.0 t1sxs_ub_b255 0.00 255.0 FORMAT "%5.1" /end CHARACTERISTIC
/begin CHARACTERISTIC ZKFRAOA "Zeitkonstante für frao-Integrator, f(Anzahl Starts mit Ölverdünnung)" CURVE 0x81D088 KlAUwSstUwWUw 4.999924 zk200msxs_uw_b5 0.00 4.999924 FORMAT "%8.6"
 /begin AXIS_DESCR STD_AXIS abo dez 3 0.00 65535.00 FORMAT "%8.2" DEPOSIT ABSOLUTE /end AXIS_DESCR
/end CHARACTERISTIC
/begin CHARACTERISTIC ZKFRAUA "Zeitkonstante für frau-Integrator, f(Anzahl Stats mit Ölverdünnung)" CURVE 0x81D096 KlAUwSstUwWUw 4.999924 zk200msxs_uw_b5 0.00 4.999924 FORMAT "%8.6"
 /begin AXIS_DESCR STD_AXIS abo dez 3 0.00 65535.00 FORMAT "%8.2" DEPOSIT ABSOLUTE /end AXIS_DESCR
/end CHARACTERISTIC
/begin CHARACTERISTIC ZKLAMFAW "Zeitkonstante Filterung Anfettung durch Fahrerwunsch" VALUE 0x81D17E KwUw 6553.4999985 zk100msxs_uw_b6553 0.10000152590 6553.6000000 FORMAT "%12.7" /end CHARACTERISTIC
/begin CHARACTERISTIC ZKLLRD "Zeitkonstante für die Abregelung des D-Anteils" VALUE 0x81139F KwUb 5.08000 zk20msxs_ub_b5p1 0.0200000 5.10000 FORMAT "%7.5" /end CHARACTERISTIC
/begin CHARACTERISTIC ZKNS "Zeitkonstante für Solldrehzahl bei Umschaltung" VALUE 0x819C65 KwUb 5.08000 zk20msxs_ub_b5p1 0.0200000 5.10000 FORMAT "%7.5" /end CHARACTERISTIC
/begin CHARACTERISTIC ZKRKATA "Integrationsgeschwindigkeit Integrator rkat, f(abo)" CURVE 0x81D0A4 KlAUwSstUwWUw 959.9854 zk200msxs_uw_b960 0.00 959.9854 FORMAT "%8.4"
 /begin AXIS_DESCR STD_AXIS abo dez 3 0.00 65535.00 FORMAT "%8.2" DEPOSIT ABSOLUTE /end AXIS_DESCR
/end CHARACTERISTIC
/begin CHARACTERISTIC ZKRKAZA "Integrationsgeschwindigkeit Integrator rkaz, f(abo)" CURVE 0x81D0B2 KlAUwSstUwWUw 959.9854 zk200msxs_uw_b960 0.00 959.9854 FORMAT "%8.4"
 /begin AXIS_DESCR STD_AXIS abo dez 3 0.00 65535.00 FORMAT "%8.2" DEPOSIT ABSOLUTE /end AXIS_DESCR
/end CHARACTERISTIC
/begin CHARACTERISTIC ZKWLAFWL "Zeitkonstante Wichtung Offset Lambda-Motor-Soll" VALUE 0x81909D KwUb 25.4996 zk100msxs_ub_b25p5 0.100392 25.6000 FORMAT "%7.4" /end CHARACTERISTIC
/begin CHARACTERISTIC ZLBTS "Zeitkonstante Lambda Bauteileschutz" VALUE 0x81D31E KwUw 6553.4999985 zk100msxs_uw_b6553 0.10000152590 6553.6000000 FORMAT "%12.7" /end CHARACTERISTIC
/begin CHARACTERISTIC ZLBTSNEG "Zeitkonstante Lambda Bauteileschutz (abgesteuert)" VALUE 0x81D320 KwUw 6553.4999985 zk100msxs_uw_b6553 0.10000152590 6553.6000000 FORMAT "%12.7" /end CHARACTERISTIC
/begin CHARACTERISTIC ZLIBG "Filterzeitkonstante für die Nachführung der Integratorgrenzen" VALUE 0x8113A0 KwUb 5.08000 zk20msxs_ub_b5p1 0.0200000 5.10000 FORMAT "%7.5" /end CHARACTERISTIC
/begin CHARACTERISTIC ZNFNGLL "Filterzeitkonstante für Drehzahlgradient auf Luftpfad (LLR)" VALUE 0x8113A1 KwUb 5.08000 zk20msxs_ub_b5p1 0.0200000 5.10000 FORMAT "%7.5" /end CHARACTERISTIC
/begin CHARACTERISTIC ZNSUB "Zeitkonstante für Mindestsolldrehzahl bei Unterspannung" VALUE 0x819C66 KwUb 50.8000 zk200msxs_ub_b51p2 0.200000 51.0000 FORMAT "%7.4" /end CHARACTERISTIC
/begin CHARACTERISTIC ZRLFRAT "Filterzeitkonstante für die Berechnung der Zeitkonstante der FRAT-Adaption" VALUE 0x818E0D KwUb 3.72308 zk200msxs_ub_b51p2 0.200000 3.92308 FORMAT "%7.5" /end CHARACTERISTIC
/begin CHARACTERISTIC ZYRKR "Zylinderzuordnung für maximale Referenzpegelbegrenzung Klopfregelung" VALUE 0x81982E KwUb 255.0 dez 0.00 255.0 FORMAT "%5.1" /end CHARACTERISTIC
/begin MEASUREMENT B_brlmx "Bedingung LDR Begrenzung der Maximalfuellung" UWORD B_TRUE 1 100 0 1 BIT_MASK 0x20 FORMAT "%13.11" ECU_ADDRESS 0xFD82 /end MEASUREMENT
/begin MEASUREMENT B_c95_g0 "Ansteuerung der Verstärkerstufe des CC195 (PIN G0)" UWORD B_TRUE 1 100 0 1 BIT_MASK 0x800 FORMAT "%13.11" ECU_ADDRESS 0xFD70 /end MEASUREMENT
/begin MEASUREMENT B_c95_g1 "Ansteuerung der Verstärkerstufe des CC195 (Pin G1)" UWORD B_TRUE 1 100 0 1 BIT_MASK 0x1000 FORMAT "%13.11" ECU_ADDRESS 0xFD70 /end MEASUREMENT
/begin MEASUREMENT B_c95_g2 "Ansteuerung der Verstärkerstufe des CC195 (Pin G2)" UWORD B_TRUE 1 100 0 1 BIT_MASK 0x2000 FORMAT "%13.11" ECU_ADDRESS 0xFD70 /end MEASUREMENT
/begin MEASUREMENT B_dslafa "Anfoderung Kurztest oder Adaption in DSLSXXX" UBYTE B_TRUE 1 100 0 1 BIT_MASK 0x1 FORMAT "%13.11" ECU_ADDRESS 0x380A72 /end MEASUREMENT
/begin MEASUREMENT B_fanfg "Freigabebit für Drehzahlanforderung bei Bandendetest" UBYTE B_TRUE 1 100 0 1 BIT_MASK 0x1 FORMAT "%13.11" ECU_ADDRESS 0x380B17 /end MEASUREMENT
/begin MEASUREMENT B_frao "Einschaltbedingung für Adaption von frao" UWORD B_TRUE 1 100 0 1 BIT_MASK 0x4000 FORMAT "%13.11" ECU_ADDRESS 0xFD5A /end MEASUREMENT
/begin MEASUREMENT B_fraor "Bedingung frao-Integrator außerhalb reduzierter Bereich" UWORD B_TRUE 1 100 0 1 BIT_MASK 0x8000 FORMAT "%13.11" ECU_ADDRESS 0xFD5A /end MEASUREMENT
/begin MEASUREMENT B_frat "Einschaltbedingung für Adaption von frat" UWORD B_TRUE 1 100 0 1 BIT_MASK 0x1 FORMAT "%13.11" ECU_ADDRESS 0xFD5C /end MEASUREMENT
/begin MEASUREMENT B_frau "Einschaltbedingung für Adaption von frau" UWORD B_TRUE 1 100 0 1 BIT_MASK 0x2 FORMAT "%13.11" ECU_ADDRESS 0xFD5C /end MEASUREMENT
/begin MEASUREMENT B_fraur "Bedingung frau-Integrator außerhalb reduzierter Bereich" UWORD B_TRUE 1 100 0 1 BIT_MASK 0x4 FORMAT "%13.11" ECU_ADDRESS 0xFD5C /end MEASUREMENT
/begin MEASUREMENT B_gasp "Bedingung Grundadaption gesperrt" UWORD B_TRUE 1 100 0 1 BIT_MASK 0x4 FORMAT "%13.11" ECU_ADDRESS 0xFD62 /end MEASUREMENT
/begin MEASUREMENT B_hll "Bedingung Heißleerlauf" UWORD B_TRUE 1 100 0 1 BIT_MASK 0x1 FORMAT "%13.11" ECU_ADDRESS 0xFD84 /end MEASUREMENT
/begin MEASUREMENT B_kl "Bedingung für erkannte Klopfer" UWORD B_TRUE 1 100 0 1 BIT_MASK 0x4000 FORMAT "%13.11" ECU_ADDRESS 0xFD70 /end MEASUREMENT
/begin MEASUREMENT B_kldf "Drehzahlanhebung bei Generatorlast aktiv" UWORD B_TRUE 1 100 0 1 BIT_MASK 0x2 FORMAT "%13.11" ECU_ADDRESS 0xFD84 /end MEASUREMENT
/begin MEASUREMENT B_kr "Bedingung Klopregelung aktiv" UWORD B_TRUE 1 100 0 1 BIT_MASK 0x8000 FORMAT "%13.11" ECU_ADDRESS 0xFD70 /end MEASUREMENT
/begin MEASUREMENT B_kra "Bedingung KR-Adaption aktiv" UWORD B_TRUE 1 100 0 1 BIT_MASK 0x1 FORMAT "%13.11" ECU_ADDRESS 0xFD72 /end MEASUREMENT
/begin MEASUREMENT B_krafrz "Bedingung: KR-Adaption ist eingefroren" UWORD B_TRUE 1 100 0 1 BIT_MASK 0x2 FORMAT "%13.11" ECU_ADDRESS 0xFD72 /end MEASUREMENT
/begin MEASUREMENT B_krdws "Bedingung Klopfregelung Sicherheitsspätverstellung" UWORD B_TRUE 1 100 0 1 BIT_MASK 0x4 FORMAT "%13.11" ECU_ADDRESS 0xFD72 /end MEASUREMENT
/begin MEASUREMENT B_krfdks "Bedingung Freigabe Diagnose KS" UWORD B_TRUE 1 100 0 1 BIT_MASK 0x8 FORMAT "%13.11" ECU_ADDRESS 0xFD72 /end MEASUREMENT
/begin MEASUREMENT B_krfrz "Bedingung: KR ist eingefroren" UWORD B_TRUE 1 100 0 1 BIT_MASK 0x10 FORMAT "%13.11" ECU_ADDRESS 0xFD72 /end MEASUREMENT
/begin MEASUREMENT B_krlz "KR-Leitzylinderfunktion aktiv" UWORD B_TRUE 1 100 0 1 BIT_MASK 0x20 FORMAT "%13.11" ECU_ADDRESS 0xFD72 /end MEASUREMENT
/begin MEASUREMENT B_krlzn "Drehzahlschwelle für KR-Leitzylinderfunktion überschritten" UWORD B_TRUE 1 100 0 1 BIT_MASK 0x3fc0 FORMAT "%13.11" ECU_ADDRESS 0xFD72 /end MEASUREMENT
/begin MEASUREMENT B_krnl "Notlauf Klopferkennung bei Phasennotlauf und/oder Doppelzündung" UWORD B_TRUE 1 100 0 1 BIT_MASK 0x80 FORMAT "%13.11" ECU_ADDRESS 0xFD72 /end MEASUREMENT
/begin MEASUREMENT B_krnlr "Notlauf KR für V6, V8 mit 2 KS bei Fehler eines KS" UWORD B_TRUE 1 100 0 1 BIT_MASK 0x100 FORMAT "%13.11" ECU_ADDRESS 0xFD72 /end MEASUREMENT
/begin MEASUREMENT B_krstatb "Bedingung stationärer KR-Betrieb" UWORD B_TRUE 1 100 0 1 BIT_MASK 0x200 FORMAT "%13.11" ECU_ADDRESS 0xFD72 /end MEASUREMENT
/begin MEASUREMENT B_krvf "Bedingung für Abregelung der KR-ZW-Spätverstellung" UWORD B_TRUE 1 100 0 1 BIT_MASK 0x400 FORMAT "%13.11" ECU_ADDRESS 0xFD72 /end MEASUREMENT
/begin MEASUREMENT B_krwa "Klopfregelung am Anschlag" UWORD B_TRUE 1 100 0 1 BIT_MASK 0x800 FORMAT "%13.11" ECU_ADDRESS 0xFD72 /end MEASUREMENT
/begin MEASUREMENT B_kseb1 "Bedingung KS-Fehler Bank 1" UWORD B_TRUE 1 100 0 1 BIT_MASK 0x1000 FORMAT "%13.11" ECU_ADDRESS 0xFD72 /end MEASUREMENT
/begin MEASUREMENT B_kseb2 "Bedingung KS-Fehler Bank 2" UWORD B_TRUE 1 100 0 1 BIT_MASK 0x2000 FORMAT "%13.11" ECU_ADDRESS 0xFD72 /end MEASUREMENT
/begin MEASUREMENT B_kvakbi "Bedingung aufsummierter Kraftstoffverbrauch ist übergelaufen" UWORD B_TRUE 1 100 0 1 BIT_MASK 0x4000 FORMAT "%13.11" ECU_ADDRESS 0xFDAE /end MEASUREMENT
/begin MEASUREMENT B_lalgf "Bedingung Laufgrenze ""Lambda fett"" aktiv" UWORD B_TRUE 1 100 0 1 BIT_MASK 0x80 FORMAT "%13.11" ECU_ADDRESS 0xFD5A /end MEASUREMENT
/begin MEASUREMENT B_lambts "Lambda für Bauteileschutz ist aktiv" UWORD B_TRUE 1 100 0 1 BIT_MASK 0x100 FORMAT "%13.11" ECU_ADDRESS 0xFD5A /end MEASUREMENT
/begin MEASUREMENT B_lamfas "Verbot  für Lambda Fahrerwunsch Aktivierung" UWORD B_TRUE 1 100 0 1 BIT_MASK 0x4000 FORMAT "%13.11" ECU_ADDRESS 0xFD60 /end MEASUREMENT
/begin MEASUREMENT B_lamfasa "Höhenabhängige Sperrzeit für Lambda Fahrerwunsch angefordert" UWORD B_TRUE 1 100 0 1 BIT_MASK 0x8000 FORMAT "%13.11" ECU_ADDRESS 0xFD60 /end MEASUREMENT
/begin MEASUREMENT B_lamfash "Höhenabhängige Sperrzeit für Lambda Fahrerwunsch ist aktiv" UWORD B_TRUE 1 100 0 1 BIT_MASK 0x1 FORMAT "%13.11" ECU_ADDRESS 0xFD62 /end MEASUREMENT
/begin MEASUREMENT B_lamka "Lambda für Kat-Ausräumen aktiv" UWORD B_TRUE 1 100 0 1 BIT_MASK 0x200 FORMAT "%13.11" ECU_ADDRESS 0xFD5A /end MEASUREMENT
/begin MEASUREMENT B_lamkh "Bedingung Lambdasoll für Katheizen aktiv" UWORD B_TRUE 1 100 0 1 BIT_MASK 0x400 FORMAT "%13.11" ECU_ADDRESS 0xFD5A /end MEASUREMENT
/begin MEASUREMENT B_lamkhe "keine Lambdaanforderung seitens LAKH" UWORD B_TRUE 1 100 0 1 BIT_MASK 0x800 FORMAT "%13.11" ECU_ADDRESS 0xFD6E /end MEASUREMENT
/begin MEASUREMENT B_lamnswl "Lambda-Motor-Soll für Nachstart und Warmlauf aktiv" UWORD B_TRUE 1 100 0 1 BIT_MASK 0x800 FORMAT "%13.11" ECU_ADDRESS 0xFD5A /end MEASUREMENT
/begin MEASUREMENT B_lamsdef "Bedingung : definierte Soll-Lambda" UWORD B_TRUE 1 100 0 1 BIT_MASK 0x1000 FORMAT "%13.11" ECU_ADDRESS 0xFD5A /end MEASUREMENT
/begin MEASUREMENT B_lbts "Bedingung: Lambda<1 durch Bauteileschutz" UBYTE B_TRUE 1 100 0 1 BIT_MASK 0x40 FORMAT "%13.11" ECU_ADDRESS 0x380A5C /end MEASUREMENT
/begin MEASUREMENT B_lddy "Flag für Bedingung LDR-Dynamikbetrieb" UBYTE B_TRUE 1 100 0 1 BIT_MASK 0x1 FORMAT "%13.11" ECU_ADDRESS 0x380AEF /end MEASUREMENT
/begin MEASUREMENT B_ldef "Bedingung : definierte Soll-Lambda Bank1" UWORD B_TRUE 1 100 0 1 BIT_MASK 0x2000 FORMAT "%13.11" ECU_ADDRESS 0xFD5A /end MEASUREMENT
/begin MEASUREMENT B_ldeffw "Bedingung : definiertes Soll-Lambda Bank1 durch Fahrerwunsch" UWORD B_TRUE 1 100 0 1 BIT_MASK 0x2 FORMAT "%13.11" ECU_ADDRESS 0xFD62 /end MEASUREMENT
/begin MEASUREMENT B_ldimxa "Bedingung für Adaption Begrenzungswert I-Anteil LDR" UBYTE B_TRUE 1 100 0 1 BIT_MASK 0x2 FORMAT "%13.11" ECU_ADDRESS 0x380AEF /end MEASUREMENT
/begin MEASUREMENT B_ldimxn "Bedingung für Negativ-Korrektur ldimxr" UBYTE B_TRUE 1 100 0 1 BIT_MASK 0x4 FORMAT "%13.11" ECU_ADDRESS 0x380AEF /end MEASUREMENT
/begin MEASUREMENT B_ldimxp "Bedingung für Positiv-Korrektur ldimxr" UBYTE B_TRUE 1 100 0 1 BIT_MASK 0x8 FORMAT "%13.11" ECU_ADDRESS 0x380AEF /end MEASUREMENT
/begin MEASUREMENT B_ldob "Bedingung: Overboost aktiv" UWORD B_TRUE 1 100 0 1 BIT_MASK 0x40 FORMAT "%13.11" ECU_ADDRESS 0xFD80 /end MEASUREMENT
/begin MEASUREMENT B_ldobsp "Bedingung LDR Overboost innerhalb Sperrzeit" UWORD B_TRUE 1 100 0 1 BIT_MASK 0x80 FORMAT "%13.11" ECU_ADDRESS 0xFD80 /end MEASUREMENT
/begin MEASUREMENT B_ldsua "Bedingung LDR Schubumluftventil aktiv (offen)" UWORD B_TRUE 1 100 0 1 BIT_MASK 0x1000 FORMAT "%13.11" ECU_ADDRESS 0xFD7E /end MEASUREMENT
/begin MEASUREMENT B_ldsuad "Bedingung Turbo Umluftsteuerung dynamisch aktiv" UWORD B_TRUE 1 100 0 1 BIT_MASK 0x2000 FORMAT "%13.11" ECU_ADDRESS 0xFD7E /end MEASUREMENT
/begin MEASUREMENT B_ldsuas "Bedingung Turbo Umluftsteuerung stationär aktiv" UWORD B_TRUE 1 100 0 1 BIT_MASK 0x4000 FORMAT "%13.11" ECU_ADDRESS 0xFD7E /end MEASUREMENT
/begin MEASUREMENT B_ldvl "Bedingung für LDR-Vollast" UBYTE B_TRUE 1 100 0 1 BIT_MASK 0x10 FORMAT "%13.11" ECU_ADDRESS 0x380AEF /end MEASUREMENT
/begin MEASUREMENT B_llr "Bedingung Leerlaufregelung" UWORD B_TRUE 1 100 0 1 BIT_MASK 0x80 FORMAT "%13.11" ECU_ADDRESS 0xFD84 /end MEASUREMENT
/begin MEASUREMENT B_llrein "Bedingung LLR Betriebsbereit nach Start" UWORD B_TRUE 1 100 0 1 BIT_MASK 0x100 FORMAT "%13.11" ECU_ADDRESS 0xFD84 /end MEASUREMENT
/begin MEASUREMENT B_llri "Bedingung I-Anteil der LLR aktiv" UWORD B_TRUE 1 100 0 1 BIT_MASK 0x200 FORMAT "%13.11" ECU_ADDRESS 0xFD84 /end MEASUREMENT
/begin MEASUREMENT B_llrpd "Bedingung PD-Anteil der LLR aktiv" UWORD B_TRUE 1 100 0 1 BIT_MASK 0x400 FORMAT "%13.11" ECU_ADDRESS 0xFD84 /end MEASUREMENT
/begin MEASUREMENT B_llrpkh "P-Verstärkung für Katheizen aktiv" UWORD B_TRUE 1 100 0 1 BIT_MASK 0x1000 FORMAT "%13.11" ECU_ADDRESS 0xFD84 /end MEASUREMENT
/begin MEASUREMENT B_llrpst "P-Anteil: Parameter für Start aktiv" UWORD B_TRUE 1 100 0 1 BIT_MASK 0x2000 FORMAT "%13.11" ECU_ADDRESS 0xFD84 /end MEASUREMENT
/begin MEASUREMENT B_llrst "Drehzahl erreicht nstat im Nachstart" UWORD B_TRUE 1 100 0 1 BIT_MASK 0x4000 FORMAT "%13.11" ECU_ADDRESS 0xFD84 /end MEASUREMENT
/begin MEASUREMENT B_lra "Bedingung Gemischadaption freigegeben" UWORD B_TRUE 1 100 0 1 BIT_MASK 0x8 FORMAT "%13.11" ECU_ADDRESS 0xFD62 /end MEASUREMENT
/begin MEASUREMENT B_lraen "Bedingung Gemischadaption freigegeben" UWORD B_TRUE 1 100 0 1 BIT_MASK 0x10 FORMAT "%13.11" ECU_ADDRESS 0xFD62 /end MEASUREMENT
/begin MEASUREMENT B_lrare "Bedingung Reset LRA" UWORD B_TRUE 1 100 0 1 BIT_MASK 0x8 FORMAT "%13.11" ECU_ADDRESS 0xFD5C /end MEASUREMENT
/begin MEASUREMENT B_lrareb "Bedingung Resetbereitschaft LRA" UWORD B_TRUE 1 100 0 1 BIT_MASK 0x10 FORMAT "%13.11" ECU_ADDRESS 0xFD5C /end MEASUREMENT
/begin MEASUREMENT B_lrat "Bedingung Gemischadaption temperaturabhängig freigegeben" UWORD B_TRUE 1 100 0 1 BIT_MASK 0x20 FORMAT "%13.11" ECU_ADDRESS 0xFD62 /end MEASUREMENT
/begin MEASUREMENT B_nofra "Bedingung Sperren der multiplikativen Gemischkorrektur" UWORD B_TRUE 1 100 0 1 BIT_MASK 0x20 FORMAT "%13.11" ECU_ADDRESS 0xFD5C /end MEASUREMENT
/begin MEASUREMENT B_nofrat "Bedingung Sperren der temperaturabhängige Gemischkorrektur" UWORD B_TRUE 1 100 0 1 BIT_MASK 0x40 FORMAT "%13.11" ECU_ADDRESS 0xFD5C /end MEASUREMENT
/begin MEASUREMENT B_norkat "Bedingung additive Korrektur der Gemischadaption pro Zeit abgeschaltet" UWORD B_TRUE 1 100 0 1 BIT_MASK 0x80 FORMAT "%13.11" ECU_ADDRESS 0xFD5C /end MEASUREMENT
/begin MEASUREMENT B_norkaz "Bedingung additive Korrektur der Gemischadaption pro Zündung abgeschaltet" UWORD B_TRUE 1 100 0 1 BIT_MASK 0x100 FORMAT "%13.11" ECU_ADDRESS 0xFD5C /end MEASUREMENT
/begin MEASUREMENT B_ns2 "Bedingung Solldrehzahl 2 aktiv" UWORD B_TRUE 1 100 0 1 BIT_MASK 0x4 FORMAT "%13.11" ECU_ADDRESS 0xFD84 /end MEASUREMENT
/begin MEASUREMENT B_ns2a "Bedingung Solldrehzahl 2 angefordert" UWORD B_TRUE 1 100 0 1 BIT_MASK 0x8 FORMAT "%13.11" ECU_ADDRESS 0xFD84 /end MEASUREMENT
/begin MEASUREMENT B_nsget "Momentenanforderung für CVT: Stellen der Kegelscheibe" UWORD B_TRUE 1 100 0 1 BIT_MASK 0x10 FORMAT "%13.11" ECU_ADDRESS 0xFD84 /end MEASUREMENT
/begin MEASUREMENT B_nsks "Bedingung für Solldrehzahlanhebung (Kochschutz)" UWORD B_TRUE 1 100 0 1 BIT_MASK 0x20 FORMAT "%13.11" ECU_ADDRESS 0xFD84 /end MEASUREMENT
/begin MEASUREMENT B_nssl "Bedingung Soll-Drehzahlanhebung bei Servo-Lenkung" UWORD B_TRUE 1 100 0 1 BIT_MASK 0x40 FORMAT "%13.11" ECU_ADDRESS 0xFD84 /end MEASUREMENT
/begin MEASUREMENT B_range "" UWORD B_TRUE 1 100 0 1 BIT_MASK 0x200 FORMAT "%13.11" ECU_ADDRESS 0xFD5C /end MEASUREMENT
/begin MEASUREMENT B_rkat "Bedingung Lernbereich additive Korrektur pro Zeit aktiv" UWORD B_TRUE 1 100 0 1 BIT_MASK 0x400 FORMAT "%13.11" ECU_ADDRESS 0xFD5C /end MEASUREMENT
/begin MEASUREMENT B_rkatr "Bedingung rkat-Integrator außerhalb reduzierten Bereich" UWORD B_TRUE 1 100 0 1 BIT_MASK 0x800 FORMAT "%13.11" ECU_ADDRESS 0xFD5C /end MEASUREMENT
/begin MEASUREMENT B_rkaz "Bedingung Lernbereich additive Korrektur pro Zündung aktiv" UWORD B_TRUE 1 100 0 1 BIT_MASK 0x1000 FORMAT "%13.11" ECU_ADDRESS 0xFD5C /end MEASUREMENT
/begin MEASUREMENT B_rkazr "Bedingung rkaz-Integrator außerhalb reduzierten Bereich" UWORD B_TRUE 1 100 0 1 BIT_MASK 0x2000 FORMAT "%13.11" ECU_ADDRESS 0xFD5C /end MEASUREMENT
/begin MEASUREMENT B_stldw "Bedingung Stützstellenwechsel LDR Adaption" UBYTE B_TRUE 1 100 0 1 BIT_MASK 0x20 FORMAT "%13.11" ECU_ADDRESS 0x380AEF /end MEASUREMENT
/begin MEASUREMENT B_tabgbts "Bedingung Abgastemperatur für Bauteileschutz überschritten" UBYTE B_TRUE 1 100 0 1 BIT_MASK 0x1 FORMAT "%13.11" ECU_ADDRESS 0x380A5C /end MEASUREMENT
/begin MEASUREMENT B_tatmbts "Bedingung: Temperatur aus ATM für Bauteileschutz überschritten" UBYTE B_TRUE 1 100 0 1 BIT_MASK 0x10 FORMAT "%13.11" ECU_ADDRESS 0x380A5C /end MEASUREMENT
/begin MEASUREMENT B_tikatbts "Bedingung Temperatur im Kat für Bauteileschutz überschritten" UBYTE B_TRUE 1 100 0 1 BIT_MASK 0x8 FORMAT "%13.11" ECU_ADDRESS 0x380A5C /end MEASUREMENT
/begin MEASUREMENT B_tisum "Bedingung Reset Ti-Summenzähler" UWORD B_TRUE 1 100 0 1 BIT_MASK 0x8000 FORMAT "%13.11" ECU_ADDRESS 0xFDAE /end MEASUREMENT
/begin MEASUREMENT B_tkatbts "Bedingung Katalysatortemperatur für Bauteileschutz überschritten" UBYTE B_TRUE 1 100 0 1 BIT_MASK 0x2 FORMAT "%13.11" ECU_ADDRESS 0x380A5C /end MEASUREMENT
/begin MEASUREMENT B_tmkr "Bedingung Temperatur (tmot) fuer KR aktiv erreicht" UWORD B_TRUE 1 100 0 1 BIT_MASK 0x4000 FORMAT "%13.11" ECU_ADDRESS 0xFD72 /end MEASUREMENT
/begin MEASUREMENT B_twilabts "Bedingung Ladertemperatur für Bauteileschutz überschritten" UBYTE B_TRUE 1 100 0 1 BIT_MASK 0x20 FORMAT "%13.11" ECU_ADDRESS 0x380A5C /end MEASUREMENT
/begin MEASUREMENT B_twistbts "Bedingung Stegtemperatur für Bauteileschutz überschritten" UBYTE B_TRUE 1 100 0 1 BIT_MASK 0x4 FORMAT "%13.11" ECU_ADDRESS 0x380A5C /end MEASUREMENT
/begin MEASUREMENT B_vllr "Bedingung Fahrzeug rollt mit eingelegtem Gang" UWORD B_TRUE 1 100 0 1 BIT_MASK 0x800 FORMAT "%13.11" ECU_ADDRESS 0xFD84 /end MEASUREMENT
/begin MEASUREMENT B_wkral "Bedingung wkr aus KR-Adaptionskennfeld einlesen" UWORD B_TRUE 1 100 0 1 BIT_MASK 0x8000 FORMAT "%13.11" ECU_ADDRESS 0xFD72 /end MEASUREMENT
/begin MEASUREMENT B_zwkraa "Bedingung Zündwinkel der KR wird ausgegeben" UWORD B_TRUE 1 100 0 1 BIT_MASK 0x1 FORMAT "%13.11" ECU_ADDRESS 0xFD74 /end MEASUREMENT
/begin MEASUREMENT B_zwkrum "Flag: schnelle Frühverstellung" UWORD B_TRUE 1 100 0 1 BIT_MASK 0x2 FORMAT "%13.11" ECU_ADDRESS 0xFD74 /end MEASUREMENT
/begin MEASUREMENT detazwbs "Delta ZW-Wirkungsgrad für Bauteileschutz" UBYTE rel_ub_b127p5 1 100 0 127.5 FORMAT "%5.1" ECU_ADDRESS 0x38488C /end MEASUREMENT
/begin MEASUREMENT dfrm_w "Abweichung schneller Mittelwert des Lambdareglers von 1.0 (Word)" SWORD fak_sw_b1 1 100 -1 0.999969 FORMAT "%8.6" ECU_ADDRESS 0x384B02 /end MEASUREMENT
/begin MEASUREMENT dlambts_w "Delta Lambda für Bauteileschutz" SWORD fak_sw_b8 1 100 -8 7.99976 FORMAT "%8.6" ECU_ADDRESS 0x384B66 /end MEASUREMENT
/begin MEASUREMENT dlrfrat "Delta rl für die Berechnug der Zeitkonstante der FRAT-Adaption" UBYTE fak_q0p0625 1 100 0 15.9375 FORMAT "%5.2" ECU_ADDRESS 0x38487B /end MEASUREMENT
/begin MEASUREMENT dmllrdl_w "geforderte Drehmomentänderung von der LLR (D-Anteil Luftpfad)" SWORD rel_sw_b100 1 100 -100 99.9969 FORMAT "%8.4" ECU_ADDRESS 0x382512 /end MEASUREMENT
/begin MEASUREMENT dmllrd_w "geforderte Drehmomentänderung von der LLR (D-Anteil)" SWORD rel_sw_b100 1 100 -100 99.9969 FORMAT "%8.4" ECU_ADDRESS 0x382514 /end MEASUREMENT
/begin MEASUREMENT dmllrib_w "I-Anteil des Masters" SWORD rel_sw_b100 1 100 -100 99.9969 FORMAT "%8.4" ECU_ADDRESS 0x382516 /end MEASUREMENT
/begin MEASUREMENT dmllrii_w "I-Anteil bei Betrieb ohne DTEV" SWORD rel_sw_b100 1 100 -100 99.9969 FORMAT "%8.4" ECU_ADDRESS 0x382518 /end MEASUREMENT
/begin MEASUREMENT dmllriz_w "I-Anteil bei Beginn der DTEV" SWORD rel_sw_b100 1 100 -100 99.9969 FORMAT "%8.4" ECU_ADDRESS 0x38251A /end MEASUREMENT
/begin MEASUREMENT dmllri_w "geforderte Drehmomentänderung von der LLR (I-Anteil)" SWORD rel_sw_b100 1 100 -100 99.9969 FORMAT "%8.4" ECU_ADDRESS 0x38251C /end MEASUREMENT
/begin MEASUREMENT dmllrl_w "geforderte Drehmomentänderung von der LLR (Anteil Luftpfad)" SWORD rel_sw_b100 1 100 -100 99.9969 FORMAT "%8.4" ECU_ADDRESS 0x38251E /end MEASUREMENT
/begin MEASUREMENT dmllrpl_w "geforderte Drehmomentänderung von der LLR (P-Anteil Luftpfad)" SWORD rel_sw_b100 1 100 -100 99.9969 FORMAT "%8.4" ECU_ADDRESS 0x382520 /end MEASUREMENT
/begin MEASUREMENT dmllrp_w "geforderte Drehmomentänderung von der LLR (P-Anteil)" SWORD rel_sw_b100 1 100 -100 99.9969 FORMAT "%8.4" ECU_ADDRESS 0x382522 /end MEASUREMENT
/begin MEASUREMENT dmllr_w "geforderte Drehmomentänderung von der LLR (PD-Anteil)" SWORD rel_sw_b100 1 100 -100 99.9969 FORMAT "%8.4" ECU_ADDRESS 0x382524 /end MEASUREMENT
/begin MEASUREMENT dmrllr_w "Momenten-Reserve für Leerlaufregelung" UWORD rel_uw_b100 1 100 0 99.9985 FORMAT "%8.5" ECU_ADDRESS 0x382598 /end MEASUREMENT
/begin MEASUREMENT dn "Drehzahlabweichung bei Leerlaufregelung" SBYTE nmotd_sb_q10 1 100 -1280 1270 FORMAT "%5.0" ECU_ADDRESS 0x380B08 /end MEASUREMENT
/begin MEASUREMENT dnbi_w "Verhältnis nsol_w / nmotbi_w" SWORD nmot_sw_q0p25 1 100 -8192 8191.75 FORMAT "%8.3" ECU_ADDRESS 0x382526 /end MEASUREMENT
/begin MEASUREMENT dnikorr_w "Korrekturwert auf den Integrator nach Diagnose" UWORD nmot_uw_q0p25 1 100 0 16383.8 FORMAT "%8.2" ECU_ADDRESS 0x382528 /end MEASUREMENT
/begin MEASUREMENT dns "LLR: Drehzahlabweichung zur stationären Solldrehzahl" SBYTE nmotd_sb_q10 1 100 -1280 1270 FORMAT "%5.0" ECU_ADDRESS 0x380AFB /end MEASUREMENT
/begin MEASUREMENT dn_w "Drehzahlabweichung bei Leerlaufregelung" SWORD nmot_sw_q0p25 1 100 -8192 8191.75 FORMAT "%8.3" ECU_ADDRESS 0x38252A /end MEASUREMENT
/begin MEASUREMENT drlmaxo "Delta Maximalfuellung bei Overboost" UBYTE rel_ub_q0p75 1 100 0 191.25 FORMAT "%5.1" ECU_ADDRESS 0x380AF0 /end MEASUREMENT
/begin MEASUREMENT dwkr "zylinderindividuelle Zündwinkelspätverstellung KR" SBYTE zw_sb_q0p75 1 100 -96 95.25 FORMAT "%5.2" ECU_ADDRESS 0x380AAF /end MEASUREMENT
/begin MEASUREMENT dwkrmsw "aktueller Wert für Mittelwertbegrenzung der Spätverstellung" UBYTE zw_ub_qn0p75 1 100 -191.25 0 FORMAT "%5.1" ECU_ADDRESS 0x380AB0 /end MEASUREMENT
/begin MEASUREMENT dwkrm_w "Differenz wkrm-wkrmstat" UWORD zw_q0p1875 1 100 0 12287.8 FORMAT "%8.2" ECU_ADDRESS 0x384C1C /end MEASUREMENT
/begin MEASUREMENT dwkrz "zyl.ind. ZW-Spätverstellung inkl. Dyn.vorhalt" SBYTE zw_sb_q0p75 1 100 -96 95.25 FORMAT "%5.2" ARRAY_SIZE 8 ECU_ADDRESS 0x380AB1 /end MEASUREMENT
/begin MEASUREMENT dzwg "Delta Zündwinkel Grund-ZW zu Optimal-ZW" SBYTE zw_sb_q0p75 1 100 -96 95.25 FORMAT "%5.2" ECU_ADDRESS 0x38488D /end MEASUREMENT
/begin MEASUREMENT dzwlamfaw "Delta Zündwinkel bei KR-Eingriff oder Warmlauf für Anfettung über Lambda" UBYTE zw_ub_qn0p75 1 100 -191.25 0 FORMAT "%5.1" ECU_ADDRESS 0x38487E /end MEASUREMENT
/begin MEASUREMENT esst_sdn10llsw "" UWORD dez 1 100 0 65535 FORMAT "%8.2" ECU_ADDRESS 0x38252C /end MEASUREMENT
/begin MEASUREMENT esst_sdz06gkub "" UWORD dez 1 100 0 65535 FORMAT "%8.2" ECU_ADDRESS 0x384B24 /end MEASUREMENT
/begin MEASUREMENT esst_sez04llub "" UWORD dez 1 100 0 65535 FORMAT "%8.2" ECU_ADDRESS 0x38252E /end MEASUREMENT
/begin MEASUREMENT esst_snm16gkub "" UWORD dez 1 100 0 65535 FORMAT "%8.2" ECU_ADDRESS 0x384B68 /end MEASUREMENT
/begin MEASUREMENT esst_sns06llsb "" UWORD dez 1 100 0 65535 FORMAT "%8.2" ECU_ADDRESS 0x3824F6 /end MEASUREMENT
/begin MEASUREMENT esst_sns206llsb "" UWORD dez 1 100 0 65535 FORMAT "%8.2" ECU_ADDRESS 0x382530 /end MEASUREMENT
/begin MEASUREMENT esst_spl08lduw "" UWORD dez 1 100 0 65535 FORMAT "%8.2" ECU_ADDRESS 0x38245A /end MEASUREMENT
/begin MEASUREMENT esst_srl12gkuw "" UWORD dez 1 100 0 65535 FORMAT "%8.2" ECU_ADDRESS 0x384B6A /end MEASUREMENT
/begin MEASUREMENT esst_sta10ldub "" UWORD dez 1 100 0 65535 FORMAT "%8.2" ECU_ADDRESS 0x382486 /end MEASUREMENT
/begin MEASUREMENT esst_stv10ldsw "" UWORD dez 1 100 0 65535 FORMAT "%8.2" ECU_ADDRESS 0x38245C /end MEASUREMENT
/begin MEASUREMENT esst_swk08lduw "" UWORD dez 1 100 0 65535 FORMAT "%8.2" ECU_ADDRESS 0x382488 /end MEASUREMENT
/begin MEASUREMENT esst_swk108lduw "" UWORD dez 1 100 0 65535 FORMAT "%8.2" ECU_ADDRESS 0x38248A /end MEASUREMENT
/begin MEASUREMENT esst_swk208lduw "" UWORD dez 1 100 0 65535 FORMAT "%8.2" ECU_ADDRESS 0x38248C /end MEASUREMENT
/begin MEASUREMENT etazwg "Wirkungsgrad beim Grundzündwinkel" UBYTE rel_ub_b127p5 1 100 0 127.5 FORMAT "%5.1" ECU_ADDRESS 0x38488E /end MEASUREMENT
/begin MEASUREMENT etazwim "Gemittelter Wirkungsgrad beim Ist-Zündwinkel" UBYTE rel_ub_b127p5 1 100 0 127.5 FORMAT "%5.1" ECU_ADDRESS 0x38488F /end MEASUREMENT
/begin MEASUREMENT flaskh "Faktor Übergang zu Lambda-Abgas bei Sekundärluft" UBYTE fak_ub_b1 1 100 0 0.996094 ECU_ADDRESS 0x3848BC /end MEASUREMENT
/begin MEASUREMENT fldrrx_w "Korrekturfaktor Maximalfuellung aus Klopfregelung" UWORD fak_uw_b2 1 100 0 1 FORMAT "%8.6" ECU_ADDRESS 0x384C1E /end MEASUREMENT
/begin MEASUREMENT fldrxk_w "Faktor zur LDR rlmax-Korrektur durch den Kurzzeitanteil" UWORD fak_uw_b2 1 100 0 1 FORMAT "%8.6" ECU_ADDRESS 0x384C20 /end MEASUREMENT
/begin MEASUREMENT fldrxl_w "Faktor zur LDR rlmax-Korrektur durch den Langzeitanteil" UWORD fak_uw_b2 1 100 0 1 FORMAT "%8.6" ECU_ADDRESS 0x384C22 /end MEASUREMENT
/begin MEASUREMENT fldrxo_w "Faktor zur Ladedruckabsenkung des Overboostwertes (drlmaxo)" UWORD fak_uw_b1 1 100 0 0.999985 FORMAT "%9.7" ECU_ADDRESS 0x384C24 /end MEASUREMENT
/begin MEASUREMENT flmsslkh "Faktor Lambda-Motor-Soll-Sekundärluftanteil, resultierend" UBYTE fak_ub_b1 1 100 0 0.996094 ECU_ADDRESS 0x3848BD /end MEASUREMENT
/begin MEASUREMENT fmvp_w "Faktor für Mittelwertbildung Solldruckverhältnis DK" UWORD fak_uw_b2 1 100 0 1.99997 FORMAT "%8.6" ECU_ADDRESS 0x38244E /end MEASUREMENT
/begin MEASUREMENT fraolt_w "multiplikative Gemischkorrektur  frao von dem letzten Trip" UWORD fak_uw_b2 1 100 0 1.99997 FORMAT "%8.6" ECU_ADDRESS 0x384B04 /end MEASUREMENT
/begin MEASUREMENT frao_w "multiplikativer Gemischadaptionsfaktor oberer Lastbereich (Word)" UWORD fak_uw_b2 1 100 0 1.99997 FORMAT "%8.6" ECU_ADDRESS 0x384B06 /end MEASUREMENT
/begin MEASUREMENT frati_w "temperaturabhängige Gemischadaptionfaktor Integralwert" UWORD fak_uw_b2 1 100 0 1.99997 FORMAT "%8.6" ECU_ADDRESS 0x384B08 /end MEASUREMENT
/begin MEASUREMENT frat_w "temperaturabhängige Gemischadaptionsfaktor" UWORD fak_uw_b2 1 100 0 1.99997 FORMAT "%8.6" ECU_ADDRESS 0x384B0A /end MEASUREMENT
/begin MEASUREMENT frault_w "multiplikative Gemischkorrektur  frau von dem letzten Trip" UWORD fak_uw_b2 1 100 0 1.99997 FORMAT "%8.6" ECU_ADDRESS 0x384B0C /end MEASUREMENT
/begin MEASUREMENT frau_w "multiplikativer Gemischadaptionsfaktor unterer mult. Bereich (Word)" UWORD fak_uw_b2 1 100 0 1.99997 FORMAT "%8.6" ECU_ADDRESS 0x384B0E /end MEASUREMENT
/begin MEASUREMENT fra_w "multiplikative Gemischkorrektur der Gemischadaption (Word)" UWORD fak_uw_b2 1 100 0 1.99997 FORMAT "%8.6" ECU_ADDRESS 0x382072 /end MEASUREMENT
/begin MEASUREMENT frxt "Faktor zur Korrektur rlmx als Funktion von Motor- und Öltemperatur" UBYTE fak_ub_b2 1 100 0 1 FORMAT "%5.3" ECU_ADDRESS 0x3848D9 /end MEASUREMENT
/begin MEASUREMENT frxta_w "Faktor zur Korrektur rlmx als Funktion von tans" UWORD fak_uw_b2 1 100 0 1.99997 FORMAT "%8.6" ECU_ADDRESS 0x384C26 /end MEASUREMENT
/begin MEASUREMENT fslsdyn "Faktor Dynamikbeschreibung Sekundärluftsystem" UBYTE fak_ub_b1 1 100 0 0.996094 ECU_ADDRESS 0x3848BE /end MEASUREMENT
/begin MEASUREMENT ftklra_w "Korrekturfaktor für temperaturabhängigen Adaptionsfaktor" UWORD fak_uw_b2 1 100 0 1.99997 FORMAT "%8.6" ECU_ADDRESS 0x384B10 /end MEASUREMENT
/begin MEASUREMENT ikrrkr_wert "" UBYTE dez 1 100 0 255 FORMAT "%5.1" ECU_ADDRESS 0x380A86 /end MEASUREMENT
/begin MEASUREMENT ikr_kek_wert "" UBYTE dez 1 100 0 255 FORMAT "%5.1" ECU_ADDRESS 0x380A87 /end MEASUREMENT
/begin MEASUREMENT int_ctr "" UBYTE dez 1 100 0 255 FORMAT "%5.1" ECU_ADDRESS 0x380BE8 /end MEASUREMENT
/begin MEASUREMENT irbgof_w "Offset für I-Reglerbegrenzung LDRPID abhängig von Drehzahlgradient" SWORD tv_sw_q0p005 1 100 -163.84 163.835 FORMAT "%8.4" ECU_ADDRESS 0x384BFC /end MEASUREMENT
/begin MEASUREMENT iver "Integratorverstärkung" UBYTE rel_q0p002383 1 100 0 0.607617 ECU_ADDRESS 0x380B09 /end MEASUREMENT
/begin MEASUREMENT ke "Klopferkennungsschwelle aus Kennfeld" UBYTE fak_ub_b16 1 100 0 15.9375 FORMAT "%5.2" ARRAY_SIZE 8 ECU_ADDRESS 0x3848BF /end MEASUREMENT
/begin MEASUREMENT kek "Klopferkennungsschwelle korrigiert" UBYTE fak_ub_b16 1 100 0 15.9375 FORMAT "%5.2" ARRAY_SIZE 8 ECU_ADDRESS 0x380A88 /end MEASUREMENT
/begin MEASUREMENT kek_tst "Klopferkennungsschwelle korrigiert rollierend mit Zyl.zähler" UBYTE fak_ub_b16 1 100 0 15.9375 FORMAT "%5.2" ECU_ADDRESS 0x380A90 /end MEASUREMENT
/begin MEASUREMENT kral1w "aktueller Wert Last-Adaptionsbereich 1" UBYTE rel_ub_q0p75 1 100 0 191.25 FORMAT "%5.1" ECU_ADDRESS 0x3848C9 /end MEASUREMENT
/begin MEASUREMENT kral2w "aktueller Wert Last-Adaptionsbereich 2" UBYTE rel_ub_q0p75 1 100 0 191.25 FORMAT "%5.1" ECU_ADDRESS 0x3848CA /end MEASUREMENT
/begin MEASUREMENT kral3w "aktueller Wert Last-Adaptionsbereich 3" UBYTE rel_ub_q0p75 1 100 0 191.25 FORMAT "%5.1" ECU_ADDRESS 0x3848CB /end MEASUREMENT
/begin MEASUREMENT krdwsw "aktueller KL-Wert der Sicherheitsspätverstellung" UBYTE zw_ub_qn0p75 1 100 -191.25 0 FORMAT "%5.1" ECU_ADDRESS 0x380AB9 /end MEASUREMENT
/begin MEASUREMENT krfkw "Aktueller Wert aus KRFKN" UBYTE zw_ub_qn0p75 1 100 -191.25 0 FORMAT "%5.1" ECU_ADDRESS 0x380ABA /end MEASUREMENT
/begin MEASUREMENT krftpakt "aktuelles Tiefpaßverhalten" UBYTE dez 1 100 0 255 FORMAT "%5.1" ECU_ADDRESS 0x380A91 /end MEASUREMENT
/begin MEASUREMENT krlzn "Bitmuster: zylinderindividuelle Drehzahlschwelle für LZF überschritten" UBYTE dez 1 100 0 255 FORMAT "%5.1" ECU_ADDRESS 0x380ABB /end MEASUREMENT
/begin MEASUREMENT krmxw "aktueller Wert für Spätbegrenzung der Spätverstellung" UBYTE zw_ub_qn0p75 1 100 -191.25 0 FORMAT "%5.1" ECU_ADDRESS 0x380ABC /end MEASUREMENT
/begin MEASUREMENT krvfsw "Initwert für schnelle Frühverstellung" UBYTE dez 1 100 0 255 FORMAT "%5.1" ECU_ADDRESS 0x380ABD /end MEASUREMENT
/begin MEASUREMENT krvfw "Initwert für normale Frühverstellung" UBYTE dez 1 100 0 255 FORMAT "%5.1" ECU_ADDRESS 0x380ABE /end MEASUREMENT
/begin MEASUREMENT kvakbi_w "aufsummierter Kraftstoffverbrauch für Kombiausgabe" UWORD dez 1 100 0 65535 FORMAT "%8.2" ECU_ADDRESS 0x382C6E /end MEASUREMENT
/begin MEASUREMENT LAKHlokBits "" UBYTE dez 1 100 0 255 FORMAT "%5.1" ECU_ADDRESS 0x380A72 /end MEASUREMENT
/begin MEASUREMENT lambas "Basis-Lambda" UBYTE fak_ub_b2 1 100 0 1.99219 FORMAT "%5.3" ECU_ADDRESS 0x380A40 /end MEASUREMENT
/begin MEASUREMENT LAMBTSlokbits "" UBYTE dez 1 100 0 255 FORMAT "%5.1" ECU_ADDRESS 0x380A5C /end MEASUREMENT
/begin MEASUREMENT lambts_w "Lambda für Bauteileschutz" UWORD fak_uw_b16 1 100 0 15.9998 FORMAT "%8.5" ECU_ADDRESS 0x384B6C /end MEASUREMENT
/begin MEASUREMENT lamfawkr_w "Lambdasoll Fahrerwunsch bei Zündwinkelspätverstellung KR, WL" UWORD fak_uw_b16 1 100 0 15.9998 FORMAT "%8.5" ECU_ADDRESS 0x384B26 /end MEASUREMENT
/begin MEASUREMENT lamfaws_w "Lambdasoll Fahrerwunsch stationärer Anteil" UWORD fak_uw_b16 1 100 0 15.9998 FORMAT "%8.5" ECU_ADDRESS 0x384B28 /end MEASUREMENT
/begin MEASUREMENT lamfaw_w "Lambdasoll Fahrerwunsch Anteil aus Kennfeld LAMFA" UWORD fak_uw_b16 1 100 0 15.9998 FORMAT "%8.5" ECU_ADDRESS 0x384B2A /end MEASUREMENT
/begin MEASUREMENT lamfa_w "Lambdasoll Fahrerwunsch (word)" UWORD fak_uw_b16 1 100 0 15.9998 FORMAT "%8.5" ECU_ADDRESS 0x384B2C /end MEASUREMENT
/begin MEASUREMENT lamfwl_w "Offset Motor-Lambda-Soll im Warmlauf" UWORD fak_uw_b16 1 100 0 15.9998 FORMAT "%8.5" ECU_ADDRESS 0x384B2E /end MEASUREMENT
/begin MEASUREMENT lamkh2_w "Lambda-Motor-Soll bei Katheizen, Bank 2 (word)" UWORD fak_q0p000244 1 100 0 15.9998 FORMAT "%8.5" ECU_ADDRESS 0x3822C6 /end MEASUREMENT
/begin MEASUREMENT lamkhe_w "Lambda-Motor-Soll bei Katheizen, effektiv" UWORD fak_uw_b16 1 100 0 15.9998 FORMAT "%8.5" ECU_ADDRESS 0x382060 /end MEASUREMENT
/begin MEASUREMENT lamkhg_w "Lambda-Motor-Soll bei Katheizen (word) gewichtet mit flakh" UWORD fak_q0p000244 1 100 0 15.9998 FORMAT "%8.5" ECU_ADDRESS 0x3822C8 /end MEASUREMENT
/begin MEASUREMENT lamkhr_w "Lambda-Motor-Soll resultierend bei Katheizen (word)" UWORD fak_q0p000244 1 100 0 15.9998 FORMAT "%8.5" ECU_ADDRESS 0x384BD0 /end MEASUREMENT
/begin MEASUREMENT lamkh_w "Lambda-Motor-Soll bei Katheizen (word)" UWORD fak_q0p000244 1 100 0 15.9998 FORMAT "%8.5" ECU_ADDRESS 0x3822CA /end MEASUREMENT
/begin MEASUREMENT lamlgfmn "Lambda Motorlaufgrenze fett" UBYTE fak_ub_b2 1 100 0 1.99219 FORMAT "%5.3" ECU_ADDRESS 0x384879 /end MEASUREMENT
/begin MEASUREMENT lamlgm "Laufgrenze ""Lambda mager""" UBYTE fak_ub_b2 1 100 0 1.99219 FORMAT "%5.3" ECU_ADDRESS 0x38487A /end MEASUREMENT
/begin MEASUREMENT lamrlmn_w "Lambdasollvorsteuerung zur Verbesserung der Brennbarkeit bei kleinem rl" UWORD fak_uw_b16 1 100 0 15.9998 FORMAT "%8.5" ECU_ADDRESS 0x384B30 /end MEASUREMENT
/begin MEASUREMENT lamsbg_w "Lambdasoll Begrenzung (word)" UWORD fak_uw_b16 1 100 0 15.9998 FORMAT "%8.5" ECU_ADDRESS 0x382062 /end MEASUREMENT
/begin MEASUREMENT lamsons_w "Lambda-Sollwert bezogen auf Einbauort Lambda-Sensor" UWORD fak_uw_b16 1 100 0 15.9998 FORMAT "%8.5" ECU_ADDRESS 0x382064 /end MEASUREMENT
/begin MEASUREMENT lamsos_w "Lambda-Sollwert bezogen auf Einbauort Lambda-Sensor" UWORD fak_uw_b16 1 100 0 15.9998 FORMAT "%8.5" ECU_ADDRESS 0x382066 /end MEASUREMENT
/begin MEASUREMENT lamsubg_w "Lambdasoll unbegrenzt (word)" UWORD fak_uw_b16 1 100 0 15.9998 FORMAT "%8.5" ECU_ADDRESS 0x382068 /end MEASUREMENT
/begin MEASUREMENT lams_w "Lambdasoll (word)" UWORD fak_uw_b16 1 100 0 15.9998 FORMAT "%8.5" ECU_ADDRESS 0x38206A /end MEASUREMENT
/begin MEASUREMENT lamvoa_w "Lambdavorsteuerung ohne additive Anteile" UWORD fak_uw_b16 1 100 0 15.9998 FORMAT "%8.5" ECU_ADDRESS 0x38206C /end MEASUREMENT
/begin MEASUREMENT lanskh_w "Lambda-Motor-Soll im Nachstart bei Katheizen" UWORD fak_q0p000244 1 100 0 15.9998 FORMAT "%8.5" ECU_ADDRESS 0x384BD2 /end MEASUREMENT
/begin MEASUREMENT lasdslg_w "Lambda-Abgas-Soll für Sekundärluftdiagnose gewichtet mit flamsl" UWORD fak_q0p000244 1 100 0 15.9998 FORMAT "%8.5" ECU_ADDRESS 0x384BD4 /end MEASUREMENT
/begin MEASUREMENT lasdsl_w "Lambda-Abgas-Soll für Sekundärluftdiagnose" UWORD fak_q0p000244 1 100 0 15.9998 FORMAT "%8.5" ECU_ADDRESS 0x384BD6 /end MEASUREMENT
/begin MEASUREMENT laskh_w "Lambda-Abgas-Soll bei Katheizen (word)" UWORD fak_q0p000244 1 100 0 15.9998 FORMAT "%8.5" ECU_ADDRESS 0x384BD8 /end MEASUREMENT
/begin MEASUREMENT lbts_w "Lambda für Bauteileschutz aus Stationärkennfeld" UWORD fak_uw_b16 1 100 0 15.9998 FORMAT "%8.5" ECU_ADDRESS 0x384B6E /end MEASUREMENT
/begin MEASUREMENT lde "LDR-Regelabweichung (Sollwert - Istwert)" SBYTE p_sb_q10 1 100 -1280 1270 FORMAT "%5.0" ECU_ADDRESS 0x3848D7 /end MEASUREMENT
/begin MEASUREMENT ldebu "Regelabweichung LDR im back up Betrieb" SWORD rel_q1p5 1 100 -49152 49150.5 FORMAT "%8.2" ECU_ADDRESS 0x38249E /end MEASUREMENT
/begin MEASUREMENT ldimn_w "Aktueller Wert zur Minimalwertbegrenzung I-Anteil LDR" SWORD tv_sw_q0p005 1 100 -163.84 163.835 FORMAT "%8.4" ECU_ADDRESS 0x384BFE /end MEASUREMENT
/begin MEASUREMENT ldimxak_w "Aktueller korrigierter Begrenzungswert I-Anteil LDR" SWORD tv_sw_q0p005 1 100 -163.84 163.835 FORMAT "%8.4" ECU_ADDRESS 0x384C00 /end MEASUREMENT
/begin MEASUREMENT ldimxa_w "Adaptive Korrektur der LDR I-Regler Maximalwertbegrenzung" SWORD tv_sw_q0p005 1 100 -163.84 163.835 FORMAT "%8.4" ARRAY_SIZE 5 ECU_ADDRESS 0x384040 /end MEASUREMENT
/begin MEASUREMENT ldimxrk_w "LDR I max. Begrenzungswert (korrigierter Referenzwert)" SWORD tv_sw_q0p005 1 100 -163.84 163.835 FORMAT "%8.4" ECU_ADDRESS 0x384C02 /end MEASUREMENT
/begin MEASUREMENT ldimxr_w "Aktueller Referenzwert zur Maximalwertbegrenzung I-Anteil LDR" SWORD tv_sw_q0p005 1 100 -163.84 163.835 FORMAT "%8.4" ECU_ADDRESS 0x384C04 /end MEASUREMENT
/begin MEASUREMENT ldimx_w "Aktueller Wert zur Maximalwertbegrenzung I-Anteil LDR" SWORD tv_sw_q0p005 1 100 -163.84 163.835 FORMAT "%8.4" ECU_ADDRESS 0x384C06 /end MEASUREMENT
/begin MEASUREMENT lditv_w "LDR, Tastverhältnis vom I-Regler (word)" SWORD tv_sw_q0p005 1 100 -163.84 163.835 FORMAT "%8.4" ECU_ADDRESS 0x384C08 /end MEASUREMENT
/begin MEASUREMENT ldptv_w "LDR, Tastverhältnis vom P-Regler" SWORD tv_sw_q0p005 1 100 -163.84 163.835 FORMAT "%8.4" ECU_ADDRESS 0x384C0A /end MEASUREMENT
/begin MEASUREMENT ldrdtv_w "LDR Tastverhältnis vom D-Regler" SWORD tv_sw_q0p005 1 100 -163.84 163.835 FORMAT "%8.4" ECU_ADDRESS 0x384C0C /end MEASUREMENT
/begin MEASUREMENT ldrkd_w "LDR-Reglerparameter für D-Anteil" UWORD rel_uw_b3276p75 1 100 0 3276.75 FORMAT "%8.3" ECU_ADDRESS 0x384C0E /end MEASUREMENT
/begin MEASUREMENT ldrki_w "LDR-Reglerparameter für I-Anteil" UWORD rel_uw_b3276p75 1 100 0 3276.75 FORMAT "%8.3" ECU_ADDRESS 0x384C10 /end MEASUREMENT
/begin MEASUREMENT ldrkp_w "LDR-Reglerparameter für P-Anteil" UWORD rel_uw_b3276p75 1 100 0 3276.75 FORMAT "%8.3" ECU_ADDRESS 0x384C12 /end MEASUREMENT
/begin MEASUREMENT ldrlms_w "Begrenzungswert für maximale Füllung LDR für Motorschutz" UWORD rel_uw_q0p0234 1 100 0 1535.98 FORMAT "%8.3" ECU_ADDRESS 0x384C28 /end MEASUREMENT
/begin MEASUREMENT ldrlts_w "Begrenzungswert für maximale Füllung LDR für ATL-Schutz" UWORD rel_uw_q0p0234 1 100 0 1535.98 FORMAT "%8.3" ECU_ADDRESS 0x384C2A /end MEASUREMENT
/begin MEASUREMENT ldrpidLokBits "" UBYTE dez 1 100 0 255 FORMAT "%5.1" ECU_ADDRESS 0x380AEF /end MEASUREMENT
/begin MEASUREMENT ldtv "LDR Tastverhältnis" SWORD tv_sw_q0p005 1 100 -163.84 163.835 FORMAT "%8.4" ECU_ADDRESS 0x384C14 /end MEASUREMENT
/begin MEASUREMENT ldtvbu_w "LDR Tastverhältnis vom back up Regler" SWORD rel_sw_b50 1 100 -50 49.9985 FORMAT "%8.5" ECU_ADDRESS 0x3824A0 /end MEASUREMENT
/begin MEASUREMENT ldtvm "LDR Tastverhältnis , moduliert (Endergebnis)" UBYTE tv_ub_b100 1 100 0 99.6094 FORMAT "%5.2" ECU_ADDRESS 0x380AF1 /end MEASUREMENT
/begin MEASUREMENT ldtvmd "LDR-Tastverhältnis aus Md-Koordination" SWORD tv_ub_b100 1 100 -12800 12799.6 FORMAT "%8.2" ECU_ADDRESS 0x3824A2 /end MEASUREMENT
/begin MEASUREMENT ldtvr_w "LDR Tastverhältnis vom Regler" SWORD tv_sw_q0p005 1 100 -163.84 163.835 FORMAT "%8.4" ECU_ADDRESS 0x384C16 /end MEASUREMENT
/begin MEASUREMENT ldtv_w "LDR Tastverhältnis" SWORD tv_sw_q0p005 1 100 -163.84 163.835 FORMAT "%8.4" ECU_ADDRESS 0x384C18 /end MEASUREMENT
/begin MEASUREMENT limax_w "LLR-Integrator-Maximalwert" SWORD rel_sw_b100 1 100 -100 99.9969 FORMAT "%8.4" ECU_ADDRESS 0x382532 /end MEASUREMENT
/begin MEASUREMENT limin_w "LLR-Integrator-Minimalwert" SWORD rel_sw_b100 1 100 -100 99.9969 FORMAT "%8.4" ECU_ADDRESS 0x382534 /end MEASUREMENT
/begin MEASUREMENT limnst "LLR-Integrator-Minimalwert während Nachstart" UBYTE rel_ub_b24p9 1 100 0 24.9 FORMAT "%5.2" ECU_ADDRESS 0x380B0A /end MEASUREMENT
/begin MEASUREMENT lkraw "aktueller Wert der Lastschwelle Klopfregel-Adaption" UBYTE rel_ub_q0p75 1 100 0 191.25 FORMAT "%5.1" ECU_ADDRESS 0x3848CC /end MEASUREMENT
/begin MEASUREMENT lkrw "aktueller Wert der Lastschwelle Klopfregelung" UBYTE rel_ub_q0p75 1 100 0 191.25 FORMAT "%5.1" ECU_ADDRESS 0x3848CD /end MEASUREMENT
/begin MEASUREMENT llrnfalokbits "" UBYTE dez 1 100 0 255 FORMAT "%5.1" ECU_ADDRESS 0x380B17 /end MEASUREMENT
/begin MEASUREMENT lmskh_w "Lambda-Motor-Soll bei katheizen (word)" UWORD fak_q0p000244 1 100 0 15.9998 FORMAT "%8.5" ECU_ADDRESS 0x384BDA /end MEASUREMENT
/begin MEASUREMENT lmssl_w "Lambda-Motor-Soll wegen Sekundärluft bei Katheizen (word)" UWORD fak_q0p000244 1 100 0 15.9998 FORMAT "%8.5" ECU_ADDRESS 0x384BDC /end MEASUREMENT
/begin MEASUREMENT lzist "Array: aktuelle Zuordnung führende - geführte Zylinder" UBYTE dez 1 100 0 255 FORMAT "%5.1" ARRAY_SIZE 8 ECU_ADDRESS 0x383140 /end MEASUREMENT
/begin MEASUREMENT ngasf_w "Drehzahlgradient über ein Arbeitsspiel (gefiltert)" SWORD nmotg_sw_q0p39 1 100 -12800.2 12799.8 FORMAT "%8.2" ECU_ADDRESS 0x382536 /end MEASUREMENT
/begin MEASUREMENT nllcvt2 "Drehzahlvorgabe aus CVT-Getriebe nach Begrenzung" UBYTE nmot_ub_q10 1 100 0 2550 FORMAT "%5.0" ECU_ADDRESS 0x380AFC /end MEASUREMENT
/begin MEASUREMENT nsfsm "LLR: Motortemperaturabhängige Solldrehzahl im LL bei S_fs=1" UBYTE nmot_ub_q10 1 100 0 2550 FORMAT "%5.0" ECU_ADDRESS 0x3848E2 /end MEASUREMENT
/begin MEASUREMENT nsfsmn "LLR: Minimale Solldrehzahl bei eingelegter Fahrstufe" UBYTE nmot_ub_q10 1 100 0 2550 FORMAT "%5.0" ECU_ADDRESS 0x380AFD /end MEASUREMENT
/begin MEASUREMENT nslbz "Solldrehtahl abhängig von lbz" UBYTE nmot_ub_q10 1 100 0 2550 FORMAT "%5.0" ECU_ADDRESS 0x3848E3 /end MEASUREMENT
/begin MEASUREMENT nslfa "Solldrehzahl bei Kurztrip" UBYTE nmot_ub_q10 1 100 0 2550 FORMAT "%5.0" ECU_ADDRESS 0x380B18 /end MEASUREMENT
/begin MEASUREMENT nsllm "LLR: Motortemperaturabhängige Solldrehzahl im LL" UBYTE nmot_ub_q10 1 100 0 2550 FORMAT "%5.0" ECU_ADDRESS 0x3848E4 /end MEASUREMENT
/begin MEASUREMENT nsllmn "LLR: Minimale Solldrehzahl im LL" UBYTE nmot_ub_q10 1 100 0 2550 FORMAT "%5.0" ECU_ADDRESS 0x380AFE /end MEASUREMENT
/begin MEASUREMENT nsnf "LLR: Nachgeführte Solldrehzahl" UBYTE nmot_ub_q10 1 100 0 2550 FORMAT "%5.0" ECU_ADDRESS 0x380AFF /end MEASUREMENT
/begin MEASUREMENT nsol "Leerlaufsolldrehzahl" UBYTE nmot_ub_q10 1 100 0 2550 FORMAT "%5.0" ECU_ADDRESS 0x380B00 /end MEASUREMENT
/begin MEASUREMENT nsol_w "Leerlaufsolldrehzahl" UWORD nmot_uw_q0p25 1 100 0 16383.8 FORMAT "%8.2" ECU_ADDRESS 0x3824F8 /end MEASUREMENT
/begin MEASUREMENT nsst "Initialisierungswert der Solldrehzahl im Start" UBYTE nmot_ub_q10 1 100 0 2550 FORMAT "%5.0" ECU_ADDRESS 0x380B01 /end MEASUREMENT
/begin MEASUREMENT nstat "Solldrehzahl stationär" UBYTE nmot_ub_q10 1 100 0 2550 FORMAT "%5.0" ECU_ADDRESS 0x380B02 /end MEASUREMENT
/begin MEASUREMENT nstat2 "Stationnäre Solldrehzahl nach Begrenzung" UBYTE nmot_ub_q10 1 100 0 2550 FORMAT "%5.0" ECU_ADDRESS 0x380B03 /end MEASUREMENT
/begin MEASUREMENT nstat3 "Stationnäre Solldrehzahl vor Filterung" UBYTE nmot_ub_q10 1 100 0 2550 FORMAT "%5.0" ECU_ADDRESS 0x380B04 /end MEASUREMENT
/begin MEASUREMENT nstate "effektive stationäre Solldrehzahl" UBYTE nmot_ub_q10 1 100 0 2550 FORMAT "%5.0" ECU_ADDRESS 0x380B05 /end MEASUREMENT
/begin MEASUREMENT nstatfil "Solldrehzahl stationär gefiltert" UBYTE nmot_ub_q10 1 100 0 2550 FORMAT "%5.0" ECU_ADDRESS 0x380B06 /end MEASUREMENT
/begin MEASUREMENT pdpld "Prädizierter Delta Druck (Überschwinger Soll-Ist)" UBYTE p_ub_q10 1 100 0 2550 FORMAT "%5.0" ECU_ADDRESS 0xF9EA /end MEASUREMENT
/begin MEASUREMENT pdpld_w "Prädizierter Delta Druck (Überschwinger Soll-Ist) word" UWORD p_uw_q0p039 1 100 0 2559.96 FORMAT "%8.3" ECU_ADDRESS 0xF9EC /end MEASUREMENT
/begin MEASUREMENT plmaxa_w "Soll-Ladedruck nach max- Auswahl" UWORD p_uw_q0p039 1 100 0 2559.96 FORMAT "%8.3" ECU_ADDRESS 0xF9EE /end MEASUREMENT
/begin MEASUREMENT plsolr_w "Relativer Solladedruck LDR" UWORD p_uw_q0p039 1 100 0 2559.96 FORMAT "%8.3" ECU_ADDRESS 0x384C1A /end MEASUREMENT
/begin MEASUREMENT plxs_w "Maximaler Soll-Ladedruck" UWORD p_uw_q0p039 1 100 0 2559.96 FORMAT "%8.3" ECU_ADDRESS 0x384C2C /end MEASUREMENT
/begin MEASUREMENT rkatlt_w "additive Gemischkorrektur von der letzten Trip (HFM)" SWORD rel_sw_b1536 1 100 -1536 1535.95 FORMAT "%8.3" ECU_ADDRESS 0x384B12 /end MEASUREMENT
/begin MEASUREMENT rkat_w "additive Gemischkorrektur (pro Zeit) der Gemischdaption (Word)" SWORD rel_sw_b1536 1 100 -1536 1535.95 FORMAT "%8.3" ECU_ADDRESS 0x384B14 /end MEASUREMENT
/begin MEASUREMENT rkazlt_w "additive Gemischkorrektur von der letzten Trip (P-System)" SWORD rel_sw_b1536 1 100 -1536 1535.95 FORMAT "%8.3" ECU_ADDRESS 0x384B16 /end MEASUREMENT
/begin MEASUREMENT rkaz_w "additive Gemischkorrektur (pro Zündung) der Gemischadaption" SWORD rel_sw_b1536 1 100 -1536 1535.95 FORMAT "%8.3" ECU_ADDRESS 0x384B18 /end MEASUREMENT
/begin MEASUREMENT rka_w "Additive adaptive Korrektur der relativen Kraftstoffmasse" SWORD rel_sw_b1536 1 100 -1536 1535.95 FORMAT "%8.3" ECU_ADDRESS 0x382074 /end MEASUREMENT
/begin MEASUREMENT rkr "Referenzpegel Klopfregelung" UBYTE spg_ub_b5 1 100 0 4.98047 FORMAT "%5.3" ARRAY_SIZE 8 ECU_ADDRESS 0x380A92 /end MEASUREMENT
/begin MEASUREMENT rkrmx "nach oben begrenzter Referenzpegel" UBYTE spg_ub_b5 1 100 0 4.98047 FORMAT "%5.3" ECU_ADDRESS 0xF9DA /end MEASUREMENT
/begin MEASUREMENT rkrmx1w "aktueller Wert der KL RKRMX1N" UBYTE spg_ub_b320 1 100 0 318.75 FORMAT "%5.1" ECU_ADDRESS 0x3848C7 /end MEASUREMENT
/begin MEASUREMENT rkrmx2w "aktueller Wert der KL RKRMX2N" UBYTE spg_ub_b320 1 100 0 318.75 FORMAT "%5.1" ECU_ADDRESS 0x3848C8 /end MEASUREMENT
/begin MEASUREMENT rkr_tst "Referenzpegel Klopfregelung rollierend mit Zyl.zähler" UBYTE spg_ub_b5 1 100 0 4.98047 FORMAT "%5.3" ECU_ADDRESS 0x380A9A /end MEASUREMENT
/begin MEASUREMENT rlmxko_w "Maximalfüllung korrigiert (ohne Begrenzungen)" UWORD rel_uw_q0p0234 1 100 0 1535.98 FORMAT "%8.3" ECU_ADDRESS 0x384C2E /end MEASUREMENT
/begin MEASUREMENT rlmx_w "Rohwert Maximalfuellung" UWORD rel_uw_q0p0234 1 100 0 1535.98 FORMAT "%8.3" ECU_ADDRESS 0x384C30 /end MEASUREMENT
/begin MEASUREMENT stkrax "Index für KR-Adaptionskennfeld" UBYTE dez 1 100 0 255 FORMAT "%5.1" ECU_ADDRESS 0x380ABF /end MEASUREMENT
/begin MEASUREMENT stkrlx "Laststützstelle für die KR-Adaption" UBYTE dez 1 100 0 255 FORMAT "%5.1" ECU_ADDRESS 0x380AC0 /end MEASUREMENT
/begin MEASUREMENT stkrnx "Drehzahlstützstelle für die KR-Adaption" UBYTE dez 1 100 0 255 FORMAT "%5.1" ECU_ADDRESS 0x380AC1 /end MEASUREMENT
/begin MEASUREMENT stldia "Aktuelle Stützstelle für LDR Adaption" UBYTE dez 1 100 0 255 FORMAT "%5.1" ECU_ADDRESS 0x3848D8 /end MEASUREMENT
/begin MEASUREMENT tabgbts_w "Abgastemperatur für Bauteileschutz" UWORD temp_uw_q0p0195_o50 1 100 -50 1229.98 FORMAT "%8.3" ECU_ADDRESS 0x384B70 /end MEASUREMENT
/begin MEASUREMENT temp_b_wert "" UBYTE dez 1 100 0 255 FORMAT "%5.1" ECU_ADDRESS 0x380A9B /end MEASUREMENT
/begin MEASUREMENT tisum_w "Einspritzzeitsummierer" UWORD dez 1 100 0 65535 FORMAT "%8.2" ECU_ADDRESS 0x382C70 /end MEASUREMENT
/begin MEASUREMENT tkvad "" UBYTE dez 1 100 0 255 FORMAT "%5.1" ECU_ADDRESS 0x38492E /end MEASUREMENT
/begin MEASUREMENT tkvag_w "" UWORD dez 1 100 0 65535 FORMAT "%8.2" ECU_ADDRESS 0x3853F8 /end MEASUREMENT
/begin MEASUREMENT tkvar "" UBYTE dez 1 100 0 255 FORMAT "%5.1" ECU_ADDRESS 0x38492F /end MEASUREMENT
/begin MEASUREMENT tkva_h "" UWORD dez 1 100 0 65535 FORMAT "%8.2" ECU_ADDRESS 0x382C72 /end MEASUREMENT
/begin MEASUREMENT tmotldrlmx "Motortemperatur in LDRLMX nach Selektion (tmot/tmkic/tmki)" UBYTE temp_ub_q0p75_o48 1 100 -48 143.25 FORMAT "%5.1" ECU_ADDRESS 0x3848DA /end MEASUREMENT
/begin MEASUREMENT tnst "Zeit nach Startende" UBYTE t1sxs_ub_b255 1 100 0 255 FORMAT "%5.1" ECU_ADDRESS 0x380B07 /end MEASUREMENT
/begin MEASUREMENT toelldrlmx "Öltemperatur in LDRLMX nach Selektion (tolc/toel/TOLEWRLMX)" UBYTE temp_ub_q1_o60 1 100 -60 195 FORMAT "%5.1" ECU_ADDRESS 0x3848DB /end MEASUREMENT
/begin MEASUREMENT tsel "Selektierte Temperatur (tans/tumc)" UBYTE temp_ub_q0p75_o48 1 100 -48 143.25 FORMAT "%5.1" ECU_ADDRESS 0x3848DC /end MEASUREMENT
/begin MEASUREMENT virkr "Verhältnis Integrator / Referenzpegel Klopfregelung" UBYTE fak_ub_b16 1 100 0 15.9375 FORMAT "%5.2" ECU_ADDRESS 0xF9DB /end MEASUREMENT
/begin MEASUREMENT vkr "Verstärkungsstufe für Eingangsverstärkung Klopf-IC" UBYTE dez 1 100 0 255 FORMAT "%5.1" ARRAY_SIZE 8 ECU_ADDRESS 0x380A9C /end MEASUREMENT
/begin MEASUREMENT vkr_tst "Verstärkungsstufe für Eingangsverstärkung Klopf-IC rollierend mit Zyl.zähler" UBYTE dez 1 100 0 255 FORMAT "%5.1" ECU_ADDRESS 0x380AA4 /end MEASUREMENT
/begin MEASUREMENT vpssplg_w "Druckverhältnis Saugrohrsolldruck zu Grundladedruck" UWORD fak_uw_b4 1 100 0 3.99994 FORMAT "%8.6" ECU_ADDRESS 0x382450 /end MEASUREMENT
/begin MEASUREMENT vpsspls_w "Verhältnis Soll-Saugrohrdruck zu Druck Sollladedruck" UWORD fak_uw_b2 1 100 0 1.99997 FORMAT "%8.6" ECU_ADDRESS 0x382452 /end MEASUREMENT
/begin MEASUREMENT vpsspu_w "Solldruckverhältnis Umgebung/Saugrohr" UWORD fak_uw_b4 1 100 0 3.99994 FORMAT "%8.6" ECU_ADDRESS 0x382454 /end MEASUREMENT
/begin MEASUREMENT vszwm "Mittelwert der ZW-Verstellung über VS2x" SBYTE zw_sb_q0p75 1 100 -96 95.25 FORMAT "%5.2" ECU_ADDRESS 0x380AC2 /end MEASUREMENT
/begin MEASUREMENT wkr "zylinderindividuelle Zündwinkelspätverstellung KR" UBYTE zw_ub_qn0p75 1 100 -191.25 0 FORMAT "%5.1" ARRAY_SIZE 4 ECU_ADDRESS 0xF9DC /end MEASUREMENT
/begin MEASUREMENT wkra "last und drehzahlabh. Adaptionskennfeld f. wkr" UBYTE zw_ub_qn0p75 1 100 -191.25 0 FORMAT "%5.1" ARRAY_SIZE 160 ECU_ADDRESS 0x383148 /end MEASUREMENT
/begin MEASUREMENT wkraa "Monitor der wkra des aktuellen Adaptionsbereiches, wkra_0, _1..." UBYTE zw_ub_qn0p75 1 100 -191.25 0 FORMAT "%5.1" ARRAY_SIZE 8 ECU_ADDRESS 0x380AC3 /end MEASUREMENT
/begin MEASUREMENT wkratst "wkra mit Synchro-Raster rollierend" UBYTE zw_ub_qn0p75 1 100 -191.25 0 FORMAT "%5.1" ECU_ADDRESS 0x380ACB /end MEASUREMENT
/begin MEASUREMENT wkrm "Mittelwert der zylinderindividuellen ZW-Spätverstellungen durch KR" UBYTE zw_ub_qn0p75 1 100 -191.25 0 FORMAT "%5.1" ECU_ADDRESS 0xF9E0 /end MEASUREMENT
/begin MEASUREMENT wkrma "Mittelwert der ZW-Spätverstellungen KR, allgemein (im Notlauf mit Sicherheit)" UBYTE zw_ub_qn0p75 1 100 -191.25 0 FORMAT "%5.1" ECU_ADDRESS 0xF9E1 /end MEASUREMENT
/begin MEASUREMENT wkrmdy_w "Dynamischer Mittelwert der zylinderindividuellen ZW Spätverstellungen" UWORD zw_q0p1875 1 100 0 12287.8 FORMAT "%8.2" ECU_ADDRESS 0x384C32 /end MEASUREMENT
/begin MEASUREMENT wkrmstat_w "Quasistationärer Mittelwert der zylinderindividuellen ZW Spätverstellwerte" UWORD zw_q0p1875 1 100 0 12287.8 FORMAT "%8.2" ECU_ADDRESS 0x38404A /end MEASUREMENT
/begin MEASUREMENT wkrmsu_w "Summenwert aus dynamischem und statischem Mittelwert der KR Verstellwinkel" UWORD zw_q0p1875 1 100 0 12287.8 FORMAT "%8.2" ECU_ADDRESS 0x384C34 /end MEASUREMENT
/begin MEASUREMENT wkr_tst "zyl.ind. ZW-Spätverstellung, rollierend" UBYTE zw_ub_qn0p75 1 100 -191.25 0 FORMAT "%5.1" ECU_ADDRESS 0x380ACC /end MEASUREMENT
/begin MEASUREMENT zhll "Zeitzähler für Heißleerlauf" UBYTE t1sxs_ub_b255 1 100 0 255 FORMAT "%5.1" ECU_ADDRESS 0x383A90 /end MEASUREMENT
/begin MEASUREMENT zkfrat_w "Zeitkonstante der FRAT-Adaption" UWORD fak_uw_b5 1 100 0 4.99992 FORMAT "%8.6" ECU_ADDRESS 0x384B1A /end MEASUREMENT
/begin MEASUREMENT zkrstat "" UBYTE t100msxs_ub_b25p5 1 100 0 25.5 FORMAT "%5.2" ECU_ADDRESS 0x380ACD /end MEASUREMENT
/begin MEASUREMENT zkrvf "Zähler, bestimmt die Frequenz der zyl.-individuellen Zündwinkelfrühverstellung" UBYTE dez 1 100 0 255 FORMAT "%5.1" ARRAY_SIZE 8 ECU_ADDRESS 0x380ACE /end MEASUREMENT
/begin FUNCTION KRKE "16.30     Klopferkennung"
 /begin DEF_CHARACTERISTIC CWKRREF CWREFI FKEFMC FKELDY FKENDY FKRFTPFMC KFKEF1 KFKEF2 KFKEF3 KFKEF4 KFKEF5 KFKEF6 KFKEF7 KFKEF8 KRFTP1 KRFTP2 KRFTP3 KRKFKS KRVST KSZA REFINI RKRMX1N RKRMX2N ZYRKR /end DEF_CHARACTERISTIC
 /begin REF_CHARACTERISTIC SNM16KRUB SRL03KRUB /end REF_CHARACTERISTIC
 /begin IN_MEASUREMENT B_c95ks3 B_dnt B_dntb B_dtp B_dtpb B_fmfkrc B_kr B_krldy B_krndy B_krnl B_st esst_snm16krub esst_srl03krub ikr ikrma ikrme nmot rl vske zzylkr /end IN_MEASUREMENT
 /begin OUT_MEASUREMENT B_c95_g0 B_c95_g1 B_c95_g2 B_kl ikrrkr_wert ikr_kek_wert ke kek kek_tst krftpakt rkr rkrmx rkrmx1w rkrmx2w rkr_tst temp_b_wert virkr vkr vkr_tst /end OUT_MEASUREMENT
 /begin LOC_MEASUREMENT /end LOC_MEASUREMENT
 /begin SUB_FUNCTION /end SUB_FUNCTION
/end FUNCTION
/begin FUNCTION KRRA "15.130    Klopfregelung mit Adaption der zylinderindividuellen Spätverstellung"
 /begin DEF_CHARACTERISTIC CWKRLZFK CWKRNLR CWKRRA DRLKRSTMX DWKRMSN KRAL1N KRAL2N KRAL3N KRALH KRAN1 KRAN2 KRAN3 KRAN4 KRANH KRDWA KRDWAA KRDWKLA KRDWSA KRDWSN KRFKLN KRFKN KRLVFN KRMXN KRNLZ KRVFN KRVFSN KRWKRAIN LKRAN LKRN LZB1 LZB2 LZFUER NGKRSTMX NKRAMAX NKRAMIN NKRF NKRMAX TMKR TMKRA TMKRAS TVKRSTAT WKRLZOF WKRLZOFEKS /end DEF_CHARACTERISTIC
 /begin REF_CHARACTERISTIC KSZA SENZZYL0 SNM16KRUB /end REF_CHARACTERISTIC
 /begin IN_MEASUREMENT B_adrkra B_asr B_kl B_krldy B_krldya B_krldyn B_krndy B_krndyn B_llr B_nldg B_nmax B_pwf B_stend B_synph B_vmax drl_w esst_snm16krub ngfil_w nmot rl tmot vszwkr zwkrafld zzylkr /end IN_MEASUREMENT
 /begin OUT_MEASUREMENT B_kr B_krdws B_krfdks B_krlz B_krnl B_krnlr B_krstatb B_krwa B_tmkr dwkr dwkrz lkraw lkrw stkrnx wkrma /end OUT_MEASUREMENT
 /begin LOC_MEASUREMENT B_kra B_krafrz B_krfrz B_krlzn B_krvf B_kseb1 B_kseb2 B_wkral B_zwkraa B_zwkrum dwkrmsw kral1w kral2w kral3w krdwsw krfkw krlzn krmxw krvfsw krvfw lzist stkrax stkrlx vszwm wkr wkra wkraa wkratst wkrm wkr_tst zkrstat zkrvf /end LOC_MEASUREMENT
 /begin SUB_FUNCTION /end SUB_FUNCTION
/end FUNCTION
/begin FUNCTION KVA "41.40     Ausgangssignal: Kraftstoff-Verbrauchs-Anzeige" /begin DEF_CHARACTERISTIC CWCKBI FKVA KD KVB /end DEF_CHARACTERISTIC /begin REF_CHARACTERISTIC KRKTE /end REF_CHARACTERISTIC /begin IN_MEASUREMENT B_sa rkte_w rk_w /end IN_MEASUREMENT /begin OUT_MEASUREMENT B_kvakbi int_ctr kvakbi_w tkvad tkvag_w tkvar tkva_h /end OUT_MEASUREMENT /begin LOC_MEASUREMENT B_tisum tisum_w /end LOC_MEASUREMENT /begin SUB_FUNCTION /end SUB_FUNCTION /end FUNCTION
/begin FUNCTION KWP2000F "" /begin DEF_CHARACTERISTIC /end DEF_CHARACTERISTIC /begin REF_CHARACTERISTIC /end REF_CHARACTERISTIC /begin IN_MEASUREMENT nmot /end IN_MEASUREMENT /begin OUT_MEASUREMENT /end OUT_MEASUREMENT /begin LOC_MEASUREMENT /end LOC_MEASUREMENT /begin SUB_FUNCTION /end SUB_FUNCTION /end FUNCTION
/begin FUNCTION KWPDATR "" /begin DEF_CHARACTERISTIC /end DEF_CHARACTERISTIC
 /begin REF_CHARACTERISTIC ADRONLOGIN GRAOFLOGIN GRAONLOGIN HLOFFLOGIN HLONLOGIN KLOGIN LUEN1LOGIN LUEN2LOGIN LUEN3LOGIN SLOGIN /end REF_CHARACTERISTIC
 /begin IN_MEASUREMENT B_acc B_accen B_fgrte B_hlon B_luef1 B_luef2 B_luef3 nmot_w /end IN_MEASUREMENT
 /begin OUT_MEASUREMENT /end OUT_MEASUREMENT
 /begin LOC_MEASUREMENT /end LOC_MEASUREMENT
 /begin SUB_FUNCTION /end SUB_FUNCTION
/end FUNCTION
/begin FUNCTION KWPDIAG "" /begin DEF_CHARACTERISTIC /end DEF_CHARACTERISTIC /begin REF_CHARACTERISTIC /end REF_CHARACTERISTIC /begin IN_MEASUREMENT /end IN_MEASUREMENT /begin OUT_MEASUREMENT /end OUT_MEASUREMENT /begin LOC_MEASUREMENT /end LOC_MEASUREMENT /begin SUB_FUNCTION /end SUB_FUNCTION /end FUNCTION
/begin FUNCTION KWPSTDA "" /begin DEF_CHARACTERISTIC /end DEF_CHARACTERISTIC /begin REF_CHARACTERISTIC /end REF_CHARACTERISTIC /begin IN_MEASUREMENT fcmEnd FCMTab ffzdfp /end IN_MEASUREMENT /begin OUT_MEASUREMENT /end OUT_MEASUREMENT /begin LOC_MEASUREMENT /end LOC_MEASUREMENT /begin SUB_FUNCTION /end SUB_FUNCTION /end FUNCTION
/begin FUNCTION LAKH "4.50      Lambda-Koordination bei Katheizen"
 /begin DEF_CHARACTERISTIC CWLAKH IMLLASKH KFLANSKH KFLASKH KFLMSKH_0_A KFLMSKH_1_A KLLAKHFH LASDSLA LASTMOT LMSTMOT ZFLASKH /end DEF_CHARACTERISTIC
 /begin REF_CHARACTERISTIC /end REF_CHARACTERISTIC
 /begin IN_MEASUREMENT anztib_w B_dsla B_fasla B_kh fho_w flakh flamsl_w flmssl fmsldyn fslpdyn imlpr ml_w nmot nmot_w rl rl_w tmot tmst /end IN_MEASUREMENT
 /begin OUT_MEASUREMENT B_lamkhe lamkh2_w lamkh_w /end OUT_MEASUREMENT
 /begin LOC_MEASUREMENT B_dslafa flaskh flmsslkh fslsdyn LAKHlokBits lamkhg_w lamkhr_w lanskh_w lasdslg_w lasdsl_w laskh_w lmskh_w lmssl_w /end LOC_MEASUREMENT
 /begin SUB_FUNCTION /end SUB_FUNCTION
/end FUNCTION
/begin FUNCTION LAMBTS "11.20     Lambda Bauteileschutz"
 /begin DEF_CHARACTERISTIC CWLAMBTS DLBTSF DTBTS FBSTABGM FBSTMOT KFDLBTS KFFDLBTS KFLBTS KFTVLBTS SNM16GKUB SRL12GKUW TABGBTS TDLAMBTS TIKATBTS TKATBTS ZDLBTS ZLBTS ZLBTSNEG /end DEF_CHARACTERISTIC
 /begin REF_CHARACTERISTIC ETADZW /end REF_CHARACTERISTIC
 /begin IN_MEASUREMENT B_dash B_gsaf etazwist nmot rl rl_w tabgkrm_w tabgm_w tikatm_w tkatm_w tmot zwgru zwopt /end IN_MEASUREMENT
 /begin OUT_MEASUREMENT dzwg esst_snm16gkub esst_srl12gkuw lambts_w /end OUT_MEASUREMENT
 /begin LOC_MEASUREMENT B_lbts B_tabgbts B_tatmbts B_tikatbts B_tkatbts B_twilabts B_twistbts detazwbs dlambts_w etazwg etazwim LAMBTSlokbits lbts_w tabgbts_w /end LOC_MEASUREMENT
 /begin SUB_FUNCTION /end SUB_FUNCTION
/end FUNCTION
/begin FUNCTION LAMFAW "7.100     Lambda Fahrerwunsch"
 /begin DEF_CHARACTERISTIC CWLAMFAW DLAMFAW DLAMOB DLAMTANS GANGFAW KFLAFWL KFLAMKR KFLAMKRL LAMFA LAMFAS LAMRLMN RLLAMMN SDZ06GKUB TLAFA TLAMFAS TMSTFWMN TMSTFWMX TNSTFWMN TNSTFWMX ZKLAMFAW ZKWLAFWL /end DEF_CHARACTERISTIC
 /begin REF_CHARACTERISTIC SNM06GKUB SRL06GKUB STM08GKUB /end REF_CHARACTERISTIC
 /begin IN_MEASUREMENT B_kh B_ldob B_sab B_stend dzwwl esst_snm06gkub esst_srl06gkub esst_stm08gkub fho gangi mifa_w milsol_w mrfa_w nmot rl tans tmot tmst tnst_w wkrma /end IN_MEASUREMENT
 /begin OUT_MEASUREMENT esst_sdz06gkub lamfa_w /end OUT_MEASUREMENT
 /begin LOC_MEASUREMENT B_lamfas B_lamfasa B_lamfash B_ldeffw dzwlamfaw lamfawkr_w lamfaws_w lamfaw_w lamfwl_w lamrlmn_w /end LOC_MEASUREMENT
 /begin SUB_FUNCTION /end SUB_FUNCTION
/end FUNCTION
/begin FUNCTION LAMKO "9.80      Lambdakoordination"
 /begin DEF_CHARACTERISTIC CWLAMKH LAMFLGSL LAMLGFKT LAMLGFTM LAMLGMKT LAMLGMTM LAMSOSOF LAMSOSUF LASOAB /end DEF_CHARACTERISTIC
 /begin REF_CHARACTERISTIC STM12ESUB /end REF_CHARACTERISTIC
 /begin IN_MEASUREMENT B_bevab B_dsla B_fa B_falsh B_fasla B_kh B_lamkhe B_lamlash B_lamnse B_ldeffw B_sls B_slsfz dlamatr_w esst_stm12esub flamkh flamsl_w imlatm lambts_w lamelsh_w lamfa_w lamka_w lamkh_w lamlash_w lamnswl_w tmot /end IN_MEASUREMENT
 /begin OUT_MEASUREMENT B_lalgf B_lamsdef lambas lamsbg_w lamsons_w lamvoa_w /end OUT_MEASUREMENT
 /begin LOC_MEASUREMENT B_lambts B_lamka B_lamkh B_lamnswl B_ldef lamkhe_w lamlgfmn lamlgm lamsos_w lamsubg_w lams_w /end LOC_MEASUREMENT
 /begin SUB_FUNCTION /end SUB_FUNCTION
/end FUNCTION
/begin FUNCTION LDOB "31.30     LDR Overboost"
 /begin DEF_CHARACTERISTIC ELDOB FKLDOBG_0_A FKLDOBG_1_A FKLDOBG_2_A FKLDOBG_3_A GWPLDOB KFLDRXO TABLDOBN TLDOBAN TLDOBN TSTLDOBA TVLDOBSO /end DEF_CHARACTERISTIC
 /begin REF_CHARACTERISTIC SNM08LDUB /end REF_CHARACTERISTIC
 /begin IN_MEASUREMENT B_kuppl B_ldr esst_snm08ldub gangi lde nmot tans wped /end IN_MEASUREMENT
 /begin OUT_MEASUREMENT B_ldob B_ldobsp drlmaxo /end OUT_MEASUREMENT
 /begin LOC_MEASUREMENT /end LOC_MEASUREMENT
 /begin SUB_FUNCTION /end SUB_FUNCTION
/end FUNCTION
/begin FUNCTION LDRLMX "8.50      Berechnung LDR Maximalfuellung rlmax"
 /begin DEF_CHARACTERISTIC CWRLMX FKRXTOL GANGIO KFFKRXTM KFFLDEO KFFLLDE KFFSLDE KFFWLLDE KFLDHBN KFTARX KFTARXB KFTARXZK LDORXN LDPBN LDRXN LDRXNZK RLKRLDA STA10LDUB SWK08LDUW SWK108LDUW SWK208LDUW TKFTARX TLKRLDAB TLKRLDAU TOELMX TOLEWRLMX TSKRLDAB TSKRLDAU UEFKTGETU /end DEF_CHARACTERISTIC
 /begin REF_CHARACTERISTIC SNM08LDUB SNM08LDUW SNM12LDUW STA08LDUB /end REF_CHARACTERISTIC
 /begin IN_MEASUREMENT B_atrf B_atsb B_autget B_ckien B_emxldr B_kfzk B_ll B_pwf B_tolcb B_wkauf drlmaxo esst_snm08ldub esst_snm08lduw esst_snm12lduw esst_sta08ldub fupsrl_w gangi nmot nmot_w pbrint_w pirg_w pu rl tans tmki tolc uefktget vfzg vsrlmx vstrlx wkrma /end IN_MEASUREMENT
 /begin OUT_MEASUREMENT esst_sta10ldub plxs_w rlmx_w tmotldrlmx toelldrlmx tsel wkrmdy_w wkrmstat_w wkrmsu_w /end OUT_MEASUREMENT
 /begin LOC_MEASUREMENT B_brlmx dwkrm_w esst_swk08lduw esst_swk108lduw esst_swk208lduw fldrrx_w fldrxk_w fldrxl_w fldrxo_w frxt frxta_w ldrlms_w ldrlts_w rlmxko_w /end LOC_MEASUREMENT
 /begin SUB_FUNCTION /end SUB_FUNCTION
/end FUNCTION
/begin FUNCTION LDRPID "25.20     LDR PID-Regler"
 /begin DEF_CHARACTERISTIC CWLDIMX FTLDIA FTLDIAP KFLDIMX KFLDIOPU KFLDIWL KFLDRL KFLDRQ0 KFLDRQ1 KFLDRQ2 KFRBGOF LDAMN LDDIAN LDDIAP LDDIMNN LDDIMXN LDEIAO LDEIAP LDEIAPS LDEIAU LDHIA LDIATA LDMXNN LDMXNP LDRQ0S LDRQ1ST LDRVL NLDIAPU SPL08LDUW STLDIA1 STLDIA2 STLDIA3 STLDIA4 STV10LDSW TLDIAN TLDIAPN TVLDMX UMDYLDR /end DEF_CHARACTERISTIC
 /begin REF_CHARACTERISTIC SLD04LDUB SNM08LDUB SNM08LDUW SNM16LDUB SNM16LDUW SPU08LDUB STA08LDUB /end REF_CHARACTERISTIC
 /begin IN_MEASUREMENT B_ldr B_pwf esst_sld04ldub esst_snm08ldub esst_snm08lduw esst_snm16ldub esst_snm16lduw esst_spu08ldub esst_sta08ldub imlatm ngfil nmot nmot_w plgru_w plsol plsol_w pu pu_w pvdkds rlmax_w rlsol_w tans tmst /end IN_MEASUREMENT
 /begin OUT_MEASUREMENT esst_spl08lduw esst_stv10ldsw irbgof_w lde ldimxak_w ldtv ldtv_w /end OUT_MEASUREMENT
 /begin LOC_MEASUREMENT B_lddy B_ldimxa B_ldimxn B_ldimxp B_ldvl B_stldw ldimn_w ldimxa_w ldimxrk_w ldimxr_w ldimx_w lditv_w ldptv_w ldrdtv_w ldrkd_w ldrki_w ldrkp_w ldrpidLokBits ldtvr_w plsolr_w stldia /end LOC_MEASUREMENT
 /begin SUB_FUNCTION /end SUB_FUNCTION
/end FUNCTION
/begin FUNCTION LDRPLS "2.50      Berechnung Soll-Ladedruck" /begin DEF_CHARACTERISTIC CWLDRPLS KFVPDKSD KFVPDKSE TDPDK /end DEF_CHARACTERISTIC /begin REF_CHARACTERISTIC SNM12LDUW SVP12LDUW /end REF_CHARACTERISTIC
 /begin IN_MEASUREMENT B_asr B_ldob B_ldobsp esst_snm12lduw esst_svp12lduw nmot_w plgrus_w pssol_w pu_w /end IN_MEASUREMENT
 /begin OUT_MEASUREMENT vpssplg_w vpsspls_w /end OUT_MEASUREMENT
 /begin LOC_MEASUREMENT fmvp_w vpsspu_w /end LOC_MEASUREMENT
 /begin SUB_FUNCTION /end SUB_FUNCTION
/end FUNCTION
/begin FUNCTION LDTVMA "21.10     Aufbereitung und Ausgabe Tastverhältnis" /begin DEF_CHARACTERISTIC KFLDRAPP KFTVLDRE LDRAPP LDRPBU TVLDMN /end DEF_CHARACTERISTIC /begin REF_CHARACTERISTIC TVLDMX /end REF_CHARACTERISTIC
 /begin IN_MEASUREMENT B_ldb B_ldrbu B_lds B_ldsafw B_ldsapp ldtv nmot plsol rl rlsol_w vsldtv wped /end IN_MEASUREMENT
 /begin OUT_MEASUREMENT ldtvm /end OUT_MEASUREMENT
 /begin LOC_MEASUREMENT ldebu ldtvbu_w ldtvmd /end LOC_MEASUREMENT
 /begin SUB_FUNCTION /end SUB_FUNCTION
/end FUNCTION
/begin FUNCTION LDUVST "2.120     LDR-Schubumluftventilsteuerung"
 /begin DEF_CHARACTERISTIC GWPLDU GWPLDUR HSLDSUA HSSLDSUA KFSDLDSUA LDUVRS PIDLDSUA SDKSUA SVDLDUVS TALDUVSE TANUVMN THLDUVD /end DEF_CHARACTERISTIC
 /begin REF_CHARACTERISTIC /end REF_CHARACTERISTIC
 /begin IN_MEASUREMENT B_ll B_stend dwped nmot plgrus_w plsol_w pu_w pvdkds_w tans wped /end IN_MEASUREMENT
 /begin OUT_MEASUREMENT B_ldsua pdpld pdpld_w /end OUT_MEASUREMENT
 /begin LOC_MEASUREMENT B_ldsuad B_ldsuas plmaxa_w /end LOC_MEASUREMENT
 /begin SUB_FUNCTION /end SUB_FUNCTION
/end FUNCTION
/begin FUNCTION LLRBB "3.30      Leerlaufregelung Betriebsbedingungen" /begin DEF_CHARACTERISTIC CNFKUPPL DNLLR TVDK TVKUPPL TVLLRI TVLLRPD VLLR /end DEF_CHARACTERISTIC /begin REF_CHARACTERISTIC /end REF_CHARACTERISTIC
 /begin IN_MEASUREMENT B_dash B_fil B_fs B_kuppl B_ll B_mdein B_nmot B_sa B_sab B_stend dmllri_w dn gangi mill_w mistt nmot nmotll nstat tmot vfzg /end IN_MEASUREMENT
 /begin OUT_MEASUREMENT B_llr B_llrein B_llri B_llrpd B_vllr /end OUT_MEASUREMENT
 /begin LOC_MEASUREMENT /end LOC_MEASUREMENT
 /begin SUB_FUNCTION /end SUB_FUNCTION
/end FUNCTION
/begin FUNCTION LLRMR "2.110     Momentenreserve Leerlaufregelung"
 /begin DEF_CHARACTERISTIC CWKUPPL DMRESLL DNLLRES KFMRES KFMRESK KFMRESKH KFMRESNL KFMRESTA MRESLL MRESSL TDMRESLL TVRESLL VANF /end DEF_CHARACTERISTIC
 /begin REF_CHARACTERISTIC SMI04LLUB SNM06LLUB SNS06LLSB STA04LLUB STM04SAUB /end REF_CHARACTERISTIC
 /begin IN_MEASUREMENT B_kh B_kuppl B_ll B_nswo1 B_sl B_stend dmrac dmrwan dn dns esst_smi04llub esst_snm06llub esst_sns06llsb esst_sta04llub esst_stm04saub mifa_w nmot_w tans tmot vfzg vstmdr /end IN_MEASUREMENT
 /begin OUT_MEASUREMENT dmrllr_w /end OUT_MEASUREMENT
 /begin LOC_MEASUREMENT /end LOC_MEASUREMENT
 /begin SUB_FUNCTION /end SUB_FUNCTION
/end FUNCTION
/begin FUNCTION LLRNFA "1.140     Solldrehzahlanhebung bei Kurztrip"
 /begin DEF_CHARACTERISTIC CWFAN NSLFAA NSLFAEZLA NSLFAKAT_0_A NSLFAKAT_1_A NSLFAKRS NSLFALDP NSLFALSV NSLFASH NSLFASHV NSLFASKNO NSLFASLS NSLFATES NSLFAWSA NSLFAWSE NSLKVS NSLLSH TNSLFA WFAN /end DEF_CHARACTERISTIC
 /begin REF_CHARACTERISTIC /end REF_CHARACTERISTIC
 /begin IN_MEASUREMENT B_autget B_brems B_faagr B_faan B_faezla B_fakat B_fakrs B_fakvs B_faldp B_falsh B_falshv B_falsv B_fanwsa B_fanwse B_fash B_faskno B_fasls B_fates B_fs B_ll vfzg wped /end IN_MEASUREMENT
 /begin OUT_MEASUREMENT nslfa /end OUT_MEASUREMENT
 /begin LOC_MEASUREMENT B_fanfg llrnfalokbits /end LOC_MEASUREMENT
 /begin SUB_FUNCTION /end SUB_FUNCTION
/end FUNCTION
/begin FUNCTION LLRNS "516.270   Leerlaufregelung-Solldrehzahl"
 /begin DEF_CHARACTERISTIC CNFLLRNS CWNSTAT DNSNFX DTAHLL DTMHLL FNSNF FNSSTKM FNSSTM KFNLLNST KFZNSM KLDFOFF KLDFON KNSNF LBZO1 LBZO2 LBZU NFHZ NFHZFS NFS2M NFSKLDF NFSKO_0_A NFSKO_1_A NFSKS NFSLPWG NFSM NFSMIN_0_A NFSMIN_1_A NFSNLDG NFSSL NGNSNF NKLDF NLL2M_0_A NLL2M_1_A NLL2M_2_A NLL2M_3_A NLLCVTMXV NLLM_0_A NLLM_1_A NLLM_2_A NLLM_3_A NLLMIN_0_A NLLMIN_1_A NSAC_0_A NSAC_1_A NSACFS_0_A NSACFS_1_A NSHLL NSKO_0_A NSKO_1_A NSKS NSL NSLBZFS NSLBZLL NSLBZS NSLPP NSLPPFS NSLPWG NSNLDG NSNOT NZHDTL NZHITL SNS06LLSB TAHLL TMHLL TMLLX TMRZHLL VSL ZHLLA ZHLLE ZKNS ZNSUB /end DEF_CHARACTERISTIC
 /begin REF_CHARACTERISTIC STM06LLUB STN06LLUB /end REF_CHARACTERISTIC
 /begin IN_MEASUREMENT B_dknolu B_dkpu B_fhz B_fs B_khn B_ko B_ll B_llrein B_nac B_nldg B_nswo1 B_pwf B_sacc B_skoc B_sl B_spsmin B_st B_stend B_wkauf esst_stm06llub esst_stn06llub kldfpwm lbz nfskh ngfil nllcvt1 nllkh nmot nmotll nslfa psl rl S_ac S_ko tans tmot tmst tnst_w vfzg vsns vstcns vstnls /end IN_MEASUREMENT
 /begin OUT_MEASUREMENT B_nsget dns esst_sns06llsb nsol nsol_w nsst nstat nstat2 nstat3 nstate nstatfil /end OUT_MEASUREMENT
 /begin LOC_MEASUREMENT B_hll B_kldf B_ns2 B_ns2a B_nsks B_nssl nllcvt2 nsfsm nsfsmn nslbz nsllm nsllmn nsnf tnst zhll /end LOC_MEASUREMENT
 /begin SUB_FUNCTION /end SUB_FUNCTION
/end FUNCTION
/begin FUNCTION LLRRM "11.120    Leerlaufregelung Reglereingriff Drehmoment"
 /begin DEF_CHARACTERISTIC CWLLRPA DMLLNGEZ DMLLNGEZV DMLLRLMNN DMLLRLMXN DMLLRMNN DMLLRMNNK DMLLRMXN DMLLRMXNK DNLLRIST DNLLST DNMNI DVNG DVNGV FDDN FDNIKOR GFDLDN IVDNDTEH IVDNHOM IVDNHOMV LIMN LIMNDLLR LIMNDTES LIMNV LIMXDNS LIMXVDNS LISTM LLRICNF PVDNHOM PVDNHOMV PVDNKH PVDNST PVLDNEZ PVLDNEZKH PVLDNEZV SDN10LLSW SEZ04LLUB SNS206LLSB SRKTEVS TVLISTU TVLLRPST TVPKH ZFLLRPL ZKLLRD ZLIBG ZNFNGLL /end DEF_CHARACTERISTIC
 /begin REF_CHARACTERISTIC SNG06LLSB SNM06LLUB SNS06LLSB STM06LLUB /end REF_CHARACTERISTIC
 /begin IN_MEASUREMENT B_dllr B_dteaam B_dtes B_dtest B_faan B_kh B_kha B_llr B_llrein B_llri B_llrpd B_mdmin B_nswo1 B_st B_stend B_temin B_trkh B_vllr dns esst_sng06llsb esst_snm06llub esst_sns06llsb esst_stm06llub etazws ngas_w ngfil nmot_w nsol_w nstat tmot /end IN_MEASUREMENT
 /begin OUT_MEASUREMENT B_llrst dmllrdl_w dmllrd_w dmllri_w dmllrl_w dmllrpl_w dmllrp_w dmllr_w dn dn_w esst_sdn10llsw esst_sez04llub esst_sns206llsb limax_w limin_w /end OUT_MEASUREMENT
 /begin LOC_MEASUREMENT B_llrpkh B_llrpst dmllrib_w dmllrii_w dmllriz_w dnbi_w dnikorr_w iver limnst ngasf_w /end LOC_MEASUREMENT
 /begin SUB_FUNCTION /end SUB_FUNCTION
/end FUNCTION
/begin FUNCTION LRA "93.140    Adaptive Vorsteuerung für Lambdaregelung"
 /begin DEF_CHARACTERISTIC CWGALSV FBZFRAT FRAOMN FRAOMX FRAORN FRAORX FRATMN FRATMX FRAUMN FRAUMX FRAURN FRAURX KFRAT MLO1 MLO1AC MLO2 MLO3 MLO3AC MLU2 MLU2AC MLU2FA MLU4 MLU4AC N0 NO1 NO2 NOLRA NRKAB NU2 NU3 RKATMN RKATMX RKATRN RKATRX RKAZMN RKAZMX RKAZRN RKAZRX RLO2 RLO3 RLO3AC RLU2 RLU2AC RLU2FA RLU3 RLU4 RLU4AC TGAALTWR TMFRATMN TMFRATUB ZKFRAOA ZKFRAUA ZKRKATA ZKRKAZA ZRLFRAT /end DEF_CHARACTERISTIC
 /begin REF_CHARACTERISTIC TMRAA /end REF_CHARACTERISTIC
 /begin IN_MEASUREMENT abo B_abor B_edkvs B_fa B_faan B_fakvs B_koe B_lr B_lra B_lrat B_lsvvsp B_pwf B_stend frm_w ml_w nmot rl tmot /end IN_MEASUREMENT
 /begin OUT_MEASUREMENT B_frao B_fraor B_frat B_frau B_fraur B_lrare B_nofra B_nofrat B_norkat B_norkaz B_rkat B_rkatr B_rkaz B_rkazr frao_w frati_w frat_w frau_w fra_w ftklra_w rkat_w rkaz_w rka_w /end OUT_MEASUREMENT
 /begin LOC_MEASUREMENT B_lrareb B_range dfrm_w dlrfrat fraolt_w frault_w rkatlt_w rkazlt_w zkfrat_w /end LOC_MEASUREMENT
 /begin SUB_FUNCTION /end SUB_FUNCTION
/end FUNCTION
/begin FUNCTION LRAEB "4.110     Einschaltbedingungen Gemischadaption" /begin DEF_CHARACTERISTIC LAMLRAMN LAMLRAMX TARA TMEWRAA TMRAA TVLRA WDKARN /end DEF_CHARACTERISTIC /begin REF_CHARACTERISTIC /end REF_CHARACTERISTIC
 /begin IN_MEASUREMENT B_agrlrasp B_brems B_dsls B_dteaa B_dtest B_enws B_fa B_falra B_fates B_gap B_lr B_lrasp B_mdarv B_sls B_te B_ukg B_vl lamsons_w nmot tans tmew tmot wdkba /end IN_MEASUREMENT
 /begin OUT_MEASUREMENT B_gasp B_lra B_lrat /end OUT_MEASUREMENT
 /begin LOC_MEASUREMENT B_lraen /end LOC_MEASUREMENT
 /begin SUB_FUNCTION /end SUB_FUNCTION
/end FUNCTION
/begin COMPU_METHOD B_TRUE "boolsche Zustände, positive Logik" TAB_VERB "%6.3" "" COMPU_TAB_REF B_TRUE /end COMPU_METHOD
/begin COMPU_VTAB B_TRUE "boolsche Zustände, positive Logik" TAB_VERB 2 0 "----" 1 "TRUE" /end COMPU_VTAB
/begin COMPU_METHOD DEZ "1 : 1 Umrechnug (dez/hex)" RAT_FUNC "%6.2" "" COEFFS 0 1 0 0 0 1 /end COMPU_METHOD
/begin COMPU_METHOD dez "1 : 1 Umrechnug (dez/hex)" RAT_FUNC "%6.2" "" COEFFS 0 1 0 0 0 1 /end COMPU_METHOD
/begin COMPU_METHOD fak_q0p000244 "" RAT_FUNC "%6.5" "-" COEFFS 0 65536 0 0 0 16 /end COMPU_METHOD
/begin COMPU_METHOD fak_q0p00153 "" RAT_FUNC "%6.4" "-" COEFFS 0 256 0 0 0 0.390625 /end COMPU_METHOD
/begin COMPU_METHOD fak_q0p0625 "" RAT_FUNC "%6.4" "-" COEFFS 0 16 0 0 0 1 /end COMPU_METHOD
/begin COMPU_METHOD fak_sb_b1 "" RAT_FUNC "%6.4" "-" COEFFS 0 256 0 0 0 2 /end COMPU_METHOD
/begin COMPU_METHOD fak_sw_b1 "" RAT_FUNC "%7.6" "-" COEFFS 0 65536 0 0 0 2 /end COMPU_METHOD
/begin COMPU_METHOD fak_sw_b8 "" RAT_FUNC "%6.5" "-" COEFFS 0 65536 0 0 0 16 /end COMPU_METHOD
/begin COMPU_METHOD fak_ub_b1 "" RAT_FUNC "%6.4" "-" COEFFS 0 256 0 0 0 1 /end COMPU_METHOD
/begin COMPU_METHOD fak_ub_b16 "" RAT_FUNC "%6.4" "-" COEFFS 0 256 0 0 0 16 /end COMPU_METHOD
/begin COMPU_METHOD fak_ub_b2 "" RAT_FUNC "%6.4" "-" COEFFS 0 256 0 0 0 2 /end COMPU_METHOD
/begin COMPU_METHOD fak_ub_b4 "" RAT_FUNC "%6.4" "-" COEFFS 0 256 0 0 0 4 /end COMPU_METHOD
/begin COMPU_METHOD fak_ub_b64 "" RAT_FUNC "%6.3" "-" COEFFS 0 256 0 0 0 64 /end COMPU_METHOD
/begin COMPU_METHOD fak_uw_b1 "" RAT_FUNC "%7.6" "-" COEFFS 0 65536 0 0 0 1 /end COMPU_METHOD
/begin COMPU_METHOD fak_uw_b16 "" RAT_FUNC "%6.5" "-" COEFFS 0 65536 0 0 0 16 /end COMPU_METHOD
/begin COMPU_METHOD fak_uw_b2 "" RAT_FUNC "%7.6" "-" COEFFS 0 65536 0 0 0 2 /end COMPU_METHOD
/begin COMPU_METHOD fak_uw_b4 "" RAT_FUNC "%7.6" "-" COEFFS 0 65536 0 0 0 4 /end COMPU_METHOD
/begin COMPU_METHOD fak_uw_b5 "" RAT_FUNC "%7.6" "-" COEFFS 0 65536 0 0 0 5 /end COMPU_METHOD
/begin COMPU_METHOD m_ub_b23p3 "" RAT_FUNC "%6.3" "kg" COEFFS 0 2812.5 0 0 0 256 /end COMPU_METHOD
/begin COMPU_METHOD m_ub_b780 "" RAT_FUNC "%6.2" "cm^3/min" COEFFS 0 256 0 0 0 780 /end COMPU_METHOD
/begin COMPU_METHOD m_uw_b6553p5 "" RAT_FUNC "%6.3" "kg/h" COEFFS 0 1 0 0 0 0.1 /end COMPU_METHOD
/begin COMPU_METHOD nmotd_sb_q10 "" RAT_FUNC "%6.1" "U/min" COEFFS 0 1 0 0 0 10 /end COMPU_METHOD
/begin COMPU_METHOD nmotg_sb_q100 "" RAT_FUNC "%6.0" "U/min/s" COEFFS 0 1 0 0 0 100 /end COMPU_METHOD
/begin COMPU_METHOD nmotg_sw_q0p39 "" RAT_FUNC "%6.3" "U/min/s" COEFFS 0 1 0 0 0 0.39063 /end COMPU_METHOD
/begin COMPU_METHOD nmotg_ub_q100 "" RAT_FUNC "%6.0" "U/min/s" COEFFS 0 1 0 0 0 100 /end COMPU_METHOD
/begin COMPU_METHOD nmot_q1 "" RAT_FUNC "%6.2" "U/min" COEFFS 0 1 0 0 0 1 /end COMPU_METHOD
/begin COMPU_METHOD nmot_sw_q0p25 "" RAT_FUNC "%6.3" "U/min" COEFFS 0 1 0 0 0 0.25 /end COMPU_METHOD
/begin COMPU_METHOD nmot_ub_q10 "" RAT_FUNC "%6.1" "U/min" COEFFS 0 1 0 0 0 10 /end COMPU_METHOD
/begin COMPU_METHOD nmot_ub_q40 "" RAT_FUNC "%6.1" "Upm" COEFFS 0 1 0 0 0 40 /end COMPU_METHOD
/begin COMPU_METHOD nmot_uw_q0p25 "" RAT_FUNC "%6.3" "U/min" COEFFS 0 1 0 0 0 0.25 /end COMPU_METHOD
/begin COMPU_METHOD p_sb_q10 "" RAT_FUNC "%6.1" "hPa" COEFFS 0 1 0 0 0 10 /end COMPU_METHOD
/begin COMPU_METHOD p_ub_q10 "" RAT_FUNC "%6.1" "hPa" COEFFS 0 1 0 0 0 10 /end COMPU_METHOD
/begin COMPU_METHOD p_ub_q5 "" RAT_FUNC "%6.2" "hPa" COEFFS 0 1 0 0 0 5 /end COMPU_METHOD
/begin COMPU_METHOD p_uw_q0p039 "" RAT_FUNC "%6.4" "hPa" COEFFS 0 256 0 0 0 10 /end COMPU_METHOD
/begin COMPU_METHOD relDK_ub_b100 "" RAT_FUNC "%6.3" "% DK" COEFFS 0 255 0 0 0 100 /end COMPU_METHOD
/begin COMPU_METHOD relPED_ub_b100 "" RAT_FUNC "%6.3" "% PED" COEFFS 0 255 0 0 0 100 /end COMPU_METHOD
/begin COMPU_METHOD rel_q0p002383 "" RAT_FUNC "%6.4" "%/(s*U/min)" COEFFS 0 256 0 0 0 0.61 /end COMPU_METHOD
/begin COMPU_METHOD rel_q0p00305 "" RAT_FUNC "%6.4" "%/(U/min)" COEFFS 0 256 0 0 0 0.7812 /end COMPU_METHOD
/begin COMPU_METHOD rel_q1p5 "" RAT_FUNC "%6.2" "%" COEFFS 0 1 0 0 0 1.5 /end COMPU_METHOD
/begin COMPU_METHOD rel_qn0p000488 "" RAT_FUNC "%8.7" "(%*s)/(U/min)" COEFFS 0 -256 0 0 0 0.125 /end COMPU_METHOD
/begin COMPU_METHOD rel_sb_q0p39 "" RAT_FUNC "%6.3" "%" COEFFS 0 1 0 0 0 0.3906 /end COMPU_METHOD
/begin COMPU_METHOD rel_sw_b100 "" RAT_FUNC "%6.4" "%" COEFFS 0 32768 0 0 0 100 /end COMPU_METHOD
/begin COMPU_METHOD rel_sw_b1536 "" RAT_FUNC "%6.4" "%" COEFFS 0 65536 0 0 0 3072 /end COMPU_METHOD
/begin COMPU_METHOD rel_sw_b192 "" RAT_FUNC "%6.4" "%" COEFFS 0 65536 0 0 0 384 /end COMPU_METHOD
/begin COMPU_METHOD rel_sw_b50 "" RAT_FUNC "%6.4" "%" COEFFS 0 65536 0 0 0 100 /end COMPU_METHOD
/begin COMPU_METHOD rel_sw_q0p0234 "" RAT_FUNC "%6.4" "%/seg" COEFFS 0 32 0 0 0 0.75 /end COMPU_METHOD
/begin COMPU_METHOD rel_ub_b127p5 "" RAT_FUNC "%6.3" "%" COEFFS 0 2 0 0 0 1 /end COMPU_METHOD
/begin COMPU_METHOD rel_ub_b1p0 "" RAT_FUNC "%6.4" "%" COEFFS 0 256 0 0 0 1 /end COMPU_METHOD
/begin COMPU_METHOD rel_ub_b24p9 "" RAT_FUNC "%6.3" "%" COEFFS 0 255 0 0 0 24.9 /end COMPU_METHOD
/begin COMPU_METHOD rel_ub_b99p6 "" RAT_FUNC "%6.3" "%" COEFFS 0 256 0 0 0 100 /end COMPU_METHOD
/begin COMPU_METHOD rel_ub_bn24p9 "" RAT_FUNC "%6.5" "%" COEFFS 0 -255 0 0 0 24.9 /end COMPU_METHOD
/begin COMPU_METHOD rel_ub_bn6p375 "" RAT_FUNC "%6.5" "%" COEFFS 0 -255 0 0 0 6.375 /end COMPU_METHOD
/begin COMPU_METHOD rel_ub_q0p75 "" RAT_FUNC "%6.3" "%" COEFFS 0 1 0 0 0 0.75 /end COMPU_METHOD
/begin COMPU_METHOD rel_ub_q8 "" RAT_FUNC "%6.2" "%/s" COEFFS 0 1 0 0 0 8 /end COMPU_METHOD
/begin COMPU_METHOD rel_uw_b100 "" RAT_FUNC "%6.4" "%" COEFFS 0 65536 0 0 0 100 /end COMPU_METHOD
/begin COMPU_METHOD rel_uw_b200 "" RAT_FUNC "%6.4" "%" COEFFS 0 65536 0 0 0 200 /end COMPU_METHOD
/begin COMPU_METHOD rel_uw_b3276p75 "" RAT_FUNC "%6.4" "%/100hPa" COEFFS 0 1 0 0 0 0.05 /end COMPU_METHOD
/begin COMPU_METHOD rel_uw_q0p0234 "" RAT_FUNC "%6.4" "%" COEFFS 0 32 0 0 0 0.75 /end COMPU_METHOD
/begin COMPU_METHOD spg_ub_b320 "" RAT_FUNC "%6.2" "V" COEFFS 0 1 0 0 0 1.25 /end COMPU_METHOD
/begin COMPU_METHOD spg_ub_b5 "" RAT_FUNC "%6.4" "V" COEFFS 0 256 0 0 0 5 /end COMPU_METHOD
/begin COMPU_METHOD t100msxs_ub_b25p5 "" RAT_FUNC "%6.3" "s" COEFFS 0 1 0 0 0 0.1 /end COMPU_METHOD
/begin COMPU_METHOD t100msxs_uw_b6553p5 "" RAT_FUNC "%6.3" "s" COEFFS 0 1 0 0 0 0.1 /end COMPU_METHOD
/begin COMPU_METHOD t10msxs_uw_b655p35 "" RAT_FUNC "%6.4" "s" COEFFS 0 1 0 0 0 0.01 /end COMPU_METHOD
/begin COMPU_METHOD t1sxs_ub_b255 "" RAT_FUNC "%6.2" "s" COEFFS 0 1 0 0 0 1 /end COMPU_METHOD
/begin COMPU_METHOD t1sxs_uw_q1 "" RAT_FUNC "%6.2" "s" COEFFS 0 1 0 0 0 1 /end COMPU_METHOD
/begin COMPU_METHOD t200msxs_ub_b51 "" RAT_FUNC "%6.3" "s" COEFFS 0 1 0 0 0 0.2 /end COMPU_METHOD
/begin COMPU_METHOD t200msxs_uw_q0p2 "" RAT_FUNC "%6.3" "s" COEFFS 0 1 0 0 0 0.2 /end COMPU_METHOD
/begin COMPU_METHOD t20msxs_ub_b5p1 "" RAT_FUNC "%6.4" "s" COEFFS 0 1 0 0 0 0.02 /end COMPU_METHOD
/begin COMPU_METHOD t50msxs_ub_b12p75 "" RAT_FUNC "%6.4" "s" COEFFS 0 1 0 0 0 0.05 /end COMPU_METHOD
/begin COMPU_METHOD t50msxs_uw_b3276p75 "" RAT_FUNC "%6.4" "s" COEFFS 0 1 0 0 0 0.05 /end COMPU_METHOD
/begin COMPU_METHOD temp_ub_b191p25 "" RAT_FUNC "%6.3" "Grad C" COEFFS 0 1 0 0 0 0.75 /end COMPU_METHOD
/begin COMPU_METHOD temp_ub_q0p75_o48 "" RAT_FUNC "%6.2" "Grad C" COEFFS 0 1 48 0 0 0.75 /end COMPU_METHOD
/begin COMPU_METHOD temp_ub_q1_o60 "" RAT_FUNC "%6.2" "Grad C" COEFFS 0 1 60 0 0 1 /end COMPU_METHOD
/begin COMPU_METHOD temp_uw_q0p0195 "" RAT_FUNC "%6.4" "Grad C" COEFFS 0 256 0 0 0 5 /end COMPU_METHOD
/begin COMPU_METHOD temp_uw_q0p0195_o50 "" RAT_FUNC "%6.2" "Grad C" COEFFS 0 256 12800 0 0 5 /end COMPU_METHOD
/begin COMPU_METHOD tv_q0p001028 "" RAT_FUNC "%6.4" "%" COEFFS 0 1 0 0 0 0.001028 /end COMPU_METHOD
/begin COMPU_METHOD tv_sw_q0p005 "" RAT_FUNC "%6.4" "%" COEFFS 0 1 0 0 0 0.005 /end COMPU_METHOD
/begin COMPU_METHOD tv_ub_b100 "" RAT_FUNC "%6.3" "%" COEFFS 0 256 0 0 0 100 /end COMPU_METHOD
/begin COMPU_METHOD tv_ub_q0p64 "" RAT_FUNC "%6.3" "%" COEFFS 0 100 0 0 0 64 /end COMPU_METHOD
/begin COMPU_METHOD tv_uw_q0p005 "" RAT_FUNC "%6.4" "%" COEFFS 0 1 0 0 0 0.005 /end COMPU_METHOD
/begin COMPU_METHOD uefktget_ub_b25p4 "" RAT_FUNC "%6.3" "" COEFFS 0 10 0 0 0 1 /end COMPU_METHOD
/begin COMPU_METHOD vfzg_ub_q1p25 "" RAT_FUNC "%6.2" "km/h" COEFFS 0 1 0 0 0 1.25 /end COMPU_METHOD
/begin COMPU_METHOD zk100msxs_ub_b25p5 "" RAT_FUNC "%6.3" "s" COEFFS 0 0 256 0 10 0 /end COMPU_METHOD
/begin COMPU_METHOD zk100msxs_uw_b6553 "" RAT_FUNC "%12.4" "s" COEFFS 0 0 65536 0 10 0 /end COMPU_METHOD
/begin COMPU_METHOD zk10msxs_uw_b655 "" RAT_FUNC "%12.5" "s" COEFFS 0 0 65536 0 100 0 /end COMPU_METHOD
/begin COMPU_METHOD zk200msxs_ub_b51p2 "" RAT_FUNC "%6.3" "s" COEFFS 0 0 255 0 5 0 /end COMPU_METHOD
/begin COMPU_METHOD zk200msxs_uw_b5 "" RAT_FUNC "%7.6" "1/s" COEFFS 0 65536 0 0 0 5 /end COMPU_METHOD
/begin COMPU_METHOD zk200msxs_uw_b960 "" RAT_FUNC "%6.4" "%/s" COEFFS 0 65536 0 0 0 960 /end COMPU_METHOD
/begin COMPU_METHOD zk20msxs_ub_b5p1 "" RAT_FUNC "%6.4" "s" COEFFS 0 0 5.1 0 1 0 /end COMPU_METHOD
/begin COMPU_METHOD zk50msxs_ub_b12p8 "" RAT_FUNC "%10.5" "s" COEFFS 0 0 128 0 10 0 /end COMPU_METHOD
/begin COMPU_METHOD zk50msxs_uw_b3276p8 "" RAT_FUNC "%12.4" "s" COEFFS 0 0 65536 0 20 0 /end COMPU_METHOD
/begin COMPU_METHOD zw_q0p1875 "" RAT_FUNC "%6.3" "Grad KW" COEFFS 0 1 0 0 0 0.1875 /end COMPU_METHOD
/begin COMPU_METHOD zw_sb_q0p75 "" RAT_FUNC "%6.3" "grad KW" COEFFS 0 255 0 0 0 191.25 /end COMPU_METHOD
/begin COMPU_METHOD zw_ub_q0p75 "" RAT_FUNC "%6.3" "Grad KW" COEFFS 0 255 0 0 0 191.25 /end COMPU_METHOD
/begin COMPU_METHOD zw_ub_qn0p75 "" RAT_FUNC "%6.4" "grad KW" COEFFS 0 1 0 0 0 -0.75 /end COMPU_METHOD
/begin RECORD_LAYOUT FklWUb FNC_VALUES 1 UBYTE COLUMN_DIR DIRECT /end RECORD_LAYOUT
/begin RECORD_LAYOUT GkfWSb FNC_VALUES 1 SBYTE COLUMN_DIR DIRECT /end RECORD_LAYOUT
/begin RECORD_LAYOUT GkfWSw FNC_VALUES 1 SWORD COLUMN_DIR DIRECT /end RECORD_LAYOUT
/begin RECORD_LAYOUT GkfWUb FNC_VALUES 1 UBYTE COLUMN_DIR DIRECT /end RECORD_LAYOUT
/begin RECORD_LAYOUT GkfWUw FNC_VALUES 1 UWORD COLUMN_DIR DIRECT /end RECORD_LAYOUT
/begin RECORD_LAYOUT GklWSb FNC_VALUES 1 SBYTE COLUMN_DIR DIRECT /end RECORD_LAYOUT
/begin RECORD_LAYOUT GklWSw FNC_VALUES 1 SWORD COLUMN_DIR DIRECT /end RECORD_LAYOUT
/begin RECORD_LAYOUT GklWUb FNC_VALUES 1 UBYTE COLUMN_DIR DIRECT /end RECORD_LAYOUT
/begin RECORD_LAYOUT GklWUw FNC_VALUES 1 UWORD COLUMN_DIR DIRECT /end RECORD_LAYOUT
/begin RECORD_LAYOUT KfAxUbAyUbSstxSwSstyUbWSw NO_AXIS_PTS_X 1 UBYTE NO_AXIS_PTS_Y 2 UBYTE AXIS_PTS_X 3 SWORD INDEX_INCR DIRECT AXIS_PTS_Y 4 UBYTE INDEX_INCR DIRECT FNC_VALUES 5 SWORD COLUMN_DIR DIRECT /end RECORD_LAYOUT
/begin RECORD_LAYOUT KfAxUbAyUbSstxUbSstyUbWSb NO_AXIS_PTS_X 1 UBYTE NO_AXIS_PTS_Y 2 UBYTE AXIS_PTS_X 3 UBYTE INDEX_INCR DIRECT AXIS_PTS_Y 4 UBYTE INDEX_INCR DIRECT FNC_VALUES 5 SBYTE COLUMN_DIR DIRECT /end RECORD_LAYOUT
/begin RECORD_LAYOUT KfAxUbAyUbSstxUbSstyUbWUb NO_AXIS_PTS_X 1 UBYTE NO_AXIS_PTS_Y 2 UBYTE AXIS_PTS_X 3 UBYTE INDEX_INCR DIRECT AXIS_PTS_Y 4 UBYTE INDEX_INCR DIRECT FNC_VALUES 5 UBYTE COLUMN_DIR DIRECT /end RECORD_LAYOUT
/begin RECORD_LAYOUT KfAxUbAyUbSstxUbSstyUwWUb NO_AXIS_PTS_X 1 UBYTE NO_AXIS_PTS_Y 2 UBYTE AXIS_PTS_X 3 UBYTE INDEX_INCR DIRECT AXIS_PTS_Y 4 UWORD INDEX_INCR DIRECT FNC_VALUES 5 UBYTE COLUMN_DIR DIRECT /end RECORD_LAYOUT
/begin RECORD_LAYOUT KfAxUbAyUbSstxUbSstyUwWUw NO_AXIS_PTS_X 1 UBYTE NO_AXIS_PTS_Y 2 UBYTE AXIS_PTS_X 3 UBYTE INDEX_INCR DIRECT AXIS_PTS_Y 4 UWORD INDEX_INCR DIRECT FNC_VALUES 5 UWORD COLUMN_DIR DIRECT /end RECORD_LAYOUT
/begin RECORD_LAYOUT KfAxUbAyUbSstxUwSstyUwWUw NO_AXIS_PTS_X 1 UWORD NO_AXIS_PTS_Y 2 UWORD AXIS_PTS_X 3 UWORD INDEX_INCR DIRECT AXIS_PTS_Y 4 UWORD INDEX_INCR DIRECT FNC_VALUES 5 UWORD COLUMN_DIR DIRECT /end RECORD_LAYOUT
/begin RECORD_LAYOUT KfAxUwAyUwSstxUwSstyUwWUw NO_AXIS_PTS_X 1 UWORD NO_AXIS_PTS_Y 2 UWORD AXIS_PTS_X 3 UWORD INDEX_INCR DIRECT AXIS_PTS_Y 4 UWORD INDEX_INCR DIRECT FNC_VALUES 5 UWORD COLUMN_DIR DIRECT /end RECORD_LAYOUT
/begin RECORD_LAYOUT KlAUbSstSbWUb NO_AXIS_PTS_X 1 UBYTE AXIS_PTS_X 2 SBYTE INDEX_INCR DIRECT FNC_VALUES 3 UBYTE COLUMN_DIR DIRECT /end RECORD_LAYOUT
/begin RECORD_LAYOUT KlAUbSstUbWSb NO_AXIS_PTS_X 1 UBYTE AXIS_PTS_X 2 UBYTE INDEX_INCR DIRECT FNC_VALUES 3 SBYTE COLUMN_DIR DIRECT /end RECORD_LAYOUT
/begin RECORD_LAYOUT KlAUbSstUbWUb NO_AXIS_PTS_X 1 UBYTE AXIS_PTS_X 2 UBYTE INDEX_INCR DIRECT FNC_VALUES 3 UBYTE COLUMN_DIR DIRECT /end RECORD_LAYOUT
/begin RECORD_LAYOUT KlAUbSstUbWUw NO_AXIS_PTS_X 1 UBYTE AXIS_PTS_X 2 UBYTE INDEX_INCR DIRECT FNC_VALUES 3 UWORD COLUMN_DIR DIRECT /end RECORD_LAYOUT
/begin RECORD_LAYOUT KlAUbSstUwWUw NO_AXIS_PTS_X 1 UWORD AXIS_PTS_X 2 UWORD INDEX_INCR DIRECT FNC_VALUES 3 UWORD COLUMN_DIR DIRECT /end RECORD_LAYOUT
/begin RECORD_LAYOUT KlAUwSstUwWUw NO_AXIS_PTS_X 1 UWORD AXIS_PTS_X 2 UWORD INDEX_INCR DIRECT FNC_VALUES 3 UWORD COLUMN_DIR DIRECT /end RECORD_LAYOUT
/begin RECORD_LAYOUT KwbUb FNC_VALUES 1 UBYTE COLUMN_DIR DIRECT /end RECORD_LAYOUT
/begin RECORD_LAYOUT KwSb FNC_VALUES 1 SBYTE COLUMN_DIR DIRECT /end RECORD_LAYOUT
/begin RECORD_LAYOUT KwSw FNC_VALUES 1 SWORD COLUMN_DIR DIRECT /end RECORD_LAYOUT
/begin RECORD_LAYOUT KwUb FNC_VALUES 1 UBYTE COLUMN_DIR DIRECT /end RECORD_LAYOUT
/begin RECORD_LAYOUT KwUw FNC_VALUES 1 UWORD COLUMN_DIR DIRECT /end RECORD_LAYOUT
/begin RECORD_LAYOUT SstASwSstSw NO_AXIS_PTS_X 1 SWORD AXIS_PTS_X 2 SWORD INDEX_INCR DIRECT /end RECORD_LAYOUT
/begin RECORD_LAYOUT SstAUbSstSb NO_AXIS_PTS_X 1 UBYTE AXIS_PTS_X 2 SBYTE INDEX_INCR DIRECT /end RECORD_LAYOUT
/begin RECORD_LAYOUT SstAUbSstSw NO_AXIS_PTS_X 1 SWORD AXIS_PTS_X 2 SWORD INDEX_INCR DIRECT /end RECORD_LAYOUT
/begin RECORD_LAYOUT SstAUbSstUb NO_AXIS_PTS_X 1 UBYTE AXIS_PTS_X 2 UBYTE INDEX_INCR DIRECT /end RECORD_LAYOUT
/begin RECORD_LAYOUT SstAUbSstUw NO_AXIS_PTS_X 1 UWORD AXIS_PTS_X 2 UWORD INDEX_INCR DIRECT /end RECORD_LAYOUT
/begin RECORD_LAYOUT SstAUwSstUw NO_AXIS_PTS_X 1 UWORD AXIS_PTS_X 2 UWORD INDEX_INCR DIRECT /end RECORD_LAYOUT
/end MODULE
/end PROJECT
