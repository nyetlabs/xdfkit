ASAP2_VERSION 1 3
/begin PROJECT X505P_24HG_1 "X505P"
/begin HEADER "" VERSION "X505P_24HG_1" PROJECT_NO X505P_24HG_1 /end HEADER
/begin MODULE DIM ""
/begin MOD_COMMON "" BYTE_ORDER MSB_LAST ALIGNMENT_BYTE 1 ALIGNMENT_WORD 2 ALIGNMENT_LONG 2 /end MOD_COMMON
/begin CHARACTERISTIC AGANGW "Anzahl Gangwechsel für Diagnose Kupplungsschalter" VALUE 0x8186F7 KwUb 255.0 dez 0.00 255.0 FORMAT "%5.1" /end CHARACTERISTIC
/begin CHARACTERISTIC AKUPPLB "Anzahl Kupplung betätigt für Diagnose Kupplungsschalter" VALUE 0x8186F8 KwUb 255.0 dez 0.00 255.0 FORMAT "%5.1" /end CHARACTERISTIC
/begin CHARACTERISTIC ANZDYNSH "Anzahl der Dynamikmessungen für Schwingungsprüfung Sonde hinter KAT" VALUE 0x818648 KwUb 255.0 dez 0.00 255.0 FORMAT "%5.1" /end CHARACTERISTIC
/begin CHARACTERISTIC ANZFEHLER "Anzahl der Fehler, bis Eintrag in Fehlerspeicher erfolgt" VALUE 0x8187D2 KwUb 255.0 DEZ 0.00 255.0 FORMAT "%5.1" /end CHARACTERISTIC
/begin CHARACTERISTIC APKTDI "Anzahl interner Prüfungen der Katalysatordiagnose" VALUE 0x8186AB KwUb 254.0 dez 1.000 255.0 FORMAT "%5.1" /end CHARACTERISTIC
/begin CHARACTERISTIC APKTDIT "Anzahl interner Prüfungen der Katalysatordiagnose, Testerbetrieb" VALUE 0x8186AC KwUb 254.0 dez 1.000 255.0 FORMAT "%5.1" /end CHARACTERISTIC
/begin CHARACTERISTIC APKTDX "Maximale Anzahl der Prüfungen bei Katdiagnose" VALUE 0x8186AD KwUb 255.0 dez 0.00 255.0 FORMAT "%5.1" /end CHARACTERISTIC
/begin CHARACTERISTIC APULSMX "Maximale Anzahl Impulse bei Einzelimpulsansteuerung" VALUE 0x812144 KwUb 255.0 dez 0.00 255.0 FORMAT "%5.1" /end CHARACTERISTIC
/begin CHARACTERISTIC AVKATFS "Setztwert für avkatf bei Powerfail" VALUE 0x8186AE KwUb 0.9961 fak_ub_b1 0.00 0.9961 /end CHARACTERISTIC
/begin CHARACTERISTIC BLDPMX "Max. Fahrzeugbeschleunigung bei 0.5 mm - Diagnose" VALUE 0x828002 KwSw 13.8899313 bfzg_sw_q4p239Em4 0.00 13.8899313 /end CHARACTERISTIC
/begin CHARACTERISTIC CDCAATUN "Codewort CARB: Tuningschutz" VAL_BLK 0x81425C KwbUw 65535.00 dez 0.00 65535.00 FORMAT "%8.2" NUMBER 4 /end CHARACTERISTIC
/begin CHARACTERISTIC CDCLDPE "Codewort CARB: Leckdiagnosepumpe Endstufe" VAL_BLK 0x81451C KwbUw 65535.00 dez 0.00 65535.00 FORMAT "%8.2" NUMBER 4 /end CHARACTERISTIC
/begin CHARACTERISTIC CDCMDB "Codewort CARB: Momentbegrenzung Sollmoment" VAL_BLK 0x814594 KwbUw 65535.00 dez 0.00 65535.00 FORMAT "%8.2" NUMBER 4 /end CHARACTERISTIC
/begin CHARACTERISTIC CDCSGEEW "Codewort CARB: Steuergerät defekt (EEPROM WFS-Bereich)" VAL_BLK 0x8145FC KwbUw 65535.00 dez 0.00 65535.00 FORMAT "%8.2" NUMBER 4 /end CHARACTERISTIC
/begin CHARACTERISTIC CDCWFS "Codewort CARB: Wegfahrsperre" VAL_BLK 0x8146E4 KwbUw 65535.00 dez 0.00 65535.00 FORMAT "%8.2" NUMBER 4 /end CHARACTERISTIC
/begin CHARACTERISTIC CDCWFSRC "Codewort CARB: Wegfahrsperre RC-Glied" VAL_BLK 0x8146EC KwbUw 65535.00 dez 0.00 65535.00 FORMAT "%8.2" NUMBER 4 /end CHARACTERISTIC
/begin CHARACTERISTIC CDKAATUN "" VAL_BLK 0x814724 KwbUw 65535.00 dez 0.00 65535.00 FORMAT "%8.2" NUMBER 4 /end CHARACTERISTIC
/begin CHARACTERISTIC CDKLDPE "Codewort Kunde: Leckdiagnosepumpe Endstufe" VAL_BLK 0x8149E4 KwbUw 65535.00 dez 0.00 65535.00 FORMAT "%8.2" NUMBER 4 /end CHARACTERISTIC
/begin CHARACTERISTIC CDKMDB "Codewort Kunde: Momentbegrenzung Sollmoment" VAL_BLK 0x814A5C KwbUw 65535.00 dez 0.00 65535.00 FORMAT "%8.2" NUMBER 4 /end CHARACTERISTIC
/begin CHARACTERISTIC CDKSGEEW "Codewort Kunde: Steuergerät defekt (EEPROM WFS-Bereich)" VAL_BLK 0x814AC4 KwbUw 65535.00 dez 0.00 65535.00 FORMAT "%8.2" NUMBER 4 /end CHARACTERISTIC
/begin CHARACTERISTIC CDKWFS "Codewort Kunde: Wegfahrsperre" VAL_BLK 0x814BAC KwbUw 65535.00 dez 0.00 65535.00 FORMAT "%8.2" NUMBER 4 /end CHARACTERISTIC
/begin CHARACTERISTIC CDKWFSRC "Codewort Kunde: Wegfahrsperre RC-Glied" VAL_BLK 0x814BB4 KwbUw 65535.00 dez 0.00 65535.00 FORMAT "%8.2" NUMBER 4 /end CHARACTERISTIC
/begin CHARACTERISTIC CDTAATUN "Codewort Tester: Tuningschutz" VALUE 0x814BE6 KwUw 65535.00 dez 0.00 65535.00 FORMAT "%8.2" /end CHARACTERISTIC
/begin CHARACTERISTIC CDTLDPE "Codewort Tester: Leckdiagnosepumpe Endstufe" VALUE 0x814C96 KwUw 65535.00 dez 0.00 65535.00 FORMAT "%8.2" /end CHARACTERISTIC
/begin CHARACTERISTIC CDTMDB "Codewort Tester: Momentbegrenzung Sollmoment" VALUE 0x814CB4 KwUw 65535.00 dez 0.00 65535.00 FORMAT "%8.2" /end CHARACTERISTIC
/begin CHARACTERISTIC CDTSGEEW "Codewort Tester: Steuergerät defekt (EEPROM WFS-Bereich)" VALUE 0x814CCE KwUw 65535.00 dez 0.00 65535.00 FORMAT "%8.2" /end CHARACTERISTIC
/begin CHARACTERISTIC CDTWFS "Codewort Tester: Wegfahrsperre" VALUE 0x814D08 KwUw 65535.00 dez 0.00 65535.00 FORMAT "%8.2" /end CHARACTERISTIC
/begin CHARACTERISTIC CDTWFSRC "Codewort Tester: Wegfahrsperre RC-Glied" VALUE 0x814D0A KwUw 65535.00 dez 0.00 65535.00 FORMAT "%8.2" /end CHARACTERISTIC
/begin CHARACTERISTIC CIDKATSP "Component Identifier für aktive Katalysatordiagnose" VALUE 0x8186AF KwUb 127.0 dez 0.00 127.0 FORMAT "%5.1" /end CHARACTERISTIC
/begin CHARACTERISTIC CIDKATSPI "Component Identifier für Katalysatordiagnose mittels Katalysatorausräumen" VALUE 0x8186B0 KwUb 127.0 dez 0.00 127.0 FORMAT "%5.1" /end CHARACTERISTIC
/begin CHARACTERISTIC CIDKATSPT "Component Identifier für Katalysatordiagnose, Testerbetrieb" VALUE 0x8186B1 KwUb 127.0 dez 0.00 127.0 FORMAT "%5.1" /end CHARACTERISTIC
/begin CHARACTERISTIC CLAAATUN "Fehlerklasse: Tuningschutz" VALUE 0x8108D1 KwUb 255.0 dez 0.00 255.0 FORMAT "%5.1" /end CHARACTERISTIC
/begin CHARACTERISTIC CLALDPE "Fehlerklasse: LDP  Endstufe" VALUE 0x810929 KwUb 255.0 dez 0.00 255.0 FORMAT "%5.1" /end CHARACTERISTIC
/begin CHARACTERISTIC CLAMDB "Fehlerklasse: Momentbgrenzung Sollmoment" VALUE 0x810938 KwUb 255.0 dez 0.00 255.0 FORMAT "%5.1" /end CHARACTERISTIC
/begin CHARACTERISTIC CLASGEEW "Fehlerklasse: SG defekt (EEPROM WFS- Bereich)" VALUE 0x810945 KwUb 255.0 dez 0.00 255.0 FORMAT "%5.1" /end CHARACTERISTIC
/begin CHARACTERISTIC CLAWFS "Fehlerklasse: Wegfahrsperre" VALUE 0x810962 KwUb 255.0 dez 0.00 255.0 FORMAT "%5.1" /end CHARACTERISTIC
/begin CHARACTERISTIC CLAWFSRC "Fehlerklasse: Wegfahrsperre RC-Glied" VALUE 0x810963 KwUb 255.0 dez 0.00 255.0 FORMAT "%5.1" /end CHARACTERISTIC
/begin CHARACTERISTIC CLDPAAV "Codewort Elektrisches AAV vorhanden" VALUE 0x812145 KwUb 255.0 dez 0.00 255.0 FORMAT "%5.1" /end CHARACTERISTIC
/begin CHARACTERISTIC CLDPTVC "Codewort DLDP-TEV- Check" VALUE 0x81A4AC KwUb 255.0 dez 0.00 255.0 FORMAT "%5.1" /end CHARACTERISTIC
/begin CHARACTERISTIC CPLRA "Codewort für Umschaltung DKVS von HFM- auf P-System" VALUE 0x81948B KwUb 255.0 dez 0.00 255.0 FORMAT "%5.1" /end CHARACTERISTIC
/begin CHARACTERISTIC CWBAESEL "Codewort für Umschaltung Bergaberkennung usw." VALUE 0x812146 KwUb 255.0 dez 0.00 255.0 FORMAT "%5.1" /end CHARACTERISTIC
/begin CHARACTERISTIC CWDHFM "Codewort in DHFM" VALUE 0x810EA7 KwUb 255.0 dez 0.00 255.0 FORMAT "%5.1" /end CHARACTERISTIC
/begin CHARACTERISTIC CWDHLSH "Codewort in DHLSHK" VALUE 0x818475 KwUb 255.0 dez 0.00 255.0 FORMAT "%5.1" /end CHARACTERISTIC
/begin CHARACTERISTIC CWDKATSP "Codewort Katalysatordiagnose %DKATSP" VALUE 0x8186B2 KwUb 255.0 dez 0.00 255.0 FORMAT "%5.1" /end CHARACTERISTIC
/begin CHARACTERISTIC CWDKRNT "Codewort: KR-Diagnose Integratorsteigung" VALUE 0x811585 KwUb 255.0 dez 0.00 255.0 FORMAT "%5.1" /end CHARACTERISTIC
/begin CHARACTERISTIC CWDKROF "Codewort: KR-Diagnose Resetwert" VALUE 0x811586 KwUb 255.0 dez 0.00 255.0 FORMAT "%5.1" /end CHARACTERISTIC
/begin CHARACTERISTIC CWDKRTP "Codewort: KR-Diagnose Testimpuls" VALUE 0x81158A KwUb 255.0 dez 0.00 255.0 FORMAT "%5.1" /end CHARACTERISTIC
/begin CHARACTERISTIC CWDKS1 "Codewort: Klopfsensordiagnose Sensor1" VALUE 0x819BAE KwUb 255.0 dez 0.00 255.0 FORMAT "%5.1" /end CHARACTERISTIC
/begin CHARACTERISTIC CWDKS2 "Codewort: Klopfsensordiagnose Sensor 2" VALUE 0x819BAF KwUb 255.0 dez 0.00 255.0 FORMAT "%5.1" /end CHARACTERISTIC
/begin CHARACTERISTIC CWDKS3 "Codewort: Klopfsensordiagnose Sensor 3" VALUE 0x819BB0 KwUb 255.0 dez 0.00 255.0 FORMAT "%5.1" /end CHARACTERISTIC
/begin CHARACTERISTIC CWDKS4 "Codewort: Klopfsensordiagnose Sensor 4" VALUE 0x819BB1 KwUb 255.0 dez 0.00 255.0 FORMAT "%5.1" /end CHARACTERISTIC
/begin CHARACTERISTIC CWDKVSS "Codewort für Error in DKVS sperren, wenn andere Fehler vorliegen" VALUE 0x81948C KwUb 255.0 dez 0.00 255.0 FORMAT "%5.1" /end CHARACTERISTIC
/begin CHARACTERISTIC CWDLDP "Codewort Leckdiagnose DLDP" VALUE 0x81A4AD KwUb 255.0 dez 0.00 255.0 FORMAT "%5.1" /end CHARACTERISTIC
/begin CHARACTERISTIC CWDLDUV "Codeword für Diagnose Schubumluftventil" VALUE 0x8187C1 KwUb 255.0 dez 0.00 255.0 FORMAT "%5.1" /end CHARACTERISTIC
/begin CHARACTERISTIC CWDLSAHK "Codewort CWDLSAHK für Alterung Sonde hinter KAT" VALUE 0x818649 KwUb 255.0 dez 0.00 255.0 FORMAT "%5.1" /end CHARACTERISTIC
/begin CHARACTERISTIC CWKATSLK "Codewort für B_lrka aktiv" VALUE 0x8186BD KwUb 255.0 dez 0.00 255.0 FORMAT "%5.1" /end CHARACTERISTIC
/begin CHARACTERISTIC DASA "Anzahl der SAS-Phasen zur Erkennung LLS Fehler" VALUE 0x81A07F KwUb 255.0 dez 0.00 255.0 FORMAT "%5.1" /end CHARACTERISTIC
/begin CHARACTERISTIC DELTATA "Delta  Ansauglufttemperatur zu Starttemperatur des Motors" VALUE 0x81A4AE KwSb 191.3 temp_ub_q0p75 -96.00 95.25 FORMAT "%5.2" /end CHARACTERISTIC
/begin CHARACTERISTIC DFRMST "Delta frm-Schwelle für Erkennung der eingeschwungenen Lambdaregelung" VALUE 0x81948D KwUb 1.992 fak_ub_b2 0.00 1.992 FORMAT "%5.3" /end CHARACTERISTIC
/begin CHARACTERISTIC DKLDPN "Maximaler Drosselklappenwinkel bei Leckdiagnose" CURVE 0x812147 KlAUbSstUbWUb 100.0 relDK_ub_b100 0.00 100.0 FORMAT "%5.1"
 /begin AXIS_DESCR STD_AXIS nmot nmot_ub_q40 6 0.00 10200. FORMAT "%5.0" DEPOSIT ABSOLUTE /end AXIS_DESCR
/end CHARACTERISTIC
/begin CHARACTERISTIC DKRAMX "Maximale Anzahl Spätverstellungen für Klopfregelanschlag" VALUE 0x815C7A KwUw 65535.00 dez 0.00 65535.00 FORMAT "%8.2" /end CHARACTERISTIC
/begin CHARACTERISTIC DKRAZ "Zündungzähler für Klopfregelanschlag" VALUE 0x815C7C KwUw 65535.00 dez 0.00 65535.00 FORMAT "%8.2" /end CHARACTERISTIC
/begin CHARACTERISTIC DKROFN "Grenzwert der Integratorsteigung für Nulltest" CURVE 0x815C82 KlAUwSstUwWUw 7323.536 tknockintgrad_sy 0.00 7323.536 FORMAT "%8.3"
 /begin AXIS_DESCR STD_AXIS tmfln_w tknockcon_sy 6 0.00 0.1747600 FORMAT "%9.7" DEPOSIT ABSOLUTE /end AXIS_DESCR
/end CHARACTERISTIC
/begin CHARACTERISTIC DKROKU "Untere Drehzahlschwelle für Ermittlung Offsetkompensationswert" VALUE 0x811587 KwUb 10200. nmot_ub_q40 0.00 10200. FORMAT "%5.0" /end CHARACTERISTIC
/begin CHARACTERISTIC DKTLMT "Max. Dauer tL-/wdkbl- Grenzwertüberschreitung" CURVE 0x81A4AF KlAUbSstUbWUb 255.0 t1sxs_ub_b255 0.00 255.0 FORMAT "%5.1"
 /begin AXIS_DESCR STD_AXIS tfpg t1sxs_ub_b255 6 0.00 255.0 FORMAT "%5.1" DEPOSIT ABSOLUTE /end AXIS_DESCR
/end CHARACTERISTIC
/begin CHARACTERISTIC DLAMLASHF "Delta-Lambda-Sollwert (Fett) für Test Schwingungsprüfung hinter KAT" VALUE 0x81C39C KwUw 15.99976 fak_uw_b16 0.00 15.99976 FORMAT "%8.5" /end CHARACTERISTIC
/begin CHARACTERISTIC DLAMLASHM "Delta-Lambda-Sollwert (Mager) für Test Schwingungsprüfung hinter KAT" VALUE 0x81C39E KwUw 15.99976 fak_uw_b16 0.00 15.99976 FORMAT "%8.5" /end CHARACTERISTIC
/begin CHARACTERISTIC DLDUVES "Einschaltschwelle f(pspvds_w) für Schubumluftventildiagnose beim Turbo" VALUE 0x813BAE KwUw 2559.961 p_uw_q0p039 0.00 2559.961 FORMAT "%8.3" /end CHARACTERISTIC
/begin CHARACTERISTIC DLUL "Delta-Last für Überladeschutz-Reset" VALUE 0x819D4B KwSb 250.0 p_sb_q10 0.00 250.0 FORMAT "%5.1" /end CHARACTERISTIC
/begin CHARACTERISTIC DMLKTDO "Obere Schwelle ml-Änderung in Kat-Diagnose" VALUE 0x81C4A8 KwUw 6553.500 m_uw_b6553p5 0.00 6553.500 FORMAT "%8.3" /end CHARACTERISTIC
/begin CHARACTERISTIC DMRKTDS_0_A "Momentenreserve für Katalysator-Diagnose" VALUE 0x81C4A4 KwUw 99.99847 rel_uw_b100 0.00 99.99847 FORMAT "%8.5" /end CHARACTERISTIC
/begin CHARACTERISTIC DMRKTDS_1_A "Momentenreserve für Katalysator-Diagnose" VALUE 0x81C4A6 KwUw 99.99847 rel_uw_b100 0.00 99.99847 FORMAT "%8.5" /end CHARACTERISTIC
/begin CHARACTERISTIC DMRLASH "Momentenreserve für Diagnose Lambdasonden-Alterungsüberwachung hinter KAT" VALUE 0x81C3A0 KwUw 99.99847 rel_uw_b100 0.00 99.99847 FORMAT "%8.5" /end CHARACTERISTIC
/begin CHARACTERISTIC DNDLLRO "Maximale Drehzahlabweichung (Unterdrehzahl) für Diagnose LLR" VALUE 0x81A080 KwUb 1270. nmot_ub_q10 0.00 1270. FORMAT "%5.0" /end CHARACTERISTIC
/begin CHARACTERISTIC DNDLLRU "Maximale Drehzahlabweichung (Überdrehzahl) für Diagnose LLR" VALUE 0x81A081 KwSb 1280. nmot_ub_q10 -1280. 0.00 FORMAT "%5.0" /end CHARACTERISTIC
/begin CHARACTERISTIC DPUBABMX "Maximale Schwelle Delta Umgebungsdruck für Bergaberkennung" VALUE 0x81770C KwSw 2559.961 p_uw_q0p039 -1280.000 1279.961 FORMAT "%8.3" /end CHARACTERISTIC
/begin CHARACTERISTIC DPUFFMN "Minimale Schwelle für Delta-Umgebungsdruck, Bergauferkennung (0.5 mm - Diagnose)" VALUE 0x81770E KwSw 2559.961 p_uw_q0p039 -1280.000 1279.961 FORMAT "%8.3" /end CHARACTERISTIC
/begin CHARACTERISTIC DPUFFMX "Maximale Schwelle für Delta-Umgebungsdruck, Bergaberkennung (0.5 mm - Diagnose)" VALUE 0x817710 KwSw 2559.961 p_uw_q0p039 -1280.000 1279.961 FORMAT "%8.3" /end CHARACTERISTIC
/begin CHARACTERISTIC DPUFVMN "Spezifische Druckdifferenz für Saugrohrdrucküberwachung" VALUE 0x817712 KwSw 5119.922 p_uw_q0p078 -2560.000 2559.922 FORMAT "%8.3" /end CHARACTERISTIC
/begin CHARACTERISTIC DPUFVSMN "Soll-Druckdifferenz für Saugrohrdrucküberwachung" VALUE 0x817714 KwSw 5119.922 p_uw_q0p078 -2560.000 2559.922 FORMAT "%8.3" /end CHARACTERISTIC
/begin CHARACTERISTIC DPULSUV "Hysterese für Pulsationsschwelle Schubumluftventildiagnose beim Turbo" VALUE 0x8187C2 KwSb 1.992 fak_sb_b1 -1.000 0.9922 FORMAT "%5.3" /end CHARACTERISTIC
/begin CHARACTERISTIC DRLFFMX "Maximale Laständerung bei 0.5 mm - Diagnose" VALUE 0x817716 KwSw 767.9766 rel_sw_q0p0234 0.00 767.9766 FORMAT "%8.4" /end CHARACTERISTIC
/begin CHARACTERISTIC DTKTDGRAX "Katdiagnose: Maximaler Temperaturgradient" VALUE 0x8186BE KwUb 1275. temp_ub_q5 0.00 1275. FORMAT "%5.0" /end CHARACTERISTIC
/begin CHARACTERISTIC DTMFFU "Differenz Abstelltemperatur - tmot im Start für 0.5 mm - Diagnose" VALUE 0x81A4BC KwUb 191.3 temp_sb_q0p75 0.00 191.3 FORMAT "%5.1" /end CHARACTERISTIC
/begin CHARACTERISTIC DTMLDP "Differenz Motorabstelltemperatur - TMOT bei Start" VALUE 0x81A4BD KwUb 191.3 temp_sb_q0p75 0.00 191.3 FORMAT "%5.1" /end CHARACTERISTIC
/begin CHARACTERISTIC DTPLDP "Delta-Periodendauer zur Berechnung des Fensters bei Leckdiagnose" VALUE 0x817718 KwUw 655.3500 t10msxs_uw_b655p35 0.00 655.3500 FORMAT "%8.4" /end CHARACTERISTIC
/begin CHARACTERISTIC DTPXF "Delta-Periodendauer zur Berechnung des Fensters bei 0.5 mm - Diagnose" VALUE 0x81771A KwUw 655.3500 t10msxs_uw_b655p35 0.00 655.3500 FORMAT "%8.4" /end CHARACTERISTIC
/begin CHARACTERISTIC DVBABFF "Geschwindigkeitsdifferenz zur Bergaberkennung bei 0.5 mm - Diagnose" VALUE 0x81A4BE KwSb 318.8 vfzg_ub_q1p25 -160.0 158.8 FORMAT "%5.1" /end CHARACTERISTIC
/begin CHARACTERISTIC DVFZBAB "Geschwindigkeitsdifferenz zur Bergaberkennung" VALUE 0x81A4BF KwSb 318.8 vfzg_ub_q1p25 -160.0 158.8 FORMAT "%5.1" /end CHARACTERISTIC
/begin CHARACTERISTIC EBEN "Bypass-Hauptschalter" VALUE 0x810B3C KwUb 255.0 default 0.00 255.0 FORMAT "%5.1" /end CHARACTERISTIC
/begin CHARACTERISTIC EBMISS_T "if more messages are missing, the bypass communication is switched off" VALUE 0x813936 KwUw 65535.00 default 0.00 65535.00 FORMAT "%8.2" /end CHARACTERISTIC
/begin CHARACTERISTIC EBMISS_Y "if more messages are missing, the bypass communication is switched off" VALUE 0x813938 KwUw 65535.00 default 0.00 65535.00 FORMAT "%8.2" /end CHARACTERISTIC
/begin CHARACTERISTIC EDLDRP "Schwelle Regelabweichung für Diagnose LDR-Regelabweichung positiv" VALUE 0x819D4C KwSb 1270. p_sb_q10 0.00 1270. FORMAT "%5.0" /end CHARACTERISTIC
/begin CHARACTERISTIC ELDUVCLR "Schwelle zum Rücksetzen des Fehlers Schubumluftventil defekt beim Turbo" VALUE 0x8187C3 KwUb 255.0 DEZ 0.00 255.0 FORMAT "%5.1" /end CHARACTERISTIC
/begin CHARACTERISTIC ELDUVSET "Schwelle zum Setzen des Fehlers Schubumluftventil defekt beim Turbo" VALUE 0x8187C4 KwUb 255.0 DEZ 0.00 255.0 FORMAT "%5.1" /end CHARACTERISTIC
/begin CHARACTERISTIC FFTAATUN "Freeze Frame Tabelle: Tuningschutz" VAL_BLK 0x81096B KwbUb 255.0 dez 0.00 255.0 FORMAT "%5.1" NUMBER 2 /end CHARACTERISTIC
/begin CHARACTERISTIC FFTLDPE "Freeze Frame Tabelle: LDP Endstufe" VAL_BLK 0x810A1B KwbUb 255.0 dez 0.00 255.0 FORMAT "%5.1" NUMBER 2 /end CHARACTERISTIC
/begin CHARACTERISTIC FFTMDB "Freeze Frame Tabelle: Momentbegrenzung Sollmoment" VAL_BLK 0x810A39 KwbUb 255.0 dez 0.00 255.0 FORMAT "%5.1" NUMBER 2 /end CHARACTERISTIC
/begin CHARACTERISTIC FFTSGEEW "Freeze Frame Tabelle: SG defekt (EEPROM WFS- Bereich)" VAL_BLK 0x810A53 KwbUb 255.0 dez 0.00 255.0 FORMAT "%5.1" NUMBER 2 /end CHARACTERISTIC
/begin CHARACTERISTIC FFTWFS "Freeze Frame Tabelle: Wegfahrsperre" VAL_BLK 0x810A8D KwbUb 255.0 dez 0.00 255.0 FORMAT "%5.1" NUMBER 2 /end CHARACTERISTIC
/begin CHARACTERISTIC FFTWFSRC "Freeze Frame Tabelle: Wegfahrsperre RC-Glied" VAL_BLK 0x810A8F KwbUb 255.0 dez 0.00 255.0 FORMAT "%5.1" NUMBER 2 /end CHARACTERISTIC
/begin CHARACTERISTIC FHDLLR "Höhenschwelle für Durchführung Diagnose Leerlaufsteller" VALUE 0x81A082 KwUb 3.984 fak_ub_b4 0.00 3.984 FORMAT "%5.3" /end CHARACTERISTIC
/begin CHARACTERISTIC FIKTD "Faktor Bewertung des Integrals Katalysatorausräumen der Katalysatordiagnose" VALUE 0x8186B3 KwUb 15.94 fak_ub_b16 0.00 15.94 FORMAT "%5.2" /end CHARACTERISTIC
/begin CHARACTERISTIC FKTDAVK "Faktor avkatf-Umrechnung der Katalysatordiagnose" VALUE 0x8186B4 KwUb 0.9961 fak_ub_b1 0.00 0.9961 /end CHARACTERISTIC
/begin CHARACTERISTIC FKTDFE "Faktor Fetteintrag für Referenzmessung der Katalysatordiagnose" VALUE 0x8186B5 KwUb 7.969 fak_ub_b8 0.00 7.969 FORMAT "%5.3" /end CHARACTERISTIC
/begin CHARACTERISTIC FKTDFET "Faktor Fetteintrag für Referenzmessung der Katalysatordiagnose, Testerbetrieb" VALUE 0x8186B6 KwUb 7.969 fak_ub_b8 0.00 7.969 FORMAT "%5.3" /end CHARACTERISTIC
/begin CHARACTERISTIC FKTDGTV "Katdiagnose: Faktor für temperaturgradientenabhängige Verzugszeit" VALUE 0x8186BF KwUb 10.20 ttemp_q0p04 0.00 10.20 FORMAT "%5.2" /end CHARACTERISTIC
/begin CHARACTERISTIC FMLDMXKO "Faktor auf max. Luftmasse für Erkennung HFM-Kurzschluß nach 5V" VALUE 0x813C36 KwUw 15.99976 fak_uw_b16 0.00 15.99976 FORMAT "%8.5" /end CHARACTERISTIC
/begin CHARACTERISTIC FPUPT "Periodendauer für Fast Pulse Leckdiagnosepumpe" CURVE 0x81A4C0 KlAUbSstUbWUb 2.550 t10msxs_ub_b2p55 0.00 2.550 FORMAT "%5.3"
 /begin AXIS_DESCR STD_AXIS tfpg t1sxs_ub_b255 6 0.00 255.0 FORMAT "%5.1" DEPOSIT ABSOLUTE /end AXIS_DESCR
/end CHARACTERISTIC
/begin CHARACTERISTIC FRAE "Delta-fra-Schwelle für Erkennung der eingeschwungenen Grundadaption" VALUE 0x81DC2A KwUw 1.999969 fak_uw_b2 0.00 1.999969 FORMAT "%8.6" /end CHARACTERISTIC
/begin CHARACTERISTIC FRAODN "untere Diagnoseschwelle des Korrekturfaktors frao" VALUE 0x81DC2C KwUw 1.999969 fak_uw_b2 0.00 1.999969 FORMAT "%8.6" /end CHARACTERISTIC
/begin CHARACTERISTIC FRAODX "obere Diagnoseschwelle des Korrekturfaktors frao" VALUE 0x81DC2E KwUw 1.999969 fak_uw_b2 0.00 1.999969 FORMAT "%8.6" /end CHARACTERISTIC
/begin CHARACTERISTIC FRAUDN "untere Diagnoseschwelle des Korrekturfaktors frau" VALUE 0x81DC30 KwUw 1.999969 fak_uw_b2 0.00 1.999969 FORMAT "%8.6" /end CHARACTERISTIC
/begin CHARACTERISTIC FRAUDX "obere Diagnoseschwelle des Korrekturfaktors frau" VALUE 0x81DC32 KwUw 1.999969 fak_uw_b2 0.00 1.999969 FORMAT "%8.6" /end CHARACTERISTIC
/begin CHARACTERISTIC FRINH1 "Multiplikativer Faktor für RIN Sollwert hinter Kat" CURVE 0x81C230 KlAUbSstUwWUb 63.75 fak_ub_b64 0.00 63.75 FORMAT "%5.2"
 /begin AXIS_DESCR STD_AXIS tahsomf_w temp_q0p0234_o273 5 -273.1500 1262.827 FORMAT "%8.3" DEPOSIT ABSOLUTE /end AXIS_DESCR
/end CHARACTERISTIC
/begin CHARACTERISTIC FRMSTDN "untere Diagnoseschwelle (short test)" VALUE 0x81948E KwUb 1.992 fak_ub_b2 0.00 1.992 FORMAT "%5.3" /end CHARACTERISTIC
/begin CHARACTERISTIC FRMSTDX "obere Diagnoseschwelle (short test)" VALUE 0x81948F KwUb 1.992 fak_ub_b2 0.00 1.992 FORMAT "%5.3" /end CHARACTERISTIC
/begin CHARACTERISTIC FVMXLDRA "Wichtungsfaktor  für max. zulässiges Druckverhältnis zur Auslösung von B_mxldra" VALUE 0x819D4D KwUb 1.992 fak_ub_b2 0.00 1.992 FORMAT "%5.3" /end CHARACTERISTIC
/begin CHARACTERISTIC FVPDKLDL "Wichtungsfaktor  für max. zulässiges Druckverhältnis zur Auslösung von E_lkvdk" VALUE 0x819D4E KwUb 1.992 fak_ub_b2 0.00 1.992 FORMAT "%5.3" /end CHARACTERISTIC
/begin CHARACTERISTIC FVPDKLDS "Wichtungsfaktor  für min. zulässiges Druckverhältnis zur Auslösung von E_lkvdk" VALUE 0x819D4F KwUb 1.992 fak_ub_b2 0.00 1.992 FORMAT "%5.3" /end CHARACTERISTIC
/begin CHARACTERISTIC FVPDKLDUS "Untere Schwelle für Leck vor Drosselklappe Erkennung im Leerlauf bei niedriger t" CURVE 0x826F1C KlAUbSstUbWUb 1.992 fak_ub_b2 0.00 1.992 FORMAT "%5.3"
 /begin AXIS_DESCR STD_AXIS tmot temp_ub_q0p75_o48 5 -48.00 143.3 FORMAT "%5.1" DEPOSIT ABSOLUTE /end AXIS_DESCR
/end CHARACTERISTIC
/begin CHARACTERISTIC FWMLHFMMN "Wichtungsfaktor für minimale HFM-Luftmassen Schwelle in Abhängigkeit von d.Höhe" CURVE 0x81CC34 KlAUwSstUwWUw 0.9999847 fak_uw_b1 0.00 0.9999847 FORMAT "%9.7"
 /begin AXIS_DESCR STD_AXIS fho_w fak_uw_b4 2 0.00 3.999939 FORMAT "%8.6" DEPOSIT ABSOLUTE /end AXIS_DESCR
/end CHARACTERISTIC
/begin CHARACTERISTIC HLDPU "Untere Höhenschwelle für Leckdiagnosemodul" VALUE 0x81A4CD KwUb 3.984 fak_ub_b4 0.00 3.984 FORMAT "%5.3" /end CHARACTERISTIC
/begin CHARACTERISTIC IKMTR "Index für Auswahl des entsprechenden Bytes im Fehlerarray" VALUE 0x8187D3 KwUb 100.0 DEZ 0.00 100.0 FORMAT "%5.1" /end CHARACTERISTIC
/begin CHARACTERISTIC IMLKVSMX "Maximale Integrationsschwelle für Fehlerfreigabe in DKVS (Tank leer)" VALUE 0x81DC34 KwUw 233.0133 m_q0p00355 0.00 233.0133 FORMAT "%8.4" /end CHARACTERISTIC
/begin CHARACTERISTIC JKMTR "Index für Auswahl der entsprechenden Bits aus dem Byte im Fehlerarray" VALUE 0x8187D4 KwUb 3.000 DEZ 0.00 3.000 FORMAT "%5.3" /end CHARACTERISTIC
/begin CHARACTERISTIC KFDLULS "Delta Druck für Überladeschutzdiagnose" MAP 0x826F27 KfAxUbAyUbSstxUbSstyUbWUb 1275. p_ub_q5 0.00 1275. FORMAT "%5.0"
 /begin AXIS_DESCR STD_AXIS nmot nmot_ub_q40 8 0.00 10200. FORMAT "%5.0" DEPOSIT ABSOLUTE /end AXIS_DESCR
 /begin AXIS_DESCR STD_AXIS plsol p_ub_q10 8 0.00 2550. FORMAT "%5.0" DEPOSIT ABSOLUTE /end AXIS_DESCR
/end CHARACTERISTIC
/begin CHARACTERISTIC KFFLTA "Schwelle zur Erkennung Feinleck" MAP 0x828004 KfAxUbAyUbSstxUbSstyUwWUb 12.75 t50msxs_ub_b12p75 0.00 12.75 FORMAT "%5.2"
 /begin AXIS_DESCR STD_AXIS tans temp_ub_q0p75_o48 4 -48.00 143.3 FORMAT "%5.1" DEPOSIT ABSOLUTE /end AXIS_DESCR
 /begin AXIS_DESCR STD_AXIS pukorf_w p_uw_q0p039 4 0.00 2559.961 FORMAT "%8.3" DEPOSIT ABSOLUTE /end AXIS_DESCR
/end CHARACTERISTIC
/begin CHARACTERISTIC KFGLTA "Schwelle zur Erkennung Grobleck" MAP 0x828022 KfAxUbAyUbSstxUbSstyUwWUb 12.75 t50msxs_ub_b12p75 0.00 12.75 FORMAT "%5.2"
 /begin AXIS_DESCR STD_AXIS tans temp_ub_q0p75_o48 4 -48.00 143.3 FORMAT "%5.1" DEPOSIT ABSOLUTE /end AXIS_DESCR
 /begin AXIS_DESCR STD_AXIS pukorf_w p_uw_q0p039 4 0.00 2559.961 FORMAT "%8.3" DEPOSIT ABSOLUTE /end AXIS_DESCR
/end CHARACTERISTIC
/begin CHARACTERISTIC KFMLDMN "ML-Schwelle für B_minflr-Diagnose HFM/HLM" MAP 0x81CC3E KfAxUbAyUbSstxSwSstyUbWSw 6553.500 m_q0p1 -3276.800 3276.700 FORMAT "%8.3"
 /begin AXIS_DESCR STD_AXIS wdkba_w relDK_q0p02441 8 -800.0000 799.9756 FORMAT "%8.4" DEPOSIT ABSOLUTE /end AXIS_DESCR
 /begin AXIS_DESCR STD_AXIS nmot nmot_ub_q40 9 0.00 10200. FORMAT "%5.0" DEPOSIT ABSOLUTE /end AXIS_DESCR
/end CHARACTERISTIC
/begin CHARACTERISTIC KFMLDMX "ML-Schwelle für B_maxflr-Diagnose HFM/HLM" MAP 0x813C38 KfAxUbAyUbSstxSwSstyUbWSw 6553.500 m_q0p1 -3276.800 3276.700 FORMAT "%8.3"
 /begin AXIS_DESCR STD_AXIS wdkbadmx_w relDK_q0p02441 8 -800.0000 799.9756 FORMAT "%8.4" DEPOSIT ABSOLUTE /end AXIS_DESCR
 /begin AXIS_DESCR STD_AXIS nmot nmot_ub_q40 9 0.00 10200. FORMAT "%5.0" DEPOSIT ABSOLUTE /end AXIS_DESCR
/end CHARACTERISTIC
/begin CHARACTERISTIC KFOSCTM "Kennfeld Grenzkatalysators-Sauerstoffspeicherfähigkeit, temperatur- und luftmass" MAP 0x81C3EE KfAxUbAyUbSstxUwSstyUwWUw 6543.500 m_q0p1_mg 10.00000 6553.500 FORMAT "%8.3"
 /begin AXIS_DESCR STD_AXIS tikatmu_w temp_uw_q0p0195_o50 8 -50.00000 1229.980 FORMAT "%8.3" DEPOSIT ABSOLUTE /end AXIS_DESCR
 /begin AXIS_DESCR STD_AXIS msabg_w m_uw_b6553p5 8 0.00 6553.500 FORMAT "%8.3" DEPOSIT ABSOLUTE /end AXIS_DESCR
/end CHARACTERISTIC
/begin CHARACTERISTIC KFRINH "Kennfeld für Nernst-Innenwiderstand hinter Kat" MAP 0x81C242 KfAxUbAyUbSstxUwSstyUbWUb 2040. r_q8 0.00 2040. FORMAT "%5.0"
 /begin AXIS_DESCR STD_AXIS tahsomf_w temp_q0p0234_o273 5 -273.1500 1262.827 FORMAT "%8.3" DEPOSIT ABSOLUTE /end AXIS_DESCR
 /begin AXIS_DESCR STD_AXIS phlsnhf fak_ub_q0p01 3 0.00 2.550 FORMAT "%5.3" DEPOSIT ABSOLUTE /end AXIS_DESCR
/end CHARACTERISTIC
/begin CHARACTERISTIC KFTXFTA "Periodendauer zur Erkennung Feinstleck (>=0,5mm) bei Testeranforderung" MAP 0x828040 KfAxUbAyUbSstxUbSstyUwWUb 12.75 t50msxs_ub_b12p75 0.00 12.75 FORMAT "%5.2"
 /begin AXIS_DESCR STD_AXIS tans temp_ub_q0p75_o48 4 -48.00 143.3 FORMAT "%5.1" DEPOSIT ABSOLUTE /end AXIS_DESCR
 /begin AXIS_DESCR STD_AXIS pukorf_w p_uw_q0p039 4 0.00 2559.961 FORMAT "%8.3" DEPOSIT ABSOLUTE /end AXIS_DESCR
/end CHARACTERISTIC
/begin CHARACTERISTIC KFVPDKLD "Max. zulässiges Druckverhältnis DK für ldra Diagnose" MAP 0x826F79 KfAxUbAyUbSstxUbSstyUbWUb 3.984 fak_ub_b4 0.00 3.984 FORMAT "%5.3"
 /begin AXIS_DESCR STD_AXIS nmot nmot_ub_q40 10 0.00 10200. FORMAT "%5.0" DEPOSIT ABSOLUTE /end AXIS_DESCR
 /begin AXIS_DESCR STD_AXIS wdkba relDK_ub_b100 12 0.00 100.0 FORMAT "%5.1" DEPOSIT ABSOLUTE /end AXIS_DESCR
/end CHARACTERISTIC
/begin CHARACTERISTIC KFXFTA "Schwelle zur Erkennung Feinstleck (>= 0.5 mm)" MAP 0x82805E KfAxUbAyUbSstxUbSstyUwWUb 12.75 t50msxs_ub_b12p75 0.00 12.75 FORMAT "%5.2"
 /begin AXIS_DESCR STD_AXIS tans temp_ub_q0p75_o48 4 -48.00 143.3 FORMAT "%5.1" DEPOSIT ABSOLUTE /end AXIS_DESCR
 /begin AXIS_DESCR STD_AXIS pukorf_w p_uw_q0p039 4 0.00 2559.961 FORMAT "%8.3" DEPOSIT ABSOLUTE /end AXIS_DESCR
/end CHARACTERISTIC
/begin CHARACTERISTIC KMXSTG "Filterkonstante für Filter max. Steigung für Sonde hinter KAT" VALUE 0x81C3A2 KwUw 0.9999847 fak_uw_b1 0.00 0.9999847 FORMAT "%9.7" /end CHARACTERISTIC
/begin CHARACTERISTIC KRFHKS "Fehlerhäufigkeit Klopfsensoren" VALUE 0x819BB2 KwUb 255.0 dez 0.00 255.0 FORMAT "%5.1" /end CHARACTERISTIC
/begin CHARACTERISTIC KRFHT "Fehlerhäufigkeit Testimpuls" VALUE 0x811588 KwUb 254.0 dez 1.000 255.0 FORMAT "%5.1" /end CHARACTERISTIC
/begin CHARACTERISTIC KTLAMSTEIG "I-Faktor  für  Rampensteigung lamlash im Kurztrip für Testfunktion hinter KAT" VALUE 0x81C3A4 KwUw 0.9999847 fak_uw_b1 0.00 0.9999847 FORMAT "%9.7" /end CHARACTERISTIC
/begin CHARACTERISTIC KUBERROR "Zeit für Fehlererkennung Kurzschluß nach U_batt" VALUE 0x81C586 KwUw 6553.500 fak_q0p1 0.00 6553.500 FORMAT "%8.3" /end CHARACTERISTIC
/begin CHARACTERISTIC KUBHEAL "Zeit für Heilung Kurzschluß nach U_batt" VALUE 0x81C588 KwUw 6553.500 fak_q0p1 0.00 6553.500 FORMAT "%8.3" /end CHARACTERISTIC
/begin CHARACTERISTIC LAERROR "Zeit für Fehlererkennung Lastabfall" VALUE 0x81C58A KwUw 6553.500 fak_q0p1 0.00 6553.500 FORMAT "%8.3" /end CHARACTERISTIC
/begin CHARACTERISTIC LAHEAL "Zeit für Heilung Lastabfall" VALUE 0x81C58C KwUw 6553.500 fak_q0p1 0.00 6553.500 FORMAT "%8.3" /end CHARACTERISTIC
/begin CHARACTERISTIC LAKTDEO "Obere Schwelle für Lambda eingeschwungen bei Katdiagnose" VALUE 0x81C492 KwUw 15.99976 fak_uw_b16 0.00 15.99976 FORMAT "%8.5" /end CHARACTERISTIC
/begin CHARACTERISTIC LAKTDEU "Untere Schwelle für Lambda eingeschwungen bei Katdiagnose" VALUE 0x81C494 KwUw 15.99976 fak_uw_b16 0.00 15.99976 FORMAT "%8.5" /end CHARACTERISTIC
/begin CHARACTERISTIC LAMLASHMIN "Minimaler Lambda-Sollwert (Fett) für Test Schwingungsprüfung hinter KAT" VALUE 0x81C3A6 KwUw 15.99976 fak_uw_b16 0.00 15.99976 FORMAT "%8.5" /end CHARACTERISTIC
/begin CHARACTERISTIC LAMSONSVL "Schwelle für Volllast Lambda-Betrieb bei der Sondenspannung überprüft wird" VALUE 0x81C3A8 KwUw 15.99976 fak_uw_b16 0.00 15.99976 FORMAT "%8.5" /end CHARACTERISTIC
/begin CHARACTERISTIC LAMSTEIG "I-Faktor  für  Rampensteigung lamlash für Testfunktion hinter KAT" VALUE 0x81C3AA KwUw 0.9999847 fak_uw_b1 0.00 0.9999847 FORMAT "%9.7" /end CHARACTERISTIC
/begin CHARACTERISTIC LKTDF "Lambdawert bei Kat-Diagnose, Fettsprung" VALUE 0x81C496 KwUw 0.2500000 fak_uw_b16 0.7500000 1.000000 FORMAT "%8.6" /end CHARACTERISTIC
/begin CHARACTERISTIC LKTDFT "Lambdawert bei Kat-Diagnose, Fettsprung, Testerbetrieb" VALUE 0x81C498 KwUw 0.2500000 fak_uw_b16 0.7500000 1.000000 FORMAT "%8.6" /end CHARACTERISTIC
/begin CHARACTERISTIC LKTDM "Lambdawert bei Kat-Diagnose, Magersprung" VALUE 0x81C49A KwUw 0.2500000 fak_uw_b16 1.000000 1.250000 FORMAT "%8.6" /end CHARACTERISTIC
/begin CHARACTERISTIC LKTDMT "Lambdawert bei Kat-Diagnose, Magersprung, Testerbetrieb" VALUE 0x81C49C KwUw 0.2500000 fak_uw_b16 1.000000 1.250000 FORMAT "%8.6" /end CHARACTERISTIC
/begin CHARACTERISTIC LKVDKNMN "Drehzahlschwelle für Leckekennung vor DK beim Turbo" VALUE 0x819D50 KwUb 10200. nmot_ub_q40 0.00 10200. FORMAT "%5.0" /end CHARACTERISTIC
/begin CHARACTERISTIC MLDHFMKU "Luftmassen Untergrenze für Erkennung HFM-Kurzschluß" VALUE 0x813CE4 KwSw 6553.500 m_q0p1 -3276.800 3276.700 FORMAT "%8.3" /end CHARACTERISTIC
/begin CHARACTERISTIC MLDKVSF "Luftmassenschwelle für Fehlerfreigabe im DKVS (Tank leer)" VALUE 0x81DC36 KwUw 233.0133 m_q0p00355 0.00 233.0133 FORMAT "%8.4" /end CHARACTERISTIC
/begin CHARACTERISTIC MLDKVSG "Luftmassenschwelle für Fehlerfreigabe Tank leer" VALUE 0x81DC38 KwUw 233.0133 m_q0p00355 0.00 233.0133 FORMAT "%8.4" /end CHARACTERISTIC
/begin CHARACTERISTIC MLHFMMN "minimale HFM-Luftmassen Schwelle zum Rücksetzen des Min-Fehlers" VALUE 0x81CCEA KwSw 6553.500 m_q0p1 -3276.800 3276.700 FORMAT "%8.3" /end CHARACTERISTIC
/begin CHARACTERISTIC MLKTDO_0_A "Obere Luftmassenschwelle für Kat-Diagnose" VALUE 0x81C4C0 KwUw 6553.500 m_uw_b6553p5 0.00 6553.500 FORMAT "%8.3" /end CHARACTERISTIC
/begin CHARACTERISTIC MLKTDO_1_A "Obere Luftmassenschwelle für Kat-Diagnose" VALUE 0x81C4C2 KwUw 6553.500 m_uw_b6553p5 0.00 6553.500 FORMAT "%8.3" /end CHARACTERISTIC
/begin CHARACTERISTIC MLKTDOO_0_A "Obere Luftmassenschwelle für Kat-Diagnose, oberes Band" VALUE 0x81C4C4 KwUw 6553.500 m_uw_b6553p5 0.00 6553.500 FORMAT "%8.3" /end CHARACTERISTIC
/begin CHARACTERISTIC MLKTDOO_1_A "Obere Luftmassenschwelle für Kat-Diagnose, oberes Band" VALUE 0x81C4C6 KwUw 6553.500 m_uw_b6553p5 0.00 6553.500 FORMAT "%8.3" /end CHARACTERISTIC
/begin CHARACTERISTIC MLKTDOT_0_A "Obere Luftmassenschwelle für Kat-Diagnose bei Testerbetrieb" VALUE 0x81C4C8 KwUw 6553.500 m_uw_b6553p5 0.00 6553.500 FORMAT "%8.3" /end CHARACTERISTIC
/begin CHARACTERISTIC MLKTDOT_1_A "Obere Luftmassenschwelle für Kat-Diagnose bei Testerbetrieb" VALUE 0x81C4CA KwUw 6553.500 m_uw_b6553p5 0.00 6553.500 FORMAT "%8.3" /end CHARACTERISTIC
/begin CHARACTERISTIC MLKTDU_0_A "Untere Luftmassenschwelle für Kat-Diagnose" VALUE 0x81C4CC KwUw 6553.500 m_uw_b6553p5 0.00 6553.500 FORMAT "%8.3" /end CHARACTERISTIC
/begin CHARACTERISTIC MLKTDU_1_A "Untere Luftmassenschwelle für Kat-Diagnose" VALUE 0x81C4CE KwUw 6553.500 m_uw_b6553p5 0.00 6553.500 FORMAT "%8.3" /end CHARACTERISTIC
/begin CHARACTERISTIC MLKTDUO_0_A "Untere Luftmassenschwelle für Kat-Diagnose, oberes Band" VALUE 0x81C4D0 KwUw 6553.500 m_uw_b6553p5 0.00 6553.500 FORMAT "%8.3" /end CHARACTERISTIC
/begin CHARACTERISTIC MLKTDUO_1_A "Untere Luftmassenschwelle für Kat-Diagnose, oberes Band" VALUE 0x81C4D2 KwUw 6553.500 m_uw_b6553p5 0.00 6553.500 FORMAT "%8.3" /end CHARACTERISTIC
/begin CHARACTERISTIC MLKTDUT_0_A "Untere Luftmassenschwelle für Kat-Diagnose, Testerbetrieb" VALUE 0x81C4D4 KwUw 6553.500 m_uw_b6553p5 0.00 6553.500 FORMAT "%8.3" /end CHARACTERISTIC
/begin CHARACTERISTIC MLKTDUT_1_A "Untere Luftmassenschwelle für Kat-Diagnose, Testerbetrieb" VALUE 0x81C4D6 KwUw 6553.500 m_uw_b6553p5 0.00 6553.500 FORMAT "%8.3" /end CHARACTERISTIC
/begin CHARACTERISTIC MLLASH "Luftmassenschwelle für Schwingungsprüfung hinter KAT" VALUE 0x81C3AC KwUw 6553.500 m_q0p1 0.00 6553.500 FORMAT "%8.3" /end CHARACTERISTIC
/begin CHARACTERISTIC MLOSTEST "obere Luftmassenschwelle für Testbeginn Schwingungsprüfung hinter KAT" VALUE 0x81C3AE KwUw 6553.500 m_q0p1 0.00 6553.500 FORMAT "%8.3" /end CHARACTERISTIC
/begin CHARACTERISTIC MLUSSTG "Luftmassenschwelle für Dynamikprüfung hinter KAT" VALUE 0x8139A0 KwUw 6553.500 m_q0p1 0.00 6553.500 FORMAT "%8.3" /end CHARACTERISTIC
/begin CHARACTERISTIC MLUSTEST "untere Luftmassenschwelle für Testbeginn Schwingungsprüfung hinter KAT" VALUE 0x81C3B0 KwUw 6553.500 m_q0p1 0.00 6553.500 FORMAT "%8.3" /end CHARACTERISTIC
/begin CHARACTERISTIC MLUSVL "Luftmassenschwelle für Vollast-Prüfung für Sonde hinter KAT" VALUE 0x81C3B2 KwUw 6553.500 m_q0p1 0.00 6553.500 FORMAT "%8.3" /end CHARACTERISTIC
/begin CHARACTERISTIC MSABHMN "untere Luftmassenschwelle für Plausibilitätsprüfung LSU" VALUE 0x810BB3 KwUb 1020. m_ub_b1020 0.00 1020. FORMAT "%5.0" /end CHARACTERISTIC
/begin CHARACTERISTIC MSTELDP "Mindestluftmasse bei Fortsetzungsspülung" VALUE 0x812154 KwUb 11.32 m_ub_q0p0444 0.00 11.32 FORMAT "%5.2" /end CHARACTERISTIC
/begin CHARACTERISTIC NDKRA "Drehzahlschwelle für Diagnose Klopfregelanschlag" VALUE 0x811578 KwUb 10200. nmot_ub_q40 0.00 10200. FORMAT "%5.0" /end CHARACTERISTIC
/begin CHARACTERISTIC NDKS "Drehzahlschwelle für Dia KS" VALUE 0x819BB3 KwUb 10200. nmot_ub_q40 0.00 10200. FORMAT "%5.0" /end CHARACTERISTIC
/begin CHARACTERISTIC NDKSBET "Drehzahlschwelle für Dia KS, Bandendetest" VALUE 0x819BB4 KwUb 10200. nmot_ub_q40 0.00 10200. FORMAT "%5.0" /end CHARACTERISTIC
/begin CHARACTERISTIC NDLDRAPU "Drehzahlschwelle für LDRA Fehlerpfad und Heilung LDO Fehlerpfad" CURVE 0x827009 KlAUbSstUbWUb 10200. nmot_ub_q40 0.00 10200. FORMAT "%5.0"
 /begin AXIS_DESCR STD_AXIS pu p_ub_q5 2 0.00 1275. FORMAT "%5.0" DEPOSIT ABSOLUTE /end AXIS_DESCR
/end CHARACTERISTIC
/begin CHARACTERISTIC NEGABW "neg zeitliche Abweichung zur Fehlererkennung" VALUE 0x8187D5 KwUb 0.8000 fak_q0p1 0.00 0.8000 FORMAT "%6.4" /end CHARACTERISTIC
/begin CHARACTERISTIC NKTDOT "Obere Drehzahlgrenze Katdiagnose bei Testerbetrieb" VALUE 0x8186C0 KwUb 10200. nmot_ub_q40 0.00 10200. FORMAT "%5.0" /end CHARACTERISTIC
/begin CHARACTERISTIC NKTDUT "Untere Drehzahlgrenze Katdiagnose bei Testerbetrieb" VALUE 0x8186C1 KwUb 10200. nmot_ub_q40 0.00 10200. FORMAT "%5.0" /end CHARACTERISTIC
/begin CHARACTERISTIC OSCKTD "Diagnoseschwelle Sauerstoffspeicherfähigkeit des Katalysators" VALUE 0x81C49E KwUw 15.99976 fak_uw_b16 0.00 15.99976 FORMAT "%8.5" /end CHARACTERISTIC
/begin CHARACTERISTIC OSCKTDNG "Messbereich der normierten Sauerstoffspeicherfähigkeit des Katalysators" VALUE 0x81C4A0 KwUw 15.99976 fak_uw_b16 0.00 15.99976 FORMAT "%8.5" /end CHARACTERISTIC
/begin CHARACTERISTIC OSCKTDT "Diagnoseschwelle Sauerstoffspeicherfähigkeit des Katalysators, Testerbetrieb" VALUE 0x81C4A2 KwUw 15.99976 fak_uw_b16 0.00 15.99976 FORMAT "%8.5" /end CHARACTERISTIC
/begin CHARACTERISTIC POSABW "pos zeitliche Abweichung zur Fehlererkennung" VALUE 0x8187D6 KwUb 1.000 fak_q0p1 0.00 1.000 FORMAT "%5.3" /end CHARACTERISTIC
/begin CHARACTERISTIC PULSUV "Pulsationsschwelle für Schubumluftventildiagnose beim Turbo" VALUE 0x8187C5 KwSb 1.992 fak_sb_b1 -1.000 0.9922 FORMAT "%5.3" /end CHARACTERISTIC
/begin CHARACTERISTIC RKAE "Delta rkat- bzw. rkaz-Schwelle für Erkennung der eingeschwungenen Grundadaption" VALUE 0x81DC3A KwSw 3071.953 rel_sw_b1536 -1536.000 1535.953 FORMAT "%8.3" /end CHARACTERISTIC
/begin CHARACTERISTIC RKATDN "untere Diagnoseschwelle additive Korrektur pro Zeit" VALUE 0x81DC3C KwSw 3071.953 rel_sw_b1536 -1536.000 1535.953 FORMAT "%8.3" /end CHARACTERISTIC
/begin CHARACTERISTIC RKATDX "obere Diagnoseschwelle additive Korrektur pro Zeit" VALUE 0x81DC3E KwSw 3071.953 rel_sw_b1536 -1536.000 1535.953 FORMAT "%8.3" /end CHARACTERISTIC
/begin CHARACTERISTIC RKAZDN "untere Diagnoseschwelle additive Korrektur pro Zündung" VALUE 0x81DC40 KwSw 3071.953 rel_sw_b1536 -1536.000 1535.953 FORMAT "%8.3" /end CHARACTERISTIC
/begin CHARACTERISTIC RKAZDX "obere Diagnoseschwelle additive Korrektur pro Zündung" VALUE 0x81DC42 KwSw 3071.953 rel_sw_b1536 -1536.000 1535.953 FORMAT "%8.3" /end CHARACTERISTIC
/begin CHARACTERISTIC RL1FGV "RL-Kennlinie Bergaberkennung Gang 1 bei Feinstleckdiagnose" CURVE 0x81A4CE GklWUb 191.3 rel_ub_q0p75 0.00 191.3 FORMAT "%5.1"
 /begin AXIS_DESCR COM_AXIS vfzg vfzg_ub_q1p25 6 0.00 318.8 AXIS_PTS_REF SVF06D_UB /end AXIS_DESCR
/end CHARACTERISTIC
/begin CHARACTERISTIC RL1GV "RL - Kennlinie Bergaberkennung Gang 1" CURVE 0x81A4D4 GklWUb 191.3 rel_ub_q0p75 0.00 191.3 FORMAT "%5.1"
 /begin AXIS_DESCR COM_AXIS vfzg vfzg_ub_q1p25 6 0.00 318.8 AXIS_PTS_REF SVF06D_UB /end AXIS_DESCR
/end CHARACTERISTIC
/begin CHARACTERISTIC RL2FGV "RL-Kennlinie Bergaberkennung Gang 2 bei Feinstleckdiagnose" CURVE 0x81A4DA GklWUb 191.3 rel_ub_q0p75 0.00 191.3 FORMAT "%5.1"
 /begin AXIS_DESCR COM_AXIS vfzg vfzg_ub_q1p25 6 0.00 318.8 AXIS_PTS_REF SVF06D_UB /end AXIS_DESCR
/end CHARACTERISTIC
/begin CHARACTERISTIC RL2GV "RL - Kennlinie Bergaberkennung Gang 2" CURVE 0x81A4E0 GklWUb 191.3 rel_ub_q0p75 0.00 191.3 FORMAT "%5.1"
 /begin AXIS_DESCR COM_AXIS vfzg vfzg_ub_q1p25 6 0.00 318.8 AXIS_PTS_REF SVF06D_UB /end AXIS_DESCR
/end CHARACTERISTIC
/begin CHARACTERISTIC RL3FGV "RL-Kennlinie Bergaberkennung Gang 3 bei Feinstleckdiagnose" CURVE 0x81A4E6 GklWUb 191.3 rel_ub_q0p75 0.00 191.3 FORMAT "%5.1"
 /begin AXIS_DESCR COM_AXIS vfzg vfzg_ub_q1p25 6 0.00 318.8 AXIS_PTS_REF SVF06D_UB /end AXIS_DESCR
/end CHARACTERISTIC
/begin CHARACTERISTIC RL3GV "RL - Kennlinie Bergaberkennung Gang 3" CURVE 0x81A4EC GklWUb 191.3 rel_ub_q0p75 0.00 191.3 FORMAT "%5.1"
 /begin AXIS_DESCR COM_AXIS vfzg vfzg_ub_q1p25 6 0.00 318.8 AXIS_PTS_REF SVF06D_UB /end AXIS_DESCR
/end CHARACTERISTIC
/begin CHARACTERISTIC RL4FGV "RL-Kennlinie Bergaberkennung Gang 4 bei Feinstleckdiagnose" CURVE 0x81A4F2 GklWUb 191.3 rel_ub_q0p75 0.00 191.3 FORMAT "%5.1"
 /begin AXIS_DESCR COM_AXIS vfzg vfzg_ub_q1p25 6 0.00 318.8 AXIS_PTS_REF SVF06D_UB /end AXIS_DESCR
/end CHARACTERISTIC
/begin CHARACTERISTIC RL4GV "RL - Kennlinie Bergaberkennung Gang 4" CURVE 0x81A4F8 GklWUb 191.3 rel_ub_q0p75 0.00 191.3 FORMAT "%5.1"
 /begin AXIS_DESCR COM_AXIS vfzg vfzg_ub_q1p25 6 0.00 318.8 AXIS_PTS_REF SVF06D_UB /end AXIS_DESCR
/end CHARACTERISTIC
/begin CHARACTERISTIC RL5FGV "RL-Kennlinie Bergaberkennung Gang 5 bei Feinstleckdiagnose" CURVE 0x81A4FE GklWUb 191.3 rel_ub_q0p75 0.00 191.3 FORMAT "%5.1"
 /begin AXIS_DESCR COM_AXIS vfzg vfzg_ub_q1p25 6 0.00 318.8 AXIS_PTS_REF SVF06D_UB /end AXIS_DESCR
/end CHARACTERISTIC
/begin CHARACTERISTIC RL5GV "RL - Kennlinie Bergaberkennung Gang 5" CURVE 0x81A504 GklWUb 191.3 rel_ub_q0p75 0.00 191.3 FORMAT "%5.1"
 /begin AXIS_DESCR COM_AXIS vfzg vfzg_ub_q1p25 6 0.00 318.8 AXIS_PTS_REF SVF06D_UB /end AXIS_DESCR
/end CHARACTERISTIC
/begin CHARACTERISTIC RL6FGV "RL-Kennlinie Bergaberkennung Gang 6 bei Feinstleckdiagnose" CURVE 0x81A50A GklWUb 191.3 rel_ub_q0p75 0.00 191.3 FORMAT "%5.1"
 /begin AXIS_DESCR COM_AXIS vfzg vfzg_ub_q1p25 6 0.00 318.8 AXIS_PTS_REF SVF06D_UB /end AXIS_DESCR
/end CHARACTERISTIC
/begin CHARACTERISTIC RL6GV "RL - Kennlinie Bergaberkennung Gang 6" CURVE 0x81A510 GklWUb 191.3 rel_ub_q0p75 0.00 191.3 FORMAT "%5.1"
 /begin AXIS_DESCR COM_AXIS vfzg vfzg_ub_q1p25 6 0.00 318.8 AXIS_PTS_REF SVF06D_UB /end AXIS_DESCR
/end CHARACTERISTIC
/begin CHARACTERISTIC RLBABMX "Begrenzung Filter Bergaberkennung" VALUE 0x82807C KwUw 1535.977 rel_uw_q0p0234 0.00 1535.977 FORMAT "%8.3" /end CHARACTERISTIC
/begin CHARACTERISTIC RLLDPMX "Maximale Last bei Diagnose" VALUE 0x812155 KwUb 191.3 rel_ub_q0p75 0.00 191.3 FORMAT "%5.1" /end CHARACTERISTIC
/begin CHARACTERISTIC RLMDVERL "Lastschwelle für Unterdrehzahlprüfung abh. von mdverl_w" CURVE 0x827222 KlAUwSstUwWUw 99.99902 rel_uw_b192 0.00 99.99902 FORMAT "%8.5"
 /begin AXIS_DESCR STD_AXIS mdverl_w rel_uw_b100 3 0.00 99.99847 FORMAT "%8.5" DEPOSIT ABSOLUTE /end AXIS_DESCR
/end CHARACTERISTIC
/begin CHARACTERISTIC SDLDRAH "rl-Schwelle fuer DLDR zum Heilen von LDRA im i.O. Fall" VALUE 0x819D51 KwUb 191.3 rel_ub_q0p75 0.00 191.3 FORMAT "%5.1" /end CHARACTERISTIC
/begin CHARACTERISTIC SDLDRAS "rl-Schwelle fuer DLDR zum Setzen von LDRA im Fehlerfall" VALUE 0x819D52 KwUb 191.3 rel_ub_q0p75 0.00 191.3 FORMAT "%5.1" /end CHARACTERISTIC
/begin CHARACTERISTIC SDLDRL "Mindestfuellung LDR fuer DIA LDR maximal zulaessiger Druck" VALUE 0x819D53 KwUb 191.3 rel_ub_q0p75 0.00 191.3 FORMAT "%5.1" /end CHARACTERISTIC
/begin CHARACTERISTIC SMLDYN "Luftmassenschwelle für Sondendynamik hinter KAT" VALUE 0x81C3B4 KwUw 182.0417 m_q0p00277 0.00 182.0417 FORMAT "%8.4" /end CHARACTERISTIC
/begin AXIS_PTS SNM16KRUB "Stützstellenverteilung Drehzahl, 16 Sst." 0x818252 nmot SstAUbSstUb 10200. nmot_ub_q40 16 0.00 10200. FORMAT "%5.0" DEPOSIT ABSOLUTE /end AXIS_PTS
/begin CHARACTERISTIC SRLLKH "Mindestfuellung zur Fehlerheilung Leck vor Drosselklappe" VALUE 0x819D54 KwUb 191.3 rel_ub_q0p75 0.00 191.3 FORMAT "%5.1" /end CHARACTERISTIC
/begin CHARACTERISTIC SRYAGR "Schwelle für Readiness-Bildung Abgasrückführungs-Diagnose" VALUE 0x81845B KwUb 255.0 dez 0.00 255.0 FORMAT "%5.1" /end CHARACTERISTIC
/begin CHARACTERISTIC SRYHS "Schwelle für Readiness-Bildung Sondenheizungs-Diagnose" VALUE 0x81845C KwUb 255.0 dez 0.00 255.0 FORMAT "%5.1" /end CHARACTERISTIC
/begin CHARACTERISTIC SRYKAT "Schwelle für Readiness-Bildung Katalysator-Diagnose" VALUE 0x81845D KwUb 255.0 dez 0.00 255.0 FORMAT "%5.1" /end CHARACTERISTIC
/begin CHARACTERISTIC SRYLS "Schwelle für Readiness-Bildung Lambdasonden-Diagnose" VALUE 0x81845E KwUb 255.0 dez 0.00 255.0 FORMAT "%5.1" /end CHARACTERISTIC
/begin CHARACTERISTIC SRYSLS "Schwelle für Readiness-Bildung Sekundärluft-Diagnose" VALUE 0x81845F KwUb 255.0 dez 0.00 255.0 FORMAT "%5.1" /end CHARACTERISTIC
/begin CHARACTERISTIC SRYTES "Schwelle für Readiness-Bildung Tankentlüftungs-Diagnose" VALUE 0x818460 KwUb 255.0 dez 0.00 255.0 FORMAT "%5.1" /end CHARACTERISTIC
/begin CHARACTERISTIC SSRLKVDK "Schwelle Spülrate Tankentl. zur Aktivierung der Leckerkennungsdiagnose Turbo" VALUE 0x82700E KwUw 0.4999924 fak_uw_b0p5 0.00 0.4999924 FORMAT "%9.7" /end CHARACTERISTIC
/begin CHARACTERISTIC SULSUMN "Schwellwert für Plausibilitätsfehler während B_sa" VALUE 0x81C3C2 KwUw 319.9951 spg_q0p00488 0.00 319.9951 FORMAT "%8.4" /end CHARACTERISTIC
/begin CHARACTERISTIC SULSUMNN "Schwellwert für Plausibilitätsfehler während B_sa" VALUE 0x81C3C4 KwUw 319.9951 spg_q0p00488 0.00 319.9951 FORMAT "%8.4" /end CHARACTERISTIC
/begin CHARACTERISTIC SULSUMXH "Schwellwert für Plausibilitätsfehler CJ110" VALUE 0x81C3C6 KwUw 319.9951 spg_q0p00488 0.00 319.9951 FORMAT "%8.4" /end CHARACTERISTIC
/begin AXIS_PTS SVF06D_UB "Stützstellenverteilung vfzg für Leckdiagnose DLDP" 0x81A516 vfzg SstAUbSstUb 318.8 vfzg_ub_q1p25 6 0.00 318.8 FORMAT "%5.1" DEPOSIT ABSOLUTE /end AXIS_PTS
/begin CHARACTERISTIC TABGSTGK "Abgastemperaturschwelle für Dynamik-Messung" VALUE 0x8139A2 KwUw 1535.977 temp_q0p0234_o273 -273.1500 1262.827 FORMAT "%8.3" /end CHARACTERISTIC
/begin CHARACTERISTIC TABSTHLSH "Mindestabstellzeit für Diagnose Heizung Lambdasonde hinter Kat" VALUE 0x81C260 KwUw 65535.00 t1sxs_uw_q1 0.00 65535.00 FORMAT "%8.2" /end CHARACTERISTIC
/begin CHARACTERISTIC TADHMNH "untere Temperaturschwelle für die Heizerdiagnose hinter Kat" VALUE 0x81C262 KwUw 1535.977 temp_q0p0234_o273 -273.1500 1262.827 FORMAT "%8.3" /end CHARACTERISTIC
/begin CHARACTERISTIC TADHMXH "obere Temperaturschwelle für die Heizerdiagnose hinter Kat" VALUE 0x81C264 KwUw 1535.977 temp_q0p0234_o273 -273.1500 1262.827 FORMAT "%8.3" /end CHARACTERISTIC
/begin CHARACTERISTIC TADLLR "Ansauglufttemperaturschwelle für Diagnose Leerlaufsteller" VALUE 0x81A083 KwUb 191.3 temp_ub_q0p75_o48 -48.00 143.3 FORMAT "%5.1" /end CHARACTERISTIC
/begin CHARACTERISTIC TAFFO "Obere tans-Schwelle für 0.5 mm - Diagnose" VALUE 0x81A51D KwUb 191.3 temp_ub_q0p75_o48 -48.00 143.3 FORMAT "%5.1" /end CHARACTERISTIC
/begin CHARACTERISTIC TAFLDPO "Obere TANS- Schwelle für Leckdiagnose bei Kurztrip" VALUE 0x81A51E KwUb 191.3 temp_ub_q0p75_o48 -48.00 143.3 FORMAT "%5.1" /end CHARACTERISTIC
/begin CHARACTERISTIC TALDPO "Obere Ansaugtemperaturschwelle für Leckdiagnosemodul" VALUE 0x81A51F KwUb 191.3 temp_ub_q0p75_o48 -48.00 143.3 FORMAT "%5.1" /end CHARACTERISTIC
/begin CHARACTERISTIC TALDPU "Untere Ansaugtemperaturschwelle für Leckdiagnosemodul" VALUE 0x81A520 KwUb 191.3 temp_ub_q0p75_o48 -48.00 143.3 FORMAT "%5.1" /end CHARACTERISTIC
/begin CHARACTERISTIC TALSUMN "Abgastemperatur-Schwellwert für Heilung E_hsvsa" VALUE 0x8139A4 KwUw 1535.977 temp_q0p0234_o273 -273.1500 1262.827 FORMAT "%8.3" /end CHARACTERISTIC
/begin CHARACTERISTIC TALSUSAE "Abgastemperatur-Schwellwert für Fehlereintrag E_hsvsa" VALUE 0x8139A6 KwUw 1535.977 temp_q0p0234_o273 -273.1500 1262.827 FORMAT "%8.3" /end CHARACTERISTIC
/begin CHARACTERISTIC TANSDHLSH "Ansauglufttemperaturschwelle für Ri- Diagnose hinter Kat" VALUE 0x818476 KwUb 191.3 temp_ub_q0p75_o48 -48.00 143.3 FORMAT "%5.1" /end CHARACTERISTIC
/begin CHARACTERISTIC TASOH "Temperaturschwelle für Sonde hinter Kat ohne Heizung funktionsfähig" VALUE 0x81C266 KwUw 1535.977 temp_q0p0234_o273 -273.1500 1262.827 FORMAT "%8.3" /end CHARACTERISTIC
/begin CHARACTERISTIC TC6LDPC1 "Mode 6 Component ID für Prüfung Grob-/Feinleck" VALUE 0x812156 KwUb 127.0 dez 0.00 127.0 FORMAT "%5.1" /end CHARACTERISTIC
/begin CHARACTERISTIC TC6LDPC2 "Mode 6 Component ID für Prüfung 'Reed-Kontakt geschlossen'" VALUE 0x812157 KwUb 127.0 dez 0.00 127.0 FORMAT "%5.1" /end CHARACTERISTIC
/begin CHARACTERISTIC TC6LDPC3 "Mode 6 Component ID für Prüfung 'Reed-Kontakt öffnet'" VALUE 0x812158 KwUb 127.0 dez 0.00 127.0 FORMAT "%5.1" /end CHARACTERISTIC
/begin CHARACTERISTIC TC6LDPC4 "Mode 6 Component ID für Prüfung während Initialspülung'" VALUE 0x812159 KwUb 127.0 dez 0.00 127.0 FORMAT "%5.1" /end CHARACTERISTIC
/begin CHARACTERISTIC TC6LDPC5 "Mode 6 Component ID für Prüfung 0.5 mm Leck'" VALUE 0x81215A KwUb 127.0 dez 0.00 127.0 FORMAT "%5.1" /end CHARACTERISTIC
/begin CHARACTERISTIC TDFHS "Entprellzeit für Heizerendstufe" VALUE 0x810BB4 KwUb 2.550 t10msxs_ub_b2p55 0.00 2.550 FORMAT "%5.3" /end CHARACTERISTIC
/begin CHARACTERISTIC TDHR "Entprellzeit für Diagnose Hauptrelais" VALUE 0x82913E KwUw 6553.500 t100msxs_uw_b6553p5 0.00 6553.500 FORMAT "%8.3" /end CHARACTERISTIC
/begin CHARACTERISTIC TDKUPNOG "Verzögerungszeit nach Gangwechsel bis erneute Gangwechselerk. möglich" VALUE 0x8186F9 KwUb 255.0 t1sxs_ub_b255 0.00 255.0 FORMAT "%5.1" /end CHARACTERISTIC
/begin CHARACTERISTIC TDLDPE "Entprellzeit für Fehler setzen LDP-Endstufe" VALUE 0x8187C8 KwUb 25.50 t100msxs_ub_b25p5 0.00 25.50 FORMAT "%5.2" /end CHARACTERISTIC
/begin CHARACTERISTIC TDLDRA "Zeitschwelle für Dia LDR - Regelabweichung" VALUE 0x819D55 KwUb 12.75 t50msxs_ub_b12p75 0.00 12.75 FORMAT "%5.2" /end CHARACTERISTIC
/begin CHARACTERISTIC TDLDRA2 "Zeitschwelle für Dia LDR - Regelabweichung (B_mxldra)" VALUE 0x819D56 KwUb 12.75 t50msxs_ub_b12p75 0.00 12.75 FORMAT "%5.2" /end CHARACTERISTIC
/begin CHARACTERISTIC TDLKVDKH "Zeitverzögerung für löschen von E_lkvdk" VALUE 0x819D57 KwUb 12.75 t50msxs_ub_b12p75 0.00 12.75 FORMAT "%5.2" /end CHARACTERISTIC
/begin CHARACTERISTIC TDLKVDKL "Zeitverzögerung für setzen von E_lkvdk im Ladebetrieb" VALUE 0x819D58 KwUb 12.75 t50msxs_ub_b12p75 0.00 12.75 FORMAT "%5.2" /end CHARACTERISTIC
/begin CHARACTERISTIC TDLKVDKLL "Zeitverzögerung für setzen von E_lkvdk im Saugbetrieb untere Schwelle" VALUE 0x819D59 KwUb 12.75 t50msxs_ub_b12p75 0.00 12.75 FORMAT "%5.2" /end CHARACTERISTIC
/begin CHARACTERISTIC TDLKVDKS "Zeitverzögerung für setzen von E_lkvdk im Saugbetrieb" VALUE 0x819D5A KwUb 12.75 t50msxs_ub_b12p75 0.00 12.75 FORMAT "%5.2" /end CHARACTERISTIC
/begin CHARACTERISTIC TDLKVDKST "Zeitverzögerung für setzen von E_lkvdk nach Startende" VALUE 0x819D5B KwUb 12.75 t50msxs_ub_b12p75 0.00 12.75 FORMAT "%5.2" /end CHARACTERISTIC
/begin CHARACTERISTIC TDLKVDKT "Zeitverzögerung für setzen von E_lkvdk im Ladebetrieb ab B_ll=true" VALUE 0x819D5C KwUb 12.75 t50msxs_ub_b12p75 0.00 12.75 FORMAT "%5.2" /end CHARACTERISTIC
/begin CHARACTERISTIC TDLLR "Wartezeit bis Setzen der Bedingung Diagnose Leerlaufsteller" VALUE 0x827230 KwUw 255.0000 t200msxs_ub_b51 0.00 255.0000 FORMAT "%8.4" /end CHARACTERISTIC
/begin CHARACTERISTIC TDLLRMN "Wartezeit bis Fehlereintrag Steller geschlossen" VALUE 0x827232 KwUw 255.0000 t200msxs_ub_b51 0.00 255.0000 FORMAT "%8.4" /end CHARACTERISTIC
/begin CHARACTERISTIC TDLLRMX "Wartezeit bis Fehlereintrag Steller offen" VALUE 0x827234 KwUw 255.0000 t200msxs_ub_b51 0.00 255.0000 FORMAT "%8.4" /end CHARACTERISTIC
/begin CHARACTERISTIC TDLLRNF "Wartezeit bis Meldung kein Fehler bei Leerlaufsteller" VALUE 0x827236 KwUw 255.0000 t200msxs_ub_b51 0.00 255.0000 FORMAT "%8.4" /end CHARACTERISTIC
/begin CHARACTERISTIC TDMLHFM "Zeitverzögerung für das Setzen von B_ehfm" VALUE 0x810EA8 KwUb 2.550 t10msxs_ub_b2p55 0.00 2.550 FORMAT "%5.3" /end CHARACTERISTIC
/begin CHARACTERISTIC TDMLMN "Entprellzeit HFM-(Hauptlastgeber-)Fehlererkennung Minimalwert" VALUE 0x818841 KwUb 25.50 t100msxs_ub_b25p5 0.00 25.50 FORMAT "%5.2" /end CHARACTERISTIC
/begin CHARACTERISTIC TDMLMX "Entprellzeit HFM-(Hauptlastgeber-)Fehlererkennung Maximalwert" VALUE 0x818842 KwUb 25.50 t100msxs_ub_b25p5 0.00 25.50 FORMAT "%5.2" /end CHARACTERISTIC
/begin CHARACTERISTIC TDMLNF "Entprellzeit HFM-(Hauptlastgeber-)Diagnose mit i.O.-Meldung" VALUE 0x818843 KwUb 25.50 t100msxs_ub_b25p5 0.00 25.50 FORMAT "%5.2" /end CHARACTERISTIC
/begin CHARACTERISTIC TDMLNPL "Entprellzeit HFM-(Hauptlastgeber-)Fehlererkennung nicht plausibler Wert" VALUE 0x818844 KwUb 25.50 t100msxs_ub_b25p5 0.00 25.50 FORMAT "%5.2" /end CHARACTERISTIC
/begin CHARACTERISTIC TDMLST "Entprellzeit HFM-(Hauptlastgeber-)Fehlererkennung im Start" VALUE 0x818845 KwUb 25.50 t100msxs_ub_b25p5 0.00 25.50 FORMAT "%5.2" /end CHARACTERISTIC
/begin CHARACTERISTIC TDUBHFM "Zeit für HFM-Diagnose mit u < UBHFM" VALUE 0x818846 KwUb 25.50 t100msxs_ub_b25p5 0.00 25.50 FORMAT "%5.2" /end CHARACTERISTIC
/begin CHARACTERISTIC TDZHR "Entprellzeit für Setzen des Zyklusflag" VALUE 0x829140 KwUw 6553.500 t100msxs_uw_b6553p5 0.00 6553.500 FORMAT "%8.3" /end CHARACTERISTIC
/begin CHARACTERISTIC TEVCKMX "Maximale Spülzeit bei DLDP-TEV- Check" VALUE 0x81771C KwUw 655.3500 t10msxs_uw_b655p35 0.00 655.3500 FORMAT "%8.4" /end CHARACTERISTIC
/begin CHARACTERISTIC TFDLLRO "Obere Schwelle für Zeitfenster für DLLR" VALUE 0x827238 KwUw 6553.500 t100msxs_uw_b6553p5 0.00 6553.500 FORMAT "%8.3" /end CHARACTERISTIC
/begin CHARACTERISTIC TFDLLRU "Untere Schwelle für Zeitfenster für DLLR" VALUE 0x82723A KwUw 6553.500 t100msxs_uw_b6553p5 0.00 6553.500 FORMAT "%8.3" /end CHARACTERISTIC
/begin CHARACTERISTIC TFRA "Erkennungszeit für eingeschwungene Grundadaption von fra" VALUE 0x819490 KwUb 51.00 t200msxs_ub_b51 0.00 51.00 FORMAT "%5.2" /end CHARACTERISTIC
/begin CHARACTERISTIC TFRAOZ "Verweilzeit in FRAO für Zyklusflag bei nicht eingeschw. Adaption" VALUE 0x819491 KwUb 51.00 t200msxs_ub_b51 0.00 51.00 FORMAT "%5.2" /end CHARACTERISTIC
/begin CHARACTERISTIC TFRAUZ "Verweilzeit in FRAU für Zyklusflag bei nicht eingeschw. Adaption" VALUE 0x819492 KwUb 51.00 t200msxs_ub_b51 0.00 51.00 FORMAT "%5.2" /end CHARACTERISTIC
/begin CHARACTERISTIC TFRMST "Erkennungszeit für Eingeschwingen von frm" VALUE 0x819493 KwUb 51.00 t200msxs_ub_b51 0.00 51.00 FORMAT "%5.2" /end CHARACTERISTIC
/begin CHARACTERISTIC TFRMZST "Verweilzeit für unplausibles frm-Signal (Kurztest)" VALUE 0x819494 KwUb 51.00 t200msxs_ub_b51 0.00 51.00 FORMAT "%5.2" /end CHARACTERISTIC
/begin CHARACTERISTIC THLKSLUE1 "Zeit zur Heilungsentprellung bei KS nach Masse" VALUE 0x81C58E KwUw 6553.500 fak_q0p1 0.00 6553.500 FORMAT "%8.3" /end CHARACTERISTIC
/begin CHARACTERISTIC THLKSLUE2 "Zeit zum Zurücksetzten der Fehlerzähler wenn KS=0" VALUE 0x81C590 KwUw 6553.500 fak_q0p1 0.00 6553.500 FORMAT "%8.3" /end CHARACTERISTIC
/begin CHARACTERISTIC TIZUMN "Minimale Zeit für TEV-zu bei Initialspülung Leckdiagnose" VALUE 0x81A521 KwUb 255.0 t1sxs_ub_b255 0.00 255.0 FORMAT "%5.1" /end CHARACTERISTIC
/begin CHARACTERISTIC TKTDGRA "Zeit für Tempereraturgradientenmessung der Katdiagnose" VALUE 0x8186C2 KwUb 51.00 t_q0p2 0.00 51.00 FORMAT "%5.2" /end CHARACTERISTIC
/begin CHARACTERISTIC TKTDSP "Wartezeit in der Katdiagnose auf die Schubprüfung" VALUE 0x81C4AA KwUw 13107.00 t_q0p2 0.00 13107.00 FORMAT "%8.2" /end CHARACTERISTIC
/begin CHARACTERISTIC TLDP1SD "Zeitschwelle 1 für Erkennung System dicht bei Leckdiagnosemodul" VALUE 0x81771E KwUw 655.3500 t10msxs_uw_b655p35 0.00 655.3500 FORMAT "%8.4" /end CHARACTERISTIC
/begin CHARACTERISTIC TLDP2SD "Zeitschwelle 2 für Erkennung System dicht bei Leckdiagnosemodul" VALUE 0x817720 KwUw 655.3500 t10msxs_uw_b655p35 0.00 655.3500 FORMAT "%8.4" /end CHARACTERISTIC
/begin CHARACTERISTIC TLDPMN "Wartezeit nach Start für Freigabe Leckdiagnose" VALUE 0x82807E KwUw 65535.00 t1sxs_uw_b65535 0.00 65535.00 FORMAT "%8.2" /end CHARACTERISTIC
/begin CHARACTERISTIC TLDPMX "Maximale Diagnosezeit nach Start" VALUE 0x828080 KwUw 65535.00 t1sxs_uw_b65535 0.00 65535.00 FORMAT "%8.2" /end CHARACTERISTIC
/begin CHARACTERISTIC TLDPRKL "Zeit für 'Reed-Kontakt zu'-Erkennung Closed Check" VALUE 0x817722 KwUw 655.3500 t10msxs_uw_b655p35 0.00 655.3500 FORMAT "%8.4" /end CHARACTERISTIC
/begin CHARACTERISTIC TLDPRKO "Zeit für ""Reed-Kontankt offen""-Erkennung bei Leckdiagnosemodul" VALUE 0x817724 KwUw 655.3500 t10msxs_uw_b655p35 0.00 655.3500 FORMAT "%8.4" /end CHARACTERISTIC
/begin CHARACTERISTIC TLDPZMN "Minimale Zeit für TEV-zu vor Fortsetzung Leckdiagnose" VALUE 0x817726 KwUw 655.3500 t10msxs_uw_b655p35 0.00 655.3500 FORMAT "%8.4" /end CHARACTERISTIC
/begin CHARACTERISTIC TLDRA "Verzögerungszeit fuer Dia LDR Regelabweichung Erkennung Zyklusflag" VALUE 0x819D5D KwUb 12.75 t50msxs_ub_b12p75 0.00 12.75 FORMAT "%5.2" /end CHARACTERISTIC
/begin CHARACTERISTIC TLLASH "Verzög.zeit um lamlash_w zu sperren wenn lamsons_w ungleich lamlash_w ist" VALUE 0x81864A KwUb 25.50 t100msxs_ub_b25p5 0.00 25.50 FORMAT "%5.2" /end CHARACTERISTIC
/begin CHARACTERISTIC TLSUSAE "Zeit für Fehlereintrag während B_sa" VALUE 0x8139A8 KwUw 1310.700 t20msxs_uw_b1310 0.00 1310.700 FORMAT "%8.3" /end CHARACTERISTIC
/begin CHARACTERISTIC TMAXKATA "Maximale Kat.-Temperatur für Ausräumprüfung bei Katdiagnose" VALUE 0x8186B7 KwUb 1275. temp_ub_q5_o50 -50.00 1225. FORMAT "%5.0" /end CHARACTERISTIC
/begin CHARACTERISTIC TMAXKATS "maximale Kat-Temperatur für Kat-diagnose" VALUE 0x8186C3 KwUb 1275. temp_ub_q5_o50 -50.00 1225. FORMAT "%5.0" /end CHARACTERISTIC
/begin CHARACTERISTIC TMAXKATSO "maximale Kat-Temperatur für Haupt-Kat-diagnose, oberes Band" VALUE 0x8186C4 KwUb 1275. temp_ub_q5_o50 -50.00 1225. FORMAT "%5.0" /end CHARACTERISTIC
/begin CHARACTERISTIC TMDLLR "Motortemperaturschwelle für Diagnose Leerlaufsteller" VALUE 0x81A084 KwUb 191.3 temp_ub_q0p75_o48 -48.00 143.3 FORMAT "%5.1" /end CHARACTERISTIC
/begin CHARACTERISTIC TMFDUV "Meßfensterzeit zur Pulsationsauswertung für Diagnose Schubumluftventil" VALUE 0x8187C6 KwUb 2.550 t_q0p01 0.00 2.550 FORMAT "%5.3" /end CHARACTERISTIC
/begin CHARACTERISTIC TMFFO "Obere tmot-Schwelle für 0.5 mm - Diagnose" VALUE 0x81A522 KwUb 191.3 temp_ub_q0p75_o48 -48.00 143.3 FORMAT "%5.1" /end CHARACTERISTIC
/begin CHARACTERISTIC TMFRST "Einschalttemperatur LR- Kurztest" VALUE 0x819495 KwUb 191.3 temp_ub_q0p75_o48 -48.00 143.3 FORMAT "%5.1" /end CHARACTERISTIC
/begin CHARACTERISTIC TMINKATS "Minimale Kat-Temperatur für Überwachung" VALUE 0x8186C5 KwUb 1275. temp_ub_q5_o50 -50.00 1225. FORMAT "%5.0" /end CHARACTERISTIC
/begin CHARACTERISTIC TMINKATSO "Minimale Haupt-Kat-Temperatur für Überwachung, oberes Band" VALUE 0x8186C6 KwUb 1275. temp_ub_q5_o50 -50.00 1225. FORMAT "%5.0" /end CHARACTERISTIC
/begin CHARACTERISTIC TMLDPO "Obere Motortemperaturschwelle für Leckdiagnosemodul" VALUE 0x81A523 KwUb 191.3 temp_ub_q0p75_o48 -48.00 143.3 FORMAT "%5.1" /end CHARACTERISTIC
/begin CHARACTERISTIC TMLDPU "Untere Motortemperaturschwelle für Leckdiagnosemodul" VALUE 0x81A524 KwUb 191.3 temp_ub_q0p75_o48 -48.00 143.3 FORMAT "%5.1" /end CHARACTERISTIC
/begin CHARACTERISTIC TMMZUV "Mindestmesszeit für Schubumluftventildignose" VALUE 0x8187C7 KwUb 2.550 t_q0p01 0.00 2.550 FORMAT "%5.3" /end CHARACTERISTIC
/begin CHARACTERISTIC TMN1DlUE1 "Fehlererkennungszeit für Hauptlüfter defekt" VALUE 0x81C592 KwUw 599.2000 fak_q0p1 0.8000000 600.0000 FORMAT "%8.4" /end CHARACTERISTIC
/begin CHARACTERISTIC TMN2DLUE1 "Fehlererkennungszeit fürZusatzlüfter defekt" VALUE 0x81C594 KwUw 599.2000 fak_q0p1 0.8000000 600.0000 FORMAT "%8.4" /end CHARACTERISTIC
/begin CHARACTERISTIC TMN3DLUE1 "Fehlererkennungszeit für beide Lüfter defekt" VALUE 0x81C596 KwUw 599.2000 fak_q0p1 0.8000000 600.0000 FORMAT "%8.4" /end CHARACTERISTIC
/begin CHARACTERISTIC TMNKATST "Minimale Kat-Temperatur für Überwachung bei Testerbetrieb" VALUE 0x8186C7 KwUb 1275. temp_ub_q5_o50 -50.00 1225. FORMAT "%5.0" /end CHARACTERISTIC
/begin CHARACTERISTIC TMNKSLUE1 "Fehlererkennungszeit für echten KS" VALUE 0x81C598 KwUw 6553.500 fak_q0p1 0.00 6553.500 FORMAT "%8.3" /end CHARACTERISTIC
/begin CHARACTERISTIC TMSUKTDS "Minimale tmot-Start-Temperatur für Katdiagnose" VALUE 0x810BBC KwUb 191.3 temp_ub_q0p75_o48 -48.00 143.3 FORMAT "%5.1" /end CHARACTERISTIC
/begin CHARACTERISTIC TMXKATST "Maximale Kat-Temperatur für Überwachung bei Testerbetrieb" VALUE 0x8186C8 KwUb 1275. temp_ub_q5_o50 -50.00 1225. FORMAT "%5.0" /end CHARACTERISTIC
/begin CHARACTERISTIC TNLDHLSU "SG-Nachlaufzeit für DHLSU" VALUE 0x81C3C8 KwUw 65535.00 t1sxs_uw_q1 0.00 65535.00 FORMAT "%8.2" /end CHARACTERISTIC
/begin CHARACTERISTIC TPFIFOANZ "Anzahl FIFO-Einträge für Berechnung Periodendauer-Mittelwert" VALUE 0x81215B KwUb 3.000 dez 1.000 4.000 FORMAT "%5.3" /end CHARACTERISTIC
/begin CHARACTERISTIC TPTEVMN "Periodendauerschwelle bei LDP-TEV-Check" VALUE 0x817728 KwUw 655.3500 t10msxs_uw_b655p35 0.00 655.3500 FORMAT "%8.4" /end CHARACTERISTIC
/begin CHARACTERISTIC TPUPH "Kennlinie für die Pumpzeit abhängig von den vorherigen Durchläufen" VAL_BLK 0x81772A KwbUw 655.3500 t10msxs_uw_b655p35 0.00 655.3500 FORMAT "%8.4" NUMBER 30 /end CHARACTERISTIC
/begin CHARACTERISTIC TRIPFASH "Kurztrip: Mindest Zeitdauer für aktive Lambda Regelung vor Kat" VALUE 0x81C3B6 KwUw 6553.500 t100msxs_uw_b6553p5 0.00 6553.500 FORMAT "%8.3" /end CHARACTERISTIC
/begin CHARACTERISTIC TRKA "Erkennungszeit für eingeschwungene Grundadaption von rkat bzw. rkaz" VALUE 0x819496 KwUb 51.00 t200msxs_ub_b51 0.00 51.00 FORMAT "%5.2" /end CHARACTERISTIC
/begin CHARACTERISTIC TRKATZ "Aktivierungszeit von rkat bis Setzen Zyklusflag, wenn B_gae = FALSE" VALUE 0x819497 KwUb 51.00 t200msxs_ub_b51 0.00 51.00 FORMAT "%5.2" /end CHARACTERISTIC
/begin CHARACTERISTIC TRKAUF "Überwachungszeit Reedkontakt öffnet während Fast Pulse" VALUE 0x817766 KwUw 655.3500 t10msxs_uw_b655p35 0.00 655.3500 FORMAT "%8.4" /end CHARACTERISTIC
/begin CHARACTERISTIC TRKAZZ "Aktivierungszeit von rkaz bis Setzen Zyklusflag, wenn B_gae = FALSE" VALUE 0x819498 KwUb 51.00 t200msxs_ub_b51 0.00 51.00 FORMAT "%5.2" /end CHARACTERISTIC
/begin CHARACTERISTIC TSALASH "Zeit nach Schub für Überprüfung Sonde hinter KAT" VALUE 0x81864B KwUb 25.50 t100msxs_ub_b25p5 0.00 25.50 FORMAT "%5.2" /end CHARACTERISTIC
/begin CHARACTERISTIC TSFAATUN "Fehlersummenzeit: Tuningschutz" VALUE 0x810A9C KwUb 255.0 dez 0.00 255.0 FORMAT "%5.1" /end CHARACTERISTIC
/begin CHARACTERISTIC TSFLDPE "Fehlersummenzeit: Leckdiagnosepumpe Endstufe" VALUE 0x810AF4 KwUb 255.0 dez 0.00 255.0 FORMAT "%5.1" /end CHARACTERISTIC
/begin CHARACTERISTIC TSFMDB "Fehlersummenzeit: Momentbegrenzung Sollmoment" VALUE 0x810B03 KwUb 255.0 dez 0.00 255.0 FORMAT "%5.1" /end CHARACTERISTIC
/begin CHARACTERISTIC TSFSGEEW "Fehlersummenzeit: Steuergerät defekt (EEPROM WFS-Bereich)" VALUE 0x810B10 KwUb 255.0 dez 0.00 255.0 FORMAT "%5.1" /end CHARACTERISTIC
/begin CHARACTERISTIC TSFWFS "Fehlersummenzeit: Wegfahrsperre" VALUE 0x810B2D KwUb 255.0 dez 0.00 255.0 FORMAT "%5.1" /end CHARACTERISTIC
/begin CHARACTERISTIC TSFWFSRC "Fehlersummenzeit: Wegfahrsperre RC-Glied" VALUE 0x810B2E KwUb 255.0 dez 0.00 255.0 FORMAT "%5.1" /end CHARACTERISTIC
/begin CHARACTERISTIC TSKTDTK "Temperaturabhängige Verzögerungszeit für Katdiagnose" CURVE 0x81C4AC KlAUbSstUwWUw 13107.00 t200msxs_uw_q0p2 0.00 13107.00 FORMAT "%8.2"
 /begin AXIS_DESCR STD_AXIS tkdkthps temp_ub_q5 4 0.00 1275.000 FORMAT "%8.3" DEPOSIT ABSOLUTE /end AXIS_DESCR
/end CHARACTERISTIC
/begin CHARACTERISTIC TSLDPV "Entprellzeit für Unterschreiten der Fz-Geschwindigkeitsschwelle für Übergang nac" VALUE 0x81A525 KwUb 25.50 t_q0p1 0.00 25.50 FORMAT "%5.2" /end CHARACTERISTIC
/begin CHARACTERISTIC TSRFPAB "Mindestschaltzeit Reed-Kontakt für Abbruch Fast Pulse" VALUE 0x817768 KwUw 655.3500 t10msxs_uw_b655p35 0.00 655.3500 FORMAT "%8.4" /end CHARACTERISTIC
/begin CHARACTERISTIC TSTZUMN "Zeit nach Start für zwangsgeschlossenes TEV" VALUE 0x81776A KwUw 65535.00 t1sxs_uw_b65535 0.00 65535.00 FORMAT "%8.2" /end CHARACTERISTIC
/begin CHARACTERISTIC TTLASH "Zeit für Verweildauer der Sonde hinter KAT unter/oberhalb des Sollwertes" VALUE 0x81C3B8 KwUw 6553.500 t100msxs_uw_b6553p5 0.00 6553.500 FORMAT "%8.3" /end CHARACTERISTIC
/begin CHARACTERISTIC TTOTLDP "Totzeit LDP- Sofortansteuerung während Fast Pulse" VALUE 0x81776C KwUw 655.3500 t10msxs_uw_b655p35 0.00 655.3500 FORMAT "%8.4" /end CHARACTERISTIC
/begin CHARACTERISTIC TULV1 "Verzögerung Überladeabschneiden, ti-Ausblengung Stufe 1" VALUE 0x819D5E KwUb 12.75 t50msxs_ub_b12p75 0.00 12.75 FORMAT "%5.2" /end CHARACTERISTIC
/begin CHARACTERISTIC TULV3 "Verzögerungszeit für Heilung Überladefehler" VALUE 0x819D5F KwUb 12.75 t50msxs_ub_b12p75 0.00 12.75 FORMAT "%5.2" /end CHARACTERISTIC
/begin CHARACTERISTIC TUSCHUB "Verzögerungszeit für Störspitzen bei Schubprüfung der Sonde hinter KAT" VALUE 0x81864C KwUb 25.50 t100msxs_ub_b25p5 0.00 25.50 FORMAT "%5.2" /end CHARACTERISTIC
/begin CHARACTERISTIC TUSENLASH "Zeitdauer bis Sonden Mager/Fett Erkennung erlaubt hinter Kat" VALUE 0x81C3BA KwUw 6553.500 t100msxs_uw_b6553p5 0.00 6553.500 FORMAT "%8.3" /end CHARACTERISTIC
/begin CHARACTERISTIC TUSHKRFM "Zeitdauer bis zur Freig. Wiederholungsmess. Schwingungspr. (Reset F/M-Flip-Flop)" VALUE 0x81C3BC KwUw 6553.500 t100msxs_uw_b6553p5 0.00 6553.500 FORMAT "%8.3" /end CHARACTERISTIC
/begin CHARACTERISTIC TUSHKVL "Verzögerungszeit für Störspitzen bei Vollastprüfung der Sonde hinter KAT" VALUE 0x81864D KwUb 25.50 t100msxs_ub_b25p5 0.00 25.50 FORMAT "%5.2" /end CHARACTERISTIC
/begin CHARACTERISTIC TUSHSMIN "Mindestdauer für Steigungsmessung für enable Filter hinter Kat" VALUE 0x81864E KwUb 25.50 t100msxs_ub_b25p5 0.00 25.50 FORMAT "%5.2" /end CHARACTERISTIC
/begin CHARACTERISTIC TUSLASH "Testzeit füt Dauer Anfettung/Abmagerung hinter KAT" VALUE 0x81C3BE KwUw 6553.500 t100msxs_uw_b6553p5 0.00 6553.500 FORMAT "%8.3" /end CHARACTERISTIC
/begin CHARACTERISTIC TUSMSVL "Zeit nach Vollast für Überprüfung Sonde hinter KAT" VALUE 0x81864F KwUb 25.50 t100msxs_ub_b25p5 0.00 25.50 FORMAT "%5.2" /end CHARACTERISTIC
/begin CHARACTERISTIC TUSSA "Verzögerungszeit nach Über/Unterschreiten der Regelschwelle hinter KAT" VALUE 0x818650 KwUb 25.50 t100msxs_ub_b25p5 0.00 25.50 FORMAT "%5.2" /end CHARACTERISTIC
/begin CHARACTERISTIC TUSTALLASH "Verzög.zeit für Erkennung B_maxlash nach ""Tank leer"" fahren für Sonde h. KAT" VALUE 0x81C3C0 KwUw 6553.500 t100msxs_uw_b6553p5 0.00 6553.500 FORMAT "%8.3" /end CHARACTERISTIC
/begin CHARACTERISTIC TVFZDIF "Zeitintervall für vfz-Differenzberechnung" VALUE 0x81A526 KwUb 25.50 t100msxs_ub_b25p5 0.00 25.50 FORMAT "%5.2" /end CHARACTERISTIC
/begin CHARACTERISTIC TVHSHEE "Entprellzeit für Heizerendstufdiagnose hinter Kat" VALUE 0x818477 KwUb 12.75 t50msxs_ub_b12p75 0.00 12.75 FORMAT "%5.2" /end CHARACTERISTIC
/begin CHARACTERISTIC TVHSHRI "Verzögerungszeit für Ri-Fehler hinter Kat" VALUE 0x818478 KwUb 255.0 t1sxs_ub_b255 0.00 255.0 FORMAT "%5.1" /end CHARACTERISTIC
/begin CHARACTERISTIC TVHSHRIHEL "Verzögerungszeit für Heilung Ri-Fehler hinter Kat, wenn B_npfhsh =1" VALUE 0x818479 KwUb 255.0 t1sxs_ub_b255 0.00 255.0 FORMAT "%5.1" /end CHARACTERISTIC
/begin CHARACTERISTIC TVHSHRIZ "Verzögerungszeit für Heilung Ri-Fehler hinter Kat" VALUE 0x81847A KwUb 255.0 t1sxs_ub_b255 0.00 255.0 FORMAT "%5.1" /end CHARACTERISTIC
/begin CHARACTERISTIC TVKTDLE "Zeitverzögerung Lambda eingeschwungen bei Katalysatordiagnose" VALUE 0x8186B8 KwUb 12.75 t_q0p05 0.00 12.75 FORMAT "%5.2" /end CHARACTERISTIC
/begin CHARACTERISTIC TVKTDRX "Maximale Fettzeit für hintere Sondenspannung bei Katdiagnose" VALUE 0x8186B9 KwUb 5.100 t_q0p02 0.00 5.100 FORMAT "%5.3" /end CHARACTERISTIC
/begin CHARACTERISTIC TVLDIMX "Tastverhältnisschwelle für I-Anteil Adaptionswert in DLDR zum Setzen von LDRA" VALUE 0x827010 KwSw 327.6750 tv_sw_q0p005 -163.8400 163.8350 FORMAT "%8.4" /end CHARACTERISTIC
/begin CHARACTERISTIC TVLDPMN "Minimales TEV-Tastverhältnis für Fortsetzung Leckdiagnose" VALUE 0x81A527 KwUb 99.61 rel_ub_b99p6 0.00 99.61 FORMAT "%5.2" /end CHARACTERISTIC
/begin CHARACTERISTIC TVLDPT "Tastverhältnis für Fast Pulse Leckdiagnosepumpe" CURVE 0x81A528 KlAUbSstUbWUb 99.61 rel_ub_b99p6 0.00 99.61 FORMAT "%5.2"
 /begin AXIS_DESCR STD_AXIS tfpg t1sxs_ub_b255 6 0.00 255.0 FORMAT "%5.1" DEPOSIT ABSOLUTE /end AXIS_DESCR
/end CHARACTERISTIC
/begin CHARACTERISTIC TVLSUBM "maximal zul. Verzögerungszeit für Betriebsbereitschaft stetige Lambdasonde LSU" VALUE 0x81C3CA KwUw 3276.750 t50msxs_uw_b3276p75 0.00 3276.750 FORMAT "%8.3" /end CHARACTERISTIC
/begin CHARACTERISTIC TVLSUEE "Verzögerungszeit für LSU Heizerendstufenfehler" VALUE 0x818655 KwUb 12.75 t50msxs_ub_b12p75 0.00 12.75 FORMAT "%5.2" /end CHARACTERISTIC
/begin CHARACTERISTIC TVLSUNP "Verzögerungszeit für Fehler stetige Lambdasonde LSU" VALUE 0x818656 KwUb 12.75 t50msxs_ub_b12p75 0.00 12.75 FORMAT "%5.2" /end CHARACTERISTIC
/begin CHARACTERISTIC TVLSUSA "Verzögerungszeit für Funktionsprüfung während B_sa" VALUE 0x81C3CC KwUw 1310.700 t20msxs_uw_q0p02 0.00 1310.700 FORMAT "%8.3" /end CHARACTERISTIC
/begin CHARACTERISTIC TVLSUSAE "Verzögerungszeit für Fehlereintrag während B_sa" VALUE 0x81C3CE KwUw 1310.700 t20msxs_uw_q0p02 0.00 1310.700 FORMAT "%8.3" /end CHARACTERISTIC
/begin CHARACTERISTIC TVLSUSAH "Verzögerungszeit für Fehlerheilung während B_sa" VALUE 0x81C3D0 KwUw 1310.700 t20msxs_uw_q0p02 0.00 1310.700 FORMAT "%8.3" /end CHARACTERISTIC
/begin CHARACTERISTIC TVLSUST "Verzögerungszeit für Endstufendiagnose Heizung LSU" VALUE 0x818657 KwUb 25.50 t100msxs_ub_b25p5 0.00 25.50 FORMAT "%5.2" /end CHARACTERISTIC
/begin CHARACTERISTIC TVRIHEE "Verzögerungszeit für Ri-Fehler nach Endstufenfehler hinter Kat" VALUE 0x81847B KwUb 255.0 t1sxs_ub_b255 0.00 255.0 FORMAT "%5.1" /end CHARACTERISTIC
/begin CHARACTERISTIC TVTEVMN "minimales TEV- Tastverhältnis bei DLDP- TEV- Check" VALUE 0x81215C KwUb 99.61 rel_ub_b99p6 0.00 99.61 FORMAT "%5.2" /end CHARACTERISTIC
/begin CHARACTERISTIC TWDKATS "Wartezeit nach Stoppbedingung für Filter und Integrator" VALUE 0x8186C9 KwUb 12.75 t_q0p05 0.00 12.75 FORMAT "%5.2" /end CHARACTERISTIC
/begin CHARACTERISTIC TWDLDPE "Wartezeit für Fehlerdiagnose LDP-Endstufe" VALUE 0x8187C9 KwUb 25.50 t100msxs_ub_b25p5 0.00 25.50 FORMAT "%5.2" /end CHARACTERISTIC
/begin CHARACTERISTIC TWLDPE "Entprellzeit für i.O.-Prüfung LDP-Endstufe" VALUE 0x8187CA KwUb 25.50 t100msxs_ub_b25p5 0.00 25.50 FORMAT "%5.2" /end CHARACTERISTIC
/begin CHARACTERISTIC TXFMX "Max. Zeit nach Start für Feinstleckdiagnose (0.5 mm)" VALUE 0x828082 KwUw 65535.00 t1sxs_uw_b65535 0.00 65535.00 FORMAT "%8.2" /end CHARACTERISTIC
/begin CHARACTERISTIC UBDHLSHMN "untere Batteriespannungsschwelle zur Freigabe der Lambdasonden-Heizer-Diagnose" VALUE 0x81C268 KwUw 25.59961 spg_q0p00039 0.00 25.59961 FORMAT "%8.5" /end CHARACTERISTIC
/begin CHARACTERISTIC UBDHLSHMX "obere Batteriespannungsschwelle für die Lambdasonden- Heizer-Diagnose" VALUE 0x81C26A KwUw 25.59961 spg_q0p00039 0.00 25.59961 FORMAT "%8.5" /end CHARACTERISTIC
/begin CHARACTERISTIC UBDHLSUMN "Batteriespannungsschwelle zur Freigabe der Heizer-Diagnose LSU" VALUE 0x8139AA KwUw 25.59961 spg_q0p00039 0.00 25.59961 FORMAT "%8.5" /end CHARACTERISTIC
/begin CHARACTERISTIC UBDHLSUMX "obere Batteriespannungsschwelle für die  Heizer-Diagnose LSU" VALUE 0x8139AC KwUw 25.59961 spg_q0p00039 0.00 25.59961 FORMAT "%8.5" /end CHARACTERISTIC
/begin CHARACTERISTIC UBDOLDPE "obere Spannungsschwelle für Freigabe LDP-Endstufendiagnose" VALUE 0x8187CB KwUb 17.95 spg_ubatt 0.00 17.95 FORMAT "%5.2" /end CHARACTERISTIC
/begin CHARACTERISTIC UBDULDPE "untere Spannungsschwelle für Freigabe LDP-Endstufendiagnose" VALUE 0x8187CC KwUb 17.95 spg_ubatt 0.00 17.95 FORMAT "%5.2" /end CHARACTERISTIC
/begin CHARACTERISTIC UBHFM "Batteriespannungsschwelle zur Umschaltung auf Ersatzlastsignal" VALUE 0x818847 KwUb 17.95 spg_ubatt 0.00 17.95 FORMAT "%5.2" /end CHARACTERISTIC
/begin CHARACTERISTIC UBKLEMN "Minimale Batteriespannung für KLE aktiv" VALUE 0x8187D7 KwUb 25.50 fak_q0p1 0.00 25.50 FORMAT "%5.2" /end CHARACTERISTIC
/begin CHARACTERISTIC UBKLEMX "Maximale Batteriespannung für KLE aktiv" VALUE 0x8187D8 KwUb 25.50 fak_q0p1 0.00 25.50 FORMAT "%5.2" /end CHARACTERISTIC
/begin CHARACTERISTIC UDKRGOFS "Spannungsschwelle für DIA/KR Grundoffset Verstärker" VALUE 0x811589 KwUb 4.980 spg_ub_b5 0.00 4.980 FORMAT "%5.3" /end CHARACTERISTIC
/begin CHARACTERISTIC UDKRTP "Integratorspannungsschwelle für Dia KS - Auswerteschaltung Testimpuls" VALUE 0x81158B KwUb 4.980 spg_ub_b5 0.00 4.980 FORMAT "%5.3" /end CHARACTERISTIC
/begin CHARACTERISTIC UDKSNO "Obere Referenzspannungsschwelle DIA KS" CURVE 0x81EB52 GklWUw 319.9813 spg_uw_b1280 0.00 319.9813 FORMAT "%8.4"
 /begin AXIS_DESCR COM_AXIS nmot nmot_ub_q40 16 0.00 10200. AXIS_PTS_REF SNM16KRUB /end AXIS_DESCR
/end CHARACTERISTIC
/begin CHARACTERISTIC UDKSNU "untere Referenzspannungsschwelle DIA KS" CURVE 0x81EB72 GklWUw 319.9813 spg_uw_b1280 0.00 319.9813 FORMAT "%8.4"
 /begin AXIS_DESCR COM_AXIS nmot nmot_ub_q40 16 0.00 10200. AXIS_PTS_REF SNM16KRUB /end AXIS_DESCR
/end CHARACTERISTIC
/begin CHARACTERISTIC UHEMN "Schwellwert für bestromte Heizerendstufe" VALUE 0x810BB5 KwUb 4.9805 spg_ub_q0p019 0.00 4.9805 /end CHARACTERISTIC
/begin CHARACTERISTIC UHEMX "Schwellwert für stromlose Heizerendstufe" VALUE 0x810BB6 KwUb 4.9805 spg_ub_q0p019 0.00 4.9805 /end CHARACTERISTIC
/begin CHARACTERISTIC UHRMN1 "untere Grenze HR-Spannung, Erkennung Kurzschl. n. Masse" VALUE 0x81AD4D KwUb 4.980 spg_ub_b5 0.00 4.980 FORMAT "%5.3" /end CHARACTERISTIC
/begin CHARACTERISTIC UHRMN2 "untere Grenze HR-Spannung, Erkennung Signalfehler" VALUE 0x81AD4E KwUb 4.980 spg_ub_b5 0.00 4.980 FORMAT "%5.3" /end CHARACTERISTIC
/begin CHARACTERISTIC UHRMX1 "obere Grenze HR-Spannung" VALUE 0x81AD4F KwUb 4.980 spg_ub_b5 0.00 4.980 FORMAT "%5.3" /end CHARACTERISTIC
/begin CHARACTERISTIC UHRMX2 "obere Grenze HR-Spannung, Erkennung Kurzschl. n. ub." VALUE 0x81AD50 KwUb 4.980 spg_ub_b5 0.00 4.980 FORMAT "%5.3" /end CHARACTERISTIC
/begin CHARACTERISTIC ULDPEMN "Minimale Spannung für Diagnose LDP-Endstufe i.O." VALUE 0x8187CD KwUb 4.9805 spg_ub_q0p019 0.00 4.9805 /end CHARACTERISTIC
/begin CHARACTERISTIC ULDPEMX "Maximale Spannung für Diagnose LDP-Endstufe i.O." VALUE 0x8187CE KwUb 4.9805 spg_ub_q0p019 0.00 4.9805 /end CHARACTERISTIC
/begin CHARACTERISTIC UNWDHFM "Umdrehungen Nockenwelle für Fehlerentprellung Diagnose HFM" VALUE 0x818848 KwUb 255.0 dez 0.00 255.0 FORMAT "%5.1" /end CHARACTERISTIC
/begin CHARACTERISTIC USHKTDM "Magerschwelle hintere Sondenspannung für Sauerstoffmessung bei Katalysatordiagno" VALUE 0x8186BA KwUb 1.330 spg_ub_q0p0052_o0p2 -0.2000 1.130 FORMAT "%5.3" /end CHARACTERISTIC
/begin CHARACTERISTIC USHKTDR "Fettschwelle hintere Sondenspannung für Referenzmessung bei Katalysatordiagnose" VALUE 0x8186BB KwUb 1.330 spg_ub_q0p0052_o0p2 -0.2000 1.130 FORMAT "%5.3" /end CHARACTERISTIC
/begin CHARACTERISTIC USHKTDRX "Maximale Fettschwelle hintere Sondenspannung für Referenzmessung bei Katalysator" VALUE 0x8186BC KwUb 1.330 spg_ub_q0p0052_o0p2 -0.2000 1.130 FORMAT "%5.3" /end CHARACTERISTIC
/begin CHARACTERISTIC USHKVL "Schwellwert für Sondenspannung hinter KAT im Volllast-Betrieb" VALUE 0x818651 KwUb 1.330 spg_ub_q0p0052_o0p2 -0.2000 1.130 FORMAT "%5.3" /end CHARACTERISTIC
/begin CHARACTERISTIC USHLEAN "Schwelle für Magerspannung für Reset Dynamikmessung der Sonde hinter KAT" VALUE 0x810BB1 KwUb 1.330 spg_ub_q0p0052_o0p2 -0.2000 1.130 FORMAT "%5.3" /end CHARACTERISTIC
/begin CHARACTERISTIC USHRICH "Schwelle für Fettspannung für gültige Dynamikmessung der Sonde hinter KAT" VALUE 0x810BB2 KwUb 1.330 spg_ub_q0p0052_o0p2 -0.2000 1.130 FORMAT "%5.3" /end CHARACTERISTIC
/begin CHARACTERISTIC USHSTGMX "Wert für maximale Steigung für Startwert Filter" VALUE 0x818652 KwUb 132.6 spgg_q0p52 0.00 132.6 FORMAT "%5.1" /end CHARACTERISTIC
/begin CHARACTERISTIC USHSTSOLL "Schwelle für zulässige Steigung der Sondenspannung hinter KAT" VALUE 0x818653 KwUb 132.6 spgg_q0p52 0.00 132.6 FORMAT "%5.1" /end CHARACTERISTIC
/begin CHARACTERISTIC USSCHUB "Schwelle für Sondenspannung hinter KAT nach Schub" VALUE 0x818654 KwUb 1.330 spg_ub_q0p0052_o0p2 -0.2000 1.130 FORMAT "%5.3" /end CHARACTERISTIC
/begin CHARACTERISTIC VALDPMN "minimale Fahrzeuggeschwindigkeit bei Aktivierung DLDP" VALUE 0x81215D KwUb 318.8 vfzg_ub_q1p25 0.00 318.8 FORMAT "%5.1" /end CHARACTERISTIC
/begin CHARACTERISTIC VDKUPPLMN "min. vfzg-Schwelle für Diagnose Kupplungsschalter" VALUE 0x8186FA KwUb 318.8 vfzg_ub_q1p25 0.00 318.8 FORMAT "%5.1" /end CHARACTERISTIC
/begin CHARACTERISTIC VLDPMN "Min. Geschwindigkeit für Grobleckverifikation" VALUE 0x81215E KwUb 318.8 vfzg_ub_q1p25 0.00 318.8 FORMAT "%5.1" /end CHARACTERISTIC
/begin CHARACTERISTIC VLDPO "Obere vfz-Schwelle für 0.5 mm - Diagnose" VALUE 0x81215F KwUb 318.8 vfzg_ub_q1p25 0.00 318.8 FORMAT "%5.1" /end CHARACTERISTIC
/begin CHARACTERISTIC VLDPU "Untere vfz-Schwelle für 0.5 mm - Diagnose" VALUE 0x812160 KwUb 318.8 vfzg_ub_q1p25 0.00 318.8 FORMAT "%5.1" /end CHARACTERISTIC
/begin CHARACTERISTIC VSLDPMN "minimale Fahrzeuggeschwindigkeit DLDP für Übergang in Zustand A_Stop" VALUE 0x812161 KwUb 318.8 vfzg_ub_q1p25 0.00 318.8 FORMAT "%5.1" /end CHARACTERISTIC
/begin CHARACTERISTIC WZLDPD "Max. Anzahl Wiederholversuche bei 1mm-Dichtprüfung" VALUE 0x812162 KwUb 255.0 dez 0.00 255.0 FORMAT "%5.1" /end CHARACTERISTIC
/begin CHARACTERISTIC WZLDPGS "Max. Anzahl Wiederholversuche nach Unterbrechung insgesamt" VALUE 0x812163 KwUb 255.0 dez 0.00 255.0 FORMAT "%5.1" /end CHARACTERISTIC
/begin CHARACTERISTIC WZLDPMX "Max. Anzahl Wiederholversuche nach Unterbrechung bei erkanntem Leck" VALUE 0x812164 KwUb 255.0 dez 0.00 255.0 FORMAT "%5.1" /end CHARACTERISTIC
/begin CHARACTERISTIC WZLDPRO "Max. Anzahl Wiederholversuche Reed-Switch Close to Open Check" VALUE 0x812165 KwUb 255.0 dez 0.00 255.0 FORMAT "%5.1" /end CHARACTERISTIC
/begin CHARACTERISTIC ZFRMST "Zeitkonstante für frm-Filter (short test)" VALUE 0x819499 KwUb 50.8000 zk200msxs_ub_b51p2 0.200000 51.0000 FORMAT "%7.4" /end CHARACTERISTIC
/begin CHARACTERISTIC ZKARIH1 "Filterzeitkonst.für Nachbildung Dynamik der Keramiktemperatur h. Kat" CURVE 0x81C26C KlAUbSstUwWUw 6553.4999985 zk100msxs_uw_b6553 0.10000152590 6553.6000000 FORMAT "%12.7"
 /begin AXIS_DESCR STD_AXIS msabg_w m_uw_b6553p5 5 0.00 6553.500 FORMAT "%8.3" DEPOSIT ABSOLUTE /end AXIS_DESCR
/end CHARACTERISTIC
/begin CHARACTERISTIC ZKDXLDPE "Einschaltzeit(konstante) für Max-Fehler-Prüfung (KS_UB) LDP-Endst.-Diagnose" VALUE 0x8187CF KwUb 25.50 t100msxs_ub_b25p5 0.00 25.50 FORMAT "%5.2" /end CHARACTERISTIC
/begin CHARACTERISTIC ZKLSU "Filterzeitkonst.für Nachbildung Dynamik der LSU-Keramiktemp. aus Abgastemp.v.Kat" VALUE 0x8139AE KwUw 6553.5000000 zk100msxs_uw_b6553 0.10000000000 6553.6000000 FORMAT "%12.7" /end CHARACTERISTIC
/begin CHARACTERISTIC ZKPRIH "Filter für Nachbildung Dynamik der Sondenkeramiktemp.aus el.Heizleistung h.Kat" VALUE 0x81C282 KwUw 6553.4999985 zk100msxs_uw_b6553 0.10000152590 6553.6000000 FORMAT "%12.7" /end CHARACTERISTIC
/begin CHARACTERISTIC ZKTDML "Tiefpaß-Filterzeitkonstante der Luftmasse für Katalysatordiagnose" VALUE 0x81C4BE KwUw 3276.7499992 zk50msxs_uw_b12p8 0.050000762951 3276.8000000 FORMAT "%12.7" /end CHARACTERISTIC
/begin CHARACTERISTIC ZKTDTK "Tiefpaß-Filterzeitkonstante der Katalysatortemperatur für Katalysatordiagnose" VALUE 0x8186CA KwUb 50.7992 zk200msxs_ub_b51p2 0.200787 51.0000 FORMAT "%7.4" /end CHARACTERISTIC
/begin CHARACTERISTIC ZMLRO "Zeitkonstante mlroh-Tiefpaß bei Diagnose HFM/HLM" VALUE 0x810EA9 KwUb 2.54000 zk10msxs_ub_b2p55 0.0100000 2.55000 FORMAT "%7.5" /end CHARACTERISTIC
/begin CHARACTERISTIC ZRLBAB "Zeitkonstante RL-Tiefpaß bei Bergaberkennung" VALUE 0x828084 KwUw 6553.4999985 zk100msxs_uw_b6553 0.10000152590 6553.6000000 FORMAT "%12.7" /end CHARACTERISTIC
/begin MEASUREMENT anzgangw "Anzahl erkannter Gangwechsel" UBYTE dez 1 100 0 255 FORMAT "%5.1" ECU_ADDRESS 0x380963 /end MEASUREMENT
/begin MEASUREMENT anzkupplb "Anzahl erkannter Kupplungsbetätigungen" UBYTE dez 1 100 0 255 FORMAT "%5.1" ECU_ADDRESS 0x380964 /end MEASUREMENT
/begin MEASUREMENT anzpuls "Zähler für Gesamtimpulsanzahl bei Einzelimpulsansteuerung" UBYTE dez 1 100 0 255 FORMAT "%5.1" ECU_ADDRESS 0x380B45 /end MEASUREMENT
/begin MEASUREMENT apdkt "Anzahl Prüfungen der Katalysatordiagnose" UBYTE dez 1 100 0 255 FORMAT "%5.1" ECU_ADDRESS 0x384848 /end MEASUREMENT
/begin MEASUREMENT apdkti "Anzahl interner Prüfungen der Katalysatordiagnose" UBYTE dez 1 100 0 255 FORMAT "%5.1" ECU_ADDRESS 0x384849 /end MEASUREMENT
/begin MEASUREMENT apedkts "Anzahl der Prüfungen mit Fehlerergebnis bei Katdiagnose" UBYTE dez 1 100 0 255 FORMAT "%5.1" ECU_ADDRESS 0x38484A /end MEASUREMENT
/begin MEASUREMENT apzdkt "Anzahl der i.O.-Prüfungen, Katdiagnose" UBYTE dez 1 100 0 255 FORMAT "%5.1" ECU_ADDRESS 0x38484B /end MEASUREMENT
/begin MEASUREMENT avkatf "AmplitudenVerhältnis laafh/laafv gefiltert" UBYTE fak_ub_b1 1 100 0 0.996094 ECU_ADDRESS 0x384014 /end MEASUREMENT
/begin MEASUREMENT bitbuffer "Temporäre Variable" UBYTE DEZ 1 100 0 255 FORMAT "%5.1" ECU_ADDRESS 0x384862 /end MEASUREMENT
/begin MEASUREMENT B_aav "Bedingung AAV wird angesteuert erfüllt" UWORD B_TRUE 1 100 0 1 BIT_MASK 0x8000 FORMAT "%13.11" ECU_ADDRESS 0xFDA0 /end MEASUREMENT
/begin MEASUREMENT B_abgstg "Bedingung Modelltemperatur (tkatm od. tanhkm_w) hinter KAT ist oberhalb Schwelle" UBYTE B_TRUE 1 100 0 1 BIT_MASK 0x1 FORMAT "%13.11" ECU_ADDRESS 0x38093F /end MEASUREMENT
/begin MEASUREMENT B_agrrdy "Bedingung AGR geprüft für 'ready-Byte'" UBYTE B_TRUE 1 100 0 1 BIT_MASK 0x80 FORMAT "%13.11" ECU_ADDRESS 0x384007 /end MEASUREMENT
/begin MEASUREMENT B_beaatun "" UWORD B_TRUE 1 100 0 1 BIT_MASK 0x20 FORMAT "%13.11" ECU_ADDRESS 0x383B08 /end MEASUREMENT
/begin MEASUREMENT B_beldpe "Bedingung Bandende-Funktionsanforderung für Endstufe LDP" UWORD B_TRUE 1 100 0 1 BIT_MASK 0x20 FORMAT "%13.11" ECU_ADDRESS 0x383BB8 /end MEASUREMENT
/begin MEASUREMENT B_bemdb "Bedingung Bandende-Funktionsanforderung MDB" UWORD B_TRUE 1 100 0 1 BIT_MASK 0x20 FORMAT "%13.11" ECU_ADDRESS 0x383BD6 /end MEASUREMENT
/begin MEASUREMENT B_bergab "Bedingung Bergabfahrt erkannt" UBYTE B_TRUE 1 100 0 1 BIT_MASK 0x1 FORMAT "%13.11" ECU_ADDRESS 0x380B47 /end MEASUREMENT
/begin MEASUREMENT B_bergabd "Bergabfahrt erkannt über Umgebungsdruck" UBYTE B_TRUE 1 100 0 1 BIT_MASK 0x10 FORMAT "%13.11" ECU_ADDRESS 0x380B49 /end MEASUREMENT
/begin MEASUREMENT B_bergabl "Bedingung Bergabfahrt erkannt über Last und Geschwindigkeit" UBYTE B_TRUE 1 100 0 1 BIT_MASK 0x8 FORMAT "%13.11" ECU_ADDRESS 0x380B49 /end MEASUREMENT
/begin MEASUREMENT B_bergxf "Bedingung Bergabfahrt erkannt für 0.5 mm - Diagnose" UBYTE B_TRUE 1 100 0 1 BIT_MASK 0x40 FORMAT "%13.11" ECU_ADDRESS 0x380B48 /end MEASUREMENT
/begin MEASUREMENT B_bergxfd "Bedingung Bergabfahrt erkannt über Umgebungsdruck für 0,5mm-Leck-Erken" UBYTE B_TRUE 1 100 0 1 BIT_MASK 0x40 FORMAT "%13.11" ECU_ADDRESS 0x380B49 /end MEASUREMENT
/begin MEASUREMENT B_bergxfl "Bedingung Bergabfahrt erkannt über Last und Geschwindigkeit für 0,5mm-Leck-Erken" UBYTE B_TRUE 1 100 0 1 BIT_MASK 0x20 FORMAT "%13.11" ECU_ADDRESS 0x380B49 /end MEASUREMENT
/begin MEASUREMENT B_besgeew "Bedingung Bandende-Funktionsanforderung: Steuergerät defekt (EEPROM WFS-Bereich)" UWORD B_TRUE 1 100 0 1 BIT_MASK 0x20 FORMAT "%13.11" ECU_ADDRESS 0x383BF0 /end MEASUREMENT
/begin MEASUREMENT B_bewfs "Bedingung Bandende-Funktionsanforderung Wegfahrsperre" UWORD B_TRUE 1 100 0 1 BIT_MASK 0x20 FORMAT "%13.11" ECU_ADDRESS 0x383C2A /end MEASUREMENT
/begin MEASUREMENT B_bewfsrc "" UWORD B_TRUE 1 100 0 1 BIT_MASK 0x20 FORMAT "%13.11" ECU_ADDRESS 0x383C2C /end MEASUREMENT
/begin MEASUREMENT B_binsti "Bedingung binäre Stoppbedingung intern, bankübergreifend" UBYTE B_TRUE 1 100 0 1 BIT_MASK 0x1 FORMAT "%13.11" ECU_ADDRESS 0x380952 /end MEASUREMENT
/begin MEASUREMENT B_binstop "Bedingung binäre Stoppbedingung, bankübergreifend" UBYTE B_TRUE 1 100 0 1 BIT_MASK 0x2 FORMAT "%13.11" ECU_ADDRESS 0x380952 /end MEASUREMENT
/begin MEASUREMENT B_bkaatun "Bedingung Ersatzwert für Tuningschutz" UWORD B_TRUE 1 100 0 1 BIT_MASK 0x40 FORMAT "%13.11" ECU_ADDRESS 0x383B08 /end MEASUREMENT
/begin MEASUREMENT B_bkldpe "Bedingung: Leckdiagnosemodul Endstufe aktiv" UWORD B_TRUE 1 100 0 1 BIT_MASK 0x40 FORMAT "%13.11" ECU_ADDRESS 0x383BB8 /end MEASUREMENT
/begin MEASUREMENT B_bkmdb "Bedingung: Momentanüberwachung (bergrenzt dauerhaft) aktiv" UWORD B_TRUE 1 100 0 1 BIT_MASK 0x40 FORMAT "%13.11" ECU_ADDRESS 0x383BD6 /end MEASUREMENT
/begin MEASUREMENT B_bksgeew "Bedingung: Steuergerät defekt (EEPROM WFS)" UWORD B_TRUE 1 100 0 1 BIT_MASK 0x40 FORMAT "%13.11" ECU_ADDRESS 0x383BF0 /end MEASUREMENT
/begin MEASUREMENT B_bkwfs "Bedingung: Wegfahrsperre" UWORD B_TRUE 1 100 0 1 BIT_MASK 0x40 FORMAT "%13.11" ECU_ADDRESS 0x383C2A /end MEASUREMENT
/begin MEASUREMENT B_bkwfsrc "Bedingung: Wegfahrsperre RC-Glied" UWORD B_TRUE 1 100 0 1 BIT_MASK 0x40 FORMAT "%13.11" ECU_ADDRESS 0x383C2C /end MEASUREMENT
/begin MEASUREMENT B_bxf1 "Flip-Flop 1: Obere vfz-Schwelle überschritten für 0.5 mm - Diagnose" UWORD B_TRUE 1 100 0 1 BIT_MASK 0x1 FORMAT "%13.11" ECU_ADDRESS 0x382B92 /end MEASUREMENT
/begin MEASUREMENT B_bxf2 "Flip-Flop2: Untere vfz-Schwelle überschrittenh für 0.5 mm - Diagnose" UWORD B_TRUE 1 100 0 1 BIT_MASK 0x2 FORMAT "%13.11" ECU_ADDRESS 0x382B92 /end MEASUREMENT
/begin MEASUREMENT B_bxf3 "Flip-Flop3: Beschleunigung größer Maximalschwelle für 0.5 mm - Diagnose" UWORD B_TRUE 1 100 0 1 BIT_MASK 0x4 FORMAT "%13.11" ECU_ADDRESS 0x382B92 /end MEASUREMENT
/begin MEASUREMENT B_bxf4 "Flip-Flop4: Laständerung größer Maximalschwelle für 0.5 mm - Diagnose" UWORD B_TRUE 1 100 0 1 BIT_MASK 0x8 FORMAT "%13.11" ECU_ADDRESS 0x382B92 /end MEASUREMENT
/begin MEASUREMENT B_bxf5 "Randbedingung: Motortemperatur größer Maximalschwelle" UWORD B_TRUE 1 100 0 1 BIT_MASK 0x10 FORMAT "%13.11" ECU_ADDRESS 0x382B92 /end MEASUREMENT
/begin MEASUREMENT B_bxf6 "Flip-Flop6: Ansauglufttemperatur größer Maximalschwelle für 0.5 mm - Diagnose" UWORD B_TRUE 1 100 0 1 BIT_MASK 0x20 FORMAT "%13.11" ECU_ADDRESS 0x382B92 /end MEASUREMENT
/begin MEASUREMENT B_bxf7 "Flip-Flop7: Motortemperaturdifferenz im Start kleiner Minimalschwelle für 0.5 mm" UWORD B_TRUE 1 100 0 1 BIT_MASK 0x40 FORMAT "%13.11" ECU_ADDRESS 0x382B92 /end MEASUREMENT
/begin MEASUREMENT B_bxf8 "Flip-Flop8: Bergabfahrt während 0.5 mm - Diagnose erkannt" UWORD B_TRUE 1 100 0 1 BIT_MASK 0x80 FORMAT "%13.11" ECU_ADDRESS 0x382B92 /end MEASUREMENT
/begin MEASUREMENT B_bxf9 "Flip-Flop9: Maximalzeit nach Start für 0.5 mm - Diagnose überschritten" UWORD B_TRUE 1 100 0 1 BIT_MASK 0x100 FORMAT "%13.11" ECU_ADDRESS 0x382B92 /end MEASUREMENT
/begin MEASUREMENT B_claatun "" UWORD B_TRUE 1 100 0 1 BIT_MASK 0x80 FORMAT "%13.11" ECU_ADDRESS 0x383B08 /end MEASUREMENT
/begin MEASUREMENT B_clldpe "Bedingung: Fehlerpfad Endstufe LDP löschen" UWORD B_TRUE 1 100 0 1 BIT_MASK 0x80 FORMAT "%13.11" ECU_ADDRESS 0x383BB8 /end MEASUREMENT
/begin MEASUREMENT B_clmdb "Flag für Löschung: Momentenbegrenzung begrenzt dauerhaft" UWORD B_TRUE 1 100 0 1 BIT_MASK 0x80 FORMAT "%13.11" ECU_ADDRESS 0x383BD6 /end MEASUREMENT
/begin MEASUREMENT B_clsgeew "Bedingung Steuergerät defekt  (EEPROM-WFS) löschen" UWORD B_TRUE 1 100 0 1 BIT_MASK 0x80 FORMAT "%13.11" ECU_ADDRESS 0x383BF0 /end MEASUREMENT
/begin MEASUREMENT B_clwfs "Bedingung Wegfahrsperre löschen" UWORD B_TRUE 1 100 0 1 BIT_MASK 0x80 FORMAT "%13.11" ECU_ADDRESS 0x383C2A /end MEASUREMENT
/begin MEASUREMENT B_clwfsrc "Bedingung löschen: Wegfahrsperre RC-Glied" UWORD B_TRUE 1 100 0 1 BIT_MASK 0x80 FORMAT "%13.11" ECU_ADDRESS 0x383C2C /end MEASUREMENT
/begin MEASUREMENT B_ddylash "Bedingung Sonde hinter KAT dynamisch langsam" UWORD B_TRUE 1 100 0 1 BIT_MASK 0x8 FORMAT "%13.11" ECU_ADDRESS 0xFD36 /end MEASUREMENT
/begin MEASUREMENT B_dhrnio "Bedingung Diagnose HR momentan nicht möglich" UWORD B_TRUE 1 100 0 1 BIT_MASK 0x100 FORMAT "%13.11" ECU_ADDRESS 0xFDB4 /end MEASUREMENT
/begin MEASUREMENT B_dkifm "Integratorfreigabe für Fett-Mager-Auswertung" UBYTE B_TRUE 1 100 0 1 BIT_MASK 0x10 FORMAT "%13.11" ECU_ADDRESS 0x38094C /end MEASUREMENT
/begin MEASUREMENT B_dkifma "Abbruch Integratorfreigabe für Fett-Mager-Auswertung" UBYTE B_TRUE 1 100 0 1 BIT_MASK 0x2 FORMAT "%13.11" ECU_ADDRESS 0x380948 /end MEASUREMENT
/begin MEASUREMENT B_dktb "Bedingung Beginn der Katalysatordiagnose" UBYTE B_TRUE 1 100 0 1 BIT_MASK 0x1 FORMAT "%13.11" ECU_ADDRESS 0x38094F /end MEASUREMENT
/begin MEASUREMENT B_dktens "Bedingung Stopp der Katalysatordiagnose für diesen Fahrzyklus da Ergebnis vorhan" UBYTE B_TRUE 1 100 0 1 BIT_MASK 0x2 FORMAT "%13.11" ECU_ADDRESS 0x380947 /end MEASUREMENT
/begin MEASUREMENT B_dktgtv "Katdiagnose: Bedingung Temperaturgradient-Verzögerungszeit" UBYTE B_TRUE 1 100 0 1 BIT_MASK 0x1 FORMAT "%13.11" ECU_ADDRESS 0x380951 /end MEASUREMENT
/begin MEASUREMENT B_dktkas "Kat.-Ausräumprüfung gestoppt bei Katdiagnose" UBYTE B_TRUE 1 100 0 1 BIT_MASK 0x2 FORMAT "%13.11" ECU_ADDRESS 0x38094F /end MEASUREMENT
/begin MEASUREMENT B_dktle "Bedingung Lambda eingeschwungen bei Katalysatordiagnose" UBYTE B_TRUE 1 100 0 1 BIT_MASK 0x1 FORMAT "%13.11" ECU_ADDRESS 0x38094B /end MEASUREMENT
/begin MEASUREMENT B_dktm "Bedingung Messbeginn der Katalysatordiagnose" UBYTE B_TRUE 1 100 0 1 BIT_MASK 0x4 FORMAT "%13.11" ECU_ADDRESS 0x38094C /end MEASUREMENT
/begin MEASUREMENT B_dktme "Bedingung Messende der Katalysatordiagnose" UBYTE B_TRUE 1 100 0 1 BIT_MASK 0x8 FORMAT "%13.11" ECU_ADDRESS 0x38094C /end MEASUREMENT
/begin MEASUREMENT B_dktn "Katdiagnose wegen Drehzahlgrenzen gesperrt" UBYTE B_TRUE 1 100 0 1 BIT_MASK 0x4 FORMAT "%13.11" ECU_ADDRESS 0x380952 /end MEASUREMENT
/begin MEASUREMENT B_dktr "Bedingung Katalysatordiagnose im Referenzzustand" UBYTE B_TRUE 1 100 0 1 BIT_MASK 0x2 FORMAT "%13.11" ECU_ADDRESS 0x38094C /end MEASUREMENT
/begin MEASUREMENT B_dktre "Bedingung Ende Referenzzustand der Katalysatordiagnose" UBYTE B_TRUE 1 100 0 1 BIT_MASK 0x1 FORMAT "%13.11" ECU_ADDRESS 0x38094C /end MEASUREMENT
/begin MEASUREMENT B_dktsbs "Bankspezifische Stoppbedingung, Hauptkatalysatordiagnose" UBYTE B_TRUE 1 100 0 1 BIT_MASK 0x4 FORMAT "%13.11" ECU_ADDRESS 0x38094F /end MEASUREMENT
/begin MEASUREMENT B_dktsps "physikalische Stoppbedingung" UBYTE B_TRUE 1 100 0 1 BIT_MASK 0x10 FORMAT "%13.11" ECU_ADDRESS 0x38094F /end MEASUREMENT
/begin MEASUREMENT B_dkttks "Katdiagnose temperaturbedingt gesperrt (Kat-Temperatur)" UBYTE B_TRUE 1 100 0 1 BIT_MASK 0x4 FORMAT "%13.11" ECU_ADDRESS 0x380951 /end MEASUREMENT
/begin MEASUREMENT B_dktts "Katdiagnose durch Verzögerungszeit nach Motorstart gesperrt" UBYTE B_TRUE 1 100 0 1 BIT_MASK 0x8 FORMAT "%13.11" ECU_ADDRESS 0x380952 /end MEASUREMENT
/begin MEASUREMENT B_dkvsef "Errorflag in DKVS trotz weitere Fehler im System freigeben" UWORD B_TRUE 1 100 0 1 BIT_MASK 0x20 FORMAT "%13.11" ECU_ADDRESS 0xFD62 /end MEASUREMENT
/begin MEASUREMENT B_dkvsf "Bedingung: Freigabe des Fehlers" UWORD B_TRUE 1 100 0 1 BIT_MASK 0x40 FORMAT "%13.11" ECU_ADDRESS 0xFD62 /end MEASUREMENT
/begin MEASUREMENT B_dkvsfm "Bedingung: Freigabe des Fehlers (Flipflop Ausgang)" UBYTE B_TRUE 1 100 0 1 BIT_MASK 0x1 FORMAT "%13.11" ECU_ADDRESS 0x383333 /end MEASUREMENT
/begin MEASUREMENT B_dkvstr "Bedingung: Integrator bei Tankleer zurücksetzen" UWORD B_TRUE 1 100 0 1 BIT_MASK 0x80 FORMAT "%13.11" ECU_ADDRESS 0xFD62 /end MEASUREMENT
/begin MEASUREMENT B_dkvszf "Zyklusflag in DKVS trotz weitere Fehler im System freigeben" UBYTE B_TRUE 1 100 0 1 BIT_MASK 0x1 FORMAT "%13.11" ECU_ADDRESS 0x38489A /end MEASUREMENT
/begin MEASUREMENT B_dlams "Bedingung Lambdaverstellung für Integrator hat max. Grenzwert erreicht." UBYTE B_TRUE 1 100 0 1 BIT_MASK 0x2 FORMAT "%13.11" ECU_ADDRESS 0x38093F /end MEASUREMENT
/begin MEASUREMENT B_dlash "Bedingung Freigabe Schwingungsprüfung hinter Kat." UWORD B_TRUE 1 100 0 1 BIT_MASK 0x10 FORMAT "%13.11" ECU_ADDRESS 0xFD36 /end MEASUREMENT
/begin MEASUREMENT B_dldp "Aktive Diagnose: Leckdiagnosemodul" UBYTE B_TRUE 1 100 0 1 BIT_MASK 0x2 FORMAT "%13.11" ECU_ADDRESS 0x380B47 /end MEASUREMENT
/begin MEASUREMENT B_dldpf "Flag DLDP ist prinzipiell freigegeben" UBYTE B_TRUE 1 100 0 1 BIT_MASK 0x4 FORMAT "%13.11" ECU_ADDRESS 0x380B47 /end MEASUREMENT
/begin MEASUREMENT B_dldpte "Anforderung TEV schließen aus Tankentlüftungsdiagnose" UWORD B_TRUE 1 100 0 1 BIT_MASK 0x1 FORMAT "%13.11" ECU_ADDRESS 0xFDA2 /end MEASUREMENT
/begin MEASUREMENT B_dllr "DLLR: Erkannter Überdrehzahlfehler, Freigabe Integratorgrenze" UWORD B_TRUE 1 100 0 1 BIT_MASK 0x8000 FORMAT "%13.11" ECU_ADDRESS 0xFD84 /end MEASUREMENT
/begin MEASUREMENT B_dllra "Bedingung DLLR Anforderung" UWORD B_TRUE 1 100 0 1 BIT_MASK 0x1 FORMAT "%13.11" ECU_ADDRESS 0xFD86 /end MEASUREMENT
/begin MEASUREMENT B_dpumn "Bedingung minimale Differenz Umgebungsdruck - Saugrohrdruck unterschritten" UBYTE B_TRUE 1 100 0 1 BIT_MASK 0x80 FORMAT "%13.11" ECU_ADDRESS 0x380B47 /end MEASUREMENT
/begin MEASUREMENT B_ds "KR: Sensordiagnose aktiv" UWORD B_TRUE 1 100 0 1 BIT_MASK 0x4000 FORMAT "%13.11" ECU_ADDRESS 0xFD74 /end MEASUREMENT
/begin MEASUREMENT B_dshk "Bedingung Diagnosefunktion in %DLSH und %DHLS mit i.O.-Meldung h. KAT" UWORD B_TRUE 1 100 0 1 BIT_MASK 0x20 FORMAT "%13.11" ECU_ADDRESS 0xFD36 /end MEASUREMENT
/begin MEASUREMENT B_dteven "Bedingung Freigabe DLDP-TEV- Check" UBYTE B_TRUE 1 100 0 1 BIT_MASK 0x2 FORMAT "%13.11" ECU_ADDRESS 0x380B48 /end MEASUREMENT
/begin MEASUREMENT B_dushkvl "Bed. Schwelle für Sonde h. KAT bei Vollast nicht überschritten" UBYTE B_TRUE 1 100 0 1 BIT_MASK 0x8 FORMAT "%13.11" ECU_ADDRESS 0x380940 /end MEASUREMENT
/begin MEASUREMENT B_dushsch "Bedingung Schwelle für Sonde hinter KAT im Schub nicht unterschritten" UWORD B_TRUE 1 100 0 1 BIT_MASK 0x40 FORMAT "%13.11" ECU_ADDRESS 0xFD36 /end MEASUREMENT
/begin MEASUREMENT B_dylash "Bedingung Sonde hinter KAT dynamisch langsam" UBYTE B_TRUE 1 100 0 1 BIT_MASK 0x1 FORMAT "%13.11" ECU_ADDRESS 0x383321 /end MEASUREMENT
/begin MEASUREMENT B_dynsp "Bedingung Leckerkennung bei Dynamik gesperrt" UWORD B_TRUE 1 100 0 1 BIT_MASK 0x100 FORMAT "%13.11" ECU_ADDRESS 0xFD80 /end MEASUREMENT
/begin MEASUREMENT B_ebDavT "Bedingung ETK_Bypass Daten verfügbar" UWORD B_TRUE 1 100 0 1 BIT_MASK 0x4 FORMAT "%13.11" ECU_ADDRESS 0xFD28 /end MEASUREMENT
/begin MEASUREMENT B_ebDavY "ETK-Bypass Daten vorhanden" UWORD B_TRUE 1 100 0 1 BIT_MASK 0x8 FORMAT "%13.11" ECU_ADDRESS 0xFD28 /end MEASUREMENT
/begin MEASUREMENT B_edkt "Bedingung Defekterkennung des Katalysators" UBYTE B_TRUE 1 100 0 1 BIT_MASK 0x4 FORMAT "%13.11" ECU_ADDRESS 0x38094B /end MEASUREMENT
/begin MEASUREMENT B_edkvs "Bedingung Adaptionsfehlerschwellen aktuell überschritten" UWORD B_TRUE 1 100 0 1 BIT_MASK 0x100 FORMAT "%13.11" ECU_ADDRESS 0xFD62 /end MEASUREMENT
/begin MEASUREMENT B_efrao "Bedingung Diagnoseschwellen obere multipl. Korrektur aktuell überschritten" UWORD B_TRUE 1 100 0 1 BIT_MASK 0x200 FORMAT "%13.11" ECU_ADDRESS 0xFD62 /end MEASUREMENT
/begin MEASUREMENT B_efrau "Bedingung Diagnoseschwellen untere multipl. Korrektur aktuell überschritten" UWORD B_TRUE 1 100 0 1 BIT_MASK 0x400 FORMAT "%13.11" ECU_ADDRESS 0xFD62 /end MEASUREMENT
/begin MEASUREMENT B_ehfm "Bedingung Fehler HFM (ohne Entprellung)" UWORD B_TRUE 1 100 0 1 BIT_MASK 0x4 FORMAT "%13.11" ECU_ADDRESS 0xFD52 /end MEASUREMENT
/begin MEASUREMENT B_ehfm1 "Bedingung Fehler HFM (ohne Entprellung) (Zwischengröße ohne Abfrage von UBAT)" UWORD B_TRUE 1 100 0 1 BIT_MASK 0x8 FORMAT "%13.11" ECU_ADDRESS 0xFD52 /end MEASUREMENT
/begin MEASUREMENT B_ehlsu "Bedingung Fehler Heizung LSU" UWORD B_TRUE 1 100 0 1 BIT_MASK 0x100 FORMAT "%13.11" ECU_ADDRESS 0xFD38 /end MEASUREMENT
/begin MEASUREMENT B_ehsh "Bedingung Error HSH" UBYTE B_TRUE 1 100 0 1 BIT_MASK 0x1 FORMAT "%13.11" ECU_ADDRESS 0x38482B /end MEASUREMENT
/begin MEASUREMENT B_elshvdk "Bedingung hintere Lambdasonden vertauscht" UBYTE B_TRUE 1 100 0 1 BIT_MASK 0x40 FORMAT "%13.11" ECU_ADDRESS 0x38094B /end MEASUREMENT
/begin MEASUREMENT B_elshvdkt "Bedingung hintere Lambdasonden vertauscht" UBYTE B_TRUE 1 100 0 1 BIT_MASK 0x10 FORMAT "%13.11" ECU_ADDRESS 0x380952 /end MEASUREMENT
/begin MEASUREMENT B_elsvdk2 "Bedingung vorderer Lambdasondenfehler" UBYTE B_TRUE 1 100 0 1 BIT_MASK 0x20 FORMAT "%13.11" ECU_ADDRESS 0x38094E /end MEASUREMENT
/begin MEASUREMENT B_enfmst "Bedingung Enable für Filter; Maximum der Steigung übernehmen hinter Kat" UWORD B_TRUE 1 100 0 1 BIT_MASK 0x80 FORMAT "%13.11" ECU_ADDRESS 0xFD36 /end MEASUREMENT
/begin MEASUREMENT B_enh "Bedingung Freigabe Ri-Diagnose Sondenheizung hinter Kat" UBYTE B_TRUE 1 100 0 1 BIT_MASK 0x20 FORMAT "%13.11" ECU_ADDRESS 0x38482B /end MEASUREMENT
/begin MEASUREMENT B_enheat "Bedingung Freigabe Diagnose Sondenheizung LSU" UWORD B_TRUE 1 100 0 1 BIT_MASK 0x200 FORMAT "%13.11" ECU_ADDRESS 0xFD38 /end MEASUREMENT
/begin MEASUREMENT B_enlash "Bedingung Test für Schwingungsprüfung abgeschlossen hinter Kat" UWORD B_TRUE 1 100 0 1 BIT_MASK 0x100 FORMAT "%13.11" ECU_ADDRESS 0xFD36 /end MEASUREMENT
/begin MEASUREMENT B_enmaxla "Bedingung enable B_maxlash ""setzen"" bei Fehler Lambdasonden hinter Kat" UBYTE B_TRUE 1 100 0 1 BIT_MASK 0x2 FORMAT "%13.11" ECU_ADDRESS 0x380940 /end MEASUREMENT
/begin MEASUREMENT B_enswit "Einschaltbedingung für die Endstufendiagnose LSU" UWORD B_TRUE 1 100 0 1 BIT_MASK 0x400 FORMAT "%13.11" ECU_ADDRESS 0xFD38 /end MEASUREMENT
/begin MEASUREMENT B_entest "Bedingung Wartezeit abgeschlossen für Test-Überprüfung Sonde hinter KAT" UWORD B_TRUE 1 100 0 1 BIT_MASK 0x200 FORMAT "%13.11" ECU_ADDRESS 0xFD36 /end MEASUREMENT
/begin MEASUREMENT B_erkat "Bedingung Diagnoseschwellen additive Korr. pro Zeit aktuell überschritten" UWORD B_TRUE 1 100 0 1 BIT_MASK 0x800 FORMAT "%13.11" ECU_ADDRESS 0xFD62 /end MEASUREMENT
/begin MEASUREMENT B_erkaz "Bedingung Diagnoseschwellen additive Korr. pro Einspr.  aktuell überschritten" UWORD B_TRUE 1 100 0 1 BIT_MASK 0x1000 FORMAT "%13.11" ECU_ADDRESS 0xFD62 /end MEASUREMENT
/begin MEASUREMENT B_erl "Bedingung für Errorpfad ldo vom rl check" UWORD B_TRUE 1 100 0 1 BIT_MASK 0x200 FORMAT "%13.11" ECU_ADDRESS 0xFD80 /end MEASUREMENT
/begin MEASUREMENT B_errldp "Bedingung Fehlerbit erfüllt" UBYTE B_TRUE 1 100 0 1 BIT_MASK 0x8 FORMAT "%13.11" ECU_ADDRESS 0x380B47 /end MEASUREMENT
/begin MEASUREMENT B_extaav "Bedingung elektrisches AAV vorhanden" UBYTE B_TRUE 1 100 0 1 BIT_MASK 0x10 FORMAT "%13.11" ECU_ADDRESS 0x380B48 /end MEASUREMENT
/begin MEASUREMENT B_faldpa "Bedingung Funktionsanforderung Leckdiagnosepumpe ist aktiviert" UBYTE B_TRUE 1 100 0 1 BIT_MASK 0x2 FORMAT "%13.11" ECU_ADDRESS 0x380B46 /end MEASUREMENT
/begin MEASUREMENT B_fev1 "Bedingung Ansaugluft<Minimalwert erkannt" UWORD B_TRUE 1 100 0 1 BIT_MASK 0x1 FORMAT "%13.11" ECU_ADDRESS 0x382B96 /end MEASUREMENT
/begin MEASUREMENT B_fev10 "Bedingung kurze Lastüberschreitung rl über Maxwert" UWORD B_TRUE 1 100 0 1 BIT_MASK 0x200 FORMAT "%13.11" ECU_ADDRESS 0x382B96 /end MEASUREMENT
/begin MEASUREMENT B_fev11 "Bedingung TEV nicht erfüllt" UWORD B_TRUE 1 100 0 1 BIT_MASK 0x400 FORMAT "%13.11" ECU_ADDRESS 0x382B96 /end MEASUREMENT
/begin MEASUREMENT B_fev12 "Bedingung Reedkontakt öffnet in der Fast Pulse Phase" UWORD B_TRUE 1 100 0 1 BIT_MASK 0x800 FORMAT "%13.11" ECU_ADDRESS 0x382B96 /end MEASUREMENT
/begin MEASUREMENT B_fev13 "Bedingung Warmabfahrt in kalte Umgebung, Grobleck" UWORD B_TRUE 1 100 0 1 BIT_MASK 0x1000 FORMAT "%13.11" ECU_ADDRESS 0x382B96 /end MEASUREMENT
/begin MEASUREMENT B_fev2 "Bedingung Ansaugluft>Maximalwert erkannt" UWORD B_TRUE 1 100 0 1 BIT_MASK 0x2 FORMAT "%13.11" ECU_ADDRESS 0x382B96 /end MEASUREMENT
/begin MEASUREMENT B_fev3 "Bedingung Motortemperatur<Minimalwert erkannt" UWORD B_TRUE 1 100 0 1 BIT_MASK 0x4 FORMAT "%13.11" ECU_ADDRESS 0x382B96 /end MEASUREMENT
/begin MEASUREMENT B_fev4 "Bedingung Motortemperatur>Maximalwert erkannt" UWORD B_TRUE 1 100 0 1 BIT_MASK 0x8 FORMAT "%13.11" ECU_ADDRESS 0x382B96 /end MEASUREMENT
/begin MEASUREMENT B_fev5 "Bedingung Differenz zwischen Motorabstell- und Motorstarttemperatur erkannt" UWORD B_TRUE 1 100 0 1 BIT_MASK 0x10 FORMAT "%13.11" ECU_ADDRESS 0x382B96 /end MEASUREMENT
/begin MEASUREMENT B_fev6 "Bedingung Höhe>Maximalwert erkannt" UWORD B_TRUE 1 100 0 1 BIT_MASK 0x20 FORMAT "%13.11" ECU_ADDRESS 0x382B96 /end MEASUREMENT
/begin MEASUREMENT B_fev7 "Bedingung Fahrzeuggeschwindigkeit<Minimalwert erfüllt" UWORD B_TRUE 1 100 0 1 BIT_MASK 0x40 FORMAT "%13.11" ECU_ADDRESS 0x382B96 /end MEASUREMENT
/begin MEASUREMENT B_fev8 "Bedingung Bergabfahrt erkannt" UWORD B_TRUE 1 100 0 1 BIT_MASK 0x80 FORMAT "%13.11" ECU_ADDRESS 0x382B96 /end MEASUREMENT
/begin MEASUREMENT B_fev9 "Bedingung lange Lastüberschreitung rl über Maxwert" UWORD B_TRUE 1 100 0 1 BIT_MASK 0x100 FORMAT "%13.11" ECU_ADDRESS 0x382B96 /end MEASUREMENT
/begin MEASUREMENT B_fgahfm "Bedingung Freigabe Auswertung HFM" UWORD B_TRUE 1 100 0 1 BIT_MASK 0x10 FORMAT "%13.11" ECU_ADDRESS 0xFD52 /end MEASUREMENT
/begin MEASUREMENT B_fgdhfmst "Bedingung Freigabe der HFM Diagnose nach Startende" UBYTE B_TRUE 1 100 0 1 BIT_MASK 0x1 FORMAT "%13.11" ECU_ADDRESS 0x384866 /end MEASUREMENT
/begin MEASUREMENT B_fgfshfm "Freigabe Fehlerspeichereintrag HFM" UBYTE B_TRUE 1 100 0 1 BIT_MASK 0x2 FORMAT "%13.11" ECU_ADDRESS 0x384866 /end MEASUREMENT
/begin MEASUREMENT B_fpchk "Bedingung Prüfung auf Abbruch Fast Pulse" UBYTE B_TRUE 1 100 0 1 BIT_MASK 0x10 FORMAT "%13.11" ECU_ADDRESS 0x380B47 /end MEASUREMENT
/begin MEASUREMENT B_frste "Bedingung frm_w eingeschwungen (Kurztest)" UWORD B_TRUE 1 100 0 1 BIT_MASK 0x2000 FORMAT "%13.11" ECU_ADDRESS 0xFD62 /end MEASUREMENT
/begin MEASUREMENT B_ftaatun "" UWORD B_TRUE 1 100 0 1 BIT_MASK 0x10 FORMAT "%13.11" ECU_ADDRESS 0x383B08 /end MEASUREMENT
/begin MEASUREMENT B_ftldpe "Bedingung Fehlereintrag durch Tester für Endstufe LDP" UWORD B_TRUE 1 100 0 1 BIT_MASK 0x10 FORMAT "%13.11" ECU_ADDRESS 0x383BB8 /end MEASUREMENT
/begin MEASUREMENT B_ftmdb "Bedingung: Fehlereintrag durch Tester für MDB" UWORD B_TRUE 1 100 0 1 BIT_MASK 0x10 FORMAT "%13.11" ECU_ADDRESS 0x383BD6 /end MEASUREMENT
/begin MEASUREMENT B_ftsgeew "Bedingung: Fehlereintrag durch Tester: SG defekt (EEPROM WFS- Bereich)" UWORD B_TRUE 1 100 0 1 BIT_MASK 0x10 FORMAT "%13.11" ECU_ADDRESS 0x383BF0 /end MEASUREMENT
/begin MEASUREMENT B_ftwfs "Bedingung: Fehlereintrag durch Tester: Wegfahrsperre" UWORD B_TRUE 1 100 0 1 BIT_MASK 0x10 FORMAT "%13.11" ECU_ADDRESS 0x383C2A /end MEASUREMENT
/begin MEASUREMENT B_ftwfsrc "" UWORD B_TRUE 1 100 0 1 BIT_MASK 0x10 FORMAT "%13.11" ECU_ADDRESS 0x383C2C /end MEASUREMENT
/begin MEASUREMENT B_gae "Bedingung Grundadaption eingeschwungen" UWORD B_TRUE 1 100 0 1 BIT_MASK 0x4000 FORMAT "%13.11" ECU_ADDRESS 0xFD62 /end MEASUREMENT
/begin MEASUREMENT B_gaefra "Bedingung Grundadaption (fra-Integrator) eingeschwungen" UWORD B_TRUE 1 100 0 1 BIT_MASK 0x8000 FORMAT "%13.11" ECU_ADDRESS 0xFD62 /end MEASUREMENT
/begin MEASUREMENT B_gaefra2 "Bedingung Grundadaption (fra2-Integrator) eingeschwungen" UWORD B_TRUE 1 100 0 1 BIT_MASK 0x1 FORMAT "%13.11" ECU_ADDRESS 0xFD64 /end MEASUREMENT
/begin MEASUREMENT B_gaeing "Bedingung Grundadaption Bank 1 eingeschwungen" UWORD B_TRUE 1 100 0 1 BIT_MASK 0x2 FORMAT "%13.11" ECU_ADDRESS 0xFD64 /end MEASUREMENT
/begin MEASUREMENT B_gaeing2 "Bedingung Grundadaption Bank 2 eingeschwungenen" UWORD B_TRUE 1 100 0 1 BIT_MASK 0x4 FORMAT "%13.11" ECU_ADDRESS 0xFD64 /end MEASUREMENT
/begin MEASUREMENT B_gangok "Bedingung Gangwechselerkennung prinziell erlaubt" UWORD B_TRUE 1 100 0 1 BIT_MASK 0x8000 FORMAT "%13.11" ECU_ADDRESS 0xFD3A /end MEASUREMENT
/begin MEASUREMENT B_heahfmlm "Bedingung Fehlerheilung HFM (für %DSELHFS)" UBYTE B_TRUE 1 100 0 1 BIT_MASK 0x1 FORMAT "%13.11" ECU_ADDRESS 0x384865 /end MEASUREMENT
/begin MEASUREMENT B_helsunp "Bedingung Freigabe Heilung LSU- Heizung Plausibilität" UBYTE B_TRUE 1 100 0 1 BIT_MASK 0x4 FORMAT "%13.11" ECU_ADDRESS 0x384847 /end MEASUREMENT
/begin MEASUREMENT B_helsusa "Bedingung Freigabe Heilung LSU- Heizung Plausibilität (Schubspannung)" UBYTE B_TRUE 1 100 0 1 BIT_MASK 0x1 FORMAT "%13.11" ECU_ADDRESS 0x380944 /end MEASUREMENT
/begin MEASUREMENT B_helsusw "Bedingung Freigabe Heilung LSU- Heizungsendstufe" UBYTE B_TRUE 1 100 0 1 BIT_MASK 0x1 FORMAT "%13.11" ECU_ADDRESS 0x384847 /end MEASUREMENT
/begin MEASUREMENT B_hfm "Bedingung HFM messbereit" UWORD B_TRUE 1 100 0 1 BIT_MASK 0x20 FORMAT "%13.11" ECU_ADDRESS 0xFD52 /end MEASUREMENT
/begin MEASUREMENT B_hfmko "Bedingung: HFM Kurzschluß Obergrenze überschritten" UWORD B_TRUE 1 100 0 1 BIT_MASK 0x40 FORMAT "%13.11" ECU_ADDRESS 0xFD52 /end MEASUREMENT
/begin MEASUREMENT B_hfmku "Bedingung: HFM Kurzschluß Obergrenze unterschritten" UWORD B_TRUE 1 100 0 1 BIT_MASK 0x80 FORMAT "%13.11" ECU_ADDRESS 0xFD52 /end MEASUREMENT
/begin MEASUREMENT B_hsokh "Bedingung Sondenheizung OK hinter Kat" UBYTE B_TRUE 1 100 0 1 BIT_MASK 0x2 FORMAT "%13.11" ECU_ADDRESS 0x38482C /end MEASUREMENT
/begin MEASUREMENT B_hsrdy "Bedingung Sondenheizung geprüft für 'ready-Byte'" UBYTE B_TRUE 1 100 0 1 BIT_MASK 0x40 FORMAT "%13.11" ECU_ADDRESS 0x384007 /end MEASUREMENT
/begin MEASUREMENT B_ildkt "Bedingung Gutprüfung des Katalysators durch Schnelldiagnose mittels Katalysator-" UBYTE B_TRUE 1 100 0 1 BIT_MASK 0x8 FORMAT "%13.11" ECU_ADDRESS 0x38094B /end MEASUREMENT
/begin MEASUREMENT B_imlkvse "Bedingung Luftmassenintegral Rücksetzen" UBYTE B_TRUE 1 100 0 1 BIT_MASK 0x2 FORMAT "%13.11" ECU_ADDRESS 0x383333 /end MEASUREMENT
/begin MEASUREMENT B_ispuel "Flag Initialspülung ist erfolgt" UBYTE B_TRUE 1 100 0 1 BIT_MASK 0x1 FORMAT "%13.11" ECU_ADDRESS 0x380B46 /end MEASUREMENT
/begin MEASUREMENT B_kathrdy "Bedingung Katalysator-Heizungen geprüft für 'ready-Byte'" UBYTE B_TRUE 1 100 0 1 BIT_MASK 0x2 FORMAT "%13.11" ECU_ADDRESS 0x384007 /end MEASUREMENT
/begin MEASUREMENT B_katrdy "Bedingung Katalysatoren geprüft für 'ready-Byte'" UBYTE B_TRUE 1 100 0 1 BIT_MASK 0x1 FORMAT "%13.11" ECU_ADDRESS 0x384007 /end MEASUREMENT
/begin MEASUREMENT B_kkrdy "Bedingung Klimakühlmittel geprüft für 'ready-Byte'" UBYTE B_TRUE 1 100 0 1 BIT_MASK 0x10 FORMAT "%13.11" ECU_ADDRESS 0x384007 /end MEASUREMENT
/begin MEASUREMENT B_ks_1 "Bedingung Kurzschluß" UWORD B_TRUE 1 100 0 1 BIT_MASK 0x1 FORMAT "%13.11" ECU_ADDRESS 0x384A8E /end MEASUREMENT
/begin MEASUREMENT B_ktrlash "Bedingung Kurztrip für Schwingungsprüfung durchführen Sonde hinter KAT" UBYTE B_TRUE 1 100 0 1 BIT_MASK 0x4 FORMAT "%13.11" ECU_ADDRESS 0x38093F /end MEASUREMENT
/begin MEASUREMENT B_kub "Kurzschluß nach U_batt erkannt" UWORD B_TRUE 1 100 0 1 BIT_MASK 0x10 FORMAT "%13.11" ECU_ADDRESS 0x384A8E /end MEASUREMENT
/begin MEASUREMENT B_kvsffl "Bedingung: Freigabe des Fehlers trotz Tank leer" UWORD B_TRUE 1 100 0 1 BIT_MASK 0x8 FORMAT "%13.11" ECU_ADDRESS 0xFD64 /end MEASUREMENT
/begin MEASUREMENT B_la "Lastabfall erkannt" UWORD B_TRUE 1 100 0 1 BIT_MASK 0x20 FORMAT "%13.11" ECU_ADDRESS 0x384A8E /end MEASUREMENT
/begin MEASUREMENT B_ladan "Bedingung für Laderansprechdrehzahl" UWORD B_TRUE 1 100 0 1 BIT_MASK 0x400 FORMAT "%13.11" ECU_ADDRESS 0xFD80 /end MEASUREMENT
/begin MEASUREMENT B_lamdkt "Bedingung Lambdasoll-Eingriff für Katalysatordiagnose aktiv" UBYTE B_TRUE 1 100 0 1 BIT_MASK 0x1 FORMAT "%13.11" ECU_ADDRESS 0x380948 /end MEASUREMENT
/begin MEASUREMENT B_lamend "Bedingung Ende der Lambdaverstellung in %LAMKO hinter Kat" UWORD B_TRUE 1 100 0 1 BIT_MASK 0x400 FORMAT "%13.11" ECU_ADDRESS 0xFD36 /end MEASUREMENT
/begin MEASUREMENT B_lamlash "Bedingung für Abmagern/Anfetten in %LAMKO" UWORD B_TRUE 1 100 0 1 BIT_MASK 0x800 FORMAT "%13.11" ECU_ADDRESS 0xFD36 /end MEASUREMENT
/begin MEASUREMENT B_lamverg "Bedingung Vergleich Lambdasoll in %DLSAHK mit %LAMKO übereinstimmend" UWORD B_TRUE 1 100 0 1 BIT_MASK 0x1000 FORMAT "%13.11" ECU_ADDRESS 0xFD36 /end MEASUREMENT
/begin MEASUREMENT B_ldp "Bedingung LDP wird angesteuert erfüllt" UWORD B_TRUE 1 100 0 1 BIT_MASK 0x2 FORMAT "%13.11" ECU_ADDRESS 0xFDA2 /end MEASUREMENT
/begin MEASUREMENT B_ldpabb "Flag DLDP-Abbruch" UBYTE B_TRUE 1 100 0 1 BIT_MASK 0x4 FORMAT "%13.11" ECU_ADDRESS 0x380B46 /end MEASUREMENT
/begin MEASUREMENT B_ldpe "Bedingung LDP-Endstufe angesteuert (eingeschaltet)" UWORD B_TRUE 1 100 0 1 BIT_MASK 0x20 FORMAT "%13.11" ECU_ADDRESS 0xFD4E /end MEASUREMENT
/begin MEASUREMENT B_ldpelok "" UWORD B_TRUE 1 100 0 1 BIT_MASK 0x40 FORMAT "%13.11" ECU_ADDRESS 0xFD4E /end MEASUREMENT
/begin MEASUREMENT B_ldpf1 "Fehler fault_1" UBYTE B_TRUE 1 100 0 1 BIT_MASK 0x8 FORMAT "%13.11" ECU_ADDRESS 0x380B46 /end MEASUREMENT
/begin MEASUREMENT B_ldpf2 "Fehler fault_2" UBYTE B_TRUE 1 100 0 1 BIT_MASK 0x10 FORMAT "%13.11" ECU_ADDRESS 0x380B46 /end MEASUREMENT
/begin MEASUREMENT B_ldpf5 "Fehler fault_5" UBYTE B_TRUE 1 100 0 1 BIT_MASK 0x20 FORMAT "%13.11" ECU_ADDRESS 0x380B46 /end MEASUREMENT
/begin MEASUREMENT B_ldpf6 "Fehler fault_6" UBYTE B_TRUE 1 100 0 1 BIT_MASK 0x40 FORMAT "%13.11" ECU_ADDRESS 0x380B46 /end MEASUREMENT
/begin MEASUREMENT B_ldpf7 "Fehler fault_7: Feinstleck ( >= 0.5 mm) erkannt" UBYTE B_TRUE 1 100 0 1 BIT_MASK 0x4 FORMAT "%13.11" ECU_ADDRESS 0x380B49 /end MEASUREMENT
/begin MEASUREMENT B_ldpflv "Bedingung Feinleckverifikation der DLDP aktiv" UBYTE B_TRUE 1 100 0 1 BIT_MASK 0x1 FORMAT "%13.11" ECU_ADDRESS 0x380B48 /end MEASUREMENT
/begin MEASUREMENT B_ldpglv "Grobleckverifikation der DLDP aktiv" UBYTE B_TRUE 1 100 0 1 BIT_MASK 0x8 FORMAT "%13.11" ECU_ADDRESS 0x380B48 /end MEASUREMENT
/begin MEASUREMENT B_ldra "Bedingung für Ersatzmaßnahme bei E_ldra bzw. E_LKVDK" UWORD B_TRUE 1 100 0 1 BIT_MASK 0x800 FORMAT "%13.11" ECU_ADDRESS 0xFD80 /end MEASUREMENT
/begin MEASUREMENT B_lldia "Diagnose Leerlaufregelung freigegeben" UWORD B_TRUE 1 100 0 1 BIT_MASK 0x2 FORMAT "%13.11" ECU_ADDRESS 0xFD86 /end MEASUREMENT
/begin MEASUREMENT B_lsahksp "allgemeine Stop-Bedingungen für die DLSAHK" UWORD B_TRUE 1 100 0 1 BIT_MASK 0x2000 FORMAT "%13.11" ECU_ADDRESS 0xFD36 /end MEASUREMENT
/begin MEASUREMENT B_lshswok "Bedingung Sonde hinter KAT nach Schwingungsprüfung in Ordnung" UBYTE B_TRUE 1 100 0 1 BIT_MASK 0x1 FORMAT "%13.11" ECU_ADDRESS 0x384844 /end MEASUREMENT
/begin MEASUREMENT B_lshswos "Negierte Speichergröße:  Sonde hinter KAT nach Schwingungsprüfung in Ordnung" UBYTE B_TRUE 1 100 0 1 BIT_MASK 0x8 FORMAT "%13.11" ECU_ADDRESS 0x380951 /end MEASUREMENT
/begin MEASUREMENT B_lsrdy "Bedingung Lambda-Sonden geprüft für 'ready-Byte'" UBYTE B_TRUE 1 100 0 1 BIT_MASK 0x20 FORMAT "%13.11" ECU_ADDRESS 0x384007 /end MEASUREMENT
/begin MEASUREMENT B_maxla "Maximalwert für Schwingungs-Prüfung hinter KAT erkannt" UBYTE B_TRUE 1 100 0 1 BIT_MASK 0x4 FORMAT "%13.11" ECU_ADDRESS 0x380940 /end MEASUREMENT
/begin MEASUREMENT B_maxlash "Sonden-Fehler Maximalwert für Schwingungs-Prüfung hinter KAT nicht erkannt" UWORD B_TRUE 1 100 0 1 BIT_MASK 0x4000 FORMAT "%13.11" ECU_ADDRESS 0xFD36 /end MEASUREMENT
/begin MEASUREMENT B_messe "Flag Periodendauermessung (State 5) beendet" UBYTE B_TRUE 1 100 0 1 BIT_MASK 0x80 FORMAT "%13.11" ECU_ADDRESS 0x380B46 /end MEASUREMENT
/begin MEASUREMENT B_messf "Messfensterzeit zur Diagnose Schubumluftventil beim Turbo" UWORD B_TRUE 1 100 0 1 BIT_MASK 0x1 FORMAT "%13.11" ECU_ADDRESS 0xFD4E /end MEASUREMENT
/begin MEASUREMENT B_minlash "Sonden Fehler Minimalwert für Schwingungsprüfung hinter KAT nicht erkannt" UWORD B_TRUE 1 100 0 1 BIT_MASK 0x8000 FORMAT "%13.11" ECU_ADDRESS 0xFD36 /end MEASUREMENT
/begin MEASUREMENT B_mldkt "Bedingung Katdiagnose freigegeben aufgrund kleiner Luftmassendynamik" UBYTE B_TRUE 1 100 0 1 BIT_MASK 0x20 FORMAT "%13.11" ECU_ADDRESS 0x380952 /end MEASUREMENT
/begin MEASUREMENT B_mldyn "Bedingung erforderliche Luftmasse im Schubbetrieb für Dynamikmessung erreicht" UWORD B_TRUE 1 100 0 1 BIT_MASK 0x1 FORMAT "%13.11" ECU_ADDRESS 0xFD38 /end MEASUREMENT
/begin MEASUREMENT B_mlustest "Bedingung ml ist innerhalb den Schwellen" UWORD B_TRUE 1 100 0 1 BIT_MASK 0x2 FORMAT "%13.11" ECU_ADDRESS 0xFD38 /end MEASUREMENT
/begin MEASUREMENT B_mnaatun "Bedingung: Min-Fehler Tuningschutz" UWORD B_TRUE 1 100 0 1 BIT_MASK 0x200 FORMAT "%13.11" ECU_ADDRESS 0x383B08 /end MEASUREMENT
/begin MEASUREMENT B_mnfhsh "Kurzschluß Heizung Lambdasonde hinter Kat nach Masse" UBYTE B_TRUE 1 100 0 1 BIT_MASK 0x4 FORMAT "%13.11" ECU_ADDRESS 0x38482B /end MEASUREMENT
/begin MEASUREMENT B_mnhfmlm "Bedingung untere Plausibilitätsschwelle HFM überschritten (für %DSELHFS)" UBYTE B_TRUE 1 100 0 1 BIT_MASK 0x2 FORMAT "%13.11" ECU_ADDRESS 0x384865 /end MEASUREMENT
/begin MEASUREMENT B_mnhlsu "Kurzschluß Heizung LSU1 nach Masse" UWORD B_TRUE 1 100 0 1 BIT_MASK 0x800 FORMAT "%13.11" ECU_ADDRESS 0xFD38 /end MEASUREMENT
/begin MEASUREMENT B_mnld "Fehlertype: Kurzschluß nach Masse LDP-Endstufe (aktuell)" UWORD B_TRUE 1 100 0 1 BIT_MASK 0x80 FORMAT "%13.11" ECU_ADDRESS 0xFD4E /end MEASUREMENT
/begin MEASUREMENT B_mnldpe "Fehlertype: Kurzschluß nach Masse LDP-Endstufe" UWORD B_TRUE 1 100 0 1 BIT_MASK 0x200 FORMAT "%13.11" ECU_ADDRESS 0x383BB8 /end MEASUREMENT
/begin MEASUREMENT B_mnmdb "Fehlertyp min.: Momentanüberwachung begrenzt dauerhaft" UWORD B_TRUE 1 100 0 1 BIT_MASK 0x200 FORMAT "%13.11" ECU_ADDRESS 0x383BD6 /end MEASUREMENT
/begin MEASUREMENT B_mnmld "Bedingung untere Plausibilitätsschwelle (Luftmassenvergleich) HFM überschritten" UWORD B_TRUE 1 100 0 1 BIT_MASK 0x100 FORMAT "%13.11" ECU_ADDRESS 0xFD52 /end MEASUREMENT
/begin MEASUREMENT B_mnsgeew "Fehlertyp min.:Steuergerät defekt (EEPROM-WFS)" UWORD B_TRUE 1 100 0 1 BIT_MASK 0x200 FORMAT "%13.11" ECU_ADDRESS 0x383BF0 /end MEASUREMENT
/begin MEASUREMENT B_mnwfs "Fehlertyp min.: Wegfahrsperre" UWORD B_TRUE 1 100 0 1 BIT_MASK 0x200 FORMAT "%13.11" ECU_ADDRESS 0x383C2A /end MEASUREMENT
/begin MEASUREMENT B_mnwfsrc "Fehlertyp min.: Wegfahrsperre RC-Glied" UWORD B_TRUE 1 100 0 1 BIT_MASK 0x200 FORMAT "%13.11" ECU_ADDRESS 0x383C2C /end MEASUREMENT
/begin MEASUREMENT B_mxaatun "Bedingung: Max-Fehler Tuningschutz" UWORD B_TRUE 1 100 0 1 BIT_MASK 0x100 FORMAT "%13.11" ECU_ADDRESS 0x383B08 /end MEASUREMENT
/begin MEASUREMENT B_mxaok "Bedingung Fehlerpfad ldra o.k." UWORD B_TRUE 1 100 0 1 BIT_MASK 0x1000 FORMAT "%13.11" ECU_ADDRESS 0xFD80 /end MEASUREMENT
/begin MEASUREMENT B_mxfhsh "Kurzschluß Heizung Lambdasonde hinter Kat nach UB" UBYTE B_TRUE 1 100 0 1 BIT_MASK 0x2 FORMAT "%13.11" ECU_ADDRESS 0x38482B /end MEASUREMENT
/begin MEASUREMENT B_mxhfmlm "Bedingung obere Plausibilitätsschwelle HFM überschritten (für %DSELHFS)" UBYTE B_TRUE 1 100 0 1 BIT_MASK 0x4 FORMAT "%13.11" ECU_ADDRESS 0x384865 /end MEASUREMENT
/begin MEASUREMENT B_mxhlsu "Kurzschluß Heizung LSU1 nach UB" UWORD B_TRUE 1 100 0 1 BIT_MASK 0x1000 FORMAT "%13.11" ECU_ADDRESS 0xFD38 /end MEASUREMENT
/begin MEASUREMENT B_mxld "Fehlertype: Kurzschluß nach Ubatt Endstufe LDP (aktuell)" UWORD B_TRUE 1 100 0 1 BIT_MASK 0x100 FORMAT "%13.11" ECU_ADDRESS 0xFD4E /end MEASUREMENT
/begin MEASUREMENT B_mxldpe "Fehlertype: Kurzschluß nach Ubatt Endstufe LDP" UWORD B_TRUE 1 100 0 1 BIT_MASK 0x100 FORMAT "%13.11" ECU_ADDRESS 0x383BB8 /end MEASUREMENT
/begin MEASUREMENT B_mxmdb "Fehlerart: Maximal zulässiges Sollmoment wird dauerhaft überschritten" UWORD B_TRUE 1 100 0 1 BIT_MASK 0x100 FORMAT "%13.11" ECU_ADDRESS 0x383BD6 /end MEASUREMENT
/begin MEASUREMENT B_mxmld "Bedingung obere Plausibilitätsschwelle (Luftmassenvergleich) HFM überschritten" UWORD B_TRUE 1 100 0 1 BIT_MASK 0x200 FORMAT "%13.11" ECU_ADDRESS 0xFD52 /end MEASUREMENT
/begin MEASUREMENT B_mxsgeew "Fehlertyp max.: Steuergerät defekt (EEPROM-WFS)" UWORD B_TRUE 1 100 0 1 BIT_MASK 0x100 FORMAT "%13.11" ECU_ADDRESS 0x383BF0 /end MEASUREMENT
/begin MEASUREMENT B_mxwfs "Fehlertyp max.: Wegfahrsperre" UWORD B_TRUE 1 100 0 1 BIT_MASK 0x100 FORMAT "%13.11" ECU_ADDRESS 0x383C2A /end MEASUREMENT
/begin MEASUREMENT B_mxwfsrc "Fehlertyp max.: Wegfahrsperre RC-Glied" UWORD B_TRUE 1 100 0 1 BIT_MASK 0x100 FORMAT "%13.11" ECU_ADDRESS 0x383C2C /end MEASUREMENT
/begin MEASUREMENT B_nolash "Bedingung Diagnosefunktion Schwingungs-Prüfung. i.O.-Meldung beendet." UWORD B_TRUE 1 100 0 1 BIT_MASK 0x4 FORMAT "%13.11" ECU_ADDRESS 0xFD38 /end MEASUREMENT
/begin MEASUREMENT B_norkam "Bedingung additive Korrektur der Adaption pro Zeit oder Zündung abgeschaltet" UWORD B_TRUE 1 100 0 1 BIT_MASK 0x10 FORMAT "%13.11" ECU_ADDRESS 0xFD64 /end MEASUREMENT
/begin MEASUREMENT B_npaatun "Bedingung: Tuningschutz unplausibel" UWORD B_TRUE 1 100 0 1 BIT_MASK 0x800 FORMAT "%13.11" ECU_ADDRESS 0x383B08 /end MEASUREMENT
/begin MEASUREMENT B_npfhsh "Nernstwiderstand Sonde hinter Kat zu groß" UBYTE B_TRUE 1 100 0 1 BIT_MASK 0x10 FORMAT "%13.11" ECU_ADDRESS 0x38482B /end MEASUREMENT
/begin MEASUREMENT B_nphealh "Heilung von B_nphsh" UBYTE B_TRUE 1 100 0 1 BIT_MASK 0x80 FORMAT "%13.11" ECU_ADDRESS 0x38482B /end MEASUREMENT
/begin MEASUREMENT B_nphlsu "Bedingung Signal LSU1 ist unplausibel" UWORD B_TRUE 1 100 0 1 BIT_MASK 0x2000 FORMAT "%13.11" ECU_ADDRESS 0xFD38 /end MEASUREMENT
/begin MEASUREMENT B_npldpe "Nicht plausibler Fehler: Leckdiagnosemodul Endstufe" UWORD B_TRUE 1 100 0 1 BIT_MASK 0x800 FORMAT "%13.11" ECU_ADDRESS 0x383BB8 /end MEASUREMENT
/begin MEASUREMENT B_nplhfmlm "Bedingung Plausfehler HFM(für %DSELHFS)" UBYTE B_TRUE 1 100 0 1 BIT_MASK 0x8 FORMAT "%13.11" ECU_ADDRESS 0x384865 /end MEASUREMENT
/begin MEASUREMENT B_npllash "Bedingung  ""nicht plausibler Wert"" für Sonde hinter KAT" UBYTE B_TRUE 1 100 0 1 BIT_MASK 0x4 FORMAT "%13.11" ECU_ADDRESS 0x380941 /end MEASUREMENT
/begin MEASUREMENT B_nplsusa "Bedingung Signal LSU1 ist unplausibel während B_sa" UWORD B_TRUE 1 100 0 1 BIT_MASK 0x4000 FORMAT "%13.11" ECU_ADDRESS 0xFD38 /end MEASUREMENT
/begin MEASUREMENT B_npmdb "Nicht plausibler Fehler: Momentanüberwachung begrenzt dauerhaft" UWORD B_TRUE 1 100 0 1 BIT_MASK 0x800 FORMAT "%13.11" ECU_ADDRESS 0x383BD6 /end MEASUREMENT
/begin MEASUREMENT B_npsgeew "Fehlerart: Steuergerät defekt (EEPROM-WFS)" UWORD B_TRUE 1 100 0 1 BIT_MASK 0x800 FORMAT "%13.11" ECU_ADDRESS 0x383BF0 /end MEASUREMENT
/begin MEASUREMENT B_npwfs "Fehlerart: Wegfahrsperre" UWORD B_TRUE 1 100 0 1 BIT_MASK 0x800 FORMAT "%13.11" ECU_ADDRESS 0x383C2A /end MEASUREMENT
/begin MEASUREMENT B_npwfsrc "Fehlerart: Wegfahrsperre RC-Glied" UWORD B_TRUE 1 100 0 1 BIT_MASK 0x800 FORMAT "%13.11" ECU_ADDRESS 0x383C2C /end MEASUREMENT
/begin MEASUREMENT B_plra "Bedingung für Umschaltung DKVS von HFM- auf P-System" UWORD B_TRUE 1 100 0 1 BIT_MASK 0x20 FORMAT "%13.11" ECU_ADDRESS 0xFD64 /end MEASUREMENT
/begin MEASUREMENT B_prxf "Bedingung Prüfung Feinstleck (0.5 mm - Diagnose) aktiv" UBYTE B_TRUE 1 100 0 1 BIT_MASK 0x2 FORMAT "%13.11" ECU_ADDRESS 0x380B49 /end MEASUREMENT
/begin MEASUREMENT B_pulsa "Pulssationserkennung  für Diagnose Schubumluftventil beim Turbo" UWORD B_TRUE 1 100 0 1 BIT_MASK 0x2 FORMAT "%13.11" ECU_ADDRESS 0xFD4E /end MEASUREMENT
/begin MEASUREMENT B_rdyagr "Bedingung ready-Info der AGR  zum Übertrag ins  'ready-Byte'" UBYTE B_TRUE 1 100 0 1 BIT_MASK 0x1 FORMAT "%13.11" ECU_ADDRESS 0x384008 /end MEASUREMENT
/begin MEASUREMENT B_rdyhs "Bedingung ready-Info der Lambdasondenheizung zum Übertrag ins  'ready-Byte'" UBYTE B_TRUE 1 100 0 1 BIT_MASK 0x1 FORMAT "%13.11" ECU_ADDRESS 0x38400A /end MEASUREMENT
/begin MEASUREMENT B_rdykat "Bedingung ready-Information der Katalysatordiagnose zum Übertrag ins  'ready-Byt" UBYTE B_TRUE 1 100 0 1 BIT_MASK 0x1 FORMAT "%13.11" ECU_ADDRESS 0x38400C /end MEASUREMENT
/begin MEASUREMENT B_rdyls "Bedingung ready-Info derLambdasonde zum Übertrag ins  'ready-Byte'" UBYTE B_TRUE 1 100 0 1 BIT_MASK 0x1 FORMAT "%13.11" ECU_ADDRESS 0x38400E /end MEASUREMENT
/begin MEASUREMENT B_rdysls "Bedingung ready-Info der Sekundärluftüberwachung zum Übertrag ins  'ready-Byte'" UBYTE B_TRUE 1 100 0 1 BIT_MASK 0x1 FORMAT "%13.11" ECU_ADDRESS 0x384010 /end MEASUREMENT
/begin MEASUREMENT B_rdytes "Bedingung ready-Info des Tankentlüftungssystems  zum Übertrag ins  'ready-Byte'" UBYTE B_TRUE 1 100 0 1 BIT_MASK 0x1 FORMAT "%13.11" ECU_ADDRESS 0x3808FF /end MEASUREMENT
/begin MEASUREMENT B_rierrh "Ri- Fehler Lambdasonde hinter Kat" UBYTE B_TRUE 1 100 0 1 BIT_MASK 0x40 FORMAT "%13.11" ECU_ADDRESS 0x38482B /end MEASUREMENT
/begin MEASUREMENT B_rkack "Bedingung Überwachung Reedkontakt auf aktiv" UBYTE B_TRUE 1 100 0 1 BIT_MASK 0x20 FORMAT "%13.11" ECU_ADDRESS 0x380B47 /end MEASUREMENT
/begin MEASUREMENT B_rkam "Bedingung einer der beiden additiven Bereiche aktiv" UWORD B_TRUE 1 100 0 1 BIT_MASK 0x40 FORMAT "%13.11" ECU_ADDRESS 0xFD64 /end MEASUREMENT
/begin MEASUREMENT B_rkamr "Bedingung rkat oder rkaz außerhalb reduzierter Schwellen" UWORD B_TRUE 1 100 0 1 BIT_MASK 0x80 FORMAT "%13.11" ECU_ADDRESS 0xFD64 /end MEASUREMENT
/begin MEASUREMENT B_rkcke "Komponentenprüfung ist abgeschlossen" UBYTE B_TRUE 1 100 0 1 BIT_MASK 0x4 FORMAT "%13.11" ECU_ADDRESS 0x380B48 /end MEASUREMENT
/begin MEASUREMENT B_rkzck "Bedingung Überwachung Reedkontakt zu aktiv" UBYTE B_TRUE 1 100 0 1 BIT_MASK 0x40 FORMAT "%13.11" ECU_ADDRESS 0x380B47 /end MEASUREMENT
/begin MEASUREMENT B_sbbhku "Bedingung umgeschaltete Betriebsbereitschaft der hinteren Sonde" UBYTE B_TRUE 1 100 0 1 BIT_MASK 0x40 FORMAT "%13.11" ECU_ADDRESS 0x380952 /end MEASUREMENT
/begin MEASUREMENT B_sbbhkv "Bedingung Sonde betriebsbereit hinter Kat verzögert" UBYTE B_TRUE 1 100 0 1 BIT_MASK 0x10 FORMAT "%13.11" ECU_ADDRESS 0x380941 /end MEASUREMENT
/begin MEASUREMENT B_siaatun "Signalfehler Tuningschutz" UWORD B_TRUE 1 100 0 1 BIT_MASK 0x400 FORMAT "%13.11" ECU_ADDRESS 0x383B08 /end MEASUREMENT
/begin MEASUREMENT B_sifhsh "Lastabfall Sondenheizung hinter Kat" UBYTE B_TRUE 1 100 0 1 BIT_MASK 0x8 FORMAT "%13.11" ECU_ADDRESS 0x38482B /end MEASUREMENT
/begin MEASUREMENT B_siglash "Bedingung Sonden-Fehler hinter KAT im Schub erkannt" UBYTE B_TRUE 1 100 0 1 BIT_MASK 0x1 FORMAT "%13.11" ECU_ADDRESS 0x380941 /end MEASUREMENT
/begin MEASUREMENT B_sihlsu "Unterbrechung im Heizstromkreis LSU1" UWORD B_TRUE 1 100 0 1 BIT_MASK 0x8000 FORMAT "%13.11" ECU_ADDRESS 0xFD38 /end MEASUREMENT
/begin MEASUREMENT B_sild "Fehlertype: Leitungsabfall Endstufe Leckage Pumpe (aktuell)" UWORD B_TRUE 1 100 0 1 BIT_MASK 0x200 FORMAT "%13.11" ECU_ADDRESS 0xFD4E /end MEASUREMENT
/begin MEASUREMENT B_sildpe "Fehlertype: Leitungsabfall Endstufe Leckage Pumpe" UWORD B_TRUE 1 100 0 1 BIT_MASK 0x400 FORMAT "%13.11" ECU_ADDRESS 0x383BB8 /end MEASUREMENT
/begin MEASUREMENT B_simdb "Fehlertyp: Momentanüberwachung begrenzt dauerhaft" UWORD B_TRUE 1 100 0 1 BIT_MASK 0x400 FORMAT "%13.11" ECU_ADDRESS 0x383BD6 /end MEASUREMENT
/begin MEASUREMENT B_sisgeew "Fehlerart: Steuergerät defekt (EEPROM-WFS)" UWORD B_TRUE 1 100 0 1 BIT_MASK 0x400 FORMAT "%13.11" ECU_ADDRESS 0x383BF0 /end MEASUREMENT
/begin MEASUREMENT B_siwfs "Fehlerart: Wegfahrsperre" UWORD B_TRUE 1 100 0 1 BIT_MASK 0x400 FORMAT "%13.11" ECU_ADDRESS 0x383C2A /end MEASUREMENT
/begin MEASUREMENT B_siwfsrc "Fehlerart: Wegfahrsperre RC-Glied" UWORD B_TRUE 1 100 0 1 BIT_MASK 0x400 FORMAT "%13.11" ECU_ADDRESS 0x383C2C /end MEASUREMENT
/begin MEASUREMENT B_slsrdy "Bedingung SLS geprüft für 'ready-Byte'" UBYTE B_TRUE 1 100 0 1 BIT_MASK 0x8 FORMAT "%13.11" ECU_ADDRESS 0x384007 /end MEASUREMENT
/begin MEASUREMENT B_steigm "Bedingung Steigung des Sondensignals messen hinter KAT" UWORD B_TRUE 1 100 0 1 BIT_MASK 0x8 FORMAT "%13.11" ECU_ADDRESS 0xFD38 /end MEASUREMENT
/begin MEASUREMENT B_sztesf "Bit für Zyklusbit-Sonderfall aus DLDP (1mm Dichterk. nach abgesp. Feinstleckf.)" UWORD B_TRUE 1 100 0 1 BIT_MASK 0x4 FORMAT "%13.11" ECU_ADDRESS 0xFDA2 /end MEASUREMENT
/begin MEASUREMENT B_tepldp "Bedingung Spülphase und prinzipielle Freigabe TEB" UBYTE B_TRUE 1 100 0 1 BIT_MASK 0x20 FORMAT "%13.11" ECU_ADDRESS 0x380B48 /end MEASUREMENT
/begin MEASUREMENT B_teslash "Bedingung Test ausführen für Überprüfung Sonde hinter KAT" UWORD B_TRUE 1 100 0 1 BIT_MASK 0x10 FORMAT "%13.11" ECU_ADDRESS 0xFD38 /end MEASUREMENT
/begin MEASUREMENT B_tesrdy "Bedingung TES geprüft für 'ready-Byte'" UBYTE B_TRUE 1 100 0 1 BIT_MASK 0x4 FORMAT "%13.11" ECU_ADDRESS 0x384007 /end MEASUREMENT
/begin MEASUREMENT B_tevioi "Bedingung TEV durch DLDP (Initialspülung) als i.O. erkannt." UWORD B_TRUE 1 100 0 1 BIT_MASK 0x8 FORMAT "%13.11" ECU_ADDRESS 0xFDA2 /end MEASUREMENT
/begin MEASUREMENT B_teviot "Bedingung TEV durch DLDP (Abfallzeiterhöhung) als i.O. erkannt." UWORD B_TRUE 1 100 0 1 BIT_MASK 0x10 FORMAT "%13.11" ECU_ADDRESS 0xFDA2 /end MEASUREMENT
/begin MEASUREMENT B_teza "Bedingung Tankentlüftung zwangsaktiv" UWORD B_TRUE 1 100 0 1 BIT_MASK 0x20 FORMAT "%13.11" ECU_ADDRESS 0xFDA2 /end MEASUREMENT
/begin MEASUREMENT B_tmsdkt "Bedingung Katdiagnose gesperrt wg. zu kleiner Motorstart-Temperatur" UBYTE B_TRUE 1 100 0 1 BIT_MASK 0x20 FORMAT "%13.11" ECU_ADDRESS 0x38094B /end MEASUREMENT
/begin MEASUREMENT B_toggle "Bit zum Toggeln der Endstufe während der Fehlerprüfung" UWORD B_TRUE 1 100 0 1 BIT_MASK 0x1000 FORMAT "%13.11" ECU_ADDRESS 0xFD4E /end MEASUREMENT
/begin MEASUREMENT B_tpstab "Flag Stabilitätskriterium erfüllt" UBYTE B_TRUE 1 100 0 1 BIT_MASK 0x80 FORMAT "%13.11" ECU_ADDRESS 0x380B48 /end MEASUREMENT
/begin MEASUREMENT B_trfash "Bedingung Kurztrip einleiten für Schwingungsprüfung Sonde hinter KAT" UWORD B_TRUE 1 100 0 1 BIT_MASK 0x20 FORMAT "%13.11" ECU_ADDRESS 0xFD38 /end MEASUREMENT
/begin MEASUREMENT B_ubok "Status: Ubat-Fenster, Taupunkt hinter Kat und B_nmot" UBYTE B_TRUE 1 100 0 1 BIT_MASK 0x1 FORMAT "%13.11" ECU_ADDRESS 0x38482C /end MEASUREMENT
/begin MEASUREMENT B_uefgab "Übernahmefreigabe für Hold Counter" UWORD B_TRUE 1 100 0 1 BIT_MASK 0x4 FORMAT "%13.11" ECU_ADDRESS 0xFD4E /end MEASUREMENT
/begin MEASUREMENT B_uscherf "Bedingung Messung Sondenspannung hinter KAT für Schubmessung erfüllt" UBYTE B_TRUE 1 100 0 1 BIT_MASK 0x1 FORMAT "%13.11" ECU_ADDRESS 0x380940 /end MEASUREMENT
/begin MEASUREMENT B_ushkf "Bedingung Sondenspannung hinter Kat ""Fett"" (Sollwert überschritten)" UWORD B_TRUE 1 100 0 1 BIT_MASK 0x40 FORMAT "%13.11" ECU_ADDRESS 0xFD38 /end MEASUREMENT
/begin MEASUREMENT B_ushkm "Bedingung Sondenspannung hinter Kat ""Mager"" (Sollwert unterschritten)" UWORD B_TRUE 1 100 0 1 BIT_MASK 0x80 FORMAT "%13.11" ECU_ADDRESS 0xFD38 /end MEASUREMENT
/begin MEASUREMENT B_ushkrfm "Bedingung für Wiederholungsmessung Schwingungspr. h. KAT (Reset F/M -Flip-Flop)" UBYTE B_TRUE 1 100 0 1 BIT_MASK 0x8 FORMAT "%13.11" ECU_ADDRESS 0x38093F /end MEASUREMENT
/begin MEASUREMENT B_ushkvl "Bed. Schwelle für Sonde h. KAT bei Vollast nicht überschritten `statisch`" UBYTE B_TRUE 1 100 0 1 BIT_MASK 0x40 FORMAT "%13.11" ECU_ADDRESS 0x383321 /end MEASUREMENT
/begin MEASUREMENT B_ushsch "Bed. Schwelle für Sonde h. KAT im Schub nicht unterschritten `statisch`" UBYTE B_TRUE 1 100 0 1 BIT_MASK 0x4 FORMAT "%13.11" ECU_ADDRESS 0x383321 /end MEASUREMENT
/begin MEASUREMENT B_usrhkmx "Bedingung für fehlerhafte Sonden hinter KAT nach abgeschlossenem Test" UBYTE B_TRUE 1 100 0 1 BIT_MASK 0x10 FORMAT "%13.11" ECU_ADDRESS 0x383321 /end MEASUREMENT
/begin MEASUREMENT B_vekat "Bedingung Fehlerverdacht bei Katalysatordiagnose" UBYTE B_TRUE 1 100 0 1 BIT_MASK 0x1 FORMAT "%13.11" ECU_ADDRESS 0x383323 /end MEASUREMENT
/begin MEASUREMENT B_vekati "Bedingung interner Fehlerverdacht bei Katalysatordiagnose" UBYTE B_TRUE 1 100 0 1 BIT_MASK 0x1 FORMAT "%13.11" ECU_ADDRESS 0x380947 /end MEASUREMENT
/begin MEASUREMENT B_vekatv "Bedingung validierter Fehlerverdacht bei Katalysatordiagnose" UBYTE B_TRUE 1 100 0 1 BIT_MASK 0x8 FORMAT "%13.11" ECU_ADDRESS 0x38094F /end MEASUREMENT
/begin MEASUREMENT B_xfstab "Stabilitätskriterium 0.5 mm - Diagnose erfüllt" UBYTE B_TRUE 1 100 0 1 BIT_MASK 0x1 FORMAT "%13.11" ECU_ADDRESS 0x380B49 /end MEASUREMENT
/begin MEASUREMENT B_zdkt "Bedingung Gutprüfung des Katalysators" UBYTE B_TRUE 1 100 0 1 BIT_MASK 0x2 FORMAT "%13.11" ECU_ADDRESS 0x38094B /end MEASUREMENT
/begin MEASUREMENT B_zfrao "wenn gleich TRUE, dann ist FRAO geprüft" UBYTE B_TRUE 1 100 0 1 BIT_MASK 0x4 FORMAT "%13.11" ECU_ADDRESS 0x38489A /end MEASUREMENT
/begin MEASUREMENT B_zfrau "wenn gleich TRUE, dann ist FRAU geprüft" UBYTE B_TRUE 1 100 0 1 BIT_MASK 0x2 FORMAT "%13.11" ECU_ADDRESS 0x38489A /end MEASUREMENT
/begin MEASUREMENT B_zkat "Bedingung: Zyklusflag setzen, Katdiagnose" UBYTE B_TRUE 1 100 0 1 BIT_MASK 0x10 FORMAT "%13.11" ECU_ADDRESS 0x38094B /end MEASUREMENT
/begin MEASUREMENT B_zrkat "wenn gleich TRUE, dann ist RKAT geprüft" UBYTE B_TRUE 1 100 0 1 BIT_MASK 0x8 FORMAT "%13.11" ECU_ADDRESS 0x38489A /end MEASUREMENT
/begin MEASUREMENT B_zrkaz "wenn gleich TRUE, dann ist RKAZ geprüft" UBYTE B_TRUE 1 100 0 1 BIT_MASK 0x10 FORMAT "%13.11" ECU_ADDRESS 0x38489A /end MEASUREMENT
/begin MEASUREMENT CountMax_DKMTR_IMPL "" UBYTE DEZ 1 100 0 255 FORMAT "%5.1" ECU_ADDRESS 0x381E36 /end MEASUREMENT
/begin MEASUREMENT CountMin_DKMTR_IMPL "" UBYTE DEZ 1 100 0 255 FORMAT "%5.1" ECU_ADDRESS 0x381E30 /end MEASUREMENT
/begin MEASUREMENT CountSig_DKMTR_IMPL "" UBYTE DEZ 1 100 0 255 FORMAT "%5.1" ECU_ADDRESS 0x381E28 /end MEASUREMENT
/begin MEASUREMENT crydldp "Counter für Readinessbildung Leckdiagnose DLDP" UBYTE dez 1 100 0 255 FORMAT "%5.1" ECU_ADDRESS 0x384011 /end MEASUREMENT
/begin MEASUREMENT crydtev "Counter für Readinessbildung TEV-Diagnose DTEV" UBYTE dez 1 100 0 255 FORMAT "%5.1" ECU_ADDRESS 0x384012 /end MEASUREMENT
/begin MEASUREMENT cryhs "Counter für Readinessbildung Sondenheizungs-Diagnose" UBYTE dez 1 100 0 255 FORMAT "%5.1" ECU_ADDRESS 0x384009 /end MEASUREMENT
/begin MEASUREMENT crykat "Counter für Readinessbildung Katalysator-Diagnose" UBYTE dez 1 100 0 255 FORMAT "%5.1" ECU_ADDRESS 0x38400B /end MEASUREMENT
/begin MEASUREMENT cryls "Counter für Readinessbildung Lambdasonden-Diagnose" UBYTE dez 1 100 0 255 FORMAT "%5.1" ECU_ADDRESS 0x38400D /end MEASUREMENT
/begin MEASUREMENT crysls "Counter für Readinessbildung Sekundärluft-Diagnose" UBYTE dez 1 100 0 255 FORMAT "%5.1" ECU_ADDRESS 0x38400F /end MEASUREMENT
/begin MEASUREMENT ctr_fein "Zähler für erkannte Feinlecks (>= 1.0 mm)" UBYTE dez 1 100 0 255 FORMAT "%5.1" ECU_ADDRESS 0x38344D /end MEASUREMENT
/begin MEASUREMENT ctr_feinst "Zähler für erkannte Feinstlecks (>= 0.5 mm)" UBYTE dez 1 100 0 255 FORMAT "%5.1" ECU_ADDRESS 0x38344E /end MEASUREMENT
/begin MEASUREMENT decj_alt "Zustand der Decj im letzten Raster" UBYTE DEZ 1 100 0 255 FORMAT "%5.1" ECU_ADDRESS 0x384863 /end MEASUREMENT
/begin MEASUREMENT DIMCTESausbits "" UBYTE dez 1 100 0 255 FORMAT "%5.1" ECU_ADDRESS 0x3808FF /end MEASUREMENT
/begin MEASUREMENT dkatspAusBits "" UBYTE dez 1 100 0 255 FORMAT "%5.1" ECU_ADDRESS 0x380947 /end MEASUREMENT
/begin MEASUREMENT dkatspAusBits20ms "" UBYTE dez 1 100 0 255 FORMAT "%5.1" ECU_ADDRESS 0x380948 /end MEASUREMENT
/begin MEASUREMENT dkatspAusBits20ms_2 "" UBYTE dez 1 100 0 255 FORMAT "%5.1" ECU_ADDRESS 0x380949 /end MEASUREMENT
/begin MEASUREMENT dkatspAusBitsNov "" UBYTE dez 1 100 0 255 FORMAT "%5.1" ECU_ADDRESS 0x383323 /end MEASUREMENT
/begin MEASUREMENT dkatspAusBitsNov_2 "" UBYTE dez 1 100 0 255 FORMAT "%5.1" ECU_ADDRESS 0x383324 /end MEASUREMENT
/begin MEASUREMENT dkatspAusBits_2 "" UBYTE dez 1 100 0 255 FORMAT "%5.1" ECU_ADDRESS 0x38094A /end MEASUREMENT
/begin MEASUREMENT dkatspLokBits "" UBYTE dez 1 100 0 255 FORMAT "%5.1" ECU_ADDRESS 0x38094B /end MEASUREMENT
/begin MEASUREMENT dkatspLokBits20ms "" UBYTE dez 1 100 0 255 FORMAT "%5.1" ECU_ADDRESS 0x38094C /end MEASUREMENT
/begin MEASUREMENT dkatspLokBits20ms_2 "" UBYTE dez 1 100 0 255 FORMAT "%5.1" ECU_ADDRESS 0x38094D /end MEASUREMENT
/begin MEASUREMENT dkatspLokBits_2 "" UBYTE dez 1 100 0 255 FORMAT "%5.1" ECU_ADDRESS 0x38094E /end MEASUREMENT
/begin MEASUREMENT dkmtrLokBits "" UWORD dez 1 100 0 65535 FORMAT "%8.2" ECU_ADDRESS 0x384A8E /end MEASUREMENT
/begin MEASUREMENT dkractr "Zündungszähler für Diagnose Klopfregelanschlag" UWORD dez 1 100 0 65535 FORMAT "%8.2" ECU_ADDRESS 0x382330 /end MEASUREMENT
/begin MEASUREMENT DKVSbits "" UBYTE dez 1 100 0 255 FORMAT "%5.1" ECU_ADDRESS 0x383333 /end MEASUREMENT
/begin MEASUREMENT DKVSlokbits "" UBYTE dez 1 100 0 255 FORMAT "%5.1" ECU_ADDRESS 0x38489A /end MEASUREMENT
/begin MEASUREMENT dlams_w "Maximalwert Lambdasoll für Test Schwingungsprüfung hinter KAT" UWORD fak_uw_b16 1 100 0 15.9998 FORMAT "%8.5" ECU_ADDRESS 0x384A2C /end MEASUREMENT
/begin MEASUREMENT DLDPlokbits1 "" UBYTE dez 1 100 0 255 FORMAT "%5.1" ECU_ADDRESS 0x380B46 /end MEASUREMENT
/begin MEASUREMENT DLDPlokbits2 "" UBYTE dez 1 100 0 255 FORMAT "%5.1" ECU_ADDRESS 0x380B47 /end MEASUREMENT
/begin MEASUREMENT DLDPlokbits3 "" UBYTE dez 1 100 0 255 FORMAT "%5.1" ECU_ADDRESS 0x380B48 /end MEASUREMENT
/begin MEASUREMENT DLDPlokbits4 "" UBYTE dez 1 100 0 255 FORMAT "%5.1" ECU_ADDRESS 0x380B49 /end MEASUREMENT
/begin MEASUREMENT dmrdkt_w "Momenten-Reserve für Katalysatordiagnose" UWORD rel_uw_b100 1 100 0 99.9985 FORMAT "%8.5" ECU_ADDRESS 0x384A46 /end MEASUREMENT
/begin MEASUREMENT dmrlash_w "Momenten-Reserve für Lambdasonden-Alterungsüberwachung hinter Kat" UWORD rel_uw_b100 1 100 0 99.9985 FORMAT "%8.5" ECU_ADDRESS 0x384A2E /end MEASUREMENT
/begin MEASUREMENT dpu_w "Druckdifferenz Umgebungsdruck - Saugrohrdruck" SWORD p_uw_q0p078 1 100 -2560 2559.92 FORMAT "%8.3" ECU_ADDRESS 0x382B8E /end MEASUREMENT
/begin MEASUREMENT drlldp_w "Last-Differenz für 0.5 mm - Diagnose" SWORD rel_sw_q0p0234 1 100 -768 767.977 FORMAT "%8.4" ECU_ADDRESS 0x382B90 /end MEASUREMENT
/begin MEASUREMENT dtmast "Motortemperaturänderung zwischen letztem Abstellen und aktuellem Start" UBYTE temp_sb_q0p75 1 100 0 191.25 FORMAT "%5.1" ECU_ADDRESS 0x38490B /end MEASUREMENT
/begin MEASUREMENT dvbab "Fahrzeuggeschwindigkeitsdifferenzbei Bergaberkennung" SBYTE vfzg_ub_q1p25 1 100 -160 158.75 FORMAT "%5.1" ECU_ADDRESS 0x38490C /end MEASUREMENT
/begin MEASUREMENT ebCtrNewT "ETK bypass counter new, channel T" UBYTE default 1 100 0 255 FORMAT "%5.1" ECU_ADDRESS 0x38090D /end MEASUREMENT
/begin MEASUREMENT ebCtrNewY "ETK bypass counter new, channel Y" UBYTE default 1 100 0 255 FORMAT "%5.1" ECU_ADDRESS 0x38090E /end MEASUREMENT
/begin MEASUREMENT ebCtrOldT "ETK bypass counter old, channel T" UBYTE default 1 100 0 255 FORMAT "%5.1" ECU_ADDRESS 0x38090F /end MEASUREMENT
/begin MEASUREMENT ebCtrOldY "ETK bypass counter old, channel Y" UBYTE default 1 100 0 255 FORMAT "%5.1" ECU_ADDRESS 0x380910 /end MEASUREMENT
/begin MEASUREMENT ebMissT "ETK bypass counter misses, channel T" UWORD default 1 100 0 65535 FORMAT "%8.2" ECU_ADDRESS 0x381974 /end MEASUREMENT
/begin MEASUREMENT ebMissY "ETK bypass counter misses, channel Y" UWORD default 1 100 0 65535 FORMAT "%8.2" ECU_ADDRESS 0x381976 /end MEASUREMENT
/begin MEASUREMENT esst_svf06d_ub "" UWORD dez 1 100 0 65535 FORMAT "%8.2" ECU_ADDRESS 0x385354 /end MEASUREMENT
/begin MEASUREMENT evsup1 "Funktionskennungsbyte für Ausgabe SAE J1979 Mode2" UBYTE dez 1 100 0 255 FORMAT "%5.1" ECU_ADDRESS 0x384006 /end MEASUREMENT
/begin MEASUREMENT E_aatun "Errorflag: Tuningschutz" UWORD B_TRUE 1 100 0 1 BIT_MASK 0x1 FORMAT "%13.11" ECU_ADDRESS 0x383B08 /end MEASUREMENT
/begin MEASUREMENT E_ldpe "Errorflag: Leckdiagnosepumpe Endstufe" UWORD B_TRUE 1 100 0 1 BIT_MASK 0x1 FORMAT "%13.11" ECU_ADDRESS 0x383BB8 /end MEASUREMENT
/begin MEASUREMENT E_mdb "Errorflag: Momentenüberwachung begrenzt dauerhaft" UWORD B_TRUE 1 100 0 1 BIT_MASK 0x1 FORMAT "%13.11" ECU_ADDRESS 0x383BD6 /end MEASUREMENT
/begin MEASUREMENT E_sgeew "Errorflag: Steuergerät defekt (EEPROM - WFS)" UWORD B_TRUE 1 100 0 1 BIT_MASK 0x1 FORMAT "%13.11" ECU_ADDRESS 0x383BF0 /end MEASUREMENT
/begin MEASUREMENT E_wfs "Errorflag: Wegfahrsperre" UWORD B_TRUE 1 100 0 1 BIT_MASK 0x1 FORMAT "%13.11" ECU_ADDRESS 0x383C2A /end MEASUREMENT
/begin MEASUREMENT E_wfsrc "Errorflag: Wegfahrsperre RC-Glied" UWORD B_TRUE 1 100 0 1 BIT_MASK 0x1 FORMAT "%13.11" ECU_ADDRESS 0x383C2C /end MEASUREMENT
/begin MEASUREMENT fehlerarray "" UBYTE DEZ 1 100 0 255 FORMAT "%5.1" ECU_ADDRESS 0x384864 /end MEASUREMENT
/begin MEASUREMENT fgdkt_w "Integrierte Fettgasmenge bei Katalysatordiagnose" UWORD m_q0p1_mg 1 100 0 6553.5 FORMAT "%8.3" ECU_ADDRESS 0x381B3A /end MEASUREMENT
/begin MEASUREMENT flgxfb "Bitstruktur für Randbedingungen der DLDP, 0.5 mm" UWORD dez 1 100 0 65535 FORMAT "%8.2" ECU_ADDRESS 0x382B92 /end MEASUREMENT
/begin MEASUREMENT flmxctr "Zähler Zündfolge bei erkanntem Klopfregelanschlag" UWORD dez 1 100 0 65535 FORMAT "%8.2" ARRAY_SIZE 8 ECU_ADDRESS 0x382332 /end MEASUREMENT
/begin MEASUREMENT fppcnt "Zähler Pumpphasen bei Fast Pulse" UBYTE dez 1 100 0 255 FORMAT "%5.1" ECU_ADDRESS 0x380B4A /end MEASUREMENT
/begin MEASUREMENT fpper "Aktuelle Periodendauer Fast Pulse" UBYTE t10msxs_ub_b2p55 1 100 0 2.55 FORMAT "%5.3" ECU_ADDRESS 0x380B4B /end MEASUREMENT
/begin MEASUREMENT fpuls "Pulsdauer für Fast Pulse" UWORD t10msxs_uw_b655p35 1 100 0 655.35 FORMAT "%8.4" ECU_ADDRESS 0x382B94 /end MEASUREMENT
/begin MEASUREMENT frauzs_w "multiplikativer Gemischadaptionsfaktor unterer mult. Bereich (alter Wert)" UWORD fak_uw_b2 1 100 0 1.99997 FORMAT "%8.6" ECU_ADDRESS 0x384B6C /end MEASUREMENT
/begin MEASUREMENT fvdldp "Bitstruktur für Fehlervorbehalte der DLDP" UWORD dez 1 100 0 65535 FORMAT "%8.2" ECU_ADDRESS 0x382B96 /end MEASUREMENT
/begin MEASUREMENT fwmlhfm_w "gewichteter MLHFMMN in Abhängigkeit von Faktor Höhe" SWORD m_q0p1 1 100 -3276.8 3276.7 FORMAT "%8.3" ECU_ADDRESS 0x384A98 /end MEASUREMENT
/begin MEASUREMENT imlkvszs_w "Zwischenspeicher: Luftmasse nach Auftreten eines DKVS Fehles bei leerem Tank" UWORD m_q0p00355 1 100 0 233.013 FORMAT "%8.4" ECU_ADDRESS 0x384060 /end MEASUREMENT
/begin MEASUREMENT imlkvs_w "Luftmasse nach Auftreten eines DKVS Fehles bei leerem Tank" UWORD m_q0p00355 1 100 0 233.013 FORMAT "%8.4" ECU_ADDRESS 0x384B6E /end MEASUREMENT
/begin MEASUREMENT imsteldp "Luftmassenintegrator bei Initial- u. Fortsetzungsspülung" UBYTE m_ub_q0p0444 1 100 0 11.322 FORMAT "%5.2" ECU_ADDRESS 0x380B4C /end MEASUREMENT
/begin MEASUREMENT intlash_w "Integrator (Rampe) für Lambdasoll Test Schwingungsprüfung h. KAT" UWORD fak_uw_b16 1 100 0 15.9998 FORMAT "%8.5" ECU_ADDRESS 0x384A30 /end MEASUREMENT
/begin MEASUREMENT lamdkt_w "Lambdasoll für Katalysatordiagnose" UWORD fak_uw_b16 1 100 0 15.9998 FORMAT "%8.5" ECU_ADDRESS 0x384A48 /end MEASUREMENT
/begin MEASUREMENT lamlash_w "Lambdasoll für Test Schwingungsprüfung hinter KAT" UWORD fak_uw_b16 1 100 0 15.9998 FORMAT "%8.5" ECU_ADDRESS 0x384A32 /end MEASUREMENT
/begin MEASUREMENT lamtrip_w "gespeicherte Lambdaabweichung aus lamsbg_w für Sonde hinter KAT" UWORD fak_uw_b16 1 100 0 15.9998 FORMAT "%8.5" ECU_ADDRESS 0x384A34 /end MEASUREMENT
/begin MEASUREMENT ldktmev_w "Lambda minus eins bei Katdiagnose, verzögerter Wert" SWORD fak_sw_b1 1 100 -1 0.999969 FORMAT "%8.6" ECU_ADDRESS 0x381B3C /end MEASUREMENT
/begin MEASUREMENT ldktme_w "Lambda minus eins bei Katdiagnose" SWORD fak_sw_b1 1 100 -1 0.999969 FORMAT "%8.6" ECU_ADDRESS 0x381B3E /end MEASUREMENT
/begin MEASUREMENT m6aktsp "Anzahl der Ausgabe-Codes SCAN-Tool Mode6 aus Kat-Diagnose" UBYTE dez 1 100 0 255 FORMAT "%5.1" ECU_ADDRESS 0x384015 /end MEASUREMENT
/begin MEASUREMENT m6cktsp "Ausgabe-Code SCAN-Tool Mode 6 aus Katalysatordiagnose" UBYTE dez 1 100 0 255 FORMAT "%5.1" ECU_ADDRESS 0x384016 /end MEASUREMENT
/begin MEASUREMENT m6sktsp_w "Ausgabe Schwellwert SCAN-Tool Mode 6 aus Katalysatordiagnose" UWORD dez 1 100 0 65535 FORMAT "%8.2" ECU_ADDRESS 0x383C58 /end MEASUREMENT
/begin MEASUREMENT m6wktsp_w "Ausgabe Prüfwert SCAN-Tool Mode 6 aus Katalysatordiagnose" UWORD dez 1 100 0 65535 FORMAT "%8.2" ECU_ADDRESS 0x38403C /end MEASUREMENT
/begin MEASUREMENT maxError "Max Error DKMTR aufgetreten" UWORD B_TRUE 1 100 0 1 BIT_MASK 0x4 FORMAT "%13.11" ECU_ADDRESS 0x384A8E /end MEASUREMENT
/begin MEASUREMENT minError "Min Error DKMTR aufgetreten" UWORD B_TRUE 1 100 0 1 BIT_MASK 0x2 FORMAT "%13.11" ECU_ADDRESS 0x384A8E /end MEASUREMENT
/begin MEASUREMENT mldko_w "Luftmassenschwelle zur Erkennung Kurzschluß nach 5V in DHFM" SWORD m_q0p1 1 100 -3276.8 3276.7 FORMAT "%8.3" ECU_ADDRESS 0x381EA4 /end MEASUREMENT
/begin MEASUREMENT mldkthp_w "Hochpaßgefilterte Luftmasse der Katalysatordiagnose" UWORD m_uw_b6553p5 1 100 0 6553.5 FORMAT "%8.3" ECU_ADDRESS 0x384A5A /end MEASUREMENT
/begin MEASUREMENT mldmn_w "minimale Luftmasse aus Kennfeld KFMLDMN" SWORD m_q0p1 1 100 -3276.8 3276.7 FORMAT "%8.3" ECU_ADDRESS 0x384A9A /end MEASUREMENT
/begin MEASUREMENT mldmx_w "maximale Luftmasse aus Kennfeld KFMLDMX" SWORD m_q0p1 1 100 -3276.8 3276.7 FORMAT "%8.3" ECU_ADDRESS 0x381EA6 /end MEASUREMENT
/begin MEASUREMENT mldyn_w "Luftmassenintegral im Schubbetrieb für Sonde hinter Kat" UWORD m_q0p00277 1 100 0 182.042 FORMAT "%8.4" ECU_ADDRESS 0x384A36 /end MEASUREMENT
/begin MEASUREMENT mlfdkt_w "ml * lambda-Produkt bei Katalysatordiagnose während Fettgaseintrag" UWORD mk_q1p56Em3 1 100 0 102.397 FORMAT "%8.4" ECU_ADDRESS 0x381B40 /end MEASUREMENT
/begin MEASUREMENT mlhfmf_w "gefilterter Luftmassen HFM-Mittelwert 16Bit-Wert" SWORD m_q0p1 1 100 -3276.8 3276.7 FORMAT "%8.3" ECU_ADDRESS 0x381EA8 /end MEASUREMENT
/begin MEASUREMENT mlldkt_w "ml * lambda-Produkt bei Katalysatordiagnose während Magergaseintrag" UWORD m_uw_b102p4 1 100 0 102.397 FORMAT "%8.4" ECU_ADDRESS 0x381B42 /end MEASUREMENT
/begin MEASUREMENT modeldp "Ansteuermodus der LDP" UBYTE dez 1 100 0 255 FORMAT "%5.1" ECU_ADDRESS 0x380B4D /end MEASUREMENT
/begin MEASUREMENT modeldp_old "" UBYTE dez 1 100 0 255 FORMAT "%5.1" ECU_ADDRESS 0x380B4E /end MEASUREMENT
/begin MEASUREMENT oscdkta_w "Sauerstoffspeichervermögen des Katalysators, Applikations-Speicherwert bei Messe" UWORD m_q0p1_mg 1 100 0 6553.5 FORMAT "%8.3" ECU_ADDRESS 0x381B44 /end MEASUREMENT
/begin MEASUREMENT oscdktf_w "Gefilterte Sauerstoffspeicherfähigkeit des Katalysators" UWORD fak_uw_b16 1 100 0 15.9998 FORMAT "%8.5" ECU_ADDRESS 0x38403E /end MEASUREMENT
/begin MEASUREMENT oscdktm_w "Mittelwert des Sauerstoffspeicherfähigkeit des Katalysators" UWORD fak_uw_b16 1 100 0 15.9998 FORMAT "%8.5" ECU_ADDRESS 0x384A4A /end MEASUREMENT
/begin MEASUREMENT oscdktn_w "Normierte Sauerstoffspeicherfähigkeit des Katalysators" UWORD fak_uw_b16 1 100 0 15.9998 FORMAT "%8.5" ECU_ADDRESS 0x381B46 /end MEASUREMENT
/begin MEASUREMENT oscdktr_w "Normierte Sauerstoffspeicherfähigkeit des Katalysators, Referenzwert bei Messend" UWORD fak_uw_b16 1 100 0 15.9998 FORMAT "%8.5" ECU_ADDRESS 0x381B48 /end MEASUREMENT
/begin MEASUREMENT oscdkts_w "Summenwert der Sauerstoffspeicherfähigkeit des Katalysators" UWORD fak_uw_b128 1 100 0 127.998 FORMAT "%8.4" ECU_ADDRESS 0x384A4C /end MEASUREMENT
/begin MEASUREMENT oscdktt_w "Sauerstoffspeichervermögen des Katalysators, temperatur- und luftmassenstrombezo" UWORD m_q0p1_mg 1 100 10 6553.5 FORMAT "%8.3" ECU_ADDRESS 0x384A4E /end MEASUREMENT
/begin MEASUREMENT oscdkt_w "Sauerstoffspeichervermögen des Katalysators" UWORD m_q0p1_mg 1 100 0 6553.5 FORMAT "%8.3" ECU_ADDRESS 0x381B4A /end MEASUREMENT
/begin MEASUREMENT oscmnd_w "Minimale Abweichung der Sauerstoffspeichervermögen des Katalysators" UWORD fak_uw_b16 1 100 0 15.9998 FORMAT "%8.5" ECU_ADDRESS 0x384A50 /end MEASUREMENT
/begin MEASUREMENT oscmn_w "Minimalwert des Sauerstoffspeichervermögens des Katalysators" UWORD fak_uw_b16 1 100 0 15.9998 FORMAT "%8.5" ECU_ADDRESS 0x384A52 /end MEASUREMENT
/begin MEASUREMENT oscmxd_w "Maximale Abweichung der Sauerstoffspeichervermögen des Katalysators" UWORD fak_uw_b16 1 100 0 15.9998 FORMAT "%8.5" ECU_ADDRESS 0x384A54 /end MEASUREMENT
/begin MEASUREMENT oscmx_w "Maximalwert des Sauerstoffspeichervermögens des Katalysators" UWORD fak_uw_b16 1 100 0 15.9998 FORMAT "%8.5" ECU_ADDRESS 0x384A56 /end MEASUREMENT
/begin MEASUREMENT phlsnhf "normierte Heizleistung der Lambdasonde hinter Kat, gefiltert" UBYTE fak_ub_q0p01 1 100 0 2.55 FORMAT "%5.3" ECU_ADDRESS 0x38482D /end MEASUREMENT
/begin MEASUREMENT pspvdsmx "Ausgangswert von Kennfeld KFVPDKLD (maximales zulässiges Druckverhältnis pspvds)" UBYTE fak_ub_b4 1 100 0 3.98438 FORMAT "%5.3" ECU_ADDRESS 0x3848D9 /end MEASUREMENT
/begin MEASUREMENT pulsct "Pulsationscounter  für Diagnose Schubumluftventil beim Turbo" UBYTE DEZ 1 100 0 255 FORMAT "%5.1" ECU_ADDRESS 0x3809B9 /end MEASUREMENT
/begin MEASUREMENT pulscthld "Pulsationscounter sample and hold  für Diagnose Schubumluftventil beim Turbo" UBYTE DEZ 1 100 0 255 FORMAT "%5.1" ECU_ADDRESS 0x3809BA /end MEASUREMENT
/begin MEASUREMENT pumem_w "Korrigierter Umgebungsdruck zu Beginn der Pump-Phase" UWORD p_uw_q0p039 1 100 0 2559.96 FORMAT "%8.3" ECU_ADDRESS 0x382B98 /end MEASUREMENT
/begin MEASUREMENT ready "readiness-Byte für Ausgabe SAE J1979 Mode2" UBYTE dez 1 100 0 255 FORMAT "%5.1" ECU_ADDRESS 0x384007 /end MEASUREMENT
/begin MEASUREMENT readyagr "" UBYTE dez 1 100 0 255 FORMAT "%5.1" ECU_ADDRESS 0x384008 /end MEASUREMENT
/begin MEASUREMENT readyhls "" UBYTE dez 1 100 0 255 FORMAT "%5.1" ECU_ADDRESS 0x38400A /end MEASUREMENT
/begin MEASUREMENT readykat "" UBYTE dez 1 100 0 255 FORMAT "%5.1" ECU_ADDRESS 0x38400C /end MEASUREMENT
/begin MEASUREMENT readylsv "" UBYTE dez 1 100 0 255 FORMAT "%5.1" ECU_ADDRESS 0x38400E /end MEASUREMENT
/begin MEASUREMENT readysls "" UBYTE dez 1 100 0 255 FORMAT "%5.1" ECU_ADDRESS 0x384010 /end MEASUREMENT
/begin MEASUREMENT rinkfh "Innenwiderstand Nernstzelle der Lambdasonde aus Kennfeld vor Kat" UBYTE r_q8 1 100 0 2040 FORMAT "%5.0" ECU_ADDRESS 0x38482E /end MEASUREMENT
/begin MEASUREMENT rinsh_w "Grenzwert Innenwiderstand Nernstzelle der Lambdasonde hinter Kat" UWORD r_uw_q2 1 100 0 131070 FORMAT "%8.1" ECU_ADDRESS 0x384A10 /end MEASUREMENT
/begin MEASUREMENT rkamzs_w "additive Gemischkorrektur (pro Zeit oder Zündung); alter Wert" SWORD rel_sw_b1536 1 100 -1536 1535.95 FORMAT "%8.3" ECU_ADDRESS 0x384B70 /end MEASUREMENT
/begin MEASUREMENT rkam_w "Auswahl additive Gemischkorrektur der Gemischadaption für Bestimmung B_gae" SWORD rel_sw_b1536 1 100 -1536 1535.95 FORMAT "%8.3" ECU_ADDRESS 0x384B72 /end MEASUREMENT
/begin MEASUREMENT rkrn_w "normierter Referenzpegel Klopfregelung" UWORD spg_uw_b1280 1 100 0 1279.98 FORMAT "%8.3" ARRAY_SIZE 8 ECU_ADDRESS 0x384BD8 /end MEASUREMENT
/begin MEASUREMENT rlbab "Aktuelle RL-Schwelle bei Bergaberkennung" UBYTE rel_ub_q0p75 1 100 0 191.25 FORMAT "%5.1" ECU_ADDRESS 0x38490D /end MEASUREMENT
/begin MEASUREMENT rlbabxf "Aktuelle RL-Schwelle bei Bergaberkennung (0.5 mm - Diagnose)" UBYTE rel_ub_q0p75 1 100 0 191.25 FORMAT "%5.1" ECU_ADDRESS 0x38490E /end MEASUREMENT
/begin MEASUREMENT rlf "Tiefpaßgefiltertes RL bei Bergaberkennung" UBYTE rel_ub_q0p75 1 100 0 191.25 FORMAT "%5.1" ECU_ADDRESS 0x38490F /end MEASUREMENT
/begin MEASUREMENT rsmcnt "Zähler Wiederholversuche nach Unterbrechung bei erkanntem Leck" UBYTE dez 1 100 0 255 FORMAT "%5.1" ECU_ADDRESS 0x380B4F /end MEASUREMENT
/begin MEASUREMENT rsmcntd "Zähler Wiederholungen 1mm-Dichtprüfungen" UBYTE dez 1 100 0 255 FORMAT "%5.1" ECU_ADDRESS 0x380B50 /end MEASUREMENT
/begin MEASUREMENT rsmcntg "Zähler Wiederholversuche nach Unterbrechung insgesamt" UBYTE dez 1 100 0 255 FORMAT "%5.1" ECU_ADDRESS 0x380B51 /end MEASUREMENT
/begin MEASUREMENT sfpaatun "Status Fehlerpfad: Tuningschutz" UWORD default 1 100 0 65535 FORMAT "%8.2" ECU_ADDRESS 0x383B08 /end MEASUREMENT
/begin MEASUREMENT sfpldpe "Status Fehlerpfad: Leckdiagnosepumpe - Endstufe" UWORD dez 1 100 0 65535 FORMAT "%8.2" ECU_ADDRESS 0x383BB8 /end MEASUREMENT
/begin MEASUREMENT sfpmdb "Status Fehlerpfad: Momentanüberwachung begrenzt dauerhaft" UWORD dez 1 100 0 65535 FORMAT "%8.2" ECU_ADDRESS 0x383BD6 /end MEASUREMENT
/begin MEASUREMENT sfpsgeew "Status Fehlerpfad: Steuergerät defekt (EEPROM WFS)" UWORD dez 1 100 0 65535 FORMAT "%8.2" ECU_ADDRESS 0x383BF0 /end MEASUREMENT
/begin MEASUREMENT sfpwfs "Status Fehlerpfad: Wegfahrsperre" UWORD dez 1 100 0 65535 FORMAT "%8.2" ECU_ADDRESS 0x383C2A /end MEASUREMENT
/begin MEASUREMENT sfpwfsrc "Status Fehlerpfad: Wegfahrsperre RC-Glied" UWORD dez 1 100 0 65535 FORMAT "%8.2" ECU_ADDRESS 0x383C2C /end MEASUREMENT
/begin MEASUREMENT sigError "Sig Error DKMTR aufgetreten" UWORD B_TRUE 1 100 0 1 BIT_MASK 0x8 FORMAT "%13.11" ECU_ADDRESS 0x384A8E /end MEASUREMENT
/begin MEASUREMENT stptr "Zustandspointer der DLDP" UBYTE dez 1 100 0 255 FORMAT "%5.1" ECU_ADDRESS 0x380B52 /end MEASUREMENT
/begin MEASUREMENT tahsomf_w "gefilterte Abgastemperatur an Sonde hinter Kat aus Modell" UWORD temp_q0p0234_o273 1 100 -273.15 1262.83 FORMAT "%8.3" ECU_ADDRESS 0x384A12 /end MEASUREMENT
/begin MEASUREMENT taldpst "Ansaugluft-Temperatur bei Start" UBYTE temp_ub_q0p75_o48 1 100 -48 143.25 FORMAT "%5.1" ECU_ADDRESS 0x384910 /end MEASUREMENT
/begin MEASUREMENT talsuf_w "gefilterte Abgastemperatur aus Modell" UWORD temp_q0p0234_o273 1 100 -273.15 1262.83 FORMAT "%8.3" ECU_ADDRESS 0x384A38 /end MEASUREMENT
/begin MEASUREMENT tc6ldpc "Ausgabe Code SCAN-Tool Mode 6 aus LDP-Diagnose" UBYTE dez 1 100 0 255 FORMAT "%5.1" ECU_ADDRESS 0x384026 /end MEASUREMENT
/begin MEASUREMENT tc6ldps "Ausgabe Schwellwert SCAN-Tool Mode 6 aus LDP-Diagnose" UWORD dez 1 100 0 65535 FORMAT "%8.2" ECU_ADDRESS 0x384092 /end MEASUREMENT
/begin MEASUREMENT tc6ldpw "Ausgabe Prüfwert SCAN-Tool Mode 6 aus LDP-Diagnose" UWORD dez 1 100 0 65535 FORMAT "%8.2" ECU_ADDRESS 0x384094 /end MEASUREMENT
/begin MEASUREMENT tdaufp "Bereitstellung Zeitdauer Fast Pulse" UWORD t10msxs_uw_b655p35 1 100 0 655.35 FORMAT "%8.4" ECU_ADDRESS 0x382B9A /end MEASUREMENT
/begin MEASUREMENT tfpg "Timer Fast Pulse Gesamtdauer" UBYTE t1sxs_ub_b255 1 100 0 255 FORMAT "%5.1" ECU_ADDRESS 0x380B53 /end MEASUREMENT
/begin MEASUREMENT tikatmu "Umgeschaltete Abgastemperatur im Katalysator aus Modell" UBYTE temp_ub_q5_o50 1 100 -50 1225 FORMAT "%5.0" ECU_ADDRESS 0x38484C /end MEASUREMENT
/begin MEASUREMENT tikatmu_w "Umgeschaltete Abgastemperatur im Katalysator aus Modell" UWORD temp_uw_q0p0195_o50 1 100 -50 1229.98 FORMAT "%8.3" ECU_ADDRESS 0x384A58 /end MEASUREMENT
/begin MEASUREMENT timaldp "Timer für Ansteuerung LDP" UWORD t10msxs_uw_b655p35 1 100 0 655.35 FORMAT "%8.4" ECU_ADDRESS 0x382B9C /end MEASUREMENT
/begin MEASUREMENT timfp "Timer für Zeitdauer Fast Pulse" UWORD t10msxs_uw_b655p35 1 100 0 655.35 FORMAT "%8.4" ECU_ADDRESS 0x382B9E /end MEASUREMENT
/begin MEASUREMENT timldp "Timer für maximale Diagnosezeit DLDP" UWORD t1sxs_uw_b65535 1 100 0 65535 FORMAT "%8.2" ECU_ADDRESS 0x385356 /end MEASUREMENT
/begin MEASUREMENT timrs "Timer für Reed-Switch Closed Check" UWORD t10msxs_uw_b655p35 1 100 0 655.35 FORMAT "%8.4" ECU_ADDRESS 0x382BA0 /end MEASUREMENT
/begin MEASUREMENT timtev "Timer für Zeitüberwachung TEV-Check" UWORD t10msxs_uw_b655p35 1 100 0 655.35 FORMAT "%8.4" ECU_ADDRESS 0x382BA2 /end MEASUREMENT
/begin MEASUREMENT timzldp "Timer für Zustandsautomat in der DLDP" UWORD t10msxs_uw_b655p35 1 100 0 655.35 FORMAT "%8.4" ECU_ADDRESS 0x382BA4 /end MEASUREMENT
/begin MEASUREMENT tispldpx_w "Schwelle für Zeit für Initialspülung bis LDP-Membran abgefallen ist" UWORD dez 1 100 0 65535 FORMAT "%8.2" ECU_ADDRESS 0x385358 /end MEASUREMENT
/begin MEASUREMENT tispldp_w "Zeit für Initialspülung bis LDP-Membran abgefallen ist" UWORD dez 1 100 0 65535 FORMAT "%8.2" ECU_ADDRESS 0x38535A /end MEASUREMENT
/begin MEASUREMENT tispuel "Timer für Initialspülung in der DLDP" UBYTE t1sxs_ub_b255 1 100 0 255 FORMAT "%5.1" ECU_ADDRESS 0x384911 /end MEASUREMENT
/begin MEASUREMENT tkdktg "Katalysasto-Temperaturgradient bei Katdiagnose" UBYTE temp_ub_q5 1 100 0 1275 FORMAT "%5.0" ECU_ADDRESS 0x38484D /end MEASUREMENT
/begin MEASUREMENT tkdkthps "hochpaßgefilterte Katalysator-Temperatur" UBYTE temp_ub_q5 1 100 0 1275 FORMAT "%5.0" ECU_ADDRESS 0x38484E /end MEASUREMENT
/begin MEASUREMENT tkdktold "Katdiagnose: alter Tamperaturwert" UBYTE temp_ub_q5_o50 1 100 -50 1225 FORMAT "%5.0" ECU_ADDRESS 0x38484F /end MEASUREMENT
/begin MEASUREMENT tkslue1 "Dauer des letzten KS nach Masse, bzw Dauer aktueller KS bei echtem KS" UWORD fak_q0p1 1 100 0 6553.5 FORMAT "%8.3" ECU_ADDRESS 0x384A90 /end MEASUREMENT
/begin MEASUREMENT tkslue1h "Zeit seit Ende des letzten KS nach Masse" UWORD fak_q0p1 1 100 0 6553.5 FORMAT "%8.3" ECU_ADDRESS 0x384A92 /end MEASUREMENT
/begin MEASUREMENT tksluetmp "temporäre Meßgröße tkslue1" UWORD fak_q0p1 1 100 0 6553.5 FORMAT "%8.3" ECU_ADDRESS 0x384A94 /end MEASUREMENT
/begin MEASUREMENT tldktim "Timer Überwachungszeit Saugrohr" UWORD t10msxs_uw_b655p35 1 100 0 655.35 FORMAT "%8.4" ECU_ADDRESS 0x382BA6 /end MEASUREMENT
/begin MEASUREMENT tldpein "" UWORD t10msxs_uw_b655p35 1 100 0 655.35 FORMAT "%8.4" ECU_ADDRESS 0x382BA8 /end MEASUREMENT
/begin MEASUREMENT tldppmw "Gleitender Mittelwert Periodendauer bei Leckdiagnose" UWORD t10msxs_uw_b655p35 1 100 0 655.35 FORMAT "%8.4" ECU_ADDRESS 0x382BAA /end MEASUREMENT
/begin MEASUREMENT tpfifo "FIFO-Speicher für Periodendauer" UWORD t10msxs_uw_b655p35 1 100 0 655.35 FORMAT "%8.4" ARRAY_SIZE 4 ECU_ADDRESS 0x382BAC /end MEASUREMENT
/begin MEASUREMENT tpldptcx_w "Schwelle Zeit für bis LDP-Membran abgefallen ist nachdem TEV geöffnet wurde" UWORD dez 1 100 0 65535 FORMAT "%8.2" ECU_ADDRESS 0x38535C /end MEASUREMENT
/begin MEASUREMENT tpldptc_w "Zeit für bis LDP-Membran abgefallen ist nachdem TEV geöffnet wurde" UWORD dez 1 100 0 65535 FORMAT "%8.2" ECU_ADDRESS 0x38535E /end MEASUREMENT
/begin MEASUREMENT tpmeanv_w "Mittelwert der Periodendauern" UWORD t10msxs_uw_b655p35 1 100 0 655.35 FORMAT "%8.4" ECU_ADDRESS 0x382BB4 /end MEASUREMENT
/begin MEASUREMENT trklow "Timer zur Überwachung Reedkontakt öffnet während Fast Pulse" UWORD t10msxs_uw_b655p35 1 100 0 655.35 FORMAT "%8.4" ECU_ADDRESS 0x382BB6 /end MEASUREMENT
/begin MEASUREMENT tsdkttk_w "Temperaturabhängige Verzögerungszeit" UWORD t_q0p2 1 100 0 13107 FORMAT "%8.2" ECU_ADDRESS 0x384A5C /end MEASUREMENT
/begin MEASUREMENT tvfzctr "Zeitbasis für v-Gradient bei Bergaberklennung" UBYTE t100msxs_ub_b25p5 1 100 0 25.5 FORMAT "%5.2" ECU_ADDRESS 0x384912 /end MEASUREMENT
/begin MEASUREMENT TYP_AATUN "" UWORD B_TRUE 1 100 0 1 BIT_MASK 0xf00 FORMAT "%13.11" ECU_ADDRESS 0x383B08 /end MEASUREMENT
/begin MEASUREMENT TYP_ldpe "" UWORD B_TRUE 1 100 0 1 BIT_MASK 0xf00 FORMAT "%13.11" ECU_ADDRESS 0x383BB8 /end MEASUREMENT
/begin MEASUREMENT TYP_mdb "Fehlertyp: Momentenbegrenzung (begrenzt dauerhaft) aktiv" UWORD B_TRUE 1 100 0 1 BIT_MASK 0xf00 FORMAT "%13.11" ECU_ADDRESS 0x383BD6 /end MEASUREMENT
/begin MEASUREMENT TYP_sgeew "" UWORD B_TRUE 1 100 0 1 BIT_MASK 0xf00 FORMAT "%13.11" ECU_ADDRESS 0x383BF0 /end MEASUREMENT
/begin MEASUREMENT TYP_wfs "" UWORD B_TRUE 1 100 0 1 BIT_MASK 0xf00 FORMAT "%13.11" ECU_ADDRESS 0x383C2A /end MEASUREMENT
/begin MEASUREMENT TYP_wfsrc "" UWORD B_TRUE 1 100 0 1 BIT_MASK 0xf00 FORMAT "%13.11" ECU_ADDRESS 0x383C2C /end MEASUREMENT
/begin MEASUREMENT udksnoa_w "KS-Diagnose: Aktueller Wert obere Schwelle (UDKSNO)" UWORD spg_uw_b1280 1 100 0 1279.98 FORMAT "%8.3" ECU_ADDRESS 0x38236A /end MEASUREMENT
/begin MEASUREMENT udksnua_w "KS-Diagnose: Aktueller Wert untere Schwelle (UDKSNU)" UWORD spg_uw_b1280 1 100 0 1279.98 FORMAT "%8.3" ECU_ADDRESS 0x38236C /end MEASUREMENT
/begin MEASUREMENT ushfmxstg "Gefilterte maximale Steigung der Sondenspannung hinter KAT" UBYTE spgg_q0p52 1 100 0 132.6 FORMAT "%5.1" ECU_ADDRESS 0x383322 /end MEASUREMENT
/begin MEASUREMENT ushkmxstg "Maximale Steigung der Sondenspannung hinter KAT" UBYTE spgg_q0p52 1 100 0 132.6 FORMAT "%5.1" ECU_ADDRESS 0x380942 /end MEASUREMENT
/begin MEASUREMENT ushksteig "Steigung der Sondenspannung hinter KAT" UBYTE spgg_q0p52 1 100 0 132.6 FORMAT "%5.1" ECU_ADDRESS 0x380943 /end MEASUREMENT
/begin MEASUREMENT usrhkmx "maximale Regelschwelle im Fehlerfall  für Sonden-Diagnose hinter KAT" UBYTE spg_ub_q0p0052_o0p2 1 100 -0.2 1.13 FORMAT "%5.3" ECU_ADDRESS 0x384013 /end MEASUREMENT
/begin MEASUREMENT usrhks "aktueller Regel-Sollwert für Diagnose hinter KAT" UBYTE spg_ub_q0p0052_o0p2 1 100 -0.2 1.13 FORMAT "%5.3" ECU_ADDRESS 0x384845 /end MEASUREMENT
/begin MEASUREMENT wdkbadmx_w "Winkel-DK für Adressierung von KFMLDMX" SWORD relDK_q0p02441 1 100 -800 799.976 FORMAT "%8.4" ECU_ADDRESS 0x381EAA /end MEASUREMENT
/begin MEASUREMENT wzcto "Zähler Wiederholversuche Close to Open Check" UBYTE dez 1 100 0 255 FORMAT "%5.1" ECU_ADDRESS 0x380B54 /end MEASUREMENT
/begin MEASUREMENT xzkrznt "Zähler Klopfregelung Zyklusflag Z_krnt" UBYTE dez 1 100 0 255 FORMAT "%5.1" ECU_ADDRESS 0x380A82 /end MEASUREMENT
/begin MEASUREMENT xzkrzof "Zähler Klopfregelung Zyklusflag Z_krof" UBYTE dez 1 100 0 255 FORMAT "%5.1" ECU_ADDRESS 0x380A83 /end MEASUREMENT
/begin MEASUREMENT xzkrzs "Zähler für Zyklusflag Diagnose Klopfsensor" UBYTE dez 1 100 0 255 FORMAT "%5.1" ARRAY_SIZE 4 ECU_ADDRESS 0x3848CF /end MEASUREMENT
/begin MEASUREMENT xzkrztp "Zähler Klopfregelung Zyklusflag Z_krtp" UBYTE dez 1 100 0 255 FORMAT "%5.1" ECU_ADDRESS 0x380A86 /end MEASUREMENT
/begin MEASUREMENT xzsen "Entprellzähler Diagnose Klopfsensor" UBYTE dez 1 100 0 255 FORMAT "%5.1" ARRAY_SIZE 4 ECU_ADDRESS 0x3848D3 /end MEASUREMENT
/begin MEASUREMENT xzskrnt "Sicherheitszähler Klopfregelung Nulltest" UBYTE dez 1 100 0 255 FORMAT "%5.1" ECU_ADDRESS 0x380A84 /end MEASUREMENT
/begin MEASUREMENT xzskrof "Sicherheitszähler Klopfregelung Offset" UBYTE dez 1 100 0 255 FORMAT "%5.1" ECU_ADDRESS 0x380A85 /end MEASUREMENT
/begin MEASUREMENT xzskrtp "Zähler Klopfregelung Errorflag E_krtp" UBYTE dez 1 100 0 255 FORMAT "%5.1" ECU_ADDRESS 0x380A87 /end MEASUREMENT
/begin MEASUREMENT zlash_w "Zeitzähler für Sondenspannung hinter KAT ober/unterhalb des Sollwertes" UWORD t100msxs_uw_b6553p5 1 100 0 6553.5 FORMAT "%8.3" ECU_ADDRESS 0x381AD6 /end MEASUREMENT
/begin MEASUREMENT zwdynsh "Zähler für Anzahl der Dynamikmessungen für Sonde hinter KAT" UBYTE dez 1 100 0 255 FORMAT "%5.1" ECU_ADDRESS 0x384846 /end MEASUREMENT
/begin MEASUREMENT Z_aatun "Zyklusflag: Tuningschutz" UWORD B_TRUE 1 100 0 1 BIT_MASK 0x2 FORMAT "%13.11" ECU_ADDRESS 0x383B08 /end MEASUREMENT
/begin MEASUREMENT Z_ldpe "Zyklusflag: Leckdiagnosepumpe Endstufe" UWORD B_TRUE 1 100 0 1 BIT_MASK 0x2 FORMAT "%13.11" ECU_ADDRESS 0x383BB8 /end MEASUREMENT
/begin MEASUREMENT Z_mdb "Zyklusflag: Momentenbegrenzung begrenzt dauerhaft" UWORD B_TRUE 1 100 0 1 BIT_MASK 0x2 FORMAT "%13.11" ECU_ADDRESS 0x383BD6 /end MEASUREMENT
/begin MEASUREMENT Z_sgeew "Zyklusflag: Steuergerät defekt (EEPROM-WFS)" UWORD B_TRUE 1 100 0 1 BIT_MASK 0x2 FORMAT "%13.11" ECU_ADDRESS 0x383BF0 /end MEASUREMENT
/begin MEASUREMENT Z_wfs "Zyklusflag: Wegfahrsperre" UWORD B_TRUE 1 100 0 1 BIT_MASK 0x2 FORMAT "%13.11" ECU_ADDRESS 0x383C2A /end MEASUREMENT
/begin MEASUREMENT Z_wfsrc "Zyklusflag: Wegfahrsperre RC-Glied" UWORD B_TRUE 1 100 0 1 BIT_MASK 0x2 FORMAT "%13.11" ECU_ADDRESS 0x383C2C /end MEASUREMENT
/begin FUNCTION DFPM_IMS ""
 /begin DEF_CHARACTERISTIC CDCSGEEW CDCWFS CDCWFSRC CDKSGEEW CDKWFS CDKWFSRC CDTSGEEW CDTWFS CDTWFSRC CLASGEEW CLAWFS CLAWFSRC FFTSGEEW FFTWFS FFTWFSRC TSFSGEEW TSFWFS TSFWFSRC /end DEF_CHARACTERISTIC
 /begin REF_CHARACTERISTIC /end REF_CHARACTERISTIC
 /begin IN_MEASUREMENT /end IN_MEASUREMENT
 /begin OUT_MEASUREMENT B_besgeew B_bewfs B_bewfsrc B_bksgeew B_bkwfs B_bkwfsrc B_clsgeew B_clwfs B_clwfsrc B_ftsgeew B_ftwfs B_ftwfsrc B_mnsgeew B_mnwfs B_mnwfsrc B_mxsgeew B_mxwfs B_mxwfsrc B_npsgeew B_npwfs B_npwfsrc B_sisgeew B_siwfs B_siwfsrc E_sgeew E_wfs E_wfsrc sfpsgeew sfpwfs sfpwfsrc TYP_sgeew TYP_wfs TYP_wfsrc Z_sgeew Z_wfs Z_wfsrc /end OUT_MEASUREMENT
 /begin LOC_MEASUREMENT /end LOC_MEASUREMENT
 /begin SUB_FUNCTION /end SUB_FUNCTION
/end FUNCTION
/begin FUNCTION DFPM_LDPE "" /begin DEF_CHARACTERISTIC CDCLDPE CDKLDPE CDTLDPE CLALDPE FFTLDPE TSFLDPE /end DEF_CHARACTERISTIC /begin REF_CHARACTERISTIC /end REF_CHARACTERISTIC /begin IN_MEASUREMENT /end IN_MEASUREMENT
 /begin OUT_MEASUREMENT B_beldpe B_bkldpe B_clldpe B_ftldpe B_mnldpe B_mxldpe B_npldpe B_sildpe E_ldpe sfpldpe TYP_ldpe Z_ldpe /end OUT_MEASUREMENT
 /begin LOC_MEASUREMENT /end LOC_MEASUREMENT
 /begin SUB_FUNCTION /end SUB_FUNCTION
/end FUNCTION
/begin FUNCTION DFPM_MDKOG "" /begin DEF_CHARACTERISTIC CDCMDB CDKMDB CDTMDB CLAMDB FFTMDB TSFMDB /end DEF_CHARACTERISTIC /begin REF_CHARACTERISTIC /end REF_CHARACTERISTIC /begin IN_MEASUREMENT /end IN_MEASUREMENT
 /begin OUT_MEASUREMENT B_bemdb B_bkmdb B_clmdb B_ftmdb B_mnmdb B_mxmdb B_npmdb B_simdb E_mdb sfpmdb TYP_mdb Z_mdb /end OUT_MEASUREMENT
 /begin LOC_MEASUREMENT /end LOC_MEASUREMENT
 /begin SUB_FUNCTION /end SUB_FUNCTION
/end FUNCTION
/begin FUNCTION DFPM_TUNING "" /begin DEF_CHARACTERISTIC CDCAATUN CDKAATUN CDTAATUN CLAAATUN FFTAATUN TSFAATUN /end DEF_CHARACTERISTIC /begin REF_CHARACTERISTIC /end REF_CHARACTERISTIC /begin IN_MEASUREMENT /end IN_MEASUREMENT
 /begin OUT_MEASUREMENT B_beaatun B_bkaatun B_claatun B_ftaatun B_mnaatun B_mxaatun B_npaatun B_siaatun E_aatun sfpaatun TYP_AATUN Z_aatun /end OUT_MEASUREMENT
 /begin LOC_MEASUREMENT /end LOC_MEASUREMENT
 /begin SUB_FUNCTION /end SUB_FUNCTION
/end FUNCTION
/begin FUNCTION DFRZ "20.20     OBDII; Beschreibung 'freeze frame'" /begin DEF_CHARACTERISTIC /end DEF_CHARACTERISTIC /begin REF_CHARACTERISTIC /end REF_CHARACTERISTIC /begin IN_MEASUREMENT /end IN_MEASUREMENT /begin OUT_MEASUREMENT /end OUT_MEASUREMENT /begin LOC_MEASUREMENT /end LOC_MEASUREMENT /begin SUB_FUNCTION /end SUB_FUNCTION /end FUNCTION
/begin FUNCTION DHFM "77.20     Diagnose; Plausibilitätsprüfung HFM"
 /begin DEF_CHARACTERISTIC CWDHFM FMLDMXKO FWMLHFMMN KFMLDMN KFMLDMX MLDHFMKU MLHFMMN TDMLHFM TDMLMN TDMLMX TDMLNF TDMLNPL TDMLST TDUBHFM UBHFM UNWDHFM ZMLRO /end DEF_CHARACTERISTIC
 /begin REF_CHARACTERISTIC /end REF_CHARACTERISTIC
 /begin IN_MEASUREMENT B_bvhfm B_cdehfm B_dkpu B_edks B_ehfmfe B_ldrugd B_stend B_zhfmfe fho_w mlsol_w mshfm1_w nmot nmot_w ub uzkw_w wdkba_w /end IN_MEASUREMENT
 /begin OUT_MEASUREMENT B_ehfm B_fgahfm B_heahfmlm B_hfm B_mnhfmlm B_mnmld B_mxhfmlm B_mxmld B_nplhfmlm fwmlhfm_w mldmn_w mldmx_w /end OUT_MEASUREMENT
 /begin LOC_MEASUREMENT B_ehfm1 B_fgdhfmst B_fgfshfm B_hfmko B_hfmku mldko_w mlhfmf_w wdkbadmx_w /end LOC_MEASUREMENT
 /begin SUB_FUNCTION /end SUB_FUNCTION
/end FUNCTION
/begin FUNCTION DHLSHK "4.90      Diagnose Sondenheizung hinter Kat"
 /begin DEF_CHARACTERISTIC CWDHLSH FRINH1 KFRINH TABSTHLSH TADHMNH TADHMXH TANSDHLSH TASOH TVHSHEE TVHSHRI TVHSHRIHEL TVHSHRIZ TVRIHEE UBDHLSHMN UBDHLSHMX ZKARIH1 ZKPRIH /end DEF_CHARACTERISTIC
 /begin REF_CHARACTERISTIC /end REF_CHARACTERISTIC
 /begin IN_MEASUREMENT B_atmst B_bvhls B_cdhsh B_lsh B_nmot B_rinh B_risigh B_stend msabg_w phlsnh rinh_w tabst_w tahsom_w tans ubsq_w /end IN_MEASUREMENT
 /begin OUT_MEASUREMENT B_hsokh B_ubok /end OUT_MEASUREMENT
 /begin LOC_MEASUREMENT B_ehsh B_enh B_mnfhsh B_mxfhsh B_npfhsh B_nphealh B_rierrh B_sifhsh phlsnhf rinkfh rinsh_w tahsomf_w /end LOC_MEASUREMENT
 /begin SUB_FUNCTION /end SUB_FUNCTION
/end FUNCTION
/begin FUNCTION DHLSHKE "1.10      Diagnose Endstufe Sondenheizung hinter Kat" /begin DEF_CHARACTERISTIC /end DEF_CHARACTERISTIC /begin REF_CHARACTERISTIC /end REF_CHARACTERISTIC /begin IN_MEASUREMENT B_cdhshe B_desee B_hshe /end IN_MEASUREMENT /begin OUT_MEASUREMENT /end OUT_MEASUREMENT /begin LOC_MEASUREMENT /end LOC_MEASUREMENT /begin SUB_FUNCTION /end SUB_FUNCTION /end FUNCTION
/begin FUNCTION DHLSU "2.171     Diagnose Heizung LSU"
 /begin DEF_CHARACTERISTIC MSABHMN SULSUMN SULSUMNN SULSUMXH TALSUMN TALSUSAE TDFHS TLSUSAE TNLDHLSU TVLSUBM TVLSUEE TVLSUNP TVLSUSA TVLSUSAE TVLSUSAH TVLSUST UBDHLSUMN UBDHLSUMX UHEMN UHEMX ZKLSU /end DEF_CHARACTERISTIC
 /begin REF_CHARACTERISTIC /end REF_CHARACTERISTIC
 /begin IN_MEASUREMENT B_bvhls B_cdhsv B_cdhsvsa B_elsu B_hsv B_hsve B_kl15 B_sa B_sbbvk B_stend msabg tabst_w tavvkm_w ubsq_w uhsv usvkk_w /end IN_MEASUREMENT
 /begin OUT_MEASUREMENT B_ehlsu B_nplsusa talsuf_w /end OUT_MEASUREMENT
 /begin LOC_MEASUREMENT B_enheat B_enswit B_helsunp B_helsusa B_helsusw B_mnhlsu B_mxhlsu B_nphlsu B_sihlsu /end LOC_MEASUREMENT
 /begin SUB_FUNCTION /end SUB_FUNCTION
/end FUNCTION
/begin FUNCTION DHR "2.20      Diagnose; Hauptrelais" /begin DEF_CHARACTERISTIC TDHR TDZHR UHRMN1 UHRMN2 UHRMX1 UHRMX2 /end DEF_CHARACTERISTIC /begin REF_CHARACTERISTIC /end REF_CHARACTERISTIC /begin IN_MEASUREMENT B_ubrdmn1 B_ubrdmn2 wuhr /end IN_MEASUREMENT /begin OUT_MEASUREMENT B_dhrnio /end OUT_MEASUREMENT /begin LOC_MEASUREMENT /end LOC_MEASUREMENT /begin SUB_FUNCTION /end SUB_FUNCTION /end FUNCTION
/begin FUNCTION DIAVALVE "" /begin DEF_CHARACTERISTIC /end DEF_CHARACTERISTIC /begin REF_CHARACTERISTIC /end REF_CHARACTERISTIC /begin IN_MEASUREMENT eevx /end IN_MEASUREMENT /begin OUT_MEASUREMENT /end OUT_MEASUREMENT /begin LOC_MEASUREMENT /end LOC_MEASUREMENT /begin SUB_FUNCTION /end SUB_FUNCTION /end FUNCTION
/begin FUNCTION DIMCA "1.10      Diagnose; Inspection Maintenance Code, allgemein" /begin DEF_CHARACTERISTIC /end DEF_CHARACTERISTIC /begin REF_CHARACTERISTIC /end REF_CHARACTERISTIC
 /begin IN_MEASUREMENT B_cdagr B_cdhsv B_cdldp B_cdlsv B_cdsls B_cdtes B_katfz B_kath B_pwf B_rdyagr B_rdyhs B_rdykat B_rdyls B_rdysls B_rdytes cd_bits1_w cd_bits2_w /end IN_MEASUREMENT
 /begin OUT_MEASUREMENT B_agrrdy B_hsrdy B_kathrdy B_katrdy B_kkrdy B_lsrdy B_slsrdy B_tesrdy evsup1 ready /end OUT_MEASUREMENT
 /begin LOC_MEASUREMENT /end LOC_MEASUREMENT
 /begin SUB_FUNCTION /end SUB_FUNCTION
/end FUNCTION
/begin FUNCTION DIMCAGR "1.10      Diagnose; Inspection Maintenance Code, Abgasrückführsystem-Überwachung" /begin DEF_CHARACTERISTIC SRYAGR /end DEF_CHARACTERISTIC /begin REF_CHARACTERISTIC /end REF_CHARACTERISTIC /begin IN_MEASUREMENT /end IN_MEASUREMENT /begin OUT_MEASUREMENT B_rdyagr readyagr /end OUT_MEASUREMENT /begin LOC_MEASUREMENT /end LOC_MEASUREMENT /begin SUB_FUNCTION /end SUB_FUNCTION /end FUNCTION
/begin FUNCTION DIMCHLS "1.20      Diagnose; Inspection Maintenance Code, LS-Heizungsüberwachung" /begin DEF_CHARACTERISTIC SRYHS /end DEF_CHARACTERISTIC /begin REF_CHARACTERISTIC /end REF_CHARACTERISTIC /begin IN_MEASUREMENT /end IN_MEASUREMENT /begin OUT_MEASUREMENT B_rdyhs readyhls /end OUT_MEASUREMENT /begin LOC_MEASUREMENT cryhs /end LOC_MEASUREMENT /begin SUB_FUNCTION /end SUB_FUNCTION /end FUNCTION
/begin FUNCTION DIMCKAT "1.10      Diagnose; Inspection maintenance Code, Katalysatorüberwachung" /begin DEF_CHARACTERISTIC SRYKAT /end DEF_CHARACTERISTIC /begin REF_CHARACTERISTIC /end REF_CHARACTERISTIC /begin IN_MEASUREMENT /end IN_MEASUREMENT /begin OUT_MEASUREMENT B_rdykat readykat /end OUT_MEASUREMENT /begin LOC_MEASUREMENT crykat /end LOC_MEASUREMENT /begin SUB_FUNCTION /end SUB_FUNCTION /end FUNCTION
/begin FUNCTION DIMCLSV "1.10      Diagnose; Inspection Maintenance Code, Lambdasonden-Überwachung" /begin DEF_CHARACTERISTIC SRYLS /end DEF_CHARACTERISTIC /begin REF_CHARACTERISTIC /end REF_CHARACTERISTIC /begin IN_MEASUREMENT /end IN_MEASUREMENT /begin OUT_MEASUREMENT B_rdyls readylsv /end OUT_MEASUREMENT /begin LOC_MEASUREMENT cryls /end LOC_MEASUREMENT /begin SUB_FUNCTION /end SUB_FUNCTION /end FUNCTION
/begin FUNCTION DIMCSLS "1.10      Diagnose; Inspection Maintenance Code, Sekundärluftsystem-Überwachung" /begin DEF_CHARACTERISTIC SRYSLS /end DEF_CHARACTERISTIC /begin REF_CHARACTERISTIC /end REF_CHARACTERISTIC /begin IN_MEASUREMENT B_cwdslt B_cwdslty B_mslmin /end IN_MEASUREMENT /begin OUT_MEASUREMENT B_rdysls readysls /end OUT_MEASUREMENT /begin LOC_MEASUREMENT crysls /end LOC_MEASUREMENT /begin SUB_FUNCTION /end SUB_FUNCTION /end FUNCTION
/begin FUNCTION DIMCTES "1.10      Diagnose; Inspection-Maintenance Code, Tankentlüftungssystem" /begin DEF_CHARACTERISTIC SRYTES /end DEF_CHARACTERISTIC /begin REF_CHARACTERISTIC /end REF_CHARACTERISTIC /begin IN_MEASUREMENT B_pwf B_sztesf /end IN_MEASUREMENT /begin OUT_MEASUREMENT B_rdytes crydldp crydtev DIMCTESausbits /end OUT_MEASUREMENT /begin LOC_MEASUREMENT /end LOC_MEASUREMENT /begin SUB_FUNCTION /end SUB_FUNCTION /end FUNCTION
/begin FUNCTION DISTAB12 "" /begin DEF_CHARACTERISTIC EBEN EBMISS_T EBMISS_Y /end DEF_CHARACTERISTIC /begin REF_CHARACTERISTIC /end REF_CHARACTERISTIC /begin IN_MEASUREMENT /end IN_MEASUREMENT
 /begin OUT_MEASUREMENT B_ebDavT B_ebDavY ebCtrNewT ebCtrNewY ebCtrOldT ebCtrOldY ebMissT ebMissY /end OUT_MEASUREMENT
 /begin LOC_MEASUREMENT /end LOC_MEASUREMENT
 /begin SUB_FUNCTION /end SUB_FUNCTION
/end FUNCTION
/begin FUNCTION DKATSP "1.160     Katalysatordiagnose durch Gemischsprung"
 /begin DEF_CHARACTERISTIC APKTDI APKTDIT APKTDX AVKATFS CIDKATSP CIDKATSPI CIDKATSPT CWDKATSP DMRKTDS_0_A DMRKTDS_1_A FIKTD FKTDAVK FKTDFE FKTDFET KFOSCTM LAKTDEO LAKTDEU LKTDF LKTDFT LKTDM LKTDMT OSCKTD OSCKTDNG OSCKTDT TMAXKATA TMSUKTDS TVKTDLE TVKTDRX USHKTDM USHKTDR USHKTDRX /end DEF_CHARACTERISTIC
 /begin REF_CHARACTERISTIC /end REF_CHARACTERISTIC
 /begin IN_MEASUREMENT B_cdkatsp B_dktb B_dktkas B_fakat B_pwf B_vekatv ilmltkx_w imllaka_w lamzak_w msabg_w tikatm tikatm_w tmst ushk /end IN_MEASUREMENT
 /begin OUT_MEASUREMENT avkatf B_dkifma B_dktens B_lamdkt B_vekat B_vekati dkatspAusBits dkatspAusBits20ms dkatspAusBits20ms_2 dkatspAusBitsNov dkatspAusBitsNov_2 dkatspAusBits_2 dmrdkt_w lamdkt_w m6aktsp m6cktsp m6sktsp_w m6wktsp_w oscdktf_w /end OUT_MEASUREMENT
 /begin LOC_MEASUREMENT apdkt apdkti apedkts apzdkt B_dkifm B_dktle B_dktm B_dktme B_dktr B_dktre B_edkt B_elshvdk B_elsvdk2 B_ildkt B_tmsdkt B_zdkt B_zkat dkatspLokBits dkatspLokBits20ms dkatspLokBits20ms_2 dkatspLokBits_2 fgdkt_w ldktmev_w ldktme_w mlfdkt_w mlldkt_w oscdkta_w oscdktm_w oscdktn_w oscdktr_w oscdkts_w oscdktt_w oscdkt_w oscmnd_w oscmn_w oscmxd_w oscmx_w tikatmu_w /end LOC_MEASUREMENT
 /begin SUB_FUNCTION DFPM_DKATSP /end SUB_FUNCTION
/end FUNCTION
/begin FUNCTION DKATSPEB "1.20      Einschaltbedingungen der Katalysatordiagnose"
 /begin DEF_CHARACTERISTIC CWKATSLK DMLKTDO DTKTDGRAX FKTDGTV MLKTDO_0_A MLKTDO_1_A MLKTDOO_0_A MLKTDOO_1_A MLKTDOT_0_A MLKTDOT_1_A MLKTDU_0_A MLKTDU_1_A MLKTDUO_0_A MLKTDUO_1_A MLKTDUT_0_A MLKTDUT_1_A NKTDOT NKTDUT TKTDGRA TKTDSP TMAXKATS TMAXKATSO TMINKATS TMINKATSO TMNKATST TMXKATST TSKTDTK TWDKATS ZKTDML ZKTDTK /end DEF_CHARACTERISTIC
 /begin REF_CHARACTERISTIC TMSUKTDS /end REF_CHARACTERISTIC
 /begin IN_MEASUREMENT B_cdkatsp B_cdkatspf B_cdkatspt B_dkifma B_dktens B_dsls B_dtes B_edkvs B_fa B_fakat B_frmax B_frmin B_lamdkt B_lr B_lrka B_lshswok B_mdarv B_mdkat B_nswo2 B_sbbhk B_sls B_stend B_tehb B_ukg B_vekati lamdkt_w lamsons_w msabg_w nmot tikatm tmst /end IN_MEASUREMENT
 /begin OUT_MEASUREMENT B_dktb B_dktkas B_dktsbs B_dktsps B_vekatv /end OUT_MEASUREMENT
 /begin LOC_MEASUREMENT B_binsti B_binstop B_dktgtv B_dktn B_dkttks B_dktts B_elshvdkt B_lshswos B_mldkt B_sbbhku mldkthp_w tikatmu tkdktg tkdkthps tkdktold tsdkttk_w /end LOC_MEASUREMENT
 /begin SUB_FUNCTION /end SUB_FUNCTION
/end FUNCTION
/begin FUNCTION DKMTR "1.40      Diagnose Kühlmittel-Temperatur-Regelung"
 /begin DEF_CHARACTERISTIC ANZFEHLER IKMTR JKMTR KUBERROR KUBHEAL LAERROR LAHEAL NEGABW POSABW THLKSLUE1 THLKSLUE2 TMN1DlUE1 TMN2DLUE1 TMN3DLUE1 TMNKSLUE1 UBKLEMN UBKLEMX /end DEF_CHARACTERISTIC
 /begin REF_CHARACTERISTIC /end REF_CHARACTERISTIC
 /begin IN_MEASUREMENT B_kl15 ubsq /end IN_MEASUREMENT
 /begin OUT_MEASUREMENT dkmtrLokBits /end OUT_MEASUREMENT
 /begin LOC_MEASUREMENT bitbuffer B_ks_1 B_kub B_la B_toggle CountMax_DKMTR_IMPL CountMin_DKMTR_IMPL CountSig_DKMTR_IMPL decj_alt fehlerarray maxError minError sigError tkslue1 tkslue1h tksluetmp /end LOC_MEASUREMENT
 /begin SUB_FUNCTION DFPM_dkmtr INDEX_dkmtr /end SUB_FUNCTION
/end FUNCTION
/begin FUNCTION DKRA "6.40      Diagnose; Klopfregelanschlag" /begin DEF_CHARACTERISTIC DKRAMX DKRAZ NDKRA /end DEF_CHARACTERISTIC /begin REF_CHARACTERISTIC /end REF_CHARACTERISTIC /begin IN_MEASUREMENT B_kl B_kr B_krwa B_pwf nmot tpnt_aktiv zzylkr /end IN_MEASUREMENT /begin OUT_MEASUREMENT flmxctr /end OUT_MEASUREMENT /begin LOC_MEASUREMENT dkractr /end LOC_MEASUREMENT /begin SUB_FUNCTION /end SUB_FUNCTION /end FUNCTION
/begin FUNCTION DKRNT "11.10     Diagnose; Klopfregelung, Nulltest (OBDII)" /begin DEF_CHARACTERISTIC CWDKRNT CWDKROF DKROFN DKROKU KRFHT UDKRGOFS /end DEF_CHARACTERISTIC /begin REF_CHARACTERISTIC DKROKD /end REF_CHARACTERISTIC /begin IN_MEASUREMENT B_dnt B_pwf B_stend igod_w ikrma nmot tmfln_w tpnt_aktiv /end IN_MEASUREMENT /begin OUT_MEASUREMENT xzskrnt xzskrof /end OUT_MEASUREMENT /begin LOC_MEASUREMENT xzkrznt xzkrzof /end LOC_MEASUREMENT /begin SUB_FUNCTION /end SUB_FUNCTION /end FUNCTION
/begin FUNCTION DKRS "30.20     Diagnose; Klopfsensor (OBDII)"
 /begin DEF_CHARACTERISTIC CWDKS1 CWDKS2 CWDKS3 CWDKS4 KRFHKS NDKS NDKSBET UDKSNO UDKSNU /end DEF_CHARACTERISTIC
 /begin REF_CHARACTERISTIC SNM16KRUB /end REF_CHARACTERISTIC
 /begin IN_MEASUREMENT B_fakrs B_kr B_krfdks B_krldy B_krndy B_pwf B_tmkr esst_snm16krub ks_sym nmot rkr sen_c95 vkr /end IN_MEASUREMENT
 /begin OUT_MEASUREMENT B_ds rkrn_w udksnoa_w udksnua_w xzkrzs xzsen /end OUT_MEASUREMENT
 /begin LOC_MEASUREMENT /end LOC_MEASUREMENT
 /begin SUB_FUNCTION /end SUB_FUNCTION
/end FUNCTION
/begin FUNCTION DKRTP "11.10     Diagnose; Klopfregelung, Testimpuls (OBDII)" /begin DEF_CHARACTERISTIC CWDKRTP UDKRTP /end DEF_CHARACTERISTIC /begin REF_CHARACTERISTIC KRFHT /end REF_CHARACTERISTIC /begin IN_MEASUREMENT B_dtp B_pwf ikrma ikrmet tpnt_aktiv /end IN_MEASUREMENT /begin OUT_MEASUREMENT xzskrtp /end OUT_MEASUREMENT /begin LOC_MEASUREMENT xzkrztp /end LOC_MEASUREMENT /begin SUB_FUNCTION /end SUB_FUNCTION /end FUNCTION
/begin FUNCTION DKUPPL "1.40      Diagnose Kupplungsschalter" /begin DEF_CHARACTERISTIC AGANGW AKUPPLB TDKUPNOG VDKUPPLMN /end DEF_CHARACTERISTIC /begin REF_CHARACTERISTIC /end REF_CHARACTERISTIC /begin IN_MEASUREMENT B_autget B_brems B_lsd gangi S_kupp vfzg /end IN_MEASUREMENT /begin OUT_MEASUREMENT anzgangw anzkupplb B_gangok /end OUT_MEASUREMENT /begin LOC_MEASUREMENT /end LOC_MEASUREMENT /begin SUB_FUNCTION /end SUB_FUNCTION /end FUNCTION
/begin FUNCTION DKVS "17.100    Diagnose; Plausibilitätsprüfung Kraftstoffversorgungssysteme"
 /begin DEF_CHARACTERISTIC CPLRA CWDKVSS DFRMST FRAE FRAODN FRAODX FRAUDN FRAUDX FRMSTDN FRMSTDX IMLKVSMX MLDKVSF MLDKVSG RKAE RKATDN RKATDX RKAZDN RKAZDX TFRA TFRAOZ TFRAUZ TFRMST TFRMZST TMFRST TRKA TRKATZ TRKAZZ ZFRMST /end DEF_CHARACTERISTIC
 /begin REF_CHARACTERISTIC /end REF_CHARACTERISTIC
 /begin IN_MEASUREMENT B_cdkvs B_fa B_fakvs B_falra B_frao B_frau B_fraur B_lr B_lra B_lrare B_nofra B_norkat B_norkaz B_pwf B_rkat B_rkatr B_rkaz B_rkazr B_sa B_tal B_talval B_te cd_bits1_w frao_w frau_w frm_w ml rkat_w rkaz_w tmot /end IN_MEASUREMENT
 /begin OUT_MEASUREMENT B_dkvsf B_dkvstr B_edkvs B_gae B_gaefra B_gaefra2 B_kvsffl /end OUT_MEASUREMENT
 /begin LOC_MEASUREMENT B_dkvsef B_dkvsfm B_dkvszf B_efrao B_efrau B_erkat B_erkaz B_frste B_gaeing B_gaeing2 B_imlkvse B_norkam B_plra B_rkam B_rkamr B_zfrao B_zfrau B_zrkat B_zrkaz DKVSbits DKVSlokbits frauzs_w imlkvszs_w imlkvs_w rkamzs_w rkam_w /end LOC_MEASUREMENT
 /begin SUB_FUNCTION /end SUB_FUNCTION
/end FUNCTION
/begin FUNCTION DLDE "7.10      Diagnose LDR-Endstufe" /begin DEF_CHARACTERISTIC /end DEF_CHARACTERISTIC /begin REF_CHARACTERISTIC /end REF_CHARACTERISTIC /begin IN_MEASUREMENT B_desee ldtvm /end IN_MEASUREMENT /begin OUT_MEASUREMENT /end OUT_MEASUREMENT /begin LOC_MEASUREMENT /end LOC_MEASUREMENT /begin SUB_FUNCTION /end SUB_FUNCTION /end FUNCTION
/begin FUNCTION DLDP "OBD II, Tankentlüftungsdiagnosemodul"
 /begin DEF_CHARACTERISTIC APULSMX BLDPMX CLDPAAV CLDPTVC CWBAESEL CWDLDP DELTATA DKLDPN DKTLMT DPUBABMX DPUFFMN DPUFFMX DPUFVMN DPUFVSMN DRLFFMX DTMFFU DTMLDP DTPLDP DTPXF DVBABFF DVFZBAB FPUPT HLDPU KFFLTA KFGLTA KFTXFTA KFXFTA MSTELDP RL1FGV RL1GV RL2FGV RL2GV RL3FGV RL3GV RL4FGV RL4GV RL5FGV RL5GV RL6FGV RL6GV RLBABMX RLLDPMX SVF06D_UB TAFFO TAFLDPO TALDPO TALDPU TC6LDPC1 TC6LDPC2 TC6LDPC3 TC6LDPC4 TC6LDPC5 TEVCKMX TIZUMN TLDP1SD TLDP2SD TLDPMN TLDPMX TLDPRKL TLDPRKO TLDPZMN TMFFO TMLDPO TMLDPU TPFIFOANZ TPTEVMN TPUPH TRKAUF TSLDPV TSRFPAB TSTZUMN TTOTLDP TVFZDIF TVLDPMN TVLDPT TVTEVMN TXFMX VALDPMN VLDPMN VLDPO VLDPU VSLDPMN WZLDPD WZLDPGS WZLDPMX WZLDPRO ZRLBAB /end DEF_CHARACTERISTIC
 /begin REF_CHARACTERISTIC /end REF_CHARACTERISTIC
 /begin IN_MEASUREMENT bfzgl_w B_autget B_cdldp B_dtes B_fa B_faldp B_fs B_ldpi B_lrar B_m8te B_nmin B_puerr B_pwf B_st B_stend B_tef B_tep cd_bits1_w fho ftefsoll_w gangi mstedte_w mstesoll_w nmot ps_w pukorf_w pu_w rl rl_w tans tateout tmot tmotab vfzg wdkba /end IN_MEASUREMENT
 /begin OUT_MEASUREMENT B_aav B_dldpte B_ldp B_sztesf B_tevioi B_teviot B_teza esst_svf06d_ub tc6ldpc tc6ldps tc6ldpw tispldpx_w tispldp_w tpldptcx_w tpldptc_w /end OUT_MEASUREMENT
 /begin LOC_MEASUREMENT anzpuls B_bergab B_bergabd B_bergabl B_bergxf B_bergxfd B_bergxfl B_bxf1 B_bxf2 B_bxf3 B_bxf4 B_bxf5 B_bxf6 B_bxf7 B_bxf8 B_bxf9 B_dldp B_dldpf B_dpumn B_dteven B_errldp B_extaav B_faldpa B_fev1 B_fev10 B_fev11 B_fev12 B_fev13 B_fev2 B_fev3 B_fev4 B_fev5 B_fev6 B_fev7 B_fev8 B_fev9 B_fpchk B_ispuel B_ldpabb B_ldpf1 B_ldpf2 B_ldpf5 B_ldpf6 B_ldpf7 B_ldpflv B_ldpglv B_messe B_prxf B_rkack B_rkcke B_rkzck B_tepldp B_tpstab B_xfstab ctr_fein ctr_feinst DLDPlokbits1 DLDPlokbits2 DLDPlokbits3 DLDPlokbits4 dpu_w drlldp_w dtmast dvbab flgxfb fppcnt fpper fpuls fvdldp imsteldp modeldp modeldp_old pumem_w rlbab rlbabxf rlf rsmcnt rsmcntd rsmcntg stptr taldpst tdaufp tfpg timaldp timfp timldp timrs timtev timzldp tispuel tldktim tldpein tldppmw tpfifo tpmeanv_w trklow tvfzctr wzcto /end LOC_MEASUREMENT
 /begin SUB_FUNCTION /end SUB_FUNCTION
/end FUNCTION
/begin FUNCTION DLDPE "5.50      Endstufendiagnose; Überdruckpumpe der Tank-Leck-Diagnose"
 /begin DEF_CHARACTERISTIC TDLDPE TWDLDPE TWLDPE UBDOLDPE UBDULDPE ULDPEMN ULDPEMX ZKDXLDPE /end DEF_CHARACTERISTIC
 /begin REF_CHARACTERISTIC /end REF_CHARACTERISTIC
 /begin IN_MEASUREMENT B_airbag B_kl15 B_ldp B_nmot B_stend ub uldpe /end IN_MEASUREMENT
 /begin OUT_MEASUREMENT B_ldpe B_ldpelok /end OUT_MEASUREMENT
 /begin LOC_MEASUREMENT B_mnld B_mxld B_sild /end LOC_MEASUREMENT
 /begin SUB_FUNCTION /end SUB_FUNCTION
/end FUNCTION
/begin FUNCTION DLDR "2.140     Diagnose LDR"
 /begin DEF_CHARACTERISTIC DLUL EDLDRP FVMXLDRA FVPDKLDL FVPDKLDS FVPDKLDUS KFDLULS KFVPDKLD LKVDKNMN NDLDRAPU SDLDRAH SDLDRAS SDLDRL SRLLKH SSRLKVDK TDLDRA TDLDRA2 TDLKVDKH TDLKVDKL TDLKVDKLL TDLKVDKS TDLKVDKST TDLKVDKT TLDRA TULV1 TULV3 TVLDIMX /end DEF_CHARACTERISTIC
 /begin REF_CHARACTERISTIC /end REF_CHARACTERISTIC
 /begin IN_MEASUREMENT B_asr B_fgren B_ldob B_ldr B_ll B_mszsdkb B_stend ftefsoll_w lde ldimxak_w nmot plsol pspvds_w pu rl_w tmot wdkba /end IN_MEASUREMENT
 /begin OUT_MEASUREMENT B_dynsp B_ldra /end OUT_MEASUREMENT
 /begin LOC_MEASUREMENT B_erl B_ladan B_mxaok pspvdsmx /end LOC_MEASUREMENT
 /begin SUB_FUNCTION DFPM_DLDR INDEX_DLDR /end SUB_FUNCTION
/end FUNCTION
/begin FUNCTION DLDUV "1.40      Diagnose Schubumluftventil beim Turbomotor"
 /begin DEF_CHARACTERISTIC CWDLDUV DLDUVES DPULSUV ELDUVCLR ELDUVSET PULSUV TMFDUV TMMZUV /end DEF_CHARACTERISTIC
 /begin REF_CHARACTERISTIC /end REF_CHARACTERISTIC
 /begin IN_MEASUREMENT B_ldsua B_neglgrd dfuelsan_w pvdkds_w /end IN_MEASUREMENT
 /begin OUT_MEASUREMENT B_messf B_pulsa B_uefgab pulsct pulscthld /end OUT_MEASUREMENT
 /begin LOC_MEASUREMENT /end LOC_MEASUREMENT
 /begin SUB_FUNCTION DFPM_DLDUV INDEX_DLDUV /end SUB_FUNCTION
/end FUNCTION
/begin FUNCTION DLDUVSE "2.10      Diagnose Endstufe Umluftventil Turbo" /begin DEF_CHARACTERISTIC /end DEF_CHARACTERISTIC /begin REF_CHARACTERISTIC /end REF_CHARACTERISTIC /begin IN_MEASUREMENT B_desee B_ldsua /end IN_MEASUREMENT /begin OUT_MEASUREMENT /end OUT_MEASUREMENT /begin LOC_MEASUREMENT /end LOC_MEASUREMENT /begin SUB_FUNCTION /end SUB_FUNCTION /end FUNCTION
/begin FUNCTION DLLR "28.120    Diagnose: Leerlaufregelung Erkennung blockierter Steller"
 /begin DEF_CHARACTERISTIC DASA DNDLLRO DNDLLRU FHDLLR RLMDVERL TADLLR TDLLR TDLLRMN TDLLRMX TDLLRNF TFDLLRO TFDLLRU TMDLLR /end DEF_CHARACTERISTIC
 /begin REF_CHARACTERISTIC /end REF_CHARACTERISTIC
 /begin IN_MEASUREMENT B_cdllr B_dknolu B_dkpu B_dsls B_dtes B_ll B_llr B_lrar B_nldg B_nmot B_nswo1 B_sa B_st B_tehb cd_bits2_w dmllri_w dns fho limax_w limin_w mdverl_w rl tans tmot tnse_w vfzg /end IN_MEASUREMENT
 /begin OUT_MEASUREMENT B_dllr B_dllra /end OUT_MEASUREMENT
 /begin LOC_MEASUREMENT B_lldia /end LOC_MEASUREMENT
 /begin SUB_FUNCTION /end SUB_FUNCTION
/end FUNCTION
/begin FUNCTION DLSAHK "12.80     Lambdasondenalterungsüberwachung hinter KAT"
 /begin DEF_CHARACTERISTIC ANZDYNSH CWDLSAHK DLAMLASHF DLAMLASHM DMRLASH KMXSTG KTLAMSTEIG LAMLASHMIN LAMSONSVL LAMSTEIG MLLASH MLOSTEST MLUSSTG MLUSTEST MLUSVL SMLDYN TABGSTGK TLLASH TRIPFASH TSALASH TTLASH TUSCHUB TUSENLASH TUSHKRFM TUSHKVL TUSHSMIN TUSLASH TUSMSVL TUSSA TUSTALLASH USHKVL USHLEAN USHRICH USHSTGMX USHSTSOLL USSCHUB /end DEF_CHARACTERISTIC
 /begin REF_CHARACTERISTIC /end REF_CHARACTERISTIC
 /begin IN_MEASUREMENT B_cdlash B_cwlshdyn B_cwlshsch B_cwlshvl B_dsls B_dtest B_edkvs B_evloc B_fa B_fash B_lr B_lrhk B_lrhkp B_lsh B_mdarv B_pwf B_sa B_sbbhk B_tal B_talval B_vlsumrb cd_bits2_w lamsbg_w lamsons_w ml_w tahsom_w ushk usrhk /end IN_MEASUREMENT
 /begin OUT_MEASUREMENT B_ddylash B_dlash B_dshk B_dushsch B_enfmst B_enlash B_entest B_lamend B_lamlash B_lamverg B_lsahksp B_lshswok B_minlash B_mldyn B_mlustest B_nolash B_steigm B_teslash B_trfash B_ushkf B_ushkm dmrlash_w lamlash_w mldyn_w ushfmxstg ushkmxstg ushksteig zlash_w zwdynsh /end OUT_MEASUREMENT
 /begin LOC_MEASUREMENT B_abgstg B_dlams B_dushkvl B_dylash B_enmaxla B_ktrlash B_maxla B_maxlash B_npllash B_sbbhkv B_siglash B_uscherf B_ushkrfm B_ushkvl B_ushsch B_usrhkmx dlams_w intlash_w lamtrip_w usrhkmx usrhks /end LOC_MEASUREMENT
 /begin SUB_FUNCTION /end SUB_FUNCTION
/end FUNCTION
/begin COMPU_METHOD bfzg_sw_q4p239Em4 "" RAT_FUNC "%10.7" "m/s^2" COEFFS 0 1 0 0 0 0.0004239 /end COMPU_METHOD
/begin COMPU_METHOD B_TRUE "boolsche Zustände, positive Logik" TAB_VERB "%6.3" "" COMPU_TAB_REF B_TRUE /end COMPU_METHOD
/begin COMPU_VTAB B_TRUE "boolsche Zustände, positive Logik" TAB_VERB 2 0 "----" 1 "TRUE" /end COMPU_VTAB
/begin COMPU_METHOD DEZ "1 : 1 Umrechnug (dez/hex)" RAT_FUNC "%6.2" "" COEFFS 0 1 0 0 0 1 /end COMPU_METHOD
/begin COMPU_METHOD dez "1 : 1 Umrechnug (dez/hex)" RAT_FUNC "%6.2" "" COEFFS 0 1 0 0 0 1 /end COMPU_METHOD
/begin COMPU_METHOD fak_q0p1 "" RAT_FUNC "%6.3" "" COEFFS 0 1 0 0 0 0.1 /end COMPU_METHOD
/begin COMPU_METHOD fak_sb_b1 "" RAT_FUNC "%6.4" "-" COEFFS 0 256 0 0 0 2 /end COMPU_METHOD
/begin COMPU_METHOD fak_sw_b1 "" RAT_FUNC "%7.6" "-" COEFFS 0 65536 0 0 0 2 /end COMPU_METHOD
/begin COMPU_METHOD fak_ub_b1 "" RAT_FUNC "%6.4" "-" COEFFS 0 256 0 0 0 1 /end COMPU_METHOD
/begin COMPU_METHOD fak_ub_b16 "" RAT_FUNC "%6.4" "-" COEFFS 0 256 0 0 0 16 /end COMPU_METHOD
/begin COMPU_METHOD fak_ub_b2 "" RAT_FUNC "%6.4" "-" COEFFS 0 256 0 0 0 2 /end COMPU_METHOD
/begin COMPU_METHOD fak_ub_b4 "" RAT_FUNC "%6.4" "-" COEFFS 0 256 0 0 0 4 /end COMPU_METHOD
/begin COMPU_METHOD fak_ub_b64 "" RAT_FUNC "%6.3" "-" COEFFS 0 256 0 0 0 64 /end COMPU_METHOD
/begin COMPU_METHOD fak_ub_b8 "" RAT_FUNC "%6.4" "-" COEFFS 0 256 0 0 0 8 /end COMPU_METHOD
/begin COMPU_METHOD fak_ub_q0p01 "" RAT_FUNC "%6.4" "-" COEFFS 0 1 0 0 0 0.01 /end COMPU_METHOD
/begin COMPU_METHOD fak_uw_b0p5 "" RAT_FUNC "%8.7" "-" COEFFS 0 65536 0 0 0 0.5 /end COMPU_METHOD
/begin COMPU_METHOD fak_uw_b1 "" RAT_FUNC "%7.6" "-" COEFFS 0 65536 0 0 0 1 /end COMPU_METHOD
/begin COMPU_METHOD fak_uw_b128 "" RAT_FUNC "%6.4" "-" COEFFS 0 65536 0 0 0 128 /end COMPU_METHOD
/begin COMPU_METHOD fak_uw_b16 "" RAT_FUNC "%6.5" "-" COEFFS 0 65536 0 0 0 16 /end COMPU_METHOD
/begin COMPU_METHOD fak_uw_b2 "" RAT_FUNC "%7.6" "-" COEFFS 0 65536 0 0 0 2 /end COMPU_METHOD
/begin COMPU_METHOD fak_uw_b4 "" RAT_FUNC "%7.6" "-" COEFFS 0 65536 0 0 0 4 /end COMPU_METHOD
/begin COMPU_METHOD mk_q1p56Em3 "" RAT_FUNC "%6.4" "kg/h*s" COEFFS 0 65536 0 0 0 102.4 /end COMPU_METHOD
/begin COMPU_METHOD m_q0p00277 "" RAT_FUNC "%6.4" "g" COEFFS 0 360 0 0 0 1 /end COMPU_METHOD
/begin COMPU_METHOD m_q0p00355 "" RAT_FUNC "%6.4" "kg" COEFFS 0 1125 0 0 0 4 /end COMPU_METHOD
/begin COMPU_METHOD m_q0p1 "" RAT_FUNC "%6.3" "kg/h" COEFFS 0 10 0 0 0 1 /end COMPU_METHOD
/begin COMPU_METHOD m_q0p1_mg "" RAT_FUNC "%6.3" "mg" COEFFS 0 1 0 0 0 0.1 /end COMPU_METHOD
/begin COMPU_METHOD m_ub_b1020 "" RAT_FUNC "%6.2" "kg/h" COEFFS 0 1 0 0 0 4 /end COMPU_METHOD
/begin COMPU_METHOD m_ub_q0p0444 "" RAT_FUNC "%6.4" "g" COEFFS 0 1 0 0 0 0.0444 /end COMPU_METHOD
/begin COMPU_METHOD m_uw_b102p4 "" RAT_FUNC "%6.4" "kg/h" COEFFS 0 65536 0 0 0 102.4 /end COMPU_METHOD
/begin COMPU_METHOD m_uw_b6553p5 "" RAT_FUNC "%6.3" "kg/h" COEFFS 0 1 0 0 0 0.1 /end COMPU_METHOD
/begin COMPU_METHOD nmot_ub_q10 "" RAT_FUNC "%6.1" "U/min" COEFFS 0 1 0 0 0 10 /end COMPU_METHOD
/begin COMPU_METHOD nmot_ub_q40 "" RAT_FUNC "%6.1" "Upm" COEFFS 0 1 0 0 0 40 /end COMPU_METHOD
/begin COMPU_METHOD p_sb_q10 "" RAT_FUNC "%6.1" "hPa" COEFFS 0 1 0 0 0 10 /end COMPU_METHOD
/begin COMPU_METHOD p_ub_q10 "" RAT_FUNC "%6.1" "hPa" COEFFS 0 1 0 0 0 10 /end COMPU_METHOD
/begin COMPU_METHOD p_ub_q5 "" RAT_FUNC "%6.2" "hPa" COEFFS 0 1 0 0 0 5 /end COMPU_METHOD
/begin COMPU_METHOD p_uw_q0p039 "" RAT_FUNC "%6.4" "hPa" COEFFS 0 256 0 0 0 10 /end COMPU_METHOD
/begin COMPU_METHOD p_uw_q0p078 "" RAT_FUNC "%6.4" "hpa" COEFFS 0 256 0 0 0 20 /end COMPU_METHOD
/begin COMPU_METHOD relDK_q0p02441 "" RAT_FUNC "%6.4" "% DK" COEFFS 0 65536 0 0 0 1600 /end COMPU_METHOD
/begin COMPU_METHOD relDK_ub_b100 "" RAT_FUNC "%6.3" "% DK" COEFFS 0 255 0 0 0 100 /end COMPU_METHOD
/begin COMPU_METHOD rel_sw_b1536 "" RAT_FUNC "%6.4" "%" COEFFS 0 65536 0 0 0 3072 /end COMPU_METHOD
/begin COMPU_METHOD rel_sw_q0p0234 "" RAT_FUNC "%6.4" "%/seg" COEFFS 0 32 0 0 0 0.75 /end COMPU_METHOD
/begin COMPU_METHOD rel_ub_b99p6 "" RAT_FUNC "%6.3" "%" COEFFS 0 256 0 0 0 100 /end COMPU_METHOD
/begin COMPU_METHOD rel_ub_q0p75 "" RAT_FUNC "%6.3" "%" COEFFS 0 1 0 0 0 0.75 /end COMPU_METHOD
/begin COMPU_METHOD rel_uw_b100 "" RAT_FUNC "%6.4" "%" COEFFS 0 65536 0 0 0 100 /end COMPU_METHOD
/begin COMPU_METHOD rel_uw_b192 "" RAT_FUNC "%6.4" "%" COEFFS 0 65536 0 0 0 192 /end COMPU_METHOD
/begin COMPU_METHOD rel_uw_q0p0234 "" RAT_FUNC "%6.4" "%" COEFFS 0 32 0 0 0 0.75 /end COMPU_METHOD
/begin COMPU_METHOD r_q8 "" RAT_FUNC "%6.2" "Ohm" COEFFS 0 1 0 0 0 8 /end COMPU_METHOD
/begin COMPU_METHOD r_uw_q2 "" RAT_FUNC "%6.2" "Ohm" COEFFS 0 1 0 0 0 2 /end COMPU_METHOD
/begin COMPU_METHOD spgg_q0p52 "" RAT_FUNC "%6.3" "mV/ms" COEFFS 0 1 0 0 0 0.52 /end COMPU_METHOD
/begin COMPU_METHOD spg_q0p00039 "" RAT_FUNC "%6.5" "V" COEFFS 0 1 0 0 0 0.000390625 /end COMPU_METHOD
/begin COMPU_METHOD spg_q0p00488 "" RAT_FUNC "%6.4" "V" COEFFS 0 1024 0 0 0 5 /end COMPU_METHOD
/begin COMPU_METHOD spg_ubatt "" RAT_FUNC "%6.4" "V" COEFFS 0 1 0 0 0 0.0704 /end COMPU_METHOD
/begin COMPU_METHOD spg_ub_b5 "" RAT_FUNC "%6.4" "V" COEFFS 0 256 0 0 0 5 /end COMPU_METHOD
/begin COMPU_METHOD spg_ub_q0p0052_o0p2 "" RAT_FUNC "%6.3" "V" COEFFS 0 255 51 0 0 1.33 /end COMPU_METHOD
/begin COMPU_METHOD spg_ub_q0p019 "" RAT_FUNC "%6.4" "V" COEFFS 0 256 0 0 0 5 /end COMPU_METHOD
/begin COMPU_METHOD spg_uw_b1280 "" RAT_FUNC "%6.4" "V" COEFFS 0 1000 0 0 0 19.5313 /end COMPU_METHOD
/begin COMPU_METHOD t100msxs_ub_b25p5 "" RAT_FUNC "%6.3" "s" COEFFS 0 1 0 0 0 0.1 /end COMPU_METHOD
/begin COMPU_METHOD t100msxs_uw_b6553p5 "" RAT_FUNC "%6.3" "s" COEFFS 0 1 0 0 0 0.1 /end COMPU_METHOD
/begin COMPU_METHOD t10msxs_ub_b2p55 "" RAT_FUNC "%6.4" "s" COEFFS 0 1 0 0 0 0.01 /end COMPU_METHOD
/begin COMPU_METHOD t10msxs_uw_b655p35 "" RAT_FUNC "%6.4" "s" COEFFS 0 1 0 0 0 0.01 /end COMPU_METHOD
/begin COMPU_METHOD t1sxs_ub_b255 "" RAT_FUNC "%6.2" "s" COEFFS 0 1 0 0 0 1 /end COMPU_METHOD
/begin COMPU_METHOD t1sxs_uw_b65535 "" RAT_FUNC "%6.2" "s" COEFFS 0 1 0 0 0 1 /end COMPU_METHOD
/begin COMPU_METHOD t1sxs_uw_q1 "" RAT_FUNC "%6.2" "s" COEFFS 0 1 0 0 0 1 /end COMPU_METHOD
/begin COMPU_METHOD t200msxs_ub_b51 "" RAT_FUNC "%6.3" "s" COEFFS 0 1 0 0 0 0.2 /end COMPU_METHOD
/begin COMPU_METHOD t200msxs_uw_q0p2 "" RAT_FUNC "%6.3" "s" COEFFS 0 1 0 0 0 0.2 /end COMPU_METHOD
/begin COMPU_METHOD t20msxs_uw_b1310 "" RAT_FUNC "%6.4" "s" COEFFS 0 1 0 0 0 0.02 /end COMPU_METHOD
/begin COMPU_METHOD t20msxs_uw_q0p02 "" RAT_FUNC "%6.4" "s" COEFFS 0 1 0 0 0 0.02 /end COMPU_METHOD
/begin COMPU_METHOD t50msxs_ub_b12p75 "" RAT_FUNC "%6.4" "s" COEFFS 0 1 0 0 0 0.05 /end COMPU_METHOD
/begin COMPU_METHOD t50msxs_uw_b3276p75 "" RAT_FUNC "%6.4" "s" COEFFS 0 1 0 0 0 0.05 /end COMPU_METHOD
/begin COMPU_METHOD temp_q0p0234_o273 "" RAT_FUNC "%6.1" "Grad C" COEFFS 0 1 273.15 0 0 0.0234375 /end COMPU_METHOD
/begin COMPU_METHOD temp_sb_q0p75 "" RAT_FUNC "%6.3" "Grad C" COEFFS 0 1 0 0 0 0.75 /end COMPU_METHOD
/begin COMPU_METHOD temp_ub_q0p75 "" RAT_FUNC "%6.3" "Grad C" COEFFS 0 1 7.31383e-307 0 0 0.75 /end COMPU_METHOD
/begin COMPU_METHOD temp_ub_q0p75_o48 "" RAT_FUNC "%6.2" "Grad C" COEFFS 0 1 48 0 0 0.75 /end COMPU_METHOD
/begin COMPU_METHOD temp_ub_q5 "" RAT_FUNC "%6.2" "Grad C" COEFFS 0 1 0 0 0 5 /end COMPU_METHOD
/begin COMPU_METHOD temp_ub_q5_o50 "" RAT_FUNC "%6.2" "Grad C" COEFFS 0 1 50 0 0 5 /end COMPU_METHOD
/begin COMPU_METHOD temp_uw_q0p0195_o50 "" RAT_FUNC "%6.2" "Grad C" COEFFS 0 256 12800 0 0 5 /end COMPU_METHOD
/begin COMPU_METHOD tknockcon_sy "" RAT_FUNC "%8.7" "s" COEFFS 0 375000 0 0 0 1 /end COMPU_METHOD
/begin COMPU_METHOD tknockintgrad_sy "" RAT_FUNC "%6.3" "V/s" COEFFS 0 8.94855 0 0 0 1 /end COMPU_METHOD
/begin COMPU_METHOD ttemp_q0p04 "" RAT_FUNC "%6.4" "s / Grad C" COEFFS 0 1 0 0 0 0.04 /end COMPU_METHOD
/begin COMPU_METHOD tv_sw_q0p005 "" RAT_FUNC "%6.4" "%" COEFFS 0 1 0 0 0 0.005 /end COMPU_METHOD
/begin COMPU_METHOD t_q0p01 "" RAT_FUNC "%6.4" "s" COEFFS 0 100 0 0 0 1 /end COMPU_METHOD
/begin COMPU_METHOD t_q0p02 "" RAT_FUNC "%6.4" "s" COEFFS 0 100 0 0 0 2 /end COMPU_METHOD
/begin COMPU_METHOD t_q0p05 "" RAT_FUNC "%6.4" "s" COEFFS 0 100 0 0 0 5 /end COMPU_METHOD
/begin COMPU_METHOD t_q0p1 "" RAT_FUNC "%6.3" "s" COEFFS 0 10 0 0 0 1 /end COMPU_METHOD
/begin COMPU_METHOD t_q0p2 "" RAT_FUNC "%6.3" "s" COEFFS 0 10 0 0 0 2 /end COMPU_METHOD
/begin COMPU_METHOD vfzg_ub_q1p25 "" RAT_FUNC "%6.2" "km/h" COEFFS 0 1 0 0 0 1.25 /end COMPU_METHOD
/begin COMPU_METHOD zk100msxs_uw_b6553 "" RAT_FUNC "%12.4" "s" COEFFS 0 0 65536 0 10 0 /end COMPU_METHOD
/begin COMPU_METHOD zk10msxs_ub_b2p55 "" RAT_FUNC "%6.4" "s" COEFFS 0 0 255 0 100 0 /end COMPU_METHOD
/begin COMPU_METHOD zk200msxs_ub_b51p2 "" RAT_FUNC "%6.3" "s" COEFFS 0 0 255 0 5 0 /end COMPU_METHOD
/begin COMPU_METHOD zk50msxs_uw_b12p8 "" RAT_FUNC "%12.4" "s" COEFFS 0 0 32768 0 10 0 /end COMPU_METHOD
/begin COMPU_METHOD default "" RAT_FUNC "%6.2" "" COEFFS 0 1 0 0 0 1 /end COMPU_METHOD
/begin RECORD_LAYOUT GklWUb FNC_VALUES 1 UBYTE COLUMN_DIR DIRECT /end RECORD_LAYOUT
/begin RECORD_LAYOUT GklWUw FNC_VALUES 1 UWORD COLUMN_DIR DIRECT /end RECORD_LAYOUT
/begin RECORD_LAYOUT KfAxUbAyUbSstxSwSstyUbWSw NO_AXIS_PTS_X 1 UBYTE NO_AXIS_PTS_Y 2 UBYTE AXIS_PTS_X 3 SWORD INDEX_INCR DIRECT AXIS_PTS_Y 4 UBYTE INDEX_INCR DIRECT FNC_VALUES 5 SWORD COLUMN_DIR DIRECT /end RECORD_LAYOUT
/begin RECORD_LAYOUT KfAxUbAyUbSstxUbSstyUbWUb NO_AXIS_PTS_X 1 UBYTE NO_AXIS_PTS_Y 2 UBYTE AXIS_PTS_X 3 UBYTE INDEX_INCR DIRECT AXIS_PTS_Y 4 UBYTE INDEX_INCR DIRECT FNC_VALUES 5 UBYTE COLUMN_DIR DIRECT /end RECORD_LAYOUT
/begin RECORD_LAYOUT KfAxUbAyUbSstxUbSstyUwWUb NO_AXIS_PTS_X 1 UBYTE NO_AXIS_PTS_Y 2 UBYTE AXIS_PTS_X 3 UBYTE INDEX_INCR DIRECT AXIS_PTS_Y 4 UWORD INDEX_INCR DIRECT FNC_VALUES 5 UBYTE COLUMN_DIR DIRECT /end RECORD_LAYOUT
/begin RECORD_LAYOUT KfAxUbAyUbSstxUwSstyUbWUb NO_AXIS_PTS_X 1 UBYTE NO_AXIS_PTS_Y 2 UBYTE AXIS_PTS_X 3 UWORD INDEX_INCR DIRECT AXIS_PTS_Y 4 UBYTE INDEX_INCR DIRECT FNC_VALUES 5 UBYTE COLUMN_DIR DIRECT /end RECORD_LAYOUT
/begin RECORD_LAYOUT KfAxUbAyUbSstxUwSstyUwWUw NO_AXIS_PTS_X 1 UWORD NO_AXIS_PTS_Y 2 UWORD AXIS_PTS_X 3 UWORD INDEX_INCR DIRECT AXIS_PTS_Y 4 UWORD INDEX_INCR DIRECT FNC_VALUES 5 UWORD COLUMN_DIR DIRECT /end RECORD_LAYOUT
/begin RECORD_LAYOUT KlAUbSstUbWUb NO_AXIS_PTS_X 1 UBYTE AXIS_PTS_X 2 UBYTE INDEX_INCR DIRECT FNC_VALUES 3 UBYTE COLUMN_DIR DIRECT /end RECORD_LAYOUT
/begin RECORD_LAYOUT KlAUbSstUwWUb NO_AXIS_PTS_X 1 UWORD AXIS_PTS_X 2 UWORD INDEX_INCR DIRECT FNC_VALUES 3 UBYTE COLUMN_DIR DIRECT /end RECORD_LAYOUT
/begin RECORD_LAYOUT KlAUbSstUwWUw NO_AXIS_PTS_X 1 UWORD AXIS_PTS_X 2 UWORD INDEX_INCR DIRECT FNC_VALUES 3 UWORD COLUMN_DIR DIRECT /end RECORD_LAYOUT
/begin RECORD_LAYOUT KlAUwSstUwWUw NO_AXIS_PTS_X 1 UWORD AXIS_PTS_X 2 UWORD INDEX_INCR DIRECT FNC_VALUES 3 UWORD COLUMN_DIR DIRECT /end RECORD_LAYOUT
/begin RECORD_LAYOUT KwbUb FNC_VALUES 1 UBYTE COLUMN_DIR DIRECT /end RECORD_LAYOUT
/begin RECORD_LAYOUT KwbUw FNC_VALUES 1 UWORD COLUMN_DIR DIRECT /end RECORD_LAYOUT
/begin RECORD_LAYOUT KwSb FNC_VALUES 1 SBYTE COLUMN_DIR DIRECT /end RECORD_LAYOUT
/begin RECORD_LAYOUT KwSw FNC_VALUES 1 SWORD COLUMN_DIR DIRECT /end RECORD_LAYOUT
/begin RECORD_LAYOUT KwUb FNC_VALUES 1 UBYTE COLUMN_DIR DIRECT /end RECORD_LAYOUT
/begin RECORD_LAYOUT KwUw FNC_VALUES 1 UWORD COLUMN_DIR DIRECT /end RECORD_LAYOUT
/begin RECORD_LAYOUT SstAUbSstUb NO_AXIS_PTS_X 1 UBYTE AXIS_PTS_X 2 UBYTE INDEX_INCR DIRECT /end RECORD_LAYOUT
/end MODULE
/end PROJECT
