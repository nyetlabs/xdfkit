/begin PROJECT X505S24EX "4016.32"
/begin HEADER "" VERSION "X505S24EX" PROJECT_NO X505S24EX /end HEADER
/begin MODULE DIM ""
/begin MOD_COMMON "" BYTE_ORDER BIG_ENDIAN S_REC_LAYOUT DAMOS /end MOD_COMMON
/begin CHARACTERISTIC KFMDKHLL_0_A "Kennfeld Drehmomentenreserve für Katheizen bei LL" MAP 0x81F08C KfAxUwAyUwSstxUwSstyUwWUw 99.99847 rel_uw_b100 0.00 99.99847 FUNCTION_LIST KHMD IF_DATA DIM_X INDIRECT 0x815CD6
 /begin AXIS_DESCR STD_AXIS nmot_w nmot_uw_q0p25 8 0.00 16383.75 DEPOSIT ABSOLUT /end AXIS_DESCR
 /begin AXIS_DESCR STD_AXIS mifakh_w rel_uw_b100 8 0.00 99.99847 DEPOSIT ABSOLUT /end AXIS_DESCR
/end CHARACTERISTIC
/begin CHARACTERISTIC KFMDKHLL_1_A "Kennfeld Drehmomentenreserve für Katheizen bei LL" MAP 0x81F1D4 KfAxUwAyUwSstxUwSstyUwWUw 99.99847 rel_uw_b100 0.00 99.99847 FUNCTION_LIST KHMD IF_DATA DIM_X INDIRECT 0x815CDA
 /begin AXIS_DESCR STD_AXIS nmot_w nmot_uw_q0p25 8 0.00 16383.75 DEPOSIT ABSOLUT /end AXIS_DESCR
 /begin AXIS_DESCR STD_AXIS mifakh_w rel_uw_b100 8 0.00 99.99847 DEPOSIT ABSOLUT /end AXIS_DESCR
/end CHARACTERISTIC
/begin CHARACTERISTIC KFMDKO "Drehmomentaufnahme Klimakompressor" MAP 0x81A182 GkfWUb 49.80 rel_q0p1953 0.00 49.80 FUNCTION_LIST MDVERB IF_DATA DIM_X DIRECT 0x81A182
 /begin AXIS_DESCR COM_AXIS nmot nmot_ub_q40 6 0.00 10200. AXIS_PTS_REF SNM06KOUB /end AXIS_DESCR
 /begin AXIS_DESCR COM_AXIS tlok temp_ub_q0p75_o48 6 -48.00 143.3 AXIS_PTS_REF STA06LLUB /end AXIS_DESCR
/end CHARACTERISTIC
/begin CHARACTERISTIC KFMDRKO "Kennfeld: Klimakompressormoment abh. von rl, nmot" MAP 0x81A1A6 GkfWUb 49.80 rel_q0p1953 0.00 49.80 FUNCTION_LIST MDVERB IF_DATA DIM_X DIRECT 0x81A1A6
 /begin AXIS_DESCR COM_AXIS nmot nmot_ub_q40 6 0.00 10200. AXIS_PTS_REF SNM06KOUB /end AXIS_DESCR
 /begin AXIS_DESCR COM_AXIS rl rel_ub_q0p75 6 0.00 191.3 AXIS_PTS_REF SRL06KOUB /end AXIS_DESCR
/end CHARACTERISTIC
/begin CHARACTERISTIC KFMDRKOE "Kennfeld: Klimakompressormoment dyn. Anteil abh. von rl, nmot" MAP 0x81A1CA GkfWSb 99.60 rel_sb_q0p39 -50.00 49.61 FUNCTION_LIST MDVERB IF_DATA DIM_X DIRECT 0x81A1CA
 /begin AXIS_DESCR COM_AXIS nmot nmot_ub_q40 6 0.00 10200. AXIS_PTS_REF SNM06KOUB /end AXIS_DESCR
 /begin AXIS_DESCR COM_AXIS rl rel_ub_q0p75 6 0.00 191.3 AXIS_PTS_REF SRL06KOUB /end AXIS_DESCR
/end CHARACTERISTIC
/begin CHARACTERISTIC KFMDS "Schleppmoment Drehzahl- und Lastabhängigkeit" MAP 0x82933A GkfWUw 99.99847 rel_uw_b100 0.00 99.99847 FUNCTION_LIST MDVER IF_DATA DIM_X DIRECT 0x82933A
 /begin AXIS_DESCR COM_AXIS nmot_w nmot_uw_q0p25 16 0.00 16383.75 AXIS_PTS_REF SNM16OPUW /end AXIS_DESCR
 /begin AXIS_DESCR COM_AXIS rl_w rel_uw_q0p0234 11 0.00 1535.977 AXIS_PTS_REF SRL11OPUW /end AXIS_DESCR
/end CHARACTERISTIC
/begin CHARACTERISTIC KFMDWMX "Max. Begrenzung für Drehmomentaufnahme des Wandlers" MAP 0x811DC2 KfAxUbAyUbSstxUbSstyUbWUb 99.61 rel_ub_b99p6 0.00 99.61 FUNCTION_LIST MDWAN IF_DATA DIM_X DIRECT 0x811DC2 /begin AXIS_DESCR STD_AXIS vfzg vfzg_ub_q1p25 6 0.00 318.8 DEPOSIT ABSOLUT /end AXIS_DESCR
 /begin AXIS_DESCR STD_AXIS tmot temp_ub_q0p75_o48 8 -48.00 143.3 DEPOSIT ABSOLUT /end AXIS_DESCR
/end CHARACTERISTIC
/begin CHARACTERISTIC KFMDZOF_UC "Kennfeld für Offset-Toleranz in Abhängigkeit vom zul. Moment im Befehlstest" MAP 0x81259E GkfWUb 99.61 rel_ub_b99p6 0.00 99.61 FUNCTION_LIST URCMZUL IF_DATA DIM_X DIRECT 0x81259E
 /begin AXIS_DESCR COM_AXIS mz_uc rel_ub_b99p6 8 0.00 99.61 AXIS_PTS_REF MDV08_UC /end AXIS_DESCR
 /begin AXIS_DESCR COM_AXIS nmot_uc nmot_ub_q40 8 0.00 10200. AXIS_PTS_REF NMV08_UC /end AXIS_DESCR
/end CHARACTERISTIC
/begin CHARACTERISTIC KFMDZOF_UM "Kennfeld für Offset-Toleranz in Abhängigkeit vom zulässigen Moment" MAP 0x81412E GkfWUb 99.61 rel_ub_b99p6 0.00 99.61 FUNCTION_LIST UFMZUL IF_DATA DIM_X DIRECT 0x81412E
 /begin AXIS_DESCR COM_AXIS mz_um rel_ub_b99p6 8 0.00 99.61 AXIS_PTS_REF MDV08_UM /end AXIS_DESCR
 /begin AXIS_DESCR COM_AXIS nmot_um nmot_ub_q40 8 0.00 10200. AXIS_PTS_REF NMV08_UM /end AXIS_DESCR
/end CHARACTERISTIC
/begin CHARACTERISTIC KFMIFABG_0_A "Delta-Moment für Gradientenbegrenzung" MAP 0x828946 KfAxUwAyUwSstxSwSstyUwWUw 99.99847 rel_uw_b100 0.00 99.99847 FUNCTION_LIST MDFAW IF_DATA DIM_X INDIRECT 0x816A3C
 /begin AXIS_DESCR STD_AXIS mkfa_w rel_sw_b50 8 -50.00000 49.99847 DEPOSIT ABSOLUT /end AXIS_DESCR
 /begin AXIS_DESCR STD_AXIS nmot_w nmot_uw_q0p25 8 0.00 16383.75 DEPOSIT ABSOLUT /end AXIS_DESCR
/end CHARACTERISTIC
/begin CHARACTERISTIC KFMIFABG_1_A "Delta-Moment für Gradientenbegrenzung" MAP 0x8289EA KfAxUwAyUwSstxSwSstyUwWUw 99.99847 rel_uw_b100 0.00 99.99847 FUNCTION_LIST MDFAW IF_DATA DIM_X INDIRECT 0x816A40
 /begin AXIS_DESCR STD_AXIS mkfa_w rel_sw_b50 8 -50.00000 49.99847 DEPOSIT ABSOLUT /end AXIS_DESCR
 /begin AXIS_DESCR STD_AXIS nmot_w nmot_uw_q0p25 8 0.00 16383.75 DEPOSIT ABSOLUT /end AXIS_DESCR
/end CHARACTERISTIC
/begin CHARACTERISTIC KFMIFALS_0_A "Indiziertes Fahrerwunschmoment für Füllungspfad bei Lastschlagdämpfung" MAP 0x828B32 KfAxUbAyUbSstxUbSstyUwWUw 99.99847 rel_uw_b100 0.00 99.99847 FUNCTION_LIST MDFAW IF_DATA DIM_X INDIRECT 0x816A44 /begin AXIS_DESCR STD_AXIS gangi dez 8 0.00 255.0 DEPOSIT ABSOLUT /end AXIS_DESCR
 /begin AXIS_DESCR STD_AXIS mifa_w rel_uw_b100 8 0.00 99.99847 DEPOSIT ABSOLUT /end AXIS_DESCR
/end CHARACTERISTIC
/begin CHARACTERISTIC KFMIFALS_1_A "Indiziertes Fahrerwunschmoment für Füllungspfad bei Lastschlagdämpfung" MAP 0x828BCC KfAxUbAyUbSstxUbSstyUwWUw 99.99847 rel_uw_b100 0.00 99.99847 FUNCTION_LIST MDFAW IF_DATA DIM_X INDIRECT 0x816A48 /begin AXIS_DESCR STD_AXIS gangi dez 8 0.00 255.0 DEPOSIT ABSOLUT /end AXIS_DESCR
 /begin AXIS_DESCR STD_AXIS mifa_w rel_uw_b100 8 0.00 99.99847 DEPOSIT ABSOLUT /end AXIS_DESCR
/end CHARACTERISTIC
/begin CHARACTERISTIC KFMILSD "Startwert indiziertes Moment für Lastschlagdämpfung" MAP 0x828D00 KfAxUwAyUwSstxUwSstyUwWUw 99.99847 rel_uw_b100 0.00 99.99847 FUNCTION_LIST MDFAW IF_DATA DIM_X DIRECT 0x828D00
 /begin AXIS_DESCR STD_AXIS mivbeb_w rel_uw_b100 6 0.00 99.99847 DEPOSIT ABSOLUT /end AXIS_DESCR
 /begin AXIS_DESCR STD_AXIS nmot_w nmot_uw_q0p25 8 0.00 16383.75 DEPOSIT ABSOLUT /end AXIS_DESCR
/end CHARACTERISTIC
/begin CHARACTERISTIC KFMIMN_0_A "Minimales Schubmoment" MAP 0x8280CC KfAxUbAyUbSstxUbSstyUwWUw 99.99847 rel_uw_b100 0.00 99.99847 FUNCTION_LIST MDMIN IF_DATA DIM_X INDIRECT 0x81623E /begin AXIS_DESCR STD_AXIS gangi dez 8 0.00 255.0 DEPOSIT ABSOLUT /end AXIS_DESCR
 /begin AXIS_DESCR STD_AXIS nmot_w nmot_uw_q0p25 8 0.00 16383.75 DEPOSIT ABSOLUT /end AXIS_DESCR
/end CHARACTERISTIC
/begin CHARACTERISTIC KFMIMN_1_A "Minimales Schubmoment" MAP 0x828166 KfAxUbAyUbSstxUbSstyUwWUw 99.99847 rel_uw_b100 0.00 99.99847 FUNCTION_LIST MDMIN IF_DATA DIM_X INDIRECT 0x816242 /begin AXIS_DESCR STD_AXIS gangi dez 8 0.00 255.0 DEPOSIT ABSOLUT /end AXIS_DESCR
 /begin AXIS_DESCR STD_AXIS nmot_w nmot_uw_q0p25 8 0.00 16383.75 DEPOSIT ABSOLUT /end AXIS_DESCR
/end CHARACTERISTIC
/begin CHARACTERISTIC KFMIOP "Kennfeld optimales Motormoment" MAP 0x817178 GkfWUw 99.99847 rel_uw_b100 0.00 99.99847 FUNCTION_LIST MDBAS MDMAX IF_DATA DIM_X DIRECT 0x817178
 /begin AXIS_DESCR COM_AXIS nmot_w nmot_uw_q0p25 16 0.00 16383.75 AXIS_PTS_REF SNM16OPUW /end AXIS_DESCR
 /begin AXIS_DESCR COM_AXIS rl_w rel_uw_q0p0234 11 0.00 1535.977 AXIS_PTS_REF SRL11OPUW /end AXIS_DESCR
/end CHARACTERISTIC
/begin CHARACTERISTIC KFMIRL "Kennfeld für Berechnung Sollfüllung" MAP 0x81D8C6 KfAxUwAyUwSstxUwSstyUwWUw 1535.977 rel_uw_q0p0234 0.00 1535.977 FUNCTION_LIST MDFUE IF_DATA DIM_X DIRECT 0x81D8C6
 /begin AXIS_DESCR STD_AXIS nmot_w nmot_uw_q0p25 16 0.00 16383.75 DEPOSIT ABSOLUT /end AXIS_DESCR
 /begin AXIS_DESCR STD_AXIS misopl1_w rel_uw_b100 16 0.00 99.99847 DEPOSIT ABSOLUT /end AXIS_DESCR
/end CHARACTERISTIC
/begin CHARACTERISTIC KFMIZUFIL "Zulässiges indiziertes Moment zur Momentenbegrenzung vor Filter" MAP 0x812162 GkfWUb 99.61 rel_ub_b99p6 0.00 99.61 FUNCTION_LIST MDZUL IF_DATA DIM_X DIRECT 0x812162
 /begin AXIS_DESCR COM_AXIS wped relPED_ub_b100 8 0.00 100.0 AXIS_PTS_REF SWP08OPUB /end AXIS_DESCR
 /begin AXIS_DESCR COM_AXIS nmot nmot_ub_q40 8 0.00 10200. AXIS_PTS_REF SNM08OPUB /end AXIS_DESCR
/end CHARACTERISTIC
/begin CHARACTERISTIC KFMIZUNS "Zulässiges Moment bei Nachstartaufweitung" MAP 0x8121A2 GkfWUb 99.61 rel_ub_b99p6 0.00 99.61 FUNCTION_LIST MDZUL IF_DATA DIM_X DIRECT 0x8121A2
 /begin AXIS_DESCR COM_AXIS wped relPED_ub_b100 8 0.00 100.0 AXIS_PTS_REF SWP08OPUB /end AXIS_DESCR
 /begin AXIS_DESCR COM_AXIS nmot nmot_ub_q40 8 0.00 10200. AXIS_PTS_REF SNM08OPUB /end AXIS_DESCR
/end CHARACTERISTIC
/begin CHARACTERISTIC KFMIZUOF "Zulässiges indiziertes Moment zur Momentenbegrenzung" MAP 0x8121E2 GkfWUb 99.61 rel_ub_b99p6 0.00 99.61 FUNCTION_LIST MDZUL IF_DATA DIM_X DIRECT 0x8121E2
 /begin AXIS_DESCR COM_AXIS mizuvfil rel_ub_b99p6 8 0.00 99.61 AXIS_PTS_REF SMO08OPUB /end AXIS_DESCR
 /begin AXIS_DESCR COM_AXIS nmot nmot_ub_q40 8 0.00 10200. AXIS_PTS_REF SNM08OPUB /end AXIS_DESCR
/end CHARACTERISTIC
/begin CHARACTERISTIC KFMI_UC "Kennfeld optimales Motormoment im Befehlstest" MAP 0x81250D GkfWUb 99.61 rel_ub_b99p6 0.00 99.61 FUNCTION_LIST URCMIST IF_DATA DIM_X DIRECT 0x81250D
 /begin AXIS_DESCR COM_AXIS rl_uc rel_ub_q0p75 8 0.00 191.3 AXIS_PTS_REF RLV08_UC /end AXIS_DESCR
 /begin AXIS_DESCR COM_AXIS nmot_uc nmot_ub_q40 8 0.00 10200. AXIS_PTS_REF NZWV08_UC /end AXIS_DESCR
/end CHARACTERISTIC
/begin CHARACTERISTIC KFMI_UM "Kennfeld optimales Motormoment in der Funktionsüberwachung" MAP 0x81409D GkfWUb 99.61 rel_ub_b99p6 0.00 99.61 FUNCTION_LIST UFMIST IF_DATA DIM_X DIRECT 0x81409D
 /begin AXIS_DESCR COM_AXIS rl_um rel_ub_q0p75 8 0.00 191.3 AXIS_PTS_REF RLV08_UM /end AXIS_DESCR
 /begin AXIS_DESCR COM_AXIS nmot_um nmot_ub_q40 8 0.00 10200. AXIS_PTS_REF NZWV08_UM /end AXIS_DESCR
/end CHARACTERISTIC
/begin CHARACTERISTIC KFMLDMN "ML-Schwelle für B_minflr-Diagnose HFM/HLM" MAP 0x81D0E2 KfAxUbAyUbSstxSwSstyUbWSw 6553.500 m_q0p1 -3276.800 3276.700 FUNCTION_LIST DHFM IF_DATA DIM_X DIRECT 0x81D0E2
 /begin AXIS_DESCR STD_AXIS wdkba_w relDK_q0p02441 8 -800.0000 799.9756 DEPOSIT ABSOLUT /end AXIS_DESCR
 /begin AXIS_DESCR STD_AXIS nmot nmot_ub_q40 9 0.00 10200. DEPOSIT ABSOLUT /end AXIS_DESCR
/end CHARACTERISTIC
/begin CHARACTERISTIC KFMLDMX "ML-Schwelle für B_maxflr-Diagnose HFM/HLM" MAP 0x8153C4 KfAxUbAyUbSstxSwSstyUbWSw 6553.500 m_q0p1 -3276.800 3276.700 FUNCTION_LIST DHFM IF_DATA DIM_X DIRECT 0x8153C4
 /begin AXIS_DESCR STD_AXIS wdkbadmx_w relDK_q0p02441 8 -800.0000 799.9756 DEPOSIT ABSOLUT /end AXIS_DESCR
 /begin AXIS_DESCR STD_AXIS nmot nmot_ub_q40 9 0.00 10200. DEPOSIT ABSOLUT /end AXIS_DESCR
/end CHARACTERISTIC
/begin CHARACTERISTIC KFMPED_UC "Kennfeld für zulässiges Moment aus der Pedalstellung im Befehlstest" MAP 0x8125DE GkfWUb 99.61 rel_ub_b99p6 0.00 99.61 FUNCTION_LIST URCMZUL IF_DATA DIM_X DIRECT 0x8125DE
 /begin AXIS_DESCR COM_AXIS spsn_uc spg_ub_q0p019 8 0.00 4.9805 AXIS_PTS_REF SPSNV08_UC /end AXIS_DESCR
 /begin AXIS_DESCR COM_AXIS nmot_uc nmot_ub_q40 8 0.00 10200. AXIS_PTS_REF NMV08_UC /end AXIS_DESCR
/end CHARACTERISTIC
/begin CHARACTERISTIC KFMPED_UM "Kennfeld für zulässiges Moment aus der Pedalstellung in der Funktionsüberwachg" MAP 0x81416E GkfWUb 99.61 rel_ub_b99p6 0.00 99.61 FUNCTION_LIST UFMZUL IF_DATA DIM_X DIRECT 0x81416E
 /begin AXIS_DESCR COM_AXIS spsn_um spg_ub_q0p019 8 0.00 4.9805 AXIS_PTS_REF SPSNV08_UM /end AXIS_DESCR
 /begin AXIS_DESCR COM_AXIS nmot_um nmot_ub_q40 8 0.00 10200. AXIS_PTS_REF NMV08_UM /end AXIS_DESCR
/end CHARACTERISTIC
/begin CHARACTERISTIC KFMPNS_UC "Kennfeld für zul. Moment aus Pedalstellung bei kaltem Motor im Befehlstest" MAP 0x81261E GkfWUb 99.61 rel_ub_b99p6 0.00 99.61 FUNCTION_LIST URCMZUL IF_DATA DIM_X DIRECT 0x81261E
 /begin AXIS_DESCR COM_AXIS spsn_uc spg_ub_q0p019 8 0.00 4.9805 AXIS_PTS_REF SPSNV08_UC /end AXIS_DESCR
 /begin AXIS_DESCR COM_AXIS nmot_uc nmot_ub_q40 8 0.00 10200. AXIS_PTS_REF NMV08_UC /end AXIS_DESCR
/end CHARACTERISTIC
/begin CHARACTERISTIC KFMPNS_UM "Kennfeld für zul. Moment aus Pedalstellung bei kaltem Motor" MAP 0x8141AE GkfWUb 99.61 rel_ub_b99p6 0.00 99.61 FUNCTION_LIST UFMZUL IF_DATA DIM_X DIRECT 0x8141AE
 /begin AXIS_DESCR COM_AXIS spsn_um spg_ub_q0p019 8 0.00 4.9805 AXIS_PTS_REF SPSNV08_UM /end AXIS_DESCR
 /begin AXIS_DESCR COM_AXIS nmot_um nmot_ub_q40 8 0.00 10200. AXIS_PTS_REF NMV08_UM /end AXIS_DESCR
/end CHARACTERISTIC
/begin CHARACTERISTIC KFMRES "LLR: Basis Momentenreserve im LL und ll-nahem Bereich" MAP 0x811E54 GkfWUb 24.90 rel_ub_b24p9 0.00 24.90 FUNCTION_LIST LLRMR IF_DATA DIM_X DIRECT 0x811E54
 /begin AXIS_DESCR COM_AXIS nmot_w nmot_uw_q0p25 6 0.00 16383.75 AXIS_PTS_REF SNM06LLUB /end AXIS_DESCR
 /begin AXIS_DESCR COM_AXIS mifa_w rel_uw_b100 4 0.00 99.99847 AXIS_PTS_REF SMI04LLUB /end AXIS_DESCR
/end CHARACTERISTIC
/begin CHARACTERISTIC KFMRESK "LLR: Basis Momentenreserve im LL und ll-nahem Bereich,ausgekuppelt" MAP 0x811E6C GkfWUb 24.90 rel_ub_b24p9 0.00 24.90 FUNCTION_LIST LLRMR IF_DATA DIM_X DIRECT 0x811E6C
 /begin AXIS_DESCR COM_AXIS nmot_w nmot_uw_q0p25 6 0.00 16383.75 AXIS_PTS_REF SNM06LLUB /end AXIS_DESCR
 /begin AXIS_DESCR COM_AXIS mifa_w rel_uw_b100 4 0.00 99.99847 AXIS_PTS_REF SMI04LLUB /end AXIS_DESCR
/end CHARACTERISTIC
/begin CHARACTERISTIC KFMRESKH "Momentenreserve bei Kat.heizen" MAP 0x811E84 GkfWUb 24.90 rel_ub_b24p9 0.00 24.90 FUNCTION_LIST LLRMR IF_DATA DIM_X DIRECT 0x811E84
 /begin AXIS_DESCR COM_AXIS dns nmotd_sb_q10 6 -1280. 1270. AXIS_PTS_REF SNS06LLSB /end AXIS_DESCR
 /begin AXIS_DESCR COM_AXIS tmot temp_ub_q0p75_o48 4 -48.00 143.3 AXIS_PTS_REF STM04SAUB /end AXIS_DESCR
/end CHARACTERISTIC
/begin CHARACTERISTIC KFMRESNL "Momentenreserve im nicht Leerlauf" MAP 0x811E9C GkfWUb 24.90 rel_ub_b24p9 0.00 24.90 FUNCTION_LIST LLRMR IF_DATA DIM_X DIRECT 0x811E9C
 /begin AXIS_DESCR COM_AXIS nmot_w nmot_uw_q0p25 6 0.00 16383.75 AXIS_PTS_REF SNM06LLUB /end AXIS_DESCR
 /begin AXIS_DESCR COM_AXIS mifa_w rel_uw_b100 4 0.00 99.99847 AXIS_PTS_REF SMI04LLUB /end AXIS_DESCR
/end CHARACTERISTIC
/begin CHARACTERISTIC KFMRESTA "Momentreserve abhängig von tans" MAP 0x811EB4 GkfWUb 24.90 rel_ub_b24p9 0.00 24.90 FUNCTION_LIST LLRMR IF_DATA DIM_X DIRECT 0x811EB4
 /begin AXIS_DESCR COM_AXIS tans temp_ub_q0p75_o48 4 -48.00000 49103.25 AXIS_PTS_REF STA04LLUB /end AXIS_DESCR
 /begin AXIS_DESCR COM_AXIS mifa_w rel_uw_b100 4 0.00 99.99847 AXIS_PTS_REF SMI04LLUB /end AXIS_DESCR
/end CHARACTERISTIC
/begin CHARACTERISTIC KFNFSKHM "Leerlaufsolldrehzahl bei Katheizen mit eingelegter Fahrstufe" MAP 0x81EB8E KfAxUbAyUbSstxUbSstyUwWUb 2550. nmot_ub_q10 0.00 2550. FUNCTION_LIST BBKHZ IF_DATA DIM_X DIRECT 0x81EB8E
 /begin AXIS_DESCR STD_AXIS tmot temp_ub_q0p75_o48 8 -48.00 143.3 DEPOSIT ABSOLUT /end AXIS_DESCR
 /begin AXIS_DESCR STD_AXIS frhokor_w fak_uw_b4 4 0.00 3.999939 DEPOSIT ABSOLUT /end AXIS_DESCR
/end CHARACTERISTIC
/begin CHARACTERISTIC KFNL2TUM "Kennfeld Nachlaufzeit bei Nachtriggerung" MAP 0x82B05E KfAxUwAyUwSstxUwSstyUwWUw 65535.00 t1sxs_uw_b65535 0.00 65535.00 FUNCTION_LIST KMTR IF_DATA DIM_X DIRECT 0x82B05E
 /begin AXIS_DESCR STD_AXIS tmotkmtr temp_ub_q0p75_o48 5 -48.00000 49103.25 DEPOSIT ABSOLUT /end AXIS_DESCR
 /begin AXIS_DESCR STD_AXIS tumgkmtr temp_ub_q0p75_o48 5 -48.00000 49103.25 DEPOSIT ABSOLUT /end AXIS_DESCR
/end CHARACTERISTIC
/begin CHARACTERISTIC KFNLLKHM "Leerlaufsolldrehzahl bei Kat.-Heizung" MAP 0x81EBC0 KfAxUbAyUbSstxUbSstyUwWUb 2550. nmot_ub_q10 0.00 2550. FUNCTION_LIST BBKHZ IF_DATA DIM_X DIRECT 0x81EBC0
 /begin AXIS_DESCR STD_AXIS tmot temp_ub_q0p75_o48 8 -48.00 143.3 DEPOSIT ABSOLUT /end AXIS_DESCR
 /begin AXIS_DESCR STD_AXIS frhokor_w fak_uw_b4 4 0.00 3.999939 DEPOSIT ABSOLUT /end AXIS_DESCR
/end CHARACTERISTIC
/begin CHARACTERISTIC KFNLLNST "Drehzahlverlauf nach Start" MAP 0x819F57 GkfWUb 2550. nmot_ub_q10 0.00 2550. FUNCTION_LIST LLRNS IF_DATA DIM_X DIRECT 0x819F57
 /begin AXIS_DESCR COM_AXIS tnst t1sxs_ub_b255 6 0.00 255.0 AXIS_PTS_REF STN06LLUB /end AXIS_DESCR
 /begin AXIS_DESCR COM_AXIS tmot temp_ub_q0p75_o48 6 -48.00 143.3 AXIS_PTS_REF STM06LLUB /end AXIS_DESCR
/end CHARACTERISTIC
/begin CHARACTERISTIC KFNLTKV "Kennfeld Nachlaufzeit" MAP 0x82B0A8 KfAxUwAyUwSstxUwSstyUwWUw 65535.00 t1sxs_uw_b65535 0.00 65535.00 FUNCTION_LIST KMTR IF_DATA DIM_X DIRECT 0x82B0A8
 /begin AXIS_DESCR STD_AXIS tmotkmtr temp_ub_q0p75_o48 5 -48.00000 49103.25 DEPOSIT ABSOLUT /end AXIS_DESCR
 /begin AXIS_DESCR STD_AXIS vsksmlf_w volgrd_q5p96Em4 5 0.00 39.06190 DEPOSIT ABSOLUT /end AXIS_DESCR
/end CHARACTERISTIC
/begin CHARACTERISTIC KFNLTUM "Kennfeld Nachlaufzeit aus TUM / TMOT" MAP 0x82B0F2 KfAxUwAyUwSstxUwSstyUwWUw 65535.00 t1sxs_uw_b65535 0.00 65535.00 FUNCTION_LIST KMTR IF_DATA DIM_X DIRECT 0x82B0F2
 /begin AXIS_DESCR STD_AXIS tmotkmtr temp_ub_q0p75_o48 5 -48.00000 49103.25 DEPOSIT ABSOLUT /end AXIS_DESCR
 /begin AXIS_DESCR STD_AXIS tumgkmtr temp_ub_q0p75_o48 5 -48.00000 49103.25 DEPOSIT ABSOLUT /end AXIS_DESCR
/end CHARACTERISTIC
/begin CHARACTERISTIC KFNSA_0_A "Nachstartanhebung" MAP 0x818EBB KfAxUbAyUbSstxUbSstyUbWUb 1.992 fak_ub_b2 0.00 1.992 FUNCTION_LIST ESNSWL IF_DATA DIM_X INDIRECT 0x813F8A
 /begin AXIS_DESCR STD_AXIS tans temp_ub_q0p75_o48 6 -48.00 143.3 DEPOSIT ABSOLUT /end AXIS_DESCR
 /begin AXIS_DESCR STD_AXIS tmot temp_ub_q0p75_o48 3 -48.00 143.3 DEPOSIT ABSOLUT /end AXIS_DESCR
/end CHARACTERISTIC
/begin CHARACTERISTIC KFNSTAMX "Drehzahlschwelle für STADAP aktiv" MAP 0x819068 KfAxUbAyUbSstxUbSstyUbWUb 10200. nmot_ub_q40 0.00 10200. FUNCTION_LIST STADAP IF_DATA DIM_X DIRECT 0x819068 /begin AXIS_DESCR STD_AXIS fho fak_ub_b4 4 0.00 3.984 DEPOSIT ABSOLUT /end AXIS_DESCR /begin AXIS_DESCR STD_AXIS nstat nmot_ub_q10 4 0.00 2550. DEPOSIT ABSOLUT /end AXIS_DESCR /end CHARACTERISTIC
/begin CHARACTERISTIC KFNSWRL_0_A "Wichtung Nachstartanhebung" MAP 0x8113E4 GkfWUb 1.992 fak_ub_b2 0.00 1.992 FUNCTION_LIST ESNSWL IF_DATA DIM_X INDIRECT 0x813FA6
 /begin AXIS_DESCR COM_AXIS tmst temp_ub_q0p75_o48 8 -48.00 143.3 AXIS_PTS_REF STS08ESUB /end AXIS_DESCR
 /begin AXIS_DESCR COM_AXIS rlp rel_ub_q0p75 6 0.00 191.3 AXIS_PTS_REF SRP06ESUB /end AXIS_DESCR
/end CHARACTERISTIC
/begin CHARACTERISTIC KFNSWRL_1_A "Wichtung Nachstartanhebung" MAP 0x811414 GkfWUb 1.992 fak_ub_b2 0.00 1.992 FUNCTION_LIST ESNSWL IF_DATA DIM_X INDIRECT 0x813FA8
 /begin AXIS_DESCR COM_AXIS tmst temp_ub_q0p75_o48 8 -48.00 143.3 AXIS_PTS_REF STS08ESUB /end AXIS_DESCR
 /begin AXIS_DESCR COM_AXIS rlp rel_ub_q0p75 6 0.00 191.3 AXIS_PTS_REF SRP06ESUB /end AXIS_DESCR
/end CHARACTERISTIC
/begin CHARACTERISTIC KFNWADE "Festlegung des Adaptionsbereichs für Flankenadaption Phasensensor Einlass" MAP 0x81A870 KfAxUbAyUbSstxUbSstyUbWUb 255.0 dez 0.00 255.0 FUNCTION_LIST BGARNW IF_DATA DIM_X DIRECT 0x81A870 /begin AXIS_DESCR STD_AXIS nmotkf nmot_ub_q40 4 0.00 10200. DEPOSIT ABSOLUT /end AXIS_DESCR /begin AXIS_DESCR STD_AXIS rlnwkf rel_ub_q0p75 4 0.00 191.3 DEPOSIT ABSOLUT /end AXIS_DESCR /end CHARACTERISTIC
/begin CHARACTERISTIC KFNWEGM_0_A "Wiedereinsetzdrehzahlkennfeld" MAP 0x819E5F GkfWUb 10200. nmot_ub_q40 0.00 10200. FUNCTION_LIST BBSAWE IF_DATA DIM_X INDIRECT 0x816162
 /begin AXIS_DESCR COM_AXIS tmot temp_ub_q0p75_o48 5 -48.00 143.3 AXIS_PTS_REF STM05SAUB /end AXIS_DESCR
 /begin AXIS_DESCR COM_AXIS gangi dez 8 0.00 255.0 AXIS_PTS_REF SGA08MDUB /end AXIS_DESCR
/end CHARACTERISTIC
/begin CHARACTERISTIC KFNWEGM_1_A "Wiedereinsetzdrehzahlkennfeld" MAP 0x819E87 GkfWUb 10200. nmot_ub_q40 0.00 10200. FUNCTION_LIST BBSAWE IF_DATA DIM_X INDIRECT 0x816166
 /begin AXIS_DESCR COM_AXIS tmot temp_ub_q0p75_o48 5 -48.00 143.3 AXIS_PTS_REF STM05SAUB /end AXIS_DESCR
 /begin AXIS_DESCR COM_AXIS gangi dez 8 0.00 255.0 AXIS_PTS_REF SGA08MDUB /end AXIS_DESCR
/end CHARACTERISTIC
/begin CHARACTERISTIC KFNWKHE "Kennfeld für Nockenwellenspreizung bei Katheizen (Einlaß)" MAP 0x82A002 GkfWSw 511.9922 kw_sw_q0p0078 -256.0000 255.9922 FUNCTION_LIST NWSOLLE IF_DATA DIM_X DIRECT 0x82A002
 /begin AXIS_DESCR COM_AXIS nmot_w nmot_uw_q0p25 16 0.00 16383.75 AXIS_PTS_REF SNM16NEUW /end AXIS_DESCR
 /begin AXIS_DESCR COM_AXIS rlnw_w rel_uw_q0p0234 8 0.00 1535.977 AXIS_PTS_REF SRL08NEUW /end AXIS_DESCR
/end CHARACTERISTIC
/begin CHARACTERISTIC KFNWKHLLE "Kennfeld für Nockenwellenspreizung bei Katheizen und B_ll (Einlaß)" MAP 0x82A102 GkfWSw 511.9922 kw_sw_q0p0078 -256.0000 255.9922 FUNCTION_LIST NWSOLLE IF_DATA DIM_X DIRECT 0x82A102
 /begin AXIS_DESCR COM_AXIS nmot_w nmot_uw_q0p25 5 0.00 16383.75 AXIS_PTS_REF SNM05NEUW /end AXIS_DESCR
 /begin AXIS_DESCR COM_AXIS rlnw_w rel_uw_q0p0234 5 0.00 1535.977 AXIS_PTS_REF SRL05NEUW /end AXIS_DESCR
/end CHARACTERISTIC
/begin CHARACTERISTIC KFNWKRE "Sollwinkel Nockenwelle  bei klopfender Verbrennung Einlaß" MAP 0x82A134 GkfWSw 511.9922 kw_sw_q0p0078 -256.0000 255.9922 FUNCTION_LIST NWSOLLE IF_DATA DIM_X DIRECT 0x82A134
 /begin AXIS_DESCR COM_AXIS nmot_w nmot_uw_q0p25 16 0.00 16383.75 AXIS_PTS_REF SNM16NEUW /end AXIS_DESCR
 /begin AXIS_DESCR COM_AXIS rlnw_w rel_uw_q0p0234 8 0.00 1535.977 AXIS_PTS_REF SRL08NEUW /end AXIS_DESCR
/end CHARACTERISTIC
/begin CHARACTERISTIC KFNWLLE "Kennfeld für Nockenwellenspreizung im Leerlauf (Einlaß)" MAP 0x82A234 GkfWSw 511.9922 kw_sw_q0p0078 -256.0000 255.9922 FUNCTION_LIST NWSOLLE IF_DATA DIM_X DIRECT 0x82A234
 /begin AXIS_DESCR COM_AXIS nmot_w nmot_uw_q0p25 5 0.00 16383.75 AXIS_PTS_REF SNM05NEUW /end AXIS_DESCR
 /begin AXIS_DESCR COM_AXIS rlnw_w rel_uw_q0p0234 5 0.00 1535.977 AXIS_PTS_REF SRL05NEUW /end AXIS_DESCR
/end CHARACTERISTIC
/begin CHARACTERISTIC KFNWSE "Kennfeld für Nockenwellenspreizung (Einlaß)" MAP 0x82A266 GkfWSw 511.9922 kw_sw_q0p0078 -256.0000 255.9922 FUNCTION_LIST NWSOLLE IF_DATA DIM_X DIRECT 0x82A266
 /begin AXIS_DESCR COM_AXIS nmot_w nmot_uw_q0p25 16 0.00 16383.75 AXIS_PTS_REF SNM16NEUW /end AXIS_DESCR
 /begin AXIS_DESCR COM_AXIS rlnw_w rel_uw_q0p0234 8 0.00 1535.977 AXIS_PTS_REF SRL08NEUW /end AXIS_DESCR
/end CHARACTERISTIC
/begin CHARACTERISTIC KFNWTME "Faktor Übergang von Kalt- auf Warm-Kennfelder bei Nockenwellensollwinkeln Einlaß" MAP 0x81A8D3 KfAxUbAyUbSstxUbSstyUbWUb 1.992 fak_ub_b2 0.00 1.992 FUNCTION_LIST NWSOLLE IF_DATA DIM_X DIRECT 0x81A8D3
 /begin AXIS_DESCR STD_AXIS tmot temp_ub_q0p75_o48 4 -48.00 143.3 DEPOSIT ABSOLUT /end AXIS_DESCR
 /begin AXIS_DESCR STD_AXIS tmst temp_ub_q0p75_o48 4 -48.00 143.3 DEPOSIT ABSOLUT /end AXIS_DESCR
/end CHARACTERISTIC
/begin CHARACTERISTIC KFNWWLE "Kennfeld für Nockenwellenspreizung im Warmlauf (Einlaß)" MAP 0x82A366 GkfWSw 511.9922 kw_sw_q0p0078 -256.0000 255.9922 FUNCTION_LIST NWSOLLE IF_DATA DIM_X DIRECT 0x82A366
 /begin AXIS_DESCR COM_AXIS nmot_w nmot_uw_q0p25 16 0.00 16383.75 AXIS_PTS_REF SNM16NEUW /end AXIS_DESCR
 /begin AXIS_DESCR COM_AXIS rlnw_w rel_uw_q0p0234 8 0.00 1535.977 AXIS_PTS_REF SRL08NEUW /end AXIS_DESCR
/end CHARACTERISTIC
/begin CHARACTERISTIC KFNWWLLE "Kennfeld für Nockenwellenspreizung im Warmlauf bei B_ll (Einlaß)" MAP 0x82A466 GkfWSw 511.9922 kw_sw_q0p0078 -256.0000 255.9922 FUNCTION_LIST NWSOLLE IF_DATA DIM_X DIRECT 0x82A466
 /begin AXIS_DESCR COM_AXIS nmot_w nmot_uw_q0p25 5 0.00 16383.75 AXIS_PTS_REF SNM05NEUW /end AXIS_DESCR
 /begin AXIS_DESCR COM_AXIS rlnw_w rel_uw_q0p0234 5 0.00 1535.977 AXIS_PTS_REF SRL05NEUW /end AXIS_DESCR
/end CHARACTERISTIC
/begin CHARACTERISTIC KFNWWUE "Kennfeld Basiswinkel für Nockenwellenverstellung (Einlaß)" MAP 0x829E66 KfAxUwAyUwSstxUwSstyUwWSw 511.9922 kw_sw_q0p0078 -256.0000 255.9922 FUNCTION_LIST NWFW IF_DATA DIM_X DIRECT 0x829E66
 /begin AXIS_DESCR STD_AXIS nmot_w nmot_uw_q0p25 12 0.00 16383.75 DEPOSIT ABSOLUT /end AXIS_DESCR
 /begin AXIS_DESCR STD_AXIS rlnw_w rel_uw_q0p0234 8 0.00 1535.977 DEPOSIT ABSOLUT /end AXIS_DESCR
/end CHARACTERISTIC
/begin CHARACTERISTIC KFOELKBI "Ölniveauschwelle für Ausgabe an Kombi" MAP 0x8183CE KfAxUbAyUbSstxUbSstyUbWUb 63.75 s_q63p75mm 0.00 63.75 FUNCTION_LIST CAN IF_DATA DIM_X DIRECT 0x8183CE
 /begin AXIS_DESCR STD_AXIS kfoelkbi_nmot nmot_ub_q40 8 0.00 10200. DEPOSIT ABSOLUT /end AXIS_DESCR
 /begin AXIS_DESCR STD_AXIS tolc temp_ub_q1_o60 8 -60.00 195.0 DEPOSIT ABSOLUT /end AXIS_DESCR
/end CHARACTERISTIC
/begin CHARACTERISTIC KFOSCTM "Kennfeld OSC des Grenzkatalysators" MAP 0x81C64C KfAxUbAyUbSstxUwSstyUwWUw 6543.500 m_q0p1_mg 10.00000 6553.500 FUNCTION_LIST DKATSP IF_DATA DIM_X DIRECT 0x81C64C
 /begin AXIS_DESCR STD_AXIS tikatmu_w temp_uw_q0p0195_o50 8 -50.00000 1229.980 DEPOSIT ABSOLUT /end AXIS_DESCR
 /begin AXIS_DESCR STD_AXIS msabg_w m_uw_b6553p5 8 0.00 6553.500 DEPOSIT ABSOLUT /end AXIS_DESCR
/end CHARACTERISTIC
/begin CHARACTERISTIC KFPBRK "Korrekturfaktor für Brennraumdruck" MAP 0x81D1AA KfAxUwAyUwSstxUwSstyUwWUw 1.999969 fak_uw_b2 0.00 1.999969 FUNCTION_LIST BGSRM IF_DATA DIM_X DIRECT 0x81D1AA
 /begin AXIS_DESCR STD_AXIS nmot_w nmot_uw_q0p25 10 0.00 16383.75 DEPOSIT ABSOLUT /end AXIS_DESCR
 /begin AXIS_DESCR STD_AXIS rl_w rel_uw_q0p0234 10 0.00 1535.977 DEPOSIT ABSOLUT /end AXIS_DESCR
/end CHARACTERISTIC
/begin CHARACTERISTIC KFPBRKNW "Korrekturfaktor für Brennraumdruck bei aktiver NWS" MAP 0x81D29E KfAxUwAyUwSstxUwSstyUwWUw 1.999969 fak_uw_b2 0.00 1.999969 FUNCTION_LIST BGSRM IF_DATA DIM_X DIRECT 0x81D29E
 /begin AXIS_DESCR STD_AXIS nmot_w nmot_uw_q0p25 10 0.00 16383.75 DEPOSIT ABSOLUT /end AXIS_DESCR
 /begin AXIS_DESCR STD_AXIS rl_w rel_uw_q0p0234 10 0.00 1535.977 DEPOSIT ABSOLUT /end AXIS_DESCR
/end CHARACTERISTIC
/begin CHARACTERISTIC KFPED "Relatives Fahrerwunschmoment aus Fahrpedal" MAP 0x816854 GkfWUw 199.9969 rel_uw_b200 0.00 199.9969 FUNCTION_LIST MDFAW IF_DATA DIM_X DIRECT 0x816854
 /begin AXIS_DESCR COM_AXIS wped_w relPED_uw_b100 16 0.00 100.0000 AXIS_PTS_REF SWP16MDUW /end AXIS_DESCR
 /begin AXIS_DESCR COM_AXIS nmot_w nmot_uw_q0p25 12 0.00 16383.75 AXIS_PTS_REF SNM12MDUW /end AXIS_DESCR
/end CHARACTERISTIC
/begin CHARACTERISTIC KFPED_VAR1 "KFPED for coding variant 1 (FA2E=1, coding 4th digit 8) - pointer table 0x1708C[1]" MAP 0x8169D4 GkfWUw 199.9969 rel_uw_b200 0.00 199.9969 FUNCTION_LIST MDFAW IF_DATA DIM_X DIRECT 0x8169D4
 /begin AXIS_DESCR COM_AXIS wped_w relPED_uw_b100 16 0.00 100.0000 AXIS_PTS_REF SWP16MDUW /end AXIS_DESCR
 /begin AXIS_DESCR COM_AXIS nmot_w nmot_uw_q0p25 12 0.00 16383.75 AXIS_PTS_REF SNM12MDUW /end AXIS_DESCR
/end CHARACTERISTIC
/begin CHARACTERISTIC KFPEDL "Relatives Fahrerwunschmoment aus Fahrpedal für kleine Geschwindigkeiten" MAP 0x816B54 GkfWUw 199.9969 rel_uw_b200 0.00 199.9969 FUNCTION_LIST MDFAW IF_DATA DIM_X DIRECT 0x816B54
 /begin AXIS_DESCR COM_AXIS wped_w relPED_uw_b100 16 0.00 100.0000 AXIS_PTS_REF SWP16MDUW /end AXIS_DESCR
 /begin AXIS_DESCR COM_AXIS nmot_w nmot_uw_q0p25 12 0.00 16383.75 AXIS_PTS_REF SNM12MDUW /end AXIS_DESCR
/end CHARACTERISTIC
/begin CHARACTERISTIC KFPEDR "Relatives Fahrerwunschmoment aus Fahrpedal für Rückwärtsgang" MAP 0x816CD4 GkfWUw 199.9969 rel_uw_b200 0.00 199.9969 FUNCTION_LIST MDFAW IF_DATA DIM_X DIRECT 0x816CD4
 /begin AXIS_DESCR COM_AXIS wped_w relPED_uw_b100 16 0.00 100.0000 AXIS_PTS_REF SWP16MDUW /end AXIS_DESCR
 /begin AXIS_DESCR COM_AXIS nmot_w nmot_uw_q0p25 12 0.00 16383.75 AXIS_PTS_REF SNM12MDUW /end AXIS_DESCR
/end CHARACTERISTIC
/begin CHARACTERISTIC KFPEDR_VAR1 "KFPEDR for coding variant 1 (FA2E=1, coding 4th digit 8) - pointer table 0x17090[1]" MAP 0x816E54 GkfWUw 199.9969 rel_uw_b200 0.00 199.9969 FUNCTION_LIST MDFAW IF_DATA DIM_X DIRECT 0x816E54
 /begin AXIS_DESCR COM_AXIS wped_w relPED_uw_b100 16 0.00 100.0000 AXIS_PTS_REF SWP16MDUW /end AXIS_DESCR
 /begin AXIS_DESCR COM_AXIS nmot_w nmot_uw_q0p25 12 0.00 16383.75 AXIS_PTS_REF SNM12MDUW /end AXIS_DESCR
/end CHARACTERISTIC
/begin CHARACTERISTIC KFPRG "interner Abgaspartialdruck abhängig von NW-Verstellung bei sumode=0" MAP 0x81D392 KfAxUwAyUwSstxUwSstyUwWUw 2559.961 p_uw_q0p039 0.00 2559.961 FUNCTION_LIST BGSRM IF_DATA DIM_X DIRECT 0x81D392
 /begin AXIS_DESCR STD_AXIS wnwsrm_w kw_q0p0019 6 0.00 127.9980 DEPOSIT ABSOLUT /end AXIS_DESCR
 /begin AXIS_DESCR STD_AXIS nmot_w nmot_uw_q0p25 10 0.00 16383.75 DEPOSIT ABSOLUT /end AXIS_DESCR
/end CHARACTERISTIC
/begin CHARACTERISTIC KFQNVP1 "Benötigter Volumenstrom dürch den Kühler, Lüfter 1" MAP 0x81ACC7 KfAxUbAyUbSstxUbSstyUbWUb 1020. m_ub_b1020 0.00 1020. FUNCTION_LIST KMTR IF_DATA DIM_X DIRECT 0x81ACC7
 /begin AXIS_DESCR STD_AXIS qmaxl1 temp_ub_q0p75_o48 6 -48.00 143.3 DEPOSIT ABSOLUT /end AXIS_DESCR
 /begin AXIS_DESCR STD_AXIS nmot nmot_ub_q40 6 0.00 10200. DEPOSIT ABSOLUT /end AXIS_DESCR
/end CHARACTERISTIC
/begin CHARACTERISTIC KFQNVP2 "Benötigter Volumenstrom dürch den Kühler, Lüfter 2" MAP 0x81ACF9 KfAxUbAyUbSstxUbSstyUbWUb 1020. m_ub_b1020 0.00 1020. FUNCTION_LIST KMTR IF_DATA DIM_X DIRECT 0x81ACF9
 /begin AXIS_DESCR STD_AXIS qmaxl2 temp_ub_q0p75_o48 6 -48.00 143.3 DEPOSIT ABSOLUT /end AXIS_DESCR
 /begin AXIS_DESCR STD_AXIS nmot nmot_ub_q40 6 0.00 10200. DEPOSIT ABSOLUT /end AXIS_DESCR
/end CHARACTERISTIC
/begin CHARACTERISTIC KFQTE "Kennfeld Auf-/Absteuergeschwindigkeit der Sollspülrate Tankentlüftung" MAP 0x81A639 GkfWUb 0.0121593164 perio_ub_b0p012207 0.00 0.0121593164 FUNCTION_LIST TEB IF_DATA DIM_X DIRECT 0x81A639 /begin AXIS_DESCR COM_AXIS ml m_ub_b1020 6 0.00 1020. AXIS_PTS_REF SML06TEUB /end AXIS_DESCR
 /begin AXIS_DESCR COM_AXIS frmit fak_ub_b2 5 0.00 1.992 AXIS_PTS_REF SFR05TEUB /end AXIS_DESCR
/end CHARACTERISTIC
/begin CHARACTERISTIC KFQVAC "Kennfeld Wärmestrom ECC in °C" MAP 0x81AD2B KfAxUbAyUbSstxUbSstyUbWUb 191.3 temp_ub_q0p75_o48 -48.00 143.3 FUNCTION_LIST KMTR IF_DATA DIM_X DIRECT 0x81AD2B
 /begin AXIS_DESCR STD_AXIS tmotkmtr temp_ub_q0p75_o48 5 -48.00 143.3 DEPOSIT ABSOLUT /end AXIS_DESCR
 /begin AXIS_DESCR STD_AXIS tumgkmtr temp_ub_q0p75_o48 5 -48.00 143.3 DEPOSIT ABSOLUT /end AXIS_DESCR
/end CHARACTERISTIC
/begin CHARACTERISTIC KFQVKOM "Kennfeld Wärmestrom erhöhter Kältebedarf" MAP 0x81AD50 KfAxUbAyUbSstxUbSstyUbWUb 191.3 temp_ub_q0p75_o48 -48.00 143.3 FUNCTION_LIST KMTR IF_DATA DIM_X DIRECT 0x81AD50
 /begin AXIS_DESCR STD_AXIS tmotkmtr temp_ub_q0p75_o48 5 -48.00 143.3 DEPOSIT ABSOLUT /end AXIS_DESCR
 /begin AXIS_DESCR STD_AXIS tumgkmtr temp_ub_q0p75_o48 5 -48.00 143.3 DEPOSIT ABSOLUT /end AXIS_DESCR
/end CHARACTERISTIC
/begin CHARACTERISTIC KFRAT "Füllungabhängige Integrationsteigung für FRAT" CURVE 0x81E016 KlAUbSstUbWUw 0.1999664 fak_uw_b5 0.00 0.1999664 FUNCTION_LIST LRA IF_DATA DIM_X DIRECT 0x81E016 /begin AXIS_DESCR STD_AXIS dlrfrat fak_q0p0625 5 0.00 15.94 DEPOSIT ABSOLUT /end AXIS_DESCR /end CHARACTERISTIC
/begin CHARACTERISTIC KFRBGOF "Offset für I-Anteilbegrenzung LDRPID" MAP 0x8278D8 KfAxUbAyUbSstxSwSstyUbWSw 327.6750 tv_sw_q0p005 -163.8400 163.8350 FUNCTION_LIST LDRPID IF_DATA DIM_X DIRECT 0x8278D8
 /begin AXIS_DESCR STD_AXIS ngfil nmotg_sb_q100 4 -12800.00 12700.00 DEPOSIT ABSOLUT /end AXIS_DESCR
 /begin AXIS_DESCR STD_AXIS nmot nmot_ub_q40 6 0.00 10200. DEPOSIT ABSOLUT /end AXIS_DESCR
/end CHARACTERISTIC
/begin CHARACTERISTIC KFRLIP_UM "Kennfeld für rl - Berechnung aus Drosselklappenwinkel in der Funktionsüberwachg" MAP 0x814016 KfAxUbAyUbSstxUbSstyUbWUb 191.3 rel_ub_q0p75 0.00 191.3 FUNCTION_LIST UFRLC IF_DATA DIM_X DIRECT 0x814016
 /begin AXIS_DESCR STD_AXIS ipsn_um spg_ub_q0p019 8 0.00 4.9805 DEPOSIT ABSOLUT /end AXIS_DESCR
 /begin AXIS_DESCR STD_AXIS nmot_um nmot_ub_q40 8 0.00 10200. DEPOSIT ABSOLUT /end AXIS_DESCR
/end CHARACTERISTIC
/begin CHARACTERISTIC KFRLMN "minimale Füllung im befeuerten Betrieb" MAP 0x818989 GkfWUb 191.3 rel_ub_q0p75 0.00 191.3 FUNCTION_LIST MDFUE IF_DATA DIM_X DIRECT 0x818989
 /begin AXIS_DESCR COM_AXIS nmot nmot_ub_q40 12 0.00 10200. AXIS_PTS_REF SNM12FEUB /end AXIS_DESCR
 /begin AXIS_DESCR COM_AXIS tmot temp_ub_q0p75_o48 4 -48.00 143.3 AXIS_PTS_REF STM04FEUB /end AXIS_DESCR
/end CHARACTERISTIC
/begin CHARACTERISTIC KFRLMNSA "minimales rl bei Schubabschalten" MAP 0x8189B9 GkfWUb 191.3 rel_ub_q0p75 0.00 191.3 FUNCTION_LIST MDFUE IF_DATA DIM_X DIRECT 0x8189B9
 /begin AXIS_DESCR COM_AXIS nmot nmot_ub_q40 12 0.00 10200. AXIS_PTS_REF SNM12FEUB /end AXIS_DESCR
 /begin AXIS_DESCR COM_AXIS tmot temp_ub_q0p75_o48 4 -48.00 143.3 AXIS_PTS_REF STM04FEUB /end AXIS_DESCR
/end CHARACTERISTIC
/begin CHARACTERISTIC KFSZDUB "Schließzeitkorrektur in Abhängigkeit von UB" MAP 0x81AA96 KfAxUbAyUbSstxUbSstyUbWUb 7.969 fak_ub_b8 0.00 7.969 FUNCTION_LIST ZUESZ IF_DATA DIM_X DIRECT 0x81AA96 /begin AXIS_DESCR STD_AXIS uzue spg_ubatt 7 0.00 17.95 DEPOSIT ABSOLUT /end AXIS_DESCR
 /begin AXIS_DESCR STD_AXIS tsrldyn txms_ub_q0p1 16 0.00 25.50 DEPOSIT ABSOLUT /end AXIS_DESCR
/end CHARACTERISTIC
/begin CHARACTERISTIC KFSZT "Schließzeit-Kennfeld" MAP 0x81AB1F KfAxUbAyUbSstxUbSstyUbWUb 25.50 txms_ub_q0p1 0.00 25.50 FUNCTION_LIST ZUESZ IF_DATA DIM_X DIRECT 0x81AB1F /begin AXIS_DESCR STD_AXIS ub spg_ubatt 8 0.00 17.95 DEPOSIT ABSOLUT /end AXIS_DESCR /begin AXIS_DESCR STD_AXIS nmot nmot_ub_q40 8 0.00 10200. DEPOSIT ABSOLUT /end AXIS_DESCR /end CHARACTERISTIC
/begin CHARACTERISTIC KFTADMS "dynamischer Bewertungsfaktor für das Absteuern des TEV" MAP 0x8177F4 KfAxUbAyUbSstxSbSstyUbWUb 1.992 fak_ub_b2 0.00 1.992 FUNCTION_LIST TEB IF_DATA DIM_X DIRECT 0x8177F4
 /begin AXIS_DESCR STD_AXIS dmssginr fak_sb_b1 5 -1.000 0.9922 DEPOSIT ABSOLUT /end AXIS_DESCR
 /begin AXIS_DESCR STD_AXIS nmot nmot_ub_q40 4 0.00 10200. DEPOSIT ABSOLUT /end AXIS_DESCR
/end CHARACTERISTIC
/begin CHARACTERISTIC KFTARX "Kennfeld Maximalfuellung Tans Korrekturfaktor" MAP 0x827BF8 GkfWUw 1.999969 fak_uw_b2 0.00 1.999969 FUNCTION_LIST LDRLMX IF_DATA DIM_X DIRECT 0x827BF8
 /begin AXIS_DESCR COM_AXIS nmot_w nmot_uw_q0p25 12 0.00 16383.75 AXIS_PTS_REF SNM12LDUW /end AXIS_DESCR
 /begin AXIS_DESCR COM_AXIS tans temp_ub_q0p75_o48 10 -48.00 143.3 AXIS_PTS_REF STA10LDUB /end AXIS_DESCR
/end CHARACTERISTIC
/begin CHARACTERISTIC KFTARXB "Basiswerte Kennfeld Maximalfuellung Tans Korrekturfaktor" MAP 0x827CE8 GkfWUw 1.999969 fak_uw_b2 0.00 1.999969 FUNCTION_LIST LDRLMX IF_DATA DIM_X DIRECT 0x827CE8
 /begin AXIS_DESCR COM_AXIS nmot_w nmot_uw_q0p25 12 0.00 16383.75 AXIS_PTS_REF SNM12LDUW /end AXIS_DESCR
 /begin AXIS_DESCR COM_AXIS tans temp_ub_q0p75_o48 10 -48.00 143.3 AXIS_PTS_REF STA10LDUB /end AXIS_DESCR
/end CHARACTERISTIC
/begin CHARACTERISTIC KFTARXZK "Kennfeld Maximalfuellung Tans Korrekturfaktor bei Dauerklopfen" MAP 0x827DD8 GkfWUw 1.999969 fak_uw_b2 0.00 1.999969 FUNCTION_LIST LDRLMX IF_DATA DIM_X DIRECT 0x827DD8
 /begin AXIS_DESCR COM_AXIS nmot_w nmot_uw_q0p25 12 0.00 16383.75 AXIS_PTS_REF SNM12LDUW /end AXIS_DESCR
 /begin AXIS_DESCR COM_AXIS tans temp_ub_q0p75_o48 10 -48.00 143.3 AXIS_PTS_REF STA10LDUB /end AXIS_DESCR
/end CHARACTERISTIC
/begin CHARACTERISTIC KFTATM "Kennfeld Abgastemperatur   f(nmot,rl)" MAP 0x8185E2 KfAxUbAyUbSstxUbSstyUbWUb 1275. temp_ub_q5_o50 -50.00 1225. FUNCTION_LIST ATM IF_DATA DIM_X DIRECT 0x8185E2 /begin AXIS_DESCR STD_AXIS nmot nmot_ub_q40 8 0.00 10200. DEPOSIT ABSOLUT /end AXIS_DESCR /begin AXIS_DESCR STD_AXIS rl rel_ub_q0p75 8 0.00 191.3 DEPOSIT ABSOLUT /end AXIS_DESCR /end CHARACTERISTIC
/begin CHARACTERISTIC KFTATX "Kennfeld für maximales Tastverhältnis" MAP 0x81A657 KfAxUbAyUbSstxUbSstyUbWUb 99.61 rel_ub_b99p6 0.00 99.61 FUNCTION_LIST TEB IF_DATA DIM_X DIRECT 0x81A657 /begin AXIS_DESCR STD_AXIS nmot nmot_ub_q40 10 0.00 10200. DEPOSIT ABSOLUT /end AXIS_DESCR /begin AXIS_DESCR STD_AXIS pspu fak_ub_b2 6 0.00 1.992 DEPOSIT ABSOLUT /end AXIS_DESCR /end CHARACTERISTIC
/begin CHARACTERISTIC KFTEKA "Kennfeld Sollkraftstoffanteil bei Regenerierung" MAP 0x829C9C KfAxUbAyUbSstxUbSstyUbWSb 0.9922 fak_sb_b1 0.00 0.9922 FUNCTION_LIST TEB IF_DATA DIM_X DIRECT 0x829C9C /begin AXIS_DESCR STD_AXIS nmot nmot_ub_q40 5 0.00 10200. DEPOSIT ABSOLUT /end AXIS_DESCR /begin AXIS_DESCR STD_AXIS rl rel_ub_q0p75 5 0.00 191.3 DEPOSIT ABSOLUT /end AXIS_DESCR /end CHARACTERISTIC
/begin CHARACTERISTIC KFTEVP "Kennfeld Periodendauer TEV" MAP 0x81A6B0 KfAxUbAyUbSstxUbSstyUbWUb 127.5 t500usxms_ub_q0p5 0.00 127.5 FUNCTION_LIST ATEV IF_DATA DIM_X DIRECT 0x81A6B0 /begin AXIS_DESCR STD_AXIS nmot nmot_ub_q40 5 0.00 10200. DEPOSIT ABSOLUT /end AXIS_DESCR /begin AXIS_DESCR STD_AXIS tateroh rel_ub_b99p6 9 0.00 99.61 DEPOSIT ABSOLUT /end AXIS_DESCR /end CHARACTERISTIC
/begin CHARACTERISTIC KFTMOTKR "Kennfeld" MAP 0x82B13C KfAxUbAyUbSstxUbSstyUwWUb 191.3 temp_ub_q0p75_o48 -48.00 143.3 FUNCTION_LIST KMTR IF_DATA DIM_X DIRECT 0x82B13C
 /begin AXIS_DESCR STD_AXIS tmotkmtr temp_ub_q0p75_o48 5 -48.00 143.3 DEPOSIT ABSOLUT /end AXIS_DESCR
 /begin AXIS_DESCR STD_AXIS vsksmlf_w volgrd_q5p96Em4 5 0.00 39.06190 DEPOSIT ABSOLUT /end AXIS_DESCR
/end CHARACTERISTIC
/begin CHARACTERISTIC KFTSDYN "Schließzeitkorrektur in Abhängigkeit des Drehzahlgradienten" MAP 0x82AFF4 KfAxUbAyUbSstxSwSstyUbWUw 7.999878 fak_uw_b8 0.00 7.999878 FUNCTION_LIST ZUESZ IF_DATA DIM_X DIRECT 0x82AFF4
 /begin AXIS_DESCR STD_AXIS ngfil_w nmotg_sw_q0p39 3 -12800.16 12799.77 DEPOSIT ABSOLUT /end AXIS_DESCR
 /begin AXIS_DESCR STD_AXIS nmot nmot_ub_q40 8 0.00 10200. DEPOSIT ABSOLUT /end AXIS_DESCR
/end CHARACTERISTIC
/begin CHARACTERISTIC KFTSRL "Schließzeitkennfeld" MAP 0x81AB71 KfAxUbAyUbSstxUbSstyUbWUb 25.50 txms_ub_q0p1 0.00 25.50 FUNCTION_LIST ZUESZ IF_DATA DIM_X DIRECT 0x81AB71 /begin AXIS_DESCR STD_AXIS nmot nmot_ub_q40 9 0.00 10200. DEPOSIT ABSOLUT /end AXIS_DESCR /begin AXIS_DESCR STD_AXIS rl rel_ub_q0p75 10 0.00 191.3 DEPOSIT ABSOLUT /end AXIS_DESCR /end CHARACTERISTIC
/begin CHARACTERISTIC KFTVETR "Kennfeld benötigtes Tastverhältnis für ETR" MAP 0x817C0A KfAxUbAyUbSstxSbSstyUbWUb 99.61 tv_ub_b100 0.00 99.61 FUNCTION_LIST KMTR IF_DATA DIM_X DIRECT 0x817C0A
 /begin AXIS_DESCR STD_AXIS dkmts temp_sb_q0p75 6 -96.00 95.25 DEPOSIT ABSOLUT /end AXIS_DESCR
 /begin AXIS_DESCR STD_AXIS tmotsoll temp_ub_q0p75_o48 6 -48.00 143.3 DEPOSIT ABSOLUT /end AXIS_DESCR
/end CHARACTERISTIC
/begin CHARACTERISTIC KFTVFRR "Kennfeld: Lambda-Regler nach dieser Zeit auf Referenzwert zurücksetzen" MAP 0x81A747 KfAxUbAyUbSstxUbSstyUbWUb 25.50 t100msxs_ub_b25p5 0.00 25.50 FUNCTION_LIST DTEV IF_DATA DIM_X DIRECT 0x81A747
 /begin AXIS_DESCR STD_AXIS tadteazs rel_ub_b99p6 4 0.00 99.61 DEPOSIT ABSOLUT /end AXIS_DESCR
 /begin AXIS_DESCR STD_AXIS ml m_ub_b1020 3 0.00 1020. DEPOSIT ABSOLUT /end AXIS_DESCR
/end CHARACTERISTIC
/begin CHARACTERISTIC KFTVLBTS "Verzögerungszeit Lambdasoll Bauteileschutz f(nmot,rl)" MAP 0x81E53A KfAxUbAyUbSstxUbSstyUwWUb 25.50 t100msxs_ub_b25p5 0.00 25.50 FUNCTION_LIST LAMBTS IF_DATA DIM_X DIRECT 0x81E53A /begin AXIS_DESCR STD_AXIS nmot nmot_ub_q40 12 0.00 10200. DEPOSIT ABSOLUT /end AXIS_DESCR
 /begin AXIS_DESCR STD_AXIS rl_w rel_uw_q0p0234 8 0.00 1535.977 DEPOSIT ABSOLUT /end AXIS_DESCR
/end CHARACTERISTIC
/begin CHARACTERISTIC KFTVLDRE "Kennfeld tastverhältnisersatzwert für LDR" MAP 0x819E1C KfAxUbAyUbSstxUbSstyUbWUb 99.61 tv_ub_b100 0.00 99.61 FUNCTION_LIST LDTVMA IF_DATA DIM_X DIRECT 0x819E1C /begin AXIS_DESCR STD_AXIS nmot nmot_ub_q40 8 0.00 10200. DEPOSIT ABSOLUT /end AXIS_DESCR /begin AXIS_DESCR STD_AXIS plsol p_ub_q10 4 0.00 2550. DEPOSIT ABSOLUT /end AXIS_DESCR /end CHARACTERISTIC
/begin CHARACTERISTIC KFTVLUE1 "Umsetzung Drehzahl in Tastverhältnis Lüfter 1" MAP 0x81AD75 KfAxUbAyUbSstxUbSstyUbWUb 99.61 tv_ub_b100 0.00 99.61 FUNCTION_LIST KMTR IF_DATA DIM_X DIRECT 0x81AD75 /begin AXIS_DESCR STD_AXIS nluez1 nmot_ub_q20 6 0.00 5100. DEPOSIT ABSOLUT /end AXIS_DESCR /begin AXIS_DESCR STD_AXIS nmot nmot_ub_q40 6 0.00 10200. DEPOSIT ABSOLUT /end AXIS_DESCR /end CHARACTERISTIC
/begin CHARACTERISTIC KFTVLUE2 "Umsetzung Drehzahl in Tastverhältnis Lüfter 2" MAP 0x81ADA7 KfAxUbAyUbSstxUbSstyUbWUb 99.61 tv_ub_b100 0.00 99.61 FUNCTION_LIST KMTR IF_DATA DIM_X DIRECT 0x81ADA7 /begin AXIS_DESCR STD_AXIS nluez2 nmot_ub_q20 6 0.00 5100. DEPOSIT ABSOLUT /end AXIS_DESCR /begin AXIS_DESCR STD_AXIS nmot nmot_ub_q40 6 0.00 10200. DEPOSIT ABSOLUT /end AXIS_DESCR /end CHARACTERISTIC
/begin CHARACTERISTIC KFTVSA "Verzögerungszeit für Schubabschalten" MAP 0x819ED7 GkfWUb 2.550 t10msxs_ub_b2p55 0.00 2.550 FUNCTION_LIST BBSAWE IF_DATA DIM_X DIRECT 0x819ED7
 /begin AXIS_DESCR COM_AXIS tmot temp_ub_q0p75_o48 5 -48.00 143.3 AXIS_PTS_REF STM05SAUB /end AXIS_DESCR
 /begin AXIS_DESCR COM_AXIS nmot nmot_ub_q40 8 0.00 10200. AXIS_PTS_REF SNM08__UB /end AXIS_DESCR
/end CHARACTERISTIC
/begin CHARACTERISTIC KFTVSAKAT "Verzögerungszeit Schubabschalten bei hohen Drehzahlen und hohen KAT-Temperatur" MAP 0x819EFF GkfWUb 10200.0 t40ms_ub_b10200 0.00 10200.0 FUNCTION_LIST BBSAWE IF_DATA DIM_X DIRECT 0x819EFF
 /begin AXIS_DESCR COM_AXIS nmot nmot_ub_q40 8 0.00 10200. AXIS_PTS_REF SNM08__UB /end AXIS_DESCR
 /begin AXIS_DESCR COM_AXIS tkatm temp_ub_q5_o50 4 -50.00 1225. AXIS_PTS_REF STK04SAUB /end AXIS_DESCR
/end CHARACTERISTIC
/begin CHARACTERISTIC KFTVTEV "Kennfeld Verzugszeit Tankentlüftungsventil" MAP 0x81A6ED KfAxUbAyUbSstxUbSstyUbWUb 127.5 t500usxms_ub_q0p5 0.00 127.5 FUNCTION_LIST ATEV IF_DATA DIM_X DIRECT 0x81A6ED /begin AXIS_DESCR STD_AXIS ub spg_ubatt 6 0.00 17.95 DEPOSIT ABSOLUT /end AXIS_DESCR
 /begin AXIS_DESCR STD_AXIS tans temp_ub_q0p75_o48 3 -48.00 143.3 DEPOSIT ABSOLUT /end AXIS_DESCR
/end CHARACTERISTIC
/begin CHARACTERISTIC KFTXFTA "Periodendauer zur Erkennung Feinstleck (>=0,5mm) bei Testeranforderung" MAP 0x829D7C KfAxUbAyUbSstxUbSstyUwWUb 12.75 t50msxs_ub_b12p75 0.00 12.75 FUNCTION_LIST DLDP IF_DATA DIM_X DIRECT 0x829D7C
 /begin AXIS_DESCR STD_AXIS tans temp_ub_q0p75_o48 4 -48.00 143.3 DEPOSIT ABSOLUT /end AXIS_DESCR
 /begin AXIS_DESCR STD_AXIS pukorf_w p_uw_q0p039 4 0.00 2559.961 DEPOSIT ABSOLUT /end AXIS_DESCR
/end CHARACTERISTIC
/begin CHARACTERISTIC KFURL "Umrechnungsfaktor von ps->rl abhängig von NW-Verstellung bei sumode=0" MAP 0x81D42E KfAxUwAyUwSstxUwSstyUwWUw 0.2999954 rel_uw_b0p3 0.00 0.2999954 FUNCTION_LIST BGSRM IF_DATA DIM_X DIRECT 0x81D42E
 /begin AXIS_DESCR STD_AXIS wnwsrm_w kw_q0p0019 6 0.00 127.9980 DEPOSIT ABSOLUT /end AXIS_DESCR
 /begin AXIS_DESCR STD_AXIS nmot_w nmot_uw_q0p25 10 0.00 16383.75 DEPOSIT ABSOLUT /end AXIS_DESCR
/end CHARACTERISTIC
/begin CHARACTERISTIC KFVAKL_0_A "Faktor Verzögerungsabmagerung (K+L-Anteil)" MAP 0x819470 GkfWUb 15.94 fak_ub_b16 0.00 15.94 FUNCTION_LIST ESUK IF_DATA DIM_X INDIRECT 0x815B9A
 /begin AXIS_DESCR COM_AXIS tmot temp_ub_q0p75_o48 9 -48.00 143.3 AXIS_PTS_REF STM09ESUB /end AXIS_DESCR
 /begin AXIS_DESCR COM_AXIS nmot nmot_ub_q40 7 0.00 10200. AXIS_PTS_REF SNM07ESUB /end AXIS_DESCR
/end CHARACTERISTIC
/begin CHARACTERISTIC KFVAKL_1_A "Faktor Verzögerungsabmagerung (K+L-Anteil)" MAP 0x8194AF GkfWUb 15.94 fak_ub_b16 0.00 15.94 FUNCTION_LIST ESUK IF_DATA DIM_X INDIRECT 0x815B9E
 /begin AXIS_DESCR COM_AXIS tmot temp_ub_q0p75_o48 9 -48.00 143.3 AXIS_PTS_REF STM09ESUB /end AXIS_DESCR
 /begin AXIS_DESCR COM_AXIS nmot nmot_ub_q40 7 0.00 10200. AXIS_PTS_REF SNM07ESUB /end AXIS_DESCR
/end CHARACTERISTIC
/begin CHARACTERISTIC KFVALDIF "Wichtungsfaktor Verzögerungsabmagerung für Lambdaist > 1.0" MAP 0x8194EE GkfWUb 0.9961 fak_ub_b1 0.00 0.9961 FUNCTION_LIST ESUK IF_DATA DIM_X DIRECT 0x8194EE
 /begin AXIS_DESCR COM_AXIS tmot temp_ub_q0p75_o48 9 -48.00 143.3 AXIS_PTS_REF STM09ESUB /end AXIS_DESCR
 /begin AXIS_DESCR COM_AXIS ladiff_w fak_sw_b1 5 0.00 1.999969 AXIS_PTS_REF SLA05ESUB /end AXIS_DESCR
/end CHARACTERISTIC
/begin CHARACTERISTIC KFVAWLA "Wichtung VA über lamsbg" MAP 0x81E44E KfAxUbAyUbSstxUbSstyUbWUb 3.984 fak_ub_b4 0.00 3.984 FUNCTION_LIST ESUK IF_DATA DIM_X DIRECT 0x81E44E
 /begin AXIS_DESCR STD_AXIS tmot temp_ub_q0p75_o48 3 -48.00 143.3 DEPOSIT ABSOLUT /end AXIS_DESCR
 /begin AXIS_DESCR STD_AXIS lamsbguk fak_ub_b4 4 0.00 3.984 DEPOSIT ABSOLUT /end AXIS_DESCR
/end CHARACTERISTIC
/begin CHARACTERISTIC KFVERST "Gewichtungskennfeld für Reibmomentenaufsteuerung" MAP 0x82829A KfAxUwAyUwSstxUwSstyUwWUw 7.999878 fak_uw_b8 0.00 7.999878 FUNCTION_LIST MDMIN IF_DATA DIM_X DIRECT 0x82829A
 /begin AXIS_DESCR STD_AXIS wped_w relPED_uw_b100 3 0.00 100.0000 DEPOSIT ABSOLUT /end AXIS_DESCR
 /begin AXIS_DESCR STD_AXIS nmot_w nmot_uw_q0p25 3 0.00 16383.75 DEPOSIT ABSOLUT /end AXIS_DESCR
/end CHARACTERISTIC
/begin CHARACTERISTIC KFVOFFS_0_A "Geschwindigkeits-Offset für FGR-Regler" MAP 0x81CAEE KfAxUwAyUwSstxUwSstyUwWUw 511.9922 vfzg_uw_q0p0078125 0.00 511.9922 FUNCTION_LIST FGRREGL IF_DATA DIM_X INDIRECT 0x813BE2
 /begin AXIS_DESCR STD_AXIS vfgro_w vfzg_uw_q0p0078125 6 0.00 511.9922 DEPOSIT ABSOLUT /end AXIS_DESCR
 /begin AXIS_DESCR STD_AXIS uevges_w fak_q0p1 8 0.00 6553.500 DEPOSIT ABSOLUT /end AXIS_DESCR
/end CHARACTERISTIC
/begin CHARACTERISTIC KFVPDKLD "Max. zulässiges Druckverhältnis DK für ldra Diagnose" MAP 0x81FAF1 KfAxUbAyUbSstxUbSstyUbWUb 3.984 fak_ub_b4 0.00 3.984 FUNCTION_LIST DLDR IF_DATA DIM_X DIRECT 0x81FAF1 /begin AXIS_DESCR STD_AXIS nmot nmot_ub_q40 10 0.00 10200. DEPOSIT ABSOLUT /end AXIS_DESCR /begin AXIS_DESCR STD_AXIS wdkba relDK_ub_b100 12 0.00 100.0 DEPOSIT ABSOLUT /end AXIS_DESCR /end CHARACTERISTIC
/begin CHARACTERISTIC KFVPDKSD "Solldruckverhältnis DK im Dynamikbetrieb" MAP 0x816378 GkfWUw 1.999969 fak_uw_b2 0.00 1.999969 FUNCTION_LIST LDRPLS IF_DATA DIM_X DIRECT 0x816378
 /begin AXIS_DESCR COM_AXIS nmot_w nmot_uw_q0p25 12 0.00 16383.75 AXIS_PTS_REF SNM12LDUW /end AXIS_DESCR
 /begin AXIS_DESCR COM_AXIS vpssplg_w fak_uw_b4 12 0.00 3.999939 AXIS_PTS_REF SVP12LDUW /end AXIS_DESCR
/end CHARACTERISTIC
/begin CHARACTERISTIC KFVPDKSE "Solldruckverhältnis DK im Stationärbetrieb" MAP 0x816498 GkfWUw 1.999969 fak_uw_b2 0.00 1.999969 FUNCTION_LIST LDRPLS IF_DATA DIM_X DIRECT 0x816498
 /begin AXIS_DESCR COM_AXIS nmot_w nmot_uw_q0p25 12 0.00 16383.75 AXIS_PTS_REF SNM12LDUW /end AXIS_DESCR
 /begin AXIS_DESCR COM_AXIS vpssplg_w fak_uw_b4 12 0.00 3.999939 AXIS_PTS_REF SVP12LDUW /end AXIS_DESCR
/end CHARACTERISTIC
/begin CHARACTERISTIC KFVPNLU1 "Benötigte Lüfterdrehzahl für Lüfter 1" MAP 0x81ADD9 KfAxUbAyUbSstxUbSstyUbWUb 5100. nmot_ub_q20 0.00 5100. FUNCTION_LIST KMTR IF_DATA DIM_X DIRECT 0x81ADD9 /begin AXIS_DESCR STD_AXIS qnvp1 m_ub_b1020 6 0.00 1020. DEPOSIT ABSOLUT /end AXIS_DESCR /begin AXIS_DESCR STD_AXIS nmot nmot_ub_q40 6 0.00 10200. DEPOSIT ABSOLUT /end AXIS_DESCR /end CHARACTERISTIC
/begin CHARACTERISTIC KFVPNLU2 "Benötigte Lüfterdrehzahl für Lüfter 2" MAP 0x81AE0B KfAxUbAyUbSstxUbSstyUbWUb 5100. nmot_ub_q20 0.00 5100. FUNCTION_LIST KMTR IF_DATA DIM_X DIRECT 0x81AE0B /begin AXIS_DESCR STD_AXIS qnvp2 m_ub_b1020 6 0.00 1020. DEPOSIT ABSOLUT /end AXIS_DESCR /begin AXIS_DESCR STD_AXIS nmot nmot_ub_q40 6 0.00 10200. DEPOSIT ABSOLUT /end AXIS_DESCR /end CHARACTERISTIC
/begin CHARACTERISTIC KFWDKMSN "Kennfeld für Drosselklappen-Sollwinkel" MAP 0x81D794 KfAxUwAyUwSstxUwSstyUwWUw 99.99847 rel_uw_b100 0.00 99.99847 FUNCTION_LIST FUEDK IF_DATA DIM_X DIRECT 0x81D794
 /begin AXIS_DESCR STD_AXIS mlwdknf_w m_uw_b6553p5 16 0.00 6553.500 DEPOSIT ABSOLUT /end AXIS_DESCR
 /begin AXIS_DESCR STD_AXIS nmot_w nmot_uw_q0p25 6 0.00 16383.75 DEPOSIT ABSOLUT /end AXIS_DESCR
/end CHARACTERISTIC
/begin CHARACTERISTIC KFWDKPP "Ersatzwert für Drosselklappenwinkel aus Füllungssignal" MAP 0x81105F KfAxUbAyUbSstxUbSstyUbWUb 100.0 relDK_ub_b100 0.00 100.0 FUNCTION_LIST GGDVE IF_DATA DIM_X DIRECT 0x81105F /begin AXIS_DESCR STD_AXIS nmot nmot_ub_q40 12 0.00 10200. DEPOSIT ABSOLUT /end AXIS_DESCR /begin AXIS_DESCR STD_AXIS rlvppl rel_ub_q0p75 12 0.00 191.3 DEPOSIT ABSOLUT /end AXIS_DESCR /end CHARACTERISTIC
/begin CHARACTERISTIC KFWDKSMX "maximaler Solldrosselklappenwinkel" MAP 0x815AD6 KfAxUwAyUwSstxUwSstyUwWUw 99.99847 rel_uw_b100 0.00 99.99847 FUNCTION_LIST FUEDK IF_DATA DIM_X DIRECT 0x815AD6
 /begin AXIS_DESCR STD_AXIS nmot_w nmot_uw_q0p25 10 0.00 16383.75 DEPOSIT ABSOLUT /end AXIS_DESCR
 /begin AXIS_DESCR STD_AXIS fho_w fak_uw_b4 3 0.00 3.999939 DEPOSIT ABSOLUT /end AXIS_DESCR
/end CHARACTERISTIC
/begin CHARACTERISTIC KFWDKSST "Sollwert Drosselklappenwinkel im Start" MAP 0x81133B KfAxUbAyUbSstxUbSstyUbWUb 100.0 relDK_ub_b100 0.00 100.0 FUNCTION_LIST WDKSOM IF_DATA DIM_X DIRECT 0x81133B
 /begin AXIS_DESCR STD_AXIS tmst temp_ub_q0p75_o48 12 -48.00 143.3 DEPOSIT ABSOLUT /end AXIS_DESCR
 /begin AXIS_DESCR STD_AXIS nmot nmot_ub_q40 4 0.00 10200. DEPOSIT ABSOLUT /end AXIS_DESCR
/end CHARACTERISTIC
/begin CHARACTERISTIC KFWEE "Kennfeld Winkel Einspritzende" MAP 0x818F79 GkfWUb 1530. zw_ub_q6 0.00 1530. FUNCTION_LIST ESVW IF_DATA DIM_X DIRECT 0x818F79
 /begin AXIS_DESCR COM_AXIS rl rel_ub_q0p75 8 0.00 191.3 AXIS_PTS_REF SRL08GKUB /end AXIS_DESCR
 /begin AXIS_DESCR COM_AXIS nmot nmot_ub_q40 8 0.00 10200. AXIS_PTS_REF SNM08GKUB /end AXIS_DESCR
/end CHARACTERISTIC
/begin CHARACTERISTIC KFWEEK "Kennfeld-Kalt Winkel Einspritzende" MAP 0x818FB9 GkfWUb 1530. zw_ub_q6 0.00 1530. FUNCTION_LIST ESVW IF_DATA DIM_X DIRECT 0x818FB9
 /begin AXIS_DESCR COM_AXIS rl rel_ub_q0p75 8 0.00 191.3 AXIS_PTS_REF SRL08GKUB /end AXIS_DESCR
 /begin AXIS_DESCR COM_AXIS nmot nmot_ub_q40 8 0.00 10200. AXIS_PTS_REF SNM08GKUB /end AXIS_DESCR
/end CHARACTERISTIC
/begin CHARACTERISTIC KFWEEST_0_A "Kennfeld Winkel Einspritzende während Start" MAP 0x811506 KfAxUbAyUbSstxUbSstyUbWUb 1530. zw_ub_q6 0.00 1530. FUNCTION_LIST ESVW IF_DATA DIM_X INDIRECT 0x813FDE
 /begin AXIS_DESCR STD_AXIS tmot temp_ub_q0p75_o48 8 -48.00 143.3 DEPOSIT ABSOLUT /end AXIS_DESCR
 /begin AXIS_DESCR STD_AXIS anztib dez 8 0.00 255.0 DEPOSIT ABSOLUT /end AXIS_DESCR
/end CHARACTERISTIC
/begin CHARACTERISTIC KFWEEST_1_A "Kennfeld Winkel Einspritzende während Start" MAP 0x811558 KfAxUbAyUbSstxUbSstyUbWUb 1530. zw_ub_q6 0.00 1530. FUNCTION_LIST ESVW IF_DATA DIM_X INDIRECT 0x813FE0
 /begin AXIS_DESCR STD_AXIS tmot temp_ub_q0p75_o48 8 -48.00 143.3 DEPOSIT ABSOLUT /end AXIS_DESCR
 /begin AXIS_DESCR STD_AXIS anztib dez 8 0.00 255.0 DEPOSIT ABSOLUT /end AXIS_DESCR
/end CHARACTERISTIC
/begin CHARACTERISTIC KFWEETM "Kennfeld Winkel Einspritzende Temperaturkorrektur" MAP 0x81DFA4 KfAxUbAyUbSstxUbSstyUbWSb 1530. zw_sb_q6 -768.0 762.0 FUNCTION_LIST ESVW IF_DATA DIM_X DIRECT 0x81DFA4
 /begin AXIS_DESCR STD_AXIS tmot temp_ub_q0p75_o48 8 -48.00 143.3 DEPOSIT ABSOLUT /end AXIS_DESCR
 /begin AXIS_DESCR STD_AXIS rl rel_ub_q0p75 6 0.00 191.3 DEPOSIT ABSOLUT /end AXIS_DESCR
/end CHARACTERISTIC
/begin CHARACTERISTIC KFWHSTT_0_A "Wichtungskennfeld Heißstart" MAP 0x811692 KfAxUbAyUbSstxUbSstyUbWUb 1.992 fak_ub_b2 0.00 1.992 FUNCTION_LIST ESSTT IF_DATA DIM_X INDIRECT 0x81599A
 /begin AXIS_DESCR STD_AXIS tans temp_ub_q0p75_o48 6 -48.00 143.3 DEPOSIT ABSOLUT /end AXIS_DESCR
 /begin AXIS_DESCR STD_AXIS anztib dez 8 0.00 255.0 DEPOSIT ABSOLUT /end AXIS_DESCR
/end CHARACTERISTIC
/begin CHARACTERISTIC KFWHSTT_1_A "Wichtungskennfeld Heißstart" MAP 0x8116D2 KfAxUbAyUbSstxUbSstyUbWUb 1.992 fak_ub_b2 0.00 1.992 FUNCTION_LIST ESSTT IF_DATA DIM_X INDIRECT 0x81599C
 /begin AXIS_DESCR STD_AXIS tans temp_ub_q0p75_o48 6 -48.00 143.3 DEPOSIT ABSOLUT /end AXIS_DESCR
 /begin AXIS_DESCR STD_AXIS anztib dez 8 0.00 255.0 DEPOSIT ABSOLUT /end AXIS_DESCR
/end CHARACTERISTIC
/begin CHARACTERISTIC KFWHSTT_2_A "Wichtungskennfeld Heißstart" MAP 0x811712 KfAxUbAyUbSstxUbSstyUbWUb 1.992 fak_ub_b2 0.00 1.992 FUNCTION_LIST ESSTT IF_DATA DIM_X INDIRECT 0x81599E
 /begin AXIS_DESCR STD_AXIS tans temp_ub_q0p75_o48 6 -48.00 143.3 DEPOSIT ABSOLUT /end AXIS_DESCR
 /begin AXIS_DESCR STD_AXIS anztib dez 8 0.00 255.0 DEPOSIT ABSOLUT /end AXIS_DESCR
/end CHARACTERISTIC
/begin CHARACTERISTIC KFWHSTT_3_A "Wichtungskennfeld Heißstart" MAP 0x811752 KfAxUbAyUbSstxUbSstyUbWUb 1.992 fak_ub_b2 0.00 1.992 FUNCTION_LIST ESSTT IF_DATA DIM_X INDIRECT 0x8159A0
 /begin AXIS_DESCR STD_AXIS tans temp_ub_q0p75_o48 6 -48.00 143.3 DEPOSIT ABSOLUT /end AXIS_DESCR
 /begin AXIS_DESCR STD_AXIS anztib dez 8 0.00 255.0 DEPOSIT ABSOLUT /end AXIS_DESCR
/end CHARACTERISTIC
/begin CHARACTERISTIC KFWKSTAB "Faktor Wiederholkaltstart zur Reduzierung der Startmenge" MAP 0x815E1A KfAxUbAyUbSstxUwSstyUbWUb 1.992 fak_ub_b2 0.00 1.992 FUNCTION_LIST ESSTT IF_DATA DIM_X DIRECT 0x815E1A
 /begin AXIS_DESCR STD_AXIS tabst_w t1sxs_uw_q1 4 0.00 65535.00 DEPOSIT ABSOLUT /end AXIS_DESCR
 /begin AXIS_DESCR STD_AXIS tmst temp_ub_q0p75_o48 4 -48.00 143.3 DEPOSIT ABSOLUT /end AXIS_DESCR
/end CHARACTERISTIC
/begin CHARACTERISTIC KFWKSTN "Wichtungskennfeld Kaltstart" MAP 0x811792 KfAxUbAyUbSstxUbSstyUbWUb 0.9961 fak_ub_b1 0.00 0.9961 FUNCTION_LIST ESSTT IF_DATA DIM_X DIRECT 0x811792
 /begin AXIS_DESCR STD_AXIS tmst temp_ub_q0p75_o48 4 -48.00 143.3 DEPOSIT ABSOLUT /end AXIS_DESCR
 /begin AXIS_DESCR STD_AXIS nmot nmot_ub_q40 4 0.00 10200. DEPOSIT ABSOLUT /end AXIS_DESCR
/end CHARACTERISTIC
/begin CHARACTERISTIC KFWMABG "Kennfeld für Wärmemengen-Schwellwert Taupunktende Abgas" MAP 0x81BEAE GkfWUw 29825.71 q_q0p4551 0.00 29825.71 FUNCTION_LIST ATM IF_DATA DIM_X DIRECT 0x81BEAE
 /begin AXIS_DESCR COM_AXIS tabgmst temp_ub_q5_o50 7 -50.00 1225. AXIS_PTS_REF ST107TMUB /end AXIS_DESCR
 /begin AXIS_DESCR COM_AXIS tmst temp_ub_q0p75_o48 5 -48.00 143.3 AXIS_PTS_REF STM05TMUB /end AXIS_DESCR
/end CHARACTERISTIC
/begin CHARACTERISTIC KFWMKAT "Kennfeld für Wärmemengen-Schwellwert Taupunktende hinter Kat" MAP 0x81BEF4 GkfWUw 29825.71 q_q0p4551 0.00 29825.71 FUNCTION_LIST ATM IF_DATA DIM_X DIRECT 0x81BEF4
 /begin AXIS_DESCR COM_AXIS tkatmst temp_ub_q5_o50 7 -50.00 1225. AXIS_PTS_REF ST307TMUB /end AXIS_DESCR
 /begin AXIS_DESCR COM_AXIS tmst temp_ub_q0p75_o48 5 -48.00 143.3 AXIS_PTS_REF STM05TMUB /end AXIS_DESCR
/end CHARACTERISTIC
/begin CHARACTERISTIC KFWNWSAPE "Kennfeld für Nockenwellenspreizung während Applikationsphase Einlass" MAP 0x82A498 KfAxUwAyUwSstxUwSstyUwWSw 511.9922 kw_sw_q0p0078 -256.0000 255.9922 FUNCTION_LIST NWSOLLE IF_DATA DIM_X DIRECT 0x82A498
 /begin AXIS_DESCR STD_AXIS nmot_w nmot_uw_q0p25 12 0.00 16383.75 DEPOSIT ABSOLUT /end AXIS_DESCR
 /begin AXIS_DESCR STD_AXIS rk_w rel_uw_b3072 8 0.00 3071.953 DEPOSIT ABSOLUT /end AXIS_DESCR
/end CHARACTERISTIC
/begin CHARACTERISTIC KFWNWWKA "Wichtungskennfeld für NW-Sollwinkel  Auslaßseitig" MAP 0x81EBF2 KfAxUbAyUbSstxUwSstyUbWUb 1.992 fak_ub_b2 0.00 1.992 FUNCTION_LIST BBKHZ IF_DATA DIM_X DIRECT 0x81EBF2
 /begin AXIS_DESCR STD_AXIS imlpr_w fak_uw_b1 8 0.00 0.9999847 DEPOSIT ABSOLUT /end AXIS_DESCR
 /begin AXIS_DESCR STD_AXIS tmst temp_ub_q0p75_o48 8 -48.00 143.3 DEPOSIT ABSOLUT /end AXIS_DESCR
/end CHARACTERISTIC
/begin CHARACTERISTIC KFWNWWKE_0_A "Wichtungskennfeld für NW-Sollwinkel  Einlaßseitig" MAP 0x81EC4C KfAxUbAyUbSstxUwSstyUbWUb 1.992 fak_ub_b2 0.00 1.992 FUNCTION_LIST BBKHZ IF_DATA DIM_X INDIRECT 0x815CC6
 /begin AXIS_DESCR STD_AXIS imlpr_w fak_uw_b1 8 0.00 0.9999847 DEPOSIT ABSOLUT /end AXIS_DESCR
 /begin AXIS_DESCR STD_AXIS tmst temp_ub_q0p75_o48 8 -48.00 143.3 DEPOSIT ABSOLUT /end AXIS_DESCR
/end CHARACTERISTIC
/begin CHARACTERISTIC KFWNWWKE_1_A "Wichtungskennfeld für NW-Sollwinkel  Einlaßseitig" MAP 0x81ECA6 KfAxUbAyUbSstxUwSstyUbWUb 1.992 fak_ub_b2 0.00 1.992 FUNCTION_LIST BBKHZ IF_DATA DIM_X INDIRECT 0x815CCA
 /begin AXIS_DESCR STD_AXIS imlpr_w fak_uw_b1 8 0.00 0.9999847 DEPOSIT ABSOLUT /end AXIS_DESCR
 /begin AXIS_DESCR STD_AXIS tmst temp_ub_q0p75_o48 8 -48.00 143.3 DEPOSIT ABSOLUT /end AXIS_DESCR
/end CHARACTERISTIC
/begin CHARACTERISTIC KFWPFGR "Inverses Pedalkennfeld für FGR-Betrieb" MAP 0x81CED4 KfAxUwAyUwSstxUwSstyUwWUw 99.99847 rel_uw_b100 0.00 99.99847 FUNCTION_LIST BGWPFGR IF_DATA DIM_X DIRECT 0x81CED4
 /begin AXIS_DESCR STD_AXIS mrfgr_w rel_uw_b200 16 0.00 199.9969 DEPOSIT ABSOLUT /end AXIS_DESCR
 /begin AXIS_DESCR STD_AXIS nmot_w nmot_uw_q0p25 12 0.00 16383.75 DEPOSIT ABSOLUT /end AXIS_DESCR
/end CHARACTERISTIC
/begin CHARACTERISTIC KFWWLML "Kennfeld Wichtung Warmlauffaktor" MAP 0x81145C GkfWUb 1.992 fak_ub_b2 0.00 1.992 FUNCTION_LIST ESNSWL IF_DATA DIM_X DIRECT 0x81145C
 /begin AXIS_DESCR COM_AXIS imlatm_w m_uw_b23p3 6 0.00 23.30133 AXIS_PTS_REF SIM06ESUW /end AXIS_DESCR
 /begin AXIS_DESCR COM_AXIS tmst temp_ub_q0p75_o48 8 -48.00 143.3 AXIS_PTS_REF STS08ESUB /end AXIS_DESCR
/end CHARACTERISTIC
/begin CHARACTERISTIC KFWWNS "Wiederholstartzeitfaktor" MAP 0x81DCD2 KfAxUbAyUbSstxUbSstyUwWUb 1.992 fak_ub_b2 0.00 1.992 FUNCTION_LIST ESNSWL IF_DATA DIM_X DIRECT 0x81DCD2
 /begin AXIS_DESCR STD_AXIS tmst temp_ub_q0p75_o48 8 -48.00 143.3 DEPOSIT ABSOLUT /end AXIS_DESCR
 /begin AXIS_DESCR STD_AXIS tabst_w t1sxs_uw_q1 8 0.00 65535.00 DEPOSIT ABSOLUT /end AXIS_DESCR
/end CHARACTERISTIC
/begin CHARACTERISTIC KFXFTA "Schwelle zur Erkennung Feinstleck (>= 0.5 mm)" MAP 0x829D9A KfAxUbAyUbSstxUbSstyUwWUb 12.75 t50msxs_ub_b12p75 0.00 12.75 FUNCTION_LIST DLDP IF_DATA DIM_X DIRECT 0x829D9A
 /begin AXIS_DESCR STD_AXIS tans temp_ub_q0p75_o48 4 -48.00 143.3 DEPOSIT ABSOLUT /end AXIS_DESCR
 /begin AXIS_DESCR STD_AXIS pukorf_w p_uw_q0p039 4 0.00 2559.961 DEPOSIT ABSOLUT /end AXIS_DESCR
/end CHARACTERISTIC
/begin CHARACTERISTIC KFZDASH_0_A "Zeitkonstante PT1-Filter Dashpot" MAP 0x828E00 GkfWUw 81.880000000 zk10msxs_uw_b655 0.040000000000 81.920000000 FUNCTION_LIST MDFAW IF_DATA DIM_X INDIRECT 0x816A4C /begin AXIS_DESCR COM_AXIS gangi dez 8 0.00 255.0 AXIS_PTS_REF SGA08MDUB /end AXIS_DESCR
 /begin AXIS_DESCR COM_AXIS nmot_w nmot_uw_q0p25 6 0.00 16383.75 AXIS_PTS_REF SNM06MDUW /end AXIS_DESCR
/end CHARACTERISTIC
/begin CHARACTERISTIC KFZDASH_1_A "Zeitkonstante PT1-Filter Dashpot" MAP 0x828E60 GkfWUw 81.880000000 zk10msxs_uw_b655 0.040000000000 81.920000000 FUNCTION_LIST MDFAW IF_DATA DIM_X INDIRECT 0x816A50 /begin AXIS_DESCR COM_AXIS gangi dez 8 0.00 255.0 AXIS_PTS_REF SGA08MDUB /end AXIS_DESCR
 /begin AXIS_DESCR COM_AXIS nmot_w nmot_uw_q0p25 6 0.00 16383.75 AXIS_PTS_REF SNM06MDUW /end AXIS_DESCR
/end CHARACTERISTIC
/begin CHARACTERISTIC KFZDASH2_0_A "Zeitkonstante PT1-Filter Dashpot bei kleinem Kupplungsmoment" MAP 0x828F20 GkfWUw 81.880000000 zk10msxs_uw_b655 0.040000000000 81.920000000 FUNCTION_LIST MDFAW IF_DATA DIM_X INDIRECT 0x816A54 /begin AXIS_DESCR COM_AXIS gangi dez 8 0.00 255.0 AXIS_PTS_REF SGA08MDUB /end AXIS_DESCR
 /begin AXIS_DESCR COM_AXIS nmot_w nmot_uw_q0p25 6 0.00 16383.75 AXIS_PTS_REF SNM06MDUW /end AXIS_DESCR
/end CHARACTERISTIC
/begin CHARACTERISTIC KFZDASH2_1_A "Zeitkonstante PT1-Filter Dashpot bei kleinem Kupplungsmoment" MAP 0x828F80 GkfWUw 81.880000000 zk10msxs_uw_b655 0.040000000000 81.920000000 FUNCTION_LIST MDFAW IF_DATA DIM_X INDIRECT 0x816A58 /begin AXIS_DESCR COM_AXIS gangi dez 8 0.00 255.0 AXIS_PTS_REF SGA08MDUB /end AXIS_DESCR
 /begin AXIS_DESCR COM_AXIS nmot_w nmot_uw_q0p25 6 0.00 16383.75 AXIS_PTS_REF SNM06MDUW /end AXIS_DESCR
/end CHARACTERISTIC
/begin CHARACTERISTIC KFZLSD_0_A "Zeitkonstante PT2-Filter Lastschlagdämpfung" MAP 0x829040 GkfWUw 655.34999985 zk10msxs_uw_b655 0.010000152590 655.36000000 FUNCTION_LIST MDFAW IF_DATA DIM_X INDIRECT 0x816A5C /begin AXIS_DESCR COM_AXIS gangi dez 8 0.00 255.0 AXIS_PTS_REF SGA08MDUB /end AXIS_DESCR
 /begin AXIS_DESCR COM_AXIS nmot_w nmot_uw_q0p25 6 0.00 16383.75 AXIS_PTS_REF SNM06MDUW /end AXIS_DESCR
/end CHARACTERISTIC
/begin CHARACTERISTIC KFZNSM "Zeitkonstante für Solldrehzahlabregelung" MAP 0x819F7B GkfWUb 5.08000 zk20msxs_ub_b5p1 0.0200000 5.10000 FUNCTION_LIST LLRNS IF_DATA DIM_X DIRECT 0x819F7B
 /begin AXIS_DESCR COM_AXIS tmot temp_ub_q0p75_o48 6 -48.00 143.3 AXIS_PTS_REF STM06LLUB /end AXIS_DESCR
 /begin AXIS_DESCR COM_AXIS dns nmotd_sb_q10 6 -1280. 1270. AXIS_PTS_REF SNS06LLSB /end AXIS_DESCR
/end CHARACTERISTIC
/begin CHARACTERISTIC KFZW "Zündwinkelkennfeld" MAP 0x812AD0 GkfWSb 191.3 zw_sb_q0p75 -96.00 95.25 FUNCTION_LIST ZWGRU IF_DATA DIM_X DIRECT 0x812AD0
 /begin AXIS_DESCR COM_AXIS nmot_w nmot_uw_q0p25 16 0.00 16383.75 AXIS_PTS_REF SNM16ZUUW /end AXIS_DESCR
 /begin AXIS_DESCR COM_AXIS rl_w rel_uw_q0p0234 12 0.00 1535.977 AXIS_PTS_REF SRL12ZUUW /end AXIS_DESCR
/end CHARACTERISTIC
/begin CHARACTERISTIC KFZW2 "Zündwinkelkennfeld Variante 2" MAP 0x812B90 GkfWSb 191.3 zw_sb_q0p75 -96.00 95.25 FUNCTION_LIST ZWGRU IF_DATA DIM_X DIRECT 0x812B90
 /begin AXIS_DESCR COM_AXIS nmot_w nmot_uw_q0p25 16 0.00 16383.75 AXIS_PTS_REF SNM16ZUUW /end AXIS_DESCR
 /begin AXIS_DESCR COM_AXIS rl_w rel_uw_q0p0234 12 0.00 1535.977 AXIS_PTS_REF SRL12ZUUW /end AXIS_DESCR
/end CHARACTERISTIC
/begin CHARACTERISTIC KFZWMN_0_A "Min-Zündwinkel" MAP 0x812887 GkfWSb 191.3 zw_sb_q0p75 -96.00 95.25 FUNCTION_LIST ZWMIN IF_DATA DIM_X INDIRECT 0x8175C0
 /begin AXIS_DESCR COM_AXIS nmot_w nmot_uw_q0p25 16 0.00 16383.75 AXIS_PTS_REF SNM16ZUUW /end AXIS_DESCR
 /begin AXIS_DESCR COM_AXIS rl_w rel_uw_q0p0234 12 0.00 1535.977 AXIS_PTS_REF SRL12ZUUW /end AXIS_DESCR
/end CHARACTERISTIC
/begin CHARACTERISTIC KFZWMN_1_A "Min-Zündwinkel" MAP 0x812947 GkfWSb 191.3 zw_sb_q0p75 -96.00 95.25 FUNCTION_LIST ZWMIN IF_DATA DIM_X INDIRECT 0x8175C2
 /begin AXIS_DESCR COM_AXIS nmot_w nmot_uw_q0p25 16 0.00 16383.75 AXIS_PTS_REF SNM16ZUUW /end AXIS_DESCR
 /begin AXIS_DESCR COM_AXIS rl_w rel_uw_q0p0234 12 0.00 1535.977 AXIS_PTS_REF SRL12ZUUW /end AXIS_DESCR
/end CHARACTERISTIC
/begin CHARACTERISTIC KFZWMNKH "Min-Zündwinkel Katheizen" MAP 0x8179C2 KfAxUbAyUbSstxUbSstyUbWSb 191.3 zw_sb_q0p75 -96.00 95.25 FUNCTION_LIST ZWMIN IF_DATA DIM_X DIRECT 0x8179C2 /begin AXIS_DESCR STD_AXIS nmot nmot_ub_q40 16 0.00 10200. DEPOSIT ABSOLUT /end AXIS_DESCR /begin AXIS_DESCR STD_AXIS rl rel_ub_q0p75 12 0.00 191.3 DEPOSIT ABSOLUT /end AXIS_DESCR /end CHARACTERISTIC
/begin CHARACTERISTIC KFZWMNST "Min-Zündwinkel für Start und Nachstart" MAP 0x817AA0 KfAxUbAyUbSstxUbSstyUbWSb 191.3 zw_sb_q0p75 -96.00 95.25 FUNCTION_LIST ZWMIN IF_DATA DIM_X DIRECT 0x817AA0 /begin AXIS_DESCR STD_AXIS nmot nmot_ub_q40 16 0.00 10200. DEPOSIT ABSOLUT /end AXIS_DESCR /begin AXIS_DESCR STD_AXIS rl rel_ub_q0p75 12 0.00 191.3 DEPOSIT ABSOLUT /end AXIS_DESCR /end CHARACTERISTIC
/begin CHARACTERISTIC KFZWMS "Kennfeld mit dauerhaft spätest möglichem Zündwinkel" MAP 0x812A07 GkfWSb 191.3 zw_sb_q0p75 -96.00 95.25 FUNCTION_LIST ZWMIN IF_DATA DIM_X DIRECT 0x812A07
 /begin AXIS_DESCR COM_AXIS nmot_w nmot_uw_q0p25 16 0.00 16383.75 AXIS_PTS_REF SNM16ZUUW /end AXIS_DESCR
 /begin AXIS_DESCR COM_AXIS rl_w rel_uw_q0p0234 12 0.00 1535.977 AXIS_PTS_REF SRL12ZUUW /end AXIS_DESCR
/end CHARACTERISTIC
/begin CHARACTERISTIC KFZWOP "optimaler Zündwinkel" MAP 0x811FEA GkfWSb 191.3 zw_sb_q0p75 -96.00 95.25 FUNCTION_LIST MDBAS IF_DATA DIM_X DIRECT 0x811FEA
 /begin AXIS_DESCR COM_AXIS nmot_w nmot_uw_q0p25 16 0.00 16383.75 AXIS_PTS_REF SNM16OPUW /end AXIS_DESCR
 /begin AXIS_DESCR COM_AXIS rl_w rel_uw_q0p0234 11 0.00 1535.977 AXIS_PTS_REF SRL11OPUW /end AXIS_DESCR
/end CHARACTERISTIC
/begin CHARACTERISTIC KFZWOP2 "optimaler Zündwinkel Variante 2" MAP 0x81209A GkfWSb 191.3 zw_sb_q0p75 -96.00 95.25 FUNCTION_LIST MDBAS IF_DATA DIM_X DIRECT 0x81209A
 /begin AXIS_DESCR COM_AXIS nmot_w nmot_uw_q0p25 16 0.00 16383.75 AXIS_PTS_REF SNM16OPUW /end AXIS_DESCR
 /begin AXIS_DESCR COM_AXIS rl_w rel_uw_q0p0234 11 0.00 1535.977 AXIS_PTS_REF SRL11OPUW /end AXIS_DESCR
/end CHARACTERISTIC
/begin CHARACTERISTIC KFZWSTTM "Zündwinkel im Start" MAP 0x817BA2 KfAxUbAyUbSstxUbSstyUbWSb 191.3 zw_sb_q0p75 -96.00 95.25 FUNCTION_LIST ZWSTT IF_DATA DIM_X DIRECT 0x817BA2 /begin AXIS_DESCR STD_AXIS nmot nmot_ub_q40 6 0.00 10200. DEPOSIT ABSOLUT /end AXIS_DESCR
 /begin AXIS_DESCR STD_AXIS tmst temp_ub_q0p75_o48 6 -48.00 143.3 DEPOSIT ABSOLUT /end AXIS_DESCR
/end CHARACTERISTIC
/begin CHARACTERISTIC KFZWWLNM "Delta Zündwinkel im Warmlauf" MAP 0x812C98 GkfWSb 191.3 zw_sb_q0p75 -96.00 95.25 FUNCTION_LIST ZWWL IF_DATA DIM_X DIRECT 0x812C98
 /begin AXIS_DESCR COM_AXIS nmot nmot_ub_q40 12 0.00 10200. AXIS_PTS_REF SNM12ESUB /end AXIS_DESCR
 /begin AXIS_DESCR COM_AXIS tans temp_ub_q0p75_o48 12 -48.00 143.3 AXIS_PTS_REF STA12WLUB /end AXIS_DESCR
/end CHARACTERISTIC
/begin CHARACTERISTIC KFZWWLRL "Delta Zündwinkel im Warmlauf" MAP 0x812D28 GkfWSb 191.3 zw_sb_q0p75 -96.00 95.25 FUNCTION_LIST ZWWL IF_DATA DIM_X DIRECT 0x812D28
 /begin AXIS_DESCR COM_AXIS tmot temp_ub_q0p75_o48 12 -48.00 143.3 AXIS_PTS_REF STM12ESUB /end AXIS_DESCR
 /begin AXIS_DESCR COM_AXIS rl rel_ub_q0p75 6 0.00 191.3 AXIS_PTS_REF SRL06ESUB /end AXIS_DESCR
/end CHARACTERISTIC
/begin CHARACTERISTIC KFZW_UC "Kennfeld für optimalen Zündwinkel im Befehlstest" MAP 0x81254D GkfWSb 191.3 zw_sb_q0p75 -96.00 95.25 FUNCTION_LIST URCMIST IF_DATA DIM_X DIRECT 0x81254D
 /begin AXIS_DESCR COM_AXIS rl_uc rel_ub_q0p75 8 0.00 191.3 AXIS_PTS_REF RLV08_UC /end AXIS_DESCR
 /begin AXIS_DESCR COM_AXIS nmot_uc nmot_ub_q40 8 0.00 10200. AXIS_PTS_REF NZWV08_UC /end AXIS_DESCR
/end CHARACTERISTIC
/begin CHARACTERISTIC KFZW_UM "Kennfeld für optimalen Zündwinkel in der Funktionsüberwachung" MAP 0x8140DD GkfWSb 191.3 zw_sb_q0p75 -96.00 95.25 FUNCTION_LIST UFMIST IF_DATA DIM_X DIRECT 0x8140DD
 /begin AXIS_DESCR COM_AXIS rl_um rel_ub_q0p75 8 0.00 191.3 AXIS_PTS_REF RLV08_UM /end AXIS_DESCR
 /begin AXIS_DESCR COM_AXIS nmot_um nmot_ub_q40 8 0.00 10200. AXIS_PTS_REF NZWV08_UM /end AXIS_DESCR
/end CHARACTERISTIC
/begin CHARACTERISTIC KHCTEAMX "Maximalwert HC-Konzentration Regeneriergas Tankentlüftung(bei B_abor)" VALUE 0x81A6A5 KwSb 3.984 fak_sb_b2 -2.000 1.984 FUNCTION_LIST TEB IF_DATA DIM_X DIRECT 0x81A6A5 /end CHARACTERISTIC
/begin CHARACTERISTIC KHCTEMN "Minimalwert HC-Konzentration Regeneriergas Tankentlüftung" VALUE 0x81A6A6 KwSb 3.984 fak_sb_b2 -2.000 1.984 FUNCTION_LIST TEB IF_DATA DIM_X DIRECT 0x81A6A6 /end CHARACTERISTIC
/begin CHARACTERISTIC KHCTEMX "Maximalwert HC-Konzentration Regeneriergas Tankentlüftung" VALUE 0x81A6A7 KwSb 3.984 fak_sb_b2 -2.000 1.984 FUNCTION_LIST TEB IF_DATA DIM_X DIRECT 0x81A6A7 /end CHARACTERISTIC
/begin CHARACTERISTIC KIDMSNTE "Integrationsgeschwindigkeit für die Berechnung der Massenstromänderung TEV" VALUE 0x829D18 KwUw 127.9980 m_q0p00195 0.00 127.9980 FUNCTION_LIST DTEV IF_DATA DIM_X DIRECT 0x829D18 /end CHARACTERISTIC
/begin CHARACTERISTIC KIFZCVT "Integratorverstärkung des Fahrzeugmodells bei CVT" CURVE 0x8284A0 GklWUw 4863.926 fak_uw_b4864 0.00 4863.926 FUNCTION_LIST ARMD IF_DATA DIM_X DIRECT 0x8284A0
 /begin AXIS_DESCR COM_AXIS uefktget uefktget_ub_b25p4 7 0.00 25.50 AXIS_PTS_REF SUV07MDUB /end AXIS_DESCR
/end CHARACTERISTIC
/begin CHARACTERISTIC KIFZGHG_0_A "Integratorverstärkung des Fahrzeugmodells bei Handschalter" CURVE 0x8284BE FklWUw 4863.926 fak_uw_b4864 0.00 4863.926 FUNCTION_LIST ARMD IF_DATA DIM_X INDIRECT 0x8162D0 /begin AXIS_DESCR FIX_AXIS gangi dez 8 0.00 7.000 FIX_AXIS_PAR 0 0 8 /end AXIS_DESCR /end CHARACTERISTIC
/begin CHARACTERISTIC KIFZGHG_1_A "Integratorverstärkung des Fahrzeugmodells bei Handschalter" CURVE 0x8284CE FklWUw 4863.926 fak_uw_b4864 0.00 4863.926 FUNCTION_LIST ARMD IF_DATA DIM_X INDIRECT 0x8162D4 /begin AXIS_DESCR FIX_AXIS gangi dez 8 0.00 7.000 FIX_AXIS_PAR 0 0 8 /end AXIS_DESCR /end CHARACTERISTIC
/begin CHARACTERISTIC KIMSALL "Beiwert für Leerlaufluftmassenintegrator für E-Gas" VALUE 0x81D5C2 KwUw 2559.0000000 mk1sxs_b2560 1.0000000000 2560.0000000 FUNCTION_LIST BGMSZS IF_DATA DIM_X DIRECT 0x81D5C2 /end CHARACTERISTIC
/begin CHARACTERISTIC KINMXNL "Verstärkung Integralanteil der NMAX-Regelung bei stromloser Drosselklappe" VALUE 0x81214C KwUb 5.080 relnmot_q0p02 0.02000 5.100 FUNCTION_LIST NMAXMD IF_DATA DIM_X DIRECT 0x81214C /end CHARACTERISTIC
/begin CHARACTERISTIC KINMXRLG "Verstärkung Integralanteil der NMAX-Regelung im Normalbetrieb" MAP 0x81A355 GkfWUb 5.100 relnmot_q0p02 0.00 5.100 FUNCTION_LIST NMAXMD IF_DATA DIM_X DIRECT 0x81A355
 /begin AXIS_DESCR COM_AXIS rl rel_ub_q0p75 8 0.00 191.3 AXIS_PTS_REF SRL08NXUB /end AXIS_DESCR
 /begin AXIS_DESCR COM_AXIS gangi dez 8 0.00 255.0 AXIS_PTS_REF SGA08MDUB /end AXIS_DESCR
/end CHARACTERISTIC
/begin CHARACTERISTIC KIRMSMS "Integrationsgeschwindigkeit Abgleich Massenstrom TEV mit berechnetem Massenstrom" CURVE 0x817838 KlAUbSstUbWUw 2498.970 fak_q0p03815 0.9918213 2499.962 FUNCTION_LIST DTEV IF_DATA DIM_X DIRECT 0x817838 /begin AXIS_DESCR STD_AXIS mstedte m_ub_b25p6 4 0.00 25.50 DEPOSIT ABSOLUT /end AXIS_DESCR /end CHARACTERISTIC
/begin CHARACTERISTIC KIVMXG "Verstärkungsfaktor I-Anteil der VMAX-Regelung" CURVE 0x82953C FklWUw 499.984741 rel_q0p007629 0.00762939453 499.992371 FUNCTION_LIST VMAXMD IF_DATA DIM_X DIRECT 0x82953C /begin AXIS_DESCR FIX_AXIS gangi dez 8 0.00 7.000 FIX_AXIS_PAR 0 0 8 /end AXIS_DESCR /end CHARACTERISTIC
/begin CHARACTERISTIC KKFFGRGA_0_A "Verstärkungsfaktor bei Konstantfahrt für FGR-Regler" CURVE 0x81CC6E KlAUwSstUwWUw 3199.951 rel_uw_b3200 0.00 3199.951 FUNCTION_LIST FGRREGL IF_DATA DIM_X INDIRECT 0x813BEA /begin AXIS_DESCR STD_AXIS uevges_w fak_q0p1 8 0.00 6553.500 DEPOSIT ABSOLUT /end AXIS_DESCR /end CHARACTERISTIC
/begin CHARACTERISTIC KKFFGRGA_1_A "Verstärkungsfaktor bei Konstantfahrt für FGR-Regler" CURVE 0x81CC90 KlAUwSstUwWUw 3199.951 rel_uw_b3200 0.00 3199.951 FUNCTION_LIST FGRREGL IF_DATA DIM_X INDIRECT 0x813BEE /begin AXIS_DESCR STD_AXIS uevges_w fak_q0p1 8 0.00 6553.500 DEPOSIT ABSOLUT /end AXIS_DESCR /end CHARACTERISTIC
/begin CHARACTERISTIC KLAF "Ausflußkennlinie" CURVE 0x81549C FklWUw 0.9999847 fak_uw_b1 0.00 0.9999847 FUNCTION_LIST BGMSZS BGRLP FUEDK IF_DATA DIM_X DIRECT 0x81549C
 /begin AXIS_DESCR FIX_AXIS klaf_kge fak_uw_q0p001 501 0.5000000 1.000000 FIX_AXIS_PAR 500 0 501 /end AXIS_DESCR
/end CHARACTERISTIC
/begin CHARACTERISTIC KLAFTE "Ausflußkennlinie für TEV incl. Leitung AKF-TEV" CURVE 0x8178D2 KlAUwSstUwWUw 1.999969 fak_uw_b2 0.00 1.999969 FUNCTION_LIST BGTEV IF_DATA DIM_X DIRECT 0x8178D2
 /begin AXIS_DESCR STD_AXIS phtevpu_w fak_uw_b2 14 0.00 1.999969 DEPOSIT ABSOLUT /end AXIS_DESCR
/end CHARACTERISTIC
/begin CHARACTERISTIC KLAH1 " Kühlleistungsanhebung Stufe 1" VALUE 0x81AE3D KwUb 191.3 temp_ub_q0p75_o48 -48.00 143.3 FUNCTION_LIST KMTR IF_DATA DIM_X DIRECT 0x81AE3D /end CHARACTERISTIC
/begin CHARACTERISTIC KLAH2 "Kühlleistungsanhebung Stufe 2" VALUE 0x81AE3E KwUb 191.3 temp_ub_q0p75_o48 -48.00 143.3 FUNCTION_LIST KMTR IF_DATA DIM_X DIRECT 0x81AE3E /end CHARACTERISTIC
/begin CHARACTERISTIC KLAHEW "Ersatzwert Kühlleistungsanhebung" VALUE 0x81AE3F KwUb 255.0 dez 0.00 255.0 FUNCTION_LIST KMTR IF_DATA DIM_X DIRECT 0x81AE3F /end CHARACTERISTIC
/begin CHARACTERISTIC KLAHTMSMX1 "Kühlleistungsanhebung bei 1.  max. Motorsolltemperatur" VALUE 0x81AE40 KwUb 191.3 temp_ub_q0p75_o48 -48.00 143.3 FUNCTION_LIST KMTR IF_DATA DIM_X DIRECT 0x81AE40 /end CHARACTERISTIC
/begin CHARACTERISTIC KLAHTMSMX2 "Kühlleistungsanhebung bei 2. max. Motorsolltemperatur" VALUE 0x81AE41 KwUb 191.3 temp_ub_q0p75_o48 -48.00 143.3 FUNCTION_LIST KMTR IF_DATA DIM_X DIRECT 0x81AE41 /end CHARACTERISTIC
/begin CHARACTERISTIC KLAHTVLUE1 "Tastverhältnis Lüfteransteuerung 1 bei max. Kühlleistungsanhebung" VALUE 0x81AE42 KwUb 99.61 rel_ub_b100 0.00 99.61 FUNCTION_LIST KMTR IF_DATA DIM_X DIRECT 0x81AE42 /end CHARACTERISTIC
/begin CHARACTERISTIC KLAHTVLUE2 "Tastverhältnis Lüfteransteuerung 2 bei max. Kühlleistungsanhebung" VALUE 0x81AE43 KwUb 99.61 rel_ub_b100 0.00 99.61 FUNCTION_LIST KMTR IF_DATA DIM_X DIRECT 0x81AE43 /end CHARACTERISTIC
/begin CHARACTERISTIC KLANFVFZ "Korrekturkennlinie Lüfteransteuerung in Abhängigkeit  vom Anfahrverhalten" CURVE 0x81AE44 KlAUbSstUbWUb 0.9961 fak_ub_b1 0.00 0.9961 FUNCTION_LIST KMTR IF_DATA DIM_X DIRECT 0x81AE44
 /begin AXIS_DESCR STD_AXIS vfzgkmtr vfzg_ub_q1p25 5 0.00 318.8 DEPOSIT ABSOLUT /end AXIS_DESCR
/end CHARACTERISTIC
/begin CHARACTERISTIC KLATMILAE "Exotherme Temperaturabnahme bei Anfettung tikatm" CURVE 0x818634 GklWUb 1.992 fak_ub_b2 0.00 1.992 FUNCTION_LIST ATM IF_DATA DIM_X DIRECT 0x818634
 /begin AXIS_DESCR COM_AXIS lamsbg_w fak_uw_b16 6 0.00 15.99976 AXIS_PTS_REF SLX06TMUW /end AXIS_DESCR
/end CHARACTERISTIC
/begin CHARACTERISTIC KLATMIZWE "Exotherme Temperaturabnahme im Kat bei späterem Zündwinkel tikatm" CURVE 0x81863A GklWUb 1.992 fak_ub_b2 0.00 1.992 FUNCTION_LIST ATM IF_DATA DIM_X DIRECT 0x81863A
 /begin AXIS_DESCR COM_AXIS etazwimt rel_ub_b127p5 6 0.00 127.5 AXIS_PTS_REF SEZ06TMUB /end AXIS_DESCR
/end CHARACTERISTIC
/begin CHARACTERISTIC KLATMLAE "Exotherme Temperaturabnahme bei Anfettung" CURVE 0x818640 GklWUb 1.992 fak_ub_b2 0.00 1.992 FUNCTION_LIST ATM IF_DATA DIM_X DIRECT 0x818640
 /begin AXIS_DESCR COM_AXIS lamsbg_w fak_uw_b16 6 0.00 15.99976 AXIS_PTS_REF SLX06TMUW /end AXIS_DESCR
/end CHARACTERISTIC
/begin CHARACTERISTIC KLATMZWE "Exotherme Temperaturabnahme im Kat bei späterem Zündwinkel tkatm" CURVE 0x818646 GklWUb 1.992 fak_ub_b2 0.00 1.992 FUNCTION_LIST ATM IF_DATA DIM_X DIRECT 0x818646
 /begin AXIS_DESCR COM_AXIS etazwimt rel_ub_b127p5 6 0.00 127.5 AXIS_PTS_REF SEZ06TMUB /end AXIS_DESCR
/end CHARACTERISTIC
/begin CHARACTERISTIC KLDFAB "Gradientenbegrenzung für kldfpwm" VALUE 0x810056 KwUb 99.22 rel_ub_b99p6 0.3906 99.61 FUNCTION_LIST GGKLDF IF_DATA DIM_X DIRECT 0x810056 /end CHARACTERISTIC
/begin CHARACTERISTIC KLDMASRL "Stellreserve bei ASR-Eingriff" CURVE 0x810194 KlAUbSstUbWUb 99.61 rel_ub_b99p6 0.00 99.61 FUNCTION_LIST GGCASR IF_DATA DIM_X DIRECT 0x810194 /begin AXIS_DESCR STD_AXIS nmot nmot_ub_q40 5 0.00 10200. DEPOSIT ABSOLUT /end AXIS_DESCR /end CHARACTERISTIC
/begin CHARACTERISTIC KLDMMX "Maximal zulässige Momentenreserven" CURVE 0x812222 KlAUbSstUbWUb 99.61 rel_ub_b99p6 0.00 99.61 FUNCTION_LIST MDZUL IF_DATA DIM_X DIRECT 0x812222 /begin AXIS_DESCR STD_AXIS nmot nmot_ub_q40 8 0.00 10200. DEPOSIT ABSOLUT /end AXIS_DESCR /end CHARACTERISTIC
/begin CHARACTERISTIC KLDNFHO "Wichtung Minimaler Drehzahlanstieg für erkannte Verbrennung" CURVE 0x819082 KlAUbSstUbWUb 1.992 fak_ub_b2 0.00 1.992 FUNCTION_LIST STADAP IF_DATA DIM_X DIRECT 0x819082 /begin AXIS_DESCR STD_AXIS fho fak_ub_b4 4 0.00 3.984 DEPOSIT ABSOLUT /end AXIS_DESCR /end CHARACTERISTIC
/begin CHARACTERISTIC KLDPDK "Druckabfall über Drosselklappe" CURVE 0x81D884 KlAUwSstUwWUw 2559.961 p_uw_q0p039 0.00 2559.961 FUNCTION_LIST FUEDK IF_DATA DIM_X DIRECT 0x81D884
 /begin AXIS_DESCR STD_AXIS mlkge_w m_uw_b6553p5 16 0.00 6553.500 DEPOSIT ABSOLUT /end AXIS_DESCR
/end CHARACTERISTIC
/begin CHARACTERISTIC KLDTPH "Festwertkennlinie eines Gewichtungsfaktors für die Dynamikbewertung" CURVE 0x810FCE FklWUb 0.9961 fak_q0p0039 0.00 0.9961 FUNCTION_LIST NLDG IF_DATA DIM_X DIRECT 0x810FCE
 /begin AXIS_DESCR FIX_AXIS dtsegph_w t5usxus_q5 16 -40960.00 40955.00 FIX_AXIS_PAR -8192 10 16 /end AXIS_DESCR
/end CHARACTERISTIC
/begin CHARACTERISTIC KLDTPHST "Festwertkennlinie eines Gewichtungsfaktors für Motorstart" CURVE 0x810FDE FklWUb 0.9961 fak_q0p0039 0.00 0.9961 FUNCTION_LIST NLDG IF_DATA DIM_X DIRECT 0x810FDE
 /begin AXIS_DESCR FIX_AXIS dtsegph_w t5usxus_q5 16 -40960.00 40955.00 FIX_AXIS_PAR -8192 10 16 /end AXIS_DESCR
/end CHARACTERISTIC
/begin CHARACTERISTIC KLDTUMTA "Offset Ansauglufttemperatur -> Umgebungstemperatur" CURVE 0x81E4C4 KlAUbSstUbWSb 191.3 temp_sb_q0p75 -96.00 95.25 FUNCTION_LIST BGTUMG IF_DATA DIM_X DIRECT 0x81E4C4
 /begin AXIS_DESCR STD_AXIS tans temp_ub_q0p75_o48 4 -48.00 143.3 DEPOSIT ABSOLUT /end AXIS_DESCR
/end CHARACTERISTIC
/begin CHARACTERISTIC KLETAZW_UC "ZW-Wirkungsgrad in Abhängigkeit von delta ZW im Befehlstest" CURVE 0x81258D KlAUbSstUbWUb 100.0 rel_ub_b127p5 0.00 100.0 FUNCTION_LIST URCMIST IF_DATA DIM_X DIRECT 0x81258D /begin AXIS_DESCR STD_AXIS dzw_uc zw_ub_q0p75 8 0.00 191.3 DEPOSIT ABSOLUT /end AXIS_DESCR /end CHARACTERISTIC
/begin CHARACTERISTIC KLETAZW_UM "ZW-Wirkungsgrad in Abhängigkeit von delta ZW in der Funktionsüberwachung" CURVE 0x81411D KlAUbSstUbWUb 100.0 rel_ub_b127p5 0.00 100.0 FUNCTION_LIST UFMIST IF_DATA DIM_X DIRECT 0x81411D /begin AXIS_DESCR STD_AXIS dzw_um zw_ub_q0p75 8 0.00 191.3 DEPOSIT ABSOLUT /end AXIS_DESCR /end CHARACTERISTIC
/begin CHARACTERISTIC KLFDQV "Geschwindigkeitsabhängiger Absteuerfaktor des Wärmeüberschusses" CURVE 0x81AE4F KlAUbSstUbWUb 0.9961 fak_ub_b1 0.00 0.9961 FUNCTION_LIST KMTR IF_DATA DIM_X DIRECT 0x81AE4F
 /begin AXIS_DESCR STD_AXIS vfzgkmtr vfzg_ub_q1p25 4 0.00 318.8 DEPOSIT ABSOLUT /end AXIS_DESCR
/end CHARACTERISTIC
/begin CHARACTERISTIC KLFMKNM "Korrekturfaktor bei Kompressormoment über CAN" CURVE 0x82831E KlAUwSstUwWUw 6.999878 fak_uw_b8 1.000000 7.999878 FUNCTION_LIST MDVERB IF_DATA DIM_X DIRECT 0x82831E /begin AXIS_DESCR STD_AXIS nmot nmot_ub_q40 4 0.00 2621400. DEPOSIT ABSOLUT /end AXIS_DESCR /end CHARACTERISTIC
/begin CHARACTERISTIC KLFNWA "Wichtung Nockenwelle Auslaß" CURVE 0x812797 KlAUbSstUbWUb 0.9961 fak_ub_b1 0.00 0.9961 FUNCTION_LIST NWFW IF_DATA DIM_X DIRECT 0x812797 /begin AXIS_DESCR STD_AXIS fnwua fak_ub_b1 6 0.00 0.9961 DEPOSIT ABSOLUT /end AXIS_DESCR /end CHARACTERISTIC
/begin CHARACTERISTIC KLFQKV "Geschwindigkeitsabhängiger Absteuerfaktor des Wärmestroms Klimakondensator" CURVE 0x81AE58 KlAUbSstUbWUb 0.9961 fak_ub_b1 0.00 0.9961 FUNCTION_LIST KMTR IF_DATA DIM_X DIRECT 0x81AE58
 /begin AXIS_DESCR STD_AXIS vfzgkmtr vfzg_ub_q1p25 4 0.00 318.8 DEPOSIT ABSOLUT /end AXIS_DESCR
/end CHARACTERISTIC
/begin CHARACTERISTIC KLFRTMKI "Kennlinie Regelfaktor aus Motortemperatur" CURVE 0x81A43C KlAUbSstUbWUb 1.992 fak_ub_b2 0.00 1.992 FUNCTION_LIST MDBGRG IF_DATA DIM_X DIRECT 0x81A43C
 /begin AXIS_DESCR STD_AXIS tmki temp_ub_q0p75_o48 4 -48.00 143.3 DEPOSIT ABSOLUT /end AXIS_DESCR
/end CHARACTERISTIC
/begin CHARACTERISTIC KLFZWMNKH_0_A "Abregelsteilheit der Brenngrenze im Nachstart bei Katheizen" CURVE 0x82AF4E KlAUbSstUbWUw 655.34999985 zk10msxs_uw_b655 0.010000152590 655.36000000 FUNCTION_LIST ZWMIN IF_DATA DIM_X INDIRECT 0x8175B0
 /begin AXIS_DESCR STD_AXIS tmot temp_ub_q0p75_o48 6 -48.00 143.3 DEPOSIT ABSOLUT /end AXIS_DESCR
/end CHARACTERISTIC
/begin CHARACTERISTIC KLFZWMNKH_1_A "Abregelsteilheit der Brenngrenze im Nachstart bei Katheizen" CURVE 0x82AF62 KlAUbSstUbWUw 655.34999985 zk10msxs_uw_b655 0.010000152590 655.36000000 FUNCTION_LIST ZWMIN IF_DATA DIM_X INDIRECT 0x8175B4
 /begin AXIS_DESCR STD_AXIS tmot temp_ub_q0p75_o48 6 -48.00 143.3 DEPOSIT ABSOLUT /end AXIS_DESCR
/end CHARACTERISTIC
/begin CHARACTERISTIC KLFZWMNST_0_A "Abregelsteilheit der Brenngrenze im Nachstart" CURVE 0x82AF76 KlAUbSstUbWUw 655.34999985 zk10msxs_uw_b655 0.010000152590 655.36000000 FUNCTION_LIST ZWMIN IF_DATA DIM_X INDIRECT 0x8175B8
 /begin AXIS_DESCR STD_AXIS tmot temp_ub_q0p75_o48 6 -48.00 143.3 DEPOSIT ABSOLUT /end AXIS_DESCR
/end CHARACTERISTIC
/begin CHARACTERISTIC KLFZWMNST_1_A "Abregelsteilheit der Brenngrenze im Nachstart" CURVE 0x82AF8A KlAUbSstUbWUw 655.34999985 zk10msxs_uw_b655 0.010000152590 655.36000000 FUNCTION_LIST ZWMIN IF_DATA DIM_X INDIRECT 0x8175BC
 /begin AXIS_DESCR STD_AXIS tmot temp_ub_q0p75_o48 6 -48.00 143.3 DEPOSIT ABSOLUT /end AXIS_DESCR
/end CHARACTERISTIC
/begin CHARACTERISTIC KLITHMS "Kennlinie integrierte Luftmassenschwelle für Thermostat-Monitoring THM" CURVE 0x819769 KlAUbSstUbWUb 23.21 m_ub_b23p3 0.00 23.21 FUNCTION_LIST GGTFM IF_DATA DIM_X DIRECT 0x819769
 /begin AXIS_DESCR STD_AXIS tmotlinst temp_ub_q0p75_o48 4 -48.00 143.3 DEPOSIT ABSOLUT /end AXIS_DESCR
/end CHARACTERISTIC
/begin CHARACTERISTIC KLLAKHFH "Umgebungsdruckkorrektur Lambda Katheizen" CURVE 0x81F7A4 KlAUwSstUwWUw 1.999969 fak_uw_b2 0.00 1.999969 FUNCTION_LIST LAKH IF_DATA DIM_X DIRECT 0x81F7A4 /begin AXIS_DESCR STD_AXIS fho_w fak_uw_b4 4 0.00 3.999939 DEPOSIT ABSOLUT /end AXIS_DESCR /end CHARACTERISTIC
/begin CHARACTERISTIC KLLUESIC "Umrechnung Tastverhältnis Lüfteransteuerung in Istzustand Lüftersteuerung" CURVE 0x81AE61 KlAUbSstUbWUb 99.61 tv_ub_b100 0.00 99.61 FUNCTION_LIST KMTR IF_DATA DIM_X DIRECT 0x81AE61 /begin AXIS_DESCR STD_AXIS tvluesicb tv_ub_b100 8 0.00 99.61 DEPOSIT ABSOLUT /end AXIS_DESCR /end CHARACTERISTIC
/begin CHARACTERISTIC KLMIGENL "Kennlinie für Getriebeeingriff bei Ausfall der Getriebe-Botschaft" CURVE 0x810177 KlAUbSstUbWUb 99.61 rel_ub_b99p6 0.00 99.61 FUNCTION_LIST CAN IF_DATA DIM_X DIRECT 0x810177
 /begin AXIS_DESCR STD_AXIS tmot temp_ub_q0p75_o48 5 -48.00 143.3 DEPOSIT ABSOLUT /end AXIS_DESCR
/end CHARACTERISTIC
/begin CHARACTERISTIC KLMIMNH "höhenabhängige Korrektur des minimalen  Moments" CURVE 0x8282BC KlAUbSstUbWSb 49.80 rel_sb_b25 -25.00 24.80 FUNCTION_LIST MDMIN IF_DATA DIM_X DIRECT 0x8282BC /begin AXIS_DESCR STD_AXIS fho fak_ub_b4 6 0.00 3.984 DEPOSIT ABSOLUT /end AXIS_DESCR /end CHARACTERISTIC
/begin CHARACTERISTIC KLMLDSLAMX "max. Luftmasse für Bedingung Adaption/Zusatzdiagnose (16 Bit)" CURVE 0x81B25C KlAUwSstUwWUw 6553.500 m_q0p1 0.00 6553.500 FUNCTION_LIST DSLSLRS IF_DATA DIM_X DIRECT 0x81B25C /begin AXIS_DESCR STD_AXIS fho_w fak_uw_b4 5 0.00 3.999939 DEPOSIT ABSOLUT /end AXIS_DESCR /end CHARACTERISTIC
/begin CHARACTERISTIC KLMLDSLKMX "max. Luftmasse für Bedingung Kurztest-Diagnose (16 Bit)" CURVE 0x81B272 KlAUwSstUwWUw 6553.500 m_q0p1 0.00 6553.500 FUNCTION_LIST DSLSLRS IF_DATA DIM_X DIRECT 0x81B272 /begin AXIS_DESCR STD_AXIS fho_w fak_uw_b4 5 0.00 3.999939 DEPOSIT ABSOLUT /end AXIS_DESCR /end CHARACTERISTIC
/begin CHARACTERISTIC KLMLDSLMX "max. Luftmasse für Bedingung Diagnose (16 Bit)" CURVE 0x81B288 KlAUwSstUwWUw 6553.500 m_q0p1 0.00 6553.500 FUNCTION_LIST DSLSLRS IF_DATA DIM_X DIRECT 0x81B288 /begin AXIS_DESCR STD_AXIS fho_w fak_uw_b4 5 0.00 3.999939 DEPOSIT ABSOLUT /end AXIS_DESCR /end CHARACTERISTIC
/begin CHARACTERISTIC KLMLDSLOMX "max. Luftmasse für Bedingung frm-Offset-Messung (16 Bit)" CURVE 0x81B29E KlAUwSstUwWUw 6553.500 m_q0p1 0.00 6553.500 FUNCTION_LIST DSLSLRS IF_DATA DIM_X DIRECT 0x81B29E /begin AXIS_DESCR STD_AXIS fho_w fak_uw_b4 5 0.00 3.999939 DEPOSIT ABSOLUT /end AXIS_DESCR /end CHARACTERISTIC
/begin CHARACTERISTIC KLMLFT "Umrechnung Tastverhältnis Lüfteransteuerung in abzuführende Wärmemenge" CURVE 0x81AE72 KlAUbSstUbWUb 191.3 temp_ub_q0p75_o48 -48.00 143.3 FUNCTION_LIST KMTR IF_DATA DIM_X DIRECT 0x81AE72
 /begin AXIS_DESCR STD_AXIS tvlueskmtr tv_ub_b100 5 0.00 99.61 DEPOSIT ABSOLUT /end AXIS_DESCR
/end CHARACTERISTIC
/begin CHARACTERISTIC KLMRESTM "Kennlinie für Momentenreserve im Nachstart" CURVE 0x811EC4 KlAUbSstUbWUb 24.90 rel_ub_b24p9 0.00 24.90 FUNCTION_LIST LLRMR IF_DATA DIM_X DIRECT 0x811EC4
 /begin AXIS_DESCR STD_AXIS tmot temp_ub_q0p75_o48 10 -48.00 143.3 DEPOSIT ABSOLUT /end AXIS_DESCR
/end CHARACTERISTIC
/begin CHARACTERISTIC KLMRHO "Kennlinie: Drehmomentreserve höhenabhängig" CURVE 0x811ED9 KlAUbSstUbWUb 24.90 rel_ub_b24p9 0.00 24.90 FUNCTION_LIST LLRMR IF_DATA DIM_X DIRECT 0x811ED9 /begin AXIS_DESCR STD_AXIS fho fak_ub_b4 10 0.00 3.984 DEPOSIT ABSOLUT /end AXIS_DESCR /end CHARACTERISTIC
/begin CHARACTERISTIC KLNLOEL "Nachlaufzeitanforderung in Abhängigkreit der Öltemperatur" CURVE 0x82B168 KlAUwSstUwWUw 65535.00 t1sxs_uw_b65535 0.00 65535.00 FUNCTION_LIST KMTR IF_DATA DIM_X DIRECT 0x82B168
 /begin AXIS_DESCR STD_AXIS toelkmtr temp_ub_q1_o60 6 -60.00000 65475.00 DEPOSIT ABSOLUT /end AXIS_DESCR
/end CHARACTERISTIC
/begin CHARACTERISTIC KLNLPHN "Korrektur des Sensor-Phasengangs" CURVE 0x810FEE FklWSb 15.94 kw_q0p0625 -8.000 7.938 FUNCTION_LIST NLDG IF_DATA DIM_X DIRECT 0x810FEE
 /begin AXIS_DESCR FIX_AXIS nmot nmot_ub_q40 16 0.00 5080. FIX_AXIS_PAR 0 3 16 /end AXIS_DESCR
/end CHARACTERISTIC
/begin CHARACTERISTIC KLNLSTP "Abbruchbedingung Nachlaufzeit abhängig von Umgebungstemp." CURVE 0x81AE7D KlAUbSstUbWUb 191.3 temp_ub_q0p75_o48 -48.00 143.3 FUNCTION_LIST KMTR IF_DATA DIM_X DIRECT 0x81AE7D
 /begin AXIS_DESCR STD_AXIS tmotnl2 temp_ub_q0p75_o48 6 -48.00 143.3 DEPOSIT ABSOLUT /end AXIS_DESCR
/end CHARACTERISTIC
/begin CHARACTERISTIC KLNLTUM "Korrektrufaktor Nachlaufzeit über Umgebungstemperatur" CURVE 0x81AE8A KlAUbSstUbWUb 0.9961 fak_ub_b1 0.00 0.9961 FUNCTION_LIST KMTR IF_DATA DIM_X DIRECT 0x81AE8A
 /begin AXIS_DESCR STD_AXIS tumgkmtr temp_ub_q0p75_o48 4 -48.00 143.3 DEPOSIT ABSOLUT /end AXIS_DESCR
/end CHARACTERISTIC
/begin CHARACTERISTIC KLNPED_UC "pedalsollwertabh. Drehzahlbegr. in der DK-Antrieb-Ersatzfunktion; Befehlstest" CURVE 0x81266A KlAUbSstUbWUb 10200. nmot_ub_q40 0.00 10200. FUNCTION_LIST URCREAC IF_DATA DIM_X DIRECT 0x81266A
 /begin AXIS_DESCR STD_AXIS spsn_uc spg_ub_q0p019 8 0.00 4.9805 DEPOSIT ABSOLUT /end AXIS_DESCR
/end CHARACTERISTIC
/begin CHARACTERISTIC KLNPED_UM "pedalsollwertabh. Drehzahlbegrenzung in der DK-Antrieb-Ersatzfunktion, Fktsüberw" CURVE 0x8141FA KlAUbSstUbWUb 10200. nmot_ub_q40 0.00 10200. FUNCTION_LIST UFREAC IF_DATA DIM_X DIRECT 0x8141FA
 /begin AXIS_DESCR STD_AXIS spsn_um spg_ub_q0p019 8 0.00 4.9805 DEPOSIT ABSOLUT /end AXIS_DESCR
/end CHARACTERISTIC
/begin CHARACTERISTIC KLOGIN "Login-Code für Kundendienst" VALUE 0x8161BC KwUw 65535.00 dez 0.00 65535.00 FUNCTION_LIST TKMWL K71SR KDIAG KWPDATR IF_DATA DIM_X DIRECT 0x8161BC /end CHARACTERISTIC
/begin CHARACTERISTIC KLOSCKL "" CURVE 0x81C736 KlAUbSstUwWUb 7.000 dez 0.00 7.000 FUNCTION_LIST STADK IF_DATA DIM_X DIRECT 0x81C736
 /begin AXIS_DESCR STD_AXIS oscdktf_w fak_uw_b16 16 0.00 15.99976 DEPOSIT ABSOLUT /end AXIS_DESCR
/end CHARACTERISTIC
/begin CHARACTERISTIC KLQKLIMA "Abzuführende Wärme f. Klimakondensator" CURVE 0x81AE93 KlAUbSstUbWUb 191.3 temp_ub_q0p75_o48 -48.00 143.3 FUNCTION_LIST KMTR IF_DATA DIM_X DIRECT 0x81AE93 /begin AXIS_DESCR STD_AXIS pklimakmtr p_q0p2 5 0.00 51.00 DEPOSIT ABSOLUT /end AXIS_DESCR /end CHARACTERISTIC
/begin CHARACTERISTIC KLQVHDS "Klimahochdruckanforderung in Abhängigkeit der Umgebungstemperatur" CURVE 0x81AE9E KlAUbSstUbWUb 191.3 temp_ub_q0p75_o48 -48.00 143.3 FUNCTION_LIST KMTR IF_DATA DIM_X DIRECT 0x81AE9E
 /begin AXIS_DESCR STD_AXIS tumgkmtr temp_ub_q0p75_o48 6 -48.00 143.3 DEPOSIT ABSOLUT /end AXIS_DESCR
/end CHARACTERISTIC
/begin CHARACTERISTIC KLRLSALULL "Lastschwelle zur Schuberkennung für Ausblendung der Aussetzererkennung im LL" CURVE 0x81071F GklWUb 191.3 rel_ub_q0p75 0.00 191.3 FUNCTION_LIST DMDSTP IF_DATA DIM_X DIRECT 0x81071F
 /begin AXIS_DESCR COM_AXIS nmot nmot_ub_q40 8 0.00 10200. AXIS_PTS_REF SNM08DMUB /end AXIS_DESCR
/end CHARACTERISTIC
/begin CHARACTERISTIC KLTALUST "Zeitdauer Ausblendung der Aussetzererkennung nach Motorstart" CURVE 0x81BD36 KlAUbSstUbWUw 655.3500 t10msxs_uw_b655p35 0.00 655.3500 FUNCTION_LIST DMDSTP IF_DATA DIM_X DIRECT 0x81BD36
 /begin AXIS_DESCR STD_AXIS tmst temp_ub_q0p75_o48 4 -48.00 143.3 DEPOSIT ABSOLUT /end AXIS_DESCR
/end CHARACTERISTIC
/begin CHARACTERISTIC KLTDS "Konvertierungskennlinie für Tankdrucksensor DS-T2" CURVE 0x81781E KlASwSstSwWSw 64.02769 p_sw_q0p000977 -32.01434 32.01336 FUNCTION_LIST GGDST IF_DATA DIM_X DIRECT 0x81781E
 /begin AXIS_DESCR STD_AXIS pterw_w p_sw_q0p00244 6 -80.00000 79.99756 DEPOSIT ABSOLUT /end AXIS_DESCR
/end CHARACTERISTIC
/begin CHARACTERISTIC KLTHMDTMS "Delta Motorstart-Temperatur für Verifikation/Heilung Thermostatdiagnose" CURVE 0x819772 KlAUbSstUbWUb 191.3 temp_ub_b191p25 0.00 191.3 FUNCTION_LIST GGTFM IF_DATA DIM_X DIRECT 0x819772
 /begin AXIS_DESCR STD_AXIS tmotlinst temp_ub_q0p75_o48 5 -48.00 143.3 DEPOSIT ABSOLUT /end AXIS_DESCR
/end CHARACTERISTIC
/begin CHARACTERISTIC KLTLAFAKR "Verzögerungszeit Lambda Fahrerwunsch bei Zündwinkelspätverst." CURVE 0x8192E1 GklWUb 25.50 t100msxs_ub_b25p5 0.00 25.50 FUNCTION_LIST LAMFAW IF_DATA DIM_X DIRECT 0x8192E1
 /begin AXIS_DESCR COM_AXIS nmot nmot_ub_q40 6 0.00 10200. AXIS_PTS_REF SNM06GKUB /end AXIS_DESCR
/end CHARACTERISTIC
/begin CHARACTERISTIC KLTMSKR "Kennfeld Motor-Soll-Temperatur in Abh. von der KR-Spätverstellung" CURVE 0x81AEAB KlAUbSstUbWUb 191.3 temp_ub_q0p75_o48 -48.00 143.3 FUNCTION_LIST KMTR IF_DATA DIM_X DIRECT 0x81AEAB /begin AXIS_DESCR STD_AXIS krtmso zw_ub_qn0p75 4 -191.3 0.00 DEPOSIT ABSOLUT /end AXIS_DESCR /end CHARACTERISTIC
/begin CHARACTERISTIC KLTNMXPR "Zeit für Drehzahlprädiktion der NMAX-Regelung" CURVE 0x81A395 GklWUb 5.080 relnmot_q0p02 0.02000 5.100 FUNCTION_LIST NMAXMD IF_DATA DIM_X DIRECT 0x81A395 /begin AXIS_DESCR COM_AXIS gangi dez 8 0.00 255.0 AXIS_PTS_REF SGA08MDUB /end AXIS_DESCR /end CHARACTERISTIC
/begin CHARACTERISTIC KLTNRDE "Kennlinie für Rückdrehzahnzeiten" CURVE 0x81848F KlAUbSstUbWUb 255.0 t1msxms_q1 0.00 255.0 FUNCTION_LIST RDE IF_DATA DIM_X DIRECT 0x81848F
 /begin AXIS_DESCR STD_AXIS tmot temp_ub_q0p75_o48 3 -48.00 143.3 DEPOSIT ABSOLUT /end AXIS_DESCR
/end CHARACTERISTIC
/begin CHARACTERISTIC KLTVLU1EW "Ersatzwert Tastverhältnis Lüfter 1 geschwindigkeitsabhängig" CURVE 0x81AEB4 KlAUbSstUbWUb 99.61 tv_ub_b100 0.00 99.61 FUNCTION_LIST KMTR IF_DATA DIM_X DIRECT 0x81AEB4
 /begin AXIS_DESCR STD_AXIS vfzgkmtr vfzg_ub_q1p25 4 0.00 318.8 DEPOSIT ABSOLUT /end AXIS_DESCR
/end CHARACTERISTIC
/begin CHARACTERISTIC KLTVLU2EW "Ersatzwert Tastverhältnis Lüfter 2 geschwindigkeitsabhängig" CURVE 0x81AEBD KlAUbSstUbWUb 99.61 tv_ub_b100 0.00 99.61 FUNCTION_LIST KMTR IF_DATA DIM_X DIRECT 0x81AEBD
 /begin AXIS_DESCR STD_AXIS vfzgkmtr vfzg_ub_q1p25 4 0.00 318.8 DEPOSIT ABSOLUT /end AXIS_DESCR
/end CHARACTERISTIC
/begin CHARACTERISTIC KLWDKTAN "Wichtung der Drosselklappenposition im Start mit Ansauglufttemperatur" CURVE 0x8189E9 KlAUbSstUbWUb 7.969 fak_ub_b8 0.00 7.969 FUNCTION_LIST WDKSOM IF_DATA DIM_X DIRECT 0x8189E9
 /begin AXIS_DESCR STD_AXIS tans temp_ub_q0p75_o48 4 -48.00 143.3 DEPOSIT ABSOLUT /end AXIS_DESCR
/end CHARACTERISTIC
/begin CHARACTERISTIC KLWLAFWL_0_A "Wichtungskennlinie Offset Lambda Motor soll" CURVE 0x8192E7 GklWUb 1.992 fak_ub_b2 0.00 1.992 FUNCTION_LIST LAMFAW IF_DATA DIM_X INDIRECT 0x815B2E
 /begin AXIS_DESCR COM_AXIS nmot nmot_ub_q40 6 0.00 10200. AXIS_PTS_REF SNM06GKUB /end AXIS_DESCR
/end CHARACTERISTIC
/begin CHARACTERISTIC KLWLAFWL_1_A "Wichtungskennlinie Offset Lambda Motor soll" CURVE 0x8192ED GklWUb 1.992 fak_ub_b2 0.00 1.992 FUNCTION_LIST LAMFAW IF_DATA DIM_X INDIRECT 0x815B32
 /begin AXIS_DESCR COM_AXIS nmot nmot_ub_q40 6 0.00 10200. AXIS_PTS_REF SNM06GKUB /end AXIS_DESCR
/end CHARACTERISTIC
/begin CHARACTERISTIC KLWNWI "Festwertkennlinie eines Gewichtungsfaktors für den Winkelfehler" CURVE 0x810FFE FklWUb 0.9961 fak_q0p0039 0.00 0.9961 FUNCTION_LIST NLDG IF_DATA DIM_X DIRECT 0x810FFE
 /begin AXIS_DESCR FIX_AXIS wnwix_w kw_sw_b128 16 -127.9961 128.0000 FIX_AXIS_PAR -32767 12 16 /end AXIS_DESCR
/end CHARACTERISTIC
/begin CHARACTERISTIC KLZANSFHO "Kennlinie für Höhenkorrektur der Zeitkonstante zur Nachstartabregelung" CURVE 0x818F19 KlAUbSstUbWUb 3.984 fak_ub_b4 0.00 3.984 FUNCTION_LIST ESNSWL IF_DATA DIM_X DIRECT 0x818F19 /begin AXIS_DESCR STD_AXIS fho fak_ub_b4 8 0.00 3.984 DEPOSIT ABSOLUT /end AXIS_DESCR /end CHARACTERISTIC
/begin CHARACTERISTIC KMDTHMMN "Minimale Fahrtstrecke für Thermostatdiagnose" VALUE 0x8197D0 KwUb 25.50 km_ub_q0p10 0.00 25.50 FUNCTION_LIST DTHM IF_DATA DIM_X DIRECT 0x8197D0 /end CHARACTERISTIC
/begin CHARACTERISTIC KMDTHMMX "Max. Fahrtstrecke für Thermostatdiagnose" VALUE 0x8197D1 KwUb 25.50 km_ub_q0p10 0.00 25.50 FUNCTION_LIST DTHM IF_DATA DIM_X DIRECT 0x8197D1 /end CHARACTERISTIC
/begin CHARACTERISTIC KMITIBGR "Steigungsfaktor für das Aufintegrieren von dtimx_w zur Momentenbeggrenzung" VALUE 0x818F76 KwUb 91.20 rkti_k_sy 0.00 91.20 FUNCTION_LIST RKTI IF_DATA DIM_X DIRECT 0x818F76 /end CHARACTERISTIC
/begin CHARACTERISTIC KMLTESG "Konstante für Regeneriermasse in Leitung TEV-Saugrohr bei Normdruck + Normtemp." VALUE 0x829E20 KwUw 1.066650 fak1_q1p63Em5 0.00 1.066650 FUNCTION_LIST BGTEV IF_DATA DIM_X DIRECT 0x829E20 /end CHARACTERISTIC
/begin CHARACTERISTIC KNLSYN "Sicherheitsfaktor für Notlauf-Synchronisationsbedingung" VALUE 0x81100E KwUb 7.969 fak_ub_b8 0.00 7.969 FUNCTION_LIST NLDG IF_DATA DIM_X DIRECT 0x81100E /end CHARACTERISTIC
/begin CHARACTERISTIC KNSNF "Sperrband für Solldrehzahlnachführung" VALUE 0x819FA1 KwUb 2550. nmot_ub_q10 0.00 2550. FUNCTION_LIST LLRNS IF_DATA DIM_X DIRECT 0x819FA1 /end CHARACTERISTIC
/begin CHARACTERISTIC KPLRHML "P-Anteil fuer stetige LRHK" CURVE 0x81271E GklWUb 3.984 fak_ub_b4 0.00 3.984 FUNCTION_LIST LRSHK IF_DATA DIM_X DIRECT 0x81271E /begin AXIS_DESCR COM_AXIS ml m_ub_b1020 8 0.00 1020. AXIS_PTS_REF SML08LHUB /end AXIS_DESCR /end CHARACTERISTIC
/begin CHARACTERISTIC KPVMXG "Verstärkungsfaktor P-Anteil der VMAX-Regelung" CURVE 0x81A3E9 FklWUb 99.70 rel_ub_q0p391 0.00 99.70 FUNCTION_LIST VMAXMD IF_DATA DIM_X DIRECT 0x81A3E9 /begin AXIS_DESCR FIX_AXIS gangi dez 8 0.00 7.000 FIX_AXIS_PAR 0 0 8 /end AXIS_DESCR /end CHARACTERISTIC
/begin CHARACTERISTIC KRAFGRGA_0_A "Verstärkungsfaktor bei Rampe für FGR-Regler" CURVE 0x81CCD4 KlAUwSstUwWUw 3199.951 rel_uw_b3200 0.00 3199.951 FUNCTION_LIST FGRREGL IF_DATA DIM_X INDIRECT 0x813BF2 /begin AXIS_DESCR STD_AXIS uevges_w fak_q0p1 8 0.00 6553.500 DEPOSIT ABSOLUT /end AXIS_DESCR /end CHARACTERISTIC
/begin CHARACTERISTIC KRAFGRGA_1_A "Verstärkungsfaktor bei Rampe für FGR-Regler" CURVE 0x81CCF6 KlAUwSstUwWUw 3199.951 rel_uw_b3200 0.00 3199.951 FUNCTION_LIST FGRREGL IF_DATA DIM_X INDIRECT 0x813BF6 /begin AXIS_DESCR STD_AXIS uevges_w fak_q0p1 8 0.00 6553.500 DEPOSIT ABSOLUT /end AXIS_DESCR /end CHARACTERISTIC
/begin CHARACTERISTIC KRAL1N "Klopfregeladaption Lastbereich 1" CURVE 0x819AAE GklWUb 191.3 rel_ub_q0p75 0.00 191.3 FUNCTION_LIST KRRA IF_DATA DIM_X DIRECT 0x819AAE
 /begin AXIS_DESCR COM_AXIS nmot nmot_ub_q40 16 0.00 10200. AXIS_PTS_REF SNM16KRUB /end AXIS_DESCR
/end CHARACTERISTIC
/begin CHARACTERISTIC KRAL2N "Klopfregeladaption Lastbereich 2" CURVE 0x819ABE GklWUb 191.3 rel_ub_q0p75 0.00 191.3 FUNCTION_LIST KRRA IF_DATA DIM_X DIRECT 0x819ABE
 /begin AXIS_DESCR COM_AXIS nmot nmot_ub_q40 16 0.00 10200. AXIS_PTS_REF SNM16KRUB /end AXIS_DESCR
/end CHARACTERISTIC
/begin CHARACTERISTIC KRAL3N "Klopfregeladaption Lastbereich 3" CURVE 0x819ACE GklWUb 191.3 rel_ub_q0p75 0.00 191.3 FUNCTION_LIST KRRA IF_DATA DIM_X DIRECT 0x819ACE
 /begin AXIS_DESCR COM_AXIS nmot nmot_ub_q40 16 0.00 10200. AXIS_PTS_REF SNM16KRUB /end AXIS_DESCR
/end CHARACTERISTIC
/begin CHARACTERISTIC KRALH "Klopfregeladaption Lasthysterese" VALUE 0x819ADE KwUb 191.3 rel_ub_q0p75 0.00 191.3 FUNCTION_LIST KRRA IF_DATA DIM_X DIRECT 0x819ADE /end CHARACTERISTIC
/begin CHARACTERISTIC KRAN1_0_A "Klopfregeladaption Drehzahlbereich, Stützstelle 1" VALUE 0x81F7CA KwUb 10200. nmot_ub_q40 0.00 10200. FUNCTION_LIST KRRA IF_DATA DIM_X DIRECT 0x81F7CA /end CHARACTERISTIC
/begin CHARACTERISTIC KRAN1_1_A "Klopfregeladaption Drehzahlbereich, Stützstelle 1" VALUE 0x81F7CB KwUb 10200. nmot_ub_q40 0.00 10200. FUNCTION_LIST KRRA IF_DATA DIM_X DIRECT 0x81F7CB /end CHARACTERISTIC
/begin CHARACTERISTIC KRAN2 "Klopfregeladaption Drehzahlbereich, Stützstelle 2" VALUE 0x819ADF KwUb 10200. nmot_ub_q40 0.00 10200. FUNCTION_LIST KRRA IF_DATA DIM_X DIRECT 0x819ADF /end CHARACTERISTIC
/begin CHARACTERISTIC KRAN3 "Klopfregeladaption Drehzahlbereich, Stützstelle 3" VALUE 0x819AE0 KwUb 10200. nmot_ub_q40 0.00 10200. FUNCTION_LIST KRRA IF_DATA DIM_X DIRECT 0x819AE0 /end CHARACTERISTIC
/begin CHARACTERISTIC KRAN4 "Klopfregeladaption Drehzahlbereich, Stützstelle 4" VALUE 0x819AE1 KwUb 10200. nmot_ub_q40 0.00 10200. FUNCTION_LIST KRRA IF_DATA DIM_X DIRECT 0x819AE1 /end CHARACTERISTIC
/begin CHARACTERISTIC KRANH "Klopfregeladaption Drehzahlhysterese" VALUE 0x819AE2 KwUb 10200. nmot_ub_q40 0.00 10200. FUNCTION_LIST KRRA GGKS IF_DATA DIM_X DIRECT 0x819AE2 /end CHARACTERISTIC
/begin CHARACTERISTIC KRDWA "Klopfregelung Differenz aktueller ZW zu Adaptionskennfeld" VALUE 0x811C10 KwUb 191.3 zw_ub_q0p75 0.00 191.3 FUNCTION_LIST KRRA IF_DATA DIM_X DIRECT 0x811C10 /end CHARACTERISTIC
/begin CHARACTERISTIC KRDWAA "zulässiger ZW-Sprung nach früh bei Auslesen Adaptionswerte" VALUE 0x811C11 KwUb 191.3 zw_ub_qn0p75 -191.3 0.00 FUNCTION_LIST KRRA IF_DATA DIM_X DIRECT 0x811C11 /end CHARACTERISTIC
/begin CHARACTERISTIC KRDWKLA "Der SV-Lernbetrag für die KR-Adaption nach einem erkannten Klopfereignis" VALUE 0x811C12 KwUb 6.000 zw_ub_qn0p75 -6.000 0.00 FUNCTION_LIST KRRA IF_DATA DIM_X DIRECT 0x811C12 /end CHARACTERISTIC
/begin CHARACTERISTIC KRDWSA "Der FV-Lernbetrag für die KR-Adaption wenn wkra-wkr > KRDWA" VALUE 0x811C13 KwUb 6.000 zw_ub_q0p75 0.00 6.000 FUNCTION_LIST KRRA IF_DATA DIM_X DIRECT 0x811C13 /end CHARACTERISTIC
/begin CHARACTERISTIC KRDWSN "Klopfregelung delta - Winkel Sicherheit" CURVE 0x819AE3 GklWUb 191.3 zw_ub_qn0p75 -191.3 0.00 FUNCTION_LIST KRRA IF_DATA DIM_X DIRECT 0x819AE3
 /begin AXIS_DESCR COM_AXIS nmot nmot_ub_q40 16 0.00 10200. AXIS_PTS_REF SNM16KRUB /end AXIS_DESCR
/end CHARACTERISTIC
/begin CHARACTERISTIC KRFHKS "Fehlerhäufigkeit Klopfsensoren" VALUE 0x819CEB KwUb 255.0 dez 0.00 255.0 FUNCTION_LIST DKRS IF_DATA DIM_X DIRECT 0x819CEB /end CHARACTERISTIC
/begin CHARACTERISTIC KRFHT "Fehlerhäufigkeit Testimpuls" VALUE 0x811C47 KwUb 254.0 dez 1.000 255.0 FUNCTION_LIST DKRNT DKRTP GGKS IF_DATA DIM_X DIRECT 0x811C47 /end CHARACTERISTIC
/begin CHARACTERISTIC KRFKLN "Spätverstellung pro Klopfereignis bei langsamer Frühverstellung" CURVE 0x819AF3 GklWUb 191.3 zw_ub_qn0p75 -191.3 0.00 FUNCTION_LIST KRRA IF_DATA DIM_X DIRECT 0x819AF3
 /begin AXIS_DESCR COM_AXIS nmot nmot_ub_q40 16 0.00 10200. AXIS_PTS_REF SNM16KRUB /end AXIS_DESCR
/end CHARACTERISTIC
/begin CHARACTERISTIC KRFKN "Spätverstellung pro Klopfereignis" CURVE 0x819B03 GklWUb 191.3 zw_ub_qn0p75 -191.3 0.00 FUNCTION_LIST KRRA IF_DATA DIM_X DIRECT 0x819B03
 /begin AXIS_DESCR COM_AXIS nmot nmot_ub_q40 16 0.00 10200. AXIS_PTS_REF SNM16KRUB /end AXIS_DESCR
/end CHARACTERISTIC
/begin CHARACTERISTIC KRFTP1 "Tiefpassverhalten normal" VALUE 0x811C02 KwUb 24.00 dez 8.000 32.00 FUNCTION_LIST KRKE GGKS IF_DATA DIM_X DIRECT 0x811C02 /end CHARACTERISTIC
/begin CHARACTERISTIC KRFTP2 "Tiefpassverhalten bei Drehzahldynamik" VALUE 0x811C03 KwUb 14.00 dez 2.000 16.00 FUNCTION_LIST KRKE IF_DATA DIM_X DIRECT 0x811C03 /end CHARACTERISTIC
/begin CHARACTERISTIC KRFTP3 "Tiefpassverhalten bei Lastdynamik" VALUE 0x811C04 KwUb 14.00 dez 2.000 16.00 FUNCTION_LIST KRKE IF_DATA DIM_X DIRECT 0x811C04 /end CHARACTERISTIC
/begin CHARACTERISTIC KRKFKS "Zuordnung der Kloperkennungskennlinie bei fehlender Zyl.-1-Erkennung" VALUE 0x811C05 KwUb 255.0 dez 0.00 255.0 FUNCTION_LIST KRKE IF_DATA DIM_X DIRECT 0x811C05 /end CHARACTERISTIC
/begin CHARACTERISTIC KRKTE "Umrechnung relative Kraftstoffmasse rk in effektive Einspritzzeit te" VALUE 0x81DF8C KwUw 7.281667 rkti11_sy 0.00 7.281667 FUNCTION_LIST RKTI KVA IF_DATA DIM_X DIRECT 0x81DF8C /end CHARACTERISTIC
/begin CHARACTERISTIC KRLVFN "Anz. Zünd./Zyl., Zeitangabe von Frühverst. zu Frühverst. (langsame Frühverst.)" CURVE 0x819B13 GklWUb 254.0 dez 1.000 255.0 FUNCTION_LIST KRRA IF_DATA DIM_X DIRECT 0x819B13
 /begin AXIS_DESCR COM_AXIS nmot nmot_ub_q40 16 0.00 10200. AXIS_PTS_REF SNM16KRUB /end AXIS_DESCR
/end CHARACTERISTIC
/begin CHARACTERISTIC KRMXN "maximale Spätverstellung" CURVE 0x819B23 GklWUb 190.5 zw_ub_qn0p75 -191.3 -0.7500 FUNCTION_LIST KRRA IF_DATA DIM_X DIRECT 0x819B23
 /begin AXIS_DESCR COM_AXIS nmot nmot_ub_q40 16 0.00 10200. AXIS_PTS_REF SNM16KRUB /end AXIS_DESCR
/end CHARACTERISTIC
/begin CHARACTERISTIC KRNLZ "Drehzahlschwelle, oberhalb der Führung durch Leitzylinder aktiv ist" VAL_BLK 0x819B33 KwbUb 10200. nmot_ub_q40 0.00 10200. NUMBER 8 FUNCTION_LIST KRRA IF_DATA DIM_X DIRECT 0x819B33 /end CHARACTERISTIC
/begin CHARACTERISTIC KRVFN "Anz. Zünd./Zyl., bzw. Zeitangabe von Frühverst. zu Frühverst. (Stufenbreite-KR)" CURVE 0x819B3B GklWUb 254.0 dez 1.000 255.0 FUNCTION_LIST KRRA IF_DATA DIM_X DIRECT 0x819B3B
 /begin AXIS_DESCR COM_AXIS nmot nmot_ub_q40 16 0.00 10200. AXIS_PTS_REF SNM16KRUB /end AXIS_DESCR
/end CHARACTERISTIC
/begin CHARACTERISTIC KRVFSN "Anzahl Zündungen/Zyl., oder Zeitangabe für schnelle Frühverstellung der KR" CURVE 0x819B4B GklWUb 254.0 dez 1.000 255.0 FUNCTION_LIST KRRA IF_DATA DIM_X DIRECT 0x819B4B
 /begin AXIS_DESCR COM_AXIS nmot nmot_ub_q40 16 0.00 10200. AXIS_PTS_REF SNM16KRUB /end AXIS_DESCR
/end CHARACTERISTIC
/begin CHARACTERISTIC KRVST "Verstärkung nach Start" VALUE 0x811C06 KwUb 6.000 dez 0.00 6.000 FUNCTION_LIST KRKE IF_DATA DIM_X DIRECT 0x811C06 /end CHARACTERISTIC
/begin CHARACTERISTIC KRWKRAIN "Initialisierungswert für Adaptionswerte" VALUE 0x811C14 KwUb 191.3 zw_ub_qn0p75 -191.3 0.00 FUNCTION_LIST KRRA IF_DATA DIM_X DIRECT 0x811C14 /end CHARACTERISTIC
/begin CHARACTERISTIC KSTA0INI "Initialisierungswert STADAP-Faktor in Bereich 0" VALUE 0x811622 KwUb 1.992 fak_ub_b2 0.00 1.992 FUNCTION_LIST STADAP IF_DATA DIM_X DIRECT 0x811622 /end CHARACTERISTIC
/begin CHARACTERISTIC KSTA1INI "Initialisierungswert STADAP-Faktor in Bereich 1" VALUE 0x811623 KwUb 1.992 fak_ub_b2 0.00 1.992 FUNCTION_LIST STADAP IF_DATA DIM_X DIRECT 0x811623 /end CHARACTERISTIC
/begin CHARACTERISTIC KSTA2INI "Initialisierungswert STADAP-Faktor in Bereich 2" VALUE 0x811624 KwUb 1.992 fak_ub_b2 0.00 1.992 FUNCTION_LIST STADAP IF_DATA DIM_X DIRECT 0x811624 /end CHARACTERISTIC
/begin CHARACTERISTIC KSTAI "Arbeitsbereiche für STADAP-Faktoren" CURVE 0x811625 KlAUbSstUbWUb 255.0 dez 0.00 255.0 FUNCTION_LIST STADAP IF_DATA DIM_X DIRECT 0x811625
 /begin AXIS_DESCR STD_AXIS tmst temp_ub_q0p75_o48 12 -48.00 143.3 DEPOSIT ABSOLUT /end AXIS_DESCR
/end CHARACTERISTIC
/begin CHARACTERISTIC KSTAMN0 "Min-Begrenzung des STADAP-Faktors in Bereich 0" VALUE 0x81163E KwUb 1.992 fak_ub_b2 0.00 1.992 FUNCTION_LIST STADAP IF_DATA DIM_X DIRECT 0x81163E /end CHARACTERISTIC
/begin CHARACTERISTIC KSTAMN1 "Min-Begrenzung des STADAP-Faktors in Bereich 1" VALUE 0x81163F KwUb 1.992 fak_ub_b2 0.00 1.992 FUNCTION_LIST STADAP IF_DATA DIM_X DIRECT 0x81163F /end CHARACTERISTIC
/begin CHARACTERISTIC KSTAMN2 "Min-Begrenzung des STADAP-Faktors in Bereich 2" VALUE 0x811640 KwUb 1.992 fak_ub_b2 0.00 1.992 FUNCTION_LIST STADAP IF_DATA DIM_X DIRECT 0x811640 /end CHARACTERISTIC
/begin CHARACTERISTIC KSTAMX0 "Max-Begrenzung des STADAP-Faktors in Bereich 0" VALUE 0x811641 KwUb 0.9922 fak_ub_b2 1.000 1.992 FUNCTION_LIST STADAP IF_DATA DIM_X DIRECT 0x811641 /end CHARACTERISTIC
/begin CHARACTERISTIC KSTAMX1 "Max-Begrenzung des STADAP-Faktors in Bereich 1" VALUE 0x811642 KwUb 0.9922 fak_ub_b2 1.000 1.992 FUNCTION_LIST STADAP IF_DATA DIM_X DIRECT 0x811642 /end CHARACTERISTIC
/begin CHARACTERISTIC KSTTOPMN "Minimale Betriebsdauer seit PWF für Startmengenadaption" VALUE 0x815D32 KwUw 393210.0 t6minxmin_q6 0.00 393210.0 FUNCTION_LIST STADAP IF_DATA DIM_X DIRECT 0x815D32 /end CHARACTERISTIC
/begin CHARACTERISTIC KSZA "Anzahl Klopfsensoren" VALUE 0x811C07 KwUb 3.000 dez 1.000 4.000 FUNCTION_LIST KRKE KRRA IF_DATA DIM_X DIRECT 0x811C07 /end CHARACTERISTIC
/begin CHARACTERISTIC KUBERROR "Zeit für Fehlererkennung Kurzschluß nach U_batt" VALUE 0x81C7DC KwUw 6553.500 fak_q0p1 0.00 6553.500 FUNCTION_LIST DKMTR IF_DATA DIM_X DIRECT 0x81C7DC /end CHARACTERISTIC
/begin CHARACTERISTIC KUBHEAL "Zeit für Heilung Kurzschluß nach U_batt" VALUE 0x81C7DE KwUw 6553.500 fak_q0p1 0.00 6553.500 FUNCTION_LIST DKMTR IF_DATA DIM_X DIRECT 0x81C7DE /end CHARACTERISTIC
/begin CHARACTERISTIC KUMSRL "Umrechnungskonstante von Massenstrom in relative Luftfüllung" VALUE 0x81131D KwUb 0.00199218750 kumsrl_ub_b0p002 0.00 0.00199218750 FUNCTION_LIST BGMSZS FUEDK IF_DATA DIM_X DIRECT 0x81131D /end CHARACTERISTIC
/begin CHARACTERISTIC KVB "Konstante für Verbrauchsanzeige" VALUE 0x81ABFB KwUb 777.0 m_ub_b780 0.00 777.0 FUNCTION_LIST KVA IF_DATA DIM_X DIRECT 0x81ABFB /end CHARACTERISTIC
/begin CHARACTERISTIC KVLAD "Konstante für Umrechnung von Ladedruck in Luftmasse" VALUE 0x81131E KwUb 1.992 rel_ub_b2p0 0.00 1.992 FUNCTION_LIST BGMSZS IF_DATA DIM_X DIRECT 0x81131E /end CHARACTERISTIC
/begin CHARACTERISTIC KVNPZ "normierter Krafstoffverbrauch pro Zylinder für Kombiausgabe" VALUE 0x810182 KwUb 5100. kva_ub_q20 0.00 5100. FUNCTION_LIST CAN IF_DATA DIM_X DIRECT 0x810182 /end CHARACTERISTIC
/begin CHARACTERISTIC LADFIL "Ladedruckfilterung" VALUE 0x815886 KwUw 0.9999847 fak_uw_b1 0.00 0.9999847 FUNCTION_LIST BGMSZS IF_DATA DIM_X DIRECT 0x815886 /end CHARACTERISTIC
/begin CHARACTERISTIC LADIFFTHR "Schwelle für Lambda-Differenz für LRS Reset bei Magerschutz" VALUE 0x8174AC KwSw 1.999969 fak_sw_b1 -1.000000 0.9999695 FUNCTION_LIST LRS IF_DATA DIM_X DIRECT 0x8174AC /end CHARACTERISTIC
/begin CHARACTERISTIC LAERROR "Zeit für Fehlererkennung Lastabfall" VALUE 0x81C7E0 KwUw 6553.500 fak_q0p1 0.00 6553.500 FUNCTION_LIST DKMTR IF_DATA DIM_X DIRECT 0x81C7E0 /end CHARACTERISTIC
/begin CHARACTERISTIC LAHEAL "Zeit für Heilung Lastabfall" VALUE 0x81C7E2 KwUw 6553.500 fak_q0p1 0.00 6553.500 FUNCTION_LIST DKMTR IF_DATA DIM_X DIRECT 0x81C7E2 /end CHARACTERISTIC
/begin CHARACTERISTIC LAKTDEO "Obere Schwelle für Lambda eingeschwungen bei Katdiagnose" VALUE 0x81C6F0 KwUw 15.99976 fak_uw_b16 0.00 15.99976 FUNCTION_LIST DKATSP IF_DATA DIM_X DIRECT 0x81C6F0 /end CHARACTERISTIC
/begin CHARACTERISTIC LAKTDEU "Untere Schwelle für Lambda eingeschwungen bei Katdiagnose" VALUE 0x81C6F2 KwUw 15.99976 fak_uw_b16 0.00 15.99976 FUNCTION_LIST DKATSP IF_DATA DIM_X DIRECT 0x81C6F2 /end CHARACTERISTIC
/begin CHARACTERISTIC LALIUS "Lambdalinearisierung, LSU-Sonde vor Katalysator" CURVE 0x814D08 KlAUwSstUwWUw 15.99976 fak_uw_b16 0.00 15.99976 FUNCTION_LIST GGLSU IF_DATA DIM_X DIRECT 0x814D08
 /begin AXIS_DESCR STD_AXIS usvkk_w spg_uw_q0p00488 22 0.00 319.9951 DEPOSIT ABSOLUT /end AXIS_DESCR
/end CHARACTERISTIC
/begin CHARACTERISTIC LALIUSH "Lambdalinearisierung, Sonde hinter Katalysator" CURVE 0x817530 KlAUwSstUwWUw 15.99976 fak_uw_b16 0.00 15.99976 FUNCTION_LIST LRSHK IF_DATA DIM_X DIRECT 0x817530
 /begin AXIS_DESCR STD_AXIS ushk_w spg_uw_q0p00488_o1 10 -1.000000 318.9951 DEPOSIT ABSOLUT /end AXIS_DESCR
/end CHARACTERISTIC
/begin CHARACTERISTIC LALIUSMN "minimales, ueber LALIUS (%GGLSU) messbares Lambda" VALUE 0x8174AE KwUw 15.99976 fak_uw_b16 0.00 15.99976 FUNCTION_LIST LRS LRSEB IF_DATA DIM_X DIRECT 0x8174AE /end CHARACTERISTIC
/begin CHARACTERISTIC LALIUSRH "Lambdalinearisierung, Sonde hinter Katalysator, Sollwert" CURVE 0x81755A KlAUbSstUbWUw 15.99976 fak_uw_b16 0.00 15.99976 FUNCTION_LIST LRSHK IF_DATA DIM_X DIRECT 0x81755A
 /begin AXIS_DESCR STD_AXIS usrhk spg_ub_q0p0052_o0p2 10 -0.2000 1.130 DEPOSIT ABSOLUT /end AXIS_DESCR
/end CHARACTERISTIC
/begin CHARACTERISTIC LAMDYNO "obere Lambdaschwelle für Dynamikprüfung LSU" VALUE 0x81C77E KwUw 15.99976 fak_uw_b16 0.00 15.99976 FUNCTION_LIST DLSU IF_DATA DIM_X DIRECT 0x81C77E /end CHARACTERISTIC
/begin CHARACTERISTIC LAMDYNU "untere Lambdaschwelle für Dynamikprüfung LSU" VALUE 0x81C780 KwUw 15.99976 fak_uw_b16 0.00 15.99976 FUNCTION_LIST DLSU IF_DATA DIM_X DIRECT 0x81C780 /end CHARACTERISTIC
/begin CHARACTERISTIC LAMFA "Lambda Fahrerwunsch" MAP 0x81E3AC KfAxUbAyUbSstxUbSstyUwWUb 1.992 fak_ub_b2 0.00 1.992 FUNCTION_LIST LAMFAW IF_DATA DIM_X DIRECT 0x81E3AC /begin AXIS_DESCR STD_AXIS nmot nmot_ub_q40 15 0.00 10200. DEPOSIT ABSOLUT /end AXIS_DESCR
 /begin AXIS_DESCR STD_AXIS mrfa_w rel_uw_b200 6 0.00 199.9969 DEPOSIT ABSOLUT /end AXIS_DESCR
/end CHARACTERISTIC
/begin CHARACTERISTIC LAMFLGSL "Lambda Motorlaufgrenze  fett bei Sekundärlufteinblasung" CURVE 0x81901B KlAUbSstUbWUb 1.992 fak_ub_b2 0.00 1.992 FUNCTION_LIST LAMKO IF_DATA DIM_X DIRECT 0x81901B /begin AXIS_DESCR STD_AXIS imlatm m_ub_b23p3 6 0.00 23.21 DEPOSIT ABSOLUT /end AXIS_DESCR /end CHARACTERISTIC
/begin CHARACTERISTIC LAMKADEF "Defaultwert Lambda für Katausräumen inaktiv" VALUE 0x8175A8 KwUw 15.99976 fak_uw_b16 0.00 15.99976 FUNCTION_LIST LRSKA IF_DATA DIM_X DIRECT 0x8175A8 /end CHARACTERISTIC
/begin CHARACTERISTIC LAMKAML "Lambdasollwert für Katalysator-Ausräumen (luftmassenabhängig)" CURVE 0x8175AA KlAUbSstUbWUw 15.99976 fak_uw_b16 0.00 15.99976 FUNCTION_LIST LRSKA IF_DATA DIM_X DIRECT 0x8175AA /begin AXIS_DESCR STD_AXIS ml m_ub_b1020 5 0.00 1020. DEPOSIT ABSOLUT /end AXIS_DESCR /end CHARACTERISTIC
/begin CHARACTERISTIC LAMLGFKT "Laufgrenze ""fett"" im Kurz Test" VALUE 0x819028 KwUb 1.992 fak_ub_b2 0.00 1.992 FUNCTION_LIST LAMKO IF_DATA DIM_X DIRECT 0x819028 /end CHARACTERISTIC
/begin CHARACTERISTIC LAMLGFTM "Lambda Motorlaufgrenze fett" CURVE 0x819029 GklWUb 1.992 fak_ub_b2 0.00 1.992 FUNCTION_LIST LAMKO IF_DATA DIM_X DIRECT 0x819029
 /begin AXIS_DESCR COM_AXIS tmot temp_ub_q0p75_o48 12 -48.00 143.3 AXIS_PTS_REF STM12ESUB /end AXIS_DESCR
/end CHARACTERISTIC
/begin CHARACTERISTIC LAMLGMKT "Laufgrenze ""mager"" im Kurz Test" VALUE 0x819035 KwUb 1.992 fak_ub_b2 0.00 1.992 FUNCTION_LIST LAMKO IF_DATA DIM_X DIRECT 0x819035 /end CHARACTERISTIC
/begin CHARACTERISTIC LAMLGMTM "Laufgrenze ""mager""" CURVE 0x819036 GklWUb 1.992 fak_ub_b2 0.00 1.992 FUNCTION_LIST LAMKO IF_DATA DIM_X DIRECT 0x819036
 /begin AXIS_DESCR COM_AXIS tmot temp_ub_q0p75_o48 12 -48.00 143.3 AXIS_PTS_REF STM12ESUB /end AXIS_DESCR
/end CHARACTERISTIC
/begin CHARACTERISTIC LAMLRAMN "minimale Lambda-Schwelle, bei der die Gemischadaption aktiv sein kann" VALUE 0x81E426 KwUw 15.99976 fak_uw_b16 0.00 15.99976 FUNCTION_LIST LRAEB IF_DATA DIM_X DIRECT 0x81E426 /end CHARACTERISTIC
/begin CHARACTERISTIC LAMLRAMX "maximale Lambda-Schwelle, bei der die Gemischadaption aktiv sein kann" VALUE 0x81E428 KwUw 15.99976 fak_uw_b16 0.00 15.99976 FUNCTION_LIST LRAEB IF_DATA DIM_X DIRECT 0x81E428 /end CHARACTERISTIC
/begin CHARACTERISTIC LAMMN "Untere Plausibilitätsschwelle für Lambda" VALUE 0x81C782 KwUw 15.99976 fak_uw_b16 0.00 15.99976 FUNCTION_LIST DLSU IF_DATA DIM_X DIRECT 0x81C782 /end CHARACTERISTIC
/begin CHARACTERISTIC LAMMX "Obere Plausibilitätsschwelle für Lambda" VALUE 0x81C784 KwUw 15.99976 fak_uw_b16 0.00 15.99976 FUNCTION_LIST DLSU IF_DATA DIM_X DIRECT 0x81C784 /end CHARACTERISTIC
/begin CHARACTERISTIC LAMRLMN "Lamdavorsteuerung bei rl < RLLAMMN zur Verbesserung der Brennbarkeit" VALUE 0x8192F3 KwUb 1.992 fak_ub_b2 0.00 1.992 FUNCTION_LIST LAMFAW IF_DATA DIM_X DIRECT 0x8192F3 /end CHARACTERISTIC
/begin CHARACTERISTIC LAMSKAMX "Lambda-Ist vor Kat für Erkennung Magerbedingung Kat-Ausräumen" VALUE 0x8175BA KwUw 15.99976 fak_uw_b16 0.00 15.99976 FUNCTION_LIST LRSKA IF_DATA DIM_X DIRECT 0x8175BA /end CHARACTERISTIC
/begin CHARACTERISTIC LAMSSAMN "untere Grenze für lamsosa und lamsisa, CARB-Tester, DLSSALRS" VALUE 0x818A10 KwUb 1.992 fak_ub_b2 0.00 1.992 FUNCTION_LIST DLSSA TC5MOD IF_DATA DIM_X DIRECT 0x818A10 /end CHARACTERISTIC
/begin CHARACTERISTIC LAMSSAMX "obere Grenze für lamsosa und lamsisa, CARB-Tester, DLSSALRS" VALUE 0x818A11 KwUb 1.992 fak_ub_b2 0.00 1.992 FUNCTION_LIST DLSSA TC5MOD IF_DATA DIM_X DIRECT 0x818A11 /end CHARACTERISTIC
/begin CHARACTERISTIC LAMSSMN "Minimales Lambdasoll für  stöchiometrischen Betrieb" VALUE 0x81C786 KwUw 15.99976 fak_uw_b16 0.00 15.99976 FUNCTION_LIST DLSU IF_DATA DIM_X DIRECT 0x81C786 /end CHARACTERISTIC
/begin CHARACTERISTIC LAMSSMX "Maximales Lambdasoll für  stöchiometrischen Betrieb" VALUE 0x81C788 KwUw 15.99976 fak_uw_b16 0.00 15.99976 FUNCTION_LIST DLSU IF_DATA DIM_X DIRECT 0x81C788 /end CHARACTERISTIC
/begin CHARACTERISTIC LAMTEMN "minimale Lambda-Schwelle, bei der die Tankentlüftung aktiv sein kann" VALUE 0x829C52 KwUw 15.99976 fak_uw_b16 0.00 15.99976 FUNCTION_LIST TEBEB IF_DATA DIM_X DIRECT 0x829C52 /end CHARACTERISTIC
/begin CHARACTERISTIC LAMTEMX "maximale Lambda-Schwelle, bei der die Tankentlüftung aktiv sein kann" VALUE 0x829C54 KwUw 15.99976 fak_uw_b16 0.00 15.99976 FUNCTION_LIST TEBEB IF_DATA DIM_X DIRECT 0x829C54 /end CHARACTERISTIC
/begin CHARACTERISTIC LASDSLA "Lambda-Abgas-Soll bei Sekundärluftadaption/Kurztest" CURVE 0x81F7B6 KlAUwSstUwWUw 15.99976 fak_q0p000244 0.00 15.99976 FUNCTION_LIST LAKH IF_DATA DIM_X DIRECT 0x81F7B6 /begin AXIS_DESCR STD_AXIS ml_w m_uw_b6553p5 4 0.00 6553.500 DEPOSIT ABSOLUT /end AXIS_DESCR /end CHARACTERISTIC
/begin CHARACTERISTIC LASHKAB "Startwert für dynamische Sollwertanhebung (lamsolh) in der LRHK" VALUE 0x81757A KwSw 0.9999695 fak_sw_b1 0.00 0.9999695 FUNCTION_LIST LRSHK IF_DATA DIM_X DIRECT 0x81757A /end CHARACTERISTIC
/begin CHARACTERISTIC LASOAB "Lambdasollwert bei Bankabschaltung" VALUE 0x81160F KwUb 1.992 fak_ub_b2 0.00 1.992 FUNCTION_LIST LAMKO IF_DATA DIM_X DIRECT 0x81160F /end CHARACTERISTIC
/begin CHARACTERISTIC LASPLCFT "Fettschwelle für den Sollwert von Lambda für den Plausibilitätscheck" VALUE 0x81C78A KwUw 15.99976 fak_uw_b16 0.00 15.99976 FUNCTION_LIST DLSU IF_DATA DIM_X DIRECT 0x81C78A /end CHARACTERISTIC
/begin CHARACTERISTIC LASPLCMR "Magerschwelle für den Sollwert von Lambda für den Plausibilitätscheck" VALUE 0x81C78C KwUw 15.99976 fak_uw_b16 0.00 15.99976 FUNCTION_LIST DLSU IF_DATA DIM_X DIRECT 0x81C78C /end CHARACTERISTIC
/begin CHARACTERISTIC LASTMOT "Motortemp.-Korrektur von Lambda-Abgas-Soll" CURVE 0x819880 KlAUbSstUbWUb 1.992 fak_ub_b2 0.00 1.992 FUNCTION_LIST LAKH IF_DATA DIM_X DIRECT 0x819880
 /begin AXIS_DESCR STD_AXIS tmot temp_ub_q0p75_o48 4 -48.00 143.3 DEPOSIT ABSOLUT /end AXIS_DESCR
/end CHARACTERISTIC
/begin CHARACTERISTIC LASWLTM_0_A "Offset Lambda-Motor-Soll bei inaktiver Lambdaregelung" CURVE 0x8191B4 GklWSb 1.992 fak_sb_b1 -1.000 0.9922 FUNCTION_LIST LANSWL IF_DATA DIM_X INDIRECT 0x815AFA
 /begin AXIS_DESCR COM_AXIS tmot temp_ub_q0p75_o48 12 -48.00 143.3 AXIS_PTS_REF STM12ESUB /end AXIS_DESCR
/end CHARACTERISTIC
/begin CHARACTERISTIC LASWLTM_1_A "Offset Lambda-Motor-Soll bei inaktiver Lambdaregelung" CURVE 0x8191C0 GklWSb 1.992 fak_sb_b1 -1.000 0.9922 FUNCTION_LIST LANSWL IF_DATA DIM_X INDIRECT 0x815AFE
 /begin AXIS_DESCR COM_AXIS tmot temp_ub_q0p75_o48 12 -48.00 143.3 AXIS_PTS_REF STM12ESUB /end AXIS_DESCR
/end CHARACTERISTIC
/begin CHARACTERISTIC LBMINC "Wert der bei Bezugsmarkenverlust hinzuaddiert wird" VALUE 0x813FCA KwUw 65535.00 dez 0.00 65535.00 FUNCTION_LIST DDG IF_DATA DIM_X DIRECT 0x813FCA /end CHARACTERISTIC
/begin CHARACTERISTIC LBMINIT "Initialisierungswert des Zählers Bezugsmarkenverlust, wenn SG zuvor im NLDG war" VALUE 0x813FCC KwUw 65535.00 dez 0.00 65535.00 FUNCTION_LIST DDG IF_DATA DIM_X DIRECT 0x813FCC /end CHARACTERISTIC
/begin CHARACTERISTIC LBMMX "Maximalwert für Zähler Bezugsmarkenverlust" VALUE 0x813FCE KwUw 65535.00 dez 0.00 65535.00 FUNCTION_LIST DDG IF_DATA DIM_X DIRECT 0x813FCE /end CHARACTERISTIC
/begin CHARACTERISTIC LBZO1 "Schwelle für lbz zur Solldrehzahlanhebung beim Verlassen des LL" VALUE 0x819FA2 KwUb 99.61 rel_ub_b99p6 0.00 99.61 FUNCTION_LIST LLRNS IF_DATA DIM_X DIRECT 0x819FA2 /end CHARACTERISTIC
/begin CHARACTERISTIC LBZO2 "Schwelle für lbz zur Solldrehzahlanhebung im Leerlauf" VALUE 0x819FA3 KwUb 99.61 rel_ub_b99p6 0.00 99.61 FUNCTION_LIST LLRNS IF_DATA DIM_X DIRECT 0x819FA3 /end CHARACTERISTIC
/begin CHARACTERISTIC LBZU "Schwelle für lbz zur Solldrehzahlabsenkung beim Verlassen des Leerlaufs" VALUE 0x819FA4 KwUb 99.61 rel_ub_b99p6 0.00 99.61 FUNCTION_LIST LLRNS IF_DATA DIM_X DIRECT 0x819FA4 /end CHARACTERISTIC
/begin CHARACTERISTIC LDAMN "Minimalwertbegrenzung der Adaption LDR I-Adaption" VALUE 0x827918 KwSw 327.6750 tv_sw_q0p005 -163.8400 163.8350 FUNCTION_LIST LDRPID IF_DATA DIM_X DIRECT 0x827918 /end CHARACTERISTIC
/begin CHARACTERISTIC LDDIAN "Schrittweite pro Programmdurchlauf für negativ-Nachführung I-Begrenzung" VALUE 0x82791A KwSw 327.6750 tv_sw_q0p005 -163.8400 163.8350 FUNCTION_LIST LDRPID IF_DATA DIM_X DIRECT 0x82791A /end CHARACTERISTIC
/begin CHARACTERISTIC LDDIAP "Schrittweite pro Programmdurchlauf für positiv-Nachführung I-Begrenzung" VALUE 0x82791C KwSw 327.6750 tv_sw_q0p005 -163.8400 163.8350 FUNCTION_LIST LDRPID IF_DATA DIM_X DIRECT 0x82791C /end CHARACTERISTIC
/begin CHARACTERISTIC LDDIMNN "Sicherheitsabstand LDR I-Regler Begrenzung negativ" CURVE 0x82791E GklWSw 327.6750 tv_sw_q0p005 -163.8400 163.8350 FUNCTION_LIST LDRPID IF_DATA DIM_X DIRECT 0x82791E
 /begin AXIS_DESCR COM_AXIS nmot_w nmot_uw_q0p25 8 0.00 16383.75 AXIS_PTS_REF SNM08LDUW /end AXIS_DESCR
/end CHARACTERISTIC
/begin CHARACTERISTIC LDDIMXN "Sicherheitsabstand LDR I-Regler Begrenzung" CURVE 0x82792E GklWSw 327.6750 tv_sw_q0p005 -163.8400 163.8350 FUNCTION_LIST LDRPID IF_DATA DIM_X DIRECT 0x82792E
 /begin AXIS_DESCR COM_AXIS nmot_w nmot_uw_q0p25 8 0.00 16383.75 AXIS_PTS_REF SNM08LDUW /end AXIS_DESCR
/end CHARACTERISTIC
/begin CHARACTERISTIC LDEIAO "Obere Regelabweichungsschwelle für Negativ-Verstellung" VALUE 0x819D34 KwSb 2550. p_sb_q10 -1280. 1270. FUNCTION_LIST LDRPID IF_DATA DIM_X DIRECT 0x819D34 /end CHARACTERISTIC
/begin CHARACTERISTIC LDEIAP "Regelabweichungsschwelle für  Positiv Adaption I-Regler" VALUE 0x819D35 KwSb 2550. p_sb_q10 -1280. 1270. FUNCTION_LIST LDRPID IF_DATA DIM_X DIRECT 0x819D35 /end CHARACTERISTIC
/begin CHARACTERISTIC LDEIAPS "Regelabweichungsschwelle für schnelle Positiv-Nachführung" VALUE 0x819D36 KwSb 2550. p_sb_q10 -1280. 1270. FUNCTION_LIST LDRPID IF_DATA DIM_X DIRECT 0x819D36 /end CHARACTERISTIC
/begin CHARACTERISTIC LDEIAU "Untere Regelabweichungsschwelle für Negativ-Verstellung" VALUE 0x819D37 KwSb 2550. p_sb_q10 -1280. 1270. FUNCTION_LIST LDRPID IF_DATA DIM_X DIRECT 0x819D37 /end CHARACTERISTIC
/begin CHARACTERISTIC LDHIA "Hysterese für LDR I-Adaptionskennlinie" VALUE 0x819D38 KwUb 10200. nmot_ub_q40 0.00 10200. FUNCTION_LIST LDRPID IF_DATA DIM_X DIRECT 0x819D38 /end CHARACTERISTIC
/begin CHARACTERISTIC LDIATA "Korrektur I-Begrenzung LDR PID Rgler als Funktion von Tans" CURVE 0x819D39 GklWSb 163.2 tv_ub_q0p64 -81.92 81.28 FUNCTION_LIST LDRPID IF_DATA DIM_X DIRECT 0x819D39
 /begin AXIS_DESCR COM_AXIS tans temp_ub_q0p75_o48 8 -48.00 143.3 AXIS_PTS_REF STA08LDUB /end AXIS_DESCR
/end CHARACTERISTIC
/begin CHARACTERISTIC LDMXNN "Begrenzung max. Nachführung LDR negativ für Regleradaption" VALUE 0x82793E KwSw 163.8400 tv_sw_q0p005 -163.8400 0.00 FUNCTION_LIST LDRPID IF_DATA DIM_X DIRECT 0x82793E /end CHARACTERISTIC
/begin CHARACTERISTIC LDMXNP "Begrenzung max. Nachführung LDR Adaption positiv bei Bereichswechsel" VALUE 0x827940 KwSw 163.8350 tv_sw_q0p005 0.00 163.8350 FUNCTION_LIST LDRPID IF_DATA DIM_X DIRECT 0x827940 /end CHARACTERISTIC
/begin CHARACTERISTIC LDPBN "LDR p-Begrenzung bei zu hoher Motortemperatur" CURVE 0x819DAB GklWUb 2550. p_ub_q10 0.00 2550. FUNCTION_LIST LDRLMX IF_DATA DIM_X DIRECT 0x819DAB
 /begin AXIS_DESCR COM_AXIS nmot nmot_ub_q40 8 0.00 10200. AXIS_PTS_REF SNM08LDUB /end AXIS_DESCR
/end CHARACTERISTIC
/begin CHARACTERISTIC LDRAPP "Festwert für LDR-Applikation ohne Md-Koordination" VALUE 0x819E4A KwUb 99.61 tv_ub_b100 0.00 99.61 FUNCTION_LIST LDTVMA IF_DATA DIM_X DIRECT 0x819E4A /end CHARACTERISTIC
/begin CHARACTERISTIC LDRPBU "P-Regler Kennwert LDR back up Regler" VALUE 0x819E4B KwUb 0.2621 tv_q0p001028 0.00 0.2621 FUNCTION_LIST LDTVMA IF_DATA DIM_X DIRECT 0x819E4B /end CHARACTERISTIC
/begin CHARACTERISTIC LDRQ0S "Reglerparameter Q0 LDR-PID Regler im Stationärbetrieb" VALUE 0x827942 KwUw 3276.750 rel_uw_b3276p75 0.00 3276.750 FUNCTION_LIST LDRPID IF_DATA DIM_X DIRECT 0x827942 /end CHARACTERISTIC
/begin CHARACTERISTIC LDRQ1ST "Reglerparameter Q1 PID-Regler im Stationärbetrieb (Integrationsbeiwert)" CURVE 0x827944 GklWUw 3276.750 rel_uw_b3276p75 0.00 3276.750 FUNCTION_LIST LDRPID IF_DATA DIM_X DIRECT 0x827944
 /begin AXIS_DESCR COM_AXIS nmot nmot_ub_q40 16 0.00 10200. AXIS_PTS_REF SNM16LDUB /end AXIS_DESCR
/end CHARACTERISTIC
/begin CHARACTERISTIC LDRVL "Vollast Erkennungsschwelle LDR" VALUE 0x819D41 KwUb 99.61 rel_ub_b99p6 0.00 99.61 FUNCTION_LIST LDRPID IF_DATA DIM_X DIRECT 0x819D41 /end CHARACTERISTIC
/begin CHARACTERISTIC LDRXN "Maximalfuellung LDR" CURVE 0x827EC8 KlAUbSstUwWUw 1535.977 rel_uw_q0p0234 0.00 1535.977 FUNCTION_LIST LDRLMX IF_DATA DIM_X DIRECT 0x827EC8
 /begin AXIS_DESCR STD_AXIS nmot_w nmot_uw_q0p25 16 0.00 16383.75 DEPOSIT ABSOLUT /end AXIS_DESCR
/end CHARACTERISTIC
/begin CHARACTERISTIC LDRXNZK "Maximalfuellung LDR bei Dauerklopfen" CURVE 0x827F0A KlAUbSstUwWUw 1535.977 rel_uw_q0p0234 0.00 1535.977 FUNCTION_LIST LDRLMX IF_DATA DIM_X DIRECT 0x827F0A
 /begin AXIS_DESCR STD_AXIS nmot_w nmot_uw_q0p25 16 0.00 16383.75 DEPOSIT ABSOLUT /end AXIS_DESCR
/end CHARACTERISTIC
/begin CHARACTERISTIC LDUVRS "LDR Umluftventilsteuerung Reset vom Sollwert" VALUE 0x816352 KwUw 2559.961 p_uw_q0p039 0.00 2559.961 FUNCTION_LIST LDUVST IF_DATA DIM_X DIRECT 0x816352 /end CHARACTERISTIC
/begin CHARACTERISTIC LIMN "Untere Integratorbegrenzung bei stehendem Fahrzeug" VALUE 0x811D0A KwUb 24.90 rel_ub_bn24p9 -24.90 0.00 FUNCTION_LIST LLRRM IF_DATA DIM_X DIRECT 0x811D0A /end CHARACTERISTIC
/begin CHARACTERISTIC LIMNDLLR "Untere Integratorbegrenzung bei Diagnose Leerlaufregelung" VALUE 0x811D0B KwUb 24.90 rel_ub_bn24p9 -24.90 0.00 FUNCTION_LIST LLRRM IF_DATA DIM_X DIRECT 0x811D0B /end CHARACTERISTIC
/begin CHARACTERISTIC LIMNDTES "Untere Integratorbegrenzung bei DTES" VALUE 0x811D0C KwUb 24.90 rel_ub_bn24p9 -24.90 0.00 FUNCTION_LIST LLRRM IF_DATA DIM_X DIRECT 0x811D0C /end CHARACTERISTIC
/begin CHARACTERISTIC LIMNV "Untere Integratorbegrenzung bei rollendem Fahrzeug" VALUE 0x811D0D KwUb 24.90 rel_ub_bn24p9 -24.90 0.00 FUNCTION_LIST LLRRM IF_DATA DIM_X DIRECT 0x811D0D /end CHARACTERISTIC
/begin CHARACTERISTIC LIMXDNS "Obere Integratorbegrenzung bei stehendem Fahrzeug" CURVE 0x81A0A0 GklWUb 24.90 rel_ub_b24p9 0.00 24.90 FUNCTION_LIST LLRRM IF_DATA DIM_X DIRECT 0x81A0A0
 /begin AXIS_DESCR COM_AXIS dns nmotd_sb_q10 6 -1280. 1270. AXIS_PTS_REF SNS206LLSB /end AXIS_DESCR
/end CHARACTERISTIC
/begin CHARACTERISTIC LIMXVDNS "Obere Integratorbegrenzung bei rollendem Fahrzeug" CURVE 0x81A0A6 GklWUb 24.90 rel_ub_b24p9 0.00 24.90 FUNCTION_LIST LLRRM IF_DATA DIM_X DIRECT 0x81A0A6
 /begin AXIS_DESCR COM_AXIS dns nmotd_sb_q10 6 -1280. 1270. AXIS_PTS_REF SNS206LLSB /end AXIS_DESCR
/end CHARACTERISTIC
/begin CHARACTERISTIC LISTM_0_A "Wert des Leerlaufintegrators im Start" CURVE 0x81A0AC GklWUb 24.90 rel_ub_b24p9 0.00 24.90 FUNCTION_LIST LLRRM IF_DATA DIM_X INDIRECT 0x816228
 /begin AXIS_DESCR COM_AXIS tmot temp_ub_q0p75_o48 6 -48.00 143.3 AXIS_PTS_REF STM06LLUB /end AXIS_DESCR
/end CHARACTERISTIC
/begin CHARACTERISTIC LISTM_1_A "Wert des Leerlaufintegrators im Start" CURVE 0x81A0B2 GklWUb 24.90 rel_ub_b24p9 0.00 24.90 FUNCTION_LIST LLRRM IF_DATA DIM_X INDIRECT 0x81622C
 /begin AXIS_DESCR COM_AXIS tmot temp_ub_q0p75_o48 6 -48.00 143.3 AXIS_PTS_REF STM06LLUB /end AXIS_DESCR
/end CHARACTERISTIC
/begin CHARACTERISTIC LKRAN "Lastschwelle Klopfregel-Adaption" CURVE 0x819B5B GklWUb 191.3 rel_ub_q0p75 0.00 191.3 FUNCTION_LIST KRRA IF_DATA DIM_X DIRECT 0x819B5B
 /begin AXIS_DESCR COM_AXIS nmot nmot_ub_q40 16 0.00 10200. AXIS_PTS_REF SNM16KRUB /end AXIS_DESCR
/end CHARACTERISTIC
/begin CHARACTERISTIC LKRN "Lastschwelle Klopfregelung" CURVE 0x819B6B GklWUb 191.3 rel_ub_q0p75 0.00 191.3 FUNCTION_LIST KRRA IF_DATA DIM_X DIRECT 0x819B6B
 /begin AXIS_DESCR COM_AXIS nmot nmot_ub_q40 16 0.00 10200. AXIS_PTS_REF SNM16KRUB /end AXIS_DESCR
/end CHARACTERISTIC
/begin CHARACTERISTIC LKTDF "Lambdawert bei Kat-Diagnose, Fettsprung" VALUE 0x81C6F4 KwUw 0.2500000 fak_uw_b16 0.7500000 1.000000 FUNCTION_LIST DKATSP IF_DATA DIM_X DIRECT 0x81C6F4 /end CHARACTERISTIC
/begin CHARACTERISTIC LKTDFT "Lambdawert bei Kat-Diagnose, Fettsprung, Testerbetrieb" VALUE 0x81C6F6 KwUw 0.2500000 fak_uw_b16 0.7500000 1.000000 FUNCTION_LIST DKATSP IF_DATA DIM_X DIRECT 0x81C6F6 /end CHARACTERISTIC
/begin CHARACTERISTIC LKTDM "Lambdawert bei Kat-Diagnose, Magersprung" VALUE 0x81C6F8 KwUw 0.2500000 fak_uw_b16 1.000000 1.250000 FUNCTION_LIST DKATSP IF_DATA DIM_X DIRECT 0x81C6F8 /end CHARACTERISTIC
/begin CHARACTERISTIC LKTDMT "Lambdawert bei Kat-Diagnose, Magersprung, Testerbetrieb" VALUE 0x81C6FA KwUw 0.2500000 fak_uw_b16 1.000000 1.250000 FUNCTION_LIST DKATSP IF_DATA DIM_X DIRECT 0x81C6FA /end CHARACTERISTIC
/begin CHARACTERISTIC LKVDKNMN "Drehzahlschwelle für Leckekennung vor DK beim Turbo" VALUE 0x819E52 KwUb 10200. nmot_ub_q40 0.00 10200. FUNCTION_LIST DLDR IF_DATA DIM_X DIRECT 0x819E52 /end CHARACTERISTIC
/begin CHARACTERISTIC LLRICNF "Configurationsbyte für LLR Integrator" VALUE 0x811D0E KwUb 255.0 dez 0.00 255.0 FUNCTION_LIST LLRRM IF_DATA DIM_X DIRECT 0x811D0E /end CHARACTERISTIC
/begin CHARACTERISTIC LMSTMOT "Motortemp.-Korrektur von Lambda-Motor-Soll" CURVE 0x819889 KlAUbSstUbWUb 1.992 fak_ub_b2 0.00 1.992 FUNCTION_LIST LAKH IF_DATA DIM_X DIRECT 0x819889
 /begin AXIS_DESCR STD_AXIS tmot temp_ub_q0p75_o48 4 -48.00 143.3 DEPOSIT ABSOLUT /end AXIS_DESCR
/end CHARACTERISTIC
/begin CHARACTERISTIC LNXQTM "Natürlicher Logarithmus aus Temperaturquotient" CURVE 0x81E46C KlAUbSstUwWUw 3.999939 fak_uw_b4 0.00 3.999939 FUNCTION_LIST BGTABST IF_DATA DIM_X DIRECT 0x81E46C
 /begin AXIS_DESCR STD_AXIS xqtm_w fak_uw_b16 12 0.00 15.99976 DEPOSIT ABSOLUT /end AXIS_DESCR
/end CHARACTERISTIC
/begin CHARACTERISTIC LRHIMN "minimale Integratorgrenze der stetigen LRHK" VALUE 0x81757C KwSw 1.999969 fak_sw_b1 -1.000000 0.9999695 FUNCTION_LIST LRSHK IF_DATA DIM_X DIRECT 0x81757C /end CHARACTERISTIC
/begin CHARACTERISTIC LRHIMX "maximale Integratorgrenze der stetigen LRHK" VALUE 0x81757E KwSw 1.999969 fak_sw_b1 -1.000000 0.9999695 FUNCTION_LIST LRSHK IF_DATA DIM_X DIRECT 0x81757E /end CHARACTERISTIC
/begin CHARACTERISTIC LRNST1_T "Wartezeit in Lernschritt 1" VALUE 0x811146 KwUb 5.080 t20msxs_ub_b5p1 0.02000 5.100 FUNCTION_LIST BGDVE IF_DATA DIM_X DIRECT 0x811146 /end CHARACTERISTIC
/begin CHARACTERISTIC LRNST3_T "Wartezeit in Lernschritt 3" VALUE 0x811147 KwUb 5.080 t20msxs_ub_b5p1 0.02000 5.100 FUNCTION_LIST BGDVE IF_DATA DIM_X DIRECT 0x811147 /end CHARACTERISTIC
/begin CHARACTERISTIC LRNST7_T "Wartezeit in Lernschritt 7" VALUE 0x811148 KwUb 5.080 t20msxs_ub_b5p1 0.02000 5.100 FUNCTION_LIST BGDVE IF_DATA DIM_X DIRECT 0x811148 /end CHARACTERISTIC
/begin CHARACTERISTIC LRNST9_T "Wartezeit in Lernschritt 9" VALUE 0x811149 KwUb 5.080 t20msxs_ub_b5p1 0.02000 5.100 FUNCTION_LIST BGDVE IF_DATA DIM_X DIRECT 0x811149 /end CHARACTERISTIC
/begin CHARACTERISTIC LRSGKTM "Korrekturkennlinie der Reglerparameter bei tiefen Motortemperaturen" CURVE 0x81A495 KlAUbSstUbWUb 1.992 fak_ub_b2 0.00 1.992 FUNCTION_LIST LRS IF_DATA DIM_X DIRECT 0x81A495
 /begin AXIS_DESCR STD_AXIS tmot temp_ub_q0p75_o48 6 -48.00 143.3 DEPOSIT ABSOLUT /end AXIS_DESCR
/end CHARACTERISTIC
/begin CHARACTERISTIC LRSTPZA "Periodendauer der LRS-Zwangsamplitude" VALUE 0x8174B0 KwUw 655.3500 t10msxs_uw_b655p35 0.00 655.3500 FUNCTION_LIST LRS IF_DATA DIM_X DIRECT 0x8174B0 /end CHARACTERISTIC
/begin CHARACTERISTIC LRSZAWML "Kennlinie Amplitude der LRS-Zwangsamplitude" CURVE 0x8174B2 KlAUwSstUwWUb 0.249023438 fak_ub_b0p25 0.00 0.249023438 FUNCTION_LIST LRS IF_DATA DIM_X DIRECT 0x8174B2 /begin AXIS_DESCR STD_AXIS ml_w m_uw_b6553p5 6 0.00 6553.500 DEPOSIT ABSOLUT /end AXIS_DESCR /end CHARACTERISTIC
/begin CHARACTERISTIC LSUNAMN "untere Schwelle für LSU nicht aktiv" VALUE 0x81C78E KwUw 15.99976 fak_uw_b16 0.00 15.99976 FUNCTION_LIST DLSU IF_DATA DIM_X DIRECT 0x81C78E /end CHARACTERISTIC
/begin CHARACTERISTIC LSUNAMX "obere Schwelle für LSU nicht aktiv" VALUE 0x81C790 KwUw 15.99976 fak_uw_b16 0.00 15.99976 FUNCTION_LIST DLSU IF_DATA DIM_X DIRECT 0x81C790 /end CHARACTERISTIC
/begin CHARACTERISTIC LUEKO1 "Alternative Lüfterkonfiguration 1 zu CWLUEKO über Login Code" VALUE 0x82B182 KwUw 65535.00 dez 0.00 65535.00 FUNCTION_LIST KMTR IF_DATA DIM_X DIRECT 0x82B182 /end CHARACTERISTIC
/begin CHARACTERISTIC LUEKO2 "Alternative Lüfterkonfiguration 2 zu CWLUEKO über Login Code" VALUE 0x82B184 KwUw 65535.00 dez 0.00 65535.00 FUNCTION_LIST KMTR IF_DATA DIM_X DIRECT 0x82B184 /end CHARACTERISTIC
/begin CHARACTERISTIC LUEKO3 "Alternative Lüfterkonfiguration 3 zu CWLUEKO über Login Code" VALUE 0x82B186 KwUw 65535.00 dez 0.00 65535.00 FUNCTION_LIST KMTR IF_DATA DIM_X DIRECT 0x82B186 /end CHARACTERISTIC
/begin CHARACTERISTIC LUEN1LOGIN "Login-Code für Drehzahlfenster 1 aktiv (Lüftersteuerung)" VALUE 0x8161BE KwUw 65535.00 dez 0.00 65535.00 FUNCTION_LIST TKMWL K71SR KWPDATR IF_DATA DIM_X DIRECT 0x8161BE /end CHARACTERISTIC
/begin CHARACTERISTIC LUEN2LOGIN "Login-Code für Drehzahlfenster 2 aktiv (Lüftersteuerung)" VALUE 0x8161C0 KwUw 65535.00 dez 0.00 65535.00 FUNCTION_LIST TKMWL K71SR KWPDATR IF_DATA DIM_X DIRECT 0x8161C0 /end CHARACTERISTIC
/begin CHARACTERISTIC LUEN3LOGIN "Login-Code für Drehzahlfenster 3 aktiv (Lüftersteuerung)" VALUE 0x8161C2 KwUw 65535.00 dez 0.00 65535.00 FUNCTION_LIST TKMWL K71SR KWPDATR IF_DATA DIM_X DIRECT 0x8161C2 /end CHARACTERISTIC
/begin CHARACTERISTIC LURBRL8_0_A "Laufunruhe-Referenzwert bei Fahrzeug steht" CURVE 0x81BD48 KlAUbSstUbWSb 172.5 luquant -86.57 85.89 FUNCTION_LIST DMDLU_C IF_DATA DIM_X INDIRECT 0x813756 /begin AXIS_DESCR STD_AXIS rl rel_ub_q0p75 8 0.00 191.3 DEPOSIT ABSOLUT /end AXIS_DESCR /end CHARACTERISTIC
/begin CHARACTERISTIC LURBRL8_1_A "Laufunruhe-Referenzwert bei Fahrzeug steht" CURVE 0x81BD5A KlAUbSstUbWSb 172.5 luquant -86.57 85.89 FUNCTION_LIST DMDLU_C IF_DATA DIM_X INDIRECT 0x81375A /begin AXIS_DESCR STD_AXIS rl rel_ub_q0p75 8 0.00 191.3 DEPOSIT ABSOLUT /end AXIS_DESCR /end CHARACTERISTIC
/begin CHARACTERISTIC LURFOST_0_A "Laufruhe-Referenzwert für stop fuel-on/-off Adaption, Vergleich mit lunw" VALUE 0x810225 KwUb 172.5 luquant 0.00 172.5 FUNCTION_LIST DMDFON IF_DATA DIM_X DIRECT 0x810225 /end CHARACTERISTIC
/begin CHARACTERISTIC LURKH_0_A "dmrkh-abh. Laufunruhe-Referenzkorrekturwert, bei Katheizen" CURVE 0x818426 KlAUbSstUbWUb 1.992 fak_ub_b2 0.00 1.992 FUNCTION_LIST DMDLU_C IF_DATA DIM_X INDIRECT 0x81374E /begin AXIS_DESCR STD_AXIS dmrkh rel_ub_b99p6 4 0.00 99.61 DEPOSIT ABSOLUT /end AXIS_DESCR /end CHARACTERISTIC
/begin CHARACTERISTIC LURKTM "Tmot-abhängiger Laufunruhe-Referenz-Korrekturwert" CURVE 0x810CC9 GklWSb 172.5 luquant -86.57 85.89 FUNCTION_LIST DMDLU IF_DATA DIM_X DIRECT 0x810CC9
 /begin AXIS_DESCR COM_AXIS tmot temp_ub_q0p75_o48 8 -48.00 143.3 AXIS_PTS_REF STM08DMUB /end AXIS_DESCR
/end CHARACTERISTIC
/begin CHARACTERISTIC LURMIN1_0_A "Drehzahlabh. Laufunruhe-Referenz-Minimalwert 1" CURVE 0x810CD9 GklWSb 172.5 luquant -86.57 85.89 FUNCTION_LIST DMDLU IF_DATA DIM_X INDIRECT 0x8173D4
 /begin AXIS_DESCR COM_AXIS nmot nmot_ub_q40 8 0.00 10200. AXIS_PTS_REF SNM08DMUB /end AXIS_DESCR
/end CHARACTERISTIC
/begin CHARACTERISTIC LURMIN1_1_A "Drehzahlabh. Laufunruhe-Referenz-Minimalwert 1" CURVE 0x810CE9 GklWSb 172.5 luquant -86.57 85.89 FUNCTION_LIST DMDLU IF_DATA DIM_X INDIRECT 0x8173D6
 /begin AXIS_DESCR COM_AXIS nmot nmot_ub_q40 8 0.00 10200. AXIS_PTS_REF SNM08DMUB /end AXIS_DESCR
/end CHARACTERISTIC
/begin CHARACTERISTIC LURMIN2_0_A "Drehzahlabh. Laufunruhe-Referenz-Minimalwert 2" CURVE 0x810CF1 GklWSb 172.5 luquant -86.57 85.89 FUNCTION_LIST DMDLU IF_DATA DIM_X INDIRECT 0x8173D8
 /begin AXIS_DESCR COM_AXIS nmot nmot_ub_q40 8 0.00 10200. AXIS_PTS_REF SNM08DMUB /end AXIS_DESCR
/end CHARACTERISTIC
/begin CHARACTERISTIC LURMIN2_1_A "Drehzahlabh. Laufunruhe-Referenz-Minimalwert 2" CURVE 0x810CF9 GklWSb 172.5 luquant -86.57 85.89 FUNCTION_LIST DMDLU IF_DATA DIM_X INDIRECT 0x8173DA
 /begin AXIS_DESCR COM_AXIS nmot nmot_ub_q40 8 0.00 10200. AXIS_PTS_REF SNM08DMUB /end AXIS_DESCR
/end CHARACTERISTIC
/begin CHARACTERISTIC LURST "Laufunruhe-Referenzwertkorrektur nach Start" CURVE 0x818441 KlAUbSstUbWUb 1.992 fak_ub_b2 0.00 1.992 FUNCTION_LIST DMDLU_C IF_DATA DIM_X DIRECT 0x818441
 /begin AXIS_DESCR STD_AXIS tnstmd t40msxs_ub_q0p04 6 0.00 10.20 DEPOSIT ABSOLUT /end AXIS_DESCR
/end CHARACTERISTIC
/begin CHARACTERISTIC LWSER "Lenkilfelastmoment bei fehlerhaftem Lenkwinkelsensor" VALUE 0x81A1EE KwUb 49.80 rel_q0p1953 0.00 49.80 FUNCTION_LIST MDVERB IF_DATA DIM_X DIRECT 0x81A1EE /end CHARACTERISTIC
/begin CHARACTERISTIC LZB1 "Leitzylinderzuordnung: Bank1 führt Bank2 bei Fehler KS 2" VAL_BLK 0x811C15 KwbUb 255.0 dez 0.00 255.0 NUMBER 8 FUNCTION_LIST KRRA IF_DATA DIM_X DIRECT 0x811C15 /end CHARACTERISTIC
/begin CHARACTERISTIC LZB2 "Leitzylinderzuordnung: Bank2 führt Bank1 bei Fehler KS 1" VAL_BLK 0x811C1D KwbUb 255.0 dez 0.00 255.0 NUMBER 8 FUNCTION_LIST KRRA IF_DATA DIM_X DIRECT 0x811C1D /end CHARACTERISTIC
/begin CHARACTERISTIC LZFUER "Festwerteblock: Leitzylinderzuordnung" VAL_BLK 0x811C25 KwbUb 255.0 dez 0.00 255.0 NUMBER 8 FUNCTION_LIST KRRA IF_DATA DIM_X DIRECT 0x811C25 /end CHARACTERISTIC
/begin CHARACTERISTIC MDATNM "Drehmomentaufnahme AT-Getriebe in Fahrstufe N/P" CURVE 0x82804E GklWSw 99.99695 rel_sw_b100 0.00 99.99695 FUNCTION_LIST MDWAN IF_DATA DIM_X DIRECT 0x82804E
 /begin AXIS_DESCR COM_AXIS twnd temp_ub_q0p75_o48 8 -48.00 143.3 AXIS_PTS_REF STW08MDUB /end AXIS_DESCR
/end CHARACTERISTIC
/begin CHARACTERISTIC MDATRM "Drehmomentanteil (Pumpenanteil) AT-Getriebe in Fahrstufe R" CURVE 0x82805E GklWSw 99.99695 rel_sw_b100 0.00 99.99695 FUNCTION_LIST MDWAN IF_DATA DIM_X DIRECT 0x82805E
 /begin AXIS_DESCR COM_AXIS twnd temp_ub_q0p75_o48 8 -48.00 143.3 AXIS_PTS_REF STW08MDUB /end AXIS_DESCR
/end CHARACTERISTIC
/begin CHARACTERISTIC MDBGRGA "Momentenbegrenzung für Luftpfad" CURVE 0x8295A8 FklWUw 99.99847 rel_uw_b100 0.00 99.99847 FUNCTION_LIST MDBGRG IF_DATA DIM_X DIRECT 0x8295A8 /begin AXIS_DESCR FIX_AXIS gangi dez 8 0.00 7.000 FIX_AXIS_PAR 0 0 8 /end AXIS_DESCR /end CHARACTERISTIC
/begin CHARACTERISTIC MDERFOKH "Anzahl Aussetzer für Adaptionsstop (Heilung) bei B_kh = 1" VALUE 0x813D3A KwUw 65535.00 dez 0.00 65535.00 FUNCTION_LIST DMDFON IF_DATA DIM_X DIRECT 0x813D3A /end CHARACTERISTIC
/begin CHARACTERISTIC MDERKFON "Anzahl Aussetzer für Adaptionsstop (Heilung)" VALUE 0x813D3C KwUw 65535.00 dez 0.00 65535.00 FUNCTION_LIST DMDFON IF_DATA DIM_X DIRECT 0x813D3C /end CHARACTERISTIC
/begin CHARACTERISTIC MDHYEZ "Momenten-Hysterese bei Entscheidung der Zylinderausblendung" VALUE 0x81215E KwUb 99.61 rel_ub_b99p6 0.00 99.61 FUNCTION_LIST MDRED IF_DATA DIM_X DIRECT 0x81215E /end CHARACTERISTIC
/begin CHARACTERISTIC MDIMX "Maximales indiziertes Motormoment" VALUE 0x81214D KwUb 99.61 rel_ub_b99p6 0.00 99.61 FUNCTION_LIST NMAXMD CAN MDFAW MDKOG MDKOL MDZUL IF_DATA DIM_X DIRECT 0x81214D /end CHARACTERISTIC
/begin CHARACTERISTIC MDKOAB "Drehmomentschwelle um den Kompressor in Beschleunigung abzuschalten" CURVE 0x812D82 GklWUb 199.2 rel_ub_b200 0.00 199.2 FUNCTION_LIST KOS IF_DATA DIM_X DIRECT 0x812D82
 /begin AXIS_DESCR COM_AXIS nmot nmot_ub_q40 8 0.00 10200. AXIS_PTS_REF SNM08KOUB /end AXIS_DESCR
/end CHARACTERISTIC
/begin CHARACTERISTIC MDKOAN "Drehmomentschwelle um den Klimakompressor abzuschalten" CURVE 0x812D8A GklWUb 199.2 rel_ub_b200 0.00 199.2 FUNCTION_LIST KOS IF_DATA DIM_X DIRECT 0x812D8A
 /begin AXIS_DESCR COM_AXIS nmot nmot_ub_q40 8 0.00 10200. AXIS_PTS_REF SNM08KOUB /end AXIS_DESCR
/end CHARACTERISTIC
/begin CHARACTERISTIC MDKOEN "Drehmomentschwelle um den Klimakompressor einzuschalten" CURVE 0x812D92 GklWUb 199.2 rel_ub_b200 0.00 199.2 FUNCTION_LIST KOS IF_DATA DIM_X DIRECT 0x812D92
 /begin AXIS_DESCR COM_AXIS nmot nmot_ub_q40 8 0.00 10200. AXIS_PTS_REF SNM08KOUB /end AXIS_DESCR
/end CHARACTERISTIC
/begin CHARACTERISTIC MDMAXKBI "maximales Drehmoment für Ausgabe an Kombi" VALUE 0x810183 KwUb 2550. md_ub_q10 0.00 2550. FUNCTION_LIST CAN IF_DATA DIM_X DIRECT 0x810183 /end CHARACTERISTIC
/begin CHARACTERISTIC MDNORM "Maximales indiziertes Motormoment für Moment-Normierung" VALUE 0x810184 KwUb 2550. md_ub_q10 0.00 2550. FUNCTION_LIST CAN GGCASR MDVERB TKMWL IF_DATA DIM_X DIRECT 0x810184 /end CHARACTERISTIC
/begin CHARACTERISTIC MDR_AOG "oberer Grenzwert Anpassung Momentenreserve Leerlaufregelung" VALUE 0x811C60 KwUb 24.90 rel_ub_b25 0.00 24.90 FUNCTION_LIST TKMWL KRACT IF_DATA DIM_X DIRECT 0x811C60 /end CHARACTERISTIC
/begin CHARACTERISTIC MDR_AUG "unterer Grenzwert Anpassung Momentenreserve Leerlaufregelung" VALUE 0x811C61 KwUb 24.90 rel_ub_b25 0.00 24.90 FUNCTION_LIST TKMWL KRACT IF_DATA DIM_X DIRECT 0x811C61 /end CHARACTERISTIC
/begin CHARACTERISTIC MDSH "Höhenabhängiger Anteil des Schleppmomentes" CURVE 0x82949A KlAUbSstUbWSb 49.90 rel_q0p1957 -25.05 24.85 FUNCTION_LIST MDVER IF_DATA DIM_X DIRECT 0x82949A /begin AXIS_DESCR STD_AXIS fho fak_ub_b4 6 0.00 3.984 DEPOSIT ABSOLUT /end AXIS_DESCR /end CHARACTERISTIC
/begin CHARACTERISTIC MDSM "Schleppmoment Temperaturanteil" CURVE 0x8294A8 GklWUw 99.99847 rel_uw_b100 0.00 99.99847 FUNCTION_LIST MDVER IF_DATA DIM_X DIRECT 0x8294A8
 /begin AXIS_DESCR COM_AXIS tmot temp_ub_q0p75_o48 10 -48.00 143.3 AXIS_PTS_REF STM10__UB /end AXIS_DESCR
/end CHARACTERISTIC
/begin AXIS_PTS MDV08_UC "Stützstellenverteilung für Moment im Befehlstest" 0x81265E mz_uc SstAUbSstUb 99.61 rel_ub_b99p6 8 0.00 99.61 FUNCTION_LIST URCMZUL DEPOSIT ABSOLUT IF_DATA DIM_X DIRECT 0x81265E /end AXIS_PTS
/begin AXIS_PTS MDV08_UM "Stützstellenverteilung für Moment in der Funktionsüberwachung" 0x8141EE mz_um SstAUbSstUb 99.61 rel_ub_b99p6 8 0.00 99.61 FUNCTION_LIST UFMZUL DEPOSIT ABSOLUT IF_DATA DIM_X DIRECT 0x8141EE /end AXIS_PTS
/begin CHARACTERISTIC MDVGLW "Momentenbedarf der Vorgelegewelle" CURVE 0x8294BC KlAUbSstUbWUw 99.99847 rel_uw_b100 0.00 99.99847 FUNCTION_LIST MDVER IF_DATA DIM_X DIRECT 0x8294BC
 /begin AXIS_DESCR STD_AXIS tmot temp_ub_q0p75_o48 6 -48.00 143.3 DEPOSIT ABSOLUT /end AXIS_DESCR
/end CHARACTERISTIC
/begin CHARACTERISTIC MDWANER "Ersatzwert fur mdwan_w bei Fehler" VALUE 0x811E42 KwUb 99.61 rel_ub_b99p6 0.00 99.61 FUNCTION_LIST MDWAN IF_DATA DIM_X DIRECT 0x811E42 /end CHARACTERISTIC
/begin CHARACTERISTIC MDWANK "minimales Wandlermoment für Sperrung des Velustmomentfilters beim Kriechen (CVT)" VALUE 0x8294D0 KwUw 99.99847 rel_uw_b100 0.00 99.99847 FUNCTION_LIST MDVER IF_DATA DIM_X DIRECT 0x8294D0 /end CHARACTERISTIC
/begin CHARACTERISTIC MEBZA_DAT_UC "" VAL_BLK 0x8122E3 KwbUb 255.0 dez 0.00 255.0 NUMBER 16 FUNCTION_LIST URCEIN IF_DATA DIM_X DIRECT 0x8122E3 /end CHARACTERISTIC
/begin CHARACTERISTIC MECS_DAT_UC "" VAL_BLK 0x8122F3 KwbUb 255.0 dez 0.00 255.0 NUMBER 16 FUNCTION_LIST URCEIN IF_DATA DIM_X DIRECT 0x8122F3 /end CHARACTERISTIC
/begin CHARACTERISTIC MER_D1_UC "" VAL_BLK 0x812303 KwbUb 255.0 dez 0.00 255.0 NUMBER 16 FUNCTION_LIST URCEIN IF_DATA DIM_X DIRECT 0x812303 /end CHARACTERISTIC
/begin CHARACTERISTIC MER_D2_UC "" VAL_BLK 0x812313 KwbUb 255.0 dez 0.00 255.0 NUMBER 16 FUNCTION_LIST URCEIN IF_DATA DIM_X DIRECT 0x812313 /end CHARACTERISTIC
/begin CHARACTERISTIC MIFABGMX_0_A "Maximalwert mifa_w für Momentenänderungsbegrenzung" VALUE 0x81706E KwUw 99.99847 rel_uw_b100 0.00 99.99847 FUNCTION_LIST MDFAW IF_DATA DIM_X DIRECT 0x81706E /end CHARACTERISTIC
/begin CHARACTERISTIC MIFABGMX_1_A "Maximalwert mifa_w für Momentenänderungsbegrenzung" VALUE 0x817070 KwUw 99.99847 rel_uw_b100 0.00 99.99847 FUNCTION_LIST MDFAW IF_DATA DIM_X DIRECT 0x817070 /end CHARACTERISTIC
/begin CHARACTERISTIC MIFALMF "Indiziertes Fahrerwunschmoment für Füllungspfad bei aktiver Gradientenbegrenzung" CURVE 0x816FD4 KlAUwSstUwWUw 99.99847 rel_uw_b100 0.00 99.99847 FUNCTION_LIST MDFAW IF_DATA DIM_X DIRECT 0x816FD4
 /begin AXIS_DESCR STD_AXIS mifa_w rel_uw_b100 8 0.00 99.99847 DEPOSIT ABSOLUT /end AXIS_DESCR
/end CHARACTERISTIC
/begin CHARACTERISTIC MIFAMXNOT "maximales indiziertes Moment im PWG-Ersatzbetrieb" CURVE 0x818721 KlAUbSstUbWUb 99.61 rel_ub_b99p6 0.00 99.61 FUNCTION_LIST GGPED IF_DATA DIM_X DIRECT 0x818721 /begin AXIS_DESCR STD_AXIS nmot nmot_ub_q40 8 0.00 10200. DEPOSIT ABSOLUT /end AXIS_DESCR /end CHARACTERISTIC
/begin CHARACTERISTIC MIFA_DAT_UC "" VAL_BLK 0x812323 KwbUb 99.61 rel_ub_q0p3906 0.00 99.61 NUMBER 16 FUNCTION_LIST URCEIN IF_DATA DIM_X DIRECT 0x812323 /end CHARACTERISTIC
/begin CHARACTERISTIC MKBRMXWP "Maximal zulässiges Kupplungsmoment bei betätigter Bremse" CURVE 0x8295B8 KlAUwSstUwWUw 99.99847 rel_uw_b100 0.00 99.99847 FUNCTION_LIST MDBGRG IF_DATA DIM_X DIRECT 0x8295B8
 /begin AXIS_DESCR STD_AXIS wped_w relPED_uw_b100 8 0.00 100.0000 DEPOSIT ABSOLUT /end AXIS_DESCR
/end CHARACTERISTIC
/begin CHARACTERISTIC MKMIFABG_0_A "Kupplungsmoment für Aktivierung der Momentenänderungsbegrenzung" VALUE 0x817072 KwSw 199.9969 rel_sw_b100 -100.0000 99.99695 FUNCTION_LIST MDFAW IF_DATA DIM_X DIRECT 0x817072 /end CHARACTERISTIC
/begin CHARACTERISTIC MKMIFABG_1_A "Kupplungsmoment für Aktivierung der Momentenänderungsbegrenzung" VALUE 0x817074 KwSw 199.9969 rel_sw_b100 -100.0000 99.99695 FUNCTION_LIST MDFAW IF_DATA DIM_X DIRECT 0x817074 /end CHARACTERISTIC
/begin CHARACTERISTIC MLDKVSF "Luftmassenschwelle für Fehlerfreigabe im DKVS (Tank leer)" VALUE 0x81E4DE KwUw 233.0133 m_q0p00355 0.00 233.0133 FUNCTION_LIST DKVS IF_DATA DIM_X DIRECT 0x81E4DE /end CHARACTERISTIC
/begin CHARACTERISTIC MLDKVSG "Luftmassenschwelle für Fehlerfreigabe Tank leer" VALUE 0x81E4E0 KwUw 233.0133 m_q0p00355 0.00 233.0133 FUNCTION_LIST DKVS IF_DATA DIM_X DIRECT 0x81E4E0 /end CHARACTERISTIC
/begin CHARACTERISTIC MLDTEFPF "Schwelle Motorluftmasse für Freigabe Überprüfung Diagnose DTEV passiv möglich" VALUE 0x829D1A KwUw 80.00000 m_q0p1 0.00 80.00000 FUNCTION_LIST DTEV IF_DATA DIM_X DIRECT 0x829D1A /end CHARACTERISTIC
/begin CHARACTERISTIC MLDTEPF "Schwelle Motorluftmasse für Freigabe Diagnose DTEV passiv möglich" VALUE 0x829D1C KwUw 80.00000 m_q0p1 0.00 80.00000 FUNCTION_LIST DTEV IF_DATA DIM_X DIRECT 0x829D1C /end CHARACTERISTIC
/begin CHARACTERISTIC MLFKMSDK "Luftmassenstromschwelle für multipl. Abgleich von HFM- und DK-Massenstrom" VALUE 0x815888 KwUw 6553.500 m_uw_b6553p5 0.00 6553.500 FUNCTION_LIST BGMSZS IF_DATA DIM_X DIRECT 0x815888 /end CHARACTERISTIC
/begin CHARACTERISTIC MLHFM "Linearisierung der Heißfilmspannung" CURVE 0x814FBE FklWUw 6553.500 m_uw_b6553p5 0.00 6553.500 FUNCTION_LIST GGHFM IF_DATA DIM_X DIRECT 0x814FBE
 /begin AXIS_DESCR FIX_AXIS uhfm_w spg_uw_q0p00488 512 0.00 4.995117 FIX_AXIS_PAR 0 1 512 /end AXIS_DESCR
/end CHARACTERISTIC
/begin CHARACTERISTIC MLHFMMN "minimale HFM-Luftmassen Schwelle zum Rücksetzen des Min-Fehlers" VALUE 0x81D18E KwSw 6553.500 m_q0p1 -3276.800 3276.700 FUNCTION_LIST DHFM IF_DATA DIM_X DIRECT 0x81D18E /end CHARACTERISTIC
/begin CHARACTERISTIC MLKTDO_0_A "Obere Luftmassenschwelle für Kat-Diagnose" VALUE 0x81C71E KwUw 6553.500 m_uw_b6553p5 0.00 6553.500 FUNCTION_LIST DKATSPEB IF_DATA DIM_X DIRECT 0x81C71E /end CHARACTERISTIC
/begin CHARACTERISTIC MLKTDO_1_A "Obere Luftmassenschwelle für Kat-Diagnose" VALUE 0x81C720 KwUw 6553.500 m_uw_b6553p5 0.00 6553.500 FUNCTION_LIST DKATSPEB IF_DATA DIM_X DIRECT 0x81C720 /end CHARACTERISTIC
/begin CHARACTERISTIC MLKTDOO_0_A "Obere Luftmassenschwelle für Kat-Diagnose, oberes Band" VALUE 0x81C722 KwUw 6553.500 m_uw_b6553p5 0.00 6553.500 FUNCTION_LIST DKATSPEB IF_DATA DIM_X DIRECT 0x81C722 /end CHARACTERISTIC
/begin CHARACTERISTIC MLKTDOO_1_A "Obere Luftmassenschwelle für Kat-Diagnose, oberes Band" VALUE 0x81C724 KwUw 6553.500 m_uw_b6553p5 0.00 6553.500 FUNCTION_LIST DKATSPEB IF_DATA DIM_X DIRECT 0x81C724 /end CHARACTERISTIC
/begin CHARACTERISTIC MLKTDOT_0_A "Obere Luftmassenschwelle für Kat-Diagnose bei Testerbetrieb" VALUE 0x81C726 KwUw 6553.500 m_uw_b6553p5 0.00 6553.500 FUNCTION_LIST DKATSPEB IF_DATA DIM_X DIRECT 0x81C726 /end CHARACTERISTIC
/begin CHARACTERISTIC MLKTDOT_1_A "Obere Luftmassenschwelle für Kat-Diagnose bei Testerbetrieb" VALUE 0x81C728 KwUw 6553.500 m_uw_b6553p5 0.00 6553.500 FUNCTION_LIST DKATSPEB IF_DATA DIM_X DIRECT 0x81C728 /end CHARACTERISTIC
/begin CHARACTERISTIC MLKTDU_0_A "Untere Luftmassenschwelle für Kat-Diagnose" VALUE 0x81C72A KwUw 6553.500 m_uw_b6553p5 0.00 6553.500 FUNCTION_LIST DKATSPEB IF_DATA DIM_X DIRECT 0x81C72A /end CHARACTERISTIC
/begin CHARACTERISTIC MLKTDU_1_A "Untere Luftmassenschwelle für Kat-Diagnose" VALUE 0x81C72C KwUw 6553.500 m_uw_b6553p5 0.00 6553.500 FUNCTION_LIST DKATSPEB IF_DATA DIM_X DIRECT 0x81C72C /end CHARACTERISTIC
/begin CHARACTERISTIC MLKTDUO_0_A "Untere Luftmassenschwelle für Kat-Diagnose, oberes Band" VALUE 0x81C72E KwUw 6553.500 m_uw_b6553p5 0.00 6553.500 FUNCTION_LIST DKATSPEB IF_DATA DIM_X DIRECT 0x81C72E /end CHARACTERISTIC
/begin CHARACTERISTIC MLKTDUO_1_A "Untere Luftmassenschwelle für Kat-Diagnose, oberes Band" VALUE 0x81C730 KwUw 6553.500 m_uw_b6553p5 0.00 6553.500 FUNCTION_LIST DKATSPEB IF_DATA DIM_X DIRECT 0x81C730 /end CHARACTERISTIC
/begin CHARACTERISTIC MLKTDUT_0_A "Untere Luftmassenschwelle für Kat-Diagnose, Testerbetrieb" VALUE 0x81C732 KwUw 6553.500 m_uw_b6553p5 0.00 6553.500 FUNCTION_LIST DKATSPEB IF_DATA DIM_X DIRECT 0x81C732 /end CHARACTERISTIC
/begin CHARACTERISTIC MLKTDUT_1_A "Untere Luftmassenschwelle für Kat-Diagnose, Testerbetrieb" VALUE 0x81C734 KwUw 6553.500 m_uw_b6553p5 0.00 6553.500 FUNCTION_LIST DKATSPEB IF_DATA DIM_X DIRECT 0x81C734 /end CHARACTERISTIC
/begin CHARACTERISTIC MLMAX "Maximaler Luftfluß für die Lastberechnung nach SAE J1979" VALUE 0x81D772 KwUw 6553.500 m_uw_b6553p5 0.00 6553.500 FUNCTION_LIST BGRML IF_DATA DIM_X DIRECT 0x81D772 /end CHARACTERISTIC
/begin CHARACTERISTIC MLMIN "minimale HFM-Luftmasse" VALUE 0x8153BE KwSw 6553.500 m_sw_b3276p8 -3276.800 3276.700 FUNCTION_LIST GGHFM IF_DATA DIM_X DIRECT 0x8153BE /end CHARACTERISTIC
/begin CHARACTERISTIC MLNKAX "Luftmassenschwelle für Einschaltbereitschaft LRSHK I-Anteil" VALUE 0x817580 KwUw 7281.667 m_uw_b7281 0.00 7281.667 FUNCTION_LIST LRSHK IF_DATA DIM_X DIRECT 0x817580 /end CHARACTERISTIC
/begin CHARACTERISTIC MLO1 "obere Luftmengenschwelle Bereich 1" VALUE 0x81E026 KwUw 6553.500 m_uw_b6553p5 0.00 6553.500 FUNCTION_LIST LRA IF_DATA DIM_X DIRECT 0x81E026 /end CHARACTERISTIC
/begin CHARACTERISTIC MLO1AC "obere Luftmengenschwelle Bereich 1 mit Kompressor" VALUE 0x81E028 KwUw 6553.500 m_uw_b6553p5 0.00 6553.500 FUNCTION_LIST LRA IF_DATA DIM_X DIRECT 0x81E028 /end CHARACTERISTIC
/begin CHARACTERISTIC MLO3 "obere Luftmengenschwelle Bereich 3" VALUE 0x81E02A KwUw 6553.500 m_uw_b6553p5 0.00 6553.500 FUNCTION_LIST LRA IF_DATA DIM_X DIRECT 0x81E02A /end CHARACTERISTIC
/begin CHARACTERISTIC MLO3AC "obere Luftmengenschwelle Bereich 3 mit Kompressor" VALUE 0x81E02C KwUw 6553.500 m_uw_b6553p5 0.00 6553.500 FUNCTION_LIST LRA IF_DATA DIM_X DIRECT 0x81E02C /end CHARACTERISTIC
/begin CHARACTERISTIC MLOFS "Kennlinienoffset HFM 5" VALUE 0x8153C0 KwUw 6553.500 m_uw_b6553p5 0.00 6553.500 FUNCTION_LIST GGHFM IF_DATA DIM_X DIRECT 0x8153C0 /end CHARACTERISTIC
/begin CHARACTERISTIC MLSLMX "max. Motor-Luftmasse für Sekundärlufteinblasung" VALUE 0x81B1B4 KwUw 6553.500 m_q0p1 0.00 6553.500 FUNCTION_LIST SLS IF_DATA DIM_X DIRECT 0x81B1B4 /end CHARACTERISTIC
/begin CHARACTERISTIC MLSUS "Sollwert Luftmassen-Integral für motorisches Katheizen" CURVE 0x81ED5C KlAUbSstUbWUw 23.30133 m_uw_b23p3 0.00 23.30133 FUNCTION_LIST BBKHZ IF_DATA DIM_X DIRECT 0x81ED5C
 /begin AXIS_DESCR STD_AXIS tmst temp_ub_q0p75_o48 12 -48.00 143.3 DEPOSIT ABSOLUT /end AXIS_DESCR
/end CHARACTERISTIC
/begin CHARACTERISTIC MLU2 "untere Luftmengenschwelle Bereich 2" VALUE 0x81E02E KwUw 6553.500 m_uw_b6553p5 0.00 6553.500 FUNCTION_LIST LRA IF_DATA DIM_X DIRECT 0x81E02E /end CHARACTERISTIC
/begin CHARACTERISTIC MLU2AC "untere Luftmengenschwelle Bereich 2 mit Kompressor" VALUE 0x81E030 KwUw 6553.500 m_uw_b6553p5 0.00 6553.500 FUNCTION_LIST LRA IF_DATA DIM_X DIRECT 0x81E030 /end CHARACTERISTIC
/begin CHARACTERISTIC MLU2FA "untere Luftmengenschwelle bei Funktionsanforderung B_faan Bereich 2" VALUE 0x81E032 KwUw 6553.500 m_uw_b6553p5 0.00 6553.500 FUNCTION_LIST LRA IF_DATA DIM_X DIRECT 0x81E032 /end CHARACTERISTIC
/begin CHARACTERISTIC MLWDSLAMN "min. Luftmasse für Bedingung Adaption/Zusatzdiagnose (16 Bit)" VALUE 0x81B2B4 KwUw 6553.500 m_uw_b6553p5 0.00 6553.500 FUNCTION_LIST DSLSLRS IF_DATA DIM_X DIRECT 0x81B2B4 /end CHARACTERISTIC
/begin CHARACTERISTIC MLWDSLKMN "min. Luftmasse für Bedingung Kurztest-Diagnose (16 Bit)" VALUE 0x81B2B6 KwUw 6553.500 m_uw_b6553p5 0.00 6553.500 FUNCTION_LIST DSLSLRS IF_DATA DIM_X DIRECT 0x81B2B6 /end CHARACTERISTIC
/begin CHARACTERISTIC MLWDSLMN "min. Luftmasse für Bedingung Diagnose (16 Bit)" VALUE 0x81B2B8 KwUw 6553.500 m_uw_b6553p5 0.00 6553.500 FUNCTION_LIST DSLSLRS IF_DATA DIM_X DIRECT 0x81B2B8 /end CHARACTERISTIC
/begin CHARACTERISTIC MLWDSLOMN "min. Luftmasse für Bedingung frm-Offset-Messung (16 Bit)" VALUE 0x81B2BA KwUw 6553.500 m_uw_b6553p5 0.00 6553.500 FUNCTION_LIST DSLSLRS IF_DATA DIM_X DIRECT 0x81B2BA /end CHARACTERISTIC
/begin CHARACTERISTIC MOTTYP "Motortyp für Ausgabe an Kombi" VALUE 0x810185 KwUb 255.0 DEZ 0.00 255.0 FUNCTION_LIST CAN IF_DATA DIM_X DIRECT 0x810185 /end CHARACTERISTIC
/begin CHARACTERISTIC MRESKH "Momentenreserve bei Kat.heizen" VALUE 0x8166D2 KwUw 99.99847 rel_uw_b100 0.00 99.99847 FUNCTION_LIST LLRMR IF_DATA DIM_X DIRECT 0x8166D2 /end CHARACTERISTIC
/begin CHARACTERISTIC MRESLL "LLR: Erhöhte Momentenreserve im LL nach Drehzahleinbruch" VALUE 0x811EEE KwUb 24.90 rel_ub_b24p9 0.00 24.90 FUNCTION_LIST LLRMR IF_DATA DIM_X DIRECT 0x811EEE /end CHARACTERISTIC
/begin CHARACTERISTIC MRESNW "Momentenreserve bei Nockenwellenverstellung" VALUE 0x811EEF KwUb 99.61 rel_ub_b99p6 0.00 99.61 FUNCTION_LIST LLRMR IF_DATA DIM_X DIRECT 0x811EEF /end CHARACTERISTIC
/begin CHARACTERISTIC MRESSL "Momentenreserve bei Servolenkung" VALUE 0x8166D4 KwUw 99.99847 rel_uw_b100 0.00 99.99847 FUNCTION_LIST LLRMR IF_DATA DIM_X DIRECT 0x8166D4 /end CHARACTERISTIC
/begin CHARACTERISTIC MRFABNTE "Schwelle zur Erkennung von Dauer-Hochlastfahrt" VALUE 0x8191D6 KwUb 99.61 rel_ub_b99p6 0.00 99.61 FUNCTION_LIST BBTEGA IF_DATA DIM_X DIRECT 0x8191D6 /end CHARACTERISTIC
/begin CHARACTERISTIC MRFALLO "Obere Leerlaufschwelle des relativen Fahrerwunschmoments" VALUE 0x816FF6 KwUw 199.9969 rel_uw_b200 0.00 199.9969 FUNCTION_LIST MDFAW IF_DATA DIM_X DIRECT 0x816FF6 /end CHARACTERISTIC
/begin CHARACTERISTIC MRFALLU "Untere Leerlaufschwelle des relativen Fahrerwunschmoments" VALUE 0x816FF8 KwUw 199.9969 rel_uw_b200 0.00 199.9969 FUNCTION_LIST MDFAW IF_DATA DIM_X DIRECT 0x816FF8 /end CHARACTERISTIC
/begin CHARACTERISTIC MRFAMXKAHY "Hysterese für Sperren Klimakompressor über mrfa-Schwelle" VALUE 0x82B292 KwUw 199.9969 rel_uw_b200 0.00 199.9969 FUNCTION_LIST BKV IF_DATA DIM_X DIRECT 0x82B292 /end CHARACTERISTIC
/begin CHARACTERISTIC MRFAVLN "Vollasterkennungsschwelle des relativen Fahrerwunsches" CURVE 0x829160 KlAUwSstUwWUw 199.9969 rel_uw_b200 0.00 199.9969 FUNCTION_LIST MDFAW IF_DATA DIM_X DIRECT 0x829160
 /begin AXIS_DESCR STD_AXIS nmot_w nmot_uw_q0p25 14 0.00 16383.75 DEPOSIT ABSOLUT /end AXIS_DESCR
/end CHARACTERISTIC
/begin CHARACTERISTIC MRFAVW "Schwelle zur Umschaltung des Vorlagerungswinkels bei max. Fahrerwunsches" CURVE 0x81DFE4 GklWUw 199.9969 rel_uw_b200 0.00 199.9969 FUNCTION_LIST ESVW IF_DATA DIM_X DIRECT 0x81DFE4
 /begin AXIS_DESCR COM_AXIS nmot nmot_ub_q40 8 0.00 10200. AXIS_PTS_REF SNM08GKUB /end AXIS_DESCR
/end CHARACTERISTIC
/begin CHARACTERISTIC MRFGRIMX "Maximaler FGR-Initialisierungswert" CURVE 0x81885F KlAUbSstUbWUb 199.2 rel_ub_b200 0.00 199.2 FUNCTION_LIST FGRREGL IF_DATA DIM_X DIRECT 0x81885F /begin AXIS_DESCR STD_AXIS nmot nmot_ub_q40 6 0.00 10200. DEPOSIT ABSOLUT /end AXIS_DESCR /end CHARACTERISTIC
/begin CHARACTERISTIC MRFGRLL "Schwelle relatives Moment vom Fahrgeschwindigkeitsregler für Erkennung Leerlauf" VALUE 0x81CD3A KwUw 199.9969 rel_uw_b200 0.00 199.9969 FUNCTION_LIST FGRREGL IF_DATA DIM_X DIRECT 0x81CD3A /end CHARACTERISTIC
/begin CHARACTERISTIC MRFGRMAX "Maximalwert für relatives Moment aus FGR" VALUE 0x81CD3C KwUw 199.9969 rel_uw_b200 0.00 199.9969 FUNCTION_LIST FGRREGL FGRFULO IF_DATA DIM_X DIRECT 0x81CD3C /end CHARACTERISTIC
/begin CHARACTERISTIC MRFGRSTA "Startwert für Relatives Moment bei Aktivierung FGR-Regler" VALUE 0x81CD3E KwUw 199.9969 rel_uw_b200 0.00 199.9969 FUNCTION_LIST FGRREGL IF_DATA DIM_X DIRECT 0x81CD3E /end CHARACTERISTIC
/begin CHARACTERISTIC MSABHMN "untere Luftmassenschwelle für Plausibilitätsprüfung LSU" VALUE 0x81101C KwUb 1020. m_ub_b1020 0.00 1020. FUNCTION_LIST DHLSU IF_DATA DIM_X DIRECT 0x81101C /end CHARACTERISTIC
/begin CHARACTERISTIC MSALLMN "Minimale Leerlaufluftmassenadaption für E-Gas" VALUE 0x81D5C4 KwUw 6553.500 m_uw_b6553p5 0.00 6553.500 FUNCTION_LIST BGMSZS IF_DATA DIM_X DIRECT 0x81D5C4 /end CHARACTERISTIC
/begin CHARACTERISTIC MSAPLMN "untere Schwelle für Plausibilitätsprüfung LSU" VALUE 0x81C792 KwUw 6553.500 m_uw_b6553p5 0.00 6553.500 FUNCTION_LIST DLSU IF_DATA DIM_X DIRECT 0x81C792 /end CHARACTERISTIC
/begin CHARACTERISTIC MSDKLMMN "minimaler Massenstrom über Drosselklappe in TE" VALUE 0x817814 KwUw 6553.500 m_uw_b6553p5 0.00 6553.500 FUNCTION_LIST TEB IF_DATA DIM_X DIRECT 0x817814 /end CHARACTERISTIC
/begin CHARACTERISTIC MSGS_DAT_UC "" VAL_BLK 0x812333 KwbUb 99.61 rel_ub_q0p3906 0.00 99.61 NUMBER 16 FUNCTION_LIST URCEIN IF_DATA DIM_X DIRECT 0x812333 /end CHARACTERISTIC
/begin CHARACTERISTIC MSLBAS "Ini.- Sekundärluftmasse" VALUE 0x81836B KwUb 102.0 m_q0p4 0.00 102.0 FUNCTION_LIST DSLSLRS IF_DATA DIM_X DIRECT 0x81836B /end CHARACTERISTIC
/begin CHARACTERISTIC MSLG "Massenstrom Leckluft gesamt" VALUE 0x81D5C8 KwUw 6553.500 m_uw_b6553p5 0.00 6553.500 FUNCTION_LIST BGMSZS IF_DATA DIM_X DIRECT 0x81D5C8 /end CHARACTERISTIC
/begin CHARACTERISTIC MSLUB "Sekundärluftmasse abhängig von der Batteriespannung" CURVE 0x81B1B6 KlAUwSstUwWUw 102.3984 m_uw_b102p4 0.00 102.3984 FUNCTION_LIST SLS IF_DATA DIM_X DIRECT 0x81B1B6
 /begin AXIS_DESCR STD_AXIS ubsqf_w spg_q0p00039 8 0.00 25.59961 DEPOSIT ABSOLUT /end AXIS_DESCR
/end CHARACTERISTIC
/begin CHARACTERISTIC MSLVMX "Diagnoseschwelle für Ventildichtheitsprüfung" VALUE 0x81B2BC KwUw 102.3984 m_q0p0015625 0.00 102.3984 FUNCTION_LIST DSLSLRS IF_DATA DIM_X DIRECT 0x81B2BC /end CHARACTERISTIC
/begin CHARACTERISTIC MSLVMXK "Diagnoseschwelle für Ventildichtheitsprüfung bei Kurztest" VALUE 0x81B2BE KwUw 102.3984 m_q0p0015625 0.00 102.3984 FUNCTION_LIST DSLSLRS IF_DATA DIM_X DIRECT 0x81B2BE /end CHARACTERISTIC
/begin CHARACTERISTIC MSLVMXX "Diagnoseschwelle für absoluten Fehler Ventildichtheit" VALUE 0x81B2C0 KwUw 102.3984 m_q0p0015625 0.00 102.3984 FUNCTION_LIST DSLSLRS IF_DATA DIM_X DIRECT 0x81B2C0 /end CHARACTERISTIC
/begin CHARACTERISTIC MSLVMXXK "Diagnoseschwelle für absoluten Fehler Ventildichtheit bei Kurztest" VALUE 0x81B2C2 KwUw 102.3984 m_q0p0015625 0.00 102.3984 FUNCTION_LIST DSLSLRS IF_DATA DIM_X DIRECT 0x81B2C2 /end CHARACTERISTIC
/begin CHARACTERISTIC MSNPCV "Massenstrom über PCV Ventil" CURVE 0x8196EF KlAUbSstUbWUb 25.50 m_q0p1 0.00 25.50 FUNCTION_LIST BBBO IF_DATA DIM_X DIRECT 0x8196EF /begin AXIS_DESCR STD_AXIS dpspu p_ub_q10 14 0.00 2550. DEPOSIT ABSOLUT /end AXIS_DESCR /end CHARACTERISTIC
/begin CHARACTERISTIC MSNTATE "Kennlinie normierter Massenstrom durch TEV" CURVE 0x81790C KlAUwSstUwWUw 25.59961 m_uw_b25p6 0.00 25.59961 FUNCTION_LIST BGTEV IF_DATA DIM_X DIRECT 0x81790C
 /begin AXIS_DESCR STD_AXIS msntate_kge rel_uw_b100 10 0.00 99.99847 DEPOSIT ABSOLUT /end AXIS_DESCR
/end CHARACTERISTIC
/begin CHARACTERISTIC MSPSN_DAT_UC "" VAL_BLK 0x812343 KwbUb 4.9805 spg_ub_q0p019 0.00 4.9805 NUMBER 16 FUNCTION_LIST URCEIN IF_DATA DIM_X DIRECT 0x812343 /end CHARACTERISTIC
/begin CHARACTERISTIC MSRC_D_UC "" VAL_BLK 0x812353 KwbUb 255.0 dez 0.00 255.0 NUMBER 16 FUNCTION_LIST URCEIN IF_DATA DIM_X DIRECT 0x812353 /end CHARACTERISTIC
/begin CHARACTERISTIC MSRC_T_UC "Fehlerzeit für MSR-Eingriff-Überwachung des Befehlstests" VALUE 0x8124E7 KwUb 10200.0 t40ms_ub_b10200 0.00 10200.0 FUNCTION_LIST URCMSRC IF_DATA DIM_X DIRECT 0x8124E7 /end CHARACTERISTIC
/begin CHARACTERISTIC MSRC_T_UM "Fehlerzeit für MSR-Eingriff-Überwachung der Funktionsüberwachung" VALUE 0x814077 KwUb 10200.0 t40ms_ub_b10200 0.00 10200.0 FUNCTION_LIST UFMSRC IF_DATA DIM_X DIRECT 0x814077 /end CHARACTERISTIC
/begin CHARACTERISTIC MSRMDTMX "Größte zulässige Momenten-Zeit-Fläche bei der MSR-Topfplausibilisierung" VALUE 0x813D2A KwSw 5111.922 mdt_sw_b2556 -2556.000 2555.922 FUNCTION_LIST GGCASR IF_DATA DIM_X DIRECT 0x813D2A /end CHARACTERISTIC
/begin CHARACTERISTIC MSTELDP "Mindestluftmasse bei Initial- u. Fortsetzungsspülung" VALUE 0x812784 KwUb 11.32 m_ub_q0p0444 0.00 11.32 FUNCTION_LIST DLDP IF_DATA DIM_X DIRECT 0x812784 /end CHARACTERISTIC
/begin CHARACTERISTIC MTABGKH "mittlere Abgastemperatur während des Katheizens" VALUE 0x81EDCE KwUw 1062.820 temp_q0p0234_o273 200.0063 1262.827 FUNCTION_LIST BBKHZ IF_DATA DIM_X DIRECT 0x81EDCE /end CHARACTERISTIC
/begin CHARACTERISTIC MVER_D_UC "" VAL_BLK 0x812363 KwbUb 255.0 dez 0.00 255.0 NUMBER 16 FUNCTION_LIST URCEIN IF_DATA DIM_X DIRECT 0x812363 /end CHARACTERISTIC
/begin CHARACTERISTIC MVER_T_UC "Fehlerzeit beim Momentenvergleich im Befehlstest" VALUE 0x812669 KwUb 10200.0 t40ms_ub_b10200 0.00 10200.0 FUNCTION_LIST URCMVER IF_DATA DIM_X DIRECT 0x812669 /end CHARACTERISTIC
/begin CHARACTERISTIC MVER_T_UM "Fehlerzeit beim Momentenvergleich in der Funktionsüberwachung" VALUE 0x8141F9 KwUb 10200.0 t40ms_ub_b10200 0.00 10200.0 FUNCTION_LIST UFMVER IF_DATA DIM_X DIRECT 0x8141F9 /end CHARACTERISTIC
/begin CHARACTERISTIC MWNTKB0 "Meßwert lesen normiert Testerkommunikation Block 0" VAL_BLK 0x826C56 KwbUw 65535.00 dez 0.00 65535.00 NUMBER 36 FUNCTION_LIST TKMWL IF_DATA DIM_X DIRECT 0x826C56 /end CHARACTERISTIC
/begin CHARACTERISTIC MWNTKB1 "Meßwert lesen normiert Testerkommunikation Block 1" VAL_BLK 0x826C9E KwbUw 65535.00 dez 0.00 65535.00 NUMBER 40 FUNCTION_LIST TKMWL IF_DATA DIM_X DIRECT 0x826C9E /end CHARACTERISTIC
/begin CHARACTERISTIC MWNTKB10 "Meßwert lesen normiert Testerkommunikation Block 10" VAL_BLK 0x826CEE KwbUw 65535.00 dez 0.00 65535.00 NUMBER 40 FUNCTION_LIST TKMWL IF_DATA DIM_X DIRECT 0x826CEE /end CHARACTERISTIC
/begin CHARACTERISTIC MWNTKB11 "Meßwert lesen normiert Testerkommunikation Block 11" VAL_BLK 0x826D3E KwbUw 65535.00 dez 0.00 65535.00 NUMBER 40 FUNCTION_LIST TKMWL IF_DATA DIM_X DIRECT 0x826D3E /end CHARACTERISTIC
/begin CHARACTERISTIC MWNTKB12 "Meßwert lesen normiert Testerkommunikation Block 12" VAL_BLK 0x826D8E KwbUw 65535.00 dez 0.00 65535.00 NUMBER 40 FUNCTION_LIST TKMWL IF_DATA DIM_X DIRECT 0x826D8E /end CHARACTERISTIC
/begin CHARACTERISTIC MWNTKB13 "Meßwert lesen normiert Testerkommunikation Block 13" VAL_BLK 0x826DDE KwbUw 65535.00 dez 0.00 65535.00 NUMBER 40 FUNCTION_LIST TKMWL IF_DATA DIM_X DIRECT 0x826DDE /end CHARACTERISTIC
/begin AXIS_PTS NMV08_UC "Stützstellenverteilung für Motordrehzahl im Befehlstest" 0x8124E9 nmot_uc SstAUbSstUb 10200. nmot_ub_q40 8 0.00 10200. FUNCTION_LIST URCEINS URCMZUL DEPOSIT ABSOLUT IF_DATA DIM_X DIRECT 0x8124E9 /end AXIS_PTS
/begin AXIS_PTS NMV08_UM "Stützstellenverteilung für Motordrehzahl in der Funktionsüberwachung" 0x814079 nmot_um SstAUbSstUb 10200. nmot_ub_q40 8 0.00 10200. FUNCTION_LIST UFEINS UFMZUL DEPOSIT ABSOLUT IF_DATA DIM_X DIRECT 0x814079 /end AXIS_PTS
/begin AXIS_PTS NZWV08_UC "" 0x8124F2 nmot_uc SstAUbSstUb 10200. nmot_ub_q40 8 0.00 10200. FUNCTION_LIST URCEINS URCMIST DEPOSIT ABSOLUT IF_DATA DIM_X DIRECT 0x8124F2 /end AXIS_PTS
/begin AXIS_PTS NZWV08_UM "" 0x814082 nmot_um SstAUbSstUb 10200. nmot_ub_q40 8 0.00 10200. FUNCTION_LIST UFEINS UFMIST DEPOSIT ABSOLUT IF_DATA DIM_X DIRECT 0x814082 /end AXIS_PTS
/begin AXIS_PTS RLV08_UC "Stutzstellenverteilung für Lastinfo im Befehlstest" 0x8124FB rl_uc SstAUbSstUb 191.3 rel_ub_q0p75 8 0.00 191.3 FUNCTION_LIST URCEINS URCMIST DEPOSIT ABSOLUT IF_DATA DIM_X DIRECT 0x8124FB /end AXIS_PTS
/begin AXIS_PTS RLV08_UM "Stutzstellenverteilung für Lastinfo in der Funktionsüberwachung" 0x81408B rl_um SstAUbSstUb 191.3 rel_ub_q0p75 8 0.00 191.3 FUNCTION_LIST UFEINS UFMIST DEPOSIT ABSOLUT IF_DATA DIM_X DIRECT 0x81408B /end AXIS_PTS
/begin AXIS_PTS SEZ06TMUB "Stützstellenverteilung, Zündwinkelwirkungsgrad" 0x8181CF etazwimt SstAUbSstUb 127.5 rel_ub_b127p5 6 0.00 127.5 FUNCTION_LIST SSTB ATM DEPOSIT ABSOLUT IF_DATA DIM_X DIRECT 0x8181CF /end AXIS_PTS
/begin AXIS_PTS SFR05TEUB "frmit abhängige Stützstellen (Anzahl 5)" 0x8181D6 frmit SstAUbSstUb 1.992 fak_ub_b2 5 0.00 1.992 FUNCTION_LIST SSTB TEB DEPOSIT ABSOLUT IF_DATA DIM_X DIRECT 0x8181D6 /end AXIS_PTS
/begin AXIS_PTS SGA08MDUB "Stützstellenverteilung Ist Gang 8 Sst." 0x810060 gangi SstAUbSstUb 255.0 dez 8 0.00 255.0 FUNCTION_LIST SSTB BBSAWE DMDSTP MDFAW NMAXMD DEPOSIT ABSOLUT IF_DATA DIM_X DIRECT 0x810060 /end AXIS_PTS
/begin AXIS_PTS SIM06ESUW "SST-Verteilung für integrierten Luftmassenstrom ab Startende" 0x81B136 imlatm_w SstAUwSstUw 23.30133 m_uw_b23p3 6 0.00 23.30133 FUNCTION_LIST SSTB ESNSWL DEPOSIT ABSOLUT IF_DATA DIM_X DIRECT 0x81B136 /end AXIS_PTS
/begin AXIS_PTS SLA05ESUB "Stützstellenverteilung Regelabweichung Lambda, 5 Sst." 0x813A4A ladiff_w SstAUwSstUw 1.999969 fak_sw_b1 5 0.00 1.999969 FUNCTION_LIST SSTB ESUK DEPOSIT ABSOLUT IF_DATA DIM_X DIRECT 0x813A4A /end AXIS_PTS
/begin AXIS_PTS SLX06TMUW "Stützstellenverteilung, Lambdasoll" 0x81B144 lamsbg_w SstAUwSstUw 15.99976 fak_uw_b16 6 0.00 15.99976 FUNCTION_LIST SSTB ATM DEPOSIT ABSOLUT IF_DATA DIM_X DIRECT 0x81B144 /end AXIS_PTS
/begin AXIS_PTS SMI04LLUB "Stützstellenverteilung: ind. Moment für Momentenreserve" 0x813A56 mifa_w SstAUwSstUw 99.99847 rel_uw_b100 4 0.00 99.99847 FUNCTION_LIST SSTB LLRMR DEPOSIT ABSOLUT IF_DATA DIM_X DIRECT 0x813A56 /end AXIS_PTS
/begin AXIS_PTS SML06TEUB "ml abhängige Stützstellen (Anzahl 6)" 0x8181DC ml SstAUbSstUb 1020. m_ub_b1020 6 0.00 1020. FUNCTION_LIST SSTB TEB DEPOSIT ABSOLUT IF_DATA DIM_X DIRECT 0x8181DC /end AXIS_PTS
/begin AXIS_PTS SML08LHUB "ml abhängige Stützstellen (Anzahl 8)" 0x8181E3 ml SstAUbSstUb 1020. m_ub_b1020 8 0.00 1020. FUNCTION_LIST SSTB LRSHK DEPOSIT ABSOLUT IF_DATA DIM_X DIRECT 0x8181E3 /end AXIS_PTS
/begin AXIS_PTS SMO08OPUB "Stützstellenverteilung für zulässiges Moment mizuvfil" 0x812235 mizuvfil SstAUbSstUb 99.61 rel_ub_b99p6 8 0.00 99.61 FUNCTION_LIST MDZUL DEPOSIT ABSOLUT IF_DATA DIM_X DIRECT 0x812235 /end AXIS_PTS
/begin AXIS_PTS SNM05NEUW "Drehzahlstützstellen Nockenwellensollwinkel Einlaß" 0x813A60 nmot_w SstAUwSstUw 16383.75 nmot_uw_q0p25 5 0.00 16383.75 FUNCTION_LIST SSTB NWSOLLE DEPOSIT ABSOLUT IF_DATA DIM_X DIRECT 0x813A60 /end AXIS_PTS
/begin AXIS_PTS SNM06GKUB "Stützstellen KFLAMKR, DLAMOB" 0x8181F9 nmot SstAUbSstUb 10200. nmot_ub_q40 6 0.00 10200. FUNCTION_LIST SSTB LAMFAW DEPOSIT ABSOLUT IF_DATA DIM_X DIRECT 0x8181F9 /end AXIS_PTS
/begin AXIS_PTS SNM06KOUB "Verteilung für Klimakompressorkennlinien" 0x81A20B nmot SstAUbSstUb 10200. nmot_ub_q40 6 0.00 10200. FUNCTION_LIST MDVERB DEPOSIT ABSOLUT IF_DATA DIM_X DIRECT 0x81A20B /end AXIS_PTS
/begin AXIS_PTS SNM06LLUB "Sützstellenverteilung für Motordrehzahl" 0x813A6C nmot_w SstAUwSstUw 16383.75 nmot_uw_q0p25 6 0.00 16383.75 FUNCTION_LIST SSTB LLRMR LLRRM DEPOSIT ABSOLUT IF_DATA DIM_X DIRECT 0x813A6C /end AXIS_PTS
/begin AXIS_PTS SNM06MDUW "Rover" 0x81B190 nmot_w SstAUwSstUw 16383.75 nmot_uw_q0p25 6 0.00 16383.75 FUNCTION_LIST SSTB MDFAW DEPOSIT ABSOLUT IF_DATA DIM_X DIRECT 0x81B190 /end AXIS_PTS
/begin AXIS_PTS SNM07ESUB "Stützstellenverteilung Drehzahl, 7 Sst." 0x818200 nmot SstAUbSstUb 10200. nmot_ub_q40 7 0.00 10200. FUNCTION_LIST SSTB ESUK LAMFAW DEPOSIT ABSOLUT IF_DATA DIM_X DIRECT 0x818200 /end AXIS_PTS
/begin AXIS_PTS SNM08DMUB "SST-Verteilung in DMD, 8 Drehzahl-SST" 0x81007C nmot SstAUbSstUb 10200. nmot_ub_q40 8 0.00 10200. FUNCTION_LIST SSTB DMDDLU DMDLU DMDLUA DMDMIL DMDSTP DEPOSIT ABSOLUT IF_DATA DIM_X DIRECT 0x81007C /end AXIS_PTS
/begin AXIS_PTS SNM08GKUB "Stützstellenverteilung Gemischkontrolle 8 nmot Stützstellen" 0x818FF9 nmot SstAUbSstUb 10200. nmot_ub_q40 8 0.00 10200. FUNCTION_LIST ESVW DEPOSIT ABSOLUT IF_DATA DIM_X DIRECT 0x818FF9 /end AXIS_PTS
/begin AXIS_PTS SNM08KOUB "Stützstellenverteilung für Klimakompressorsteuerung  8  nmot" 0x812D9A nmot SstAUbSstUb 10200. nmot_ub_q40 8 0.00 10200. FUNCTION_LIST KOS DEPOSIT ABSOLUT IF_DATA DIM_X DIRECT 0x812D9A /end AXIS_PTS
/begin AXIS_PTS SNM08LDUB "Stützstellenverteilung für Ladedruckregelung" 0x810085 nmot SstAUbSstUb 10200. nmot_ub_q40 8 0.00 10200. FUNCTION_LIST SSTB LDOB LDRLMX LDRPID DEPOSIT ABSOLUT IF_DATA DIM_X DIRECT 0x810085 /end AXIS_PTS
/begin AXIS_PTS SNM08LDUW "Stützstellenverteilung für Ladedruckregelung" 0x813A8A nmot_w SstAUwSstUw 16383.75 nmot_uw_q0p25 8 0.00 16383.75 FUNCTION_LIST SSTB BGPLGU LDRLMX LDRPID DEPOSIT ABSOLUT IF_DATA DIM_X DIRECT 0x813A8A /end AXIS_PTS
/begin AXIS_PTS SNM08OPUB "Stützstellenverteilung für Motordrehzahl nmot" 0x81008E nmot SstAUbSstUb 10200. nmot_ub_q40 8 0.00 10200. FUNCTION_LIST SSTB MDZUL DEPOSIT ABSOLUT IF_DATA DIM_X DIRECT 0x81008E /end AXIS_PTS
/begin AXIS_PTS SNM08__UB "Stützstellenverteilung Drehzahl, 8 Sst." 0x81821A nmot SstAUbSstUb 10200. nmot_ub_q40 8 0.00 10200. FUNCTION_LIST SSTB BBSAWE ZUE DEPOSIT ABSOLUT IF_DATA DIM_X DIRECT 0x81821A /end AXIS_PTS
/begin AXIS_PTS SNM12ESUB "SST-Verteilung für die Motordrehzahl nmot" 0x8100A2 nmot SstAUbSstUb 10200. nmot_ub_q40 12 0.00 10200. FUNCTION_LIST SSTB ZWWL DEPOSIT ABSOLUT IF_DATA DIM_X DIRECT 0x8100A2 /end AXIS_PTS
/begin AXIS_PTS SNM12FEUB "Stützstellen für WDKSMX, WDKUGDN" 0x8100AF nmot SstAUbSstUb 10200. nmot_ub_q40 12 0.00 10200. FUNCTION_LIST SSTB BGMSZS MDFUE DEPOSIT ABSOLUT IF_DATA DIM_X DIRECT 0x8100AF /end AXIS_PTS
/begin AXIS_PTS SNM12LDUW "Stützstellenverteilung für Ladedruckregelung" 0x813AAE nmot_w SstAUwSstUw 16383.75 nmot_uw_q0p25 12 0.00 16383.75 FUNCTION_LIST SSTB LDRLMX LDRPLS DEPOSIT ABSOLUT IF_DATA DIM_X DIRECT 0x813AAE /end AXIS_PTS
/begin AXIS_PTS SNM12MDUW "Stützstellenverteilung nmot_w" 0x816FFC nmot_w SstAUwSstUw 16383.75 nmot_uw_q0p25 12 0.00 16383.75 FUNCTION_LIST MDFAW DEPOSIT ABSOLUT IF_DATA DIM_X DIRECT 0x816FFC /end AXIS_PTS
/begin AXIS_PTS SNM16KRUB "Stützstellenverteilung Drehzahl, 16 Sst." 0x818250 nmot SstAUbSstUb 10200. nmot_ub_q40 16 0.00 10200. FUNCTION_LIST SSTB DKRS GGKS KRDY KRKE KRRA DEPOSIT ABSOLUT IF_DATA DIM_X DIRECT 0x818250 /end AXIS_PTS
/begin AXIS_PTS SNM16LDUB "Stützstellenverteilung für Ladedruckregelung" 0x8100BC nmot SstAUbSstUb 10200. nmot_ub_q40 16 0.00 10200. FUNCTION_LIST SSTB LDRPID DEPOSIT ABSOLUT IF_DATA DIM_X DIRECT 0x8100BC /end AXIS_PTS
/begin AXIS_PTS SNM16NEUW "Drehzahlstützstellen Nockenwellensollwinkel Einlaß" 0x813AEA nmot_w SstAUwSstUw 16383.75 nmot_uw_q0p25 16 0.00 16383.75 FUNCTION_LIST SSTB NWSOLLE DEPOSIT ABSOLUT IF_DATA DIM_X DIRECT 0x813AEA /end AXIS_PTS
/begin AXIS_PTS SNM16OPUW "Stützstellenverteilung Drehzahl" 0x813B0C nmot_w SstAUwSstUw 16383.75 nmot_uw_q0p25 16 0.00 16383.75 FUNCTION_LIST SSTB MDBAS MDMAX MDVER DEPOSIT ABSOLUT IF_DATA DIM_X DIRECT 0x813B0C /end AXIS_PTS
/begin AXIS_PTS SNM16ZUUW "Stützstellenverteilung Drehzahl, 16 Sst." 0x813B2E nmot_w SstAUwSstUw 16383.75 nmot_uw_q0p25 16 0.00 16383.75 FUNCTION_LIST SSTB ZWGRU ZWMIN DEPOSIT ABSOLUT IF_DATA DIM_X DIRECT 0x813B2E /end AXIS_PTS
/begin AXIS_PTS SNS06LLSB "Stützstellenvert., Solldrehzahlabw., 06 Sst., LL-Regel." 0x81A071 dns SstAUbSstSb 2550. nmotd_sb_q10 6 -1280. 1270. FUNCTION_LIST LLRNS LLRMR LLRRM DEPOSIT ABSOLUT IF_DATA DIM_X DIRECT 0x81A071 /end AXIS_PTS
/begin AXIS_PTS SNS206LLSB "" 0x811DA0 dns SstAUbSstSb 2550. nmotd_sb_q10 6 -1280. 1270. FUNCTION_LIST LLRRM DEPOSIT ABSOLUT IF_DATA DIM_X DIRECT 0x811DA0 /end AXIS_PTS
/begin AXIS_PTS SPSNV08_UC "Stützstellenverteilung für Pedalwert im Befehlstest" 0x812504 spsn_uc SstAUbSstUb 4.9805 spg_ub_q0p019 8 0.00 4.9805 FUNCTION_LIST URCEINS URCMZUL DEPOSIT ABSOLUT IF_DATA DIM_X DIRECT 0x812504 /end AXIS_PTS
/begin AXIS_PTS SPSNV08_UM "Stützstellenverteilung für Pedalwert in der Funktionsüberwachung" 0x814094 spsn_um SstAUbSstUb 4.9805 spg_ub_q0p019 8 0.00 4.9805 FUNCTION_LIST UFEINS UFMZUL DEPOSIT ABSOLUT IF_DATA DIM_X DIRECT 0x814094 /end AXIS_PTS
/begin AXIS_PTS SRL05NEUW "Laststützstellen Nockenwellensollwinkel Einlaß" 0x813B50 rlnw_w SstAUwSstUw 1535.977 rel_uw_q0p0234 5 0.00 1535.977 FUNCTION_LIST SSTB NWSOLLE DEPOSIT ABSOLUT IF_DATA DIM_X DIRECT 0x813B50 /end AXIS_PTS
/begin AXIS_PTS SRL06ESUB "Sst-Verteilung für die relative Füllung rl" 0x8100DC rl SstAUbSstUb 191.3 rel_ub_q0p75 6 0.00 191.3 FUNCTION_LIST SSTB ZWWL DEPOSIT ABSOLUT IF_DATA DIM_X DIRECT 0x8100DC /end AXIS_PTS
/begin AXIS_PTS SRL06KOUB "Stützstellenverteilung Kompressormoment" 0x81A212 rl SstAUbSstUb 191.3 rel_ub_q0p75 6 0.00 191.3 FUNCTION_LIST MDVERB DEPOSIT ABSOLUT IF_DATA DIM_X DIRECT 0x81A212 /end AXIS_PTS
/begin AXIS_PTS SRL08GKUB "Stützstellenverteilung Gemischkontrolle 8 rl Stützstellen" 0x819002 rl SstAUbSstUb 191.3 rel_ub_q0p75 8 0.00 191.3 FUNCTION_LIST ESVW DEPOSIT ABSOLUT IF_DATA DIM_X DIRECT 0x819002 /end AXIS_PTS
/begin AXIS_PTS SRL08NEUW "Laststützstellen Nockenwellensollwinkel Einlaß" 0x813B7C rlnw_w SstAUwSstUw 1535.977 rel_uw_q0p0234 8 0.00 1535.977 FUNCTION_LIST SSTB NWSOLLE DEPOSIT ABSOLUT IF_DATA DIM_X DIRECT 0x813B7C /end AXIS_PTS
/begin AXIS_PTS SRL08NXUB "Stützstellenverteilung relative Luftfüllung 8 Sst." 0x818278 rl SstAUbSstUb 191.3 rel_ub_q0p75 8 0.00 191.3 FUNCTION_LIST SSTB NMAXMD DEPOSIT ABSOLUT IF_DATA DIM_X DIRECT 0x818278 /end AXIS_PTS
/begin AXIS_PTS SRL11OPUW "Stützstellenverteilung relative Luftfüllung" 0x8172D8 rl_w SstAUwSstUw 1535.977 rel_uw_q0p0234 11 0.00 1535.977 FUNCTION_LIST MDBAS MDMAX MDVER DEPOSIT ABSOLUT IF_DATA DIM_X DIRECT 0x8172D8 /end AXIS_PTS
/begin AXIS_PTS SRL12ZUUW "Stützstellenverteilung relative Luftfüllung, 12 St." 0x813B8E rl_w SstAUwSstUw 1535.977 rel_uw_q0p0234 12 0.00 1535.977 FUNCTION_LIST SSTB ZWGRU ZWMIN DEPOSIT ABSOLUT IF_DATA DIM_X DIRECT 0x813B8E /end AXIS_PTS
/begin AXIS_PTS SRP06ESUB "SST-Verteilung für rel. Luftfüllung präd. für Einspritzung" 0x8100F7 rlp SstAUbSstUb 191.3 rel_ub_q0p75 6 0.00 191.3 FUNCTION_LIST SSTB ESNSWL DEPOSIT ABSOLUT IF_DATA DIM_X DIRECT 0x8100F7 /end AXIS_PTS
/begin AXIS_PTS ST107TMUB "Stützstellenverteilung, Starttemperatur an Sonde vorne" 0x818281 tabgmst SstAUbSstUb 1275. temp_ub_q5_o50 7 -50.00 1225. FUNCTION_LIST SSTB ATM DEPOSIT ABSOLUT IF_DATA DIM_X DIRECT 0x818281 /end AXIS_PTS
/begin AXIS_PTS ST307TMUB "Stützstellenverteilung, Starttemperatur an Sonde hinten" 0x818289 tkatmst SstAUbSstUb 1275. temp_ub_q5_o50 7 -50.00 1225. FUNCTION_LIST SSTB ATM DEPOSIT ABSOLUT IF_DATA DIM_X DIRECT 0x818289 /end AXIS_PTS
/begin AXIS_PTS STA04LLUB "Stützstellenverteilung: tans für Momentenreserve" 0x813BA8 tans SstAUwSstUw 49151.25 temp_ub_q0p75_o48 4 -48.00000 49103.25 FUNCTION_LIST SSTB LLRMR DEPOSIT ABSOLUT IF_DATA DIM_X DIRECT 0x813BA8 /end AXIS_PTS
/begin AXIS_PTS STA06LLUB "Temperatur: Ansaugluft bzw. PWM-Signal von AC/Kompressor" 0x81A219 tlok SstAUbSstUb 191.3 temp_ub_q0p75_o48 6 -48.00 143.3 FUNCTION_LIST MDVERB DEPOSIT ABSOLUT IF_DATA DIM_X DIRECT 0x81A219 /end AXIS_PTS
/begin AXIS_PTS STA08LDUB "Stützstellenverteilung für Ladedruckregelung" 0x8100FE tans SstAUbSstUb 191.3 temp_ub_q0p75_o48 8 -48.00 143.3 FUNCTION_LIST SSTB LDRLMX LDRPID DEPOSIT ABSOLUT IF_DATA DIM_X DIRECT 0x8100FE /end AXIS_PTS
/begin AXIS_PTS STA10LDUB "Stützstellenverteilung für Ladedruckregelung" 0x819DBB tans SstAUbSstUb 191.3 temp_ub_q0p75_o48 10 -48.00 143.3 FUNCTION_LIST LDRLMX DEPOSIT ABSOLUT IF_DATA DIM_X DIRECT 0x819DBB /end AXIS_PTS
/begin AXIS_PTS STA12WLUB "SST-Verteilung für die Ansauglufttemperatur" 0x810107 tans SstAUbSstUb 191.3 temp_ub_q0p75_o48 12 -48.00 143.3 FUNCTION_LIST SSTB ZWWL DEPOSIT ABSOLUT IF_DATA DIM_X DIRECT 0x810107 /end AXIS_PTS
/begin AXIS_PTS STK04SAUB "SST-Verteilung Kattemperatur für Funktion SAWE" 0x818298 tkatm SstAUbSstUb 1275. temp_ub_q5_o50 4 -50.00 1225. FUNCTION_LIST SSTB BBSAWE DEPOSIT ABSOLUT IF_DATA DIM_X DIRECT 0x818298 /end AXIS_PTS
/begin AXIS_PTS STM04FEUB "Stützstellenverteilung Motortemperatur" 0x810114 tmot SstAUbSstUb 191.3 temp_ub_q0p75_o48 4 -48.00 143.3 FUNCTION_LIST SSTB MDFUE DEPOSIT ABSOLUT IF_DATA DIM_X DIRECT 0x810114 /end AXIS_PTS
/begin AXIS_PTS STM04SAUB "Stützstellenverteilung Motortemperatur, 4 Sst." 0x810119 tmot SstAUbSstUb 191.3 temp_ub_q0p75_o48 4 -48.00 143.3 FUNCTION_LIST SSTB LLRMR DEPOSIT ABSOLUT IF_DATA DIM_X DIRECT 0x810119 /end AXIS_PTS
/begin AXIS_PTS STM05SAUB "Stützstellenverteilung" 0x81829D tmot SstAUbSstUb 191.3 temp_ub_q0p75_o48 5 -48.00 143.3 FUNCTION_LIST SSTB BBSAWE DEPOSIT ABSOLUT IF_DATA DIM_X DIRECT 0x81829D /end AXIS_PTS
/begin AXIS_PTS STM05TMUB "Stützstellenverteilung, Motorstarttemperatur" 0x8182A3 tmst SstAUbSstUb 191.3 temp_ub_q0p75_o48 5 -48.00 143.3 FUNCTION_LIST SSTB ATM DEPOSIT ABSOLUT IF_DATA DIM_X DIRECT 0x8182A3 /end AXIS_PTS
/begin AXIS_PTS STM06LLUB "Stützstellenverteilung Motortemperatur, 6 Sst." 0x8182A9 tmot SstAUbSstUb 191.3 temp_ub_q0p75_o48 6 -48.00 143.3 FUNCTION_LIST SSTB LLRNS LLRRM DEPOSIT ABSOLUT IF_DATA DIM_X DIRECT 0x8182A9 /end AXIS_PTS
/begin AXIS_PTS STM08DMUB "8 Motortemperaturstützstellen für DMD" 0x81011E tmot SstAUbSstUb 191.3 temp_ub_q0p75_o48 8 -48.00 143.3 FUNCTION_LIST SSTB DMDLU DEPOSIT ABSOLUT IF_DATA DIM_X DIRECT 0x81011E /end AXIS_PTS
/begin AXIS_PTS STM09ESUB "Stützstellenverteilung Motortemperatur, 9 Sst." 0x8182C0 tmot SstAUbSstUb 191.3 temp_ub_q0p75_o48 9 -48.00 143.3 FUNCTION_LIST SSTB ESUK ESUKAS DEPOSIT ABSOLUT IF_DATA DIM_X DIRECT 0x8182C0 /end AXIS_PTS
/begin AXIS_PTS STM10__UB "" 0x8182CA tmot SstAUbSstUb 191.3 temp_ub_q0p75_o48 10 -48.00 143.3 FUNCTION_LIST SSTB MDVER DEPOSIT ABSOLUT IF_DATA DIM_X DIRECT 0x8182CA /end AXIS_PTS
/begin AXIS_PTS STM12ESUB "SST-Verteilung für die Motortemperatur tmot" 0x810127 tmot SstAUbSstUb 191.3 temp_ub_q0p75_o48 12 -48.00 143.3 FUNCTION_LIST SSTB ESNSWL LAMKO LANSWL ZWWL DEPOSIT ABSOLUT IF_DATA DIM_X DIRECT 0x810127 /end AXIS_PTS
/begin AXIS_PTS STN06LLUB "Stützstellenverteilung: Zeit nach Start; für Drehzahlverlauf nach Start" 0x8182D5 tnst SstAUbSstUb 255.0 t1sxs_ub_b255 6 0.00 255.0 FUNCTION_LIST SSTB LLRNS DEPOSIT ABSOLUT IF_DATA DIM_X DIRECT 0x8182D5 /end AXIS_PTS
/begin AXIS_PTS STS08ESUB "SST-Verteilung für Motorstarttemperatur" 0x810134 tmst SstAUbSstUb 191.3 temp_ub_q0p75_o48 8 -48.00 143.3 FUNCTION_LIST SSTB ESNSWL DEPOSIT ABSOLUT IF_DATA DIM_X DIRECT 0x810134 /end AXIS_PTS
/begin AXIS_PTS STW08MDUB "Stützstellenverteilung  Temperatur des Drehmomentenwandlers" 0x81A0DE twnd SstAUbSstUb 191.3 temp_ub_q0p75_o48 8 -48.00 143.3 FUNCTION_LIST MDWAN DEPOSIT ABSOLUT IF_DATA DIM_X DIRECT 0x81A0DE /end AXIS_PTS
/begin AXIS_PTS SUV07MDUB "Stützstellenverteilung für die Übertragungsfunktion der Getriebesteuerung" 0x8182DC uefktget SstAUbSstUb 25.50 uefktget_ub_b25p4 7 0.00 25.50 FUNCTION_LIST SSTB ARMD DEPOSIT ABSOLUT IF_DATA DIM_X DIRECT 0x8182DC /end AXIS_PTS
/begin AXIS_PTS SVP12LDUW "Stützstellenverteilung für vpssplg bei LDR" 0x813BB2 vpssplg_w SstAUwSstUw 3.999939 fak_uw_b4 12 0.00 3.999939 FUNCTION_LIST SSTB LDRPLS DEPOSIT ABSOLUT IF_DATA DIM_X DIRECT 0x813BB2 /end AXIS_PTS
/begin AXIS_PTS SWP08OPUB "Stützstellenverteilung für Pedalstellung wped" 0x810153 wped SstAUbSstUb 100.0 relPED_ub_b100 8 0.00 100.0 FUNCTION_LIST SSTB MDZUL DEPOSIT ABSOLUT IF_DATA DIM_X DIRECT 0x810153 /end AXIS_PTS
/begin AXIS_PTS SWP16MDUW "Stützstellenverteilung wped_w" 0x817016 wped_w SstAUwSstUw 100.0000 relPED_uw_b100 16 0.00 100.0000 FUNCTION_LIST MDFAW DEPOSIT ABSOLUT IF_DATA DIM_X DIRECT 0x817016 /end AXIS_PTS
/begin COMPU_METHOD DEZ "1 : 1 Umrechnug (dez/hex)" RAT_FUNC "%6.2" "" COEFFS 0 1 0 0 0 1 /end COMPU_METHOD
/begin COMPU_METHOD dez "1 : 1 Umrechnug (dez/hex)" RAT_FUNC "%6.2" "" COEFFS 0 1 0 0 0 1 /end COMPU_METHOD
/begin COMPU_METHOD fak1_q1p63Em5 "" RAT_FUNC "%7.6" "[g*K]/hPa" COEFFS 0 61440 0 0 0 1 /end COMPU_METHOD
/begin COMPU_METHOD fak_q0p000244 "" RAT_FUNC "%6.5" "-" COEFFS 0 65536 0 0 0 16 /end COMPU_METHOD
/begin COMPU_METHOD fak_q0p0039 "" RAT_FUNC "%6.4" "-" COEFFS 0 256 0 0 0 1 /end COMPU_METHOD
/begin COMPU_METHOD fak_q0p03815 "" RAT_FUNC "%6.4" "%/(s*kg/h)" COEFFS 0 65536 0 0 0 2500 /end COMPU_METHOD
/begin COMPU_METHOD fak_q0p0625 "" RAT_FUNC "%6.4" "-" COEFFS 0 16 0 0 0 1 /end COMPU_METHOD
/begin COMPU_METHOD fak_q0p1 "" RAT_FUNC "%6.3" "" COEFFS 0 1 0 0 0 0.1 /end COMPU_METHOD
/begin COMPU_METHOD fak_sb_b1 "" RAT_FUNC "%6.4" "-" COEFFS 0 256 0 0 0 2 /end COMPU_METHOD
/begin COMPU_METHOD fak_sb_b2 "" RAT_FUNC "%6.4" "-" COEFFS 0 256 0 0 0 4 /end COMPU_METHOD
/begin COMPU_METHOD fak_sw_b1 "" RAT_FUNC "%7.6" "-" COEFFS 0 65536 0 0 0 2 /end COMPU_METHOD
/begin COMPU_METHOD fak_ub_b0p25 "" RAT_FUNC "%10.7" "-" COEFFS 0 256 0 0 0 0.25 /end COMPU_METHOD
/begin COMPU_METHOD fak_ub_b1 "" RAT_FUNC "%6.4" "-" COEFFS 0 256 0 0 0 1 /end COMPU_METHOD
/begin COMPU_METHOD fak_ub_b16 "" RAT_FUNC "%6.4" "-" COEFFS 0 256 0 0 0 16 /end COMPU_METHOD
/begin COMPU_METHOD fak_ub_b2 "" RAT_FUNC "%6.4" "-" COEFFS 0 256 0 0 0 2 /end COMPU_METHOD
/begin COMPU_METHOD fak_ub_b4 "" RAT_FUNC "%6.4" "-" COEFFS 0 256 0 0 0 4 /end COMPU_METHOD
/begin COMPU_METHOD fak_ub_b8 "" RAT_FUNC "%6.4" "-" COEFFS 0 256 0 0 0 8 /end COMPU_METHOD
/begin COMPU_METHOD fak_uw_b1 "" RAT_FUNC "%7.6" "-" COEFFS 0 65536 0 0 0 1 /end COMPU_METHOD
/begin COMPU_METHOD fak_uw_b16 "" RAT_FUNC "%6.5" "-" COEFFS 0 65536 0 0 0 16 /end COMPU_METHOD
/begin COMPU_METHOD fak_uw_b2 "" RAT_FUNC "%7.6" "-" COEFFS 0 65536 0 0 0 2 /end COMPU_METHOD
/begin COMPU_METHOD fak_uw_b4 "" RAT_FUNC "%7.6" "-" COEFFS 0 65536 0 0 0 4 /end COMPU_METHOD
/begin COMPU_METHOD fak_uw_b4864 "" RAT_FUNC "%6.4" "-" COEFFS 0 65536 0 0 0 4864 /end COMPU_METHOD
/begin COMPU_METHOD fak_uw_b5 "" RAT_FUNC "%7.6" "-" COEFFS 0 65536 0 0 0 5 /end COMPU_METHOD
/begin COMPU_METHOD fak_uw_b8 "" RAT_FUNC "%6.5" "-" COEFFS 0 65536 0 0 0 8 /end COMPU_METHOD
/begin COMPU_METHOD fak_uw_q0p001 "" RAT_FUNC "%6.5" "" COEFFS 0 65536 0 0 0 65.536 /end COMPU_METHOD
/begin COMPU_METHOD km_ub_q0p10 "" RAT_FUNC "%6.3" "km" COEFFS 0 10 0 0 0 1 /end COMPU_METHOD
/begin COMPU_METHOD kumsrl_ub_b0p002 "" RAT_FUNC "%10.9" "(kg/h)/(1/min)(%)" COEFFS 0 128000 0 0 0 1 /end COMPU_METHOD
/begin COMPU_METHOD kva_ub_q20 "" RAT_FUNC "%6.1" "L/Zyl." COEFFS 0 1 0 0 0 20 /end COMPU_METHOD
/begin COMPU_METHOD kw_q0p0019 "" RAT_FUNC "%6.4" "°KW" COEFFS 0 512 0 0 0 1 /end COMPU_METHOD
/begin COMPU_METHOD kw_q0p0625 "" RAT_FUNC "%6.4" "°KW" COEFFS 0 16 0 0 0 1 /end COMPU_METHOD
/begin COMPU_METHOD kw_sw_b128 "" RAT_FUNC "%6.4" "°KW" COEFFS 0 65536 0 0 0 256 /end COMPU_METHOD
/begin COMPU_METHOD kw_sw_q0p0078 "" RAT_FUNC "%6.4" "°KW" COEFFS 0 128 0 0 0 1 /end COMPU_METHOD
/begin COMPU_METHOD luquant "Umrechnung Laufunruhe in DMD" RAT_FUNC "%6.3" "(Umdr./sec)^2" COEFFS 0 1.47862 0 0 0 1 /end COMPU_METHOD
/begin COMPU_METHOD mdt_sw_b2556 "" RAT_FUNC "%6.4" "Nms" COEFFS 0 65536 0 0 0 5112 /end COMPU_METHOD
/begin COMPU_METHOD md_ub_q10 "" RAT_FUNC "%6.1" "Nm" COEFFS 0 1 0 0 0 10 /end COMPU_METHOD
/begin COMPU_METHOD mk1sxs_b2560 "" RAT_FUNC "%6.1" "s/(kg/h)" COEFFS 0 0 2560 0 1 0 /end COMPU_METHOD
/begin COMPU_METHOD m_q0p0015625 "" RAT_FUNC "%6.4" "kg/h" COEFFS 0 640 0 0 0 1 /end COMPU_METHOD
/begin COMPU_METHOD m_q0p00195 "" RAT_FUNC "%6.4" "kg/(h*s)" COEFFS 0 65536 0 0 0 128 /end COMPU_METHOD
/begin COMPU_METHOD m_q0p00355 "" RAT_FUNC "%6.4" "kg" COEFFS 0 1125 0 0 0 4 /end COMPU_METHOD
/begin COMPU_METHOD m_q0p1 "" RAT_FUNC "%6.3" "kg/h" COEFFS 0 10 0 0 0 1 /end COMPU_METHOD
/begin COMPU_METHOD m_q0p1_mg "" RAT_FUNC "%6.3" "mg" COEFFS 0 1 0 0 0 0.1 /end COMPU_METHOD
/begin COMPU_METHOD m_q0p4 "" RAT_FUNC "%6.3" "kg/h" COEFFS 0 1 0 0 0 0.4 /end COMPU_METHOD
/begin COMPU_METHOD m_sw_b3276p8 "" RAT_FUNC "%6.3" "kg/h" COEFFS 0 1 0 0 0 0.1 /end COMPU_METHOD
/begin COMPU_METHOD m_ub_b1020 "" RAT_FUNC "%6.2" "kg/h" COEFFS 0 1 0 0 0 4 /end COMPU_METHOD
/begin COMPU_METHOD m_ub_b23p3 "" RAT_FUNC "%6.3" "kg" COEFFS 0 2812.5 0 0 0 256 /end COMPU_METHOD
/begin COMPU_METHOD m_ub_b25p6 "" RAT_FUNC "%6.3" "kg/h" COEFFS 0 256 0 0 0 25.6 /end COMPU_METHOD
/begin COMPU_METHOD m_ub_b780 "" RAT_FUNC "%6.2" "cm^3/min" COEFFS 0 256 0 0 0 780 /end COMPU_METHOD
/begin COMPU_METHOD m_ub_q0p0444 "" RAT_FUNC "%6.4" "g" COEFFS 0 1 0 0 0 0.0444 /end COMPU_METHOD
/begin COMPU_METHOD m_uw_b102p4 "" RAT_FUNC "%6.4" "kg/h" COEFFS 0 65536 0 0 0 102.4 /end COMPU_METHOD
/begin COMPU_METHOD m_uw_b23p3 "" RAT_FUNC "%6.5" "kg" COEFFS 0 2812.5 0 0 0 1 /end COMPU_METHOD
/begin COMPU_METHOD m_uw_b25p6 "" RAT_FUNC "%6.5" "kg/h" COEFFS 0 65536 0 0 0 25.6 /end COMPU_METHOD
/begin COMPU_METHOD m_uw_b6553p5 "" RAT_FUNC "%6.3" "kg/h" COEFFS 0 1 0 0 0 0.1 /end COMPU_METHOD
/begin COMPU_METHOD m_uw_b7281 "" RAT_FUNC "%6.3" "g" COEFFS 0 9 0 0 0 1 /end COMPU_METHOD
/begin COMPU_METHOD nmotd_sb_q10 "" RAT_FUNC "%6.1" "U/min" COEFFS 0 1 0 0 0 10 /end COMPU_METHOD
/begin COMPU_METHOD nmotg_sb_q100 "" RAT_FUNC "%6.0" "U/min/s" COEFFS 0 1 0 0 0 100 /end COMPU_METHOD
/begin COMPU_METHOD nmotg_sw_q0p39 "" RAT_FUNC "%6.3" "U/min/s" COEFFS 0 1 0 0 0 0.39063 /end COMPU_METHOD
/begin COMPU_METHOD nmot_ub_q10 "" RAT_FUNC "%6.1" "U/min" COEFFS 0 1 0 0 0 10 /end COMPU_METHOD
/begin COMPU_METHOD nmot_ub_q20 "" RAT_FUNC "%6.1" "U/min" COEFFS 0 1 0 0 0 20 /end COMPU_METHOD
/begin COMPU_METHOD nmot_ub_q40 "" RAT_FUNC "%6.1" "Upm" COEFFS 0 1 0 0 0 40 /end COMPU_METHOD
/begin COMPU_METHOD nmot_uw_q0p25 "" RAT_FUNC "%6.3" "U/min" COEFFS 0 1 0 0 0 0.25 /end COMPU_METHOD
/begin COMPU_METHOD perio_ub_b0p012207 "" RAT_FUNC "%10.8" "1/s" COEFFS 0 256 0 0 0 0.012207 /end COMPU_METHOD
/begin COMPU_METHOD p_q0p2 "" RAT_FUNC "%6.3" "bar" COEFFS 0 5 0 0 0 1 /end COMPU_METHOD
/begin COMPU_METHOD p_sb_q10 "" RAT_FUNC "%6.1" "hPa" COEFFS 0 1 0 0 0 10 /end COMPU_METHOD
/begin COMPU_METHOD p_sw_q0p000977 "" RAT_FUNC "%6.5" "hPa" COEFFS 0 1 0 0 0 0.000977 /end COMPU_METHOD
/begin COMPU_METHOD p_sw_q0p00244 "" RAT_FUNC "%6.4" "hPa" COEFFS 0 32768 0 0 0 80 /end COMPU_METHOD
/begin COMPU_METHOD p_ub_q10 "" RAT_FUNC "%6.1" "hPa" COEFFS 0 1 0 0 0 10 /end COMPU_METHOD
/begin COMPU_METHOD p_uw_q0p039 "" RAT_FUNC "%6.4" "hPa" COEFFS 0 256 0 0 0 10 /end COMPU_METHOD
/begin COMPU_METHOD q_q0p4551 "" RAT_FUNC "%6.3" "kJ" COEFFS 0 36000 0 0 0 16384 /end COMPU_METHOD
/begin COMPU_METHOD relDK_q0p02441 "" RAT_FUNC "%6.4" "% DK" COEFFS 0 65536 0 0 0 1600 /end COMPU_METHOD
/begin COMPU_METHOD relDK_ub_b100 "" RAT_FUNC "%6.3" "% DK" COEFFS 0 255 0 0 0 100 /end COMPU_METHOD
/begin COMPU_METHOD relnmot_q0p02 "" RAT_FUNC "%6.4" "%/(U/min)/s" COEFFS 0 1 0 0 0 0.02 /end COMPU_METHOD
/begin COMPU_METHOD relPED_ub_b100 "" RAT_FUNC "%6.3" "% PED" COEFFS 0 255 0 0 0 100 /end COMPU_METHOD
/begin COMPU_METHOD relPED_uw_b100 "" RAT_FUNC "%6.4" "% PED" COEFFS 0 65535 0 0 0 100 /end COMPU_METHOD
/begin COMPU_METHOD rel_q0p007629 "" RAT_FUNC "%10.6" "%/(km/h)/s" COEFFS 0 65536 0 0 0 500 /end COMPU_METHOD
/begin COMPU_METHOD rel_q0p1953 "" RAT_FUNC "%6.3" "%" COEFFS 0 256 0 0 0 50 /end COMPU_METHOD
/begin COMPU_METHOD rel_q0p1957 "" RAT_FUNC "%6.3" "%" COEFFS 0 511 0 0 0 100 /end COMPU_METHOD
/begin COMPU_METHOD rel_sb_b25 "" RAT_FUNC "%6.3" "%" COEFFS 0 128 0 0 0 25 /end COMPU_METHOD
/begin COMPU_METHOD rel_sb_q0p39 "" RAT_FUNC "%6.3" "%" COEFFS 0 1 0 0 0 0.3906 /end COMPU_METHOD
/begin COMPU_METHOD rel_sw_b100 "" RAT_FUNC "%6.4" "%" COEFFS 0 32768 0 0 0 100 /end COMPU_METHOD
/begin COMPU_METHOD rel_sw_b50 "" RAT_FUNC "%6.4" "%" COEFFS 0 65536 0 0 0 100 /end COMPU_METHOD
/begin COMPU_METHOD rel_ub_b100 "" RAT_FUNC "%6.3" "%" COEFFS 0 256 0 0 0 100 /end COMPU_METHOD
/begin COMPU_METHOD rel_ub_b127p5 "" RAT_FUNC "%6.3" "%" COEFFS 0 2 0 0 0 1 /end COMPU_METHOD
/begin COMPU_METHOD rel_ub_b200 "" RAT_FUNC "%6.3" "%" COEFFS 0 256 0 0 0 200 /end COMPU_METHOD
/begin COMPU_METHOD rel_ub_b24p9 "" RAT_FUNC "%6.3" "%" COEFFS 0 255 0 0 0 24.9 /end COMPU_METHOD
/begin COMPU_METHOD rel_ub_b25 "" RAT_FUNC "%6.3" "%" COEFFS 0 256 0 0 0 25 /end COMPU_METHOD
/begin COMPU_METHOD rel_ub_b2p0 "" RAT_FUNC "%6.4" "%" COEFFS 0 256 0 0 0 2 /end COMPU_METHOD
/begin COMPU_METHOD rel_ub_b99p6 "" RAT_FUNC "%6.3" "%" COEFFS 0 256 0 0 0 100 /end COMPU_METHOD
/begin COMPU_METHOD rel_ub_bn24p9 "" RAT_FUNC "%6.5" "%" COEFFS 0 -255 0 0 0 24.9 /end COMPU_METHOD
/begin COMPU_METHOD rel_ub_q0p3906 "" RAT_FUNC "%6.3" "%" COEFFS 0 256 0 0 0 100 /end COMPU_METHOD
/begin COMPU_METHOD rel_ub_q0p391 "" RAT_FUNC "%6.3" "%/km/h" COEFFS 0 1 0 0 0 0.391 /end COMPU_METHOD
/begin COMPU_METHOD rel_ub_q0p75 "" RAT_FUNC "%6.3" "%" COEFFS 0 1 0 0 0 0.75 /end COMPU_METHOD
/begin COMPU_METHOD rel_uw_b0p3 "" RAT_FUNC "%8.7" "%/hPa" COEFFS 0 65536 0 0 0 0.3 /end COMPU_METHOD
/begin COMPU_METHOD rel_uw_b100 "" RAT_FUNC "%6.4" "%" COEFFS 0 65536 0 0 0 100 /end COMPU_METHOD
/begin COMPU_METHOD rel_uw_b200 "" RAT_FUNC "%6.4" "%" COEFFS 0 65536 0 0 0 200 /end COMPU_METHOD
/begin COMPU_METHOD rel_uw_b3072 "" RAT_FUNC "%6.4" "%" COEFFS 0 65536 0 0 0 3072 /end COMPU_METHOD
/begin COMPU_METHOD rel_uw_b3200 "" RAT_FUNC "%6.4" "%/(km/h)" COEFFS 0 65536 0 0 0 3200 /end COMPU_METHOD
/begin COMPU_METHOD rel_uw_b3276p75 "" RAT_FUNC "%6.4" "%/100hPa" COEFFS 0 1 0 0 0 0.05 /end COMPU_METHOD
/begin COMPU_METHOD rel_uw_b40 "" RAT_FUNC "%6.5" "%" COEFFS 0 65536 0 0 0 40 /end COMPU_METHOD
/begin COMPU_METHOD rel_uw_b728 "" RAT_FUNC "%4.2" "%/s" COEFFS 0 6.5536 0 0 0 1 /end COMPU_METHOD
/begin COMPU_METHOD rel_uw_q0p001 "" RAT_FUNC "%6.5" "%" COEFFS 0 1000 0 0 0 1 /end COMPU_METHOD
/begin COMPU_METHOD rel_uw_q0p0234 "" RAT_FUNC "%6.4" "%" COEFFS 0 32 0 0 0 0.75 /end COMPU_METHOD
/begin COMPU_METHOD rel_uw_q0p1875 "" RAT_FUNC "%6.3" "%" COEFFS 0 65536 0 0 0 12288 /end COMPU_METHOD
/begin COMPU_METHOD rkti11_sy "" RAT_FUNC "%6.5" "ms/%" COEFFS 0 9000 0 0 0 1 /end COMPU_METHOD
/begin COMPU_METHOD rkti_k_sy "" RAT_FUNC "%6.3" "%/(ms*s)" COEFFS 0 2.7962 0 0 0 1 /end COMPU_METHOD
/begin COMPU_METHOD runtime1_sy "" RAT_FUNC "%6.3" "us" COEFFS 0 1.5 0 0 0 1 /end COMPU_METHOD
/begin COMPU_METHOD runtime2_sy "" RAT_FUNC "%6.1" "us" COEFFS 0 0.09375 0 0 0 1 /end COMPU_METHOD
/begin COMPU_METHOD r_q8 "" RAT_FUNC "%6.2" "Ohm" COEFFS 0 1 0 0 0 8 /end COMPU_METHOD
/begin COMPU_METHOD r_ub_q64 "" RAT_FUNC "%6.1" "Ohm" COEFFS 0 1 0 0 0 64 /end COMPU_METHOD
/begin COMPU_METHOD r_uw_q2 "" RAT_FUNC "%6.2" "Ohm" COEFFS 0 1 0 0 0 2 /end COMPU_METHOD
/begin COMPU_METHOD spg_q0p00039 "" RAT_FUNC "%6.5" "V" COEFFS 0 1 0 0 0 0.000390625 /end COMPU_METHOD
/begin COMPU_METHOD spg_q0p00977 "" RAT_FUNC "%6.4" "V" COEFFS 0 256 0 0 0 2.5 /end COMPU_METHOD
/begin COMPU_METHOD spg_q0p03125 "" RAT_FUNC "%6.4" "V" COEFFS 0 256 0 0 0 8 /end COMPU_METHOD
/begin COMPU_METHOD spg_q1o200 "" RAT_FUNC "%6.3" "mV" COEFFS 0 1 200 0 0 1 /end COMPU_METHOD
/begin COMPU_METHOD spg_ubatt "" RAT_FUNC "%6.4" "V" COEFFS 0 1 0 0 0 0.0704 /end COMPU_METHOD
/begin COMPU_METHOD spg_ub_q0p0052_o0p2 "" RAT_FUNC "%6.3" "V" COEFFS 0 255 51 0 0 1.33 /end COMPU_METHOD
/begin COMPU_METHOD spg_ub_q0p019 "" RAT_FUNC "%6.4" "V" COEFFS 0 256 0 0 0 5 /end COMPU_METHOD
/begin COMPU_METHOD spg_uw_q0p00488 "" RAT_FUNC "%6.4" "V" COEFFS 0 1024 0 0 0 5 /end COMPU_METHOD
/begin COMPU_METHOD spg_uw_q0p00488_o1 "" RAT_FUNC "%6.3" "V" COEFFS 0 1024 1024 0 0 5 /end COMPU_METHOD
/begin COMPU_METHOD s_q63p75mm "" RAT_FUNC "%6.3" "mm" COEFFS 0 1 0 0 0 0.25 /end COMPU_METHOD
/begin COMPU_METHOD t100msxs_ub_b25p5 "" RAT_FUNC "%6.3" "s" COEFFS 0 1 0 0 0 0.1 /end COMPU_METHOD
/begin COMPU_METHOD t10msxs_ub_b2p55 "" RAT_FUNC "%6.4" "s" COEFFS 0 1 0 0 0 0.01 /end COMPU_METHOD
/begin COMPU_METHOD t10msxs_uw_b655p35 "" RAT_FUNC "%6.4" "s" COEFFS 0 1 0 0 0 0.01 /end COMPU_METHOD
/begin COMPU_METHOD t1msxms_q1 "" RAT_FUNC "%6.2" "ms" COEFFS 0 1 0 0 0 1 /end COMPU_METHOD
/begin COMPU_METHOD t1sxs_ub_b255 "" RAT_FUNC "%6.2" "s" COEFFS 0 1 0 0 0 1 /end COMPU_METHOD
/begin COMPU_METHOD t1sxs_uw_b65535 "" RAT_FUNC "%6.2" "s" COEFFS 0 1 0 0 0 1 /end COMPU_METHOD
/begin COMPU_METHOD t1sxs_uw_q1 "" RAT_FUNC "%6.2" "s" COEFFS 0 1 0 0 0 1 /end COMPU_METHOD
/begin COMPU_METHOD t20msxs_ub_b5p1 "" RAT_FUNC "%6.4" "s" COEFFS 0 1 0 0 0 0.02 /end COMPU_METHOD
/begin COMPU_METHOD t40msxs_ub_q0p04 "" RAT_FUNC "%6.4" "s" COEFFS 0 1 0 0 0 0.04 /end COMPU_METHOD
/begin COMPU_METHOD t40ms_ub_b10200 "" RAT_FUNC "%7.2" "ms" COEFFS 0 1 0 0 0 40 /end COMPU_METHOD
/begin COMPU_METHOD t500usxms_ub_q0p5 "" RAT_FUNC "%6.3" "ms" COEFFS 0 1 0 0 0 0.5 /end COMPU_METHOD
/begin COMPU_METHOD t50msxs_ub_b12p75 "" RAT_FUNC "%6.4" "s" COEFFS 0 1 0 0 0 0.05 /end COMPU_METHOD
/begin COMPU_METHOD t5usxus_q5 "" RAT_FUNC "%6.2" "us" COEFFS 0 1 0 0 0 5 /end COMPU_METHOD
/begin COMPU_METHOD t6minxmin_q6 "" RAT_FUNC "%6.2" "min" COEFFS 0 1 0 0 0 6 /end COMPU_METHOD
/begin COMPU_METHOD temp_q0p0234_o273 "" RAT_FUNC "%6.1" "Grad C" COEFFS 0 1 273.15 0 0 0.0234375 /end COMPU_METHOD
/begin COMPU_METHOD temp_sb_q0p75 "" RAT_FUNC "%6.3" "Grad C" COEFFS 0 1 0 0 0 0.75 /end COMPU_METHOD
/begin COMPU_METHOD temp_ub_b191p25 "" RAT_FUNC "%6.3" "Grad C" COEFFS 0 1 0 0 0 0.75 /end COMPU_METHOD
/begin COMPU_METHOD temp_ub_q0p75_o48 "" RAT_FUNC "%6.2" "Grad C" COEFFS 0 1 48 0 0 0.75 /end COMPU_METHOD
/begin COMPU_METHOD temp_ub_q1_o60 "" RAT_FUNC "%6.2" "Grad C" COEFFS 0 1 60 0 0 1 /end COMPU_METHOD
/begin COMPU_METHOD temp_ub_q5_o50 "" RAT_FUNC "%6.2" "Grad C" COEFFS 0 1 50 0 0 5 /end COMPU_METHOD
/begin COMPU_METHOD temp_uw_q0p0195_o50 "" RAT_FUNC "%6.2" "Grad C" COEFFS 0 256 12800 0 0 5 /end COMPU_METHOD
/begin COMPU_METHOD tv_q0p001028 "" RAT_FUNC "%6.4" "%" COEFFS 0 1 0 0 0 0.001028 /end COMPU_METHOD
/begin COMPU_METHOD tv_sw_q0p005 "" RAT_FUNC "%6.4" "%" COEFFS 0 1 0 0 0 0.005 /end COMPU_METHOD
/begin COMPU_METHOD tv_ub_b100 "" RAT_FUNC "%6.3" "%" COEFFS 0 256 0 0 0 100 /end COMPU_METHOD
/begin COMPU_METHOD tv_ub_q0p64 "" RAT_FUNC "%6.3" "%" COEFFS 0 100 0 0 0 64 /end COMPU_METHOD
/begin COMPU_METHOD txms_ub_q0p1 "" RAT_FUNC "%6.3" "ms" COEFFS 0 10 0 0 0 1 /end COMPU_METHOD
/begin COMPU_METHOD uefktget_ub_b25p4 "" RAT_FUNC "%6.3" "" COEFFS 0 10 0 0 0 1 /end COMPU_METHOD
/begin COMPU_METHOD vfzg_ub_q1p25 "" RAT_FUNC "%6.2" "km/h" COEFFS 0 1 0 0 0 1.25 /end COMPU_METHOD
/begin COMPU_METHOD vfzg_uw_q0p0078125 "" RAT_FUNC "%6.4" "km/h" COEFFS 0 1 0 0 0 0.0078125 /end COMPU_METHOD
/begin COMPU_METHOD volgrd_q5p96Em4 "" RAT_FUNC "%6.5" "mL/s" COEFFS 0 65536 0 0 0 39.0625 /end COMPU_METHOD
/begin COMPU_METHOD zk10msxs_uw_b655 "" RAT_FUNC "%12.5" "s" COEFFS 0 0 65536 0 100 0 /end COMPU_METHOD
/begin COMPU_METHOD zk20msxs_ub_b5p1 "" RAT_FUNC "%6.4" "s" COEFFS 0 0 5.1 0 1 0 /end COMPU_METHOD
/begin COMPU_METHOD zw_sb_q0p75 "" RAT_FUNC "%6.3" "grad KW" COEFFS 0 255 0 0 0 191.25 /end COMPU_METHOD
/begin COMPU_METHOD zw_sb_q6 "" RAT_FUNC "%6.2" "Grad KW" COEFFS 0 1 0 0 0 6 /end COMPU_METHOD
/begin COMPU_METHOD zw_ub_q0p75 "" RAT_FUNC "%6.3" "Grad KW" COEFFS 0 255 0 0 0 191.25 /end COMPU_METHOD
/begin COMPU_METHOD zw_ub_q6 "" RAT_FUNC "%6.2" "Grad KW" COEFFS 0 255 0 0 0 1530 /end COMPU_METHOD
/begin COMPU_METHOD zw_ub_qn0p75 "" RAT_FUNC "%6.4" "grad KW" COEFFS 0 1 0 0 0 -0.75 /end COMPU_METHOD
/begin RECORD_LAYOUT FklWSb FNC_VALUES 1 SBYTE COLUMN_DIR DIRECT /end RECORD_LAYOUT
/begin RECORD_LAYOUT FklWUb FNC_VALUES 1 UBYTE COLUMN_DIR DIRECT /end RECORD_LAYOUT
/begin RECORD_LAYOUT FklWUw FNC_VALUES 1 UWORD COLUMN_DIR DIRECT /end RECORD_LAYOUT
/begin RECORD_LAYOUT GkfWSb FNC_VALUES 1 SBYTE COLUMN_DIR DIRECT /end RECORD_LAYOUT
/begin RECORD_LAYOUT GkfWSw FNC_VALUES 1 SWORD COLUMN_DIR DIRECT /end RECORD_LAYOUT
/begin RECORD_LAYOUT GkfWUb FNC_VALUES 1 UBYTE COLUMN_DIR DIRECT /end RECORD_LAYOUT
/begin RECORD_LAYOUT GkfWUw FNC_VALUES 1 UWORD COLUMN_DIR DIRECT /end RECORD_LAYOUT
/begin RECORD_LAYOUT GklWSb FNC_VALUES 1 SBYTE COLUMN_DIR DIRECT /end RECORD_LAYOUT
/begin RECORD_LAYOUT GklWSw FNC_VALUES 1 SWORD COLUMN_DIR DIRECT /end RECORD_LAYOUT
/begin RECORD_LAYOUT GklWUb FNC_VALUES 1 UBYTE COLUMN_DIR DIRECT /end RECORD_LAYOUT
/begin RECORD_LAYOUT GklWUw FNC_VALUES 1 UWORD COLUMN_DIR DIRECT /end RECORD_LAYOUT
/begin RECORD_LAYOUT KfAxUbAyUbSstxSbSstyUbWUb NO_AXIS_PTS_X 1 UBYTE NO_AXIS_PTS_Y 2 UBYTE AXIS_PTS_X 3 SBYTE INDEX_INCR DIRECT AXIS_PTS_Y 4 UBYTE INDEX_INCR DIRECT FNC_VALUES 5 UBYTE COLUMN_DIR DIRECT /end RECORD_LAYOUT
/begin RECORD_LAYOUT KfAxUbAyUbSstxSwSstyUbWSw NO_AXIS_PTS_X 1 UBYTE NO_AXIS_PTS_Y 2 UBYTE AXIS_PTS_X 3 SWORD INDEX_INCR DIRECT AXIS_PTS_Y 4 UBYTE INDEX_INCR DIRECT FNC_VALUES 5 SWORD COLUMN_DIR DIRECT /end RECORD_LAYOUT
/begin RECORD_LAYOUT KfAxUbAyUbSstxSwSstyUbWUw NO_AXIS_PTS_X 1 UBYTE NO_AXIS_PTS_Y 2 UBYTE AXIS_PTS_X 3 SWORD INDEX_INCR DIRECT AXIS_PTS_Y 4 UBYTE INDEX_INCR DIRECT FNC_VALUES 5 UWORD COLUMN_DIR DIRECT /end RECORD_LAYOUT
/begin RECORD_LAYOUT KfAxUbAyUbSstxUbSstyUbWSb NO_AXIS_PTS_X 1 UBYTE NO_AXIS_PTS_Y 2 UBYTE AXIS_PTS_X 3 UBYTE INDEX_INCR DIRECT AXIS_PTS_Y 4 UBYTE INDEX_INCR DIRECT FNC_VALUES 5 SBYTE COLUMN_DIR DIRECT /end RECORD_LAYOUT
/begin RECORD_LAYOUT KfAxUbAyUbSstxUbSstyUbWUb NO_AXIS_PTS_X 1 UBYTE NO_AXIS_PTS_Y 2 UBYTE AXIS_PTS_X 3 UBYTE INDEX_INCR DIRECT AXIS_PTS_Y 4 UBYTE INDEX_INCR DIRECT FNC_VALUES 5 UBYTE COLUMN_DIR DIRECT /end RECORD_LAYOUT
/begin RECORD_LAYOUT KfAxUbAyUbSstxUbSstyUwWUb NO_AXIS_PTS_X 1 UBYTE NO_AXIS_PTS_Y 2 UBYTE AXIS_PTS_X 3 UBYTE INDEX_INCR DIRECT AXIS_PTS_Y 4 UWORD INDEX_INCR DIRECT FNC_VALUES 5 UBYTE COLUMN_DIR DIRECT /end RECORD_LAYOUT
/begin RECORD_LAYOUT KfAxUbAyUbSstxUbSstyUwWUw NO_AXIS_PTS_X 1 UBYTE NO_AXIS_PTS_Y 2 UBYTE AXIS_PTS_X 3 UBYTE INDEX_INCR DIRECT AXIS_PTS_Y 4 UWORD INDEX_INCR DIRECT FNC_VALUES 5 UWORD COLUMN_DIR DIRECT /end RECORD_LAYOUT
/begin RECORD_LAYOUT KfAxUbAyUbSstxUwSstyUbWUb NO_AXIS_PTS_X 1 UBYTE NO_AXIS_PTS_Y 2 UBYTE AXIS_PTS_X 3 UWORD INDEX_INCR DIRECT AXIS_PTS_Y 4 UBYTE INDEX_INCR DIRECT FNC_VALUES 5 UBYTE COLUMN_DIR DIRECT /end RECORD_LAYOUT
/begin RECORD_LAYOUT KfAxUbAyUbSstxUwSstyUwWUw NO_AXIS_PTS_X 1 UWORD NO_AXIS_PTS_Y 2 UWORD AXIS_PTS_X 3 UWORD INDEX_INCR DIRECT AXIS_PTS_Y 4 UWORD INDEX_INCR DIRECT FNC_VALUES 5 UWORD COLUMN_DIR DIRECT /end RECORD_LAYOUT
/begin RECORD_LAYOUT KfAxUwAyUwSstxSwSstyUwWUw NO_AXIS_PTS_X 1 UWORD NO_AXIS_PTS_Y 2 UWORD AXIS_PTS_X 3 SWORD INDEX_INCR DIRECT AXIS_PTS_Y 4 UWORD INDEX_INCR DIRECT FNC_VALUES 5 UWORD COLUMN_DIR DIRECT /end RECORD_LAYOUT
/begin RECORD_LAYOUT KfAxUwAyUwSstxUwSstyUwWSw NO_AXIS_PTS_X 1 UWORD NO_AXIS_PTS_Y 2 UWORD AXIS_PTS_X 3 UWORD INDEX_INCR DIRECT AXIS_PTS_Y 4 UWORD INDEX_INCR DIRECT FNC_VALUES 5 SWORD COLUMN_DIR DIRECT /end RECORD_LAYOUT
/begin RECORD_LAYOUT KfAxUwAyUwSstxUwSstyUwWUw NO_AXIS_PTS_X 1 UWORD NO_AXIS_PTS_Y 2 UWORD AXIS_PTS_X 3 UWORD INDEX_INCR DIRECT AXIS_PTS_Y 4 UWORD INDEX_INCR DIRECT FNC_VALUES 5 UWORD COLUMN_DIR DIRECT /end RECORD_LAYOUT
/begin RECORD_LAYOUT KlASwSstSwWSw NO_AXIS_PTS_X 1 SWORD AXIS_PTS_X 2 SWORD INDEX_INCR DIRECT FNC_VALUES 3 SWORD COLUMN_DIR DIRECT /end RECORD_LAYOUT
/begin RECORD_LAYOUT KlAUbSstUbWSb NO_AXIS_PTS_X 1 UBYTE AXIS_PTS_X 2 UBYTE INDEX_INCR DIRECT FNC_VALUES 3 SBYTE COLUMN_DIR DIRECT /end RECORD_LAYOUT
/begin RECORD_LAYOUT KlAUbSstUbWUb NO_AXIS_PTS_X 1 UBYTE AXIS_PTS_X 2 UBYTE INDEX_INCR DIRECT FNC_VALUES 3 UBYTE COLUMN_DIR DIRECT /end RECORD_LAYOUT
/begin RECORD_LAYOUT KlAUbSstUbWUw NO_AXIS_PTS_X 1 UBYTE AXIS_PTS_X 2 UBYTE INDEX_INCR DIRECT FNC_VALUES 3 UWORD COLUMN_DIR DIRECT /end RECORD_LAYOUT
/begin RECORD_LAYOUT KlAUbSstUwWUb NO_AXIS_PTS_X 1 UWORD AXIS_PTS_X 2 UWORD INDEX_INCR DIRECT FNC_VALUES 3 UBYTE COLUMN_DIR DIRECT /end RECORD_LAYOUT
/begin RECORD_LAYOUT KlAUbSstUwWUw NO_AXIS_PTS_X 1 UWORD AXIS_PTS_X 2 UWORD INDEX_INCR DIRECT FNC_VALUES 3 UWORD COLUMN_DIR DIRECT /end RECORD_LAYOUT
/begin RECORD_LAYOUT KlAUwSstUwWUb NO_AXIS_PTS_X 1 UWORD AXIS_PTS_X 2 UWORD INDEX_INCR DIRECT FNC_VALUES 3 UBYTE COLUMN_DIR DIRECT /end RECORD_LAYOUT
/begin RECORD_LAYOUT KlAUwSstUwWUw NO_AXIS_PTS_X 1 UWORD AXIS_PTS_X 2 UWORD INDEX_INCR DIRECT FNC_VALUES 3 UWORD COLUMN_DIR DIRECT /end RECORD_LAYOUT
/begin RECORD_LAYOUT KwbUb FNC_VALUES 1 UBYTE COLUMN_DIR DIRECT /end RECORD_LAYOUT
/begin RECORD_LAYOUT KwbUw FNC_VALUES 1 UWORD COLUMN_DIR DIRECT /end RECORD_LAYOUT
/begin RECORD_LAYOUT KwSb FNC_VALUES 1 SBYTE COLUMN_DIR DIRECT /end RECORD_LAYOUT
/begin RECORD_LAYOUT KwSw FNC_VALUES 1 SWORD COLUMN_DIR DIRECT /end RECORD_LAYOUT
/begin RECORD_LAYOUT KwUb FNC_VALUES 1 UBYTE COLUMN_DIR DIRECT /end RECORD_LAYOUT
/begin RECORD_LAYOUT KwUw FNC_VALUES 1 UWORD COLUMN_DIR DIRECT /end RECORD_LAYOUT
/begin RECORD_LAYOUT SstAUbSstSb NO_AXIS_PTS_X 1 UBYTE AXIS_PTS_X 2 SBYTE INDEX_INCR DIRECT /end RECORD_LAYOUT
/begin RECORD_LAYOUT SstAUbSstUb NO_AXIS_PTS_X 1 UBYTE AXIS_PTS_X 2 UBYTE INDEX_INCR DIRECT /end RECORD_LAYOUT
/begin RECORD_LAYOUT SstAUwSstUw NO_AXIS_PTS_X 1 UWORD AXIS_PTS_X 2 UWORD INDEX_INCR DIRECT /end RECORD_LAYOUT
/end MODULE
/end PROJECT
