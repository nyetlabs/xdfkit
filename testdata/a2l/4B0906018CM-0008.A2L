ASAP2_VERSION 1 3
/begin PROJECT X505P_24HG_1 "X505P"
/begin HEADER "" VERSION "X505P_24HG_1" PROJECT_NO X505P_24HG_1 /end HEADER
/begin MODULE DIM ""
/begin MOD_COMMON "" BYTE_ORDER MSB_LAST ALIGNMENT_BYTE 1 ALIGNMENT_WORD 2 ALIGNMENT_LONG 2 /end MOD_COMMON
/begin CHARACTERISTIC AIMVM "Anzahl Geschwindigkeitsimpulse pro m für Normierung v-Signal" VALUE 0x813A76 KwUw 9.999000 fak_uw_q0p001 0.001000000 10.00000 FORMAT "%8.5" /end CHARACTERISTIC
/begin CHARACTERISTIC ANZRIBEH "Anzahl der Ri-Berechnungen hinter KAT" VALUE 0x810BAD KwUb 255.0 dez 0.00 255.0 FORMAT "%5.1" /end CHARACTERISTIC
/begin CHARACTERISTIC CWBWEEN "Codewort zur Deaktivierung der Bewegungserkennung" VALUE 0x810BD0 KwUb 255.0 dez 0.00 255.0 FORMAT "%5.1" /end CHARACTERISTIC
/begin CHARACTERISTIC CWGGLSH "Codeword für Ri-Auswertung für Sonde hinter KAT" VALUE 0x818647 KwUb 255.0 dez 0.00 255.0 FORMAT "%5.1" /end CHARACTERISTIC
/begin CHARACTERISTIC CWGGLSU "Codewort für GGLSU" VALUE 0x810BB7 KwUb 255.0 dez 0.00 255.0 FORMAT "%5.1" /end CHARACTERISTIC
/begin CHARACTERISTIC CWGGPBKV "Codewort für Bremskraftverstärker Funktion GGPBKV" VALUE 0x8127CA KwUb 255.0 dez 0.00 255.0 FORMAT "%5.1" /end CHARACTERISTIC
/begin CHARACTERISTIC CWGGVFZG "Codewort für %GGVFZG" VALUE 0x810BC5 KwUb 255.0 dez 0.00 255.0 FORMAT "%5.1" /end CHARACTERISTIC
/begin CHARACTERISTIC CWHLSU "Codewort Heizung LSU" VALUE 0x81A1EC KwUb 255.0 dez 0.00 255.0 FORMAT "%5.1" /end CHARACTERISTIC
/begin CHARACTERISTIC CWKHMD "Codewort für Drehmomentenreserve bei Katheizen" VALUE 0x819734 KwUb 255.0 dez 0.00 255.0 FORMAT "%5.1" /end CHARACTERISTIC
/begin CHARACTERISTIC CWKONGTM "Codewort für Konfiguration Größe Temperatur Motor TMOT" VALUE 0x8196BC KwUb 255.0 dez 0.00 255.0 FORMAT "%5.1" /end CHARACTERISTIC
/begin CHARACTERISTIC CWKRAPP "Codewort für Applikation KR" VALUE 0x81975C KwUb 255.0 dez 0.00 255.0 FORMAT "%5.1" /end CHARACTERISTIC
/begin CHARACTERISTIC CWKVHR "Codewort für Komponenten-Versorgungsspannung über Hauptrelais" VALUE 0x81C572 KwUw 65535.00 dez 0.00 65535.00 FORMAT "%8.2" /end CHARACTERISTIC
/begin CHARACTERISTIC CWUM_ZDG "" VALUE 0x8196F3 KwUb 20.00 dez 0.00 20.00 FORMAT "%5.2" /end CHARACTERISTIC
/begin CHARACTERISTIC CW_TABST "Codewort: Berücksichtigung Abstellzeit bei Initialisierung Ersatzwert tmot" VALUE 0x8196BD KwUb 255.0 dez 0.00 255.0 FORMAT "%5.1" /end CHARACTERISTIC
/begin CHARACTERISTIC DKROKD "Obere Drehzahlschwelle für Nulltest-Diagnose Klopfregelung" VALUE 0x81975D KwUb 10200. nmot_ub_q40 0.00 10200. FORMAT "%5.0" /end CHARACTERISTIC
/begin CHARACTERISTIC DKROKMX "Maximaler Offsetkompensationswert" VALUE 0x81153E KwUb 4.980 spg_ub_b5 0.00 4.980 FORMAT "%5.3" /end CHARACTERISTIC
/begin CHARACTERISTIC DKROKO "Obere Drehzahlschwelle für Ermittlung Offsetkompensationswert" VALUE 0x81975E KwUb 10200. nmot_ub_q40 0.00 10200. FORMAT "%5.0" /end CHARACTERISTIC
/begin CHARACTERISTIC DPBKVBBG "Faktor Druckgradient am Beginn einer Bremsung" VALUE 0x829034 KwUw 7.999878 fak_uw_b8 0.00 7.999878 FORMAT "%8.6" /end CHARACTERISTIC
/begin CHARACTERISTIC DPBKVBSGV0 "Faktor Druckgradient während Bremsung bei v=0" VALUE 0x829036 KwUw 7.999878 fak_uw_b8 0.00 7.999878 FORMAT "%8.6" /end CHARACTERISTIC
/begin CHARACTERISTIC DPBKVBSGVS "Faktor Druckgradient während Bremsung bei v>Schwelle" VALUE 0x829038 KwUw 7.999878 fak_uw_b8 0.00 7.999878 FORMAT "%8.6" /end CHARACTERISTIC
/begin CHARACTERISTIC DPBKVEBG "Faktor Druckgradient am Ende einer Bremsung" VALUE 0x82903A KwUw 7.999878 fak_uw_b8 0.00 7.999878 FORMAT "%8.6" /end CHARACTERISTIC
/begin CHARACTERISTIC DPBKVEBGVS "Faktor Druckgradient am Ende einer Bremsung bei vfzg>Schwelle" VALUE 0x82903C KwUw 7.999878 fak_uw_b8 0.00 7.999878 FORMAT "%8.6" /end CHARACTERISTIC
/begin CHARACTERISTIC DPBKVEVK "Faktor Druckgradient während Evakuierung des Bremskraftverstärkers" VALUE 0x82903E KwUw 15.99976 fak_uw_b16 0.00 15.99976 FORMAT "%8.5" /end CHARACTERISTIC
/begin CHARACTERISTIC DPBKVEVKEP "Fak. Druckgrad. während Evakuierung des Bremskraftverstärkers durch el. Pumpe" VALUE 0x829040 KwUw 15.99976 fak_uw_b16 0.00 15.99976 FORMAT "%8.5" /end CHARACTERISTIC
/begin CHARACTERISTIC DPBKVEVKSP "Fak. Druckgrad. während Evakuierung des BKV durch Saugstrahlpumpe" VALUE 0x829042 KwUw 15.99976 fak_uw_b16 0.00 15.99976 FORMAT "%8.5" /end CHARACTERISTIC
/begin CHARACTERISTIC DPBKVSTG "Faktor Druckgradient durch Undichtigkeit des Bremskraftverstärkers" VALUE 0x829044 KwUw 7.999878 fak_uw_b8 0.00 7.999878 FORMAT "%8.6" /end CHARACTERISTIC
/begin CHARACTERISTIC DSBGRAD "Gradient für Drucksensor Bremskraftverstärker" VALUE 0x829046 KwUw 1023.984 fak_uw_b1024 0.00 1023.984 FORMAT "%8.3" /end CHARACTERISTIC
/begin CHARACTERISTIC DSBOFS "Offset Drucksensor Bremskraftverstärker" VALUE 0x829048 KwSw 2559.961 p_sw_q0p039 -1280.000 1279.961 FORMAT "%8.3" /end CHARACTERISTIC
/begin CHARACTERISTIC DTASWEMN "Delta Tastverhältnis ABS Schlechtwegsignal" VALUE 0x81378E KwSw 49.99847 rel_sw_b50 0.00 49.99847 FORMAT "%8.5" /end CHARACTERISTIC
/begin CHARACTERISTIC DTMABDTMN "Min. Differenz Motortemperatur zwischen Abstellen und Neustart für Diagnose TMOT" VALUE 0x8196BE KwUb 191.3 temp_ub_b191p25 0.00 191.3 FORMAT "%5.1" /end CHARACTERISTIC
/begin CHARACTERISTIC DTMDMA "Abstand Motortemperaturmodell zur Starttemperatur" VALUE 0x8196BF KwUb 191.3 temp_ub_b191p25 0.00 191.3 FORMAT "%5.1" /end CHARACTERISTIC
/begin CHARACTERISTIC DTMDNPO "Abstand Motortemperaturmodell zur oberen Unplausibilitätsschwelle" VALUE 0x8196C0 KwUb 191.3 temp_ub_b191p25 0.00 191.3 FORMAT "%5.1" /end CHARACTERISTIC
/begin CHARACTERISTIC DTMSRT "Delta Motortemp.zu Starttemp. f.Retrigg. Modelle (Blockheater-Erkennung)" VALUE 0x8196C1 KwUb 191.3 temp_ub_b191p25 0.00 191.3 FORMAT "%5.1" /end CHARACTERISTIC
/begin CHARACTERISTIC DUPW12 "Zulässige Spannungsabweichung zwischen PWG-Poti 1 und 2" VALUE 0x810BD1 KwUb 4.980 spg_ub_b5 0.00 4.980 FORMAT "%5.3" /end CHARACTERISTIC
/begin CHARACTERISTIC DUPW12BE "notweniger Spannungsweg von Poti 2 zur Bewegungserkennung" VALUE 0x813ABC KwUw 4.995117 spg_uw_q0p00488 0.00 4.995117 FORMAT "%8.6" /end CHARACTERISTIC
/begin CHARACTERISTIC DUPW12TG "Zulässige Spannungsabweichung zwischen PWG Poti 1 und  2 im Teilgasbereich" VALUE 0x810BD2 KwUb 4.980 spg_ub_b5 0.00 4.980 FORMAT "%5.3" /end CHARACTERISTIC
/begin CHARACTERISTIC DUPW12VG "Zulässige Spannungsabweichung zwischen PWG-Poti 1 und 2 im Vollgasbereich" VALUE 0x810BD3 KwUb 4.980 spg_ub_b5 0.00 4.980 FORMAT "%5.3" /end CHARACTERISTIC
/begin CHARACTERISTIC DUPWGHY "Spannungshysterese bei Entjitterung der PWG-Spannung" VALUE 0x813ABE KwUw 4.995117 spg_uw_q0p00488 0.00 4.995117 FORMAT "%8.6" /end CHARACTERISTIC
/begin CHARACTERISTIC DUSRIH "Delta Sondenspannung hinter Kat zwischen Neu-und Altwert  für Ri-Messung" VALUE 0x813988 KwSw 319.9951 spg_sw_q0p00488 -160.0000 159.9951 FORMAT "%8.4" /end CHARACTERISTIC
/begin CHARACTERISTIC DUSSPH "Delta Sondensp. hinter Kat zwischen Neu-und 2 Altwerten für Sonden Sprungmessung" VALUE 0x81398A KwSw 319.9951 spg_sw_q0p00488 -160.0000 159.9951 FORMAT "%8.4" /end CHARACTERISTIC
/begin CHARACTERISTIC DVFZBEG "Delta-Geschwindigkeit für Änderungsbegrenzung" VALUE 0x813A78 KwUw 511.9922 vfzg_uw_b512 0.00 511.9922 FORMAT "%8.4" /end CHARACTERISTIC
/begin CHARACTERISTIC DWPMXNB "Maximal zulässige Pedalwerterhöhung pro Rechenschritt nach Bremsbetätigung" VALUE 0x813AC0 KwUw 100.0000 relPED_uw_b100 0.00 100.0000 FORMAT "%8.4" /end CHARACTERISTIC
/begin CHARACTERISTIC DWPMXNOT "Maximal zulässige Pedalwerterhöhung pro Rechenschritt im PWG-Ersatzbetrieb" VALUE 0x813AC2 KwUw 100.0000 relPED_uw_b100 0.00 100.0000 FORMAT "%8.4" /end CHARACTERISTIC
/begin CHARACTERISTIC DWPOPBP "Pedalgradient zur Deaktivierung der PWG/Brems-Plaus." VALUE 0x813AC4 KwUw 100.0000 relPED_uw_b100 0.00 100.0000 FORMAT "%8.4" /end CHARACTERISTIC
/begin CHARACTERISTIC DWPPBP "Pedalwerterniedrigung pro Rechenschritt bei Plausibilität Bremse/PWG" VALUE 0x813AC6 KwUw 100.0000 relPED_uw_b100 0.00 100.0000 FORMAT "%8.4" /end CHARACTERISTIC
/begin CHARACTERISTIC FABSTT "Faktor Abstellzeit für Modelltemperatur" CURVE 0x81DDF2 KlAUwSstUwWUw 1.999969 fak_uw_b2 0.00 1.999969 FORMAT "%8.6"
 /begin AXIS_DESCR STD_AXIS tabst_w t1sxs_uw_q1 5 0.00 65535.00 FORMAT "%8.2" DEPOSIT ABSOLUTE /end AXIS_DESCR
/end CHARACTERISTIC
/begin CHARACTERISTIC FBKVP "Faktor zur Berechnung des min. Pumpdrucks abhängig von Umgebungsdruck" VALUE 0x82904A KwUw 1.999969 fak_uw_b2 0.00 1.999969 FORMAT "%8.6" /end CHARACTERISTIC
/begin CHARACTERISTIC FLAMPA "Druck-Korrekturfaktor für Lambda" CURVE 0x8139B0 KlAUwSstUwWUw 1.999969 fak_uw_b2 0.00 1.999969 FORMAT "%8.6"
 /begin AXIS_DESCR STD_AXIS palsu_w p_uw_q0p039 10 0.00 2559.961 FORMAT "%8.3" DEPOSIT ABSOLUTE /end AXIS_DESCR
/end CHARACTERISTIC
/begin CHARACTERISTIC FLSUIP "Faktor für Umrechnung Spannung in Pumpstrom" VALUE 0x8139DA KwUw 204.7969 leit_q3p125Em6 0.00 204.7969 FORMAT "%8.4" /end CHARACTERISTIC
/begin CHARACTERISTIC FMDKHFH "Höhenkorrektur Drehmomentenreserve für Katheizen" CURVE 0x81E1F8 KlAUwSstUwWUw 1.999969 fak_uw_b2 0.00 1.999969 FORMAT "%8.6"
 /begin AXIS_DESCR STD_AXIS fho_w fak_uw_b4 4 0.00 3.999939 FORMAT "%8.6" DEPOSIT ABSOLUTE /end AXIS_DESCR
/end CHARACTERISTIC
/begin CHARACTERISTIC FMDKHTMST "tmst-Korrektur Drehmomentenresrve für Katheizen" CURVE 0x819735 KlAUbSstUbWUb 1.992 fak_ub_b2 0.00 1.992 FORMAT "%5.3"
 /begin AXIS_DESCR STD_AXIS tmst temp_ub_q0p75_o48 8 -48.00 143.3 FORMAT "%5.1" DEPOSIT ABSOLUTE /end AXIS_DESCR
/end CHARACTERISTIC
/begin CHARACTERISTIC FMDPUBKV "Abregelungsfaktor für Momentenreserve bei Katheizen und leeren BKV" CURVE 0x81E20A KlAUwSstUwWUb 0.9961 fak_ub_b1 0.00 0.9961
 /begin AXIS_DESCR STD_AXIS pubkv_w p_uw_q0p039 6 0.00 2559.961 FORMAT "%8.3" DEPOSIT ABSOLUTE /end AXIS_DESCR
/end CHARACTERISTIC
/begin CHARACTERISTIC FMFKRB0 "Filtermittenfrequenz Bereich 0" VALUE 0x81975F KwUb 255.0 fmfkr_dez 0.00 255.0 FORMAT "%5.1" /end CHARACTERISTIC
/begin CHARACTERISTIC FMFKRB1 "Filtermittenfrequenz Bereich 1" VALUE 0x819760 KwUb 255.0 fmfkr_dez 0.00 255.0 FORMAT "%5.1" /end CHARACTERISTIC
/begin CHARACTERISTIC FMFKRB2 "Filtermittenfrequenz Bereich 2" VALUE 0x819761 KwUb 255.0 fmfkr_dez 0.00 255.0 FORMAT "%5.1" /end CHARACTERISTIC
/begin CHARACTERISTIC FMFKRB3 "Filtermittenfrequenz Bereich 3" VALUE 0x819762 KwUb 255.0 fmfkr_dez 0.00 255.0 FORMAT "%5.1" /end CHARACTERISTIC
/begin CHARACTERISTIC FRINOF "Faktor für Bewertung alter Ri-Wert ohne Filter" VALUE 0x810BAE KwUb 15.94 fak_ub_b16 0.00 15.94 FORMAT "%5.2" /end CHARACTERISTIC
/begin CHARACTERISTIC HLSUKORMX "Maximalwert des Korrekturfaktors für die  LSU-Heizleistung" VALUE 0x81A1ED KwUb 1.992 fak_ub_b2 0.00 1.992 FORMAT "%5.3" /end CHARACTERISTIC
/begin CHARACTERISTIC KAFPBKVPU "Korrektur Ausfluß abh. von pbkvmod_w/pubkv_w" CURVE 0x82904C KlAUwSstUwWUw 1.999969 fak_uw_b2 0.00 1.999969 FORMAT "%8.6"
 /begin AXIS_DESCR STD_AXIS pbkvmpu_w fak_uw_b2 4 0.00 1.999969 FORMAT "%8.6" DEPOSIT ABSOLUTE /end AXIS_DESCR
/end CHARACTERISTIC
/begin CHARACTERISTIC KEDNEG "Wert für die Reduzierung der Einschaltdauer LSU-Heizung nach Start" VALUE 0x811FD6 KwUb 99.22 tgrad_ub_b99p6 0.3906 99.61 FORMAT "%5.2" /end CHARACTERISTIC
/begin CHARACTERISTIC KEDPOS "Wert für die Vergrößerung der Einschaltdauer LSU-Heizung nach Start" VALUE 0x811FD7 KwUb 99.22 tgrad_ub_b99p6 0.3906 99.61 FORMAT "%5.2" /end CHARACTERISTIC
/begin CHARACTERISTIC KEMLN "Messfensterlänge für Klopfregelung" CURVE 0x819763 GklWUb 191.3 zw_ub_q0p75 0.00 191.3 FORMAT "%5.1"
 /begin AXIS_DESCR COM_AXIS nmot nmot_ub_q40 16 0.00 10200. AXIS_PTS_REF SNM16KRUB /end AXIS_DESCR
/end CHARACTERISTIC
/begin CHARACTERISTIC KFBBLSU "Kennfeld für B_sbblsu" MAP 0x8139DC KfAxUbAyUbSstxUbSstyUwWUb 25.50 t100msxs_ub_b25p5 0.00 25.50 FORMAT "%5.2"
 /begin AXIS_DESCR STD_AXIS ub spg_ubatt 4 0.00 17.95 FORMAT "%5.2" DEPOSIT ABSOLUTE /end AXIS_DESCR
 /begin AXIS_DESCR STD_AXIS lamsons_w fak_uw_b16 5 0.00 15.99976 FORMAT "%8.5" DEPOSIT ABSOLUTE /end AXIS_DESCR
/end CHARACTERISTIC
/begin CHARACTERISTIC KFDTMRS "Kennfeld Motortemperatur-Gradient im Schub für Referenzmodell" MAP 0x81DE08 KfAxUbAyUbSstxUbSstyUbWSb 0.1868 temp_sb_b0p093 -0.09375 0.09302 FORMAT "%7.5"
 /begin AXIS_DESCR STD_AXIS mll1 m_ub_b1020 5 0.00 1020. FORMAT "%5.0" DEPOSIT ABSOLUTE /end AXIS_DESCR
 /begin AXIS_DESCR STD_AXIS tmrw temp_ub_q0p75_o48 4 -48.00 143.3 FORMAT "%5.1" DEPOSIT ABSOLUTE /end AXIS_DESCR
/end CHARACTERISTIC
/begin CHARACTERISTIC KFDTMTE "Kennfeld Motortemperaturgradient für Ersatztemperatur" MAP 0x81DE28 KfAxUbAyUbSstxUbSstyUbWSb 0.1868 temp_sb_b0p093 -0.09375 0.09302 FORMAT "%7.5"
 /begin AXIS_DESCR STD_AXIS mll1 m_ub_b1020 5 0.00 1020. FORMAT "%5.0" DEPOSIT ABSOLUTE /end AXIS_DESCR
 /begin AXIS_DESCR STD_AXIS tmew temp_ub_q0p75_o48 4 -48.00 143.3 FORMAT "%5.1" DEPOSIT ABSOLUTE /end AXIS_DESCR
/end CHARACTERISTIC
/begin CHARACTERISTIC KFDTMTR "Kennfeld Motortemperaturgradient für Referenztemperatur" MAP 0x81DE48 KfAxUbAyUbSstxUbSstyUbWSb 0.1868 temp_sb_b0p093 -0.09375 0.09302 FORMAT "%7.5"
 /begin AXIS_DESCR STD_AXIS mll1 m_ub_b1020 5 0.00 1020. FORMAT "%5.0" DEPOSIT ABSOLUTE /end AXIS_DESCR
 /begin AXIS_DESCR STD_AXIS tmrw temp_ub_q0p75_o48 4 -48.00 143.3 FORMAT "%5.1" DEPOSIT ABSOLUTE /end AXIS_DESCR
/end CHARACTERISTIC
/begin CHARACTERISTIC KFDTMTU "Kennfeld Korrekturgradient Motortemperatur bei geringer Erwärmung" MAP 0x81DE68 KfAxUbAyUbSstxUbSstyUbWSb 0.1868 temp_sb_b0p093 -0.09375 0.09302 FORMAT "%7.5"
 /begin AXIS_DESCR STD_AXIS mll1 m_ub_b1020 5 0.00 1020. FORMAT "%5.0" DEPOSIT ABSOLUTE /end AXIS_DESCR
 /begin AXIS_DESCR STD_AXIS tumginp temp_ub_q0p75_o48 4 -48.00 143.3 FORMAT "%5.1" DEPOSIT ABSOLUTE /end AXIS_DESCR
/end CHARACTERISTIC
/begin CHARACTERISTIC KFKWTMP "Kennfeld Drehmomentenreserve für Kat warmhalten, zeitweise" MAP 0x81E21E KfAxUwAyUwSstxUwSstyUwWUw 99.99847 rel_uw_b100 0.00 99.99847 FORMAT "%8.5"
 /begin AXIS_DESCR STD_AXIS nmot_w nmot_uw_q0p25 4 0.00 16383.75 FORMAT "%8.2" DEPOSIT ABSOLUTE /end AXIS_DESCR
 /begin AXIS_DESCR STD_AXIS mifakh_w rel_uw_b100 4 0.00 99.99847 FORMAT "%8.5" DEPOSIT ABSOLUTE /end AXIS_DESCR
/end CHARACTERISTIC
/begin CHARACTERISTIC KFLAMSLS "Kennfeld Lambda-Korrektur bei Sekundärluft" MAP 0x818658 KfAxUbAyUbSstxUbSstyUbWUb 0.4980 fak_ub_b1p25_o0p75 0.7500 1.248 FORMAT "%5.3"
 /begin AXIS_DESCR STD_AXIS nmot nmot_ub_q40 8 0.00 10200. FORMAT "%5.0" DEPOSIT ABSOLUTE /end AXIS_DESCR
 /begin AXIS_DESCR STD_AXIS rl rel_ub_q0p75 8 0.00 191.3 FORMAT "%5.1" DEPOSIT ABSOLUTE /end AXIS_DESCR
/end CHARACTERISTIC
/begin CHARACTERISTIC KFLSUED "Kennfeld für die Einschaltdauer der LSU-Heizung abh. von Abgastemperatur und ml" MAP 0x81A1EE KfAxUbAyUbSstxUbSstyUbWUb 2.550 t10msxs_ub_b2p55 0.00 2.550 FORMAT "%5.3"
 /begin AXIS_DESCR STD_AXIS tabgm temp_ub_q5_o50 7 -50.00 1225. FORMAT "%5.0" DEPOSIT ABSOLUTE /end AXIS_DESCR
 /begin AXIS_DESCR STD_AXIS msabg m_ub_b1020 5 0.00 1020. FORMAT "%5.0" DEPOSIT ABSOLUTE /end AXIS_DESCR
/end CHARACTERISTIC
/begin CHARACTERISTIC KFMAKR "Kennfeld Meßfensteranfang Klopfregelung" MAP 0x819773 GkfWUb 191.3 zw_ub_q0p75 0.00 191.3 FORMAT "%5.1"
 /begin AXIS_DESCR COM_AXIS nmot nmot_ub_q40 16 0.00 10200. AXIS_PTS_REF SNM16KRUB /end AXIS_DESCR
 /begin AXIS_DESCR COM_AXIS rl rel_ub_q0p75 4 0.00 191.3 AXIS_PTS_REF SRL04KRUB /end AXIS_DESCR
/end CHARACTERISTIC
/begin CHARACTERISTIC KFMDDSLAD "Kennfeld Drehmomentenreserve bei Aktivdiagnose-Sekundärluft" MAP 0x81E252 KfAxUwAyUwSstxUwSstyUwWUw 99.99847 rel_uw_b100 0.00 99.99847 FORMAT "%8.5"
 /begin AXIS_DESCR STD_AXIS mifakh_w rel_uw_b100 4 0.00 99.99847 FORMAT "%8.5" DEPOSIT ABSOLUTE /end AXIS_DESCR
 /begin AXIS_DESCR STD_AXIS nmot_w nmot_uw_q0p25 4 0.00 16383.75 FORMAT "%8.2" DEPOSIT ABSOLUTE /end AXIS_DESCR
/end CHARACTERISTIC
/begin CHARACTERISTIC KFMDDSLFA "Kennfeld Drehmomentenreserve bei Testereingriff Sekundärluftdiagnose" MAP 0x81E286 KfAxUwAyUwSstxUwSstyUwWUw 99.99847 rel_uw_b100 0.00 99.99847 FORMAT "%8.5"
 /begin AXIS_DESCR STD_AXIS nmot_w nmot_uw_q0p25 4 0.00 16383.75 FORMAT "%8.2" DEPOSIT ABSOLUTE /end AXIS_DESCR
 /begin AXIS_DESCR STD_AXIS mifakh_w rel_uw_b100 4 0.00 99.99847 FORMAT "%8.5" DEPOSIT ABSOLUTE /end AXIS_DESCR
/end CHARACTERISTIC
/begin CHARACTERISTIC KFMDKH_0_A "Kennfeld Drehmomentenreserve für Katheizen" MAP 0x81E2BA KfAxUwAyUwSstxUwSstyUwWUw 99.99847 rel_uw_b100 0.00 99.99847 FORMAT "%8.5"
 /begin AXIS_DESCR STD_AXIS nmot_w nmot_uw_q0p25 8 0.00 16383.75 FORMAT "%8.2" DEPOSIT ABSOLUTE /end AXIS_DESCR
 /begin AXIS_DESCR STD_AXIS mifakh_w rel_uw_b100 8 0.00 99.99847 FORMAT "%8.5" DEPOSIT ABSOLUTE /end AXIS_DESCR
/end CHARACTERISTIC
/begin CHARACTERISTIC KFMDKH_1_A "Kennfeld Drehmomentenreserve für Katheizen" MAP 0x81E35E KfAxUwAyUwSstxUwSstyUwWUw 99.99847 rel_uw_b100 0.00 99.99847 FORMAT "%8.5"
 /begin AXIS_DESCR STD_AXIS nmot_w nmot_uw_q0p25 8 0.00 16383.75 FORMAT "%8.2" DEPOSIT ABSOLUTE /end AXIS_DESCR
 /begin AXIS_DESCR STD_AXIS mifakh_w rel_uw_b100 8 0.00 99.99847 FORMAT "%8.5" DEPOSIT ABSOLUTE /end AXIS_DESCR
/end CHARACTERISTIC
/begin CHARACTERISTIC KFMDKHLL_0_A "Kennfeld Drehmomentenreserve für Katheizen bei LL" MAP 0x81E402 KfAxUwAyUwSstxUwSstyUwWUw 99.99847 rel_uw_b100 0.00 99.99847 FORMAT "%8.5"
 /begin AXIS_DESCR STD_AXIS nmot_w nmot_uw_q0p25 8 0.00 16383.75 FORMAT "%8.2" DEPOSIT ABSOLUTE /end AXIS_DESCR
 /begin AXIS_DESCR STD_AXIS mifakh_w rel_uw_b100 8 0.00 99.99847 FORMAT "%8.5" DEPOSIT ABSOLUTE /end AXIS_DESCR
/end CHARACTERISTIC
/begin CHARACTERISTIC KFMDKHLL_1_A "Kennfeld Drehmomentenreserve für Katheizen bei LL" MAP 0x81E4A6 KfAxUwAyUwSstxUwSstyUwWUw 99.99847 rel_uw_b100 0.00 99.99847 FORMAT "%8.5"
 /begin AXIS_DESCR STD_AXIS nmot_w nmot_uw_q0p25 8 0.00 16383.75 FORMAT "%8.2" DEPOSIT ABSOLUTE /end AXIS_DESCR
 /begin AXIS_DESCR STD_AXIS mifakh_w rel_uw_b100 8 0.00 99.99847 FORMAT "%8.5" DEPOSIT ABSOLUTE /end AXIS_DESCR
/end CHARACTERISTIC
/begin CHARACTERISTIC KLITHMS "Kennlinie integrierte Luftmassenschwelle für Thermostat-Monitoring THM" CURVE 0x8196C2 KlAUbSstUbWUb 23.21 m_ub_b23p3 0.00 23.21 FORMAT "%5.2"
 /begin AXIS_DESCR STD_AXIS tmotlinst temp_ub_q0p75_o48 4 -48.00 143.3 FORMAT "%5.1" DEPOSIT ABSOLUTE /end AXIS_DESCR
/end CHARACTERISTIC
/begin CHARACTERISTIC KLTHMDTMS "Delta Motorstart-Temperatur für Verifikation/Heilung Thermostatdiagnose" CURVE 0x8196CB KlAUbSstUbWUb 191.3 temp_ub_b191p25 0.00 191.3 FORMAT "%5.1"
 /begin AXIS_DESCR STD_AXIS tmotlinst temp_ub_q0p75_o48 5 -48.00 143.3 FORMAT "%5.1" DEPOSIT ABSOLUTE /end AXIS_DESCR
/end CHARACTERISTIC
/begin CHARACTERISTIC LALIUS "Lambdalinearisierung, LSU-Sonde vor Katalysator" CURVE 0x813A00 KlAUwSstUwWUw 15.99976 fak_uw_b16 0.00 15.99976 FORMAT "%8.5"
 /begin AXIS_DESCR STD_AXIS usvkk_w spg_uw_q0p00488 22 0.00 319.9951 FORMAT "%8.4" DEPOSIT ABSOLUTE /end AXIS_DESCR
/end CHARACTERISTIC
/begin CHARACTERISTIC MIFAMXNOT "maximales relativ Moment im Pedal Fehler" CURVE 0x818701 KlAUbSstUbWUb 99.61 rel_ub_b99p6 0.00 99.61 FORMAT "%5.2"
 /begin AXIS_DESCR STD_AXIS nmot nmot_ub_q40 8 0.00 10200. FORMAT "%5.0" DEPOSIT ABSOLUTE /end AXIS_DESCR
/end CHARACTERISTIC
/begin CHARACTERISTIC NDABS "Drehzahlschwelle für Auswertung Schlechtweginfo" VALUE 0x8108CF KwUb 10200. nmot_ub_q40 0.00 10200. FORMAT "%5.0" /end CHARACTERISTIC
/begin CHARACTERISTIC NKRFM1 "Drehzahlschwelle für Filtermittenfrequenz Bereich 1" VALUE 0x8197B3 KwUb 10200. nmot_ub_q40 0.00 10200. FORMAT "%5.0" /end CHARACTERISTIC
/begin CHARACTERISTIC NKRFM2 "Drehzahlschwelle für Filtermittenfrequenz Bereich 2" VALUE 0x8197B4 KwUb 10200. nmot_ub_q40 0.00 10200. FORMAT "%5.0" /end CHARACTERISTIC
/begin CHARACTERISTIC NKRFM3 "Drehzahlschwelle für Filtermittenfrequenz Bereich 3" VALUE 0x8197B5 KwUb 10200. nmot_ub_q40 0.00 10200. FORMAT "%5.0" /end CHARACTERISTIC
/begin CHARACTERISTIC NWPMBBR "Mindestdrehzahl für Pedalwertbegrenzung bei betätigter Bremse" VALUE 0x810BD4 KwUb 10200. nmot_ub_q40 0.00 10200. FORMAT "%5.0" /end CHARACTERISTIC
/begin CHARACTERISTIC PADMSA "Abgasgegendruck am Sondeneinbauort LSU" CURVE 0x81C3D2 KlAUwSstUwWUw 2559.961 p_uw_q0p039 0.00 2559.961 FORMAT "%8.3"
 /begin AXIS_DESCR STD_AXIS msabg_w m_uw_b6553p5 6 0.00 6553.500 FORMAT "%8.3" DEPOSIT ABSOLUTE /end AXIS_DESCR
/end CHARACTERISTIC
/begin CHARACTERISTIC PBKVVSTGPV "Unterdruckverstärkung durch Saugstrahleffekt" CURVE 0x82905E KlAUwSstUwWUw 2559.961 p_uw_q0p039 0.00 2559.961 FORMAT "%8.3"
 /begin AXIS_DESCR STD_AXIS dpspvdkd_w p_uw_q0p039 6 0.00 2559.961 FORMAT "%8.3" DEPOSIT ABSOLUTE /end AXIS_DESCR
/end CHARACTERISTIC
/begin CHARACTERISTIC PHLSNHMN "Heizleistung für ausreichende Sondenheizung" VALUE 0x8186DD KwUb 2.550 fak_ub_q0p01 0.00 2.550 FORMAT "%5.3" /end CHARACTERISTIC
/begin CHARACTERISTIC PHNMO "Drehzahlschwelle für Umschaltung auf 1 Phasenflanke" VALUE 0x818472 KwUb 10200. nmot_ub_q40 0.00 10200. FORMAT "%5.0" /end CHARACTERISTIC
/begin CHARACTERISTIC PHNMU "Drehzahlschwelle für Umschaltung auf 2 Phasenflanken" VALUE 0x818473 KwUb 10200. nmot_ub_q40 0.00 10200. FORMAT "%5.0" /end CHARACTERISTIC
/begin CHARACTERISTIC PUEBKV "Ersatzwert für Umgebungsdruck für BKV" VALUE 0x829078 KwUw 1279.961 p_uw_q0p039 0.00 1279.961 FORMAT "%8.3" /end CHARACTERISTIC
/begin CHARACTERISTIC PUELSU "Ersatzwert für Umgebungsdruck" VALUE 0x81C3EC KwUw 2559.961 p_uw_q0p039 0.00 2559.961 FORMAT "%8.3" /end CHARACTERISTIC
/begin CHARACTERISTIC RBEL "Belastungswiderstand für Pumpstrom-Erzeugung" VALUE 0x81398C KwUw 131070.0 r_uw_q2 0.00 131070.0 FORMAT "%8.1" /end CHARACTERISTIC
/begin CHARACTERISTIC RINHMX "Innenwiderstand Ri der Nernstsonde hinter KAT auf Maximalwert begrenzen" VALUE 0x81398E KwUw 131070.0 r_uw_q2 0.00 131070.0 FORMAT "%8.1" /end CHARACTERISTIC
/begin CHARACTERISTIC RKSP "Widerstand zwischen kongurierende Spannung und Sondensignal" VALUE 0x813990 KwUw 131070.0 r_uw_q2 0.00 131070.0 FORMAT "%8.1" /end CHARACTERISTIC
/begin CHARACTERISTIC SDLAA "Schwelle delta Lambda für LSU Abgleich" VALUE 0x813A5A KwSw 15.99976 fak_sw_b8 -8.000000 7.999756 FORMAT "%8.6" /end CHARACTERISTIC
/begin CHARACTERISTIC SDLAB "Schwelle delta Lambda für Erkennung Betriebsbereitschaft LSU" VALUE 0x813A5C KwSw 15.99976 fak_sw_b8 -8.000000 7.999756 FORMAT "%8.6" /end CHARACTERISTIC
/begin CHARACTERISTIC SENZZYL0 "Klopfsensor für SW-Zylinderzähler 0" VALUE 0x8197B6 KwUb 3.000 dezsub1 1.000 4.000 FORMAT "%5.3" /end CHARACTERISTIC
/begin CHARACTERISTIC SENZZYL1 "Klopfsensor für SW-Zylinderzähler 1" VALUE 0x8197B7 KwUb 3.000 dezsub1 1.000 4.000 FORMAT "%5.3" /end CHARACTERISTIC
/begin CHARACTERISTIC SENZZYL2 "Klopfsensor für SW-Zylinderzähler 2" VALUE 0x8197B8 KwUb 3.000 dezsub1 1.000 4.000 FORMAT "%5.3" /end CHARACTERISTIC
/begin CHARACTERISTIC SENZZYL3 "Klopfsensor für SW-Zylinderzähler 3" VALUE 0x8197B9 KwUb 3.000 dezsub1 1.000 4.000 FORMAT "%5.3" /end CHARACTERISTIC
/begin CHARACTERISTIC SENZZYL4 "Klopfsensor für SW-Zylinderzähler 4" VALUE 0x8197BA KwUb 3.000 dezsub1 1.000 4.000 FORMAT "%5.3" /end CHARACTERISTIC
/begin CHARACTERISTIC SENZZYL5 "Klopfsensor für SW-Zylinderzähler 5" VALUE 0x8197BB KwUb 3.000 dezsub1 1.000 4.000 FORMAT "%5.3" /end CHARACTERISTIC
/begin CHARACTERISTIC SENZZYL6 "Klopfsensor für SW-Zylinderzähler 6" VALUE 0x8197BC KwUb 3.000 dezsub1 1.000 4.000 FORMAT "%5.3" /end CHARACTERISTIC
/begin CHARACTERISTIC SENZZYL7 "Klopfsensor für SW-Zylinderzähler 7" VALUE 0x8197BD KwUb 3.000 dezsub1 1.000 4.000 FORMAT "%5.3" /end CHARACTERISTIC
/begin CHARACTERISTIC SGIDB4 "Fertigungsdatum" ASCII 0x81839E KwbUb 255.0 KennText 0.00 255.0 FORMAT "%5.1" NUMBER 10 /end CHARACTERISTIC
/begin CHARACTERISTIC SGIDB5 "BOSCH-Software-Teilenummer = Typ-Teile-Nummer des Master EPROMs" ASCII 0x8183A8 KwbUb 255.0 KennText 0.00 255.0 FORMAT "%5.1" NUMBER 10 /end CHARACTERISTIC
/begin CHARACTERISTIC SGIDB6 "Nummer Teilsoftware" ASCII 0x8183B2 KtxC 255.0 defaultAscii 0.00 255.0 NUMBER 7 /end CHARACTERISTIC
/begin CHARACTERISTIC SGIDB7 "Hardware Teilenummer" ASCII 0x8183BA KtxC 255.0 defaultAscii 0.00 255.0 NUMBER 11 /end CHARACTERISTIC
/begin CHARACTERISTIC SGIDK1_DAT "Diagnose-Nummer" ASCII 0x8183C6 KtxC 255.0 defaultAscii 0.00 255.0 NUMBER 5 /end CHARACTERISTIC
/begin AXIS_PTS SNM16KRUB "Stützstellenverteilung Drehzahl, 16 Sst." 0x818252 nmot SstAUbSstUb 10200. nmot_ub_q40 16 0.00 10200. FORMAT "%5.0" DEPOSIT ABSOLUTE /end AXIS_PTS
/begin AXIS_PTS SRL04KRUB "Stützstellenverteilung relative Füllung, 4 Sst." 0x818267 rl SstAUbSstUb 191.3 rel_ub_q0p75 4 0.00 191.3 FORMAT "%5.1" DEPOSIT ABSOLUTE /end AXIS_PTS
/begin CHARACTERISTIC TABGL "Zeit für LSU-Abgleich" VALUE 0x810BB8 KwUb 2.550 t10msxs_ub_b2p55 0.00 2.550 FORMAT "%5.3" /end CHARACTERISTIC
/begin CHARACTERISTIC TABGMHS "Abgastemperaturschwelle für die Sondenheizung LSU" VALUE 0x811FD8 KwUb 1275. temp_ub_q5_o50 -50.00 1225. FORMAT "%5.0" /end CHARACTERISTIC
/begin CHARACTERISTIC TABGS "Zeit nach Start für LSU-Abgleich" VALUE 0x810BB9 KwUb 25.50 t100msxs_ub_b25p5 0.00 25.50 FORMAT "%5.2" /end CHARACTERISTIC
/begin CHARACTERISTIC TABSMADTM "Abstellzeit bis Abkühlung Motor für Diagnose TMOT" VALUE 0x81DE88 KwUw 65535.00 t1sxs_uw_q1 0.00 65535.00 FORMAT "%8.2" /end CHARACTERISTIC
/begin CHARACTERISTIC TABSTHLSU "Mindestabstellzeit für Wiederholstart Heizung LSU" VALUE 0x827E9C KwUw 65535.00 t1sxs_uw_q1 0.00 65535.00 FORMAT "%8.2" /end CHARACTERISTIC
/begin CHARACTERISTIC TADE "Ersatzgröße Lufttemperatur im Fehlerfall" VALUE 0x81968D KwUb 191.3 temp_ub_q0p75_o48 -48.00 143.3 FORMAT "%5.1" /end CHARACTERISTIC
/begin CHARACTERISTIC TADMM "1. Stufenbreite (Zeit) für Motortemperaturmodell" VALUE 0x81DE8A KwUw 6553.500 t100msxs_uw_b6553p5 0.00 6553.500 FORMAT "%8.3" /end CHARACTERISTIC
/begin CHARACTERISTIC TADMN "Ansauglufttemperatur min." VALUE 0x81968E KwUb 191.3 temp_ub_q0p75_o48 -48.00 143.3 FORMAT "%5.1" /end CHARACTERISTIC
/begin CHARACTERISTIC TADMX "Ansauglufttemperatur max." VALUE 0x81968F KwUb 191.3 temp_ub_q0p75_o48 -48.00 143.3 FORMAT "%5.1" /end CHARACTERISTIC
/begin CHARACTERISTIC TANHKMMN "Kat-Temperatur für ausreichende Sondenheizung" VALUE 0x81C550 KwUw 1535.977 temp_q0p0234_o273 -273.1500 1262.827 FORMAT "%8.3" /end CHARACTERISTIC
/begin CHARACTERISTIC TANSELI "Temperatur Ansaugluft-Erfassung u. Linearisierung, Inverskennlinie" CURVE 0x819690 KlAUbSstUbWUb 191.3 temp_ub_q0p75_o48 -48.00 143.3 FORMAT "%5.1"
 /begin AXIS_DESCR STD_AXIS wtans spg_ub_b5 20 0.00 4.980 FORMAT "%5.3" DEPOSIT ABSOLUTE /end AXIS_DESCR
/end CHARACTERISTIC
/begin CHARACTERISTIC TBKVP "Evakuierzeit der BKV-Pumpe" VALUE 0x81AD37 KwUb 12.7498039 zk50msxs_ub_b12p8 0.0501960784 12.8000000 FORMAT "%10.7" /end CHARACTERISTIC
/begin CHARACTERISTIC TDAPTUBR "Wartezeit für UBR-Fehler bei Abschaltpfadtest" VALUE 0x8186ED KwUb 25.50 t100msxs_ub_b25p5 0.00 25.50 FORMAT "%5.2" /end CHARACTERISTIC
/begin CHARACTERISTIC TDHREVAB "Entprellzeit für EV-Abschaltung bei Hauptrelais- bzw. -Kontakt-Fehler" VALUE 0x8186EE KwUb 25.50 t100msxs_ub_b25p5 0.00 25.50 FORMAT "%5.2" /end CHARACTERISTIC
/begin CHARACTERISTIC TDNSTA "Auspufferwärmzeit ab Start, für TANS - Diagnose" VALUE 0x8196B9 KwUb 255.0 t1sxs_ub_b255 0.00 255.0 FORMAT "%5.1" /end CHARACTERISTIC
/begin CHARACTERISTIC TDNSUB "Batterie - Erholzeit ab Start, für UBATT - Diagnose" VALUE 0x810BBE KwUb 255.0 t100msxs_ub_b255 0.00 255.0 FORMAT "%5.1" /end CHARACTERISTIC
/begin CHARACTERISTIC TDRNLUBR "Entprellzeit Rücksetzen Nachlauf-Anforderung von GGUBR" VALUE 0x8186EF KwUb 25.50 t100msxs_ub_b25p5 0.00 25.50 FORMAT "%5.2" /end CHARACTERISTIC
/begin CHARACTERISTIC TDTA "Entprellzeit Fehlererkennung TANS" VALUE 0x8196BA KwUb 25.50 t100msxs_ub_b25p5 0.00 25.50 FORMAT "%5.2" /end CHARACTERISTIC
/begin CHARACTERISTIC TDTAL "TANS Fehlererkennung / Zeitsperre ab B_LL = 1" VALUE 0x8196BB KwUb 255.0 t1sxs_ub_b255 0.00 255.0 FORMAT "%5.1" /end CHARACTERISTIC
/begin CHARACTERISTIC TDTKAUS "Entprellzeit Fehlererkennung Temperatur Kühlerausgang" VALUE 0x81AD00 KwUb 25.50 t100msxs_ub_b25p5 0.00 25.50 FORMAT "%5.2" /end CHARACTERISTIC
/begin CHARACTERISTIC TDTM "Entprellzeit Fehlererkennung, Motortemperatursensor" VALUE 0x81DE8C KwUw 6553.500 t100msxs_uw_b6553p5 0.00 6553.500 FORMAT "%8.3" /end CHARACTERISTIC
/begin CHARACTERISTIC TDTMMA "Verzögerungszeit Anfangswert Motortemperaturmodell" VALUE 0x815B32 KwUw 6553.500 t100msxs_uw_b6553p5 0.00 6553.500 FORMAT "%8.3" /end CHARACTERISTIC
/begin CHARACTERISTIC TDTMNP "Entprellzeit Fehlererkennung Unplausibilität Signal TMOT" VALUE 0x815B34 KwUw 6553.500 t100msxs_uw_b6553p5 0.00 6553.500 FORMAT "%8.3" /end CHARACTERISTIC
/begin CHARACTERISTIC TDTMNPO "Entprellzeit Fehlererkennung Unplausibilität oben TMOT" VALUE 0x8196D6 KwUb 25.50 t100msxs_ub_b25p5 0.00 25.50 FORMAT "%5.2" /end CHARACTERISTIC
/begin CHARACTERISTIC TDTMPOG "Entprellzeit Prüfung obere Unplausibilität gültig TMOT" VALUE 0x8196D7 KwUb 25.50 t100msxs_ub_b25p5 0.00 25.50 FORMAT "%5.2" /end CHARACTERISTIC
/begin CHARACTERISTIC TDUB "Wartezeit für UBATT-Diagnose" VALUE 0x810BBF KwUb 25.50 t100msxs_ub_b25p5 0.00 25.50 FORMAT "%5.2" /end CHARACTERISTIC
/begin CHARACTERISTIC TDUBR "Entprellzeit für Diagnose UBR" VALUE 0x8186F0 KwUb 25.50 t100msxs_ub_b25p5 0.00 25.50 FORMAT "%5.2" /end CHARACTERISTIC
/begin CHARACTERISTIC TDUBRNL "Entprellzeit für Diagnose UBR im Nachlauf" VALUE 0x8186F1 KwUb 25.40 t100msxs_ub_b25p5 0.1000 25.50 FORMAT "%5.2" /end CHARACTERISTIC
/begin CHARACTERISTIC TDWPOPBP "Entprellzeit zur Deaktivierung der PWG/Brems-Plaus. über Pedalgradient" VALUE 0x810BD5 KwUb 2.550 t10msxs_ub_b2p55 0.00 2.550 FORMAT "%5.3" /end CHARACTERISTIC
/begin CHARACTERISTIC TEBBREMS "Entprellzeit von B_brems" VALUE 0x81AD38 KwUb 0.5000 t50msxs_q0p05 0.00 0.5000 /end CHARACTERISTIC
/begin CHARACTERISTIC TEDTP "Einschaltdauer der LSU-Heizung während Kondenswasserphase" VALUE 0x811FD9 KwUb 2.550 t10msxs_ub_b2p55 0.00 2.550 FORMAT "%5.3" /end CHARACTERISTIC
/begin CHARACTERISTIC TFGRVRAB "FGR: Zeit für Geschwindigkeitsabschaltung über vroh =0" VALUE 0x810BC6 KwUb 5.100 t20msxs_ub_b5p1 0.00 5.100 FORMAT "%5.3" /end CHARACTERISTIC
/begin CHARACTERISTIC TFPWG2 "Filterzeit zur Filterung von Poti 2 bei der Bewegungserkennung" VALUE 0x813AC8 KwUw 655.34999985 zk10msxs_uw_b655 0.010000152590 655.36000000 FORMAT "%12.8" /end CHARACTERISTIC
/begin CHARACTERISTIC TGGLS "Zeitdauer für ADC nach Interrupt im Funktionsrechner (Asic)" VALUE 0x810BAF KwUb 2.000 t1msxms_q1 3.000 5.000 FORMAT "%5.3" /end CHARACTERISTIC
/begin CHARACTERISTIC THHA "Auszeit für Reduzierung der Heizleistung Sonde hinter Kat bei 13V" VALUE 0x8186DE KwUb 2.550 t10msxs_q0p01_o0p05 -0.05000 2.500 FORMAT "%5.3" /end CHARACTERISTIC
/begin CHARACTERISTIC THHAWU "Ausschaltzeit während Leistungsreduzierung Sondenheizung hinter Kat" VALUE 0x8186DF KwUb 2.550 t10msxs_ub_b2p55 0.00 2.550 FORMAT "%5.3" /end CHARACTERISTIC
/begin CHARACTERISTIC THOPP1 "Fehlerzeit bei Hochohmigkeitsprüfung Poti 1" VALUE 0x810BD6 KwUb 2.550 t10msxs_ub_b2p55 0.00 2.550 FORMAT "%5.3" /end CHARACTERISTIC
/begin CHARACTERISTIC THOPP2 "Fehlerzeit bei Hochohmigkeitsprüfung Poti 2" VALUE 0x810BD7 KwUb 2.550 t10msxs_ub_b2p55 0.00 2.550 FORMAT "%5.3" /end CHARACTERISTIC
/begin CHARACTERISTIC THSHA "Verzögerungszeit für Sonde ausreichend beheizt" VALUE 0x8186E0 KwUb 25.50 t100msxs_ub_b25p5 0.00 25.50 FORMAT "%5.2" /end CHARACTERISTIC
/begin CHARACTERISTIC THSHKTK "Kennlinie für die Ausschaltdauer der Sondenheizung abh. v.d. Abgastemp. h.Kat" CURVE 0x81C552 KlAUbSstUwWUb 2.550 t10msxs_q0p01_o0p05 -0.05000 2.500 FORMAT "%5.3"
 /begin AXIS_DESCR STD_AXIS tanhkm_w temp_q0p0234_o273 8 -273.1500 1262.827 FORMAT "%8.3" DEPOSIT ABSOLUTE /end AXIS_DESCR
/end CHARACTERISTIC
/begin CHARACTERISTIC THSRIH "Zeitverzög. Bereitschaft der Ri-Messung nach eingesch. Sondenheizung hinter KAT" VALUE 0x813992 KwUw 655.3500 t10msxs_uw_b655p35 0.00 655.3500 FORMAT "%8.4" /end CHARACTERISTIC
/begin CHARACTERISTIC TIDLEMAX "" VALUE 0x819BB5 KwUb 0.00 t100msxs_ub_b25p5 10.00 10.00 FORMAT "%5.2" /end CHARACTERISTIC
/begin CHARACTERISTIC TIDLEMIN "" VALUE 0x819BB6 KwUb 0.00 t100msxs_ub_b25p5 2.300 2.300 FORMAT "%5.3" /end CHARACTERISTIC
/begin CHARACTERISTIC TKAELI "Temperatur Kühlerausgang Erfassung und Linearisierung" CURVE 0x81AD01 KlAUbSstUbWUb 191.3 temp_ub_q0p75_o48 -48.00 143.3 FORMAT "%5.1"
 /begin AXIS_DESCR STD_AXIS wtka spg_ub_b5 20 0.00 4.980 FORMAT "%5.3" DEPOSIT ABSOLUTE /end AXIS_DESCR
/end CHARACTERISTIC
/begin CHARACTERISTIC TKAUSDE "Ersatzgröße Temperatur Kühlerausgang im Fehlerfall" VALUE 0x81AD2A KwUb 191.3 temp_ub_q0p75_o48 -48.00 143.3 FORMAT "%5.1" /end CHARACTERISTIC
/begin CHARACTERISTIC TKAUSDMN "Min. Temperatur Kühlerausgang" VALUE 0x81AD2B KwUb 191.3 temp_ub_q0p75_o48 -48.00 143.3 FORMAT "%5.1" /end CHARACTERISTIC
/begin CHARACTERISTIC TKAUSDMX "Max. Temperatur Kühlerausgang" VALUE 0x81AD2C KwUb 191.3 temp_ub_q0p75_o48 -48.00 143.3 FORMAT "%5.1" /end CHARACTERISTIC
/begin CHARACTERISTIC TKWFS "" VALUE 0x8196F4 KwUb 14.00 fak_q0p0625 1.000 15.00 FORMAT "%5.2" /end CHARACTERISTIC
/begin CHARACTERISTIC TLSUTA "Kennlinie für die Einschaltdauer der LSU-Heizung nach Start" CURVE 0x81A21F KlAUbSstUbWUb 2.550 t10msxs_ub_b2p55 0.00 2.550 FORMAT "%5.3"
 /begin AXIS_DESCR STD_AXIS tans temp_ub_q0p75_o48 4 -48.00 143.3 FORMAT "%5.1" DEPOSIT ABSOLUTE /end AXIS_DESCR
/end CHARACTERISTIC
/begin CHARACTERISTIC TLSUVH "Zeit für LSU vorheizen" VALUE 0x811FDA KwUb 25.50 t100msxs_ub_b25p5 0.00 25.50 FORMAT "%5.2" /end CHARACTERISTIC
/begin CHARACTERISTIC TMABDTMN "Minimalschwelle der Motorabstelltemperatur für Diagnose TMOT" VALUE 0x8196D8 KwUb 103.5 temp_ub_q0p75_o48 39.75 143.3 FORMAT "%5.1" /end CHARACTERISTIC
/begin CHARACTERISTIC TMBVH "Verzögerungszeit für Aktivierung Mißbrauchsverhinderung" VALUE 0x81C57A KwUw 6553.500 t100msxs_uw_b6553p5 0.00 6553.500 FORMAT "%8.3" /end CHARACTERISTIC
/begin CHARACTERISTIC TMCC650 "KR-testmode am Pin ADT des CC650" VALUE 0x8197BE KwUb 255.0 dez 0.00 255.0 FORMAT "%5.1" /end CHARACTERISTIC
/begin CHARACTERISTIC TMDMMA "Anfangstemperatur für Motortemperaturmodell" VALUE 0x8196D9 KwUb 191.3 temp_ub_q0p75_o48 -48.00 143.3 FORMAT "%5.1" /end CHARACTERISTIC
/begin CHARACTERISTIC TMDMMAT "Ersatztemperatur abh. Abstellzeit während TDTMMA" CURVE 0x81DE8E KlAUwSstUwWUw 191.2500 temp_ub_q0p75_o48 -48.00000 143.2500 FORMAT "%8.4"
 /begin AXIS_DESCR STD_AXIS tabst_w t1sxs_uw_q1 3 0.00 65535.00 FORMAT "%8.2" DEPOSIT ABSOLUTE /end AXIS_DESCR
/end CHARACTERISTIC
/begin CHARACTERISTIC TMDMMAU "Unterster Anfangswert aus tans für Motortemperaturmodell" VALUE 0x8196DA KwUb 191.3 temp_ub_q0p75_o48 -48.00 143.3 FORMAT "%5.1" /end CHARACTERISTIC
/begin CHARACTERISTIC TMDMMEE "Endtemperatur für Ersatzwert Motortemperatur" VALUE 0x8196DB KwUb 191.3 temp_ub_q0p75_o48 -48.00 143.3 FORMAT "%5.1" /end CHARACTERISTIC
/begin CHARACTERISTIC TMDMMER "Endtemperatur für Referenzwert Motortemperatur" VALUE 0x8196DC KwUb 191.3 temp_ub_q0p75_o48 -48.00 143.3 FORMAT "%5.1" /end CHARACTERISTIC
/begin CHARACTERISTIC TMDMN "Motortemperatur min." VALUE 0x8196DD KwUb 191.3 temp_ub_q0p75_o48 -48.00 143.3 FORMAT "%5.1" /end CHARACTERISTIC
/begin CHARACTERISTIC TMDMX "Motortemperatur max." VALUE 0x8196DE KwUb 191.3 temp_ub_q0p75_o48 -48.00 143.3 FORMAT "%5.1" /end CHARACTERISTIC
/begin CHARACTERISTIC TMELIPU1 "Motor-Temperatur: Erfassung u. Linearisierung, Inverskennlinie 1, pullup aktiv" CURVE 0x81DE9C KlAUwSstUwWUw 191.9970 temp_uw_q0p75_o48 -48.00000 143.9970 FORMAT "%8.4"
 /begin AXIS_DESCR STD_AXIS wtmot_w spg_uw_q0p00488 20 0.00 319.9951 FORMAT "%8.4" DEPOSIT ABSOLUTE /end AXIS_DESCR
/end CHARACTERISTIC
/begin CHARACTERISTIC TMMXRT "max. Motortemperatur f. Retrigg. Modelle (Blockheater-Erkennung)" VALUE 0x8196DF KwUb 191.3 temp_ub_q0p75_o48 -48.00 143.3 FORMAT "%5.1" /end CHARACTERISTIC
/begin CHARACTERISTIC TMOTELI "Temperatur Motor Erfassung u. Linearisierung, Inverskennlinie" CURVE 0x81DEEE KlAUwSstUwWUw 191.9970 temp_uw_q0p75_o48 -48.00000 143.9970 FORMAT "%8.4"
 /begin AXIS_DESCR STD_AXIS wtmot_w spg_uw_q0p00488 20 0.00 319.9951 FORMAT "%8.4" DEPOSIT ABSOLUTE /end AXIS_DESCR
/end CHARACTERISTIC
/begin CHARACTERISTIC TMOTSH "Motortemperaturschwelle für die Sondenheizung LSU" VALUE 0x811FDB KwUb 191.3 temp_ub_q0p75_o48 -48.00 143.3 FORMAT "%5.1" /end CHARACTERISTIC
/begin CHARACTERISTIC TMPUPOFF "untere Motortemperaturschwelle für pullup-Abschaltung" VALUE 0x8196E0 KwUb 191.3 temp_ub_q0p75_o48 -48.00 143.3 FORMAT "%5.1" /end CHARACTERISTIC
/begin CHARACTERISTIC TMPUPON "obere Motortemperaturschwelle für pullup-Zuschaltung" VALUE 0x8196E1 KwUb 191.3 temp_ub_q0p75_o48 -48.00 143.3 FORMAT "%5.1" /end CHARACTERISTIC
/begin CHARACTERISTIC TNLETM "Nachlaufzeitverlaengerung fuer E_tm" VALUE 0x81DF40 KwUw 65535.00 t1sxs_uw_q1 0.00 65535.00 FORMAT "%8.2" /end CHARACTERISTIC
/begin CHARACTERISTIC TNSRT "Max.-Zeit ab Start für Retriggerung Berechnung Motortemperaturmodell" VALUE 0x8196E2 KwUb 255.0 t1sxs_ub_b255 0.00 255.0 FORMAT "%5.1" /end CHARACTERISTIC
/begin CHARACTERISTIC TPNSE1 "Prüfzeit nach Startende für PWG-Diagnose" VALUE 0x818712 KwUb 12.70 t50msxs_ub_b12p75 0.05000 12.75 FORMAT "%5.2" /end CHARACTERISTIC
/begin CHARACTERISTIC TPSSWE "Sollwert Periodendauer Schlechtwegsignal" VALUE 0x818456 KwUb 255.0 t1msxms_q1 0.00 255.0 FORMAT "%5.1" /end CHARACTERISTIC
/begin CHARACTERISTIC TPWMST "Zeit nach Start für PWM-Signal" VALUE 0x818457 KwUb 25.50 t100msxs_ub_b25p5 0.00 25.50 FORMAT "%5.2" /end CHARACTERISTIC
/begin CHARACTERISTIC TRETRY "" VALUE 0x8196F5 KwUb 255.0 t1sxs_ub_b255 0.00 255.0 FORMAT "%5.1" /end CHARACTERISTIC
/begin CHARACTERISTIC TRIAKTH "Zeitdauer für Ri-Berechnung aktuell hinter KAT" VALUE 0x813994 KwUw 6553.500 t100msxs_uw_b6553p5 0.00 6553.500 FORMAT "%8.3" /end CHARACTERISTIC
/begin CHARACTERISTIC TRIIMPH "Zeitdauer für Pumpimpuls für beide Bänke hinter KAT" VALUE 0x813996 KwUw 655.3500 t10msxs_uw_b655p35 0.00 655.3500 FORMAT "%8.4" /end CHARACTERISTIC
/begin CHARACTERISTIC TSTBB "Störunterdrückungszeit für Erkennung Betriebsbereitschaft LSU" VALUE 0x810BBA KwUb 2.550 t10msxs_ub_b2p55 0.00 2.550 FORMAT "%5.3" /end CHARACTERISTIC
/begin CHARACTERISTIC TUBKL15 "Filterzeit für redundante KL15-Erfassung" VALUE 0x81A1E2 KwUb 2.550 t10msxs_ub_b2p55 0.00 2.550 FORMAT "%5.3" /end CHARACTERISTIC
/begin CHARACTERISTIC TUMDETM "Umgebungslufttemperatur-Ersatzwert für Motortemperatur-Modell" VALUE 0x8196E3 KwUb 191.3 temp_ub_q0p75_o48 -48.00 143.3 FORMAT "%5.1" /end CHARACTERISTIC
/begin CHARACTERISTIC TUPWBWV "Zeitverzögerung zum Einspeichern eines neuen Poti 2 Wertes" VALUE 0x810BD8 KwUb 2.550 t10msxs_ub_b2p55 0.00 2.550 FORMAT "%5.3" /end CHARACTERISTIC
/begin CHARACTERISTIC TUPWG12 "Fehlerzeit bei Vergleich von PWG-Poti 1 und 2" VALUE 0x810BD9 KwUb 2.550 t10msxs_ub_b2p55 0.00 2.550 FORMAT "%5.3" /end CHARACTERISTIC
/begin CHARACTERISTIC TUPWG1O "Fehlerzeit bei Bereichsverletzung von PWG-Poti 1 nach oben" VALUE 0x810BDA KwUb 2.550 t10msxs_ub_b2p55 0.00 2.550 FORMAT "%5.3" /end CHARACTERISTIC
/begin CHARACTERISTIC TUPWG1U "Fehlerzeit bei Bereichsverletzung von PWG-Poti 1 nach unten" VALUE 0x810BDB KwUb 2.550 t10msxs_ub_b2p55 0.00 2.550 FORMAT "%5.3" /end CHARACTERISTIC
/begin CHARACTERISTIC TUPWG2O "Fehlerzeit bei Bereichsverletzung von PWG-Poti 2 nach oben" VALUE 0x810BDC KwUb 2.550 t10msxs_ub_b2p55 0.00 2.550 FORMAT "%5.3" /end CHARACTERISTIC
/begin CHARACTERISTIC TUPWG2U "Fehlerzeit bei Bereichsverletzung von PWG-Poti 2 nach unten" VALUE 0x810BDD KwUb 2.550 t10msxs_ub_b2p55 0.00 2.550 FORMAT "%5.3" /end CHARACTERISTIC
/begin CHARACTERISTIC TUPWLLU "Entprellzeit zur Fehlererkennung ""unerwartete Leerlaufspannungen""" VALUE 0x810BDE KwUb 2.550 t10msxs_ub_b2p55 0.00 2.550 FORMAT "%5.3" /end CHARACTERISTIC
/begin CHARACTERISTIC TUSBELH "Zeit für Festhaltung der Sondenspannung nach Impulsbelastung  hinter KAT" VALUE 0x810BB0 KwUb 2.550 t10msxs_ub_b2p55 0.00 2.550 FORMAT "%5.3" /end CHARACTERISTIC
/begin CHARACTERISTIC TVABGL "Verzögerungszeit für LSU-Abgleich" VALUE 0x813A5E KwUw 655.3500 t10msxs_uw_b655p35 0.00 655.3500 FORMAT "%8.4" /end CHARACTERISTIC
/begin CHARACTERISTIC TVHSH "Einschaltverzögerung der Sondenheizung hinter Kat" VALUE 0x8186E1 KwUb 25.50 t100msxs_ub_b25p5 0.00 25.50 FORMAT "%5.2" /end CHARACTERISTIC
/begin CHARACTERISTIC TVLENA "Verzögerungszeit für Lambdakorrektur" VALUE 0x810BBB KwUb 2.550 t10msxs_ub_b2p55 0.00 2.550 FORMAT "%5.3" /end CHARACTERISTIC
/begin CHARACTERISTIC TVLSUWU "maximale Zeit für ""warm up"" stetige Lambdasonde LSU" VALUE 0x811FDC KwUb 25.50 t100msxs_ub_b25p5 0.00 25.50 FORMAT "%5.2" /end CHARACTERISTIC
/begin CHARACTERISTIC TWDUBRNL "Wartezeit für Diagnose UBR im Nachlauf bis Ausschalten Komponenten" VALUE 0x8186F2 KwUb 25.40 t100msxs_ub_b25p5 0.1000 25.50 FORMAT "%5.2" /end CHARACTERISTIC
/begin CHARACTERISTIC TWPLK "Entprellzeit für Rücknahme der LL-Vorgabe bei Lebendkennung" VALUE 0x818713 KwUb 25.50 t100msxs_ub_b25p5 0.00 25.50 FORMAT "%5.2" /end CHARACTERISTIC
/begin CHARACTERISTIC TWPMBBR "Verzögerungszeit für Pedalwertbegrenzung bei betätigter Bremse" VALUE 0x810BDF KwUb 2.550 t10msxs_ub_b2p55 0.00 2.550 FORMAT "%5.3" /end CHARACTERISTIC
/begin CHARACTERISTIC UBDABS "Batteriespannungsschwelle für Auswertung Schlechtweginfo" VALUE 0x818458 KwUb 17.95 spg_ubatt 0.00 17.95 FORMAT "%5.2" /end CHARACTERISTIC
/begin CHARACTERISTIC UBDE "Ubatt - Ersatzwert bei defektem AD-Kanal" VALUE 0x813A72 KwUw 1153.416 spg_ubatt_w 0.00 1153.416 FORMAT "%8.3" /end CHARACTERISTIC
/begin CHARACTERISTIC UBDMN1 "Batteriespannung min. (Netz)" VALUE 0x810BC0 KwUb 17.95 spg_ubatt 0.00 17.95 FORMAT "%5.2" /end CHARACTERISTIC
/begin CHARACTERISTIC UBDMN2 "Batteriespannung min. (ADC)" VALUE 0x810BC1 KwUb 17.95 spg_ubatt 0.00 17.95 FORMAT "%5.2" /end CHARACTERISTIC
/begin CHARACTERISTIC UBDMN3 "Batteriespannung, untere Schwelle für Umschaltung auf Nachlaufwertübernahme" VALUE 0x810BC2 KwUb 17.95 spg_ubatt 0.00 17.95 FORMAT "%5.2" /end CHARACTERISTIC
/begin CHARACTERISTIC UBDMX "Batteriespannung max." VALUE 0x810BC3 KwUb 17.95 spg_ubatt 0.00 17.95 FORMAT "%5.2" /end CHARACTERISTIC
/begin CHARACTERISTIC UBGGLSU "Batteriespannungsschwelle zur Freigabe B_sbbvk LSU" VALUE 0x8186AA KwUb 17.95 spg_ubatt 0.00 17.95 FORMAT "%5.2" /end CHARACTERISTIC
/begin CHARACTERISTIC UBHS "Batteriespannungsschwelle für Abschalten der Sondenheizung" VALUE 0x8186E2 KwUb 17.95 spg_ubatt 0.00 17.95 FORMAT "%5.2" /end CHARACTERISTIC
/begin CHARACTERISTIC UBKL15 "Ub-Schwelle für redundaten KL15-Erfassung" VALUE 0x81A1E3 KwUb 4.998 spg_ubatt 0.00 4.998 FORMAT "%5.3" /end CHARACTERISTIC
/begin CHARACTERISTIC UBMNPUP "Mindest-Bordspannung für pullup-Ansteuerung" VALUE 0x8196E4 KwUb 25.50 spg_q0p1 0.00 25.50 FORMAT "%5.2" /end CHARACTERISTIC
/begin CHARACTERISTIC UBNACHL "Ub-Ersatzwert im Nachlauf" VALUE 0x813A74 KwUw 1153.416 spg_ubatt_w 0.00 1153.416 FORMAT "%8.3" /end CHARACTERISTIC
/begin CHARACTERISTIC UBRDMN1 "untere Grenze Bordnetzspannung über Hauptrelais, Erkennung Lastabfall" VALUE 0x8186F3 KwUb 25.50 spg_q0p1 0.00 25.50 FORMAT "%5.2" /end CHARACTERISTIC
/begin CHARACTERISTIC UBRDMN2 "untere Grenze Bordnetzspannung über Hauptrelais" VALUE 0x8186F4 KwUb 25.50 spg_q0p1 0.00 25.50 FORMAT "%5.2" /end CHARACTERISTIC
/begin CHARACTERISTIC UBRDMX "obere Grenze Bordnetzspannung über Hauptrelais" VALUE 0x8186F5 KwUb 28.38 spg_ub_b28p5 0.00 28.38 FORMAT "%5.2" /end CHARACTERISTIC
/begin CHARACTERISTIC UBRDUNL "Schwellwert für Unplausibilität der Bordnetzspannung über Hauptrelais (im Nachl)" VALUE 0x8186F6 KwUb 25.50 spg_q0p1 0.00 25.50 FORMAT "%5.2" /end CHARACTERISTIC
/begin CHARACTERISTIC UHSN "Nennspannung für die Sondenheizung" VALUE 0x8186E3 KwUb 17.95 spg_ubatt 0.00 17.95 FORMAT "%5.2" /end CHARACTERISTIC
/begin CHARACTERISTIC ULSUAMN "Minimale Spannung der LSU während Abgleich" VALUE 0x813A60 KwUw 319.9951 spg_uw_q0p00488 0.00 319.9951 FORMAT "%8.4" /end CHARACTERISTIC
/begin CHARACTERISTIC ULSUAMX "Maximale Spannung der LSU während Abgleich" VALUE 0x813A62 KwUw 319.9951 spg_uw_q0p00488 0.00 319.9951 FORMAT "%8.4" /end CHARACTERISTIC
/begin CHARACTERISTIC UPW1BE "Spannung PWG-Poti 1 für Durchführung der Bewegungserkennung" VALUE 0x810BE0 KwUb 4.980 spg_ub_b5 0.00 4.980 FORMAT "%5.3" /end CHARACTERISTIC
/begin CHARACTERISTIC UPW1LLMX "Maximale Spannung von Poti 1 im Leergaspunkt" VALUE 0x810BE1 KwUb 4.980 spg_ub_b5 0.00 4.980 FORMAT "%5.3" /end CHARACTERISTIC
/begin CHARACTERISTIC UPWG12U "Untere Begrenzung PWG-Poti-Spannung vor Vergleich Poti 1 und 2" VALUE 0x810BE2 KwUb 4.980 spg_ub_b5 0.00 4.980 FORMAT "%5.3" /end CHARACTERISTIC
/begin CHARACTERISTIC UPWG1O "Obere Schranke für PWG-Poti-1-Spannung" VALUE 0x810BE3 KwUb 4.980 spg_ub_b5 0.00 4.980 FORMAT "%5.3" /end CHARACTERISTIC
/begin CHARACTERISTIC UPWG1U "Untere Schranke für PWG-Poti-1-Spannung" VALUE 0x810BE4 KwUb 4.980 spg_ub_b5 0.00 4.980 FORMAT "%5.3" /end CHARACTERISTIC
/begin CHARACTERISTIC UPWG2O "Obere Schranke für PWG-Poti-2-Spannung" VALUE 0x810BE5 KwUb 4.980 spg_ub_b5 0.00 4.980 FORMAT "%5.3" /end CHARACTERISTIC
/begin CHARACTERISTIC UPWG2U "Untere Schranke für PWG-Poti-2-Spannung" VALUE 0x810BE6 KwUb 4.980 spg_ub_b5 0.00 4.980 FORMAT "%5.3" /end CHARACTERISTIC
/begin CHARACTERISTIC UPWGO "Oberer PWG-Spannungswert für Umnormierung auf Pedalwert" VALUE 0x810BE7 KwUb 4.980 spg_ub_b5 0.00 4.980 FORMAT "%5.3" /end CHARACTERISTIC
/begin CHARACTERISTIC UPWGTG "PWG-Spannungsschwelle für Teilgasbereich" VALUE 0x810BE8 KwUb 4.980 spg_ub_b5 0.00 4.980 FORMAT "%5.3" /end CHARACTERISTIC
/begin CHARACTERISTIC UPWGTL "Teillastschwelle der PWG-Spannung in Hochohmigkeitsprüfung" VALUE 0x810BE9 KwUb 4.980 spg_ub_b5 0.00 4.980 FORMAT "%5.3" /end CHARACTERISTIC
/begin CHARACTERISTIC UPWGU "Unterer PWG-Spannungswert für Umnormierung auf Pedalwert" VALUE 0x810BEA KwUb 4.980 spg_ub_b5 0.00 4.980 FORMAT "%5.3" /end CHARACTERISTIC
/begin CHARACTERISTIC UPWGUBF "Unterer Spannungswert zur Umnormierung bei erkanntem Bewegungsfehler" VALUE 0x810BEB KwUb 4.980 spg_ub_b5 0.00 4.980 FORMAT "%5.3" /end CHARACTERISTIC
/begin CHARACTERISTIC UPWGUR "Reduzierter unterer PWG-Spannungswert für Umnormierung auf Pedalwert" VALUE 0x810BEC KwUb 4.980 spg_ub_b5 0.00 4.980 FORMAT "%5.3" /end CHARACTERISTIC
/begin CHARACTERISTIC UPWGVG "PWG-Spannungsschwelle für Vollgasbereich" VALUE 0x810BED KwUb 4.980 spg_ub_b5 0.00 4.980 FORMAT "%5.3" /end CHARACTERISTIC
/begin CHARACTERISTIC USABGL "LSU-Spannung bei Pumpstrom Null" VALUE 0x813A64 KwUw 319.9951 spg_uw_q0p00488 0.00 319.9951 FORMAT "%8.4" /end CHARACTERISTIC
/begin CHARACTERISTIC USRIMINH "Mindest Spannungs-Schwelle für Ri-Messung der Sonde hinter KAT" VALUE 0x813998 KwUw 319.9951 spg_uw_q0p00488_o1 -1.000000 318.9951 FORMAT "%8.4" /end CHARACTERISTIC
/begin CHARACTERISTIC USRIOH "Obere Spannungs-Schwelle für Ri-Messung der Sonde hinter KAT" VALUE 0x81399A KwUw 319.9951 spg_uw_q0p00488_o1 -1.000000 318.9951 FORMAT "%8.4" /end CHARACTERISTIC
/begin CHARACTERISTIC USRIUH "Untere Spannungs-Schwelle für Ri-Messung der Sonde hinter KAT" VALUE 0x81399C KwUw 319.9951 spg_uw_q0p00488_o1 -1.000000 318.9951 FORMAT "%8.4" /end CHARACTERISTIC
/begin CHARACTERISTIC VFZGSCH "Schwelle für Fahrzeuggeschwindigkeit" VALUE 0x82907A KwUw 511.9922 vfzg_uw_q0p00781 0.00 511.9922 FORMAT "%8.4" /end CHARACTERISTIC
/begin CHARACTERISTIC VFZMN "Erkennen Fahren-Stehen" VALUE 0x813A7A KwUw 511.9922 vfzg_uw_b512 0.00 511.9922 FORMAT "%8.4" /end CHARACTERISTIC
/begin CHARACTERISTIC VFZR1O "Schwelle vfzroh_w für Umschaltung zfcnt von 1 auf ZFCNT1" VALUE 0x813A7C KwUw 511.9922 vfzg_uw_b512 0.00 511.9922 FORMAT "%8.4" /end CHARACTERISTIC
/begin CHARACTERISTIC VFZR1U "Schwelle vfzroh_w für Umschaltung zfcnt von ZFCNT1 auf 1" VALUE 0x813A7E KwUw 511.9922 vfzg_uw_b512 0.00 511.9922 FORMAT "%8.4" /end CHARACTERISTIC
/begin CHARACTERISTIC VFZR2O "Schwelle vfzroh_w für Umschaltung zfcnt von ZFCNT1 auf ZFCNT2" VALUE 0x813A80 KwUw 511.9922 vfzg_uw_b512 0.00 511.9922 FORMAT "%8.4" /end CHARACTERISTIC
/begin CHARACTERISTIC VFZR2U "Schwelle vfzroh_w für Umschaltung zfcnt von ZFCNT2 auf ZFCNT1" VALUE 0x813A82 KwUw 511.9922 vfzg_uw_b512 0.00 511.9922 FORMAT "%8.4" /end CHARACTERISTIC
/begin CHARACTERISTIC VMDUB "Geschwindigkeitsschwelle min. für Batteriespannungs-Diagnose" VALUE 0x810BC4 KwUb 318.8 vfzg_ub_q1p25 0.00 318.8 FORMAT "%5.1" /end CHARACTERISTIC
/begin CHARACTERISTIC VRFGRMN "Untere Schwelle vroh_w für FGR-Abschaltung über vfzg_w = 0" VALUE 0x813A84 KwUw 511.9922 vfzg_uw_b512 0.00 511.9922 FORMAT "%8.4" /end CHARACTERISTIC
/begin CHARACTERISTIC VWPMBBR "Mindestgeschwindigkeit für Pedalwertbegrenzung bei betätigter Bremse" VALUE 0x810BEE KwUb 318.8 vfzg_ub_q1p25 0.00 318.8 FORMAT "%5.1" /end CHARACTERISTIC
/begin CHARACTERISTIC WHLSUKOR "Korrekturwert für die  LSU-Heizleistung" VALUE 0x81A228 KwUb 1.992 fak_ub_b2 0.00 1.992 FORMAT "%5.3" /end CHARACTERISTIC
/begin CHARACTERISTIC WNWAFMX "Begrenzung Adaption Spätanschlag nach 'früh'" VALUE 0x810B42 KwSb 128.0 kw_q1 -128.0 0.00 FORMAT "%5.1" /end CHARACTERISTIC
/begin CHARACTERISTIC WNWASMX "Obere Begrenzung Adaption NW-Spätanschlag (Richtung spät)" VALUE 0x810B43 KwSb 127.0 kw_q1 0.00 127.0 FORMAT "%5.1" /end CHARACTERISTIC
/begin CHARACTERISTIC WNWKM "Korrekturwinkel Nockenwelle über Motortemperatur" CURVE 0x81C202 KlAUbSstUbWSb 7.969 kw_q0p03125 -4.000 3.969 FORMAT "%5.3"
 /begin AXIS_DESCR STD_AXIS tmot temp_ub_q0p75_o48 5 -48.00 143.3 FORMAT "%5.1" DEPOSIT ABSOLUTE /end AXIS_DESCR
/end CHARACTERISTIC
/begin CHARACTERISTIC WNWKN "Korrekturwinkel Nockenwelle über Drehzahl" CURVE 0x81C20E KlAUbSstUbWSb 7.969 kw_q0p03125 -4.000 3.969 FORMAT "%5.3"
 /begin AXIS_DESCR STD_AXIS nmot nmot_ub_q40 6 0.00 10200. FORMAT "%5.0" DEPOSIT ABSOLUTE /end AXIS_DESCR
/end CHARACTERISTIC
/begin CHARACTERISTIC WNWRPS "Sollwinkel der Phasengeberflanken in Referenzposition, Nockenwelle 1" VAL_BLK 0x813944 KwbUw 1023.984 kw_q0p0156 0.00 1023.984 FORMAT "%8.3" NUMBER 4 /end CHARACTERISTIC
/begin CHARACTERISTIC WPMXBR "Maximal zulässiger Pedalwert bei betätigter Bremse (vor Erkennung wped = 0)" VALUE 0x813ACA KwUw 100.0000 relPED_uw_b100 0.00 100.0000 FORMAT "%8.4" /end CHARACTERISTIC
/begin CHARACTERISTIC WPMXNOT "Maximal zulässiger Fahrpedalwert im PWG-Notfahren" VALUE 0x810BEF KwUb 100.0 relPED_ub_b100 0.00 100.0 FORMAT "%5.1" /end CHARACTERISTIC
/begin CHARACTERISTIC WPRMBVH "Pedalwertgrenze zur Rücknahme der Mißbrauchsverhinderung" VALUE 0x818714 KwUb 100.0 relPED_ub_b100 0.00 100.0 FORMAT "%5.1" /end CHARACTERISTIC
/begin CHARACTERISTIC ZBWF "Zählerstand für Fehlereintrag Bewegungserkennung" VALUE 0x810BF0 KwUb 255.0 dez 0.00 255.0 FORMAT "%5.1" /end CHARACTERISTIC
/begin CHARACTERISTIC ZFBFZGL "Filterzeitkonstante für 16-bit-Beschleunigungssignal" VALUE 0x813A86 KwUw 1310.6999997 zk20msxs_uw_b1310 0.020000305180 1310.7200000 FORMAT "%12.7" /end CHARACTERISTIC
/begin CHARACTERISTIC ZFCNT1 "Anzahl Zahnflanken im mittleren Geschwindigkeitsbereich" VALUE 0x813A88 KwUw 65535.00 dez 0.00 65535.00 FORMAT "%8.2" /end CHARACTERISTIC
/begin CHARACTERISTIC ZFCNT2 "Anzahl Zahnflanken im oberen Geschwindigkeitsbereich" VALUE 0x813A8A KwUw 65535.00 dez 0.00 65535.00 FORMAT "%8.2" /end CHARACTERISTIC
/begin CHARACTERISTIC ZFDUSVK "Filterzeitkonstante für LSU-Spannungsabgleich vor Kat" VALUE 0x813A66 KwUw 655.34999985 zk10msxs_uw_b655 0.010000152590 655.36000000 FORMAT "%12.8" /end CHARACTERISTIC
/begin CHARACTERISTIC ZFRIH "Abschwächungsfaktor für Innenwiderstand Ri-Nernst-Filter hinter KAT" VALUE 0x81399E KwUw 0.9999847 fak_uw_b1 0.00 0.9999847 FORMAT "%9.7" /end CHARACTERISTIC
/begin CHARACTERISTIC ZFTANS "Zeitkonstante Tiefpaßfilter Ansauglufttemperatur" VALUE 0x81DDF0 KwUw 6553.4999985 zk100msxs_uw_b6553 0.10000152590 6553.6000000 FORMAT "%12.7" /end CHARACTERISTIC
/begin CHARACTERISTIC ZFUULSU "Filterzeitkonstante für Lambda" VALUE 0x813A68 KwUw 655.34999985 zk10msxs_uw_b655 0.010000152590 655.36000000 FORMAT "%12.8" /end CHARACTERISTIC
/begin CHARACTERISTIC ZFV "Zeitkonstante für Filterung des Geschwindigkeitssignals" VALUE 0x813A8C KwUw 1310.6999997 zk20msxs_uw_b1310 0.020000305180 1310.7200000 FORMAT "%12.7" /end CHARACTERISTIC
/begin CHARACTERISTIC ZKBKVAB "Zeitkonstante Absteuerung Momentenreserve Katheizen für BKV" VALUE 0x819746 KwUb 25.4996 zk100msxs_ub_b25p5 0.100392 25.6000 FORMAT "%7.4" /end CHARACTERISTIC
/begin CHARACTERISTIC ZKMDKH "Filterzeitkonstante bei Wechsel von Teillast nach LL und umgekehrt" VALUE 0x819747 KwUb 25.4996 zk100msxs_ub_b25p5 0.100392 25.6000 FORMAT "%7.4" /end CHARACTERISTIC
/begin CHARACTERISTIC ZNWSP "Zeitkonstante für Adaption-Spätanschlagposition" VALUE 0x810B44 KwUb 99.61 rel_ub_b99p6 0.00 99.61 FORMAT "%5.2" /end CHARACTERISTIC
/begin CHARACTERISTIC ZPHFLBM1 "Nockenwellenflanken Nr. vor Bezugsmarke 1" VALUE 0x810B45 KwSb 255.0 dez -128.0 127.0 FORMAT "%5.1" /end CHARACTERISTIC
/begin MEASUREMENT bfzgl_b "Fahrzeuglängsbeschleunigung" SBYTE bfzg_sb_q0p217 1 100 -27.776 27.559 FORMAT "%5.2" ECU_ADDRESS 0x380965 /end MEASUREMENT
/begin MEASUREMENT bfzgl_w "Fahrzeugbeschleunigung in Längsrichtung" SWORD bfzg_sw_q4p239Em4 1 100 -13.8904 13.8899 ECU_ADDRESS 0x381CB4 /end MEASUREMENT
/begin MEASUREMENT B_0101_ack "" UBYTE B_TRUE 1 100 0 1 BIT_MASK 0x2 FORMAT "%13.11" ECU_ADDRESS 0x380A88 /end MEASUREMENT
/begin MEASUREMENT B_0101_ident "" UBYTE B_TRUE 1 100 0 1 BIT_MASK 0x1 FORMAT "%13.11" ECU_ADDRESS 0x380A88 /end MEASUREMENT
/begin MEASUREMENT B_0101_notadr "" UBYTE B_TRUE 1 100 0 1 BIT_MASK 0x8 FORMAT "%13.11" ECU_ADDRESS 0x380A88 /end MEASUREMENT
/begin MEASUREMENT B_0101_switch "" UBYTE B_TRUE 1 100 0 1 BIT_MASK 0x4 FORMAT "%13.11" ECU_ADDRESS 0x380A88 /end MEASUREMENT
/begin MEASUREMENT B_abll "Bedingung Abgleich im Leerlauf" UBYTE B_TRUE 1 100 0 1 BIT_MASK 0x1 FORMAT "%13.11" ECU_ADDRESS 0x380946 /end MEASUREMENT
/begin MEASUREMENT B_bwf "Bedingung: Bewegungserkennung hat Fehler erkannt" UWORD B_TRUE 1 100 0 1 BIT_MASK 0x1 FORMAT "%13.11" ECU_ADDRESS 0x381CE6 /end MEASUREMENT
/begin MEASUREMENT B_bwunpl "Bedingung Unplausibilität bei Bewegungserkennung" UWORD B_TRUE 1 100 0 1 BIT_MASK 0x2 FORMAT "%13.11" ECU_ADDRESS 0x381CE6 /end MEASUREMENT
/begin MEASUREMENT B_c95bf0 "Ansteuersignal zum Einstellen der Filtermittenfrequenz des CC195 (Pin BF0)" UWORD B_TRUE 1 100 0 1 BIT_MASK 0x100 FORMAT "%13.11" ECU_ADDRESS 0xFD6E /end MEASUREMENT
/begin MEASUREMENT B_c95bf1 "Ansteuersignal zum Einstellen der Filtermittenfrequenz des CC195 (Pin BF1)" UWORD B_TRUE 1 100 0 1 BIT_MASK 0x200 FORMAT "%13.11" ECU_ADDRESS 0xFD6E /end MEASUREMENT
/begin MEASUREMENT B_c95bf2 "Ansteuersignal zum Einstellen der Filtermittenfrequenz des CC195 (Pin BF2)" UWORD B_TRUE 1 100 0 1 BIT_MASK 0x400 FORMAT "%13.11" ECU_ADDRESS 0xFD6E /end MEASUREMENT
/begin MEASUREMENT B_c95bf3 "Ansteuersignal zum Eintstellen der Filtermittenfrequenz des CC195 (Pin BF3)" UWORD B_TRUE 1 100 0 1 BIT_MASK 0x800 FORMAT "%13.11" ECU_ADDRESS 0xFD6E /end MEASUREMENT
/begin MEASUREMENT B_c95ks3 "Ansteuersignal für den Nulltest des CC195" UWORD B_TRUE 1 100 0 1 BIT_MASK 0x1000 FORMAT "%13.11" ECU_ADDRESS 0xFD6E /end MEASUREMENT
/begin MEASUREMENT B_dnlubr "Bedingung Diagnoseprüfung im Steuergerätenachlauf für UBR durchgeführt" UBYTE B_TRUE 1 100 0 1 BIT_MASK 0x8 FORMAT "%13.11" ECU_ADDRESS 0x38095B /end MEASUREMENT
/begin MEASUREMENT B_dnt "Aktive Diagnose: Klopfregelung Nulltest" UWORD B_TRUE 1 100 0 1 BIT_MASK 0x2000 FORMAT "%13.11" ECU_ADDRESS 0xFD6E /end MEASUREMENT
/begin MEASUREMENT B_dntb "Bedingung Diagnose: Bereitschaft zum Nulltest (Nulltest im nächsten MF)" UWORD B_TRUE 1 100 0 1 BIT_MASK 0x4000 FORMAT "%13.11" ECU_ADDRESS 0xFD6E /end MEASUREMENT
/begin MEASUREMENT B_dtp "Aktive Diagnose: Klopfregelung Testimpuls" UWORD B_TRUE 1 100 0 1 BIT_MASK 0x8000 FORMAT "%13.11" ECU_ADDRESS 0xFD6E /end MEASUREMENT
/begin MEASUREMENT B_dtpb "Bedingung Diagnose: Bereitschaft zum Testpuls (Testpuls im nächsten MF)" UWORD B_TRUE 1 100 0 1 BIT_MASK 0x1 FORMAT "%13.11" ECU_ADDRESS 0xFD70 /end MEASUREMENT
/begin MEASUREMENT B_dubre "Bedingung Freigabe Diagnoseprüfung für UBR-Eingang (Versorgung über Hauptrelais)" UBYTE B_TRUE 1 100 0 1 BIT_MASK 0x1 FORMAT "%13.11" ECU_ADDRESS 0x38095B /end MEASUREMENT
/begin MEASUREMENT B_dupw "Bedingung Abweichung zwischen Poti 1 und 2 zu groß" UWORD B_TRUE 1 100 0 1 BIT_MASK 0x4 FORMAT "%13.11" ECU_ADDRESS 0x381CE6 /end MEASUREMENT
/begin MEASUREMENT B_dupw12 "Bedingung zulässige Abweichung zwischen PWG-Poti 1 und 2 überschritten" UWORD B_TRUE 1 100 0 1 BIT_MASK 0x8 FORMAT "%13.11" ECU_ADDRESS 0x381CE6 /end MEASUREMENT
/begin MEASUREMENT B_dveeson "Bedingung: DV-E-Endstufe ist eingeschaltet = P_dveeson" UWORD B_TRUE 1 100 0 1 BIT_MASK 0x800 FORMAT "%13.11" ECU_ADDRESS 0xFD6A /end MEASUREMENT
/begin MEASUREMENT B_enhlshk "Bedingung Freigabe Heizung Lambdasonde hinter Katalysator" UWORD B_TRUE 1 100 0 1 BIT_MASK 0x40 FORMAT "%13.11" ECU_ADDRESS 0xFD3A /end MEASUREMENT
/begin MEASUREMENT B_enhlsu "Bedingung Freigabe Heizung LSU" UWORD B_TRUE 1 100 0 1 BIT_MASK 0x80 FORMAT "%13.11" ECU_ADDRESS 0xFD96 /end MEASUREMENT
/begin MEASUREMENT B_enrinh "Bedingung enable für Ri-Nernst mit Filter hinter KAT" UWORD B_TRUE 1 100 0 1 BIT_MASK 0x8 FORMAT "%13.11" ECU_ADDRESS 0xFD34 /end MEASUREMENT
/begin MEASUREMENT B_erinofh "Bedingung enable für Ri-Nernst ohne Filter hinter KAT" UWORD B_TRUE 1 100 0 1 BIT_MASK 0x10 FORMAT "%13.11" ECU_ADDRESS 0xFD34 /end MEASUREMENT
/begin MEASUREMENT B_fmfkrc "Filtermittenfrequenz des CC195/CC650 umgeschaltet" UWORD B_TRUE 1 100 0 1 BIT_MASK 0x2 FORMAT "%13.11" ECU_ADDRESS 0xFD70 /end MEASUREMENT
/begin MEASUREMENT B_fmfkrco "Filtermittenfrequenz umgeschaltet, neue Frequenz ist höher" UWORD B_TRUE 1 100 0 1 BIT_MASK 0x4 FORMAT "%13.11" ECU_ADDRESS 0xFD70 /end MEASUREMENT
/begin MEASUREMENT B_fmfkrcu "Filtermittenfrequenz umgeschaltet, neue Frequenz ist kleiner" UWORD B_TRUE 1 100 0 1 BIT_MASK 0x8 FORMAT "%13.11" ECU_ADDRESS 0xFD70 /end MEASUREMENT
/begin MEASUREMENT B_fpwld "Flashprogrammierungswunsch Lüfter deaktivieren" UWORD B_TRUE 1 100 0 1 BIT_MASK 0x8 FORMAT "%13.11" ECU_ADDRESS 0xFD10 /end MEASUREMENT
/begin MEASUREMENT B_glf "Bedingung Gleichlauf zwischen Poti 1 und Poti 2 verletzt" UWORD B_TRUE 1 100 0 1 BIT_MASK 0x8000 FORMAT "%13.11" ECU_ADDRESS 0xFD3C /end MEASUREMENT
/begin MEASUREMENT B_hmx "Bedingung LSU maximal beheizt" UWORD B_TRUE 1 100 0 1 BIT_MASK 0x100 FORMAT "%13.11" ECU_ADDRESS 0xFD96 /end MEASUREMENT
/begin MEASUREMENT B_holp1 "Bedingung Hochohmigkeit im Leerlauf an PWG-Poti 1 erkannt" UWORD B_TRUE 1 100 0 1 BIT_MASK 0x10 FORMAT "%13.11" ECU_ADDRESS 0x381CE6 /end MEASUREMENT
/begin MEASUREMENT B_holp1a "Bedingung Hochohmigkeit im Leerlauf an PWG-Poti 1 im aktuellen Fahrzyklus" UWORD B_TRUE 1 100 0 1 BIT_MASK 0x20 FORMAT "%13.11" ECU_ADDRESS 0x381CE6 /end MEASUREMENT
/begin MEASUREMENT B_holp1l "Bedingung Hochohmigkeit im Leerlauf an PWG-Poti 1 im letzten Fahrzyklus" UBYTE B_TRUE 1 100 0 1 BIT_MASK 0x1 FORMAT "%13.11" ECU_ADDRESS 0x383328 /end MEASUREMENT
/begin MEASUREMENT B_holp2 "Bedingung Hochohmigkeit im Leerlauf an PWG-Poti 2 erkannt" UWORD B_TRUE 1 100 0 1 BIT_MASK 0x40 FORMAT "%13.11" ECU_ADDRESS 0x381CE6 /end MEASUREMENT
/begin MEASUREMENT B_holp2a "Bedingung Hochohmigkeit im Leerlauf an PWG-Poti 2 im aktuellen Fahrzyklus" UWORD B_TRUE 1 100 0 1 BIT_MASK 0x80 FORMAT "%13.11" ECU_ADDRESS 0x381CE6 /end MEASUREMENT
/begin MEASUREMENT B_holp2l "Bedingung Hochohmigkeit im Leerlauf an PWG-Poti 2 im letzten Fahrzyklus" UBYTE B_TRUE 1 100 0 1 BIT_MASK 0x2 FORMAT "%13.11" ECU_ADDRESS 0x383328 /end MEASUREMENT
/begin MEASUREMENT B_hop1mn "Bedingung Bereichsverletzung nach unten an Poti 1 in Hochohmigkeitsprüfung" UWORD B_TRUE 1 100 0 1 BIT_MASK 0x100 FORMAT "%13.11" ECU_ADDRESS 0x381CE6 /end MEASUREMENT
/begin MEASUREMENT B_hop2mn "Bedingung Bereichsverletzung nach unten an Poti 2 in Hochohmigkeitsprüfung" UWORD B_TRUE 1 100 0 1 BIT_MASK 0x200 FORMAT "%13.11" ECU_ADDRESS 0x381CE6 /end MEASUREMENT
/begin MEASUREMENT B_hopakt "Bedingung Hochohmigkeitsprüfung aktiv" UWORD B_TRUE 1 100 0 1 BIT_MASK 0x400 FORMAT "%13.11" ECU_ADDRESS 0x381CE6 /end MEASUREMENT
/begin MEASUREMENT B_hrevab "Anforderung EV-Abschaltung bei Hauptrelaisfehler" UBYTE B_TRUE 1 100 0 1 BIT_MASK 0x4 FORMAT "%13.11" ECU_ADDRESS 0x38095B /end MEASUREMENT
/begin MEASUREMENT B_hrkng "Bedingung Hauptrelaiskontakt nicht geschlossen" UBYTE B_TRUE 1 100 0 1 BIT_MASK 0x10 FORMAT "%13.11" ECU_ADDRESS 0x38095B /end MEASUREMENT
/begin MEASUREMENT B_hrkzlg "Bedingung Hauptrelaiskontakt zu langsam geschlossen" UBYTE B_TRUE 1 100 0 1 BIT_MASK 0x20 FORMAT "%13.11" ECU_ADDRESS 0x38095B /end MEASUREMENT
/begin MEASUREMENT B_hsha "Bedingung Sonde hinter Kat ausreichend beheizt" UWORD B_TRUE 1 100 0 1 BIT_MASK 0x80 FORMAT "%13.11" ECU_ADDRESS 0xFD3A /end MEASUREMENT
/begin MEASUREMENT B_hshe "Bedingung Endstufe Sondenheizung hinter Kat angesteuert" UWORD B_TRUE 1 100 0 1 BIT_MASK 0x100 FORMAT "%13.11" ECU_ADDRESS 0xFD3A /end MEASUREMENT
/begin MEASUREMENT B_hsv "Bedingung Heizung Sonde vor Kat einschaltbereit" UWORD B_TRUE 1 100 0 1 BIT_MASK 0x200 FORMAT "%13.11" ECU_ADDRESS 0xFD96 /end MEASUREMENT
/begin MEASUREMENT B_hsve "Bedingung Endstufe Sondenheizung vor Kat angesteuert" UWORD B_TRUE 1 100 0 1 BIT_MASK 0x400 FORMAT "%13.11" ECU_ADDRESS 0xFD96 /end MEASUREMENT
/begin MEASUREMENT B_kdhre "Bedingung Komponenten an Hauptrelais zur Diagnose UBR einschalten" UBYTE B_TRUE 1 100 0 1 BIT_MASK 0x2 FORMAT "%13.11" ECU_ADDRESS 0x38095B /end MEASUREMENT
/begin MEASUREMENT B_kl15 "Bedingung Klemme 15" UWORD B_TRUE 1 100 0 1 BIT_MASK 0x1 FORMAT "%13.11" ECU_ADDRESS 0xFD90 /end MEASUREMENT
/begin MEASUREMENT B_ldpi "Bedingung Reed-Kontakt Leckdiagnosepumpe" UWORD B_TRUE 1 100 0 1 BIT_MASK 0x1000 FORMAT "%13.11" ECU_ADDRESS 0xFD6A /end MEASUREMENT
/begin MEASUREMENT B_lsuab "Bedingung Abgleich stetige Lambda-Sonde LSU" UWORD B_TRUE 1 100 0 1 BIT_MASK 0x1 FORMAT "%13.11" ECU_ADDRESS 0xFD3A /end MEASUREMENT
/begin MEASUREMENT B_luv "" UWORD B_TRUE 1 100 0 1 BIT_MASK 0x2000 FORMAT "%13.11" ECU_ADDRESS 0xFD6A /end MEASUREMENT
/begin MEASUREMENT B_mbvh "Bedingung Mißbrauchsverhinderung" UWORD B_TRUE 1 100 0 1 BIT_MASK 0x1 FORMAT "%13.11" ECU_ADDRESS 0xFD3E /end MEASUREMENT
/begin MEASUREMENT B_nputm "Bedingung: Motortemperatursignal im unteren Bereich nicht plausibel ggü. Modell" UBYTE B_TRUE 1 100 0 1 BIT_MASK 0x2 FORMAT "%13.11" ECU_ADDRESS 0x3848A7 /end MEASUREMENT
/begin MEASUREMENT B_ntini "KR: Bedingung für Initialisierungs-Nulltest" UWORD B_TRUE 1 100 0 1 BIT_MASK 0x10 FORMAT "%13.11" ECU_ADDRESS 0xFD70 /end MEASUREMENT
/begin MEASUREMENT B_nwflad "Bedingung Flankenadaption Geber 1 angefordert" UBYTE B_TRUE 1 100 0 1 BIT_MASK 0x1 FORMAT "%13.11" ECU_ADDRESS 0x38091C /end MEASUREMENT
/begin MEASUREMENT B_nwie "Auszuwertender Einlaß-NW-Interrupt liegt vor (Einlaß)" UBYTE B_TRUE 1 100 0 1 BIT_MASK 0x8 FORMAT "%13.11" ECU_ADDRESS 0x383315 /end MEASUREMENT
/begin MEASUREMENT B_pbpabr "Bedingung: Plausibilitätbegrenzung ""Bremse/PWG"" aktivieren über Bremse" UWORD B_TRUE 1 100 0 1 BIT_MASK 0x2 FORMAT "%13.11" ECU_ADDRESS 0xFD3E /end MEASUREMENT
/begin MEASUREMENT B_phad "Adaption Kurbel/Nockenwelle erfolgt" UBYTE B_TRUE 1 100 0 1 BIT_MASK 0x10 FORMAT "%13.11" ECU_ADDRESS 0x383315 /end MEASUREMENT
/begin MEASUREMENT B_phade "Adaption Kurbel/Einlaßnockenwelle erfolgt" UBYTE B_TRUE 1 100 0 1 BIT_MASK 0x80 FORMAT "%13.11" ECU_ADDRESS 0x383315 /end MEASUREMENT
/begin MEASUREMENT B_phgefl "Bedingung, dass Phasenflanke ausgewertet wird" UBYTE B_TRUE 1 100 0 1 BIT_MASK 0x1 FORMAT "%13.11" ECU_ADDRESS 0x38091B /end MEASUREMENT
/begin MEASUREMENT B_phnmo "Bedingung für Umschaltung auf Auswertung von einer Phasenflanke" UBYTE B_TRUE 1 100 0 1 BIT_MASK 0x4 FORMAT "%13.11" ECU_ADDRESS 0x38091B /end MEASUREMENT
/begin MEASUREMENT B_phnmu "Bedingung für Umschaltung auf Auswertung von 2 Phasenflanken" UBYTE B_TRUE 1 100 0 1 BIT_MASK 0x8 FORMAT "%13.11" ECU_ADDRESS 0x38091B /end MEASUREMENT
/begin MEASUREMENT B_priph "Bedingung Port schalten für Pumpimpuls hinter KAT" UWORD B_TRUE 1 100 0 1 BIT_MASK 0x20 FORMAT "%13.11" ECU_ADDRESS 0xFD34 /end MEASUREMENT
/begin MEASUREMENT B_pullup "Bedingung Pullup-Widerstand für NTC zugeschaltet" UBYTE B_TRUE 1 100 0 1 BIT_MASK 0x1 FORMAT "%13.11" ECU_ADDRESS 0x3848A7 /end MEASUREMENT
/begin MEASUREMENT B_pump "Bedingung Starten des Timers TTGLS" UWORD B_TRUE 1 100 0 1 BIT_MASK 0x40 FORMAT "%13.11" ECU_ADDRESS 0xFD34 /end MEASUREMENT
/begin MEASUREMENT B_pwgbwf "Bedingung PWG-Bewegungsfehler" UBYTE B_TRUE 1 100 0 1 BIT_MASK 0x80 FORMAT "%13.11" ECU_ADDRESS 0x380973 /end MEASUREMENT
/begin MEASUREMENT B_pwglk "Bedingung Lebenderkennung PWG" UWORD B_TRUE 1 100 0 1 BIT_MASK 0x2000 FORMAT "%13.11" ECU_ADDRESS 0x381CE6 /end MEASUREMENT
/begin MEASUREMENT B_pwgnotfr "FR-Fehlerreaktion PWG-Notfahren" UWORD B_TRUE 1 100 0 1 BIT_MASK 0x4 FORMAT "%13.11" ECU_ADDRESS 0xFD3E /end MEASUREMENT
/begin MEASUREMENT B_rehs "Restart Sondenheizung" UWORD B_TRUE 1 100 0 1 BIT_MASK 0x200 FORMAT "%13.11" ECU_ADDRESS 0xFD3A /end MEASUREMENT
/begin MEASUREMENT B_riakh "Bedingung für Strom-Pumpen aktualisiert hinter KAT" UWORD B_TRUE 1 100 0 1 BIT_MASK 0x80 FORMAT "%13.11" ECU_ADDRESS 0xFD34 /end MEASUREMENT
/begin MEASUREMENT B_ribeh "Bedingung Innenwiderstand Ri berechnen für Sonde hinter KAT" UWORD B_TRUE 1 100 0 1 BIT_MASK 0x100 FORMAT "%13.11" ECU_ADDRESS 0xFD34 /end MEASUREMENT
/begin MEASUREMENT B_riibh "Bedingung Sondenspannung im zulässigen Band für Strompumpen hinter KAT" UWORD B_TRUE 1 100 0 1 BIT_MASK 0x200 FORMAT "%13.11" ECU_ADDRESS 0xFD34 /end MEASUREMENT
/begin MEASUREMENT B_riimph "Bedingung Impuls für Strom-Pumpen hinter KAT" UWORD B_TRUE 1 100 0 1 BIT_MASK 0x400 FORMAT "%13.11" ECU_ADDRESS 0xFD34 /end MEASUREMENT
/begin MEASUREMENT B_rimh "Bedingung (ADC-Trigger) für Messen belastete Sondenspannung hinter KAT" UWORD B_TRUE 1 100 0 1 BIT_MASK 0x800 FORMAT "%13.11" ECU_ADDRESS 0xFD34 /end MEASUREMENT
/begin MEASUREMENT B_rinh "Bedingung Innenwiderstand Ri-Messung der Nernstsonde aktiv hinter Kat" UWORD B_TRUE 1 100 0 1 BIT_MASK 0x1000 FORMAT "%13.11" ECU_ADDRESS 0xFD34 /end MEASUREMENT
/begin MEASUREMENT B_ripuh "Bedingung Strom-Pumpen für Sonde hinter KAT" UWORD B_TRUE 1 100 0 1 BIT_MASK 0x2000 FORMAT "%13.11" ECU_ADDRESS 0xFD34 /end MEASUREMENT
/begin MEASUREMENT B_rireh "Bedingung Resultat für Innenwiderstand Ri für Sonde hinter KAT" UWORD B_TRUE 1 100 0 1 BIT_MASK 0x4000 FORMAT "%13.11" ECU_ADDRESS 0xFD34 /end MEASUREMENT
/begin MEASUREMENT B_risph "Bedingung Sondensprung hinter KAT" UWORD B_TRUE 1 100 0 1 BIT_MASK 0x8000 FORMAT "%13.11" ECU_ADDRESS 0xFD34 /end MEASUREMENT
/begin MEASUREMENT B_sbblsu "Bedingung LSU betriebsbereit vor Kat f(lamsons_w)" UWORD B_TRUE 1 100 0 1 BIT_MASK 0x2 FORMAT "%13.11" ECU_ADDRESS 0xFD3A /end MEASUREMENT
/begin MEASUREMENT B_sbbvk "Bedingung Sonde betriebsbereit vor Kat" UWORD B_TRUE 1 100 0 1 BIT_MASK 0x4 FORMAT "%13.11" ECU_ADDRESS 0xFD3A /end MEASUREMENT
/begin MEASUREMENT B_shuerf "Bedingung Sondenspannung hinter KAT erfassen" UWORD B_TRUE 1 100 0 1 BIT_MASK 0x1 FORMAT "%13.11" ECU_ADDRESS 0xFD36 /end MEASUREMENT
/begin MEASUREMENT B_sp1s "Mitteilung an SR: SP1S ist Führungsgröße." UWORD B_TRUE 1 100 0 1 BIT_MASK 0x8 FORMAT "%13.11" ECU_ADDRESS 0xFD3E /end MEASUREMENT
/begin MEASUREMENT B_sp2s "Mitteilung an SR:Poti2 SP2S Führungsgröße,Poti1 Ober-oder Untergrenze überschr." UWORD B_TRUE 1 100 0 1 BIT_MASK 0x10 FORMAT "%13.11" ECU_ADDRESS 0xFD3E /end MEASUREMENT
/begin MEASUREMENT B_spsa "Bedingung Winkeladaption Kurbel- zu Nockenwelle zulässig" UBYTE B_TRUE 1 100 0 1 BIT_MASK 0x10 FORMAT "%13.11" ECU_ADDRESS 0x38091B /end MEASUREMENT
/begin MEASUREMENT B_spsmin "Mitteilung an SR: '1'= PWG-Notfahren mit SPSMIN" UWORD B_TRUE 1 100 0 1 BIT_MASK 0x20 FORMAT "%13.11" ECU_ADDRESS 0xFD3E /end MEASUREMENT
/begin MEASUREMENT B_sweb "Bedingung: Schlechtwegsignal betriebsbereit" UWORD B_TRUE 1 100 0 1 BIT_MASK 0x800 FORMAT "%13.11" ECU_ADDRESS 0xFD26 /end MEASUREMENT
/begin MEASUREMENT B_swe_p "Bedingung Schlechtwegstrecke erkannt über PWM-Signal über CAN (vom ABS-SG)" UWORD B_TRUE 1 100 0 1 BIT_MASK 0x1000 FORMAT "%13.11" ECU_ADDRESS 0xFD26 /end MEASUREMENT
/begin MEASUREMENT B_tabgs "Bedingung Abgleich stetige Lambda-Sonde LSU nach Start" UBYTE B_TRUE 1 100 0 1 BIT_MASK 0x4 FORMAT "%13.11" ECU_ADDRESS 0x380946 /end MEASUREMENT
/begin MEASUREMENT B_tevtini "TEV timer wurde neu initialisiert" UWORD B_TRUE 1 100 0 1 BIT_MASK 0x1000 FORMAT "%13.11" ECU_ADDRESS 0xFD9C /end MEASUREMENT
/begin MEASUREMENT B_tmmn "Bedingung: Blockheater erkannt" UWORD B_TRUE 1 100 0 1 BIT_MASK 0x20 FORMAT "%13.11" ECU_ADDRESS 0xFD6A /end MEASUREMENT
/begin MEASUREMENT B_tmsrt "Bedingung Retriggerung Motortemperaturmodell nach Start" UWORD B_TRUE 1 100 0 1 BIT_MASK 0x40 FORMAT "%13.11" ECU_ADDRESS 0xFD6A /end MEASUREMENT
/begin MEASUREMENT B_tpnt_aw "KR: Auswahl Nulltest oder Testimpuls" UWORD B_TRUE 1 100 0 1 BIT_MASK 0x20 FORMAT "%13.11" ECU_ADDRESS 0xFD70 /end MEASUREMENT
/begin MEASUREMENT B_tpnt_e "KR: Nulltest/Testimpuls freigegeben" UWORD B_TRUE 1 100 0 1 BIT_MASK 0x40 FORMAT "%13.11" ECU_ADDRESS 0xFD70 /end MEASUREMENT
/begin MEASUREMENT B_ubrdmn1 "Bedingung Bordnetzspannung über Hauptrelais kleiner UBRDMN1" UWORD B_TRUE 1 100 0 1 BIT_MASK 0x400 FORMAT "%13.11" ECU_ADDRESS 0xFD3A /end MEASUREMENT
/begin MEASUREMENT B_ubrdmn2 "Bedingung Bordnetzspannung über Hauptrelais größer UBRDMN2" UWORD B_TRUE 1 100 0 1 BIT_MASK 0x800 FORMAT "%13.11" ECU_ADDRESS 0xFD3A /end MEASUREMENT
/begin MEASUREMENT B_ubrk "Bedingung Hauptrelais Kontaktfehler" UWORD B_TRUE 1 100 0 1 BIT_MASK 0x1000 FORMAT "%13.11" ECU_ADDRESS 0xFD3A /end MEASUREMENT
/begin MEASUREMENT B_ubrmax "Bedingung Bordnetzspannung über Hauptrelais höher als UBRDMX" UWORD B_TRUE 1 100 0 1 BIT_MASK 0x2000 FORMAT "%13.11" ECU_ADDRESS 0xFD3A /end MEASUREMENT
/begin MEASUREMENT B_ubru "Bedingung Unterbrechung zur Bordnetzversorgung über Hauptrelais" UBYTE B_TRUE 1 100 0 1 BIT_MASK 0x1 FORMAT "%13.11" ECU_ADDRESS 0x383326 /end MEASUREMENT
/begin MEASUREMENT B_up2bwf "Bewegungsfehler an Poti 2 bei Abschluß der Bewegungserkennung" UWORD B_TRUE 1 100 0 1 BIT_MASK 0x4000 FORMAT "%13.11" ECU_ADDRESS 0x381CE6 /end MEASUREMENT
/begin MEASUREMENT B_upw12e "Bedingung: Fehler bei Vergleich der beiden normierten PWG-Poti-Spannungen" UBYTE B_TRUE 1 100 0 1 BIT_MASK 0x4 FORMAT "%13.11" ECU_ADDRESS 0x380973 /end MEASUREMENT
/begin MEASUREMENT B_upw1mn "Bedingung: Spannung PWG-Poti 1 unterhalb Minimalwert" UBYTE B_TRUE 1 100 0 1 BIT_MASK 0x8 FORMAT "%13.11" ECU_ADDRESS 0x380973 /end MEASUREMENT
/begin MEASUREMENT B_upw1mx "Bedingung: Spannung PWG-Poti 1 oberhalb Maximalwert" UBYTE B_TRUE 1 100 0 1 BIT_MASK 0x10 FORMAT "%13.11" ECU_ADDRESS 0x380973 /end MEASUREMENT
/begin MEASUREMENT B_upw2mn "Bedingung: Spannung PWG-Poti 2 unterhalb Minimalwert" UBYTE B_TRUE 1 100 0 1 BIT_MASK 0x20 FORMAT "%13.11" ECU_ADDRESS 0x380973 /end MEASUREMENT
/begin MEASUREMENT B_upw2mx "Bedingung: Spannung PWG-Poti 2 oberhalb Maximalwert" UBYTE B_TRUE 1 100 0 1 BIT_MASK 0x40 FORMAT "%13.11" ECU_ADDRESS 0x380973 /end MEASUREMENT
/begin MEASUREMENT B_upwbwf "Bewegungserkennung hat im aktuellen Fahrzyklus einen Fehler erkannt" UWORD B_TRUE 1 100 0 1 BIT_MASK 0x40 FORMAT "%13.11" ECU_ADDRESS 0xFD3E /end MEASUREMENT
/begin MEASUREMENT B_upwg1o "Bedingung Bereichsverletzung an PWG-Poti 1 nach oben" UWORD B_TRUE 1 100 0 1 BIT_MASK 0x800 FORMAT "%13.11" ECU_ADDRESS 0x381CE6 /end MEASUREMENT
/begin MEASUREMENT B_upwg1u "Bedingung Bereichsverletzung an PWG-Poti 1 nach unten" UWORD B_TRUE 1 100 0 1 BIT_MASK 0x1000 FORMAT "%13.11" ECU_ADDRESS 0x381CE6 /end MEASUREMENT
/begin MEASUREMENT B_upwg2o "Bedingung Bereichsverletzung an PWG-Poti 2 nach oben" UBYTE B_TRUE 1 100 0 1 BIT_MASK 0x1 FORMAT "%13.11" ECU_ADDRESS 0x380973 /end MEASUREMENT
/begin MEASUREMENT B_upwg2u "Bedingung Bereichsverletzung an PWG-Poti 2 nach unten" UBYTE B_TRUE 1 100 0 1 BIT_MASK 0x2 FORMAT "%13.11" ECU_ADDRESS 0x380973 /end MEASUREMENT
/begin MEASUREMENT B_usbeh "Bedingung für Zeitzähler zur Ausblendung der Sondenbelastung hinter KAT" UWORD B_TRUE 1 100 0 1 BIT_MASK 0x2 FORMAT "%13.11" ECU_ADDRESS 0xFD36 /end MEASUREMENT
/begin MEASUREMENT B_vnull "Bedingung Fahrzeug steht" UWORD B_TRUE 1 100 0 1 BIT_MASK 0x4 FORMAT "%13.11" ECU_ADDRESS 0xFD3C /end MEASUREMENT
/begin MEASUREMENT B_vpwgerr "Bedingung: Verdacht auf PWG-Fehler" UWORD B_TRUE 1 100 0 1 BIT_MASK 0x80 FORMAT "%13.11" ECU_ADDRESS 0xFD3E /end MEASUREMENT
/begin MEASUREMENT B_wnwiout "Bedingung: Winkeldifferenz wnwi_ad_w nicht plausibel" UBYTE B_TRUE 1 100 0 1 BIT_MASK 0x40 FORMAT "%13.11" ECU_ADDRESS 0x38091B /end MEASUREMENT
/begin MEASUREMENT B_wpabnb "Bedingung Änderungsbegrenzung des Pedalwerts nach Bremsbetätigung" UWORD B_TRUE 1 100 0 1 BIT_MASK 0x100 FORMAT "%13.11" ECU_ADDRESS 0xFD3E /end MEASUREMENT
/begin MEASUREMENT B_wpmbbr "Bedingung Maximalbegrenzung des Pedalwerts bei Bremsbetätigung" UWORD B_TRUE 1 100 0 1 BIT_MASK 0x200 FORMAT "%13.11" ECU_ADDRESS 0xFD3E /end MEASUREMENT
/begin MEASUREMENT B_wu "Flagge Verzögerungszeit TVLSUWU abgelaufen" UWORD B_TRUE 1 100 0 1 BIT_MASK 0x800 FORMAT "%13.11" ECU_ADDRESS 0xFD96 /end MEASUREMENT
/begin MEASUREMENT B_znptm "Bedingung: Zyklusflag-Freigabe von Unplausibilitätsprüfung TMOT-Signal" UBYTE B_TRUE 1 100 0 1 BIT_MASK 0x4 FORMAT "%13.11" ECU_ADDRESS 0x3848A7 /end MEASUREMENT
/begin MEASUREMENT B_zsitm "Bedingung: Zyklusflag-Freigabe von Signalfehlerprüfung TMOT-Signal" UBYTE B_TRUE 1 100 0 1 BIT_MASK 0x8 FORMAT "%13.11" ECU_ADDRESS 0x3848A7 /end MEASUREMENT
/begin MEASUREMENT ctrbwf "Fehlerzähler Bewegungserkennung" UBYTE dez 1 100 0 255 FORMAT "%5.1" ECU_ADDRESS 0x380971 /end MEASUREMENT
/begin MEASUREMENT ctr_MD5Block "" UWORD dez 1 100 0 65535 FORMAT "%8.2" ECU_ADDRESS 0x382728 /end MEASUREMENT
/begin MEASUREMENT dist_w "Zurückgelegte Strecke" UWORD dist_uw_q0p1 1 100 0 6553.5 FORMAT "%8.3" ECU_ADDRESS 0x381CB6 /end MEASUREMENT
/begin MEASUREMENT dlam_w "delta Lambda, Abweichung von Lambda 1" SWORD fak_sw_b8 1 100 -8 7.99976 FORMAT "%8.6" ECU_ADDRESS 0x381B18 /end MEASUREMENT
/begin MEASUREMENT dmnpbkv_w "Delta um das modellierter Bremskraftverstärkerdruck minimiert wird" SWORD pgrad_q0p15625 1 100 -5120 5119.84 FORMAT "%8.3" ECU_ADDRESS 0x3853C4 /end MEASUREMENT
/begin MEASUREMENT dmrdsls_w "Momentenreserve für Diagnose Sekundärluft" UWORD rel_uw_b100 1 100 0 99.9985 FORMAT "%8.5" ECU_ADDRESS 0x384BBC /end MEASUREMENT
/begin MEASUREMENT dmrkh "Momenten-Reserve für Katheizen" UBYTE rel_ub_b99p6 1 100 0 99.6094 FORMAT "%5.2" ECU_ADDRESS 0x3848BB /end MEASUREMENT
/begin MEASUREMENT dmrkhz_w "Momentenreserve für Katheizen" UWORD rel_uw_b100 1 100 0 99.9985 FORMAT "%8.5" ECU_ADDRESS 0x384BBE /end MEASUREMENT
/begin MEASUREMENT dmrkh_w "Momentenreserve für Katheizen" UWORD rel_uw_b100 1 100 0 99.9985 FORMAT "%8.5" ECU_ADDRESS 0x384BC0 /end MEASUREMENT
/begin MEASUREMENT dmxpbkv_w "Delta um das modellierter Bremskraftverstärkerdruck vergrößert wird" UWORD pgrad_q0p15625 1 100 0 10239.8 FORMAT "%8.2" ECU_ADDRESS 0x3853C6 /end MEASUREMENT
/begin MEASUREMENT dpbkvep_w "Druckgradient während Evakuierung des BKV durch el. Pumpe" SWORD pgrad_q0p039 1 100 -1280 1279.96 FORMAT "%8.3" ECU_ADDRESS 0x3853C8 /end MEASUREMENT
/begin MEASUREMENT dpbkvmx_w "Faktor Druckgradient für Berechnung von dmxpbkv_w" UWORD fak_uw_b8 1 100 0 7.99988 FORMAT "%8.6" ECU_ADDRESS 0x3853CA /end MEASUREMENT
/begin MEASUREMENT dpbkvps_w "Druckgradient während Evakuierung des BKV durch ps" SWORD pgrad_q0p039 1 100 -1280 1279.96 FORMAT "%8.3" ECU_ADDRESS 0x3853CC /end MEASUREMENT
/begin MEASUREMENT dpbkvsp_w "Druckgradient während Evakuierung des BKV durch Saugstrahlpumpe" SWORD pgrad_q0p039 1 100 -1280 1279.96 FORMAT "%8.3" ECU_ADDRESS 0x3853CE /end MEASUREMENT
/begin MEASUREMENT dpbkvu_w "Differenz zwischen Bremskraftverstärker-Druck und Umgebungsdruck" UWORD p_uw_q0p039 1 100 0 2559.96 FORMAT "%8.3" ECU_ADDRESS 0x3853D0 /end MEASUREMENT
/begin MEASUREMENT dpspvdkd_w "Delta zwischen Saugrohrdruck und Druck vor Drosselklappe" UWORD p_uw_q0p039 1 100 0 2559.96 FORMAT "%8.3" ECU_ADDRESS 0x3853D2 /end MEASUREMENT
/begin MEASUREMENT drkwtmp_w "Momentenreserve für Kat warmhalten, zeitweise" UWORD rel_uw_b100 1 100 0 99.9985 FORMAT "%8.5" ECU_ADDRESS 0x384BC2 /end MEASUREMENT
/begin MEASUREMENT dwped "Gradient des normierten Fahrpedalwinkels" SBYTE rel_sb_q0p39 1 100 -49.9968 49.6062 FORMAT "%5.2" ECU_ADDRESS 0x380972 /end MEASUREMENT
/begin MEASUREMENT dwped_w "Gradient des normierten Fahrpedalwinkels" SWORD rel_sw_b50 1 100 -50 49.9985 FORMAT "%8.5" ECU_ADDRESS 0x381CE4 /end MEASUREMENT
/begin MEASUREMENT flamsls "Faktor Lambdaänderung durch Sekundärluft" UBYTE fak_ub_b1p25_o0p75 1 100 0.75 1.24805 FORMAT "%5.3" ECU_ADDRESS 0x380945 /end MEASUREMENT
/begin MEASUREMENT fmfkrakt "Mittenfrequenz für Bandpaßfilter Klopfregelung" UBYTE fmfkr_dez 1 100 0 255 FORMAT "%5.1" ECU_ADDRESS 0x380A1C /end MEASUREMENT
/begin MEASUREMENT fmfkraktol "Mittenfrequenz für Bandpaßfilter Klopfregelung, alter Wert" UBYTE fmfkr_dez 1 100 0 255 FORMAT "%5.1" ECU_ADDRESS 0x380A1D /end MEASUREMENT
/begin MEASUREMENT fmkhfho_w "Höhenkorrektur der Drehmomentenreserve bei Katheizen" UWORD fak_uw_b2 1 100 0 1.99997 FORMAT "%8.6" ECU_ADDRESS 0x384BC4 /end MEASUREMENT
/begin MEASUREMENT fmkhtmst "tmst-Korrektur der Drehmomentreserve bei Katheizen" UBYTE fak_ub_b2 1 100 0 1.99219 FORMAT "%5.3" ECU_ADDRESS 0x3848BC /end MEASUREMENT
/begin MEASUREMENT fvst_w "Faktor Vorsteuerung" UWORD fak_uw_b64 1 100 0 63.999 FORMAT "%8.5" ECU_ADDRESS 0x38209E /end MEASUREMENT
/begin MEASUREMENT GGLSUBits "" UBYTE dez 1 100 0 255 FORMAT "%5.1" ECU_ADDRESS 0x380946 /end MEASUREMENT
/begin MEASUREMENT GGPEDlokbits "" UWORD dez 1 100 0 65535 FORMAT "%8.2" ECU_ADDRESS 0x381CE6 /end MEASUREMENT
/begin MEASUREMENT GGPEDlokbits2 "" UBYTE dez 1 100 0 255 FORMAT "%5.1" ECU_ADDRESS 0x380973 /end MEASUREMENT
/begin MEASUREMENT GGPEDnonVolbits "" UBYTE dez 1 100 0 255 FORMAT "%5.1" ECU_ADDRESS 0x383328 /end MEASUREMENT
/begin MEASUREMENT GGUBRausbits "" UBYTE dez 1 100 0 255 FORMAT "%5.1" ECU_ADDRESS 0x38095B /end MEASUREMENT
/begin MEASUREMENT GGUBRausbitsNOV1 "" UBYTE dez 1 100 0 255 FORMAT "%5.1" ECU_ADDRESS 0x383326 /end MEASUREMENT
/begin MEASUREMENT hlsukor "Korrekturfaktor für die LSU-Heizung" UBYTE fak_ub_b2 1 100 0 1.99219 FORMAT "%5.3" ECU_ADDRESS 0x384024 /end MEASUREMENT
/begin MEASUREMENT igod_w "Integratorgradient für Nulltest-Diagnose Klopfregelung" SWORD tknockintgrad_sy 1 100 -3661.82 3661.71 FORMAT "%8.3" ECU_ADDRESS 0x382306 /end MEASUREMENT
/begin MEASUREMENT igokr_w "Integratorgradient für Offsetkorrektur Klopfregelung (Word)" SWORD tknockintgrad_sy 1 100 -3661.82 3661.71 FORMAT "%8.3" ECU_ADDRESS 0x382308 /end MEASUREMENT
/begin MEASUREMENT ikr "Integratorwert Klopfregelung offsetkorrigiert" UBYTE spg_ub_b5 1 100 0 4.98047 FORMAT "%5.3" ARRAY_SIZE 8 ECU_ADDRESS 0xE426 /end MEASUREMENT
/begin MEASUREMENT ikrma "Integratorwert Klopfregelung Meßfensteranfang" UBYTE spg_ub_b5 1 100 0 4.98047 FORMAT "%5.3" ECU_ADDRESS 0x380A1E /end MEASUREMENT
/begin MEASUREMENT ikrme "Integratorwert Klopfregelung Meßfensterende" UBYTE spg_ub_b5 1 100 0 4.98047 FORMAT "%5.3" ARRAY_SIZE 8 ECU_ADDRESS 0xE42E /end MEASUREMENT
/begin MEASUREMENT ikrmen "Integratorwert Klopfregelung Meßfensterende Nulltest" UBYTE spg_ub_b5 1 100 0 4.98047 FORMAT "%5.3" ECU_ADDRESS 0x380A1F /end MEASUREMENT
/begin MEASUREMENT ikrmet "Integratorwert Klopfregelung Meßfensterende Testimpuls" UBYTE spg_ub_b5 1 100 0 4.98047 FORMAT "%5.3" ECU_ADDRESS 0x380A20 /end MEASUREMENT
/begin MEASUREMENT ikr_tst "Integratorwert Klopfregelung offsetkorrigiert rollierend mit Zyl.zähler" UBYTE spg_ub_b5 1 100 0 4.98047 FORMAT "%5.3" ECU_ADDRESS 0x380A21 /end MEASUREMENT
/begin MEASUREMENT iokkr "Integratoroffsetkorrektur Klopfregelung" UBYTE spg_ub_b5 1 100 0 4.98047 FORMAT "%5.3" ECU_ADDRESS 0x380A22 /end MEASUREMENT
/begin MEASUREMENT iplsuvj_w "Pumpstrom IP LSU" UWORD dez 1 100 0 65535 FORMAT "%8.2" ECU_ADDRESS 0x384A3A /end MEASUREMENT
/begin MEASUREMENT iplsu_w "Pumpstrom IP LSU" SWORD i_q0p0039_mA 1 100 -128 127.996 FORMAT "%8.4" ECU_ADDRESS 0x384A3C /end MEASUREMENT
/begin MEASUREMENT korrfak "" UBYTE fak_ub_b2 1 100 0 1.99219 FORMAT "%5.3" ECU_ADDRESS 0x3848A8 /end MEASUREMENT
/begin MEASUREMENT ks_sym "Eingang des Klopfauswerte-IC" UBYTE dez 1 100 0 255 FORMAT "%5.1" ARRAY_SIZE 4 ECU_ADDRESS 0xE436 /end MEASUREMENT
/begin MEASUREMENT kusvk_w "Korrekturwert der LSU-Spannung vor Kat" SWORD spg_sw_q0p00488 1 100 -160 159.995 FORMAT "%8.4" ECU_ADDRESS 0x383C52 /end MEASUREMENT
/begin MEASUREMENT kwp71_bits "" UBYTE dez 1 100 0 255 FORMAT "%5.1" ECU_ADDRESS 0x380A88 /end MEASUREMENT
/begin MEASUREMENT lalsuvj_w "Lambda-Istwert für Scan Tool" UWORD fak_uw_b2 1 100 0 1.99997 FORMAT "%8.6" ECU_ADDRESS 0x384A3E /end MEASUREMENT
/begin MEASUREMENT lamsonb_w "Basis-Lambda Istwert" UWORD fak_uw_b16 1 100 0 15.9998 FORMAT "%8.5" ECU_ADDRESS 0x381B1A /end MEASUREMENT
/begin MEASUREMENT lamsoni_w "Lambda-Istwert" UWORD fak_uw_b16 1 100 0 15.9998 FORMAT "%8.5" ECU_ADDRESS 0x381B1C /end MEASUREMENT
/begin MEASUREMENT mifakh_w "indiziertes Motormoment für Katheizen" UWORD rel_uw_b100 1 100 0 99.9985 FORMAT "%8.5" ECU_ADDRESS 0x384BC6 /end MEASUREMENT
/begin MEASUREMENT mifamx_w "maximales indiziertes Motormoment Fahrerwunsch im PWG-Notfahren" UWORD rel_uw_b100 1 100 0 99.9985 FORMAT "%8.5" ECU_ADDRESS 0x384A88 /end MEASUREMENT
/begin MEASUREMENT mkfamx_w "maximales Kupplungsmoment Fahrerwunsch im PWG-Notfahren" UWORD rel_uw_b100 1 100 0 99.9985 FORMAT "%8.5" ECU_ADDRESS 0x384A8A /end MEASUREMENT
/begin MEASUREMENT mll1 "Luftmassenfluß bezogen auf lambda=1" UBYTE m_ub_b1020 1 100 0 1020 FORMAT "%5.0" ECU_ADDRESS 0x3848A9 /end MEASUREMENT
/begin MEASUREMENT mulres_w "Korrekturfaktor für Umgebungsdruck und Starttemperatur" UWORD fak_uw_b4 1 100 0 3.99994 FORMAT "%8.6" ECU_ADDRESS 0x384BC8 /end MEASUREMENT
/begin MEASUREMENT padlsu_w "Abgasgegendruck (Differenz gg. Umgebung)" UWORD p_uw_q0p039 1 100 0 2559.96 FORMAT "%8.3" ECU_ADDRESS 0x384A40 /end MEASUREMENT
/begin MEASUREMENT palsu_w "Absolutdruck Abgassystem" UWORD p_uw_q0p039 1 100 0 2559.96 FORMAT "%8.3" ECU_ADDRESS 0x384A42 /end MEASUREMENT
/begin MEASUREMENT pbkv "Bremskraftverstärker-Druck" UBYTE p_ub_q5 1 100 0 1275 FORMAT "%5.0" ECU_ADDRESS 0x380B8F /end MEASUREMENT
/begin MEASUREMENT pbkvmod_w "Bremskraftverstärkerdruck modelliert" UWORD p_uw_q0p039 1 100 0 2559.96 FORMAT "%8.3" ECU_ADDRESS 0x3853D4 /end MEASUREMENT
/begin MEASUREMENT pbkvmpu_w "Druckverhältnis pbkvmod_w/pubkv_w" UWORD fak_uw_b2 1 100 0 1.99997 FORMAT "%8.6" ECU_ADDRESS 0x3853D6 /end MEASUREMENT
/begin MEASUREMENT pbkvpmn_w "min. Druck druch elektrische Bremskraftverstärkerpumpe" UWORD p_uw_q0p039 1 100 0 2559.96 FORMAT "%8.3" ECU_ADDRESS 0x3853D8 /end MEASUREMENT
/begin MEASUREMENT pbkv_w "Bremskraftverstärker-Druck" UWORD p_uw_q0p039 1 100 0 2559.96 FORMAT "%8.3" ECU_ADDRESS 0x382D3A /end MEASUREMENT
/begin MEASUREMENT phlsnh "normierte Heizleistung der Lambdasonde hinter Kat" UBYTE fak_ub_q0p01 1 100 0 2.55 FORMAT "%5.3" ECU_ADDRESS 0x384851 /end MEASUREMENT
/begin MEASUREMENT psspbkv_w "Druck Saugstrahlpumpe von Bremskraftverstärker" UWORD p_uw_q0p039 1 100 0 2559.96 FORMAT "%8.3" ECU_ADDRESS 0x3853DA /end MEASUREMENT
/begin MEASUREMENT pubkv_w "Umgebungsdruck für Bremskraftver. (im Fehlerfall Umgebungsd. anderer Ersatzwert)" UWORD p_uw_q0p039 1 100 0 2559.96 FORMAT "%8.3" ECU_ADDRESS 0x3853DC /end MEASUREMENT
/begin MEASUREMENT P_ats "Port Abgastemperatursensor" UWORD B_TRUE 1 100 0 1 BIT_MASK 0x4000 FORMAT "%13.11" ECU_ADDRESS 0xFD6A /end MEASUREMENT
/begin MEASUREMENT P_crsh "Signalport vom AD- Wandler" UWORD B_TRUE 1 100 0 1 BIT_MASK 0x8000 FORMAT "%13.11" ECU_ADDRESS 0xFD6A /end MEASUREMENT
/begin MEASUREMENT P_swe "Port ABS-Schlechtwegsignal" UWORD B_TRUE 1 100 0 1 BIT_MASK 0x1 FORMAT "%13.11" ECU_ADDRESS 0xFD6C /end MEASUREMENT
/begin MEASUREMENT rinh_w "Istwert (word) Innenwiderstand Ri-Nernstzelle der Lambdasonde hinter KAT" UWORD r_uw_q2 1 100 0 131070 FORMAT "%8.1" ECU_ADDRESS 0x381AAA /end MEASUREMENT
/begin MEASUREMENT rinofha_w "Innenwiderstand (word) Ri Nernst (alter Wert) ohne Filterung hinter KAT" UWORD r_uw_q2 1 100 0 131070 FORMAT "%8.1" ECU_ADDRESS 0x381AAC /end MEASUREMENT
/begin MEASUREMENT rinofh_w "Innenwiderstand (word) Ri Nernst ohne Filterung hinter KAT" UWORD r_uw_q2 1 100 0 131070 FORMAT "%8.1" ECU_ADDRESS 0x381AAE /end MEASUREMENT
/begin MEASUREMENT rk_w "Relative Kraftstoffmasse" UWORD rel_uw_b3072 1 100 0 3071.95 FORMAT "%8.3" ECU_ADDRESS 0x3820A0 /end MEASUREMENT
/begin MEASUREMENT sen_c95 "Klopfsensoreingang am Klopfauswerte-IC" UBYTE dezsub1 1 100 1 256 FORMAT "%5.1" ARRAY_SIZE 8 ECU_ADDRESS 0x380A23 /end MEASUREMENT
/begin MEASUREMENT S_ac "Klima-Anforderung aktiv" UWORD B_TRUE 1 100 0 1 BIT_MASK 0x2 FORMAT "%13.11" ECU_ADDRESS 0xFD6C /end MEASUREMENT
/begin MEASUREMENT S_brs "Schalter Bremstest" UWORD B_TRUE 1 100 0 1 BIT_MASK 0x4 FORMAT "%13.11" ECU_ADDRESS 0xFD6C /end MEASUREMENT
/begin MEASUREMENT S_fgrsv "Schalter Setzen/Verzögern am FGR-Bedienhebel" UWORD B_TRUE 1 100 0 1 BIT_MASK 0x8 FORMAT "%13.11" ECU_ADDRESS 0xFD6C /end MEASUREMENT
/begin MEASUREMENT S_fgrwb "Schalter Wiederaufnahme/Beschleunigen am FGR-Bedienhebel" UWORD B_TRUE 1 100 0 1 BIT_MASK 0x10 FORMAT "%13.11" ECU_ADDRESS 0xFD6C /end MEASUREMENT
/begin MEASUREMENT S_hds "P54" UWORD B_TRUE 1 100 0 1 BIT_MASK 0x20 FORMAT "%13.11" ECU_ADDRESS 0xFD6C /end MEASUREMENT
/begin MEASUREMENT S_kl15 "Schalter Klemme 15" UWORD B_TRUE 1 100 0 1 BIT_MASK 0x40 FORMAT "%13.11" ECU_ADDRESS 0xFD6C /end MEASUREMENT
/begin MEASUREMENT S_ko "Kompressoranforderung aktiv" UWORD B_TRUE 1 100 0 1 BIT_MASK 0x80 FORMAT "%13.11" ECU_ADDRESS 0xFD6C /end MEASUREMENT
/begin MEASUREMENT S_kupp "Schalter Kupplung" UWORD B_TRUE 1 100 0 1 BIT_MASK 0x100 FORMAT "%13.11" ECU_ADDRESS 0xFD6C /end MEASUREMENT
/begin MEASUREMENT S_tal "Schalter Tank leer bzw. Reserve" UWORD B_TRUE 1 100 0 1 BIT_MASK 0x200 FORMAT "%13.11" ECU_ADDRESS 0xFD6C /end MEASUREMENT
/begin MEASUREMENT tans "Ansaugluft-Temperatur" UBYTE temp_ub_q0p75_o48 1 100 -48 143.25 FORMAT "%5.1" ECU_ADDRESS 0x380A0F /end MEASUREMENT
/begin MEASUREMENT tansab "Ansauglufttemperatur beim Abstellen" UBYTE temp_ub_q0p75_o48 1 100 -48 143.25 FORMAT "%5.1" ECU_ADDRESS 0x383334 /end MEASUREMENT
/begin MEASUREMENT tanslin "Ansauglufttemperatur, linearisiert und umgerechnet" UBYTE temp_ub_q0p75_o48 1 100 -48 143.25 FORMAT "%5.1" ECU_ADDRESS 0x3848A6 /end MEASUREMENT
/begin MEASUREMENT taswer_w "Tastverhältnis Schlechtwegsignal ungefiltert" UWORD rel_uw_b100 1 100 0 99.9985 FORMAT "%8.5" ECU_ADDRESS 0x384A04 /end MEASUREMENT
/begin MEASUREMENT taswe_w "Tastverhältnis Schlechtwegsignal ABS" UWORD rel_uw_b100 1 100 0 99.9985 FORMAT "%8.5" ECU_ADDRESS 0x384A06 /end MEASUREMENT
/begin MEASUREMENT tedi "Istwert der Einschaltdauer der LSU-Heizung nach Start" UBYTE t10msxs_ub_b2p55 1 100 0 2.55 FORMAT "%5.3" ECU_ADDRESS 0x380B22 /end MEASUREMENT
/begin MEASUREMENT tedst "Einschaltdauer der LSU-Heizung nach Start" UBYTE t10msxs_ub_b2p55 1 100 0 2.55 FORMAT "%5.3" ECU_ADDRESS 0x380B23 /end MEASUREMENT
/begin MEASUREMENT tedtml "Einschaltdauer der LSU-Heizung abhängig von der Abgastemperatur und ml" UBYTE t10msxs_ub_b2p55 1 100 0 2.55 FORMAT "%5.3" ECU_ADDRESS 0x380B24 /end MEASUREMENT
/begin MEASUREMENT tedub "korrigierte Einschaltdauer der LSU-Heizung" UBYTE t10msxs_ub_b2p55 1 100 0 2.55 FORMAT "%5.3" ECU_ADDRESS 0x380B25 /end MEASUREMENT
/begin MEASUREMENT thhaist "Auszeit für Sondenheizung hinter Kat" UBYTE t10msxs_ub_b2p55 1 100 0 2.55 FORMAT "%5.3" ECU_ADDRESS 0x384852 /end MEASUREMENT
/begin MEASUREMENT thhat "unkorrigierte Ausschaltzeit der Sondenheizung hinter Kat" UBYTE t10msxs_q0p01_o0p05 1 100 -0.05 2.5 FORMAT "%5.3" ECU_ADDRESS 0x384853 /end MEASUREMENT
/begin MEASUREMENT tka "Temperatur Motorkühlerausgang (Kühlmittel)" UBYTE temp_ub_q0p75_o48 1 100 -48 143.25 FORMAT "%5.1" ECU_ADDRESS 0x380B8B /end MEASUREMENT
/begin MEASUREMENT tkalin "Temperatur Kühlerausgang linearisiert und umgerechnet" UBYTE temp_ub_q0p75_o48 1 100 -48 143.25 FORMAT "%5.1" ECU_ADDRESS 0x380B8C /end MEASUREMENT
/begin MEASUREMENT tmew "Motortemperatur-Ersatzwert aus Modell" UBYTE temp_ub_q0p75_o48 1 100 -48 143.25 FORMAT "%5.1" ECU_ADDRESS 0x3848AA /end MEASUREMENT
/begin MEASUREMENT tmewab "Motortemperatur-Ersatzwert aus Modell beim Abstellen" UBYTE temp_ub_q0p75_o48 1 100 -48 143.25 FORMAT "%5.1" ECU_ADDRESS 0x383335 /end MEASUREMENT
/begin MEASUREMENT tmfa_w "Meßfensteranfang Klopfregelung" UWORD tknockcon_sy 1 100 0 0.17476 FORMAT "%9.7" ECU_ADDRESS 0x38230A /end MEASUREMENT
/begin MEASUREMENT tmfln_w "Meßfensterlänge während Nulltest, KR" UWORD tknockcon_sy 1 100 0 0.17476 FORMAT "%9.7" ECU_ADDRESS 0x38230C /end MEASUREMENT
/begin MEASUREMENT tmfl_w "Meßfensterlänge Klopfregelung" UWORD tknockcon_sy 1 100 0 0.17476 FORMAT "%9.7" ECU_ADDRESS 0x38230E /end MEASUREMENT
/begin MEASUREMENT tmot "Motor-Temperatur" UBYTE temp_ub_q0p75_o48 1 100 -48 143.25 FORMAT "%5.1" ECU_ADDRESS 0x380A10 /end MEASUREMENT
/begin MEASUREMENT tmotab "Motortemperatur beim Abstellen" UBYTE temp_ub_q0p75_o48 1 100 -48 143.25 FORMAT "%5.1" ECU_ADDRESS 0x383336 /end MEASUREMENT
/begin MEASUREMENT tmotlin "Motortemperatur, linearisiert und umgerechnet" UBYTE temp_ub_q0p75_o48 1 100 -48 143.25 FORMAT "%5.1" ECU_ADDRESS 0x3848AB /end MEASUREMENT
/begin MEASUREMENT tmotlinab "gemessene Motor-Abstelltemperatur, linearisiert und umgerechnet" UBYTE temp_ub_q0p75_o48 1 100 -48 143.25 FORMAT "%5.1" ECU_ADDRESS 0x384020 /end MEASUREMENT
/begin MEASUREMENT tmotlinst "gemessene Motortemperatur im Start, linearisiert und umgerechnet" UBYTE temp_ub_q0p75_o48 1 100 -48 143.25 FORMAT "%5.1" ECU_ADDRESS 0x3848AC /end MEASUREMENT
/begin MEASUREMENT tmotlin_w "Motortemperatur, linearisiert und umgerechnet, 16Bit-Wort" UWORD temp_uw_q0p75_o48 1 100 -48 143.997 FORMAT "%8.4" ECU_ADDRESS 0x384BAC /end MEASUREMENT
/begin MEASUREMENT tmotvt "Motortemperatur vor Tiefpaßfilter" UBYTE temp_ub_q0p75_o48 1 100 -48 143.25 FORMAT "%5.1" ECU_ADDRESS 0x3848AD /end MEASUREMENT
/begin MEASUREMENT tmrw "Motortemperatur-Referenzwert aus Modell" UBYTE temp_ub_q0p75_o48 1 100 -48 143.25 FORMAT "%5.1" ECU_ADDRESS 0x3848AE /end MEASUREMENT
/begin MEASUREMENT tmrwend "Endwert für Referenzwert Motortemperatur-Modell" UBYTE temp_ub_q0p75_o48 1 100 -48 143.25 FORMAT "%5.1" ECU_ADDRESS 0x3848AF /end MEASUREMENT
/begin MEASUREMENT tmsnp "Motor-Starttemperatur des Betriebszyklus' mit erstmaliger tmot-Unplausibilität" UBYTE temp_ub_q0p75_o48 1 100 -48 143.25 FORMAT "%5.1" ECU_ADDRESS 0x384021 /end MEASUREMENT
/begin MEASUREMENT tmst "Motorstarttemperatur" UBYTE temp_ub_q0p75_o48 1 100 -48 143.25 FORMAT "%5.1" ECU_ADDRESS 0x3848B0 /end MEASUREMENT
/begin MEASUREMENT tpnt_aktiv "Aktivierung von KR-Funktionen" UBYTE dez 1 100 0 255 FORMAT "%5.1" ECU_ADDRESS 0x380A2B /end MEASUREMENT
/begin MEASUREMENT tpswe "Periodendauer Schlechtwegsinal ABS" UBYTE t1msxms_q1 1 100 0 255 FORMAT "%5.1" ECU_ADDRESS 0x38481F /end MEASUREMENT
/begin MEASUREMENT tumginp "Umgebungstemperatur als Eingangsgröße für Kennfeld KFDTMTU" UBYTE temp_ub_q0p75_o48 1 100 -48 143.25 FORMAT "%5.1" ECU_ADDRESS 0x3848B1 /end MEASUREMENT
/begin MEASUREMENT t_idle_ctr "" UBYTE dez 1 100 0 255 FORMAT "%5.1" ECU_ADDRESS 0x3848D7 /end MEASUREMENT
/begin MEASUREMENT UADKI "eingelesener Integratorwert von Klopfauswerteschaltung" UWORD dez 1 100 0 65535 FORMAT "%8.2" ECU_ADDRESS 0xF9D0 /end MEASUREMENT
/begin MEASUREMENT UADMFA "eingelesener Integratorwert von Klopfauswerteschaltung bei Meßfensteranfang" UWORD dez 1 100 0 65535 FORMAT "%8.2" ECU_ADDRESS 0xF9D2 /end MEASUREMENT
/begin MEASUREMENT ub "Batteriespannung" UBYTE spg_ubatt 1 100 0 17.952 FORMAT "%5.2" ECU_ADDRESS 0x380960 /end MEASUREMENT
/begin MEASUREMENT ubrsq "Bordnetzspannung über Hauptrelais, Standard-Quantisierung" UBYTE spg_q0p1 1 100 0 25.5 FORMAT "%5.2" ECU_ADDRESS 0x38095C /end MEASUREMENT
/begin MEASUREMENT ubrsqf "Hauptrelaisspannung, umgerechnet in Standard-Quantisierung und gefiltert" UBYTE spg_q0p1 1 100 0 25.5 FORMAT "%5.2" ECU_ADDRESS 0x38095D /end MEASUREMENT
/begin MEASUREMENT ubrsqf_w "Hauptrelaisspannung, umgerechnet in Standard-Quantisierung und gefiltert" UWORD spg_q0p00039 1 100 0 25.5996 FORMAT "%8.5" ECU_ADDRESS 0x381C86 /end MEASUREMENT
/begin MEASUREMENT ubrsqka "Bordnetzspannung über HR, standardquantisiert, bei ausgeschalteten Komponenten" UBYTE spg_q0p1 1 100 0 25.5 FORMAT "%5.2" ECU_ADDRESS 0x38095E /end MEASUREMENT
/begin MEASUREMENT ubrsqke "Bordnetzspannung über HR, standardquantisiert, bei eingeschalteten Komponenten" UBYTE spg_q0p1 1 100 0 25.5 FORMAT "%5.2" ECU_ADDRESS 0x38095F /end MEASUREMENT
/begin MEASUREMENT ubrsq_w "Bordnetzspannung über Hauptrelais (word), Standard-Quantisierung" UWORD spg_q0p00039 1 100 0 25.5996 FORMAT "%8.5" ECU_ADDRESS 0x381C88 /end MEASUREMENT
/begin MEASUREMENT ubsq "Bordnetzspannung, umgerechnet in Standard-Quantisierung" UBYTE spg_q0p1 1 100 0 25.5 FORMAT "%5.2" ECU_ADDRESS 0x380961 /end MEASUREMENT
/begin MEASUREMENT ubsqf "Bordnetzspannung, umgerechnet in Standard-Quantisierung und gefiltert" UBYTE spg_q0p1 1 100 0 25.5 FORMAT "%5.2" ECU_ADDRESS 0x380962 /end MEASUREMENT
/begin MEASUREMENT ubsqf_w "Bordnetzspannung, umgerechnet in Standard-Quantisierung und gefiltert" UWORD spg_q0p00039 1 100 0 25.5996 FORMAT "%8.5" ECU_ADDRESS 0x381C9A /end MEASUREMENT
/begin MEASUREMENT ubsq_w "Bordnetzspannung, umgerechnet in Standard-Quantisierung" UWORD spg_q0p00039 1 100 0 25.5996 FORMAT "%8.5" ECU_ADDRESS 0x381C9C /end MEASUREMENT
/begin MEASUREMENT upw2ll_w "Spannungswert von PWG-Poti 2 vor der Bewegung" UWORD spg_uw_q0p00488 1 100 0 319.995 FORMAT "%8.4" ECU_ADDRESS 0x383C5C /end MEASUREMENT
/begin MEASUREMENT upwg2d_w "Verdoppelte PWG-Poti-2-Spannung (Word)" UWORD spg_uw_q0p00488 1 100 0 319.995 FORMAT "%8.4" ECU_ADDRESS 0x381CE8 /end MEASUREMENT
/begin MEASUREMENT upwg2fil_w "Gefilterte Poti 2 Spannung" UWORD spg_uw_q0p00488 1 100 0 319.995 FORMAT "%8.4" ECU_ADDRESS 0x381CEA /end MEASUREMENT
/begin MEASUREMENT upwgej_w "Entjitterte PWG-Poti-Spannung" UWORD spg_uw_q0p00488 1 100 0 319.995 FORMAT "%8.4" ECU_ADDRESS 0x381CEC /end MEASUREMENT
/begin MEASUREMENT upwg_w "Resultierende PWG-Poti-Spannung nach Plausibilitätsprüfung" UWORD spg_uw_q0p00488 1 100 0 319.995 FORMAT "%8.4" ECU_ADDRESS 0x381CEE /end MEASUREMENT
/begin MEASUREMENT usbeh_w "Spannung (word) Lambdasonde mit Widerstand belastet hinter KAT" UWORD spg_uw_q0p00488_o1 1 100 -1 318.995 FORMAT "%8.4" ECU_ADDRESS 0x381AB0 /end MEASUREMENT
/begin MEASUREMENT ushb_w "Spannung (word) Lambdasonde mit Widerstand belastet hinter KAT" UWORD spg_uw_q0p00488_o1 1 100 -1 318.995 FORMAT "%8.4" ECU_ADDRESS 0x381AB2 /end MEASUREMENT
/begin MEASUREMENT ushk "Spannung Lambdasonde hinter Katalysator" UBYTE spg_ub_q0p0052_o0p2 1 100 -0.2 1.13 FORMAT "%5.3" ECU_ADDRESS 0x38093C /end MEASUREMENT
/begin MEASUREMENT ushk2 "Spannung Lambdasonde hinter Katalysator 2" UBYTE spg_ub_q0p0052_o0p2 1 100 -0.2 1.13 FORMAT "%5.3" ECU_ADDRESS 0x38093D /end MEASUREMENT
/begin MEASUREMENT ushkr_w "Spannung (word) Lambdasonde Rohwert hinter KAT" UWORD spg_uw_q0p00488_o1 1 100 -1 318.995 FORMAT "%8.4" ECU_ADDRESS 0x381AB4 /end MEASUREMENT
/begin MEASUREMENT ushk_w "Spannung Lambdasonde (4.88mV/LSB) hinter Katalysator" UWORD spg_uw_q0p00488_o1 1 100 -1 318.995 FORMAT "%8.4" ECU_ADDRESS 0x381AB6 /end MEASUREMENT
/begin MEASUREMENT ushmb_w "Spannung (word, 10 ms-Raster) Lambdasonde mit Widerstand belastet hinter KAT" UWORD spg_uw_q0p00488_o1 1 100 -1 318.995 FORMAT "%8.4" ECU_ADDRESS 0x381AB8 /end MEASUREMENT
/begin MEASUREMENT ushob_w "Spannung (word, 10 ms-Raster) Lambdasonde ohne Belastung hinter KAT" UWORD spg_uw_q0p00488_o1 1 100 -1 318.995 FORMAT "%8.4" ECU_ADDRESS 0x381ABA /end MEASUREMENT
/begin MEASUREMENT usobh_w "Spannung (word) Lambdasonde ohne Belastung hinter KAT" UWORD spg_uw_q0p00488_o1 1 100 -1 318.995 FORMAT "%8.4" ECU_ADDRESS 0x381ABC /end MEASUREMENT
/begin MEASUREMENT usvkk_w "LSU-Spannung vor Kat, korrigiert" UWORD spg_uw_q0p00488 1 100 0 319.995 FORMAT "%8.4" ECU_ADDRESS 0x381B1E /end MEASUREMENT
/begin MEASUREMENT uulsuf_w "gefilterte Sondenspannung vor Kat einer Breitbandlambdasonde" UWORD spg_uw_q0p00488 1 100 0 319.995 FORMAT "%8.4" ECU_ADDRESS 0x381B20 /end MEASUREMENT
/begin MEASUREMENT uushmb_w "Spannung (word, 1 ms-Raster) Lambdasonde mit Widerstand belastet hinter KAT" UWORD spg_uw_q0p00488 1 100 0 319.995 FORMAT "%8.4" ECU_ADDRESS 0xF920 /end MEASUREMENT
/begin MEASUREMENT uushob_w "ADC-Spannung (word, 1 ms-Raster) Sonde ohne Belastung hinter Katalysator" UWORD spg_uw_q0p00488 1 100 0 319.995 FORMAT "%8.4" ECU_ADDRESS 0xF922 /end MEASUREMENT
/begin MEASUREMENT vfgr_w "Fahrzeug-Ist-Geschwindigkeit für FGR" UWORD vfzg_uw_b512 1 100 0 511.992 FORMAT "%8.4" ECU_ADDRESS 0x381CB8 /end MEASUREMENT
/begin MEASUREMENT vfil_w "gefilterte Geschwindigkeit (16-Bit)" UWORD vfzg_uw_b512 1 100 0 511.992 FORMAT "%8.4" ECU_ADDRESS 0x381CBA /end MEASUREMENT
/begin MEASUREMENT vfzg "Fahrzeuggeschwindigkeit" UBYTE vfzg_ub_q1p25 1 100 0 318.75 FORMAT "%5.1" ECU_ADDRESS 0x38485A /end MEASUREMENT
/begin MEASUREMENT vfzg_w "Fahrzeuggeschwindigkeit" UWORD vfzg_uw_b512 1 100 0 511.992 FORMAT "%8.4" ECU_ADDRESS 0x381CBC /end MEASUREMENT
/begin MEASUREMENT vfzroh_w "Fahrzeuggeschwindigkeit Ausgabewert an SCAN-Tool" UWORD vfzg_uw_b512 1 100 0 511.992 FORMAT "%8.4" ECU_ADDRESS 0x381CBE /end MEASUREMENT
/begin MEASUREMENT vroh_w "Fahrzeuggeschwindigkeit ungefiltert" UWORD vfzg_uw_b512 1 100 0 511.992 FORMAT "%8.4" ECU_ADDRESS 0x381CC0 /end MEASUREMENT
/begin MEASUREMENT wmfa "Meßfensteranfang in Grad Kurbelwinkel" UBYTE zw_ub_q0p75 1 100 0 191.25 FORMAT "%5.1" ECU_ADDRESS 0x380A2C /end MEASUREMENT
/begin MEASUREMENT wmfl "Meßfensterlänge in Grad Kurbelwinkel" UBYTE zw_ub_q0p75 1 100 0 191.25 FORMAT "%5.1" ECU_ADDRESS 0x380A2D /end MEASUREMENT
/begin MEASUREMENT wnweoas_w "Winkeldifferenz zwischen adaptierter und aktueller Phasenflanke bez. auf EO / AS" SWORD kw_q0p0078 1 100 -256 255.992 FORMAT "%8.4" ECU_ADDRESS 0x3819E4 /end MEASUREMENT
/begin MEASUREMENT wnwe_w "Winkel Einlassventil oeffnet bezogen auf LWOT" SWORD kw_q0p0078 1 100 -256 255.992 FORMAT "%8.4" ECU_ADDRESS 0x3819E6 /end MEASUREMENT
/begin MEASUREMENT wnwim_w "Mittelwert Abweichung Adaption Nocken-/Kurbelwelle" UWORD kw_q0p0039 1 100 0 255.996 FORMAT "%8.4" ECU_ADDRESS 0x383C42 /end MEASUREMENT
/begin MEASUREMENT wnwi_ad_w "Winkeldifferenz zwischen adaptierter und aktueller Phasenflanke (word)" SWORD kw_q0p0039 1 100 -128 127.996 FORMAT "%8.4" ECU_ADDRESS 0x3819E8 /end MEASUREMENT
/begin MEASUREMENT wnwkor_w "Aktueller Korrekturwert für NW-Signal" SWORD kw_q0p0156 1 100 -512 511.984 FORMAT "%8.4" ECU_ADDRESS 0x384A0C /end MEASUREMENT
/begin MEASUREMENT wnwkwas_w "Winkel Nockenwelle zur Kurbelwelle im Arbeitsspiel" UWORD kw_q0p0156 1 100 0 1023.98 FORMAT "%8.3" ECU_ADDRESS 0x3819EA /end MEASUREMENT
/begin MEASUREMENT wnwspas_w "Adaptionswinkel der Nockenwellenflanken im Arbeitsspiel (Referenzposition)" UWORD kw_q0p0156 1 100 0 1023.98 FORMAT "%8.3" ECU_ADDRESS 0x3819EC /end MEASUREMENT
/begin MEASUREMENT wnwsp_w "Adaptionswinkel Nockenwelle (Spätanschlag)" UWORD kw_q0p0156 1 100 0 1023.98 FORMAT "%8.3" ARRAY_SIZE 4 ECU_ADDRESS 0x383C44 /end MEASUREMENT
/begin MEASUREMENT wped "Normierter Fahrpedalwinkel" UBYTE relPED_ub_b100 1 100 0 100 FORMAT "%5.1" ECU_ADDRESS 0x380974 /end MEASUREMENT
/begin MEASUREMENT wpedt_w "Pedalwert (temporär) bei 2 ME-Steuergeräten" UWORD relPED_uw_b100 1 100 0 100 FORMAT "%8.4" ECU_ADDRESS 0x381CF0 /end MEASUREMENT
/begin MEASUREMENT wpedv_w "Normierter Fahrpedalwinkel vor Berücksichtigung der Begrenzungen im Notfahren" UWORD relPED_uw_b100 1 100 0 100 FORMAT "%8.4" ECU_ADDRESS 0x381CF2 /end MEASUREMENT
/begin MEASUREMENT wped_w "normierter Fahrpedalwinkel" UWORD relPED_uw_b100 1 100 0 100 FORMAT "%8.4" ECU_ADDRESS 0x381CF4 /end MEASUREMENT
/begin MEASUREMENT zfcnt "Zähler Zahnflanken zur Messung der Fahrzeuggeschwindigkeit" UBYTE dez 1 100 0 255 FORMAT "%5.1" ECU_ADDRESS 0x380966 /end MEASUREMENT
/begin MEASUREMENT zphfl "Zähler äquidistante Phasenflanken" UBYTE dez 1 100 0 255 FORMAT "%5.1" ECU_ADDRESS 0x38091D /end MEASUREMENT
/begin MEASUREMENT zriberh "Ri-Berechnungszähler nach Start hinter KAT" UBYTE dez 1 100 0 255 FORMAT "%5.1" ECU_ADDRESS 0x38093E /end MEASUREMENT
/begin MEASUREMENT zrinh_w "Zeitzähler zur Bereitstellung der aktuellen Bedingung Ri-Nernst hinter KAT" UWORD t100msxs_uw_b6553p5 1 100 0 6553.5 FORMAT "%8.3" ECU_ADDRESS 0x381ABE /end MEASUREMENT
/begin MEASUREMENT ztpnt_a "KR: Zähler für die Freigabe von Nulltest oder Testimpuls" UBYTE dez 1 100 0 255 FORMAT "%5.1" ECU_ADDRESS 0x380A2E /end MEASUREMENT
/begin FUNCTION GGKS "4.40      Gebergröße Klopfsensor"
 /begin DEF_CHARACTERISTIC CWKRAPP DKROKD DKROKMX DKROKO FMFKRB0 FMFKRB1 FMFKRB2 FMFKRB3 KEMLN KFMAKR NKRFM1 NKRFM2 NKRFM3 SENZZYL0 SENZZYL1 SENZZYL2 SENZZYL3 SENZZYL4 SENZZYL5 SENZZYL6 SENZZYL7 TMCC650 /end DEF_CHARACTERISTIC
 /begin REF_CHARACTERISTIC CWDKRTP KRANH KRFHT KRFTP1 SNM16KRUB SRL04KRUB TMKR /end REF_CHARACTERISTIC
 /begin IN_MEASUREMENT B_kr B_st B_stend B_tmkr esst_snm16krub esst_srl04krub nmot rl tmot tn2 xzskrnt xzskrof xzskrtp zzylkr /end IN_MEASUREMENT
 /begin OUT_MEASUREMENT B_c95bf0 B_c95bf1 B_c95bf2 B_c95bf3 B_c95ks3 B_dnt B_dntb B_dtp B_dtpb B_fmfkrc B_fmfkrco B_fmfkrcu B_ntini B_tpnt_aw B_tpnt_e igod_w igokr_w ikr ikrma ikrme ikrmen ikrmet ikr_tst iokkr ks_sym sen_c95 tmfa_w tmfln_w tmfl_w tpnt_aktiv UADKI UADMFA wmfa wmfl ztpnt_a /end OUT_MEASUREMENT
 /begin LOC_MEASUREMENT fmfkrakt fmfkraktol /end LOC_MEASUREMENT
 /begin SUB_FUNCTION /end SUB_FUNCTION
/end FUNCTION
/begin FUNCTION GGKS_MF "" /begin DEF_CHARACTERISTIC /end DEF_CHARACTERISTIC /begin REF_CHARACTERISTIC /end REF_CHARACTERISTIC /begin IN_MEASUREMENT B_fmfkrc /end IN_MEASUREMENT /begin OUT_MEASUREMENT /end OUT_MEASUREMENT /begin LOC_MEASUREMENT /end LOC_MEASUREMENT /begin SUB_FUNCTION /end SUB_FUNCTION /end FUNCTION
/begin FUNCTION GGLSH "3.30      Gebergröße Lambdasondensignal (Nernst-Type) hinter Kat"
 /begin DEF_CHARACTERISTIC ANZRIBEH CWGGLSH DUSRIH DUSSPH FRINOF RBEL RINHMX RKSP TGGLS THSRIH TRIAKTH TRIIMPH TUSBELH USRIMINH USRIOH USRIUH ZFRIH /end DEF_CHARACTERISTIC
 /begin REF_CHARACTERISTIC /end REF_CHARACTERISTIC
 /begin IN_MEASUREMENT B_lsh B_lsv B_ripuv B_sa B_svuerf B_ttbmhh uushk_w /end IN_MEASUREMENT
 /begin OUT_MEASUREMENT B_priph B_pump B_rinh B_shuerf rinh_w ushk ushk2 ushk_w /end OUT_MEASUREMENT
 /begin LOC_MEASUREMENT B_enrinh B_erinofh B_riakh B_ribeh B_riibh B_riimph B_rimh B_ripuh B_rireh B_risph B_usbeh rinofha_w rinofh_w usbeh_w ushb_w ushkr_w ushmb_w ushob_w usobh_w uushmb_w uushob_w zriberh zrinh_w /end LOC_MEASUREMENT
 /begin SUB_FUNCTION /end SUB_FUNCTION
/end FUNCTION
/begin FUNCTION GGLSU "5.40      Gebersignal LSU"
 /begin DEF_CHARACTERISTIC CWGGLSU FLAMPA FLSUIP KFBBLSU KFLAMSLS LALIUS PADMSA PUELSU SDLAA SDLAB TABGL TABGS TSTBB TVABGL TVLENA UBGGLSU ULSUAMN ULSUAMX USABGL ZFDUSVK ZFUULSU /end DEF_CHARACTERISTIC
 /begin REF_CHARACTERISTIC /end REF_CHARACTERISTIC
 /begin IN_MEASUREMENT B_ehlsu B_elsu B_hag B_hsv B_llr B_pwf B_sls B_st B_stend lamsons_w msabg_w nmot pu_w rl ub uulsuv_w /end IN_MEASUREMENT
 /begin OUT_MEASUREMENT B_lsuab B_sbblsu B_sbbvk iplsuvj_w kusvk_w lalsuvj_w lamsoni_w usvkk_w /end OUT_MEASUREMENT
 /begin LOC_MEASUREMENT B_abll B_tabgs dlam_w flamsls GGLSUBits iplsu_w lamsonb_w padlsu_w palsu_w uulsuf_w /end LOC_MEASUREMENT
 /begin SUB_FUNCTION /end SUB_FUNCTION
/end FUNCTION
/begin FUNCTION GGNW "1.30      Winkeladaption der Nockenwelle zur Kurbelwelle"
 /begin DEF_CHARACTERISTIC PHNMO PHNMU WNWAFMX WNWASMX WNWKM WNWKN WNWRPS ZNWSP ZPHFLBM1 /end DEF_CHARACTERISTIC
 /begin REF_CHARACTERISTIC WNWREO /end REF_CHARACTERISTIC
 /begin IN_MEASUREMENT B_bm B_luecke B_nldg B_nwflade B_pwf B_syn B_synnldg B_zztab gaptooth nmot synstate tmot wkwsyn_w wkw_w zphflsyn zzseg zztab zzyl /end IN_MEASUREMENT
 /begin OUT_MEASUREMENT B_nwie B_phad B_phade B_spsa B_wnwiout wnweoas_w wnwe_w wnwi_ad_w wnwkwas_w wnwspas_w zphfl /end OUT_MEASUREMENT
 /begin LOC_MEASUREMENT B_nwflad B_phgefl B_phnmo B_phnmu wnwim_w wnwkor_w wnwsp_w /end LOC_MEASUREMENT
 /begin SUB_FUNCTION /end SUB_FUNCTION
/end FUNCTION
/begin FUNCTION GGPBKV "Gebergröße Druck für Bremskraftverstärker"
 /begin DEF_CHARACTERISTIC CWGGPBKV DPBKVBBG DPBKVBSGV0 DPBKVBSGVS DPBKVEBG DPBKVEBGVS DPBKVEVK DPBKVEVKEP DPBKVEVKSP DPBKVSTG DSBGRAD DSBOFS FBKVP KAFPBKVPU PBKVVSTGPV PUEBKV TBKVP TEBBREMS VFZGSCH /end DEF_CHARACTERISTIC
 /begin REF_CHARACTERISTIC /end REF_CHARACTERISTIC
 /begin IN_MEASUREMENT B_bkvp B_brems B_cddsbkv ps_w pu_w pvdkds_w udsbkv_w vfzg_w /end IN_MEASUREMENT
 /begin OUT_MEASUREMENT dpbkvu_w pbkv pbkvpmn_w pbkv_w psspbkv_w pubkv_w /end OUT_MEASUREMENT
 /begin LOC_MEASUREMENT dmnpbkv_w dmxpbkv_w dpbkvep_w dpbkvmx_w dpbkvps_w dpbkvsp_w dpspvdkd_w pbkvmod_w pbkvmpu_w /end LOC_MEASUREMENT
 /begin SUB_FUNCTION /end SUB_FUNCTION
/end FUNCTION
/begin FUNCTION GGPED "8.70      Gebergröße Fahrpedal"
 /begin DEF_CHARACTERISTIC CWBWEEN DUPW12 DUPW12BE DUPW12TG DUPW12VG DUPWGHY DWPMXNB DWPMXNOT DWPOPBP DWPPBP MIFAMXNOT NWPMBBR TDWPOPBP TFPWG2 THOPP1 THOPP2 TMBVH TPNSE1 TUPWBWV TUPWG12 TUPWG1O TUPWG1U TUPWG2O TUPWG2U TUPWLLU TWPLK TWPMBBR UPW1BE UPW1LLMX UPWG12U UPWG1O UPWG1U UPWG2O UPWG2U UPWGO UPWGTG UPWGTL UPWGU UPWGUBF UPWGUR UPWGVG VWPMBBR WPMXBR WPMXNOT WPRMBVH ZBWF /end DEF_CHARACTERISTIC
 /begin REF_CHARACTERISTIC /end REF_CHARACTERISTIC
 /begin IN_MEASUREMENT B_bkva B_bkvv B_bl B_br B_br2k B_brems B_dknot B_dksbeg B_fabr B_nmax B_pwf B_pwgnotum B_stend B_ubpvg nmot upwg1_w upwg2_w vfzg /end IN_MEASUREMENT
 /begin OUT_MEASUREMENT B_pwgnotfr B_upwbwf dwped dwped_w mifamx_w mkfamx_w wped wped_w /end OUT_MEASUREMENT
 /begin LOC_MEASUREMENT B_bwf B_bwunpl B_dupw B_dupw12 B_glf B_holp1 B_holp1a B_holp1l B_holp2 B_holp2a B_holp2l B_hop1mn B_hop2mn B_hopakt B_mbvh B_pbpabr B_pwgbwf B_pwglk B_sp1s B_sp2s B_spsmin B_up2bwf B_upw12e B_upw1mn B_upw1mx B_upw2mn B_upw2mx B_upwg1o B_upwg1u B_upwg2o B_upwg2u B_vpwgerr B_wpabnb B_wpmbbr ctrbwf GGPEDlokbits GGPEDlokbits2 GGPEDnonVolbits upw2ll_w upwg2d_w upwg2fil_w upwgej_w upwg_w wpedt_w wpedv_w /end LOC_MEASUREMENT
 /begin SUB_FUNCTION /end SUB_FUNCTION
/end FUNCTION
/begin FUNCTION GGSWEA "1.10      Gebergröße-Schlechtwegerkennung-PWM-Signal" /begin DEF_CHARACTERISTIC DTASWEMN NDABS TPSSWE TPWMST UBDABS /end DEF_CHARACTERISTIC /begin REF_CHARACTERISTIC /end REF_CHARACTERISTIC
 /begin IN_MEASUREMENT B_cdswe B_stend cd_bits1_w nmot P_swe tcchswe_w tccpswe_w ub /end IN_MEASUREMENT
 /begin OUT_MEASUREMENT B_sweb B_swe_p taswe_w tpswe /end OUT_MEASUREMENT
 /begin LOC_MEASUREMENT taswer_w /end LOC_MEASUREMENT
 /begin SUB_FUNCTION /end SUB_FUNCTION
/end FUNCTION
/begin FUNCTION GGTFA "18.20     Gebergröße TFA Temperaturfühler Ansaugluft" /begin DEF_CHARACTERISTIC TADE TADMN TADMX TANSELI TDNSTA TDTA TDTAL ZFTANS /end DEF_CHARACTERISTIC /begin REF_CHARACTERISTIC /end REF_CHARACTERISTIC /begin IN_MEASUREMENT B_ll B_pwf B_sa B_stend wtans /end IN_MEASUREMENT /begin OUT_MEASUREMENT tans tansab tanslin /end OUT_MEASUREMENT /begin LOC_MEASUREMENT /end LOC_MEASUREMENT /begin SUB_FUNCTION /end SUB_FUNCTION /end FUNCTION
/begin FUNCTION GGTFM "44.40     Gebergröße TFM Temperaturfühler Motor (/-Kühlmittel)"
 /begin DEF_CHARACTERISTIC CWKONGTM CW_TABST DTMABDTMN DTMDMA DTMDNPO DTMSRT FABSTT KFDTMRS KFDTMTE KFDTMTR KFDTMTU KLITHMS KLTHMDTMS TABSMADTM TADMM TDTM TDTMMA TDTMNP TDTMNPO TDTMPOG TMABDTMN TMDMMA TMDMMAT TMDMMAU TMDMMEE TMDMMER TMDMN TMDMX TMELIPU1 TMMXRT TMOTELI TMPUPOFF TMPUPON TNLETM TNSRT TUMDETM UBMNPUP /end DEF_CHARACTERISTIC
 /begin REF_CHARACTERISTIC /end REF_CHARACTERISTIC
 /begin IN_MEASUREMENT B_abstgp B_abstnlgp B_kl15 B_nletm B_nmin B_nmot B_pwf B_sa B_st B_stend imlatm ml tabst_w tans tansab tmki ubsq wtmot_w /end IN_MEASUREMENT
 /begin OUT_MEASUREMENT B_nputm B_tmmn B_tmsrt B_znptm B_zsitm korrfak tmew tmewab tmot tmotab tmotlin tmotlinab tmotlinst tmotlin_w tmotvt tmrw tmrwend tmsnp tmst tumginp /end OUT_MEASUREMENT
 /begin LOC_MEASUREMENT B_pullup mll1 /end LOC_MEASUREMENT
 /begin SUB_FUNCTION /end SUB_FUNCTION
/end FUNCTION
/begin FUNCTION GGTKA "5.10      Gebergröße TKA Temperatur Kühlerausgang" /begin DEF_CHARACTERISTIC TDTKAUS TKAELI TKAUSDE TKAUSDMN TKAUSDMX /end DEF_CHARACTERISTIC /begin REF_CHARACTERISTIC /end REF_CHARACTERISTIC /begin IN_MEASUREMENT wtka /end IN_MEASUREMENT /begin OUT_MEASUREMENT tka tkalin /end OUT_MEASUREMENT /begin LOC_MEASUREMENT /end LOC_MEASUREMENT /begin SUB_FUNCTION /end SUB_FUNCTION /end FUNCTION
/begin FUNCTION GGUB "11.30     Gebergröße Batteriespannung, inkl.Diagnose" /begin DEF_CHARACTERISTIC TDNSUB TDUB UBDE UBDMN1 UBDMN2 UBDMN3 UBDMX UBNACHL VMDUB /end DEF_CHARACTERISTIC /begin REF_CHARACTERISTIC /end REF_CHARACTERISTIC /begin IN_MEASUREMENT B_stend B_ubrk ubrsq_w vfzg wub wub_w /end IN_MEASUREMENT /begin OUT_MEASUREMENT ub ubsq ubsqf ubsqf_w ubsq_w /end OUT_MEASUREMENT /begin LOC_MEASUREMENT /end LOC_MEASUREMENT /begin SUB_FUNCTION /end SUB_FUNCTION /end FUNCTION
/begin FUNCTION GGUBR "1.80      Gebergröße und Diagnose Bordnetzspannung über Hauptrelais"
 /begin DEF_CHARACTERISTIC CWKVHR TDAPTUBR TDHREVAB TDRNLUBR TDUBR TDUBRNL TWDUBRNL UBRDMN1 UBRDMN2 UBRDMX UBRDUNL /end DEF_CHARACTERISTIC
 /begin REF_CHARACTERISTIC /end REF_CHARACTERISTIC
 /begin IN_MEASUREMENT B_nldve B_nlsgls B_nlubr B_nmin B_stend ei_ubr_um wubr wubr_w /end IN_MEASUREMENT
 /begin OUT_MEASUREMENT B_dnlubr B_dubre B_hrevab B_hrkng B_hrkzlg B_kdhre B_ubrdmn1 B_ubrdmn2 B_ubrk B_ubrmax B_ubru GGUBRausbits GGUBRausbitsNOV1 ubrsq ubrsqf ubrsqf_w ubrsqka ubrsqke ubrsq_w /end OUT_MEASUREMENT
 /begin LOC_MEASUREMENT /end LOC_MEASUREMENT
 /begin SUB_FUNCTION /end SUB_FUNCTION
/end FUNCTION
/begin FUNCTION GGVFZG "14.70     Gebergröße Fahrzeuggeschwindigkeit"
 /begin DEF_CHARACTERISTIC AIMVM CWGGVFZG DVFZBEG TFGRVRAB VFZMN VFZR1O VFZR1U VFZR2O VFZR2U VRFGRMN ZFBFZGL ZFCNT1 ZFCNT2 ZFV /end DEF_CHARACTERISTIC
 /begin REF_CHARACTERISTIC /end REF_CHARACTERISTIC
 /begin IN_MEASUREMENT B_cankbi vamsr_w vfzgkb_w /end IN_MEASUREMENT
 /begin OUT_MEASUREMENT bfzgl_b bfzgl_w B_vnull dist_w vfgr_w vfzg vfzg_w vfzroh_w zfcnt /end OUT_MEASUREMENT
 /begin LOC_MEASUREMENT vfil_w vroh_w /end LOC_MEASUREMENT
 /begin SUB_FUNCTION /end SUB_FUNCTION
/end FUNCTION
/begin FUNCTION GGZDGON "1.30      Gebergröße Klemme 15" /begin DEF_CHARACTERISTIC TUBKL15 UBKL15 /end DEF_CHARACTERISTIC /begin REF_CHARACTERISTIC /end REF_CHARACTERISTIC /begin IN_MEASUREMENT S_kl15 wub /end IN_MEASUREMENT /begin OUT_MEASUREMENT B_kl15 /end OUT_MEASUREMENT /begin LOC_MEASUREMENT /end LOC_MEASUREMENT /begin SUB_FUNCTION /end SUB_FUNCTION /end FUNCTION
/begin FUNCTION GK "13.20     Gemischkontrolle" /begin DEF_CHARACTERISTIC /end DEF_CHARACTERISTIC /begin REF_CHARACTERISTIC CWWL /end REF_CHARACTERISTIC
 /begin IN_MEASUREMENT B_stendes fgru fnswl_w fra_w fr_w fst_w fwe lamns_w lamsbg_w nmot rka_w rkte_w rkukg_w rl rlp_w /end IN_MEASUREMENT
 /begin OUT_MEASUREMENT rk_w /end OUT_MEASUREMENT
 /begin LOC_MEASUREMENT fvst_w /end LOC_MEASUREMENT
 /begin SUB_FUNCTION /end SUB_FUNCTION
/end FUNCTION
/begin FUNCTION Hash "" /begin DEF_CHARACTERISTIC /end DEF_CHARACTERISTIC /begin REF_CHARACTERISTIC /end REF_CHARACTERISTIC /begin IN_MEASUREMENT /end IN_MEASUREMENT /begin OUT_MEASUREMENT /end OUT_MEASUREMENT /begin LOC_MEASUREMENT ctr_MD5Block /end LOC_MEASUREMENT /begin SUB_FUNCTION /end SUB_FUNCTION /end FUNCTION
/begin FUNCTION HLSHK "3.30      Sondenheizung hinter Kat"
 /begin DEF_CHARACTERISTIC PHLSNHMN TANHKMMN THHA THHAWU THSHA THSHKTK TVHSH UBHS UHSN /end DEF_CHARACTERISTIC
 /begin REF_CHARACTERISTIC /end REF_CHARACTERISTIC
 /begin IN_MEASUREMENT B_atmtpk B_atmtpl B_stend tanhkm_w ub /end IN_MEASUREMENT
 /begin OUT_MEASUREMENT B_hsha B_hshe phlsnh /end OUT_MEASUREMENT
 /begin LOC_MEASUREMENT B_enhlshk B_rehs thhaist thhat /end LOC_MEASUREMENT
 /begin SUB_FUNCTION /end SUB_FUNCTION
/end FUNCTION
/begin FUNCTION HLSU "3.90      Heizung stetige Lambdasonde LSU"
 /begin DEF_CHARACTERISTIC CWHLSU HLSUKORMX KEDNEG KEDPOS KFLSUED TABGMHS TABSTHLSU TEDTP TLSUTA TLSUVH TMOTSH TVLSUWU WHLSUKOR /end DEF_CHARACTERISTIC
 /begin REF_CHARACTERISTIC UBHS /end REF_CHARACTERISTIC
 /begin IN_MEASUREMENT B_atmtpa B_nmot B_nplsusa B_pwf B_sbbvk B_trkh msabg tabgm tabst_w tans tmot ub /end IN_MEASUREMENT
 /begin OUT_MEASUREMENT B_hsv B_hsve /end OUT_MEASUREMENT
 /begin LOC_MEASUREMENT B_enhlsu B_hmx B_wu hlsukor tedi tedst tedtml tedub /end LOC_MEASUREMENT
 /begin SUB_FUNCTION /end SUB_FUNCTION
/end FUNCTION
/begin FUNCTION HWDIG75 "" /begin DEF_CHARACTERISTIC CWUM_ZDG /end DEF_CHARACTERISTIC /begin REF_CHARACTERISTIC CWKRAPP /end REF_CHARACTERISTIC
 /begin IN_MEASUREMENT B_bkvp B_ekp B_epcl B_etr B_hshe B_hsve B_kov B_ldp B_ldpe B_ldsua B_lsuab B_lues B_mil B_nachl B_nwse B_priph B_slp B_slv ldtvm swOffDlBits /end IN_MEASUREMENT
 /begin OUT_MEASUREMENT B_dveeson B_ldpi B_luv P_ats P_crsh P_swe S_ac S_brs S_fgrsv S_fgrwb S_hds S_kl15 S_ko S_kupp S_tal /end OUT_MEASUREMENT
 /begin LOC_MEASUREMENT /end LOC_MEASUREMENT
 /begin SUB_FUNCTION /end SUB_FUNCTION
/end FUNCTION
/begin FUNCTION HWTEV "Komponententreiber für Tankentlüftungsventil (TEV)" /begin DEF_CHARACTERISTIC /end DEF_CHARACTERISTIC /begin REF_CHARACTERISTIC /end REF_CHARACTERISTIC /begin IN_MEASUREMENT B_tevtstp tateout tevper /end IN_MEASUREMENT /begin OUT_MEASUREMENT B_tevtini /end OUT_MEASUREMENT /begin LOC_MEASUREMENT /end LOC_MEASUREMENT /begin SUB_FUNCTION /end SUB_FUNCTION /end FUNCTION
/begin FUNCTION ims_501 "" /begin DEF_CHARACTERISTIC TKWFS TRETRY /end DEF_CHARACTERISTIC /begin REF_CHARACTERISTIC /end REF_CHARACTERISTIC /begin IN_MEASUREMENT B_nachl B_nlwfs B_pwf nmot_w swOffDlBits /end IN_MEASUREMENT /begin OUT_MEASUREMENT /end OUT_MEASUREMENT /begin LOC_MEASUREMENT /end LOC_MEASUREMENT /begin SUB_FUNCTION /end SUB_FUNCTION /end FUNCTION
/begin FUNCTION INDEX_BGTOL "" /begin DEF_CHARACTERISTIC /end DEF_CHARACTERISTIC /begin REF_CHARACTERISTIC /end REF_CHARACTERISTIC /begin IN_MEASUREMENT /end IN_MEASUREMENT /begin OUT_MEASUREMENT /end OUT_MEASUREMENT /begin LOC_MEASUREMENT /end LOC_MEASUREMENT /begin SUB_FUNCTION /end SUB_FUNCTION /end FUNCTION
/begin FUNCTION INDEX_BGTUMG "" /begin DEF_CHARACTERISTIC /end DEF_CHARACTERISTIC /begin REF_CHARACTERISTIC /end REF_CHARACTERISTIC /begin IN_MEASUREMENT /end IN_MEASUREMENT /begin OUT_MEASUREMENT /end OUT_MEASUREMENT /begin LOC_MEASUREMENT /end LOC_MEASUREMENT /begin SUB_FUNCTION /end SUB_FUNCTION /end FUNCTION
/begin FUNCTION INDEX_CAIR "" /begin DEF_CHARACTERISTIC /end DEF_CHARACTERISTIC /begin REF_CHARACTERISTIC /end REF_CHARACTERISTIC /begin IN_MEASUREMENT /end IN_MEASUREMENT /begin OUT_MEASUREMENT /end OUT_MEASUREMENT /begin LOC_MEASUREMENT /end LOC_MEASUREMENT /begin SUB_FUNCTION /end SUB_FUNCTION /end FUNCTION
/begin FUNCTION INDEX_CALL "" /begin DEF_CHARACTERISTIC /end DEF_CHARACTERISTIC /begin REF_CHARACTERISTIC /end REF_CHARACTERISTIC /begin IN_MEASUREMENT /end IN_MEASUREMENT /begin OUT_MEASUREMENT /end OUT_MEASUREMENT /begin LOC_MEASUREMENT /end LOC_MEASUREMENT /begin SUB_FUNCTION /end SUB_FUNCTION /end FUNCTION
/begin FUNCTION INDEX_CAS "" /begin DEF_CHARACTERISTIC /end DEF_CHARACTERISTIC /begin REF_CHARACTERISTIC /end REF_CHARACTERISTIC /begin IN_MEASUREMENT /end IN_MEASUREMENT /begin OUT_MEASUREMENT /end OUT_MEASUREMENT /begin LOC_MEASUREMENT /end LOC_MEASUREMENT /begin SUB_FUNCTION /end SUB_FUNCTION /end FUNCTION
/begin FUNCTION INDEX_CAT "" /begin DEF_CHARACTERISTIC /end DEF_CHARACTERISTIC /begin REF_CHARACTERISTIC /end REF_CHARACTERISTIC /begin IN_MEASUREMENT /end IN_MEASUREMENT /begin OUT_MEASUREMENT /end OUT_MEASUREMENT /begin LOC_MEASUREMENT /end LOC_MEASUREMENT /begin SUB_FUNCTION /end SUB_FUNCTION /end FUNCTION
/begin FUNCTION INDEX_CBSG "" /begin DEF_CHARACTERISTIC /end DEF_CHARACTERISTIC /begin REF_CHARACTERISTIC /end REF_CHARACTERISTIC /begin IN_MEASUREMENT /end IN_MEASUREMENT /begin OUT_MEASUREMENT /end OUT_MEASUREMENT /begin LOC_MEASUREMENT /end LOC_MEASUREMENT /begin SUB_FUNCTION /end SUB_FUNCTION /end FUNCTION
/begin FUNCTION INDEX_CGE "" /begin DEF_CHARACTERISTIC /end DEF_CHARACTERISTIC /begin REF_CHARACTERISTIC /end REF_CHARACTERISTIC /begin IN_MEASUREMENT /end IN_MEASUREMENT /begin OUT_MEASUREMENT /end OUT_MEASUREMENT /begin LOC_MEASUREMENT /end LOC_MEASUREMENT /begin SUB_FUNCTION /end SUB_FUNCTION /end FUNCTION
/begin FUNCTION INDEX_CGRA "" /begin DEF_CHARACTERISTIC /end DEF_CHARACTERISTIC /begin REF_CHARACTERISTIC /end REF_CHARACTERISTIC /begin IN_MEASUREMENT /end IN_MEASUREMENT /begin OUT_MEASUREMENT /end OUT_MEASUREMENT /begin LOC_MEASUREMENT /end LOC_MEASUREMENT /begin SUB_FUNCTION /end SUB_FUNCTION /end FUNCTION
/begin FUNCTION INDEX_CIF "" /begin DEF_CHARACTERISTIC /end DEF_CHARACTERISTIC /begin REF_CHARACTERISTIC /end REF_CHARACTERISTIC /begin IN_MEASUREMENT /end IN_MEASUREMENT /begin OUT_MEASUREMENT /end OUT_MEASUREMENT /begin LOC_MEASUREMENT /end LOC_MEASUREMENT /begin SUB_FUNCTION /end SUB_FUNCTION /end FUNCTION
/begin FUNCTION INDEX_CINS "" /begin DEF_CHARACTERISTIC /end DEF_CHARACTERISTIC /begin REF_CHARACTERISTIC /end REF_CHARACTERISTIC /begin IN_MEASUREMENT /end IN_MEASUREMENT /begin OUT_MEASUREMENT /end OUT_MEASUREMENT /begin LOC_MEASUREMENT /end LOC_MEASUREMENT /begin SUB_FUNCTION /end SUB_FUNCTION /end FUNCTION
/begin FUNCTION INDEX_CKLA "" /begin DEF_CHARACTERISTIC /end DEF_CHARACTERISTIC /begin REF_CHARACTERISTIC /end REF_CHARACTERISTIC /begin IN_MEASUREMENT /end IN_MEASUREMENT /begin OUT_MEASUREMENT /end OUT_MEASUREMENT /begin LOC_MEASUREMENT /end LOC_MEASUREMENT /begin SUB_FUNCTION /end SUB_FUNCTION /end FUNCTION
/begin FUNCTION INDEX_CLWS "" /begin DEF_CHARACTERISTIC /end DEF_CHARACTERISTIC /begin REF_CHARACTERISTIC /end REF_CHARACTERISTIC /begin IN_MEASUREMENT /end IN_MEASUREMENT /begin OUT_MEASUREMENT /end OUT_MEASUREMENT /begin LOC_MEASUREMENT /end LOC_MEASUREMENT /begin SUB_FUNCTION /end SUB_FUNCTION /end FUNCTION
/begin FUNCTION INDEX_CNIV "" /begin DEF_CHARACTERISTIC /end DEF_CHARACTERISTIC /begin REF_CHARACTERISTIC /end REF_CHARACTERISTIC /begin IN_MEASUREMENT /end IN_MEASUREMENT /begin OUT_MEASUREMENT /end OUT_MEASUREMENT /begin LOC_MEASUREMENT /end LOC_MEASUREMENT /begin SUB_FUNCTION /end SUB_FUNCTION /end FUNCTION
/begin FUNCTION INDEX_CNOX "" /begin DEF_CHARACTERISTIC /end DEF_CHARACTERISTIC /begin REF_CHARACTERISTIC /end REF_CHARACTERISTIC /begin IN_MEASUREMENT /end IN_MEASUREMENT /begin OUT_MEASUREMENT /end OUT_MEASUREMENT /begin LOC_MEASUREMENT /end LOC_MEASUREMENT /begin SUB_FUNCTION /end SUB_FUNCTION /end FUNCTION
/begin FUNCTION INDEX_CZAS "" /begin DEF_CHARACTERISTIC /end DEF_CHARACTERISTIC /begin REF_CHARACTERISTIC /end REF_CHARACTERISTIC /begin IN_MEASUREMENT /end IN_MEASUREMENT /begin OUT_MEASUREMENT /end OUT_MEASUREMENT /begin LOC_MEASUREMENT /end LOC_MEASUREMENT /begin SUB_FUNCTION /end SUB_FUNCTION /end FUNCTION
/begin FUNCTION INDEX_DATR "" /begin DEF_CHARACTERISTIC /end DEF_CHARACTERISTIC /begin REF_CHARACTERISTIC /end REF_CHARACTERISTIC /begin IN_MEASUREMENT /end IN_MEASUREMENT /begin OUT_MEASUREMENT /end OUT_MEASUREMENT /begin LOC_MEASUREMENT /end LOC_MEASUREMENT /begin SUB_FUNCTION /end SUB_FUNCTION /end FUNCTION
/begin FUNCTION INDEX_DATS "" /begin DEF_CHARACTERISTIC /end DEF_CHARACTERISTIC /begin REF_CHARACTERISTIC /end REF_CHARACTERISTIC /begin IN_MEASUREMENT /end IN_MEASUREMENT /begin OUT_MEASUREMENT /end OUT_MEASUREMENT /begin LOC_MEASUREMENT /end LOC_MEASUREMENT /begin SUB_FUNCTION /end SUB_FUNCTION /end FUNCTION
/begin FUNCTION INDEX_DBKVP "" /begin DEF_CHARACTERISTIC /end DEF_CHARACTERISTIC /begin REF_CHARACTERISTIC /end REF_CHARACTERISTIC /begin IN_MEASUREMENT /end IN_MEASUREMENT /begin OUT_MEASUREMENT /end OUT_MEASUREMENT /begin LOC_MEASUREMENT /end LOC_MEASUREMENT /begin SUB_FUNCTION /end SUB_FUNCTION /end FUNCTION
/begin FUNCTION INDEX_DDG "" /begin DEF_CHARACTERISTIC /end DEF_CHARACTERISTIC /begin REF_CHARACTERISTIC /end REF_CHARACTERISTIC /begin IN_MEASUREMENT /end IN_MEASUREMENT /begin OUT_MEASUREMENT /end OUT_MEASUREMENT /begin LOC_MEASUREMENT /end LOC_MEASUREMENT /begin SUB_FUNCTION /end SUB_FUNCTION /end FUNCTION
/begin FUNCTION INDEX_DDKV "" /begin DEF_CHARACTERISTIC /end DEF_CHARACTERISTIC /begin REF_CHARACTERISTIC /end REF_CHARACTERISTIC /begin IN_MEASUREMENT /end IN_MEASUREMENT /begin OUT_MEASUREMENT /end OUT_MEASUREMENT /begin LOC_MEASUREMENT /end LOC_MEASUREMENT /begin SUB_FUNCTION /end SUB_FUNCTION /end FUNCTION
/begin FUNCTION INDEX_DDVE "" /begin DEF_CHARACTERISTIC /end DEF_CHARACTERISTIC /begin REF_CHARACTERISTIC /end REF_CHARACTERISTIC /begin IN_MEASUREMENT /end IN_MEASUREMENT /begin OUT_MEASUREMENT /end OUT_MEASUREMENT /begin LOC_MEASUREMENT /end LOC_MEASUREMENT /begin SUB_FUNCTION /end SUB_FUNCTION /end FUNCTION
/begin FUNCTION INDEX_DEGFE "" /begin DEF_CHARACTERISTIC /end DEF_CHARACTERISTIC /begin REF_CHARACTERISTIC /end REF_CHARACTERISTIC /begin IN_MEASUREMENT /end IN_MEASUREMENT /begin OUT_MEASUREMENT /end OUT_MEASUREMENT /begin LOC_MEASUREMENT /end LOC_MEASUREMENT /begin SUB_FUNCTION /end SUB_FUNCTION /end FUNCTION
/begin FUNCTION INDEX_DEKON "" /begin DEF_CHARACTERISTIC /end DEF_CHARACTERISTIC /begin REF_CHARACTERISTIC /end REF_CHARACTERISTIC /begin IN_MEASUREMENT /end IN_MEASUREMENT /begin OUT_MEASUREMENT /end OUT_MEASUREMENT /begin LOC_MEASUREMENT /end LOC_MEASUREMENT /begin SUB_FUNCTION /end SUB_FUNCTION /end FUNCTION
/begin FUNCTION INDEX_DENWS "" /begin DEF_CHARACTERISTIC /end DEF_CHARACTERISTIC /begin REF_CHARACTERISTIC /end REF_CHARACTERISTIC /begin IN_MEASUREMENT /end IN_MEASUREMENT /begin OUT_MEASUREMENT /end OUT_MEASUREMENT /begin LOC_MEASUREMENT /end LOC_MEASUREMENT /begin SUB_FUNCTION /end SUB_FUNCTION /end FUNCTION
/begin FUNCTION INDEX_DFPM "" /begin DEF_CHARACTERISTIC /end DEF_CHARACTERISTIC /begin REF_CHARACTERISTIC /end REF_CHARACTERISTIC /begin IN_MEASUREMENT /end IN_MEASUREMENT /begin OUT_MEASUREMENT /end OUT_MEASUREMENT /begin LOC_MEASUREMENT /end LOC_MEASUREMENT /begin SUB_FUNCTION /end SUB_FUNCTION /end FUNCTION
/begin FUNCTION INDEX_DHFM "" /begin DEF_CHARACTERISTIC /end DEF_CHARACTERISTIC /begin REF_CHARACTERISTIC /end REF_CHARACTERISTIC /begin IN_MEASUREMENT /end IN_MEASUREMENT /begin OUT_MEASUREMENT /end OUT_MEASUREMENT /begin LOC_MEASUREMENT /end LOC_MEASUREMENT /begin SUB_FUNCTION /end SUB_FUNCTION /end FUNCTION
/begin FUNCTION INDEX_DHLSHK "" /begin DEF_CHARACTERISTIC /end DEF_CHARACTERISTIC /begin REF_CHARACTERISTIC /end REF_CHARACTERISTIC /begin IN_MEASUREMENT /end IN_MEASUREMENT /begin OUT_MEASUREMENT /end OUT_MEASUREMENT /begin LOC_MEASUREMENT /end LOC_MEASUREMENT /begin SUB_FUNCTION /end SUB_FUNCTION /end FUNCTION
/begin FUNCTION INDEX_DHLSU "" /begin DEF_CHARACTERISTIC /end DEF_CHARACTERISTIC /begin REF_CHARACTERISTIC /end REF_CHARACTERISTIC /begin IN_MEASUREMENT /end IN_MEASUREMENT /begin OUT_MEASUREMENT /end OUT_MEASUREMENT /begin LOC_MEASUREMENT /end LOC_MEASUREMENT /begin SUB_FUNCTION /end SUB_FUNCTION /end FUNCTION
/begin FUNCTION INDEX_DKATSP "" /begin DEF_CHARACTERISTIC /end DEF_CHARACTERISTIC /begin REF_CHARACTERISTIC /end REF_CHARACTERISTIC /begin IN_MEASUREMENT /end IN_MEASUREMENT /begin OUT_MEASUREMENT /end OUT_MEASUREMENT /begin LOC_MEASUREMENT /end LOC_MEASUREMENT /begin SUB_FUNCTION /end SUB_FUNCTION /end FUNCTION
/begin FUNCTION INDEX_dkmtr "dkmtr." /begin DEF_CHARACTERISTIC /end DEF_CHARACTERISTIC /begin REF_CHARACTERISTIC /end REF_CHARACTERISTIC /begin IN_MEASUREMENT /end IN_MEASUREMENT /begin OUT_MEASUREMENT /end OUT_MEASUREMENT /begin LOC_MEASUREMENT /end LOC_MEASUREMENT /begin SUB_FUNCTION /end SUB_FUNCTION /end FUNCTION
/begin FUNCTION INDEX_DKRA "" /begin DEF_CHARACTERISTIC /end DEF_CHARACTERISTIC /begin REF_CHARACTERISTIC /end REF_CHARACTERISTIC /begin IN_MEASUREMENT /end IN_MEASUREMENT /begin OUT_MEASUREMENT /end OUT_MEASUREMENT /begin LOC_MEASUREMENT /end LOC_MEASUREMENT /begin SUB_FUNCTION /end SUB_FUNCTION /end FUNCTION
/begin FUNCTION INDEX_DKRNT "" /begin DEF_CHARACTERISTIC /end DEF_CHARACTERISTIC /begin REF_CHARACTERISTIC /end REF_CHARACTERISTIC /begin IN_MEASUREMENT /end IN_MEASUREMENT /begin OUT_MEASUREMENT /end OUT_MEASUREMENT /begin LOC_MEASUREMENT /end LOC_MEASUREMENT /begin SUB_FUNCTION /end SUB_FUNCTION /end FUNCTION
/begin FUNCTION INDEX_DKRS "" /begin DEF_CHARACTERISTIC /end DEF_CHARACTERISTIC /begin REF_CHARACTERISTIC /end REF_CHARACTERISTIC /begin IN_MEASUREMENT /end IN_MEASUREMENT /begin OUT_MEASUREMENT /end OUT_MEASUREMENT /begin LOC_MEASUREMENT /end LOC_MEASUREMENT /begin SUB_FUNCTION /end SUB_FUNCTION /end FUNCTION
/begin FUNCTION INDEX_DKRTP "" /begin DEF_CHARACTERISTIC /end DEF_CHARACTERISTIC /begin REF_CHARACTERISTIC /end REF_CHARACTERISTIC /begin IN_MEASUREMENT /end IN_MEASUREMENT /begin OUT_MEASUREMENT /end OUT_MEASUREMENT /begin LOC_MEASUREMENT /end LOC_MEASUREMENT /begin SUB_FUNCTION /end SUB_FUNCTION /end FUNCTION
/begin FUNCTION INDEX_DKUPPL "" /begin DEF_CHARACTERISTIC /end DEF_CHARACTERISTIC /begin REF_CHARACTERISTIC /end REF_CHARACTERISTIC /begin IN_MEASUREMENT /end IN_MEASUREMENT /begin OUT_MEASUREMENT /end OUT_MEASUREMENT /begin LOC_MEASUREMENT /end LOC_MEASUREMENT /begin SUB_FUNCTION /end SUB_FUNCTION /end FUNCTION
/begin FUNCTION INDEX_DKVS "" /begin DEF_CHARACTERISTIC /end DEF_CHARACTERISTIC /begin REF_CHARACTERISTIC /end REF_CHARACTERISTIC /begin IN_MEASUREMENT /end IN_MEASUREMENT /begin OUT_MEASUREMENT /end OUT_MEASUREMENT /begin LOC_MEASUREMENT /end LOC_MEASUREMENT /begin SUB_FUNCTION /end SUB_FUNCTION /end FUNCTION
/begin FUNCTION INDEX_DLDP "" /begin DEF_CHARACTERISTIC /end DEF_CHARACTERISTIC /begin REF_CHARACTERISTIC /end REF_CHARACTERISTIC /begin IN_MEASUREMENT /end IN_MEASUREMENT /begin OUT_MEASUREMENT /end OUT_MEASUREMENT /begin LOC_MEASUREMENT /end LOC_MEASUREMENT /begin SUB_FUNCTION /end SUB_FUNCTION /end FUNCTION
/begin FUNCTION INDEX_DLDR "DLDR." /begin DEF_CHARACTERISTIC /end DEF_CHARACTERISTIC /begin REF_CHARACTERISTIC /end REF_CHARACTERISTIC /begin IN_MEASUREMENT /end IN_MEASUREMENT /begin OUT_MEASUREMENT /end OUT_MEASUREMENT /begin LOC_MEASUREMENT /end LOC_MEASUREMENT /begin SUB_FUNCTION /end SUB_FUNCTION /end FUNCTION
/begin FUNCTION INDEX_DLDUV "1.40" /begin DEF_CHARACTERISTIC /end DEF_CHARACTERISTIC /begin REF_CHARACTERISTIC /end REF_CHARACTERISTIC /begin IN_MEASUREMENT /end IN_MEASUREMENT /begin OUT_MEASUREMENT /end OUT_MEASUREMENT /begin LOC_MEASUREMENT /end LOC_MEASUREMENT /begin SUB_FUNCTION /end SUB_FUNCTION /end FUNCTION
/begin FUNCTION INDEX_DLLR "" /begin DEF_CHARACTERISTIC /end DEF_CHARACTERISTIC /begin REF_CHARACTERISTIC /end REF_CHARACTERISTIC /begin IN_MEASUREMENT /end IN_MEASUREMENT /begin OUT_MEASUREMENT /end OUT_MEASUREMENT /begin LOC_MEASUREMENT /end LOC_MEASUREMENT /begin SUB_FUNCTION /end SUB_FUNCTION /end FUNCTION
/begin FUNCTION INDEX_DLSAHK "" /begin DEF_CHARACTERISTIC /end DEF_CHARACTERISTIC /begin REF_CHARACTERISTIC /end REF_CHARACTERISTIC /begin IN_MEASUREMENT /end IN_MEASUREMENT /begin OUT_MEASUREMENT /end OUT_MEASUREMENT /begin LOC_MEASUREMENT /end LOC_MEASUREMENT /begin SUB_FUNCTION /end SUB_FUNCTION /end FUNCTION
/begin FUNCTION INDEX_DLSH "" /begin DEF_CHARACTERISTIC /end DEF_CHARACTERISTIC /begin REF_CHARACTERISTIC /end REF_CHARACTERISTIC /begin IN_MEASUREMENT /end IN_MEASUREMENT /begin OUT_MEASUREMENT /end OUT_MEASUREMENT /begin LOC_MEASUREMENT /end LOC_MEASUREMENT /begin SUB_FUNCTION /end SUB_FUNCTION /end FUNCTION
/begin FUNCTION INDEX_DLSU "" /begin DEF_CHARACTERISTIC /end DEF_CHARACTERISTIC /begin REF_CHARACTERISTIC /end REF_CHARACTERISTIC /begin IN_MEASUREMENT /end IN_MEASUREMENT /begin OUT_MEASUREMENT /end OUT_MEASUREMENT /begin LOC_MEASUREMENT /end LOC_MEASUREMENT /begin SUB_FUNCTION /end SUB_FUNCTION /end FUNCTION
/begin FUNCTION INDEX_DMDMIL "" /begin DEF_CHARACTERISTIC /end DEF_CHARACTERISTIC /begin REF_CHARACTERISTIC /end REF_CHARACTERISTIC /begin IN_MEASUREMENT /end IN_MEASUREMENT /begin OUT_MEASUREMENT /end OUT_MEASUREMENT /begin LOC_MEASUREMENT /end LOC_MEASUREMENT /begin SUB_FUNCTION /end SUB_FUNCTION /end FUNCTION
/begin FUNCTION INDEX_DMFB "" /begin DEF_CHARACTERISTIC /end DEF_CHARACTERISTIC /begin REF_CHARACTERISTIC /end REF_CHARACTERISTIC /begin IN_MEASUREMENT /end IN_MEASUREMENT /begin OUT_MEASUREMENT /end OUT_MEASUREMENT /begin LOC_MEASUREMENT /end LOC_MEASUREMENT /begin SUB_FUNCTION /end SUB_FUNCTION /end FUNCTION
/begin FUNCTION INDEX_DNMAX "" /begin DEF_CHARACTERISTIC /end DEF_CHARACTERISTIC /begin REF_CHARACTERISTIC /end REF_CHARACTERISTIC /begin IN_MEASUREMENT /end IN_MEASUREMENT /begin OUT_MEASUREMENT /end OUT_MEASUREMENT /begin LOC_MEASUREMENT /end LOC_MEASUREMENT /begin SUB_FUNCTION /end SUB_FUNCTION /end FUNCTION
/begin FUNCTION INDEX_DNWKW "" /begin DEF_CHARACTERISTIC /end DEF_CHARACTERISTIC /begin REF_CHARACTERISTIC /end REF_CHARACTERISTIC /begin IN_MEASUREMENT /end IN_MEASUREMENT /begin OUT_MEASUREMENT /end OUT_MEASUREMENT /begin LOC_MEASUREMENT /end LOC_MEASUREMENT /begin SUB_FUNCTION /end SUB_FUNCTION /end FUNCTION
/begin FUNCTION INDEX_DPH "" /begin DEF_CHARACTERISTIC /end DEF_CHARACTERISTIC /begin REF_CHARACTERISTIC /end REF_CHARACTERISTIC /begin IN_MEASUREMENT /end IN_MEASUREMENT /begin OUT_MEASUREMENT /end OUT_MEASUREMENT /begin LOC_MEASUREMENT /end LOC_MEASUREMENT /begin SUB_FUNCTION /end SUB_FUNCTION /end FUNCTION
/begin FUNCTION INDEX_DPL "" /begin DEF_CHARACTERISTIC /end DEF_CHARACTERISTIC /begin REF_CHARACTERISTIC /end REF_CHARACTERISTIC /begin IN_MEASUREMENT /end IN_MEASUREMENT /begin OUT_MEASUREMENT /end OUT_MEASUREMENT /begin LOC_MEASUREMENT /end LOC_MEASUREMENT /begin SUB_FUNCTION /end SUB_FUNCTION /end FUNCTION
/begin FUNCTION INDEX_DSBKV "" /begin DEF_CHARACTERISTIC /end DEF_CHARACTERISTIC /begin REF_CHARACTERISTIC /end REF_CHARACTERISTIC /begin IN_MEASUREMENT /end IN_MEASUREMENT /begin OUT_MEASUREMENT /end OUT_MEASUREMENT /begin LOC_MEASUREMENT /end LOC_MEASUREMENT /begin SUB_FUNCTION /end SUB_FUNCTION /end FUNCTION
/begin FUNCTION INDEX_DSELHFS "" /begin DEF_CHARACTERISTIC /end DEF_CHARACTERISTIC /begin REF_CHARACTERISTIC /end REF_CHARACTERISTIC /begin IN_MEASUREMENT /end IN_MEASUREMENT /begin OUT_MEASUREMENT /end OUT_MEASUREMENT /begin LOC_MEASUREMENT /end LOC_MEASUREMENT /begin SUB_FUNCTION /end SUB_FUNCTION /end FUNCTION
/begin FUNCTION INDEX_DSGEEP "" /begin DEF_CHARACTERISTIC /end DEF_CHARACTERISTIC /begin REF_CHARACTERISTIC /end REF_CHARACTERISTIC /begin IN_MEASUREMENT /end IN_MEASUREMENT /begin OUT_MEASUREMENT /end OUT_MEASUREMENT /begin LOC_MEASUREMENT /end LOC_MEASUREMENT /begin SUB_FUNCTION /end SUB_FUNCTION /end FUNCTION
/begin FUNCTION INDEX_DSLSLRS "" /begin DEF_CHARACTERISTIC /end DEF_CHARACTERISTIC /begin REF_CHARACTERISTIC /end REF_CHARACTERISTIC /begin IN_MEASUREMENT /end IN_MEASUREMENT /begin OUT_MEASUREMENT /end OUT_MEASUREMENT /begin LOC_MEASUREMENT /end LOC_MEASUREMENT /begin SUB_FUNCTION /end SUB_FUNCTION /end FUNCTION
/begin FUNCTION INDEX_DSWEA "" /begin DEF_CHARACTERISTIC /end DEF_CHARACTERISTIC /begin REF_CHARACTERISTIC /end REF_CHARACTERISTIC /begin IN_MEASUREMENT /end IN_MEASUREMENT /begin OUT_MEASUREMENT /end OUT_MEASUREMENT /begin LOC_MEASUREMENT /end LOC_MEASUREMENT /begin SUB_FUNCTION /end SUB_FUNCTION /end FUNCTION
/begin FUNCTION INDEX_DT2STC "" /begin DEF_CHARACTERISTIC /end DEF_CHARACTERISTIC /begin REF_CHARACTERISTIC /end REF_CHARACTERISTIC /begin IN_MEASUREMENT /end IN_MEASUREMENT /begin OUT_MEASUREMENT /end OUT_MEASUREMENT /begin LOC_MEASUREMENT /end LOC_MEASUREMENT /begin SUB_FUNCTION /end SUB_FUNCTION /end FUNCTION
/begin FUNCTION INDEX_DTANKL "" /begin DEF_CHARACTERISTIC /end DEF_CHARACTERISTIC /begin REF_CHARACTERISTIC /end REF_CHARACTERISTIC /begin IN_MEASUREMENT /end IN_MEASUREMENT /begin OUT_MEASUREMENT /end OUT_MEASUREMENT /begin LOC_MEASUREMENT /end LOC_MEASUREMENT /begin SUB_FUNCTION /end SUB_FUNCTION /end FUNCTION
/begin FUNCTION INDEX_DTEV "" /begin DEF_CHARACTERISTIC /end DEF_CHARACTERISTIC /begin REF_CHARACTERISTIC /end REF_CHARACTERISTIC /begin IN_MEASUREMENT /end IN_MEASUREMENT /begin OUT_MEASUREMENT /end OUT_MEASUREMENT /begin LOC_MEASUREMENT /end LOC_MEASUREMENT /begin SUB_FUNCTION /end SUB_FUNCTION /end FUNCTION
/begin FUNCTION INDEX_DTHM "" /begin DEF_CHARACTERISTIC /end DEF_CHARACTERISTIC /begin REF_CHARACTERISTIC /end REF_CHARACTERISTIC /begin IN_MEASUREMENT /end IN_MEASUREMENT /begin OUT_MEASUREMENT /end OUT_MEASUREMENT /begin LOC_MEASUREMENT /end LOC_MEASUREMENT /begin SUB_FUNCTION /end SUB_FUNCTION /end FUNCTION
/begin FUNCTION INDEX_DUF "" /begin DEF_CHARACTERISTIC /end DEF_CHARACTERISTIC /begin REF_CHARACTERISTIC /end REF_CHARACTERISTIC /begin IN_MEASUREMENT /end IN_MEASUREMENT /begin OUT_MEASUREMENT /end OUT_MEASUREMENT /begin LOC_MEASUREMENT /end LOC_MEASUREMENT /begin SUB_FUNCTION /end SUB_FUNCTION /end FUNCTION
/begin FUNCTION INDEX_DUMMY_D "" /begin DEF_CHARACTERISTIC /end DEF_CHARACTERISTIC /begin REF_CHARACTERISTIC /end REF_CHARACTERISTIC /begin IN_MEASUREMENT /end IN_MEASUREMENT /begin OUT_MEASUREMENT /end OUT_MEASUREMENT /begin LOC_MEASUREMENT /end LOC_MEASUREMENT /begin SUB_FUNCTION /end SUB_FUNCTION /end FUNCTION
/begin FUNCTION INDEX_DUR "" /begin DEF_CHARACTERISTIC /end DEF_CHARACTERISTIC /begin REF_CHARACTERISTIC /end REF_CHARACTERISTIC /begin IN_MEASUREMENT /end IN_MEASUREMENT /begin OUT_MEASUREMENT /end OUT_MEASUREMENT /begin LOC_MEASUREMENT /end LOC_MEASUREMENT /begin SUB_FUNCTION /end SUB_FUNCTION /end FUNCTION
/begin FUNCTION INDEX_DVFZ "" /begin DEF_CHARACTERISTIC /end DEF_CHARACTERISTIC /begin REF_CHARACTERISTIC /end REF_CHARACTERISTIC /begin IN_MEASUREMENT /end IN_MEASUREMENT /begin OUT_MEASUREMENT /end OUT_MEASUREMENT /begin LOC_MEASUREMENT /end LOC_MEASUREMENT /begin SUB_FUNCTION /end SUB_FUNCTION /end FUNCTION
/begin FUNCTION INDEX_GECOD "" /begin DEF_CHARACTERISTIC /end DEF_CHARACTERISTIC /begin REF_CHARACTERISTIC /end REF_CHARACTERISTIC /begin IN_MEASUREMENT /end IN_MEASUREMENT /begin OUT_MEASUREMENT /end OUT_MEASUREMENT /begin LOC_MEASUREMENT /end LOC_MEASUREMENT /begin SUB_FUNCTION /end SUB_FUNCTION /end FUNCTION
/begin FUNCTION INDEX_GGCS "" /begin DEF_CHARACTERISTIC /end DEF_CHARACTERISTIC /begin REF_CHARACTERISTIC /end REF_CHARACTERISTIC /begin IN_MEASUREMENT /end IN_MEASUREMENT /begin OUT_MEASUREMENT /end OUT_MEASUREMENT /begin LOC_MEASUREMENT /end LOC_MEASUREMENT /begin SUB_FUNCTION /end SUB_FUNCTION /end FUNCTION
/begin FUNCTION INDEX_GGDSAS "" /begin DEF_CHARACTERISTIC /end DEF_CHARACTERISTIC /begin REF_CHARACTERISTIC /end REF_CHARACTERISTIC /begin IN_MEASUREMENT /end IN_MEASUREMENT /begin OUT_MEASUREMENT /end OUT_MEASUREMENT /begin LOC_MEASUREMENT /end LOC_MEASUREMENT /begin SUB_FUNCTION /end SUB_FUNCTION /end FUNCTION
/begin FUNCTION INDEX_GGEGAS "" /begin DEF_CHARACTERISTIC /end DEF_CHARACTERISTIC /begin REF_CHARACTERISTIC /end REF_CHARACTERISTIC /begin IN_MEASUREMENT /end IN_MEASUREMENT /begin OUT_MEASUREMENT /end OUT_MEASUREMENT /begin LOC_MEASUREMENT /end LOC_MEASUREMENT /begin SUB_FUNCTION /end SUB_FUNCTION /end FUNCTION
/begin FUNCTION INDEX_GGFGRH "" /begin DEF_CHARACTERISTIC /end DEF_CHARACTERISTIC /begin REF_CHARACTERISTIC /end REF_CHARACTERISTIC /begin IN_MEASUREMENT /end IN_MEASUREMENT /begin OUT_MEASUREMENT /end OUT_MEASUREMENT /begin LOC_MEASUREMENT /end LOC_MEASUREMENT /begin SUB_FUNCTION /end SUB_FUNCTION /end FUNCTION
/begin FUNCTION INDEX_GGGTS "" /begin DEF_CHARACTERISTIC /end DEF_CHARACTERISTIC /begin REF_CHARACTERISTIC /end REF_CHARACTERISTIC /begin IN_MEASUREMENT /end IN_MEASUREMENT /begin OUT_MEASUREMENT /end OUT_MEASUREMENT /begin LOC_MEASUREMENT /end LOC_MEASUREMENT /begin SUB_FUNCTION /end SUB_FUNCTION /end FUNCTION
/begin FUNCTION INDEX_GGHLA "" /begin DEF_CHARACTERISTIC /end DEF_CHARACTERISTIC /begin REF_CHARACTERISTIC /end REF_CHARACTERISTIC /begin IN_MEASUREMENT /end IN_MEASUREMENT /begin OUT_MEASUREMENT /end OUT_MEASUREMENT /begin LOC_MEASUREMENT /end LOC_MEASUREMENT /begin SUB_FUNCTION /end SUB_FUNCTION /end FUNCTION
/begin FUNCTION INDEX_GGPED "" /begin DEF_CHARACTERISTIC /end DEF_CHARACTERISTIC /begin REF_CHARACTERISTIC /end REF_CHARACTERISTIC /begin IN_MEASUREMENT /end IN_MEASUREMENT /begin OUT_MEASUREMENT /end OUT_MEASUREMENT /begin LOC_MEASUREMENT /end LOC_MEASUREMENT /begin SUB_FUNCTION /end SUB_FUNCTION /end FUNCTION
/begin FUNCTION INDEX_GGTFA "" /begin DEF_CHARACTERISTIC /end DEF_CHARACTERISTIC /begin REF_CHARACTERISTIC /end REF_CHARACTERISTIC /begin IN_MEASUREMENT /end IN_MEASUREMENT /begin OUT_MEASUREMENT /end OUT_MEASUREMENT /begin LOC_MEASUREMENT /end LOC_MEASUREMENT /begin SUB_FUNCTION /end SUB_FUNCTION /end FUNCTION
/begin FUNCTION INDEX_GGTFM "" /begin DEF_CHARACTERISTIC /end DEF_CHARACTERISTIC /begin REF_CHARACTERISTIC /end REF_CHARACTERISTIC /begin IN_MEASUREMENT /end IN_MEASUREMENT /begin OUT_MEASUREMENT /end OUT_MEASUREMENT /begin LOC_MEASUREMENT /end LOC_MEASUREMENT /begin SUB_FUNCTION /end SUB_FUNCTION /end FUNCTION
/begin FUNCTION INDEX_GGTKA "" /begin DEF_CHARACTERISTIC /end DEF_CHARACTERISTIC /begin REF_CHARACTERISTIC /end REF_CHARACTERISTIC /begin IN_MEASUREMENT /end IN_MEASUREMENT /begin OUT_MEASUREMENT /end OUT_MEASUREMENT /begin LOC_MEASUREMENT /end LOC_MEASUREMENT /begin SUB_FUNCTION /end SUB_FUNCTION /end FUNCTION
/begin FUNCTION INDEX_GGUB "" /begin DEF_CHARACTERISTIC /end DEF_CHARACTERISTIC /begin REF_CHARACTERISTIC /end REF_CHARACTERISTIC /begin IN_MEASUREMENT /end IN_MEASUREMENT /begin OUT_MEASUREMENT /end OUT_MEASUREMENT /begin LOC_MEASUREMENT /end LOC_MEASUREMENT /begin SUB_FUNCTION /end SUB_FUNCTION /end FUNCTION
/begin FUNCTION INDEX_GGUBR "" /begin DEF_CHARACTERISTIC /end DEF_CHARACTERISTIC /begin REF_CHARACTERISTIC /end REF_CHARACTERISTIC /begin IN_MEASUREMENT /end IN_MEASUREMENT /begin OUT_MEASUREMENT /end OUT_MEASUREMENT /begin LOC_MEASUREMENT /end LOC_MEASUREMENT /begin SUB_FUNCTION /end SUB_FUNCTION /end FUNCTION
/begin FUNCTION INDEX_HRE "" /begin DEF_CHARACTERISTIC /end DEF_CHARACTERISTIC /begin REF_CHARACTERISTIC /end REF_CHARACTERISTIC /begin IN_MEASUREMENT /end IN_MEASUREMENT /begin OUT_MEASUREMENT /end OUT_MEASUREMENT /begin LOC_MEASUREMENT /end LOC_MEASUREMENT /begin SUB_FUNCTION /end SUB_FUNCTION /end FUNCTION
/begin FUNCTION INDEX_IMS "" /begin DEF_CHARACTERISTIC /end DEF_CHARACTERISTIC /begin REF_CHARACTERISTIC /end REF_CHARACTERISTIC /begin IN_MEASUREMENT /end IN_MEASUREMENT /begin OUT_MEASUREMENT /end OUT_MEASUREMENT /begin LOC_MEASUREMENT /end LOC_MEASUREMENT /begin SUB_FUNCTION /end SUB_FUNCTION /end FUNCTION
/begin FUNCTION INDEX_LDPE "" /begin DEF_CHARACTERISTIC /end DEF_CHARACTERISTIC /begin REF_CHARACTERISTIC /end REF_CHARACTERISTIC /begin IN_MEASUREMENT /end IN_MEASUREMENT /begin OUT_MEASUREMENT /end OUT_MEASUREMENT /begin LOC_MEASUREMENT /end LOC_MEASUREMENT /begin SUB_FUNCTION /end SUB_FUNCTION /end FUNCTION
/begin FUNCTION INDEX_MDKOG "" /begin DEF_CHARACTERISTIC /end DEF_CHARACTERISTIC /begin REF_CHARACTERISTIC /end REF_CHARACTERISTIC /begin IN_MEASUREMENT /end IN_MEASUREMENT /begin OUT_MEASUREMENT /end OUT_MEASUREMENT /begin LOC_MEASUREMENT /end LOC_MEASUREMENT /begin SUB_FUNCTION /end SUB_FUNCTION /end FUNCTION
/begin FUNCTION INDEX_TUNING "" /begin DEF_CHARACTERISTIC /end DEF_CHARACTERISTIC /begin REF_CHARACTERISTIC /end REF_CHARACTERISTIC /begin IN_MEASUREMENT /end IN_MEASUREMENT /begin OUT_MEASUREMENT /end OUT_MEASUREMENT /begin LOC_MEASUREMENT /end LOC_MEASUREMENT /begin SUB_FUNCTION /end SUB_FUNCTION /end FUNCTION
/begin FUNCTION K71EXT "" /begin DEF_CHARACTERISTIC /end DEF_CHARACTERISTIC /begin REF_CHARACTERISTIC /end REF_CHARACTERISTIC /begin IN_MEASUREMENT fcmEnd /end IN_MEASUREMENT /begin OUT_MEASUREMENT /end OUT_MEASUREMENT /begin LOC_MEASUREMENT /end LOC_MEASUREMENT /begin SUB_FUNCTION /end SUB_FUNCTION /end FUNCTION
/begin FUNCTION K71MN "" /begin DEF_CHARACTERISTIC TIDLEMAX TIDLEMIN /end DEF_CHARACTERISTIC /begin REF_CHARACTERISTIC /end REF_CHARACTERISTIC /begin IN_MEASUREMENT B_fa B_fgrte B_grdst B_kstebf B_lrndia B_stend nmot_w /end IN_MEASUREMENT
 /begin OUT_MEASUREMENT B_0101_ack B_0101_ident B_0101_notadr B_0101_switch kwp71_bits /end OUT_MEASUREMENT
 /begin LOC_MEASUREMENT t_idle_ctr /end LOC_MEASUREMENT
 /begin SUB_FUNCTION /end SUB_FUNCTION
/end FUNCTION
/begin FUNCTION K71SR "" /begin DEF_CHARACTERISTIC /end DEF_CHARACTERISTIC
 /begin REF_CHARACTERISTIC ADRONLOGIN GRAOFLOGIN GRAONLOGIN HLOFFLOGIN HLONLOGIN KLOGIN LUEN1LOGIN LUEN2LOGIN LUEN3LOGIN SGIDB1 SGIDB2 SGIDB3 SLOGIN VARDEF /end REF_CHARACTERISTIC
 /begin IN_MEASUREMENT B_0101_ack B_0101_ident B_0101_switch B_acc B_accen B_fgrte B_hlon B_luef1 B_luef2 B_luef3 kwp71_bits nmot_w /end IN_MEASUREMENT
 /begin OUT_MEASUREMENT /end OUT_MEASUREMENT
 /begin LOC_MEASUREMENT /end LOC_MEASUREMENT
 /begin SUB_FUNCTION /end SUB_FUNCTION
/end FUNCTION
/begin FUNCTION KDIAG "" /begin DEF_CHARACTERISTIC SGIDB4 SGIDB5 SGIDB6 SGIDB7 SGIDK1_DAT /end DEF_CHARACTERISTIC
 /begin REF_CHARACTERISTIC ADRONLOGIN GRAOFLOGIN GRAONLOGIN KLOGIN SGIDB1 SGIDB2 SGIDB3 SLOGIN VARDEF /end REF_CHARACTERISTIC
 /begin IN_MEASUREMENT B_acc B_accen B_fgrte B_fpwld_ok B_pwf nmot_w /end IN_MEASUREMENT
 /begin OUT_MEASUREMENT B_fpwld /end OUT_MEASUREMENT
 /begin LOC_MEASUREMENT /end LOC_MEASUREMENT
 /begin SUB_FUNCTION /end SUB_FUNCTION
/end FUNCTION
/begin FUNCTION keycheck "" /begin DEF_CHARACTERISTIC /end DEF_CHARACTERISTIC /begin REF_CHARACTERISTIC /end REF_CHARACTERISTIC /begin IN_MEASUREMENT /end IN_MEASUREMENT /begin OUT_MEASUREMENT /end OUT_MEASUREMENT /begin LOC_MEASUREMENT /end LOC_MEASUREMENT /begin SUB_FUNCTION /end SUB_FUNCTION /end FUNCTION
/begin FUNCTION KHMD "1.100     Berechnung Reservemoment für Katheizen"
 /begin DEF_CHARACTERISTIC CWKHMD FMDKHFH FMDKHTMST FMDPUBKV KFKWTMP KFMDDSLAD KFMDDSLFA KFMDKH_0_A KFMDKH_1_A KFMDKHLL_0_A KFMDKHLL_1_A ZKBKVAB ZKMDKH /end DEF_CHARACTERISTIC
 /begin REF_CHARACTERISTIC /end REF_CHARACTERISTIC
 /begin IN_MEASUREMENT B_bkvleer B_dsl4 B_fasla B_kh B_kw B_ll dmllri_w fho_w fmdkh mifa_w nmot_w pubkv_w tmst /end IN_MEASUREMENT
 /begin OUT_MEASUREMENT dmrdsls_w dmrkh dmrkh_w /end OUT_MEASUREMENT
 /begin LOC_MEASUREMENT dmrkhz_w drkwtmp_w fmkhfho_w fmkhtmst mifakh_w mulres_w /end LOC_MEASUREMENT
 /begin SUB_FUNCTION /end SUB_FUNCTION
/end FUNCTION
/begin COMPU_METHOD bfzg_sb_q0p217 "" RAT_FUNC "%6.3" "m/s^2" COEFFS 0 1 0 0 0 0.217 /end COMPU_METHOD
/begin COMPU_METHOD bfzg_sw_q4p239Em4 "" RAT_FUNC "%10.7" "m/s^2" COEFFS 0 1 0 0 0 0.0004239 /end COMPU_METHOD
/begin COMPU_METHOD B_TRUE "boolsche Zustände, positive Logik" TAB_VERB "%6.3" "" COMPU_TAB_REF B_TRUE /end COMPU_METHOD
/begin COMPU_VTAB B_TRUE "boolsche Zustände, positive Logik" TAB_VERB 2 0 "----" 1 "TRUE" /end COMPU_VTAB
/begin COMPU_METHOD dez "1 : 1 Umrechnug (dez/hex)" RAT_FUNC "%6.2" "" COEFFS 0 1 0 0 0 1 /end COMPU_METHOD
/begin COMPU_METHOD dezsub1 "" RAT_FUNC "%6.2" "-" COEFFS 0 1 -1 0 0 1 /end COMPU_METHOD
/begin COMPU_METHOD dist_uw_q0p1 "" RAT_FUNC "%6.3" "-" COEFFS 0 10 0 0 0 1 /end COMPU_METHOD
/begin COMPU_METHOD fak_q0p0625 "" RAT_FUNC "%6.4" "-" COEFFS 0 16 0 0 0 1 /end COMPU_METHOD
/begin COMPU_METHOD fak_sw_b8 "" RAT_FUNC "%6.5" "-" COEFFS 0 65536 0 0 0 16 /end COMPU_METHOD
/begin COMPU_METHOD fak_ub_b1 "" RAT_FUNC "%6.4" "-" COEFFS 0 256 0 0 0 1 /end COMPU_METHOD
/begin COMPU_METHOD fak_ub_b16 "" RAT_FUNC "%6.4" "-" COEFFS 0 256 0 0 0 16 /end COMPU_METHOD
/begin COMPU_METHOD fak_ub_b1p25_o0p75 "" RAT_FUNC "%6.3" "-" COEFFS 0 1 -0.75 0 0 0.00195313 /end COMPU_METHOD
/begin COMPU_METHOD fak_ub_b2 "" RAT_FUNC "%6.4" "-" COEFFS 0 256 0 0 0 2 /end COMPU_METHOD
/begin COMPU_METHOD fak_ub_q0p01 "" RAT_FUNC "%6.4" "-" COEFFS 0 1 0 0 0 0.01 /end COMPU_METHOD
/begin COMPU_METHOD fak_uw_b1 "" RAT_FUNC "%7.6" "-" COEFFS 0 65536 0 0 0 1 /end COMPU_METHOD
/begin COMPU_METHOD fak_uw_b1024 "" RAT_FUNC "%6.4" "-" COEFFS 0 65536 0 0 0 1024 /end COMPU_METHOD
/begin COMPU_METHOD fak_uw_b16 "" RAT_FUNC "%6.5" "-" COEFFS 0 65536 0 0 0 16 /end COMPU_METHOD
/begin COMPU_METHOD fak_uw_b2 "" RAT_FUNC "%7.6" "-" COEFFS 0 65536 0 0 0 2 /end COMPU_METHOD
/begin COMPU_METHOD fak_uw_b4 "" RAT_FUNC "%7.6" "-" COEFFS 0 65536 0 0 0 4 /end COMPU_METHOD
/begin COMPU_METHOD fak_uw_b64 "" RAT_FUNC "%6.5" "-" COEFFS 0 65536 0 0 0 64 /end COMPU_METHOD
/begin COMPU_METHOD fak_uw_b8 "" RAT_FUNC "%6.5" "-" COEFFS 0 65536 0 0 0 8 /end COMPU_METHOD
/begin COMPU_METHOD fak_uw_q0p001 "" RAT_FUNC "%6.5" "" COEFFS 0 65536 0 0 0 65.536 /end COMPU_METHOD
/begin COMPU_METHOD fmfkr_dez "" RAT_FUNC "%6.2" "kHz" COEFFS 0 1 0 0 0 1 /end COMPU_METHOD
/begin COMPU_METHOD i_q0p0039_mA "" RAT_FUNC "%6.4" "mA" COEFFS 0 65536 0 0 0 256 /end COMPU_METHOD
/begin COMPU_METHOD KennText "" RAT_FUNC "%6.2" "" COEFFS 0 1 0 0 0 1 /end COMPU_METHOD
/begin COMPU_METHOD kw_q0p0039 "" RAT_FUNC "%6.4" "°KW" COEFFS 0 256 0 0 0 1 /end COMPU_METHOD
/begin COMPU_METHOD kw_q0p0078 "" RAT_FUNC "%6.4" "°KW" COEFFS 0 256 0 0 0 2 /end COMPU_METHOD
/begin COMPU_METHOD kw_q0p0156 "" RAT_FUNC "%6.4" "°KW" COEFFS 0 64 0 0 0 1 /end COMPU_METHOD
/begin COMPU_METHOD kw_q0p03125 "" RAT_FUNC "%6.4" "°KW" COEFFS 0 32 0 0 0 1 /end COMPU_METHOD
/begin COMPU_METHOD kw_q1 "" RAT_FUNC "%6.2" "°KW" COEFFS 0 1 0 0 0 1 /end COMPU_METHOD
/begin COMPU_METHOD leit_q3p125Em6 "" RAT_FUNC "%6.4" "mS [mSiemens]" COEFFS 0 65536 0 0 0 204.8 /end COMPU_METHOD
/begin COMPU_METHOD m_ub_b1020 "" RAT_FUNC "%6.2" "kg/h" COEFFS 0 1 0 0 0 4 /end COMPU_METHOD
/begin COMPU_METHOD m_ub_b23p3 "" RAT_FUNC "%6.3" "kg" COEFFS 0 2812.5 0 0 0 256 /end COMPU_METHOD
/begin COMPU_METHOD m_uw_b6553p5 "" RAT_FUNC "%6.3" "kg/h" COEFFS 0 1 0 0 0 0.1 /end COMPU_METHOD
/begin COMPU_METHOD nmot_ub_q40 "" RAT_FUNC "%6.1" "Upm" COEFFS 0 1 0 0 0 40 /end COMPU_METHOD
/begin COMPU_METHOD nmot_uw_q0p25 "" RAT_FUNC "%6.3" "U/min" COEFFS 0 1 0 0 0 0.25 /end COMPU_METHOD
/begin COMPU_METHOD pgrad_q0p039 "" RAT_FUNC "%6.4" "hPa/s" COEFFS 0 128 0 0 0 5 /end COMPU_METHOD
/begin COMPU_METHOD pgrad_q0p15625 "" RAT_FUNC "%6.3" "hPa/s" COEFFS 0 32 0 0 0 5 /end COMPU_METHOD
/begin COMPU_METHOD p_sw_q0p039 "" RAT_FUNC "%6.4" "hPa" COEFFS 0 256 0 0 0 10 /end COMPU_METHOD
/begin COMPU_METHOD p_ub_q5 "" RAT_FUNC "%6.2" "hPa" COEFFS 0 1 0 0 0 5 /end COMPU_METHOD
/begin COMPU_METHOD p_uw_q0p039 "" RAT_FUNC "%6.4" "hPa" COEFFS 0 256 0 0 0 10 /end COMPU_METHOD
/begin COMPU_METHOD relPED_ub_b100 "" RAT_FUNC "%6.3" "% PED" COEFFS 0 255 0 0 0 100 /end COMPU_METHOD
/begin COMPU_METHOD relPED_uw_b100 "" RAT_FUNC "%6.4" "% PED" COEFFS 0 65535 0 0 0 100 /end COMPU_METHOD
/begin COMPU_METHOD rel_sb_q0p39 "" RAT_FUNC "%6.3" "%" COEFFS 0 1 0 0 0 0.3906 /end COMPU_METHOD
/begin COMPU_METHOD rel_sw_b50 "" RAT_FUNC "%6.4" "%" COEFFS 0 65536 0 0 0 100 /end COMPU_METHOD
/begin COMPU_METHOD rel_ub_b99p6 "" RAT_FUNC "%6.3" "%" COEFFS 0 256 0 0 0 100 /end COMPU_METHOD
/begin COMPU_METHOD rel_ub_q0p75 "" RAT_FUNC "%6.3" "%" COEFFS 0 1 0 0 0 0.75 /end COMPU_METHOD
/begin COMPU_METHOD rel_uw_b100 "" RAT_FUNC "%6.4" "%" COEFFS 0 65536 0 0 0 100 /end COMPU_METHOD
/begin COMPU_METHOD rel_uw_b3072 "" RAT_FUNC "%6.4" "%" COEFFS 0 65536 0 0 0 3072 /end COMPU_METHOD
/begin COMPU_METHOD r_uw_q2 "" RAT_FUNC "%6.2" "Ohm" COEFFS 0 1 0 0 0 2 /end COMPU_METHOD
/begin COMPU_METHOD spg_q0p00039 "" RAT_FUNC "%6.5" "V" COEFFS 0 1 0 0 0 0.000390625 /end COMPU_METHOD
/begin COMPU_METHOD spg_q0p1 "" RAT_FUNC "%6.3" "V" COEFFS 0 1 0 0 0 0.1 /end COMPU_METHOD
/begin COMPU_METHOD spg_sw_q0p00488 "" RAT_FUNC "%6.4" "V" COEFFS 0 1024 0 0 0 5 /end COMPU_METHOD
/begin COMPU_METHOD spg_ubatt "" RAT_FUNC "%6.4" "V" COEFFS 0 1 0 0 0 0.0704 /end COMPU_METHOD
/begin COMPU_METHOD spg_ubatt_w "" RAT_FUNC "%6.4" "V" COEFFS 0 1 0 0 0 0.0176 /end COMPU_METHOD
/begin COMPU_METHOD spg_ub_b28p5 "" RAT_FUNC "%6.3" "V" COEFFS 0 1 0 0 0 0.1113 /end COMPU_METHOD
/begin COMPU_METHOD spg_ub_b5 "" RAT_FUNC "%6.4" "V" COEFFS 0 256 0 0 0 5 /end COMPU_METHOD
/begin COMPU_METHOD spg_ub_q0p0052_o0p2 "" RAT_FUNC "%6.3" "V" COEFFS 0 255 51 0 0 1.33 /end COMPU_METHOD
/begin COMPU_METHOD spg_uw_q0p00488 "" RAT_FUNC "%6.4" "V" COEFFS 0 1024 0 0 0 5 /end COMPU_METHOD
/begin COMPU_METHOD spg_uw_q0p00488_o1 "" RAT_FUNC "%6.3" "V" COEFFS 0 1024 1024 0 0 5 /end COMPU_METHOD
/begin COMPU_METHOD t100msxs_ub_b255 "" RAT_FUNC "%6.2" "s" COEFFS 0 1 0 0 0 1 /end COMPU_METHOD
/begin COMPU_METHOD t100msxs_ub_b25p5 "" RAT_FUNC "%6.3" "s" COEFFS 0 1 0 0 0 0.1 /end COMPU_METHOD
/begin COMPU_METHOD t100msxs_uw_b6553p5 "" RAT_FUNC "%6.3" "s" COEFFS 0 1 0 0 0 0.1 /end COMPU_METHOD
/begin COMPU_METHOD t10msxs_q0p01_o0p05 "" RAT_FUNC "%6.4" "s" COEFFS 0 1 0.05 0 0 0.01 /end COMPU_METHOD
/begin COMPU_METHOD t10msxs_ub_b2p55 "" RAT_FUNC "%6.4" "s" COEFFS 0 1 0 0 0 0.01 /end COMPU_METHOD
/begin COMPU_METHOD t10msxs_uw_b655p35 "" RAT_FUNC "%6.4" "s" COEFFS 0 1 0 0 0 0.01 /end COMPU_METHOD
/begin COMPU_METHOD t1msxms_q1 "" RAT_FUNC "%6.2" "ms" COEFFS 0 1 0 0 0 1 /end COMPU_METHOD
/begin COMPU_METHOD t1sxs_ub_b255 "" RAT_FUNC "%6.2" "s" COEFFS 0 1 0 0 0 1 /end COMPU_METHOD
/begin COMPU_METHOD t1sxs_uw_q1 "" RAT_FUNC "%6.2" "s" COEFFS 0 1 0 0 0 1 /end COMPU_METHOD
/begin COMPU_METHOD t20msxs_ub_b5p1 "" RAT_FUNC "%6.4" "s" COEFFS 0 1 0 0 0 0.02 /end COMPU_METHOD
/begin COMPU_METHOD t50msxs_q0p05 "" RAT_FUNC "%6.4" "s" COEFFS 0 1 0 0 0 0.05 /end COMPU_METHOD
/begin COMPU_METHOD t50msxs_ub_b12p75 "" RAT_FUNC "%6.4" "s" COEFFS 0 1 0 0 0 0.05 /end COMPU_METHOD
/begin COMPU_METHOD temp_q0p0234_o273 "" RAT_FUNC "%6.1" "Grad C" COEFFS 0 1 273.15 0 0 0.0234375 /end COMPU_METHOD
/begin COMPU_METHOD temp_sb_b0p093 "" RAT_FUNC "%6.5" "Grad C" COEFFS 0 512 0 0 0 0.375 /end COMPU_METHOD
/begin COMPU_METHOD temp_ub_b191p25 "" RAT_FUNC "%6.3" "Grad C" COEFFS 0 1 0 0 0 0.75 /end COMPU_METHOD
/begin COMPU_METHOD temp_ub_q0p75_o48 "" RAT_FUNC "%6.2" "Grad C" COEFFS 0 1 48 0 0 0.75 /end COMPU_METHOD
/begin COMPU_METHOD temp_ub_q5_o50 "" RAT_FUNC "%6.2" "Grad C" COEFFS 0 1 50 0 0 5 /end COMPU_METHOD
/begin COMPU_METHOD temp_uw_q0p75_o48 "" RAT_FUNC "%6.2" "Grad C" COEFFS 0 1 48 0 0 0.00292969 /end COMPU_METHOD
/begin COMPU_METHOD tgrad_ub_b99p6 "" RAT_FUNC "%6.3" "ms/s" COEFFS 0 1 0 0 0 0.390625 /end COMPU_METHOD
/begin COMPU_METHOD tknockcon_sy "" RAT_FUNC "%8.7" "s" COEFFS 0 375000 0 0 0 1 /end COMPU_METHOD
/begin COMPU_METHOD tknockintgrad_sy "" RAT_FUNC "%6.3" "V/s" COEFFS 0 8.94855 0 0 0 1 /end COMPU_METHOD
/begin COMPU_METHOD vfzg_ub_q1p25 "" RAT_FUNC "%6.2" "km/h" COEFFS 0 1 0 0 0 1.25 /end COMPU_METHOD
/begin COMPU_METHOD vfzg_uw_b512 "" RAT_FUNC "%6.4" "km/h" COEFFS 0 65536 0 0 0 512 /end COMPU_METHOD
/begin COMPU_METHOD vfzg_uw_q0p00781 "" RAT_FUNC "%6.4" "km/h" COEFFS 0 1 0 0 0 0.0078125 /end COMPU_METHOD
/begin COMPU_METHOD zk100msxs_ub_b25p5 "" RAT_FUNC "%6.3" "s" COEFFS 0 0 256 0 10 0 /end COMPU_METHOD
/begin COMPU_METHOD zk100msxs_uw_b6553 "" RAT_FUNC "%12.4" "s" COEFFS 0 0 65536 0 10 0 /end COMPU_METHOD
/begin COMPU_METHOD zk10msxs_uw_b655 "" RAT_FUNC "%12.5" "s" COEFFS 0 0 65536 0 100 0 /end COMPU_METHOD
/begin COMPU_METHOD zk20msxs_uw_b1310 "" RAT_FUNC "%12.4" "s" COEFFS 0 0 65536 0 50 0 /end COMPU_METHOD
/begin COMPU_METHOD zk50msxs_ub_b12p8 "" RAT_FUNC "%10.5" "s" COEFFS 0 0 128 0 10 0 /end COMPU_METHOD
/begin COMPU_METHOD zw_ub_q0p75 "" RAT_FUNC "%6.3" "Grad KW" COEFFS 0 255 0 0 0 191.25 /end COMPU_METHOD
/begin COMPU_METHOD defaultAscii "" RAT_FUNC "%6.2" "" COEFFS 0 1 0 0 0 1 /end COMPU_METHOD
/begin RECORD_LAYOUT GkfWUb FNC_VALUES 1 UBYTE COLUMN_DIR DIRECT /end RECORD_LAYOUT
/begin RECORD_LAYOUT GklWUb FNC_VALUES 1 UBYTE COLUMN_DIR DIRECT /end RECORD_LAYOUT
/begin RECORD_LAYOUT KfAxUbAyUbSstxUbSstyUbWSb NO_AXIS_PTS_X 1 UBYTE NO_AXIS_PTS_Y 2 UBYTE AXIS_PTS_X 3 UBYTE INDEX_INCR DIRECT AXIS_PTS_Y 4 UBYTE INDEX_INCR DIRECT FNC_VALUES 5 SBYTE COLUMN_DIR DIRECT /end RECORD_LAYOUT
/begin RECORD_LAYOUT KfAxUbAyUbSstxUbSstyUbWUb NO_AXIS_PTS_X 1 UBYTE NO_AXIS_PTS_Y 2 UBYTE AXIS_PTS_X 3 UBYTE INDEX_INCR DIRECT AXIS_PTS_Y 4 UBYTE INDEX_INCR DIRECT FNC_VALUES 5 UBYTE COLUMN_DIR DIRECT /end RECORD_LAYOUT
/begin RECORD_LAYOUT KfAxUbAyUbSstxUbSstyUwWUb NO_AXIS_PTS_X 1 UBYTE NO_AXIS_PTS_Y 2 UBYTE AXIS_PTS_X 3 UBYTE INDEX_INCR DIRECT AXIS_PTS_Y 4 UWORD INDEX_INCR DIRECT FNC_VALUES 5 UBYTE COLUMN_DIR DIRECT /end RECORD_LAYOUT
/begin RECORD_LAYOUT KfAxUwAyUwSstxUwSstyUwWUw NO_AXIS_PTS_X 1 UWORD NO_AXIS_PTS_Y 2 UWORD AXIS_PTS_X 3 UWORD INDEX_INCR DIRECT AXIS_PTS_Y 4 UWORD INDEX_INCR DIRECT FNC_VALUES 5 UWORD COLUMN_DIR DIRECT /end RECORD_LAYOUT
/begin RECORD_LAYOUT KlAUbSstUbWSb NO_AXIS_PTS_X 1 UBYTE AXIS_PTS_X 2 UBYTE INDEX_INCR DIRECT FNC_VALUES 3 SBYTE COLUMN_DIR DIRECT /end RECORD_LAYOUT
/begin RECORD_LAYOUT KlAUbSstUbWUb NO_AXIS_PTS_X 1 UBYTE AXIS_PTS_X 2 UBYTE INDEX_INCR DIRECT FNC_VALUES 3 UBYTE COLUMN_DIR DIRECT /end RECORD_LAYOUT
/begin RECORD_LAYOUT KlAUbSstUwWUb NO_AXIS_PTS_X 1 UWORD AXIS_PTS_X 2 UWORD INDEX_INCR DIRECT FNC_VALUES 3 UBYTE COLUMN_DIR DIRECT /end RECORD_LAYOUT
/begin RECORD_LAYOUT KlAUwSstUwWUb NO_AXIS_PTS_X 1 UWORD AXIS_PTS_X 2 UWORD INDEX_INCR DIRECT FNC_VALUES 3 UBYTE COLUMN_DIR DIRECT /end RECORD_LAYOUT
/begin RECORD_LAYOUT KlAUwSstUwWUw NO_AXIS_PTS_X 1 UWORD AXIS_PTS_X 2 UWORD INDEX_INCR DIRECT FNC_VALUES 3 UWORD COLUMN_DIR DIRECT /end RECORD_LAYOUT
/begin RECORD_LAYOUT KtxC FNC_VALUES 1 UBYTE COLUMN_DIR DIRECT /end RECORD_LAYOUT
/begin RECORD_LAYOUT KwbUb FNC_VALUES 1 UBYTE COLUMN_DIR DIRECT /end RECORD_LAYOUT
/begin RECORD_LAYOUT KwbUw FNC_VALUES 1 UWORD COLUMN_DIR DIRECT /end RECORD_LAYOUT
/begin RECORD_LAYOUT KwSb FNC_VALUES 1 SBYTE COLUMN_DIR DIRECT /end RECORD_LAYOUT
/begin RECORD_LAYOUT KwSw FNC_VALUES 1 SWORD COLUMN_DIR DIRECT /end RECORD_LAYOUT
/begin RECORD_LAYOUT KwUb FNC_VALUES 1 UBYTE COLUMN_DIR DIRECT /end RECORD_LAYOUT
/begin RECORD_LAYOUT KwUw FNC_VALUES 1 UWORD COLUMN_DIR DIRECT /end RECORD_LAYOUT
/begin RECORD_LAYOUT SstAUbSstUb NO_AXIS_PTS_X 1 UBYTE AXIS_PTS_X 2 UBYTE INDEX_INCR DIRECT /end RECORD_LAYOUT
/end MODULE
/end PROJECT
