ASAP2_VERSION 1 3
/begin PROJECT X505P_24HG_1 "X505P"
/begin HEADER "" VERSION "X505P_24HG_1" PROJECT_NO X505P_24HG_1 /end HEADER
/begin MODULE DIM ""
/begin MOD_COMMON "" BYTE_ORDER MSB_LAST ALIGNMENT_BYTE 1 ALIGNMENT_WORD 2 ALIGNMENT_LONG 2 /end MOD_COMMON
/begin CHARACTERISTIC ANZTPMX "Maximale Anzahl von hintereinander erlaubten Tips" VALUE 0x8187DB KwUb 255.0 dez 0.00 255.0 FORMAT "%5.1" /end CHARACTERISTIC
/begin CHARACTERISTIC BFGRO "Obere Schwelle für Beschleunigung im FGR-Betrieb" VALUE 0x813BB0 KwSw 27.7802865 bfzg_sw_q4p239Em4 -13.8903552 13.8899313 /end CHARACTERISTIC
/begin CHARACTERISTIC BFGRU "Untere Schwelle für Beschleunigung im FGR-Betrieb" VALUE 0x813BB2 KwSw 27.7802865 bfzg_sw_q4p239Em4 -13.8903552 13.8899313 /end CHARACTERISTIC
/begin CHARACTERISTIC BRABEVI_0_A "Beschleunigung bei Rampe Beschleunigen" CURVE 0x81C5A2 KlAUwSstUwWUw 27.7802865 bfzg_sw_q4p239Em4 0.00 27.7802865
 /begin AXIS_DESCR STD_AXIS vfgr_w vfzg_uw_b512 8 0.00 511.9922 FORMAT "%8.4" DEPOSIT ABSOLUTE /end AXIS_DESCR
/end CHARACTERISTIC
/begin CHARACTERISTIC BRABEVI_1_A "Beschleunigung bei Rampe Beschleunigen" CURVE 0x81C5C4 KlAUwSstUwWUw 27.7802865 bfzg_sw_q4p239Em4 0.00 27.7802865
 /begin AXIS_DESCR STD_AXIS vfgr_w vfzg_uw_b512 8 0.00 511.9922 FORMAT "%8.4" DEPOSIT ABSOLUTE /end AXIS_DESCR
/end CHARACTERISTIC
/begin CHARACTERISTIC BRATD "Beschleunigung (Betrag) bei Rampe Tip-Down" VALUE 0x81C5E6 KwUw 27.7802865 bfzg_sw_q4p239Em4 0.00 27.7802865 /end CHARACTERISTIC
/begin CHARACTERISTIC BRATU "Beschleunigung bei Rampe Tip-Up" VALUE 0x81C5E8 KwUw 27.7802865 bfzg_sw_q4p239Em4 0.00 27.7802865 /end CHARACTERISTIC
/begin CHARACTERISTIC CSGRA "Checksumme für GRA-Can-Botschaft" VALUE 0x810DBE KwUb 255.0 DEZ 0.00 255.0 FORMAT "%5.1" /end CHARACTERISTIC
/begin CHARACTERISTIC CUKA "Codewort ÜK-Adaption" VALUE 0x811530 KwUb 255.0 dez 0.00 255.0 FORMAT "%5.1" /end CHARACTERISTIC
/begin CHARACTERISTIC CWCS "Codewort für Auswertung der CAN-Crash-Info" VALUE 0x81AD2D KwUb 255.0 DEZ 0.00 255.0 FORMAT "%5.1" /end CHARACTERISTIC
/begin CHARACTERISTIC CWFGRFULO "Codewort FGRFULO" VALUE 0x8187DC KwUb 255.0 dez 0.00 255.0 FORMAT "%5.1" /end CHARACTERISTIC
/begin CHARACTERISTIC CWFGRGA_0_A "Codewort für gangabhängiges FGR-Verbot" VALUE 0x813BBE KwUb 255.0 dez 0.00 255.0 FORMAT "%5.1" /end CHARACTERISTIC
/begin CHARACTERISTIC CWFGRGA_1_A "Codewort für gangabhängiges FGR-Verbot" VALUE 0x813BBF KwUb 255.0 dez 0.00 255.0 FORMAT "%5.1" /end CHARACTERISTIC
/begin CHARACTERISTIC CWFGRGABED "" VALUE 0x810DB9 KwUb 255.0 dez 0.00 255.0 FORMAT "%5.1" /end CHARACTERISTIC
/begin CHARACTERISTIC CWFGRREGL_0_A "Codewort FGRREGL" VALUE 0x81CA2E KwUb 255.0 dez 0.00 255.0 FORMAT "%5.1" /end CHARACTERISTIC
/begin CHARACTERISTIC CWFGRREGL_1_A "Codewort FGRREGL" VALUE 0x81CA2F KwUb 255.0 dez 0.00 255.0 FORMAT "%5.1" /end CHARACTERISTIC
/begin CHARACTERISTIC CWFUEDK "Codewort FUEDK" VALUE 0x813E2A KwUw 65535.00 dez 0.00 65535.00 FORMAT "%8.2" /end CHARACTERISTIC
/begin CHARACTERISTIC CWFUEREG "Codewort Füllungsregler außerhalb Leerlauf aktiv" VALUE 0x81892B KwUb 255.0 dez 0.00 255.0 FORMAT "%5.1" /end CHARACTERISTIC
/begin CHARACTERISTIC CWGGEGAS "Codewort für GGEGAS" VALUE 0x810D9E KwUb 255.0 dez 0.00 255.0 FORMAT "%5.1" /end CHARACTERISTIC
/begin CHARACTERISTIC CWGGFGRH "Codewort  GGFGRH" VALUE 0x810BCF KwUb 255.0 dez 0.00 255.0 FORMAT "%5.1" /end CHARACTERISTIC
/begin CHARACTERISTIC CWMSRCAN "Codewort für MSR/ASR über CAN" VALUE 0x810192 KwUb 255.0 DEZ 0.00 255.0 FORMAT "%5.1" /end CHARACTERISTIC
/begin CHARACTERISTIC CWNWREF "Nockenwellenverhalten im Start" VALUE 0x810B56 KwUb 255.0 dez 0.00 255.0 FORMAT "%5.1" /end CHARACTERISTIC
/begin CHARACTERISTIC CWVWKNWS "Code Wort: Vorlagerungswinkelkorrektur bei NWS" VALUE 0x818EC1 KwUb 255.0 dez 0.00 255.0 FORMAT "%5.1" /end CHARACTERISTIC
/begin CHARACTERISTIC CWWDKSPE "Codewort: prädizierende DK-Sollwertentjitterung aktiv" VALUE 0x810EC7 KwUb 255.0 dez 0.00 255.0 FORMAT "%5.1" /end CHARACTERISTIC
/begin CHARACTERISTIC DBZ_AIR "obere Grenze für Botschaftszählerdifferenz" VALUE 0x8127C4 KwUb 255.0 DEZ 0.00 255.0 FORMAT "%5.1" /end CHARACTERISTIC
/begin CHARACTERISTIC DBZ_GRA "oberer Grenzwert für Botschaftszählerdifferenz GRA" VALUE 0x810DBF KwUb 255.0 DEZ 0.00 255.0 FORMAT "%5.1" /end CHARACTERISTIC
/begin CHARACTERISTIC DBZ_MN "kleinstes zulässiges Delta des Botschaftszählers in der Funktion" VALUE 0x810193 KwUb 255.0 DEZ 0.00 255.0 FORMAT "%5.1" /end CHARACTERISTIC
/begin CHARACTERISTIC DBZ_MX "Größtes zulässiges Delta des Botschaftszählers in der Funktion" VALUE 0x810194 KwUb 255.0 DEZ 0.00 255.0 FORMAT "%5.1" /end CHARACTERISTIC
/begin CHARACTERISTIC DFAFRG "Aufregelungsfaktor nach Einschalten des Füllungsreglers" VALUE 0x81892C KwUb 0.9961 fak_ub_b1 0.00 0.9961 /end CHARACTERISTIC
/begin CHARACTERISTIC DKNOTBEGR "Sollwertbegrenzung bei DK-Potinotfahren als f(nmot)" CURVE 0x813EB6 KlAUbSstUbWUw 100.0000 relDK_uw_b100 0.00 100.0000 FORMAT "%8.4"
 /begin AXIS_DESCR STD_AXIS nmot nmot_ub_q40 8 0.00 10200. FORMAT "%5.0" DEPOSIT ABSOLUTE /end AXIS_DESCR
/end CHARACTERISTIC
/begin CHARACTERISTIC DMGETAFW "Korrektur des Getriebeausgangsmoments bei FGR-Initialisierung" CURVE 0x81C76C KlASwSstSwWSw 639.9902 rel_q0p009766 -320.0000 319.9902 FORMAT "%8.4"
 /begin AXIS_DESCR STD_AXIS fawifgr_w rel_q0p249 6 -8159.232 8158.983 FORMAT "%8.3" DEPOSIT ABSOLUTE /end AXIS_DESCR
/end CHARACTERISTIC
/begin CHARACTERISTIC DN10BURN "Minimaler Drehzahlanstieg für ""Verbrennnung erfolgt""" VALUE 0x8110EC KwUb 2550. nmot_ub_q10 0.00 2550. FORMAT "%5.0" /end CHARACTERISTIC
/begin CHARACTERISTIC DNFGRMX "Drehzahl-Differenz zu Maximaldrehzahl für FGR-Abschaltung" VALUE 0x813BB4 KwUw 16383.75 nmot_uw_q0p25 0.00 16383.75 FORMAT "%8.2" /end CHARACTERISTIC
/begin CHARACTERISTIC DPDSVLU "Delta Druckwert für Signalvergleich Ladedruck mit Umgebungsdruck" VALUE 0x81D190 KwUw 2559.961 p_uw_q0p039 0.00 2559.961 FORMAT "%8.3" /end CHARACTERISTIC
/begin CHARACTERISTIC DPUPS "Druckdifferenz für Umschaltung Referenzdruck vor Drosselklappe" VALUE 0x810EB8 KwUb 2550. p_ub_q10 0.00 2550. FORMAT "%5.0" /end CHARACTERISTIC
/begin CHARACTERISTIC DPUPVDK "Differenzdruck pu-pvdk" CURVE 0x81D192 KlAUwSstUwWUw 2559.961 p_uw_q0p039 0.00 2559.961 FORMAT "%8.3"
 /begin AXIS_DESCR STD_AXIS ml_w m_uw_b6553p5 8 0.00 6553.500 FORMAT "%8.3" DEPOSIT ABSOLUTE /end AXIS_DESCR
/end CHARACTERISTIC
/begin CHARACTERISTIC DRLSOLMF "Schwelle delta rlsol für Medianfilter" VALUE 0x813E2C KwUw 1535.977 rel_uw_q0p0234 0.00 1535.977 FORMAT "%8.3" /end CHARACTERISTIC
/begin CHARACTERISTIC DSLGRAD "Gradient für Drucksensor Ladedruck" VALUE 0x813CE8 KwUw 1023.984 dgrad_uw_q0p015 0.00 1023.984 FORMAT "%8.3" /end CHARACTERISTIC
/begin CHARACTERISTIC DSLOFS "Offset Drucksensor Ladedruck" VALUE 0x813CEA KwSw 2559.961 p_sw_q0p039 -1280.000 1279.961 FORMAT "%8.3" /end CHARACTERISTIC
/begin CHARACTERISTIC DSTGRAD "Gradient für Umrechnung Spannung -> Druck bei Tankdrucksensor" VALUE 0x8176E0 KwUw 127.9980 adb_uw_q0p00195 0.00 127.9980 FORMAT "%8.4" /end CHARACTERISTIC
/begin CHARACTERISTIC DSTOFFS "Offset für Umrechnung Spannung -> Druck bei Tankdrucksensor" VALUE 0x8176E2 KwSw 330.0000 spg_sw_b5 -320.0000 10.00000 FORMAT "%8.4" /end CHARACTERISTIC
/begin CHARACTERISTIC DSUGRAD "Gradient für Drucksensor Umgebung" VALUE 0x81D1B4 KwUw 1023.984 dgrad_uw_q0p015 0.00 1023.984 FORMAT "%8.3" /end CHARACTERISTIC
/begin CHARACTERISTIC DSUOFS "Offset Drucksensor Umgebung" VALUE 0x81D1B6 KwSw 2559.961 p_sw_q0p039 -1280.000 1279.961 FORMAT "%8.3" /end CHARACTERISTIC
/begin CHARACTERISTIC DTMKI "Sicherheitsoffset zwischen Kühlmitteltemperatur aus Kombiinstrument und tmot" VALUE 0x8196F1 KwUb 191.3 temp_ub_b191p25 0.00 191.3 FORMAT "%5.1" /end CHARACTERISTIC
/begin CHARACTERISTIC DUDKP1HY "Offset für Hysterese bei Umschaltung auf verstärktes Signal von DK-Poti 1" VALUE 0x813AE0 KwUw 79.99878 spg_uw_q0p001222 0.00 79.99878 FORMAT "%8.5" /end CHARACTERISTIC
/begin CHARACTERISTIC DUKK "Schwelle für Kurzzeitanteil" VALUE 0x815ABE KwSw 12287.81 rel_sw_q0p1875 -6144.000 6143.813 FORMAT "%8.3" /end CHARACTERISTIC
/begin CHARACTERISTIC DVIVZMX "Max. zul. Abweichung zw. Istgeschw. und Zielgeschw. bei FGR-Konstantfahrt" VALUE 0x813BB6 KwUw 511.9922 vfzg_uw_b512 0.00 511.9922 FORMAT "%8.4" /end CHARACTERISTIC
/begin CHARACTERISTIC DVIVZTMX "Maximales Delta zw. Ist- und Zielgeschw. für Tip-Erlaubnis" VALUE 0x81C5EA KwUw 511.9922 vfzg_uw_q0p0078125 0.00 511.9922 FORMAT "%8.4" /end CHARACTERISTIC
/begin CHARACTERISTIC DVLLVO "Delta Geschwindigkeit für Rücksetzen Leerlauf-Verbot vom FGR" VALUE 0x81C786 KwUw 511.9922 vfzg_uw_q0p0078125 0.00 511.9922 FORMAT "%8.4" /end CHARACTERISTIC
/begin CHARACTERISTIC DVLLVU "Delta Geschwindigkeit für Setzen Leerlauf-Verbot vom FGR" VALUE 0x81C788 KwUw 511.9922 vfzg_uw_q0p0078125 0.00 511.9922 FORMAT "%8.4" /end CHARACTERISTIC
/begin CHARACTERISTIC DVSAVO "Delta Geschwindigkeit für Rücksetzen Schubabschalteverbot vom FGR" VALUE 0x81C78A KwUw 511.9922 vfzg_uw_q0p0078125 0.00 511.9922 FORMAT "%8.4" /end CHARACTERISTIC
/begin CHARACTERISTIC DVSAVU "Delta Geschwindigkeit für Setzen Schubabschalteverbot vom FGR" VALUE 0x81C78C KwUw 511.9922 vfzg_uw_q0p0078125 0.00 511.9922 FORMAT "%8.4" /end CHARACTERISTIC
/begin CHARACTERISTIC DVSKNBGA_0_A "Delta Geschwindigkeit für Setzwertkorrektur nach Beschleunigen" CURVE 0x81C5EC KlAUbSstUbWUw 511.9922 vfzg_uw_q0p0078125 0.00 511.9922 FORMAT "%8.4"
 /begin AXIS_DESCR STD_AXIS uevges fak_q0p1 8 0.00 25.50 FORMAT "%5.2" DEPOSIT ABSOLUTE /end AXIS_DESCR
/end CHARACTERISTIC
/begin CHARACTERISTIC DVSKNBGA_1_A "Delta Geschwindigkeit für Setzwertkorrektur nach Beschleunigen" CURVE 0x81C606 KlAUbSstUbWUw 511.9922 vfzg_uw_q0p0078125 0.00 511.9922 FORMAT "%8.4"
 /begin AXIS_DESCR STD_AXIS uevges fak_q0p1 8 0.00 25.50 FORMAT "%5.2" DEPOSIT ABSOLUTE /end AXIS_DESCR
/end CHARACTERISTIC
/begin CHARACTERISTIC DVSKNVGA_0_A "Delta Geschwindigkeit für Setzwertkorrektur nach Verzögern" CURVE 0x81C620 KlAUbSstUbWUw 511.9922 vfzg_uw_q0p0078125 0.00 511.9922 FORMAT "%8.4"
 /begin AXIS_DESCR STD_AXIS uevges fak_q0p1 8 0.00 25.50 FORMAT "%5.2" DEPOSIT ABSOLUTE /end AXIS_DESCR
/end CHARACTERISTIC
/begin CHARACTERISTIC DVSKNVGA_1_A "Delta Geschwindigkeit für Setzwertkorrektur nach Verzögern" CURVE 0x81C63A KlAUbSstUbWUw 511.9922 vfzg_uw_q0p0078125 0.00 511.9922 FORMAT "%8.4"
 /begin AXIS_DESCR STD_AXIS uevges fak_q0p1 8 0.00 25.50 FORMAT "%5.2" DEPOSIT ABSOLUTE /end AXIS_DESCR
/end CHARACTERISTIC
/begin CHARACTERISTIC DVTIPUD "Änderung der Zielgeschwindigkeit bei Tip-Up oder Tip-Down" VALUE 0x81C654 KwUw 511.9922 vfzg_uw_q0p0078125 0.00 511.9922 FORMAT "%8.4" /end CHARACTERISTIC
/begin CHARACTERISTIC DVZVIMX "Max. zul. Abweichung zw. Zielgeschw. und Istgeschw. bei FGR-Konstantfahrt" VALUE 0x813BB8 KwUw 511.9922 vfzg_uw_b512 0.00 511.9922 FORMAT "%8.4" /end CHARACTERISTIC
/begin CHARACTERISTIC DVZVITMX "Maximales Delta zw. Ziel- und Istgeschw. für Tip-Erlaubnis" VALUE 0x81C656 KwUw 511.9922 vfzg_uw_q0p0078125 0.00 511.9922 FORMAT "%8.4" /end CHARACTERISTIC
/begin CHARACTERISTIC DVZVIWA "Delta zw. Ziel- und Istgeschw. für Übergang von Konstantfahrt in Wiederaufnahme" VALUE 0x81C658 KwUw 511.9922 vfzg_uw_q0p0078125 0.00 511.9922 FORMAT "%8.4" /end CHARACTERISTIC
/begin CHARACTERISTIC DWDK12O "Maximal zulässige Abweichung zwischen den DK-Winkeln aus Poti 1 und 2" VALUE 0x810BF3 KwUb 100.0 relDK_ub_b100 0.00 100.0 FORMAT "%5.1" /end CHARACTERISTIC
/begin CHARACTERISTIC DWDK13O "Maximal zulässige Abweichung zwischen DK-Winkel aus Poti 1 und Ersatzwert" VALUE 0x810BF4 KwUb 100.0 relDK_ub_b100 0.00 100.0 FORMAT "%5.1" /end CHARACTERISTIC
/begin CHARACTERISTIC DWDK23O "Maximal zulässige Abweichung zwischen DK-Winkel aus Poti 2 und Ersatzwert" VALUE 0x810BF5 KwUb 100.0 relDK_ub_b100 0.00 100.0 FORMAT "%5.1" /end CHARACTERISTIC
/begin CHARACTERISTIC DWDKUGD "Delta zum DK-Winkel ungedrosselt (Toleranz)" VALUE 0x813E2E KwUw 99.99847 rel_uw_b100 0.00 99.99847 FORMAT "%8.5" /end CHARACTERISTIC
/begin CHARACTERISTIC DWEEMX "maximal zulässige Zunahme Winkel Einspritzende pro Synchro" VALUE 0x810FED KwUb 1530. zw_ub_q6 0.00 1530. FORMAT "%5.0" /end CHARACTERISTIC
/begin CHARACTERISTIC DZZST "Anzahl Zähne bei Zahnunterdrückung im Start" VALUE 0x810B57 KwUb 254.0 dez 0.00 254.0 FORMAT "%5.1" /end CHARACTERISTIC
/begin CHARACTERISTIC DZZSTNLP "Anzahl der Entprellzähne bei Notlauf-Phasengeber" VALUE 0x810B58 KwUb 254.0 dez 0.00 254.0 FORMAT "%5.1" /end CHARACTERISTIC
/begin CHARACTERISTIC ENTDKLL "Entjitterschwelle (Ink) für DK-Sollwert im Leerlauf (B_ll)" VALUE 0x810EC8 KwUb 20.00 dez 0.00 20.00 FORMAT "%5.2" /end CHARACTERISTIC
/begin CHARACTERISTIC ENTDKNLL "Entjitterschwelle (Ink) für DK-Sollwert außerhalb Leerlauf (!B_ll)" VALUE 0x810EC9 KwUb 20.00 dez 0.00 20.00 FORMAT "%5.2" /end CHARACTERISTIC
/begin CHARACTERISTIC EVTMODMNDK "min. Temperatur bei der Offset nicht zu DK-Kennlinie bei nmot=0 addiert wird" VALUE 0x810EB9 KwUb 191.3 temp_ub_q0p75_o48 -48.00 143.3 FORMAT "%5.1" /end CHARACTERISTIC
/begin CHARACTERISTIC FBFGRSFW "Korrekturfaktor für FGR-Sollbeschleunigung" CURVE 0x81C65A KlAUbSstSbWUb 1.992 fak_ub_b2 0.00 1.992 FORMAT "%5.3"
 /begin AXIS_DESCR STD_AXIS fawifgr rel_q0p25 6 -32.00 31.75 FORMAT "%5.2" DEPOSIT ABSOLUTE /end AXIS_DESCR
/end CHARACTERISTIC
/begin CHARACTERISTIC FGMRIDV "Gewichtungsfaktor für Reglerinitialisierung bei Wiederaufnahme" CURVE 0x81C78E KlASwSstSwWSw 1.999939 fak_sw_b2 0.00 1.999939 FORMAT "%8.6"
 /begin AXIS_DESCR STD_AXIS dvzvi_w vfzg_sw_q0p00781 4 -256.0000 255.9922 FORMAT "%8.4" DEPOSIT ABSOLUTE /end AXIS_DESCR
/end CHARACTERISTIC
/begin CHARACTERISTIC FHOE "Ersatzwert für Höhe" VALUE 0x81884C KwUb 3.984 fak_ub_b4 0.00 3.984 FORMAT "%5.3" /end CHARACTERISTIC
/begin CHARACTERISTIC FIMHU "Faktor Impuls hart" CURVE 0x81150C FklWUb 1.992 fak_ub_b2 0.00 1.992 FORMAT "%5.3"
 /begin AXIS_DESCR FIX_AXIS anzwefim dez 16 0.00 15.00 FORMAT "%5.2" FIX_AXIS_PAR 0 0 16 /end AXIS_DESCR
/end CHARACTERISTIC
/begin CHARACTERISTIC FIMWU "Faktor Impuls weich" CURVE 0x81151C FklWUb 1.992 fak_ub_b2 0.00 1.992 FORMAT "%5.3"
 /begin AXIS_DESCR FIX_AXIS anzwefim dez 16 0.00 15.00 FORMAT "%5.2" FIX_AXIS_PAR 0 0 16 /end AXIS_DESCR
/end CHARACTERISTIC
/begin CHARACTERISTIC FKSTT_0_A "Faktor Kaltstart" CURVE 0x815836 KlAUbSstUbWUw 63.99902 fak_uw_b64 0.00 63.99902 FORMAT "%8.5"
 /begin AXIS_DESCR STD_AXIS tmst temp_ub_q0p75_o48 12 -48.00 143.3 FORMAT "%5.1" DEPOSIT ABSOLUTE /end AXIS_DESCR
/end CHARACTERISTIC
/begin CHARACTERISTIC FKSTT_1_A "Faktor Kaltstart" CURVE 0x81585C KlAUbSstUbWUw 63.99902 fak_uw_b64 0.00 63.99902 FORMAT "%8.5"
 /begin AXIS_DESCR STD_AXIS tmst temp_ub_q0p75_o48 12 -48.00 143.3 FORMAT "%5.1" DEPOSIT ABSOLUTE /end AXIS_DESCR
/end CHARACTERISTIC
/begin CHARACTERISTIC FKSTT_2_A "Faktor Kaltstart" CURVE 0x815882 KlAUbSstUbWUw 63.99902 fak_uw_b64 0.00 63.99902 FORMAT "%8.5"
 /begin AXIS_DESCR STD_AXIS tmst temp_ub_q0p75_o48 12 -48.00 143.3 FORMAT "%5.1" DEPOSIT ABSOLUTE /end AXIS_DESCR
/end CHARACTERISTIC
/begin CHARACTERISTIC FKSTT_3_A "Faktor Kaltstart" CURVE 0x8158A8 KlAUbSstUbWUw 63.99902 fak_uw_b64 0.00 63.99902 FORMAT "%8.5"
 /begin AXIS_DESCR STD_AXIS tmst temp_ub_q0p75_o48 12 -48.00 143.3 FORMAT "%5.1" DEPOSIT ABSOLUTE /end AXIS_DESCR
/end CHARACTERISTIC
/begin CHARACTERISTIC FKUKAO "Obergrenze Korrekturfaktor in UK-Adaption" VALUE 0x811531 KwUb 3.984 fak_ub_b4 0.00 3.984 FORMAT "%5.3" /end CHARACTERISTIC
/begin CHARACTERISTIC FKUKAU "Untergrenze Korrekturfaktor in UK-Adaption" VALUE 0x811532 KwUb 3.891 fak_ub_b4 0.09375 3.984 FORMAT "%5.3" /end CHARACTERISTIC
/begin CHARACTERISTIC FLAMSBATM "Faktor Lambdasoll bei Beschleunigungsanreicherung" CURVE 0x81DDA6 GklWUw 2.000000 fak_uw_b16 0.00 2.000000 FORMAT "%8.6"
 /begin AXIS_DESCR COM_AXIS tmot temp_ub_q0p75_o48 9 -48.00 143.3 AXIS_PTS_REF STM09ESUB /end AXIS_DESCR
/end CHARACTERISTIC
/begin CHARACTERISTIC FLAMSVATM "Faktor Lambdasoll bei Verzögerungsabmagerung" CURVE 0x81DDB8 GklWUw 2.000000 fak_uw_b16 0.00 2.000000 FORMAT "%8.6"
 /begin AXIS_DESCR COM_AXIS tmot temp_ub_q0p75_o48 9 -48.00 143.3 AXIS_PTS_REF STM09ESUB /end AXIS_DESCR
/end CHARACTERISTIC
/begin CHARACTERISTIC FPLMRM "Wichtungsfaktor für P-Anteil Luftmassenregler" CURVE 0x81892D KlAUbSstUbWUb 0.9961 fak_ub_b1 0.00 0.9961
 /begin AXIS_DESCR STD_AXIS tmot temp_ub_q0p75_o48 6 -48.00 143.3 FORMAT "%5.1" DEPOSIT ABSOLUTE /end AXIS_DESCR
/end CHARACTERISTIC
/begin CHARACTERISTIC FPWDKAPP "Drosselklappenkennlinie abh. von Fahrpedal nur f. Applik." CURVE 0x813E30 KlAUwSstUwWUw 99.99847 rel_uw_b100 0.00 99.99847 FORMAT "%8.5"
 /begin AXIS_DESCR STD_AXIS wped_w relPED_uw_b100 16 0.00 100.0000 FORMAT "%8.4" DEPOSIT ABSOLUTE /end AXIS_DESCR
/end CHARACTERISTIC
/begin CHARACTERISTIC FSTHO "Wichtung Startfaktor" CURVE 0x818FD4 KlAUbSstUbWUb 1.992 fak_ub_b2 0.00 1.992 FORMAT "%5.3"
 /begin AXIS_DESCR STD_AXIS fho fak_ub_b4 4 0.00 3.984 FORMAT "%5.3" DEPOSIT ABSOLUTE /end AXIS_DESCR
/end CHARACTERISTIC
/begin CHARACTERISTIC FUEPMLD "Faktor für gleitender Übergang Druckmittelwert(Referenzdruck) beim Turbo" CURVE 0x81D304 KlAUwSstSwWUw 0.9999847 fak_uw_b1 0.00 0.9999847 FORMAT "%9.7"
 /begin AXIS_DESCR STD_AXIS lditv_w tv_sw_q0p005 4 -163.8400 163.8350 FORMAT "%8.4" DEPOSIT ABSOLUTE /end AXIS_DESCR
/end CHARACTERISTIC
/begin CHARACTERISTIC FUKABAKI_0_A "Init.-Wert adaptiver ÜK-Korrekturfaktor BA für kalten Motor" VALUE 0x815B1A KwUb 3.984 fak_ub_b4 0.00 3.984 FORMAT "%5.3" /end CHARACTERISTIC
/begin CHARACTERISTIC FUKABAKI_1_A "Init.-Wert adaptiver ÜK-Korrekturfaktor BA für kalten Motor" VALUE 0x815B1B KwUb 3.984 fak_ub_b4 0.00 3.984 FORMAT "%5.3" /end CHARACTERISTIC
/begin CHARACTERISTIC FUKABAKO_0_A "Obergrenze adaptiver ÜK-Korrekturfaktor BA bei kaltem Motor" VALUE 0x815B1C KwUb 3.984 fak_ub_b4 0.00 3.984 FORMAT "%5.3" /end CHARACTERISTIC
/begin CHARACTERISTIC FUKABAKO_1_A "Obergrenze adaptiver ÜK-Korrekturfaktor BA bei kaltem Motor" VALUE 0x815B1D KwUb 3.984 fak_ub_b4 0.00 3.984 FORMAT "%5.3" /end CHARACTERISTIC
/begin CHARACTERISTIC FUKABAKU_0_A "Untergrenze adaptiver ÜK-Korrekturfaktor BA bei kaltem Motor" VALUE 0x815B1E KwUb 3.891 fak_ub_b4 0.09375 3.984 FORMAT "%5.3" /end CHARACTERISTIC
/begin CHARACTERISTIC FUKABAKU_1_A "Untergrenze adaptiver ÜK-Korrekturfaktor BA bei kaltem Motor" VALUE 0x815B1F KwUb 3.891 fak_ub_b4 0.09375 3.984 FORMAT "%5.3" /end CHARACTERISTIC
/begin CHARACTERISTIC FUKABAWI_0_A "Init.-Wert adaptiver ÜK-Korrekturfaktor BA für warmen Motor" VALUE 0x815B20 KwUb 3.984 fak_ub_b4 0.00 3.984 FORMAT "%5.3" /end CHARACTERISTIC
/begin CHARACTERISTIC FUKABAWI_1_A "Init.-Wert adaptiver ÜK-Korrekturfaktor BA für warmen Motor" VALUE 0x815B21 KwUb 3.984 fak_ub_b4 0.00 3.984 FORMAT "%5.3" /end CHARACTERISTIC
/begin CHARACTERISTIC FUKABAWO_0_A "Obergrenze adaptiver ÜK-Korrekturfaktor BA bei warmem Motor" VALUE 0x815B22 KwUb 3.984 fak_ub_b4 0.00 3.984 FORMAT "%5.3" /end CHARACTERISTIC
/begin CHARACTERISTIC FUKABAWO_1_A "Obergrenze adaptiver ÜK-Korrekturfaktor BA bei warmem Motor" VALUE 0x815B23 KwUb 3.984 fak_ub_b4 0.00 3.984 FORMAT "%5.3" /end CHARACTERISTIC
/begin CHARACTERISTIC FUKABAWU_0_A "Untergrenze adaptiver ÜK-Korrekturfaktor BA bei warmem Motor" VALUE 0x815B24 KwUb 3.891 fak_ub_b4 0.09375 3.984 FORMAT "%5.3" /end CHARACTERISTIC
/begin CHARACTERISTIC FUKABAWU_1_A "Untergrenze adaptiver ÜK-Korrekturfaktor BA bei warmem Motor" VALUE 0x815B25 KwUb 3.891 fak_ub_b4 0.09375 3.984 FORMAT "%5.3" /end CHARACTERISTIC
/begin CHARACTERISTIC FUKAVAKI_0_A "Init.-Wert adaptiver ÜK-Korrekturfaktor VA für kalten Motor" VALUE 0x815B26 KwUb 3.984 fak_ub_b4 0.00 3.984 FORMAT "%5.3" /end CHARACTERISTIC
/begin CHARACTERISTIC FUKAVAKI_1_A "Init.-Wert adaptiver ÜK-Korrekturfaktor VA für kalten Motor" VALUE 0x815B27 KwUb 3.984 fak_ub_b4 0.00 3.984 FORMAT "%5.3" /end CHARACTERISTIC
/begin CHARACTERISTIC FUKAVAKO_0_A "Obergrenze adaptiver ÜK-Korrekturfaktor VA bei kaltem Motor" VALUE 0x815B28 KwUb 3.984 fak_ub_b4 0.00 3.984 FORMAT "%5.3" /end CHARACTERISTIC
/begin CHARACTERISTIC FUKAVAKO_1_A "Obergrenze adaptiver ÜK-Korrekturfaktor VA bei kaltem Motor" VALUE 0x815B29 KwUb 3.984 fak_ub_b4 0.00 3.984 FORMAT "%5.3" /end CHARACTERISTIC
/begin CHARACTERISTIC FUKAVAKU_0_A "Untergrenze adaptiver ÜK-Korrekturfaktor VA bei kaltem Motor" VALUE 0x815B2A KwUb 3.891 fak_ub_b4 0.09375 3.984 FORMAT "%5.3" /end CHARACTERISTIC
/begin CHARACTERISTIC FUKAVAKU_1_A "Untergrenze adaptiver ÜK-Korrekturfaktor VA bei kaltem Motor" VALUE 0x815B2B KwUb 3.891 fak_ub_b4 0.09375 3.984 FORMAT "%5.3" /end CHARACTERISTIC
/begin CHARACTERISTIC FUKAVAWI_0_A "Init.-Wert adaptiver ÜK-Korrekturfaktor VA für warmen Motor" VALUE 0x815B2C KwUb 3.984 fak_ub_b4 0.00 3.984 FORMAT "%5.3" /end CHARACTERISTIC
/begin CHARACTERISTIC FUKAVAWI_1_A "Init.-Wert adaptiver ÜK-Korrekturfaktor VA für warmen Motor" VALUE 0x815B2D KwUb 3.984 fak_ub_b4 0.00 3.984 FORMAT "%5.3" /end CHARACTERISTIC
/begin CHARACTERISTIC FUKAVAWO_0_A "Obergrenze adaptiver ÜK-Korrekturfaktor VA bei warmem Motor" VALUE 0x815B2E KwUb 3.984 fak_ub_b4 0.00 3.984 FORMAT "%5.3" /end CHARACTERISTIC
/begin CHARACTERISTIC FUKAVAWO_1_A "Obergrenze adaptiver ÜK-Korrekturfaktor VA bei warmem Motor" VALUE 0x815B2F KwUb 3.984 fak_ub_b4 0.00 3.984 FORMAT "%5.3" /end CHARACTERISTIC
/begin CHARACTERISTIC FUKAVAWU_0_A "Untergrenze adaptiver ÜK-Korrekturfaktor VA bei warmem Motor" VALUE 0x815B30 KwUb 3.891 fak_ub_b4 0.09375 3.984 FORMAT "%5.3" /end CHARACTERISTIC
/begin CHARACTERISTIC FUKAVAWU_1_A "Untergrenze adaptiver ÜK-Korrekturfaktor VA bei warmem Motor" VALUE 0x815B31 KwUb 3.891 fak_ub_b4 0.09375 3.984 FORMAT "%5.3" /end CHARACTERISTIC
/begin CHARACTERISTIC FUKE "Faktor ÜK-Ersatzwert" VALUE 0x815AC0 KwUw 7.999878 fak_uw_b8 0.00 7.999878 FORMAT "%8.6" /end CHARACTERISTIC
/begin CHARACTERISTIC FUKNSTHO "Hoehenfaktor ÜK im Nachstart" CURVE 0x819264 KlAUbSstUbWUb 1.992 fak_ub_b2 0.00 1.992 FORMAT "%5.3"
 /begin AXIS_DESCR STD_AXIS fho fak_ub_b4 6 0.00 3.984 FORMAT "%5.3" DEPOSIT ABSOLUTE /end AXIS_DESCR
/end CHARACTERISTIC
/begin CHARACTERISTIC FUKNSTM "Startwert Faktor ÜK im Nachstart" CURVE 0x819271 KlAUbSstUbWUb 3.984 fak_ub_b4 0.00 3.984 FORMAT "%5.3"
 /begin AXIS_DESCR STD_AXIS tmst temp_ub_q0p75_o48 9 -48.00 143.3 FORMAT "%5.1" DEPOSIT ABSOLUTE /end AXIS_DESCR
/end CHARACTERISTIC
/begin CHARACTERISTIC FVANST "Gewichtungsfaktor VA im Nachstart" VALUE 0x81152D KwUb 1.992 fak_ub_b2 0.00 1.992 FORMAT "%5.3" /end CHARACTERISTIC
/begin CHARACTERISTIC FVFKUKA "Gewichtung des Korrekturfaktors in UK-Adaption" VALUE 0x811533 KwUb 7.969 fak_ub_b8 0.00 7.969 FORMAT "%5.3" /end CHARACTERISTIC
/begin CHARACTERISTIC FWEHT "Faktor Wiedereinsetzmenge  temperaturabhängig (hartes WE)" CURVE 0x819123 KlAUbSstUbWUb 1.992 fak_ub_b2 0.00 1.992 FORMAT "%5.3"
 /begin AXIS_DESCR STD_AXIS tmot temp_ub_q0p75_o48 9 -48.00 143.3 FORMAT "%5.1" DEPOSIT ABSOLUTE /end AXIS_DESCR
/end CHARACTERISTIC
/begin CHARACTERISTIC FWEMRFA "Faktor Wiedereinsetzmenge über Fahrerwunschmoment" CURVE 0x815A92 KlAUwSstUwWUb 1.992 fak_ub_b2 0.00 1.992 FORMAT "%5.3"
 /begin AXIS_DESCR STD_AXIS mrfa_w rel_uw_b200 6 0.00 199.9969 FORMAT "%8.4" DEPOSIT ABSOLUTE /end AXIS_DESCR
/end CHARACTERISTIC
/begin CHARACTERISTIC FWET "Faktor Wiedereinsetzmenge temperaturabhaengig" CURVE 0x819136 KlAUbSstUbWUb 1.992 fak_ub_b2 0.00 1.992 FORMAT "%5.3"
 /begin AXIS_DESCR STD_AXIS tmot temp_ub_q0p75_o48 9 -48.00 143.3 FORMAT "%5.1" DEPOSIT ABSOLUTE /end AXIS_DESCR
/end CHARACTERISTIC
/begin CHARACTERISTIC FWFN "Faktor Wandfilm Drehzahleinfluss" VALUE 0x815AC2 KwSw 2.999954 rel_sw_b1p5 -1.500000 1.499954 FORMAT "%8.6" /end CHARACTERISTIC
/begin CHARACTERISTIC ILMRMN "Minimalwert des Luftmassenreglers" VALUE 0x813D36 KwSw 1535.977 rel_sw_q0p0234 -768.0000 767.9766 FORMAT "%8.4" /end CHARACTERISTIC
/begin CHARACTERISTIC ILMRMX "Maximalwert des Luftmassenreglers" VALUE 0x813D38 KwSw 1535.977 rel_sw_q0p0234 -768.0000 767.9766 FORMAT "%8.4" /end CHARACTERISTIC
/begin CHARACTERISTIC ILMRN "Integratorverstärkung von Luftmassenregler" CURVE 0x81893A GklWUb 7.969 fak_ub_b8 0.00 7.969 FORMAT "%5.3"
 /begin AXIS_DESCR COM_AXIS nmot nmot_ub_q40 8 0.00 10200. AXIS_PTS_REF SNM08FEUB /end AXIS_DESCR
/end CHARACTERISTIC
/begin CHARACTERISTIC IMLHS "Luftmassenintegral Heißstart" VALUE 0x8110ED KwUb 23.21 m_ub_b23p3 0.00 23.21 FORMAT "%5.2" /end CHARACTERISTIC
/begin CHARACTERISTIC KFABAK "Aufteilungsfaktor Wandfilm bei BA" MAP 0x819284 GkfWUb 0.9961 fak_ub_b1 0.00 0.9961
 /begin AXIS_DESCR COM_AXIS tmot temp_ub_q0p75_o48 9 -48.00 143.3 AXIS_PTS_REF STM09ESUB /end AXIS_DESCR
 /begin AXIS_DESCR COM_AXIS nmot nmot_ub_q40 7 0.00 10200. AXIS_PTS_REF SNM07ESUB /end AXIS_DESCR
/end CHARACTERISTIC
/begin CHARACTERISTIC KFAVAK "Aufteilungsfaktor Wandfilm bei VA" MAP 0x8192C3 GkfWUb 0.9961 fak_ub_b1 0.00 0.9961
 /begin AXIS_DESCR COM_AXIS tmot temp_ub_q0p75_o48 9 -48.00 143.3 AXIS_PTS_REF STM09ESUB /end AXIS_DESCR
 /begin AXIS_DESCR COM_AXIS nmot nmot_ub_q40 7 0.00 10200. AXIS_PTS_REF SNM07ESUB /end AXIS_DESCR
/end CHARACTERISTIC
/begin CHARACTERISTIC KFBAKL_0_A "Faktor Beschleunigungsanreicherung (K+L-Anteil)" MAP 0x819302 GkfWUb 15.94 fak_ub_b16 0.00 15.94 FORMAT "%5.2"
 /begin AXIS_DESCR COM_AXIS tmot temp_ub_q0p75_o48 9 -48.00 143.3 AXIS_PTS_REF STM09ESUB /end AXIS_DESCR
 /begin AXIS_DESCR COM_AXIS nmot nmot_ub_q40 7 0.00 10200. AXIS_PTS_REF SNM07ESUB /end AXIS_DESCR
/end CHARACTERISTIC
/begin CHARACTERISTIC KFBAKL_1_A "Faktor Beschleunigungsanreicherung (K+L-Anteil)" MAP 0x819341 GkfWUb 15.94 fak_ub_b16 0.00 15.94 FORMAT "%5.2"
 /begin AXIS_DESCR COM_AXIS tmot temp_ub_q0p75_o48 9 -48.00 143.3 AXIS_PTS_REF STM09ESUB /end AXIS_DESCR
 /begin AXIS_DESCR COM_AXIS nmot nmot_ub_q40 7 0.00 10200. AXIS_PTS_REF SNM07ESUB /end AXIS_DESCR
/end CHARACTERISTIC
/begin CHARACTERISTIC KFBALB "Faktor Beschleunigungsanreicherung Ladebereich" MAP 0x819380 KfAxUbAyUbSstxUbSstyUbWUb 3.984 fak_q0p015625 0.00 3.984 FORMAT "%5.3"
 /begin AXIS_DESCR STD_AXIS nmot nmot_ub_q40 6 0.00 10200. FORMAT "%5.0" DEPOSIT ABSOLUTE /end AXIS_DESCR
 /begin AXIS_DESCR STD_AXIS rlp rel_ub_q0p75 6 0.00 191.3 FORMAT "%5.1" DEPOSIT ABSOLUTE /end AXIS_DESCR
/end CHARACTERISTIC
/begin CHARACTERISTIC KFBRAWA_0_A "Sollbeschleunigung bei Wiederaufnahme" MAP 0x81C668 KfAxUwAyUwSstxUwSstyUwWUw 27.7802865 bfzg_sw_q4p239Em4 0.00 27.7802865
 /begin AXIS_DESCR STD_AXIS vfgr_w vfzg_uw_b512 8 0.00 511.9922 FORMAT "%8.4" DEPOSIT ABSOLUTE /end AXIS_DESCR
 /begin AXIS_DESCR STD_AXIS dvzi_w vfzg_uw_q0p0078125 6 0.00 511.9922 FORMAT "%8.4" DEPOSIT ABSOLUTE /end AXIS_DESCR
/end CHARACTERISTIC
/begin CHARACTERISTIC KFBRAWA_1_A "Sollbeschleunigung bei Wiederaufnahme" MAP 0x81C6E8 KfAxUwAyUwSstxUwSstyUwWUw 27.7802865 bfzg_sw_q4p239Em4 0.00 27.7802865
 /begin AXIS_DESCR STD_AXIS vfgr_w vfzg_uw_b512 8 0.00 511.9922 FORMAT "%8.4" DEPOSIT ABSOLUTE /end AXIS_DESCR
 /begin AXIS_DESCR STD_AXIS dvzi_w vfzg_uw_q0p0078125 6 0.00 511.9922 FORMAT "%8.4" DEPOSIT ABSOLUTE /end AXIS_DESCR
/end CHARACTERISTIC
/begin CHARACTERISTIC KFHSTT_0_A "Faktor Heißstart" MAP 0x8110EE KfAxUbAyUbSstxUbSstyUbWUb 63.75 fak_ub_b64 0.00 63.75 FORMAT "%5.2"
 /begin AXIS_DESCR STD_AXIS tans temp_ub_q0p75_o48 6 -48.00 143.3 FORMAT "%5.1" DEPOSIT ABSOLUTE /end AXIS_DESCR
 /begin AXIS_DESCR STD_AXIS tmst temp_ub_q0p75_o48 3 -48.00 143.3 FORMAT "%5.1" DEPOSIT ABSOLUTE /end AXIS_DESCR
/end CHARACTERISTIC
/begin CHARACTERISTIC KFHSTT_1_A "Faktor Heißstart" MAP 0x81110B KfAxUbAyUbSstxUbSstyUbWUb 63.75 fak_ub_b64 0.00 63.75 FORMAT "%5.2"
 /begin AXIS_DESCR STD_AXIS tans temp_ub_q0p75_o48 6 -48.00 143.3 FORMAT "%5.1" DEPOSIT ABSOLUTE /end AXIS_DESCR
 /begin AXIS_DESCR STD_AXIS tmst temp_ub_q0p75_o48 3 -48.00 143.3 FORMAT "%5.1" DEPOSIT ABSOLUTE /end AXIS_DESCR
/end CHARACTERISTIC
/begin CHARACTERISTIC KFKHFM "Korrekturkennfeld für HFM" MAP 0x810DC5 KfAxUbAyUbSstxUbSstyUbWUb 1.992 fak_ub_b2 0.00 1.992 FORMAT "%5.3"
 /begin AXIS_DESCR STD_AXIS nmot nmot_ub_q40 14 0.00 10200. FORMAT "%5.0" DEPOSIT ABSOLUTE /end AXIS_DESCR
 /begin AXIS_DESCR STD_AXIS rl rel_ub_q0p75 14 0.00 191.3 FORMAT "%5.1" DEPOSIT ABSOLUTE /end AXIS_DESCR
/end CHARACTERISTIC
/begin CHARACTERISTIC KFLDFK "Ladedruck Filterkonstante" MAP 0x813CEC KfAxUwAyUwSstxUwSstyUwWUw 655.34999985 zk10msxs_uw_b655 0.010000152590 655.36000000 FORMAT "%12.8"
 /begin AXIS_DESCR STD_AXIS nmot_w nmot_uw_q0p25 4 0.00 16383.75 FORMAT "%8.2" DEPOSIT ABSOLUTE /end AXIS_DESCR
 /begin AXIS_DESCR STD_AXIS psspvdkd_w fak_uw_b4 6 0.00 3.999939 FORMAT "%8.6" DEPOSIT ABSOLUTE /end AXIS_DESCR
/end CHARACTERISTIC
/begin CHARACTERISTIC KFPLMR "P-Anteil von Luftmassenregler" MAP 0x813D3A KfAxUbAyUbSstxSwSstyUbWSw 1535.977 rel_sw_q0p0234 -768.0000 767.9766 FORMAT "%8.4"
 /begin AXIS_DESCR STD_AXIS drlm_w rel_sw_q0p0234 8 -768.0000 767.9766 FORMAT "%8.4" DEPOSIT ABSOLUTE /end AXIS_DESCR
 /begin AXIS_DESCR STD_AXIS nmotll nmot_ub_q10 6 0.00 2550. FORMAT "%5.0" DEPOSIT ABSOLUTE /end AXIS_DESCR
/end CHARACTERISTIC
/begin CHARACTERISTIC KFPLMRMSR "P-Anteil von Luftmassenregler bei MSR-Eingriff" MAP 0x813DB2 KfAxUbAyUbSstxSwSstyUbWSw 1535.977 rel_sw_q0p0234 -768.0000 767.9766 FORMAT "%8.4"
 /begin AXIS_DESCR STD_AXIS drlm_w rel_sw_q0p0234 8 -768.0000 767.9766 FORMAT "%8.4" DEPOSIT ABSOLUTE /end AXIS_DESCR
 /begin AXIS_DESCR STD_AXIS nmotll nmot_ub_q10 6 0.00 2550. FORMAT "%5.0" DEPOSIT ABSOLUTE /end AXIS_DESCR
/end CHARACTERISTIC
/begin CHARACTERISTIC KFVAKL_0_A "Faktor Verzögerungsabmagerung (K+L-Anteil)" MAP 0x8193B2 GkfWUb 15.94 fak_ub_b16 0.00 15.94 FORMAT "%5.2"
 /begin AXIS_DESCR COM_AXIS tmot temp_ub_q0p75_o48 9 -48.00 143.3 AXIS_PTS_REF STM09ESUB /end AXIS_DESCR
 /begin AXIS_DESCR COM_AXIS nmot nmot_ub_q40 7 0.00 10200. AXIS_PTS_REF SNM07ESUB /end AXIS_DESCR
/end CHARACTERISTIC
/begin CHARACTERISTIC KFVAKL_1_A "Faktor Verzögerungsabmagerung (K+L-Anteil)" MAP 0x8193F1 GkfWUb 15.94 fak_ub_b16 0.00 15.94 FORMAT "%5.2"
 /begin AXIS_DESCR COM_AXIS tmot temp_ub_q0p75_o48 9 -48.00 143.3 AXIS_PTS_REF STM09ESUB /end AXIS_DESCR
 /begin AXIS_DESCR COM_AXIS nmot nmot_ub_q40 7 0.00 10200. AXIS_PTS_REF SNM07ESUB /end AXIS_DESCR
/end CHARACTERISTIC
/begin CHARACTERISTIC KFVALDIF "Wichtungsfaktor Verzögerungsabmagerung für Lambdaist > 1.0" MAP 0x819430 GkfWUb 0.9961 fak_ub_b1 0.00 0.9961
 /begin AXIS_DESCR COM_AXIS tmot temp_ub_q0p75_o48 9 -48.00 143.3 AXIS_PTS_REF STM09ESUB /end AXIS_DESCR
 /begin AXIS_DESCR COM_AXIS ladiff_w fak_sw_b1 5 0.00 1.999969 AXIS_PTS_REF SLA05ESUB /end AXIS_DESCR
/end CHARACTERISTIC
/begin CHARACTERISTIC KFVAWLA "Wichtung VA über lamsbg" MAP 0x81DBA6 KfAxUbAyUbSstxUbSstyUbWUb 3.984 fak_ub_b4 0.00 3.984 FORMAT "%5.3"
 /begin AXIS_DESCR STD_AXIS tmot temp_ub_q0p75_o48 3 -48.00 143.3 FORMAT "%5.1" DEPOSIT ABSOLUTE /end AXIS_DESCR
 /begin AXIS_DESCR STD_AXIS lamsbguk fak_ub_b4 4 0.00 3.984 FORMAT "%5.3" DEPOSIT ABSOLUTE /end AXIS_DESCR
/end CHARACTERISTIC
/begin CHARACTERISTIC KFVOFFS_0_A "Geschwindigkeits-Offset für FGR-Regler" MAP 0x81C7A0 KfAxUwAyUwSstxUwSstyUwWUw 511.9922 vfzg_uw_q0p0078125 0.00 511.9922 FORMAT "%8.4"
 /begin AXIS_DESCR STD_AXIS vfgro_w vfzg_uw_q0p0078125 6 0.00 511.9922 FORMAT "%8.4" DEPOSIT ABSOLUTE /end AXIS_DESCR
 /begin AXIS_DESCR STD_AXIS uevges_w fak_q0p1 8 0.00 6553.500 FORMAT "%8.3" DEPOSIT ABSOLUTE /end AXIS_DESCR
/end CHARACTERISTIC
/begin CHARACTERISTIC KFVOFFS_1_A "Geschwindigkeits-Offset für FGR-Regler" MAP 0x81C820 KfAxUwAyUwSstxUwSstyUwWUw 511.9922 vfzg_uw_q0p0078125 0.00 511.9922 FORMAT "%8.4"
 /begin AXIS_DESCR STD_AXIS vfgro_w vfzg_uw_q0p0078125 6 0.00 511.9922 FORMAT "%8.4" DEPOSIT ABSOLUTE /end AXIS_DESCR
 /begin AXIS_DESCR STD_AXIS uevges_w fak_q0p1 8 0.00 6553.500 FORMAT "%8.3" DEPOSIT ABSOLUTE /end AXIS_DESCR
/end CHARACTERISTIC
/begin CHARACTERISTIC KFWDKMSN "Kennfeld für Drosselklappen-Sollwinkel" MAP 0x81D316 KfAxUwAyUwSstxUwSstyUwWUw 99.99847 rel_uw_b100 0.00 99.99847 FORMAT "%8.5"
 /begin AXIS_DESCR STD_AXIS mlwdknf_w m_uw_b6553p5 16 0.00 6553.500 FORMAT "%8.3" DEPOSIT ABSOLUTE /end AXIS_DESCR
 /begin AXIS_DESCR STD_AXIS nmot_w nmot_uw_q0p25 6 0.00 16383.75 FORMAT "%8.2" DEPOSIT ABSOLUTE /end AXIS_DESCR
/end CHARACTERISTIC
/begin CHARACTERISTIC KFWDKPP "Ersatzwert für Drosselklappenwinkel aus Füllungssignal" MAP 0x810BF6 KfAxUbAyUbSstxUbSstyUbWUb 100.0 relDK_ub_b100 0.00 100.0 FORMAT "%5.1"
 /begin AXIS_DESCR STD_AXIS nmot nmot_ub_q40 12 0.00 10200. FORMAT "%5.0" DEPOSIT ABSOLUTE /end AXIS_DESCR
 /begin AXIS_DESCR STD_AXIS rlvppl rel_ub_q0p75 12 0.00 191.3 FORMAT "%5.1" DEPOSIT ABSOLUTE /end AXIS_DESCR
/end CHARACTERISTIC
/begin CHARACTERISTIC KFWDKSMX "maximaler Solldrosselklappenwinkel" MAP 0x81D406 KfAxUwAyUwSstxUwSstyUwWUw 99.99847 rel_uw_b100 0.00 99.99847 FORMAT "%8.5"
 /begin AXIS_DESCR STD_AXIS nmot_w nmot_uw_q0p25 10 0.00 16383.75 FORMAT "%8.2" DEPOSIT ABSOLUTE /end AXIS_DESCR
 /begin AXIS_DESCR STD_AXIS fho_w fak_uw_b4 3 0.00 3.999939 FORMAT "%8.6" DEPOSIT ABSOLUTE /end AXIS_DESCR
/end CHARACTERISTIC
/begin CHARACTERISTIC KFWEE "Kennfeld Winkel Einspritzende" MAP 0x818EC2 GkfWUb 1530. zw_ub_q6 0.00 1530. FORMAT "%5.0"
 /begin AXIS_DESCR COM_AXIS rl rel_ub_q0p75 8 0.00 191.3 AXIS_PTS_REF SRL08GKUB /end AXIS_DESCR
 /begin AXIS_DESCR COM_AXIS nmot nmot_ub_q40 8 0.00 10200. AXIS_PTS_REF SNM08GKUB /end AXIS_DESCR
/end CHARACTERISTIC
/begin CHARACTERISTIC KFWEEK "Kennfeld-Kalt Winkel Einspritzende" MAP 0x818F02 GkfWUb 1530. zw_ub_q6 0.00 1530. FORMAT "%5.0"
 /begin AXIS_DESCR COM_AXIS rl rel_ub_q0p75 8 0.00 191.3 AXIS_PTS_REF SRL08GKUB /end AXIS_DESCR
 /begin AXIS_DESCR COM_AXIS nmot nmot_ub_q40 8 0.00 10200. AXIS_PTS_REF SNM08GKUB /end AXIS_DESCR
/end CHARACTERISTIC
/begin CHARACTERISTIC KFWEEST_0_A "Kennfeld Winkel Einspritzende während Start" MAP 0x810FEE KfAxUbAyUbSstxUbSstyUbWUb 1530. zw_ub_q6 0.00 1530. FORMAT "%5.0"
 /begin AXIS_DESCR STD_AXIS tmot temp_ub_q0p75_o48 8 -48.00 143.3 FORMAT "%5.1" DEPOSIT ABSOLUTE /end AXIS_DESCR
 /begin AXIS_DESCR STD_AXIS anztib dez 8 0.00 255.0 FORMAT "%5.1" DEPOSIT ABSOLUTE /end AXIS_DESCR
/end CHARACTERISTIC
/begin CHARACTERISTIC KFWEEST_1_A "Kennfeld Winkel Einspritzende während Start" MAP 0x811040 KfAxUbAyUbSstxUbSstyUbWUb 1530. zw_ub_q6 0.00 1530. FORMAT "%5.0"
 /begin AXIS_DESCR STD_AXIS tmot temp_ub_q0p75_o48 8 -48.00 143.3 FORMAT "%5.1" DEPOSIT ABSOLUTE /end AXIS_DESCR
 /begin AXIS_DESCR STD_AXIS anztib dez 8 0.00 255.0 FORMAT "%5.1" DEPOSIT ABSOLUTE /end AXIS_DESCR
/end CHARACTERISTIC
/begin CHARACTERISTIC KFWEETM "Kennfeld Winkel Einspritzende Temperaturkorrektur" MAP 0x81D9A0 KfAxUbAyUbSstxUbSstyUbWSb 1530. zw_sb_q6 -768.0 762.0 FORMAT "%5.1"
 /begin AXIS_DESCR STD_AXIS tmot temp_ub_q0p75_o48 8 -48.00 143.3 FORMAT "%5.1" DEPOSIT ABSOLUTE /end AXIS_DESCR
 /begin AXIS_DESCR STD_AXIS rl rel_ub_q0p75 6 0.00 191.3 FORMAT "%5.1" DEPOSIT ABSOLUTE /end AXIS_DESCR
/end CHARACTERISTIC
/begin CHARACTERISTIC KFWHSTT_0_A "Wichtungskennfeld Heißstart" MAP 0x811128 KfAxUbAyUbSstxUbSstyUbWUb 1.992 fak_ub_b2 0.00 1.992 FORMAT "%5.3"
 /begin AXIS_DESCR STD_AXIS tans temp_ub_q0p75_o48 6 -48.00 143.3 FORMAT "%5.1" DEPOSIT ABSOLUTE /end AXIS_DESCR
 /begin AXIS_DESCR STD_AXIS anztib dez 8 0.00 255.0 FORMAT "%5.1" DEPOSIT ABSOLUTE /end AXIS_DESCR
/end CHARACTERISTIC
/begin CHARACTERISTIC KFWHSTT_1_A "Wichtungskennfeld Heißstart" MAP 0x811168 KfAxUbAyUbSstxUbSstyUbWUb 1.992 fak_ub_b2 0.00 1.992 FORMAT "%5.3"
 /begin AXIS_DESCR STD_AXIS tans temp_ub_q0p75_o48 6 -48.00 143.3 FORMAT "%5.1" DEPOSIT ABSOLUTE /end AXIS_DESCR
 /begin AXIS_DESCR STD_AXIS anztib dez 8 0.00 255.0 FORMAT "%5.1" DEPOSIT ABSOLUTE /end AXIS_DESCR
/end CHARACTERISTIC
/begin CHARACTERISTIC KFWHSTT_2_A "Wichtungskennfeld Heißstart" MAP 0x8111A8 KfAxUbAyUbSstxUbSstyUbWUb 1.992 fak_ub_b2 0.00 1.992 FORMAT "%5.3"
 /begin AXIS_DESCR STD_AXIS tans temp_ub_q0p75_o48 6 -48.00 143.3 FORMAT "%5.1" DEPOSIT ABSOLUTE /end AXIS_DESCR
 /begin AXIS_DESCR STD_AXIS anztib dez 8 0.00 255.0 FORMAT "%5.1" DEPOSIT ABSOLUTE /end AXIS_DESCR
/end CHARACTERISTIC
/begin CHARACTERISTIC KFWHSTT_3_A "Wichtungskennfeld Heißstart" MAP 0x8111E8 KfAxUbAyUbSstxUbSstyUbWUb 1.992 fak_ub_b2 0.00 1.992 FORMAT "%5.3"
 /begin AXIS_DESCR STD_AXIS tans temp_ub_q0p75_o48 6 -48.00 143.3 FORMAT "%5.1" DEPOSIT ABSOLUTE /end AXIS_DESCR
 /begin AXIS_DESCR STD_AXIS anztib dez 8 0.00 255.0 FORMAT "%5.1" DEPOSIT ABSOLUTE /end AXIS_DESCR
/end CHARACTERISTIC
/begin CHARACTERISTIC KFWKSTAB "Faktor Wiederholkaltstart zur Reduzierung der Startmenge" MAP 0x8158CE KfAxUbAyUbSstxUwSstyUbWUb 1.992 fak_ub_b2 0.00 1.992 FORMAT "%5.3"
 /begin AXIS_DESCR STD_AXIS tabst_w t1sxs_uw_q1 4 0.00 65535.00 FORMAT "%8.2" DEPOSIT ABSOLUTE /end AXIS_DESCR
 /begin AXIS_DESCR STD_AXIS tmst temp_ub_q0p75_o48 4 -48.00 143.3 FORMAT "%5.1" DEPOSIT ABSOLUTE /end AXIS_DESCR
/end CHARACTERISTIC
/begin CHARACTERISTIC KFWKSTN "Wichtungskennfeld Kaltstart" MAP 0x811228 KfAxUbAyUbSstxUbSstyUbWUb 0.9961 fak_ub_b1 0.00 0.9961
 /begin AXIS_DESCR STD_AXIS tmst temp_ub_q0p75_o48 4 -48.00 143.3 FORMAT "%5.1" DEPOSIT ABSOLUTE /end AXIS_DESCR
 /begin AXIS_DESCR STD_AXIS nmot nmot_ub_q40 4 0.00 10200. FORMAT "%5.0" DEPOSIT ABSOLUTE /end AXIS_DESCR
/end CHARACTERISTIC
/begin CHARACTERISTIC KFWKSTT_0_A "Wichtungskennfeld Kaltstart" MAP 0x811242 KfAxUbAyUbSstxUbSstyUbWUb 1.992 fak_ub_b2 0.00 1.992 FORMAT "%5.3"
 /begin AXIS_DESCR STD_AXIS tmst temp_ub_q0p75_o48 12 -48.00 143.3 FORMAT "%5.1" DEPOSIT ABSOLUTE /end AXIS_DESCR
 /begin AXIS_DESCR STD_AXIS anztib dez 12 0.00 255.0 FORMAT "%5.1" DEPOSIT ABSOLUTE /end AXIS_DESCR
/end CHARACTERISTIC
/begin CHARACTERISTIC KFWKSTT_1_A "Wichtungskennfeld Kaltstart" MAP 0x8112EC KfAxUbAyUbSstxUbSstyUbWUb 1.992 fak_ub_b2 0.00 1.992 FORMAT "%5.3"
 /begin AXIS_DESCR STD_AXIS tmst temp_ub_q0p75_o48 12 -48.00 143.3 FORMAT "%5.1" DEPOSIT ABSOLUTE /end AXIS_DESCR
 /begin AXIS_DESCR STD_AXIS anztib dez 12 0.00 255.0 FORMAT "%5.1" DEPOSIT ABSOLUTE /end AXIS_DESCR
/end CHARACTERISTIC
/begin CHARACTERISTIC KFWKSTT_2_A "Wichtungskennfeld Kaltstart" MAP 0x811396 KfAxUbAyUbSstxUbSstyUbWUb 1.992 fak_ub_b2 0.00 1.992 FORMAT "%5.3"
 /begin AXIS_DESCR STD_AXIS tmst temp_ub_q0p75_o48 12 -48.00 143.3 FORMAT "%5.1" DEPOSIT ABSOLUTE /end AXIS_DESCR
 /begin AXIS_DESCR STD_AXIS anztib dez 12 0.00 255.0 FORMAT "%5.1" DEPOSIT ABSOLUTE /end AXIS_DESCR
/end CHARACTERISTIC
/begin CHARACTERISTIC KFWKSTT_3_A "Wichtungskennfeld Kaltstart" MAP 0x811440 KfAxUbAyUbSstxUbSstyUbWUb 1.992 fak_ub_b2 0.00 1.992 FORMAT "%5.3"
 /begin AXIS_DESCR STD_AXIS tmst temp_ub_q0p75_o48 12 -48.00 143.3 FORMAT "%5.1" DEPOSIT ABSOLUTE /end AXIS_DESCR
 /begin AXIS_DESCR STD_AXIS anztib dez 12 0.00 255.0 FORMAT "%5.1" DEPOSIT ABSOLUTE /end AXIS_DESCR
/end CHARACTERISTIC
/begin CHARACTERISTIC KKFFGRGA_0_A "Verstärkungsfaktor bei Konstantfahrt für FGR-Regler" CURVE 0x81C8A0 KlAUwSstUwWUw 3199.951 rel_uw_b3200 0.00 3199.951 FORMAT "%8.3"
 /begin AXIS_DESCR STD_AXIS uevges_w fak_q0p1 8 0.00 6553.500 FORMAT "%8.3" DEPOSIT ABSOLUTE /end AXIS_DESCR
/end CHARACTERISTIC
/begin CHARACTERISTIC KKFFGRGA_1_A "Verstärkungsfaktor bei Konstantfahrt für FGR-Regler" CURVE 0x81C8C2 KlAUwSstUwWUw 3199.951 rel_uw_b3200 0.00 3199.951 FORMAT "%8.3"
 /begin AXIS_DESCR STD_AXIS uevges_w fak_q0p1 8 0.00 6553.500 FORMAT "%8.3" DEPOSIT ABSOLUTE /end AXIS_DESCR
/end CHARACTERISTIC
/begin CHARACTERISTIC KLDMASRL "Stellreserve bei ASR-Eingriff" CURVE 0x810195 KlAUbSstUbWUb 99.61 rel_ub_b99p6 0.00 99.61 FORMAT "%5.2"
 /begin AXIS_DESCR STD_AXIS nmot nmot_ub_q40 5 0.00 10200. FORMAT "%5.0" DEPOSIT ABSOLUTE /end AXIS_DESCR
/end CHARACTERISTIC
/begin CHARACTERISTIC KLDPDK "Druckabfall über Drosselklappe" CURVE 0x81D460 KlAUwSstUwWUw 2559.961 p_uw_q0p039 0.00 2559.961 FORMAT "%8.3"
 /begin AXIS_DESCR STD_AXIS mlkge_w m_uw_b6553p5 16 0.00 6553.500 FORMAT "%8.3" DEPOSIT ABSOLUTE /end AXIS_DESCR
/end CHARACTERISTIC
/begin CHARACTERISTIC KLTDS "Konvertierungskennlinie für Tankdrucksensor DS-T2" CURVE 0x8176E4 KlASwSstSwWSw 63.99902 p_sw_q0p000977 -32.00000 31.99902 FORMAT "%8.5"
 /begin AXIS_DESCR STD_AXIS pterw_w p_sw_q0p00244 6 -80.00000 79.99756 FORMAT "%8.5" DEPOSIT ABSOLUTE /end AXIS_DESCR
/end CHARACTERISTIC
/begin CHARACTERISTIC KRAFGRGA_0_A "Verstärkungsfaktor bei Rampe für FGR-Regler" CURVE 0x81C8E4 KlAUwSstUwWUw 3199.951 rel_uw_b3200 0.00 3199.951 FORMAT "%8.3"
 /begin AXIS_DESCR STD_AXIS uevges_w fak_q0p1 8 0.00 6553.500 FORMAT "%8.3" DEPOSIT ABSOLUTE /end AXIS_DESCR
/end CHARACTERISTIC
/begin CHARACTERISTIC KRAFGRGA_1_A "Verstärkungsfaktor bei Rampe für FGR-Regler" CURVE 0x81C906 KlAUwSstUwWUw 3199.951 rel_uw_b3200 0.00 3199.951 FORMAT "%8.3"
 /begin AXIS_DESCR STD_AXIS uevges_w fak_q0p1 8 0.00 6553.500 FORMAT "%8.3" DEPOSIT ABSOLUTE /end AXIS_DESCR
/end CHARACTERISTIC
/begin CHARACTERISTIC LADIFFVA "Schwelle für Wichtungsfaktor Verzögerungsabmagerung für Lambdaist > 1.0" VALUE 0x815AC4 KwSw 1.999969 fak_sw_b1 -1.000000 0.9999695 FORMAT "%8.6" /end CHARACTERISTIC
/begin CHARACTERISTIC LAMUKAF "Lambda-Soll Fettgrenze für Freigabe ÜK-Adaption" VALUE 0x813FF4 KwUw 15.99976 fak_uw_b16 0.00 15.99976 FORMAT "%8.5" /end CHARACTERISTIC
/begin CHARACTERISTIC LAMUKAM "Lambda-Soll Magergrenze für Freigabe ÜK-Adaption" VALUE 0x813FF6 KwUw 15.99976 fak_uw_b16 0.00 15.99976 FORMAT "%8.5" /end CHARACTERISTIC
/begin CHARACTERISTIC MLHFM "Linearisierung der Heißfilmspannung" CURVE 0x814D16 FklWUw 6553.500 m_uw_b6553p5 0.00 6553.500 FORMAT "%8.3"
 /begin AXIS_DESCR FIX_AXIS uhfm_w spg_uw_q0p00488 512 0.00 4.995117 FORMAT "%8.6" FIX_AXIS_PAR 0 1 512 /end AXIS_DESCR
/end CHARACTERISTIC
/begin CHARACTERISTIC MLMIN "minimale HFM-Luftmasse" VALUE 0x815116 KwSw 6553.500 m_sw_b3276p8 -3276.800 3276.700 FORMAT "%8.3" /end CHARACTERISTIC
/begin CHARACTERISTIC MLOFS "Kennlinienoffset HFM 5" VALUE 0x815118 KwUw 6553.500 m_uw_b6553p5 0.00 6553.500 FORMAT "%8.3" /end CHARACTERISTIC
/begin CHARACTERISTIC MRFAVW "Schwelle zur Umschaltung des Vorlagerungswinkels bei max. Fahrerwunsches" CURVE 0x81D9E0 GklWUw 199.9969 rel_uw_b200 0.00 199.9969 FORMAT "%8.4"
 /begin AXIS_DESCR COM_AXIS nmot nmot_ub_q40 8 0.00 10200. AXIS_PTS_REF SNM08GKUB /end AXIS_DESCR
/end CHARACTERISTIC
/begin CHARACTERISTIC MRFGRIMX "Maximaler FGR-Initialisierungswert" CURVE 0x818821 KlAUbSstUbWUb 199.2 rel_ub_b200 0.00 199.2 FORMAT "%5.1"
 /begin AXIS_DESCR STD_AXIS nmot nmot_ub_q40 6 0.00 10200. FORMAT "%5.0" DEPOSIT ABSOLUTE /end AXIS_DESCR
/end CHARACTERISTIC
/begin CHARACTERISTIC MRFGRLL "Schwelle relatives Moment vom Fahrgeschwindigkeitsregler für Erkennung Leerlauf" VALUE 0x81C928 KwUw 199.9969 rel_uw_b200 0.00 199.9969 FORMAT "%8.4" /end CHARACTERISTIC
/begin CHARACTERISTIC MRFGRMAX "Maximalwert für relatives Moment aus FGR" VALUE 0x81C92A KwUw 199.9969 rel_uw_b200 0.00 199.9969 FORMAT "%8.4" /end CHARACTERISTIC
/begin CHARACTERISTIC MRFGRSTA "Startwert für Relatives Moment bei Aktivierung FGR-Regler" VALUE 0x81C92C KwUw 199.9969 rel_uw_b200 0.00 199.9969 FORMAT "%8.4" /end CHARACTERISTIC
/begin CHARACTERISTIC MSRMDTMX "Größte zulässige Momenten-Zeit-Fläche bei der MSR-Topfplausibilisierung" VALUE 0x813706 KwSw 5111.922 mdt_sw_b2556 -2556.000 2555.922 FORMAT "%8.3" /end CHARACTERISTIC
/begin CHARACTERISTIC NDKPPU "Minimaldrehzahl für Plausibilisierung DK-Poti 2 nach unten im Normalbetrieb" VALUE 0x810CA0 KwUb 10000. nmot_ub_q40 200.0 10200. FORMAT "%5.0" /end CHARACTERISTIC
/begin CHARACTERISTIC NDSVLO "obere Drehzahlschwelle für Signalvergleich Ladedruck mit Umgebungsdruck" VALUE 0x81884D KwUb 10200. nmot_ub_q40 0.00 10200. FORMAT "%5.0" /end CHARACTERISTIC
/begin CHARACTERISTIC NDSVLU "Drehzahlschwelle für Signalvergleich Ladedruck mit Umgebungsdruck" VALUE 0x81884E KwUb 10200. nmot_ub_q40 0.00 10200. FORMAT "%5.0" /end CHARACTERISTIC
/begin CHARACTERISTIC NFGRMIN "Min. zul. Drehzahl bei FGR-Betrieb" VALUE 0x8187D9 KwUb 10120. nmot_ub_q40 0.00 10120. FORMAT "%5.0" /end CHARACTERISTIC
/begin CHARACTERISTIC NMIN "Minimal Drehzahl" VALUE 0x81394C KwUw 16383.75 nmot_uw_q0p25 0.00 16383.75 FORMAT "%8.2" /end CHARACTERISTIC
/begin CHARACTERISTIC NMOTDELAY "Wartezeit bis Motorstillstand erkannt" VALUE 0x8127C5 KwUb 2.550 t10msxs_ub_b2p55 0.00 2.550 FORMAT "%5.3" /end CHARACTERISTIC
/begin CHARACTERISTIC NMOTQSYN "Motordrehzahlschwelle zur Freigabe des Schnellstarts über PG Schnellstart" VALUE 0x81394E KwUw 700.0000 nmot_uw_q0p25 0.00 700.0000 FORMAT "%8.4" /end CHARACTERISTIC
/begin CHARACTERISTIC NOASR "Wert für inaktiver ASR-Botschaft" VALUE 0x8101A0 KwUb 99.61 rel_ub_b99p6 0.00 99.61 FORMAT "%5.2" /end CHARACTERISTIC
/begin CHARACTERISTIC NRLMN "Minimaldrehzahl zur Berechnung von umsrln" VALUE 0x813E72 KwUw 16383.75 nmot_ub_q0p25 0.00 16383.75 FORMAT "%8.2" /end CHARACTERISTIC
/begin CHARACTERISTIC NRLMNLLR "Minimaldrehzahl zur Berechnung von umsrln im LL" VALUE 0x813E74 KwUw 16383.75 nmot_ub_q0p25 0.00 16383.75 FORMAT "%8.2" /end CHARACTERISTIC
/begin CHARACTERISTIC NUKAO "obere Drehzahlgrenze für ÜK-Adaption" VALUE 0x811534 KwUb 10200. nmot_ub_q40 0.00 10200. FORMAT "%5.0" /end CHARACTERISTIC
/begin CHARACTERISTIC NUKAU "untere Drehzahlgrenze für ÜK-Adaption" VALUE 0x811535 KwUb 10200. nmot_ub_q40 0.00 10200. FORMAT "%5.0" /end CHARACTERISTIC
/begin CHARACTERISTIC NVGDSLL "Drehzahlschwelle  für Drucksensorvergleich DSU/DSL im Leerlauf" VALUE 0x81884F KwUb 10200. nmot_ub_q40 0.00 10200. FORMAT "%5.0" /end CHARACTERISTIC
/begin CHARACTERISTIC NWDK3 "Minimaldrehzahl für Berechnung DK-Winkel-Ersatzwert aus Füllungssignal" VALUE 0x810CA1 KwUb 10000. nmot_ub_q40 200.0 10200. FORMAT "%5.0" /end CHARACTERISTIC
/begin CHARACTERISTIC OFQSYNADAP "Offset zwischen adaptierter Phasenflanke und Phasenflanke im Start" VALUE 0x813950 KwSw 72.00000 kw_q0p0156 -36.00000 36.00000 FORMAT "%8.5" /end CHARACTERISTIC
/begin CHARACTERISTIC PH_MINSEG "Segmentlänge kurzes Segment beim Schnellstart-Phasengebersignal" VALUE 0x810B59 KwUb 90.00 kw_tooth_sy 0.00 90.00 FORMAT "%5.2" /end CHARACTERISTIC
/begin CHARACTERISTIC PLSOLAP "Applikationswert für Soll-Ladedruck" VALUE 0x813E76 KwUw 2559.961 p_uw_q0p039 0.00 2559.961 FORMAT "%8.3" /end CHARACTERISTIC
/begin CHARACTERISTIC PUE "Ersatzwert für Umgebungsdruck" VALUE 0x81D1B8 KwUw 2559.961 p_uw_q0p039 0.00 2559.961 FORMAT "%8.3" /end CHARACTERISTIC
/begin CHARACTERISTIC PUKANS "Pulsationskorrektur abhängig von Ansauglufttemperatur" CURVE 0x818830 KlAUbSstUbWUb 1.992 fak_ub_b2 0.00 1.992 FORMAT "%5.3"
 /begin AXIS_DESCR STD_AXIS tans temp_ub_q0p75_o48 8 -48.00 143.3 FORMAT "%5.1" DEPOSIT ABSOLUTE /end AXIS_DESCR
/end CHARACTERISTIC
/begin CHARACTERISTIC PUMN "Umgebungsdruckbegrenzung minimal" VALUE 0x81D1BA KwUw 2559.961 p_uw_q0p039 0.00 2559.961 FORMAT "%8.3" /end CHARACTERISTIC
/begin CHARACTERISTIC PUMX "Umgebungsdruckbegrenzung maximal" VALUE 0x81D1BC KwUw 2559.961 p_uw_q0p039 0.00 2559.961 FORMAT "%8.3" /end CHARACTERISTIC
/begin CHARACTERISTIC PUSPSMX "max. Abweichung von Umgebungsdruck und Saugrohrdruck" VALUE 0x81D1BE KwUw 2559.961 p_uw_q0p039 0.00 2559.961 FORMAT "%8.3" /end CHARACTERISTIC
/begin CHARACTERISTIC PVDKMN "pvdk min. Schwelle für Fehlererkennung Ladedrucksensor" VALUE 0x81D1C0 KwUw 2559.961 p_uw_q0p039 0.00 2559.961 FORMAT "%8.3" /end CHARACTERISTIC
/begin CHARACTERISTIC PVDKMX "Ladedruckgrenze für Diagnose max. Fehler" CURVE 0x81D1C2 KlAUwSstUwWUw 2559.961 p_uw_q0p039 0.00 2559.961 FORMAT "%8.3"
 /begin AXIS_DESCR STD_AXIS nmot_w nmot_uw_q0p25 4 0.00 16383.75 FORMAT "%8.2" DEPOSIT ABSOLUTE /end AXIS_DESCR
/end CHARACTERISTIC
/begin CHARACTERISTIC PVDKPSMX "max. Abweichung von Saugrohrdruck und Druck vor Drosselklappe" VALUE 0x81D1D4 KwUw 2559.961 p_uw_q0p039 0.00 2559.961 FORMAT "%8.3" /end CHARACTERISTIC
/begin CHARACTERISTIC PVDKPUD "Schwelle unterhalb welcher die Diff. zw. pvdkds und pu als 0 ausgegeben wird" VALUE 0x818850 KwUb 2550. p_ub_q10 0.00 2550. FORMAT "%5.0" /end CHARACTERISTIC
/begin CHARACTERISTIC RAMPASR "Rampensteilheit bei Aufregelung des ASR-Moments" VALUE 0x813708 KwUw 655.34999985 zk10msxs_uw_b655 0.010000152590 655.36000000 FORMAT "%12.8" /end CHARACTERISTIC
/begin CHARACTERISTIC RKBAUM "rk-Schwelle für BA-Anzeige" CURVE 0x81DB82 GklWSw 6143.813 rel_sw_q0p1875 0.00 6143.813 FORMAT "%8.3"
 /begin AXIS_DESCR COM_AXIS tmot temp_ub_q0p75_o48 9 -48.00 143.3 AXIS_PTS_REF STM09ESUB /end AXIS_DESCR
/end CHARACTERISTIC
/begin CHARACTERISTIC RKUKKLU "Schwelle Summe Kurz-/Langzeitanteil" VALUE 0x815AC6 KwSw 12287.81 rel_sw_q0p1875 -6144.000 6143.813 FORMAT "%8.3" /end CHARACTERISTIC
/begin CHARACTERISTIC RKUKKTUBA "Schwelle für Erkennung UK-Aktivität (Kurzzeitanteil) BA" VALUE 0x813FF8 KwSw 6143.813 rel_sw_q0p1875 0.00 6143.813 FORMAT "%8.3" /end CHARACTERISTIC
/begin CHARACTERISTIC RKUKKTUVA "Schwelle für Erkennung UK-Aktivität (Kurzzeitanteil) VA" VALUE 0x813FFA KwSw 6144.000 rel_sw_q0p1875 -6144.000 0.00 FORMAT "%8.3" /end CHARACTERISTIC
/begin CHARACTERISTIC RKVAUM "rk-Schwelle für VA-Anzeige" CURVE 0x81DB94 GklWSw 6144.000 rel_sw_q0p1875 -6144.000 0.00 FORMAT "%8.3"
 /begin AXIS_DESCR COM_AXIS tmot temp_ub_q0p75_o48 9 -48.00 143.3 AXIS_PTS_REF STM09ESUB /end AXIS_DESCR
/end CHARACTERISTIC
/begin CHARACTERISTIC RLUKAO "obere Lastgrenze für ÜK-Adaption" VALUE 0x811536 KwUb 191.3 rel_ub_q0p75 0.00 191.3 FORMAT "%5.1" /end CHARACTERISTIC
/begin CHARACTERISTIC RLUKAU "untere Lastgrenze für ÜK-Adaption" VALUE 0x811537 KwUb 191.3 rel_ub_q0p75 0.00 191.3 FORMAT "%5.1" /end CHARACTERISTIC
/begin AXIS_PTS SLA05ESUB "Stützstellenverteilung Regelabweichung Lambda, 5 Sst." 0x81340E ladiff_w SstAUwSstUw 1.999969 fak_sw_b1 5 0.00 1.999969 FORMAT "%8.6" DEPOSIT ABSOLUTE /end AXIS_PTS
/begin AXIS_PTS SNM07ESUB "Stützstellenverteilung Drehzahl, 7 Sst." 0x818202 nmot SstAUbSstUb 10200. nmot_ub_q40 7 0.00 10200. FORMAT "%5.0" DEPOSIT ABSOLUTE /end AXIS_PTS
/begin AXIS_PTS SNM08FEUB "Stützstellenverteilung Drehzahl, 08 Sst., Füllungseingriffe" 0x81820A nmot SstAUbSstUb 10200. nmot_ub_q40 8 0.00 10200. FORMAT "%5.0" DEPOSIT ABSOLUTE /end AXIS_PTS
/begin AXIS_PTS SNM08GKUB "Stützstellenverteilung Gemischkontrolle 8 nmot Stützstellen" 0x818F42 nmot SstAUbSstUb 10200. nmot_ub_q40 8 0.00 10200. FORMAT "%5.0" DEPOSIT ABSOLUTE /end AXIS_PTS
/begin AXIS_PTS SRL08GKUB "Stützstellenverteilung Gemischkontrolle 8 rl Stützstellen" 0x818F4B rl SstAUbSstUb 191.3 rel_ub_q0p75 8 0.00 191.3 FORMAT "%5.1" DEPOSIT ABSOLUTE /end AXIS_PTS
/begin AXIS_PTS STM09ESUB "Stützstellenverteilung Motortemperatur, 9 Sst." 0x8182C2 tmot SstAUbSstUb 191.3 temp_ub_q0p75_o48 9 -48.00 143.3 FORMAT "%5.1" DEPOSIT ABSOLUTE /end AXIS_PTS
/begin CHARACTERISTIC TABGTA "Abgastemperatur aus Sensor" CURVE 0x81DD34 KlAUwSstUwWUw 1279.980 temp_uw_q0p0195_o50 -50.00000 1229.980 FORMAT "%8.3"
 /begin AXIS_DESCR STD_AXIS tabgta_kge rel_uw_b100 18 0.00 99.99847 FORMAT "%8.5" DEPOSIT ABSOLUTE /end AXIS_DESCR
/end CHARACTERISTIC
/begin CHARACTERISTIC TAIRCMX "Überwachungszeit für obere Grenze der Botschaftszählerdifferenz" VALUE 0x8127C6 KwUb 255.0 DEZ 0.00 255.0 FORMAT "%5.1" /end CHARACTERISTIC
/begin CHARACTERISTIC TAIRCNU "Überwachungszeit für untere Grenze der Botschaftszählerdifferenz" VALUE 0x8127C7 KwUb 5.100 t20msxs_ub_b5p1 0.00 5.100 FORMAT "%5.3" /end CHARACTERISTIC
/begin CHARACTERISTIC TANDT "Schwelle Temperaturdifferenz Ansaugluft für Heißstart" CURVE 0x8114EA KlAUbSstUbWUb 191.3 temp_ub_b191p25 0.00 191.3 FORMAT "%5.1"
 /begin AXIS_DESCR STD_AXIS tansab temp_ub_q0p75_o48 8 -48.00 143.3 FORMAT "%5.1" DEPOSIT ABSOLUTE /end AXIS_DESCR
/end CHARACTERISTIC
/begin CHARACTERISTIC TANH "Ansauglufttemperatur - Schwelle heiß" VALUE 0x8114FB KwUb 191.3 temp_ub_q0p75_o48 -48.00 143.3 FORMAT "%5.1" /end CHARACTERISTIC
/begin CHARACTERISTIC TBPWMCS "Wartezeit bis Signalunterbrechung erkannt" VALUE 0x81AD2E KwUb 2.550 t10msxs_ub_b2p55 0.00 2.550 FORMAT "%5.3" /end CHARACTERISTIC
/begin CHARACTERISTIC TCONT_HILO "Entprellzeit Signal Dauer- high- low" VALUE 0x8127C8 KwUb 1.270 t10msxs_ub_b2p55 0.00 1.270 FORMAT "%5.3" /end CHARACTERISTIC
/begin CHARACTERISTIC TCRCAN "Filterzeit für Crash-CAN-Signal" VALUE 0x8127C9 KwUb 255.0 DEZ 0.00 255.0 FORMAT "%5.1" /end CHARACTERISTIC
/begin CHARACTERISTIC TCSERC "Zeit zur sicheren Crash-CAN-Erkennung" VALUE 0x81AD2F KwUb 12.75 t50msxs_ub_b12p75 0.00 12.75 FORMAT "%5.2" /end CHARACTERISTIC
/begin CHARACTERISTIC TCSERNPL "Zeit für fehlgeschlagene automatische Crashsignalerkennung" VALUE 0x81AD30 KwUb 12.75 t50msxs_ub_b12p75 0.00 12.75 FORMAT "%5.2" /end CHARACTERISTIC
/begin CHARACTERISTIC TCSERP "Zeit zur sicheren Crash-PWM Erkennung" VALUE 0x81AD31 KwUb 12.75 t50msxs_ub_b12p75 0.00 12.75 FORMAT "%5.2" /end CHARACTERISTIC
/begin CHARACTERISTIC TDDFL "Entprellzeit für Fehlereintrag Drucksensor Ladedruck" VALUE 0x818851 KwUb 25.50 t100msxs_ub_b25p5 0.00 25.50 FORMAT "%5.2" /end CHARACTERISTIC
/begin CHARACTERISTIC TDDFLUGD "Entprellzeit für Fehlereintrag Drucksensor Ladedruck" VALUE 0x818852 KwUb 25.50 t100msxs_ub_b25p5 0.00 25.50 FORMAT "%5.2" /end CHARACTERISTIC
/begin CHARACTERISTIC TDDFU "Entprellzeit für Fehlereintrag Druckksensor Umgebung" VALUE 0x818853 KwUb 25.50 t100msxs_ub_b25p5 0.00 25.50 FORMAT "%5.2" /end CHARACTERISTIC
/begin CHARACTERISTIC TDDFUUGD "Entprellzeit für Fehlereintrag Druckksensor Umgebung" VALUE 0x818854 KwUb 25.50 t100msxs_ub_b25p5 0.00 25.50 FORMAT "%5.2" /end CHARACTERISTIC
/begin CHARACTERISTIC TDHLA "Entprellzeit für Klimatronik-Fehler" VALUE 0x81A958 KwUb 25.50 t100msxs_ub_b25p5 0.00 25.50 FORMAT "%5.2" /end CHARACTERISTIC
/begin CHARACTERISTIC TDKPAW "Zeit für DK-Poti-Auswahl" VALUE 0x810CA2 KwUb 2.540 t10msxs_ub_b2p55 0.01000 2.550 FORMAT "%5.3" /end CHARACTERISTIC
/begin CHARACTERISTIC TDUHPOTI "Entprellzeit nach Klemme15_ein für Analogdiagnos" VALUE 0x81A959 KwUb 25.50 t100msxs_ub_b25p5 0.00 25.50 FORMAT "%5.2" /end CHARACTERISTIC
/begin CHARACTERISTIC TDVGDSLL "Verzögerungszeit für Drucksensorvergleich DSU/DSL im Leerlauf" VALUE 0x818855 KwUb 25.50 t100msxs_ub_b25p5 0.00 25.50 FORMAT "%5.2" /end CHARACTERISTIC
/begin CHARACTERISTIC TDVIVZ "Toleranzzeit bei zu großer Abweichung zw. Istgeschw. und Zielgeschw." VALUE 0x813BBA KwUw 1310.700 t20msxs_uw_q0p02 0.00 1310.700 FORMAT "%8.3" /end CHARACTERISTIC
/begin CHARACTERISTIC TDVZVI "Toleranzzeit bei zu großer Abweichung zw. Zielgeschw. und Istgeschw." VALUE 0x813BBC KwUw 1310.700 t20msxs_uw_q0p02 0.00 1310.700 FORMAT "%8.3" /end CHARACTERISTIC
/begin CHARACTERISTIC TEEUHE "Entprellzeit für analogem Fenster" VALUE 0x81A95A KwUb 25.50 t100msxs_ub_b25p5 0.00 25.50 FORMAT "%5.2" /end CHARACTERISTIC
/begin CHARACTERISTIC TEPBRKUP "Entprellzeit für Brems- und Kupplungsschalter" VALUE 0x810D9F KwUb 5.100 t20msxs_ub_b5p1 0.00 5.100 FORMAT "%5.3" /end CHARACTERISTIC
/begin CHARACTERISTIC TEPFGRH "Entprellzeit für FGR-Bedienhebel" VALUE 0x8186FB KwUb 5.100 t20msxs_ub_b5p1 0.00 5.100 FORMAT "%5.3" /end CHARACTERISTIC
/begin CHARACTERISTIC TFGRABS "Zeitkonstante zum Entprellen der FGR-Abschaltung bei ABS-Bremsung" VALUE 0x8187DA KwUb 0.4000 t20msxs_ub_b5p1 0.00 0.4000 /end CHARACTERISTIC
/begin CHARACTERISTIC TFGRAR "Rampenlaufzeit bei Komfortabschaltung des FGR" VALUE 0x81882E KwUb 5.080 t20msxs_ub_b5p1 0.00 5.080 FORMAT "%5.3" /end CHARACTERISTIC
/begin CHARACTERISTIC TFGRFDY "Toleranzzeit für Eingriffe von Fahrdynamikfunktionen im FGR-Betrieb" VALUE 0x810DBA KwUb 5.100 t20msxs_ub_b5p1 0.00 5.100 FORMAT "%5.3" /end CHARACTERISTIC
/begin CHARACTERISTIC TFGRHE "Verzögerungszeit für Erkennung FGR-Bedienhebelfehler" VALUE 0x8186FC KwUb 5.100 t20msxs_ub_b5p1 0.00 5.100 FORMAT "%5.3" /end CHARACTERISTIC
/begin CHARACTERISTIC TFGRHSNP "Toleranzzeit für Unplausibilität FGR-Hauptschalter" VALUE 0x8186FD KwUb 5.100 t20msxs_ub_b5p1 0.00 5.100 FORMAT "%5.3" /end CHARACTERISTIC
/begin CHARACTERISTIC TFGRTIP "Zeit für Erkennung gehaltene FGR-Funktionstaste Beschleunigen oder Verzögern" VALUE 0x8186FE KwUb 5.100 t20msxs_ub_b5p1 0.00 5.100 FORMAT "%5.3" /end CHARACTERISTIC
/begin CHARACTERISTIC TFGRUEOB "Toleranzzeit für Überschreiten der oberen Beschleunigungsschwelle im FGR-Betrieb" VALUE 0x810DBB KwUb 5.100 t20msxs_ub_b5p1 0.00 5.100 FORMAT "%5.3" /end CHARACTERISTIC
/begin CHARACTERISTIC TFGRUM "Toleranzzeit für Erkennung FGR-Betrieb in der Funktionsüberwachung" VALUE 0x810DBC KwUb 5.100 t20msxs_ub_b5p1 0.00 5.100 FORMAT "%5.3" /end CHARACTERISTIC
/begin CHARACTERISTIC TFGRUNUB "Toleranzzeit für Unterschreiten der unteren Beschl.schwelle im FGR-Betrieb" VALUE 0x810DBD KwUb 5.100 t20msxs_ub_b5p1 0.00 5.100 FORMAT "%5.3" /end CHARACTERISTIC
/begin CHARACTERISTIC TFUHPOTI "Entprellzeit nach Klemme15_ein" VALUE 0x81A95B KwUb 25.50 t100msxs_ub_b25p5 0.00 25.50 FORMAT "%5.2" /end CHARACTERISTIC
/begin CHARACTERISTIC TFWDKPN "Zeitkonstante für Filterung der DK-Winkel vor Vergl. mit Ersatzwert aus Füllung" CURVE 0x810CA3 KlAUbSstUbWUb 2.54000 zk10msxs_ub_b2p55 0.0100000 2.55000 FORMAT "%7.5"
 /begin AXIS_DESCR STD_AXIS nmot nmot_ub_q40 6 0.00 10200. FORMAT "%5.0" DEPOSIT ABSOLUTE /end AXIS_DESCR
/end CHARACTERISTIC
/begin CHARACTERISTIC TFWDKSOF "Zeit für Soll-Drosselklappenfilterung" VALUE 0x810EBA KwUb 2.54000 zk10msxs_ub_b2p55 0.0100000 2.55000 FORMAT "%7.5" /end CHARACTERISTIC
/begin CHARACTERISTIC TGRACMX "Überwachungszähler für obere Grenze der Botschaftszählerdifferenz GRA" VALUE 0x810DC0 KwUb 255.0 DEZ 0.00 255.0 FORMAT "%5.1" /end CHARACTERISTIC
/begin CHARACTERISTIC TGRACNU "Überwachungszeit für untere Grenze der Botschaftszählerdifferenz GRA" VALUE 0x810DC1 KwUb 5.100 t20msxs_ub_b5p1 0.00 5.100 FORMAT "%5.3" /end CHARACTERISTIC
/begin CHARACTERISTIC THUHPOTI "Entprellzeit Fehlerheilung" VALUE 0x81A95C KwUb 25.50 t100msxs_ub_b25p5 0.00 25.50 FORMAT "%5.2" /end CHARACTERISTIC
/begin CHARACTERISTIC TMH "Motortemperatur - Schwelle heiß" VALUE 0x8114FC KwUb 191.3 temp_ub_q0p75_o48 -48.00 143.3 FORMAT "%5.1" /end CHARACTERISTIC
/begin CHARACTERISTIC TMHSG "Motortemperatur Heißstartgrenze" VALUE 0x8114FD KwUb 191.3 temp_ub_q0p75_o48 -48.00 143.3 FORMAT "%5.1" /end CHARACTERISTIC
/begin CHARACTERISTIC TMK "Motortemperatur - Schwelle kalt" VALUE 0x8114FE KwUb 191.3 temp_ub_q0p75_o48 -48.00 143.3 FORMAT "%5.1" /end CHARACTERISTIC
/begin CHARACTERISTIC TMKIMN "Temperaturschwelle für Umschaltung auf Ersatzsignal" VALUE 0x8196F2 KwUb 191.3 temp_ub_q0p75_o48 -48.00 143.3 FORMAT "%5.1" /end CHARACTERISTIC
/begin CHARACTERISTIC TMNUUKA "Minimalzeit zwischen 2 Adaptionsvorgängen (ÜK-Adaption)" VALUE 0x811538 KwUb 1.850 t10msxs_ub_b2p55 0.7000 2.550 FORMAT "%5.3" /end CHARACTERISTIC
/begin CHARACTERISTIC TMODT "Schwelle Temperaturdifferenz Wassertemperatur für Heißstart" CURVE 0x8114FF KlAUbSstUbWUb 191.3 temp_ub_b191p25 0.00 191.3 FORMAT "%5.1"
 /begin AXIS_DESCR STD_AXIS tmotab temp_ub_q0p75_o48 3 -48.00 143.3 FORMAT "%5.1" DEPOSIT ABSOLUTE /end AXIS_DESCR
/end CHARACTERISTIC
/begin CHARACTERISTIC TMORSTE "Obere Temperaturschwelle resetieren B_stendes bei B_stend = false" VALUE 0x811506 KwUb 191.3 temp_ub_q0p75_o48 -48.00 143.3 FORMAT "%5.1" /end CHARACTERISTIC
/begin CHARACTERISTIC TMQSYN "Motortemperaturschwelle zur Freigabe PG-Schnellstart" VALUE 0x810B5A KwUb 191.3 temp_ub_q0p75_o48 -48.00 143.3 FORMAT "%5.1" /end CHARACTERISTIC
/begin CHARACTERISTIC TMSRCERR "Entprellzeit für irreversible ASR/MSR-Abschaltung bei Botschaftsfehler" VALUE 0x8101A1 KwUb 2.550 t10msxs_ub_b2p55 0.00 2.550 FORMAT "%5.3" /end CHARACTERISTIC
/begin CHARACTERISTIC TMSRCNU "Entprellzeit zur Berücksichtigung von Rasterversätzen im Botschaftszähler" VALUE 0x8101A2 KwUb 2.550 t10msxs_ub_b2p55 0.00 2.550 FORMAT "%5.3" /end CHARACTERISTIC
/begin CHARACTERISTIC TMUKAK "Temperaturbereich kalter Motor für ÜK-Adaption" VALUE 0x811539 KwUb 191.3 temp_ub_q0p75_o48 -48.00 143.3 FORMAT "%5.1" /end CHARACTERISTIC
/begin CHARACTERISTIC TMUKAU "untere Motortemperatur-Grenze für ÜK-Adaption" VALUE 0x81153A KwUb 191.3 temp_ub_q0p75_o48 -48.00 143.3 FORMAT "%5.1" /end CHARACTERISTIC
/begin CHARACTERISTIC TMUKAW "Temperaturbereich warmer Motor für ÜK-Adaption" VALUE 0x81153B KwUb 191.3 temp_ub_q0p75_o48 -48.00 143.3 FORMAT "%5.1" /end CHARACTERISTIC
/begin CHARACTERISTIC TMURSTE "Untere Temperaturschwelle resetieren B_stendes bei B_stend = false" VALUE 0x811507 KwUb 191.3 temp_ub_q0p75_o48 -48.00 143.3 FORMAT "%5.1" /end CHARACTERISTIC
/begin CHARACTERISTIC TN2FGRGA_0_A "Doppelte Nennerzeitkonstante für FGR-Regler" CURVE 0x81C92E KlAUwSstUwWUw 1310.660 t20msxs_uw_q0p02 0.02000000 1310.680 FORMAT "%8.3"
 /begin AXIS_DESCR STD_AXIS uevges_w fak_q0p1 8 0.00 6553.500 FORMAT "%8.3" DEPOSIT ABSOLUTE /end AXIS_DESCR
/end CHARACTERISTIC
/begin CHARACTERISTIC TN2FGRGA_1_A "Doppelte Nennerzeitkonstante für FGR-Regler" CURVE 0x81C950 KlAUwSstUwWUw 1310.660 t20msxs_uw_q0p02 0.02000000 1310.680 FORMAT "%8.3"
 /begin AXIS_DESCR STD_AXIS uevges_w fak_q0p1 8 0.00 6553.500 FORMAT "%8.3" DEPOSIT ABSOLUTE /end AXIS_DESCR
/end CHARACTERISTIC
/begin CHARACTERISTIC TNSUUK "Zeit UK-Unterdrückung im Nachstart" VALUE 0x81152E KwUb 25.50 t100msxs_ub_b25p5 0.00 25.50 FORMAT "%5.2" /end CHARACTERISTIC
/begin CHARACTERISTIC TNSUUKA "Verbotszeit ÜK-Adaption im Nachstart" VALUE 0x813FFC KwUw 655.3500 t10msxs_uw_b655p35 0.00 655.3500 FORMAT "%8.4" /end CHARACTERISTIC
/begin CHARACTERISTIC TOOTAUS "Zeit für Nicht-Betätigung ON/OFF-Taster GRA zur erneuten Freigabe" VALUE 0x8186FF KwUb 5.100 t20msxs_ub_b5p1 0.00 5.100 FORMAT "%5.3" /end CHARACTERISTIC
/begin CHARACTERISTIC TOOTEIN "Zeit für Hauptschalter ein bei ON/OFF-Taster GRA" VALUE 0x818700 KwUb 5.100 t20msxs_ub_b5p1 0.00 5.100 FORMAT "%5.3" /end CHARACTERISTIC
/begin CHARACTERISTIC TOOTULB "Zeit für Erkennung unplausibel lange Betätigung ON/OFF-Taster GRA" VALUE 0x81C578 KwUw 1310.700 t20msxs_uw_b1310 0.00 1310.700 FORMAT "%8.3" /end CHARACTERISTIC
/begin CHARACTERISTIC TPREL "Zahnentprellzeit in der Initialisierung" VALUE 0x810B5B KwUb 0.1000 t10msxs_ub_b2p55 0.00 0.1000 /end CHARACTERISTIC
/begin CHARACTERISTIC TPUKUKA "Entprellzeit für Erkennung ÜK-Eingriff (ÜK-Adaption)" VALUE 0x81153C KwUb 2.550 t10msxs_ub_b2p55 0.00 2.550 FORMAT "%5.3" /end CHARACTERISTIC
/begin CHARACTERISTIC TSPUUKA "Sperrzeit fuer Freigabe UK-Adaption" VALUE 0x81153D KwUb 24.50 t100msxs_ub_b25p5 1.000 25.50 FORMAT "%5.2" /end CHARACTERISTIC
/begin CHARACTERISTIC TSWKNBGA_0_A "Zeit bis Setzwertkorrektur nach Ende Beschleunigen" CURVE 0x8187DD KlAUbSstUbWUb 5.100 t20msxs_ub_q0p02 0.00 5.100 FORMAT "%5.3"
 /begin AXIS_DESCR STD_AXIS uevges fak_q0p1 8 0.00 25.50 FORMAT "%5.2" DEPOSIT ABSOLUTE /end AXIS_DESCR
/end CHARACTERISTIC
/begin CHARACTERISTIC TSWKNBGA_1_A "Zeit bis Setzwertkorrektur nach Ende Beschleunigen" CURVE 0x8187EE KlAUbSstUbWUb 5.100 t20msxs_ub_q0p02 0.00 5.100 FORMAT "%5.3"
 /begin AXIS_DESCR STD_AXIS uevges fak_q0p1 8 0.00 25.50 FORMAT "%5.2" DEPOSIT ABSOLUTE /end AXIS_DESCR
/end CHARACTERISTIC
/begin CHARACTERISTIC TSWKNVGA_0_A "Zeit bis Setzwertkorrektur nach Ende Verzögern" CURVE 0x8187FF KlAUbSstUbWUb 5.100 t20msxs_ub_q0p02 0.00 5.100 FORMAT "%5.3"
 /begin AXIS_DESCR STD_AXIS uevges fak_q0p1 8 0.00 25.50 FORMAT "%5.2" DEPOSIT ABSOLUTE /end AXIS_DESCR
/end CHARACTERISTIC
/begin CHARACTERISTIC TSWKNVGA_1_A "Zeit bis Setzwertkorrektur nach Ende Verzögern" CURVE 0x818810 KlAUbSstUbWUb 5.100 t20msxs_ub_q0p02 0.00 5.100 FORMAT "%5.3"
 /begin AXIS_DESCR STD_AXIS uevges fak_q0p1 8 0.00 25.50 FORMAT "%5.2" DEPOSIT ABSOLUTE /end AXIS_DESCR
/end CHARACTERISTIC
/begin CHARACTERISTIC TVAG "Zeit für Gewichtungsfaktor VA aktiv" VALUE 0x81945D KwUb 25.50 t100msxs_ub_b25p5 0.00 25.50 FORMAT "%5.2" /end CHARACTERISTIC
/begin CHARACTERISTIC TVCAMSR "Entprellzeit nach Start Startende bei ASR/MSR-Timeoutfehler" VALUE 0x81370A KwUw 655.3500 t10msxs_uw_b655p35 0.00 655.3500 FORMAT "%8.4" /end CHARACTERISTIC
/begin CHARACTERISTIC TVERBR "Verzögerungszeit für Bremsschalter-Plausibilitätsprüfung" VALUE 0x81871D KwUb 25.50 t100msxs_ub_b25p5 0.00 25.50 FORMAT "%5.2" /end CHARACTERISTIC
/begin CHARACTERISTIC TVFRG "Verzögerundszeit nach Satrtende bis zur Freigabe des Füllungsreglers" VALUE 0x810EB7 KwUb 12.75 t50msxs_ub_b12p75 0.00 12.75 FORMAT "%5.2" /end CHARACTERISTIC
/begin CHARACTERISTIC TVKUP "Verzögerungszeit für B_kupplv" VALUE 0x810DA0 KwUb 5.100 t20msxs_ub_b5p1 0.00 5.100 FORMAT "%5.3" /end CHARACTERISTIC
/begin CHARACTERISTIC TVKUPV "Verzögerungszeit für Rücksetzen von B_kupplv" VALUE 0x813B7C KwUw 1310.700 t20msxs_uw_q0p02 0.00 1310.700 FORMAT "%8.3" /end CHARACTERISTIC
/begin CHARACTERISTIC TVLADV_0_A "Zeitkonstante für Integrator bei vlast-Berechnung" CURVE 0x81C972 KlAUwSstSwWUw 1310.6999997 zk20msxs_uw_b1310 0.020000305180 1310.7200000 FORMAT "%12.7"
 /begin AXIS_DESCR STD_AXIS dvzvi_w vfzg_sw_q0p00781 8 -256.0000 255.9922 FORMAT "%8.4" DEPOSIT ABSOLUTE /end AXIS_DESCR
/end CHARACTERISTIC
/begin CHARACTERISTIC TVLADV_1_A "Zeitkonstante für Integrator bei vlast-Berechnung" CURVE 0x81C994 KlAUwSstSwWUw 1310.6999997 zk20msxs_uw_b1310 0.020000305180 1310.7200000 FORMAT "%12.7"
 /begin AXIS_DESCR STD_AXIS dvzvi_w vfzg_sw_q0p00781 8 -256.0000 255.9922 FORMAT "%8.4" DEPOSIT ABSOLUTE /end AXIS_DESCR
/end CHARACTERISTIC
/begin CHARACTERISTIC TVPDKP1 "Fehlertoleranzzeit bei Bereichsprüfung DK-Poti 1" VALUE 0x810CB0 KwUb 2.540 t10msxs_ub_b2p55 0.01000 2.550 FORMAT "%5.3" /end CHARACTERISTIC
/begin CHARACTERISTIC TVPDKP2 "Fehlertoleranzzeit bei Bereichsprüfung DK-Poti 2" VALUE 0x810CB1 KwUb 2.540 t10msxs_ub_b2p55 0.01000 2.550 FORMAT "%5.3" /end CHARACTERISTIC
/begin CHARACTERISTIC TVPWDK12 "Fehlertoleranzzeit bei Gleichlaufprüfung der DK-Potis" VALUE 0x810CB2 KwUb 2.540 t10msxs_ub_b2p55 0.01000 2.550 FORMAT "%5.3" /end CHARACTERISTIC
/begin CHARACTERISTIC TVPWDK13 "Fehlertoleranzzeit bei Gleichlaufprüfung DK-Poti 1 und Ersatzwert aus Füllung" VALUE 0x810CB3 KwUb 2.540 t10msxs_ub_b2p55 0.01000 2.550 FORMAT "%5.3" /end CHARACTERISTIC
/begin CHARACTERISTIC TVPWDK23 "Fehlertoleranzzeit bei Gleichlaufprüfung DK-Poti 2 und Ersatzwert aus Füllung" VALUE 0x810CB4 KwUb 2.540 t10msxs_ub_b2p55 0.01000 2.550 FORMAT "%5.3" /end CHARACTERISTIC
/begin CHARACTERISTIC TVPWMCSR "Entprellzeit Fehler zurücksetzen" VALUE 0x81AD32 KwUb 6.350 t50msxs_ub_b12p75 0.00 6.350 FORMAT "%5.3" /end CHARACTERISTIC
/begin CHARACTERISTIC TVPWMCSS "Entprellzeit Fehler setzen" VALUE 0x81AD33 KwUb 6.350 t50msxs_ub_b12p75 0.00 6.350 FORMAT "%5.3" /end CHARACTERISTIC
/begin CHARACTERISTIC TVTMKIC "Entprellzeit für tmkic-Fehler" VALUE 0x81DF90 KwUw 6553.400 t100msxs_uw_b6553p5 0.1000000 6553.500 FORMAT "%8.3" /end CHARACTERISTIC
/begin CHARACTERISTIC TVTMKIE "Entprellzeit für Umschaltung auf Ersatzwert bei tmkic-Fehler" VALUE 0x81DF92 KwUw 6553.400 t100msxs_uw_b6553p5 0.1000000 6553.500 FORMAT "%8.3" /end CHARACTERISTIC
/begin CHARACTERISTIC TVTOLC "Verzögerungszeit für das Eintragen eines Fehlers beim Öltemperatursignal über CA" VALUE 0x81BB62 KwUw 65535.00 t1sxs_uw_b65535 0.00 65535.00 FORMAT "%8.2" /end CHARACTERISTIC
/begin CHARACTERISTIC TVTUMC "Verzögerungszeit für das Setzen eines Fehlers für das CAN-Signal tumc" VALUE 0x81BB64 KwUw 65535.00 t1sxs_uw_b65535 0.00 65535.00 FORMAT "%8.2" /end CHARACTERISTIC
/begin CHARACTERISTIC TVUBATS "Ausschaltverzögerung für Ubatt-Betriebsbereitschaft Abgastemperatursensor" VALUE 0x81962C KwUb 25.50 t100msxs_ub_b25p5 0.00 25.50 FORMAT "%5.2" /end CHARACTERISTIC
/begin CHARACTERISTIC TVWDKS "Verzögerungszeit für Drosselklappen-Sollwinkel" VALUE 0x810ECA KwUb 2.550 t10msxs_ub_b2p55 0.00 2.550 FORMAT "%5.3" /end CHARACTERISTIC
/begin CHARACTERISTIC TWDKSV "Zeitkonstante für Drosselklappensollwinkelfilterung" CURVE 0x813E78 KlAUwSstUwWUw 655.34999985 zk10msxs_uw_b655 0.010000152590 655.36000000 FORMAT "%12.8"
 /begin AXIS_DESCR STD_AXIS pspvmin_w fak_uw_b2 6 0.00 1.999969 FORMAT "%8.6" DEPOSIT ABSOLUTE /end AXIS_DESCR
/end CHARACTERISTIC
/begin CHARACTERISTIC TWNSTA "Wartezeit nach Motorstart" VALUE 0x81C574 KwUw 655.3500 t10msxs_uw_b655p35 0.00 655.3500 FORMAT "%8.4" /end CHARACTERISTIC
/begin CHARACTERISTIC TWNTAL "Wartezeit bis Nicht-Tankleer-Signal gültig ist" VALUE 0x81C576 KwUw 13107.00 t200msxs_uw_q0p2 0.00 13107.00 FORMAT "%8.2" /end CHARACTERISTIC
/begin CHARACTERISTIC TWSTT "Schwelle Abstellzeit für Wiederholstart" CURVE 0x8158EC KlAUwSstUwWUw 65535.00 t1sxs_uw_q1 0.00 65535.00 FORMAT "%8.2"
 /begin AXIS_DESCR STD_AXIS tmotab temp_ub_q0p75_o48 12 -48.00000 49103.25 FORMAT "%8.2" DEPOSIT ABSOLUTE /end AXIS_DESCR
/end CHARACTERISTIC
/begin CHARACTERISTIC TZ2FGRGA_0_A "Doppelte Zählerzeitkonstante für FGR-Regler" CURVE 0x81C9B6 KlAUwSstUwWUw 1310.660 t20msxs_uw_q0p02 0.02000000 1310.680 FORMAT "%8.3"
 /begin AXIS_DESCR STD_AXIS uevges_w fak_q0p1 8 0.00 6553.500 FORMAT "%8.3" DEPOSIT ABSOLUTE /end AXIS_DESCR
/end CHARACTERISTIC
/begin CHARACTERISTIC TZ2FGRGA_1_A "Doppelte Zählerzeitkonstante für FGR-Regler" CURVE 0x81C9D8 KlAUwSstUwWUw 1310.660 t20msxs_uw_q0p02 0.02000000 1310.680 FORMAT "%8.3"
 /begin AXIS_DESCR STD_AXIS uevges_w fak_q0p1 8 0.00 6553.500 FORMAT "%8.3" DEPOSIT ABSOLUTE /end AXIS_DESCR
/end CHARACTERISTIC
/begin CHARACTERISTIC T_ASRFGR "Zeit für GRA-Abwurf bei ASR-Eingriff" VALUE 0x8101A3 KwUb 2.550 t10msxs_ub_b2p55 0.00 2.550 FORMAT "%5.3" /end CHARACTERISTIC
/begin CHARACTERISTIC T_NOMASR "Filterzeit bis Erkennung der Kommunikationsunterbrechung zu Knoten ASR" VALUE 0x8101A4 KwUb 2.550 t10msxs_ub_b2p55 0.00 2.550 FORMAT "%5.3" /end CHARACTERISTIC
/begin CHARACTERISTIC T_NOMASRTA "DCAN Timeoutzeit ASR Botschaft" VALUE 0x8101A5 KwUb 25.50 t100msxs_ub_b25p5 0.00 25.50 FORMAT "%5.2" /end CHARACTERISTIC
/begin CHARACTERISTIC T_NOMBR3 "CAN : Timeoutzeit für Botschaft Bremse 3" VALUE 0x8101A6 KwUb 2.550 t10msxs_ub_b2p55 0.00 2.550 FORMAT "%5.3" /end CHARACTERISTIC
/begin CHARACTERISTIC T_NOMGRA "Fehlerzeit GRA-Botschaft" VALUE 0x810DC2 KwUb 5.100 t20msxs_ub_b5p1 0.00 5.100 FORMAT "%5.3" /end CHARACTERISTIC
/begin CHARACTERISTIC T_NOMGRAD "Entprellzeit für Botschaftsausfall bei Ub <10,8V" VALUE 0x810DC3 KwUb 5.100 t20msxs_ub_b5p1 0.00 5.100 FORMAT "%5.3" /end CHARACTERISTIC
/begin CHARACTERISTIC T_NOMGRATA "Timeoutzeit GRA-Botschaft" VALUE 0x810DC4 KwUb 5.100 t20msxs_ub_b5p1 0.00 5.100 FORMAT "%5.3" /end CHARACTERISTIC
/begin CHARACTERISTIC UADPLMN "min. Spannungswert für Diagnose Drucksensor Ladedruck" VALUE 0x818856 KwUb 4.980 spg_ub_b5 0.00 4.980 FORMAT "%5.3" /end CHARACTERISTIC
/begin CHARACTERISTIC UADPLMX "max. Spannungswert für Diagnose Drucksensor Ladedruck" VALUE 0x818857 KwUb 4.980 spg_ub_b5 0.00 4.980 FORMAT "%5.3" /end CHARACTERISTIC
/begin CHARACTERISTIC UADPUMN "min. Spannungswert für Diagnose Drucksensor" VALUE 0x818858 KwUb 4.9805 spg_ub_q0p019 0.00 4.9805 /end CHARACTERISTIC
/begin CHARACTERISTIC UADPUMX "max. Spannungswert für Diagnose Drucksensor" VALUE 0x818859 KwUb 4.9805 spg_ub_q0p019 0.00 4.9805 /end CHARACTERISTIC
/begin CHARACTERISTIC UBATSMN "Mindestbatteriespannung für Abgastemperatursensor" VALUE 0x81962D KwUb 17.95 spg_ubatt 0.00 17.95 FORMAT "%5.2" /end CHARACTERISTIC
/begin CHARACTERISTIC UBVDKPO "Batteriespannungsschwelle für Umschaltung auf verstärktes Signal von DK-Poti 1" VALUE 0x810CB5 KwUb 17.95 spg_ubatt 0.00 17.95 FORMAT "%5.2" /end CHARACTERISTIC
/begin CHARACTERISTIC UBVDKPU "Batteriespannungsschwelle für Umschaltung auf unverstärktes Signal von DK-Poti 1" VALUE 0x810CB6 KwUb 17.95 spg_ubatt 0.00 17.95 FORMAT "%5.2" /end CHARACTERISTIC
/begin CHARACTERISTIC UDKP1O "Maximale zulässige Spannung von DK-Poti 1" VALUE 0x810CB7 KwUb 4.980 spg_ub_b5 0.00 4.980 FORMAT "%5.3" /end CHARACTERISTIC
/begin CHARACTERISTIC UDKP1U "Minimale zulässige Spannung von DK-Poti 1" VALUE 0x810CB8 KwUb 4.980 spg_ub_b5 0.00 4.980 FORMAT "%5.3" /end CHARACTERISTIC
/begin CHARACTERISTIC UDKP2O "Maximale zulässige Spannung von DK-Poti 2" VALUE 0x810CB9 KwUb 4.980 spg_ub_b5 0.00 4.980 FORMAT "%5.3" /end CHARACTERISTIC
/begin CHARACTERISTIC UDKP2U "Minimale zulässige Spannung von DK-Poti 2" VALUE 0x810CBA KwUb 4.980 spg_ub_b5 0.00 4.980 FORMAT "%5.3" /end CHARACTERISTIC
/begin CHARACTERISTIC UKAFRTMO "Obere Schwelle Faktor Lambdaregler (fr) zur Freigabe der UK-Adaption" CURVE 0x81DDCA GklWUw 1.999969 fak_uw_b2 0.00 1.999969 FORMAT "%8.6"
 /begin AXIS_DESCR COM_AXIS tmot temp_ub_q0p75_o48 9 -48.00 143.3 AXIS_PTS_REF STM09ESUB /end AXIS_DESCR
/end CHARACTERISTIC
/begin CHARACTERISTIC UKAFRTMU "Untere Schwelle Faktor Lambdaregler (fr) zur Freigabe der UK-Adaption" CURVE 0x81DDDC GklWUw 1.999969 fak_uw_b2 0.00 1.999969 FORMAT "%8.6"
 /begin AXIS_DESCR COM_AXIS tmot temp_ub_q0p75_o48 9 -48.00 143.3 AXIS_PTS_REF STM09ESUB /end AXIS_DESCR
/end CHARACTERISTIC
/begin CHARACTERISTIC UPOTHI "Tastverhältnis Heizleistung=1" VALUE 0x81A95D KwUb 4.980 spg_ub_b5 0.00 4.980 FORMAT "%5.3" /end CHARACTERISTIC
/begin CHARACTERISTIC UPOTLO "Tastverhältnis Heizleistung=0" VALUE 0x81A95E KwUb 4.980 spg_ub_b5 0.00 4.980 FORMAT "%5.3" /end CHARACTERISTIC
/begin CHARACTERISTIC UPWMCS "Ubatt-Schwelle für Diagnose Crash-Signal" VALUE 0x81AD34 KwUb 17.95 spg_ubatt 0.00 17.95 FORMAT "%5.2" /end CHARACTERISTIC
/begin CHARACTERISTIC UPWMHI "Obere Spannungsquelle" VALUE 0x81A95F KwUb 4.980 spg_ub_b5 0.00 4.980 FORMAT "%5.3" /end CHARACTERISTIC
/begin CHARACTERISTIC UPWMLO "Untere Spannungsquelle" VALUE 0x81A960 KwUb 4.980 spg_ub_b5 0.00 4.980 FORMAT "%5.3" /end CHARACTERISTIC
/begin CHARACTERISTIC VFGREMAX "Maximale FGR-Einschaltgeschwindigkeit" VALUE 0x81C59A KwUw 511.9922 vfzg_uw_q0p0078125 0.00 511.9922 FORMAT "%8.4" /end CHARACTERISTIC
/begin CHARACTERISTIC VFGREMIN "Minimale FGR-Einschaltgeschwindigkeit" VALUE 0x81C59C KwUw 511.9922 vfzg_uw_q0p0078125 0.00 511.9922 FORMAT "%8.4" /end CHARACTERISTIC
/begin CHARACTERISTIC VFGRMAX "Maximal zulässige Geschwindigkeit im FGR-Betrieb" VALUE 0x81C59E KwUw 511.9922 vfzg_uw_q0p0078125 0.00 511.9922 FORMAT "%8.4" /end CHARACTERISTIC
/begin CHARACTERISTIC VFGRMIN "Minimal zulässige Geschwindigkeit im FGR-Betrieb" VALUE 0x81C5A0 KwUw 511.9922 vfzg_uw_q0p0078125 0.00 511.9922 FORMAT "%8.4" /end CHARACTERISTIC
/begin CHARACTERISTIC VLMXVZ_0_A "Maximalwert für vlast_w" CURVE 0x81C9FA KlAUwSstUwWUw 511.9922 vfzg_uw_q0p0078125 0.00 511.9922 FORMAT "%8.4"
 /begin AXIS_DESCR STD_AXIS vziel_w vfzg_uw_q0p0078125 6 0.00 511.9922 FORMAT "%8.4" DEPOSIT ABSOLUTE /end AXIS_DESCR
/end CHARACTERISTIC
/begin CHARACTERISTIC VLMXVZ_1_A "Maximalwert für vlast_w" CURVE 0x81CA14 KlAUwSstUwWUw 511.9922 vfzg_uw_q0p0078125 0.00 511.9922 FORMAT "%8.4"
 /begin AXIS_DESCR STD_AXIS vziel_w vfzg_uw_q0p0078125 6 0.00 511.9922 FORMAT "%8.4" DEPOSIT ABSOLUTE /end AXIS_DESCR
/end CHARACTERISTIC
/begin CHARACTERISTIC VMINAMSR "Geschwindigkeitsschwelle für plausiblen MSR-Eingriff" VALUE 0x81370C KwUw 324.9950 vfzg_uw_b325 0.00 324.9950 FORMAT "%8.4" /end CHARACTERISTIC
/begin CHARACTERISTIC VPSSPLSWDK "Druckverhältnis zur Freigabe der DK-Überwegs bei DK-Winkel > DK-Winkel ung.-Schw" VALUE 0x813E92 KwUw 1.999969 fak_uw_b2 0.00 1.999969 FORMAT "%8.6" /end CHARACTERISTIC
/begin CHARACTERISTIC VREGLMAX "Maximal zulässige Sollgeschwindigkeit für FGR" VALUE 0x81C768 KwUw 511.9922 vfzg_uw_q0p0078125 0.00 511.9922 FORMAT "%8.4" /end CHARACTERISTIC
/begin CHARACTERISTIC VREGLMIN "Minimal zulässige Sollgeschwindigkeit für FGR" VALUE 0x81C76A KwUw 511.9922 vfzg_uw_q0p0078125 0.00 511.9922 FORMAT "%8.4" /end CHARACTERISTIC
/begin CHARACTERISTIC WDKDSVLU "Drosselklappenschwelle für Drucksensorplausibilisierung" CURVE 0x81885A KlAUbSstUbWUb 100.0 relDK_ub_b100 0.00 100.0 FORMAT "%5.1"
 /begin AXIS_DESCR STD_AXIS nmot nmot_ub_q40 6 0.00 10200. FORMAT "%5.0" DEPOSIT ABSOLUTE /end AXIS_DESCR
/end CHARACTERISTIC
/begin CHARACTERISTIC WDKPMXN "Maximaler Drosselklappenwinkel für Plausibilisierung mit Füllungssignal" CURVE 0x810CBB KlAUbSstUbWUb 100.0 relDK_ub_b100 0.00 100.0 FORMAT "%5.1"
 /begin AXIS_DESCR STD_AXIS nmot nmot_ub_q40 12 0.00 10200. FORMAT "%5.0" DEPOSIT ABSOLUTE /end AXIS_DESCR
/end CHARACTERISTIC
/begin CHARACTERISTIC WDKSAPP "Drosselklappensollwert für Applikationszwecke" VALUE 0x813E94 KwUw 99.99847 rel_uw_b100 0.00 99.99847 FORMAT "%8.5" /end CHARACTERISTIC
/begin CHARACTERISTIC WDKSHYS "Drosselklappen-Hystereseschwelle für Aktivierung/Deaktivierung Überweg" VALUE 0x813E96 KwUw 99.99847 rel_uw_b100 0.00 99.99847 FORMAT "%8.5" /end CHARACTERISTIC
/begin CHARACTERISTIC WDKSOFS "Offset zu appl. DK-Sollwinkel bei niedrigen Temperaturen" VALUE 0x813E98 KwUw 99.99847 rel_uw_b100 0.00 99.99847 FORMAT "%8.5" /end CHARACTERISTIC
/begin CHARACTERISTIC WEAN "Winkel Einspritzabbruch" CURVE 0x818F54 GklWUb 1530. zw_ub_q6 0.00 1530. FORMAT "%5.0"
 /begin AXIS_DESCR COM_AXIS nmot nmot_ub_q40 8 0.00 10200. AXIS_PTS_REF SNM08GKUB /end AXIS_DESCR
/end CHARACTERISTIC
/begin CHARACTERISTIC WEEMRFAN "Winkel Einspritzende bei maximalem Fahrerwunsch" CURVE 0x818F5C GklWUb 1530. zw_ub_q6 0.00 1530. FORMAT "%5.0"
 /begin AXIS_DESCR COM_AXIS nmot nmot_ub_q40 8 0.00 10200. AXIS_PTS_REF SNM08GKUB /end AXIS_DESCR
/end CHARACTERISTIC
/begin CHARACTERISTIC WEESTN_0_A "Winkel Einspritzende im Start" CURVE 0x811092 KlAUbSstUbWUb 1530. zw_ub_q6 0.00 1530. FORMAT "%5.0"
 /begin AXIS_DESCR STD_AXIS nmot nmot_ub_q40 4 0.00 10200. FORMAT "%5.0" DEPOSIT ABSOLUTE /end AXIS_DESCR
/end CHARACTERISTIC
/begin CHARACTERISTIC WEESTN_1_A "Winkel Einspritzende im Start" CURVE 0x81109B KlAUbSstUbWUb 1530. zw_ub_q6 0.00 1530. FORMAT "%5.0"
 /begin AXIS_DESCR STD_AXIS nmot nmot_ub_q40 4 0.00 10200. FORMAT "%5.0" DEPOSIT ABSOLUTE /end AXIS_DESCR
/end CHARACTERISTIC
/begin CHARACTERISTIC WFRL "Kraftstoffwandfilmkennlinie" CURVE 0x815AC8 FklWUw 6143.906 rel_uw_b6144 0.00 6143.906 FORMAT "%8.3"
 /begin AXIS_DESCR FIX_AXIS rlp_w rel_uw_q0p0234 31 0.00 185.9766 FORMAT "%8.4" FIX_AXIS_PAR 0 8 31 /end AXIS_DESCR
/end CHARACTERISTIC
/begin CHARACTERISTIC WKVGDSLL "Drosselklappenschwelle für DSU/DSL Plausibilitätscheck nach Start" VALUE 0x818867 KwUb 100.0 relDK_ub_b100 0.00 100.0 FORMAT "%5.1" /end CHARACTERISTIC
/begin CHARACTERISTIC ZBAKM "Abregelfaktor K-Speicher (tmot) BA" CURVE 0x81945E GklWUb 0.9961 fak_q0p0039 0.00 0.9961
 /begin AXIS_DESCR COM_AXIS tmot temp_ub_q0p75_o48 9 -48.00 143.3 AXIS_PTS_REF STM09ESUB /end AXIS_DESCR
/end CHARACTERISTIC
/begin CHARACTERISTIC ZBALM "Abregelfaktor L-Speicher (tmot) BA" CURVE 0x819467 GklWUb 0.1245 fak_ub_b0p125 0.00 0.1245 FORMAT "%6.4"
 /begin AXIS_DESCR COM_AXIS tmot temp_ub_q0p75_o48 9 -48.00 143.3 AXIS_PTS_REF STM09ESUB /end AXIS_DESCR
/end CHARACTERISTIC
/begin CHARACTERISTIC ZBURNLIM "Schwelle erkannte Verbrennungen für Wiederholstart" VALUE 0x811508 KwUb 255.0 dez 0.00 255.0 FORMAT "%5.1" /end CHARACTERISTIC
/begin CHARACTERISTIC ZDELBMSRCH "Zusätzlicher Zahnoffset beim Warten auf BM im Schnellstart" VALUE 0x810B5C KwUb 6.000 dez 0.00 6.000 FORMAT "%5.3" /end CHARACTERISTIC
/begin CHARACTERISTIC ZDSU "Zeitkonstante für Filterung von pu und fho in GGDSU" VALUE 0x818868 KwUb 25.4996 zk100msxs_ub_b25p5 0.100392 25.6000 FORMAT "%7.4" /end CHARACTERISTIC
/begin CHARACTERISTIC ZERBR "Fehlerzähler für Bremsschalter-Unplausibilitäten" VALUE 0x81871E KwUb 255.0 dez 0.00 255.0 FORMAT "%5.1" /end CHARACTERISTIC
/begin CHARACTERISTIC ZKPSFIL "Zeitkonstante für Filterung von Saugrohrdruck für KLAF-Berechnung in FUEDK" VALUE 0x813E9A KwUw 655.34999985 zk10msxs_uw_b655 0.010000152590 655.36000000 FORMAT "%12.8" /end CHARACTERISTIC
/begin CHARACTERISTIC ZPPWMX "Reset-Schwelle für Fehleraktualisierung aus Periodencheck" VALUE 0x81A961 KwUb 255.0 dez 0.00 255.0 FORMAT "%5.1" /end CHARACTERISTIC
/begin CHARACTERISTIC ZPVDKR "Zeitkonstante für pvdkr-Filterung" CURVE 0x813E9C KlAUwSstUwWUw 655.34999985 zk10msxs_uw_b655 0.010000152590 655.36000000 FORMAT "%12.8"
 /begin AXIS_DESCR STD_AXIS vpsspu_w fak_uw_b4 6 0.00 3.999939 FORMAT "%8.6" DEPOSIT ABSOLUTE /end AXIS_DESCR
/end CHARACTERISTIC
/begin CHARACTERISTIC ZPWMCS "Anzahl Crash-Impulse bis Crash erkannt" VALUE 0x81AD35 KwUb 255.0 DEZ 0.00 255.0 FORMAT "%5.1" /end CHARACTERISTIC
/begin CHARACTERISTIC ZPWMCSMAX "Entprellzähler für Diagnose Crash-Signal" VALUE 0x81AD36 KwUb 255.0 DEZ 0.00 255.0 FORMAT "%5.1" /end CHARACTERISTIC
/begin CHARACTERISTIC ZPWMDMN "Plaus.-Schwelle-Min für Dekodierung" VALUE 0x81A962 KwUb 255.0 dez 0.00 255.0 FORMAT "%5.1" /end CHARACTERISTIC
/begin CHARACTERISTIC ZPWMDMX "Plaus.-Schwelle-Max für Dekodierung" VALUE 0x81A963 KwUb 255.0 dez 0.00 255.0 FORMAT "%5.1" /end CHARACTERISTIC
/begin CHARACTERISTIC ZPWMPMN "Plaus.-Schwelle-Min für Periodenmessung" VALUE 0x81A964 KwUb 255.0 dez 0.00 255.0 FORMAT "%5.1" /end CHARACTERISTIC
/begin CHARACTERISTIC ZPWMPMX "Plaus.-Schwelle-Max für Periodenmessung" VALUE 0x81A965 KwUb 255.0 dez 0.00 255.0 FORMAT "%5.1" /end CHARACTERISTIC
/begin CHARACTERISTIC ZTPREL "Anzahl Zähne während der Starterkennung" VALUE 0x810B5D KwUb 255.0 dez 0.00 255.0 FORMAT "%5.1" /end CHARACTERISTIC
/begin CHARACTERISTIC ZUKE "Zeitkonstante ÜK-Ersatzwert" VALUE 0x815B06 KwUw 655.34999985 zk10msxs_uw_b655 0.010000152590 655.36000000 FORMAT "%12.8" /end CHARACTERISTIC
/begin CHARACTERISTIC ZUKNST "Abregelzeitkonstante ÜK-Faktor im Nachstart" VALUE 0x815B08 KwUw 6553.4999985 zk100msxs_uw_b6553 0.10000152590 6553.6000000 FORMAT "%12.7" /end CHARACTERISTIC
/begin CHARACTERISTIC ZVAKM "Abregelfaktor K-Speicher (tmot) VA" CURVE 0x819470 GklWUb 0.9961 fak_q0p0039 0.00 0.9961
 /begin AXIS_DESCR COM_AXIS tmot temp_ub_q0p75_o48 9 -48.00 143.3 AXIS_PTS_REF STM09ESUB /end AXIS_DESCR
/end CHARACTERISTIC
/begin CHARACTERISTIC ZVALM "Abregelfaktor L-Speicher (tmot) VA" CURVE 0x819479 GklWUb 0.1245 fak_ub_b0p125 0.00 0.1245 FORMAT "%6.4"
 /begin AXIS_DESCR COM_AXIS tmot temp_ub_q0p75_o48 9 -48.00 143.3 AXIS_PTS_REF STM09ESUB /end AXIS_DESCR
/end CHARACTERISTIC
/begin CHARACTERISTIC ZZWEETM "Umschaltschwelle Vorlagerungswinkel" CURVE 0x81D9F0 KlAUwSstUwWUw 65535.00 dez 0.00 65535.00 FORMAT "%8.2"
 /begin AXIS_DESCR STD_AXIS tmst temp_ub_q0p75_o48 8 -48.00000 49103.25 FORMAT "%8.2" DEPOSIT ABSOLUTE /end AXIS_DESCR
/end CHARACTERISTIC
/begin MEASUREMENT abak "Aufteilungsfaktor Wandfilm bei BA" UBYTE fak_ub_b1 1 100 0 0.996094 ECU_ADDRESS 0x38488E /end MEASUREMENT
/begin MEASUREMENT anzfkuka "Anzahl berechnete Korrekturfaktoren während ÜK-Eingriff (ÜK-Adaption)" UBYTE dez 1 100 0 255 FORMAT "%5.1" ECU_ADDRESS 0x380A0C /end MEASUREMENT
/begin MEASUREMENT anzhfma_w "Anzahl der HFM-Abtastungen über ein Synchro" UWORD dez 1 100 0 65535 FORMAT "%8.2" ECU_ADDRESS 0xF99E /end MEASUREMENT
/begin MEASUREMENT anztip "Anzahl der hintereinander erfolgten Tip-Ups oder Tip-Downs" UBYTE dez 1 100 0 255 FORMAT "%5.1" ECU_ADDRESS 0x3809BC /end MEASUREMENT
/begin MEASUREMENT anztis "Anzahl vom CIFI initialisierter ti's (Synchro-Abtastung)" UBYTE dez 1 100 0 255 FORMAT "%5.1" ECU_ADDRESS 0x380A04 /end MEASUREMENT
/begin MEASUREMENT anzudsl_w "Anzahl Abtastungen Drucksensor Ladedruck über einem Segment(word)" UWORD dez 1 100 0 65535 FORMAT "%8.2" ECU_ADDRESS 0xF9BE /end MEASUREMENT
/begin MEASUREMENT anzwefim "Anzahl der abgearbeiteten Wiedereinsetzfaktoren" UBYTE dez 1 100 0 255 FORMAT "%5.1" ECU_ADDRESS 0x380A00 /end MEASUREMENT
/begin MEASUREMENT avak "Aufteilungsfaktor Wandfilm bei VA" UBYTE fak_ub_b1 1 100 0 0.996094 ECU_ADDRESS 0x38488F /end MEASUREMENT
/begin MEASUREMENT azylwe "Anzahl wiedereingesetzter Zylinder" UBYTE dez 1 100 0 255 FORMAT "%5.1" ECU_ADDRESS 0x380A01 /end MEASUREMENT
/begin MEASUREMENT bfgrs_w "FGR-Sollbeschleunigung" UWORD bfzg_sw_q4p239Em4 1 100 0 27.7803 ECU_ADDRESS 0x381E68 /end MEASUREMENT
/begin MEASUREMENT bmLosCtr_w "Zähler (Word) Neusynchronisationen durch Lückenverlust" UWORD dez 1 100 0 65535 FORMAT "%8.2" ECU_ADDRESS 0x383C4E /end MEASUREMENT
/begin MEASUREMENT bmzzyl "Initialisierungswert Zylinderzähler nach erster Bezugsmarke" UBYTE dez 1 100 0 255 FORMAT "%5.1" ECU_ADDRESS 0x380929 /end MEASUREMENT
/begin MEASUREMENT brafgr_w "Rampenbeschleunigung FGR" UWORD bfzg_sw_q4p239Em4 1 100 0 27.7803 ECU_ADDRESS 0x381E6A /end MEASUREMENT
/begin MEASUREMENT bz_can "Botschaftszähler bei ASR/MSR" UBYTE DEZ 1 100 0 255 FORMAT "%5.1" ECU_ADDRESS 0x3808DB /end MEASUREMENT
/begin MEASUREMENT bz_gra "CAN-Botschaftszähler für GRA" UBYTE DEZ 1 100 0 255 FORMAT "%5.1" ECU_ADDRESS 0x3809C5 /end MEASUREMENT
/begin MEASUREMENT bz_msr "MSR-Botschaftszähler" UBYTE DEZ 1 100 0 255 FORMAT "%5.1" ECU_ADDRESS 0x3808DC /end MEASUREMENT
/begin MEASUREMENT B_absfgr "Bedingung ABS-Bremsung (als Abschaltbedingung für FGR)" UWORD B_TRUE 1 100 0 1 BIT_MASK 0x2 FORMAT "%13.11" ECU_ADDRESS 0xFD1E /end MEASUREMENT
/begin MEASUREMENT B_afgrbs "Bedingung Aktualisierung FGR-Bediensignale erforderlich" UBYTE B_TRUE 1 100 0 1 BIT_MASK 0x1 FORMAT "%13.11" ECU_ADDRESS 0x380970 /end MEASUREMENT
/begin MEASUREMENT B_afwe "Bedingung Anzahl der Wiedereinsetzfaktoren" UWORD B_TRUE 1 100 0 1 BIT_MASK 0x4000 FORMAT "%13.11" ECU_ADDRESS 0xFD5E /end MEASUREMENT
/begin MEASUREMENT B_airbag "Bedingung Airbag ausgelöst" UWORD B_TRUE 1 100 0 1 BIT_MASK 0x20 FORMAT "%13.11" ECU_ADDRESS 0xFDB2 /end MEASUREMENT
/begin MEASUREMENT B_airbz "Bedingung Botschaftszähler der Airbag-Botschaft unplausibel" UWORD B_TRUE 1 100 0 1 BIT_MASK 0x40 FORMAT "%13.11" ECU_ADDRESS 0xFDB2 /end MEASUREMENT
/begin MEASUREMENT B_airbz1 "Bedingung Botschaftszählerdifferenz größer Grenzwert" UWORD B_TRUE 1 100 0 1 BIT_MASK 0x80 FORMAT "%13.11" ECU_ADDRESS 0xFDB2 /end MEASUREMENT
/begin MEASUREMENT B_airbz2 "Bedingung Botschaftszählerdifferenz = 0" UWORD B_TRUE 1 100 0 1 BIT_MASK 0x100 FORMAT "%13.11" ECU_ADDRESS 0xFDB2 /end MEASUREMENT
/begin MEASUREMENT B_amsren "Bedingung ASR/MSR-Eingriff erlaubt" UWORD B_TRUE 1 100 0 1 BIT_MASK 0x4 FORMAT "%13.11" ECU_ADDRESS 0xFD1E /end MEASUREMENT
/begin MEASUREMENT B_amsrf "Bedingung ASR-MSR Konsistenzfehler" UWORD B_TRUE 1 100 0 1 BIT_MASK 0x8 FORMAT "%13.11" ECU_ADDRESS 0xFD1E /end MEASUREMENT
/begin MEASUREMENT B_amsrinpl "Bedingung ASR/MSR-Eingriff irreversibel verboten" UWORD B_TRUE 1 100 0 1 BIT_MASK 0x10 FORMAT "%13.11" ECU_ADDRESS 0xFD1E /end MEASUREMENT
/begin MEASUREMENT B_amsrknpl "Bedingung unplausible Konsistenzprüfung bei ASR/MSR" UWORD B_TRUE 1 100 0 1 BIT_MASK 0x20 FORMAT "%13.11" ECU_ADDRESS 0xFD1E /end MEASUREMENT
/begin MEASUREMENT B_amsrn "Bedingung ASR-MSR nicht aktiv" UWORD B_TRUE 1 100 0 1 BIT_MASK 0x40 FORMAT "%13.11" ECU_ADDRESS 0xFD1E /end MEASUREMENT
/begin MEASUREMENT B_amsr_t "Bedingung MSR zulässig (Master-SG)" UWORD B_TRUE 1 100 0 1 BIT_MASK 0x80 FORMAT "%13.11" ECU_ADDRESS 0xFD1E /end MEASUREMENT
/begin MEASUREMENT B_asrakt "ASR-Funktion aktiviert" UWORD B_TRUE 1 100 0 1 BIT_MASK 0x100 FORMAT "%13.11" ECU_ADDRESS 0xFD1E /end MEASUREMENT
/begin MEASUREMENT B_asresp "Bedingung ASR/ESP verbaut" UWORD B_TRUE 1 100 0 1 BIT_MASK 0x200 FORMAT "%13.11" ECU_ADDRESS 0xFD1E /end MEASUREMENT
/begin MEASUREMENT B_asr_can "Bedingung ASR-Anforderung über CAN" UWORD B_TRUE 1 100 0 1 BIT_MASK 0x400 FORMAT "%13.11" ECU_ADDRESS 0xFD1E /end MEASUREMENT
/begin MEASUREMENT B_atsb "Bedingung: Abgastemperatursensor betriebsbereit" UWORD B_TRUE 1 100 0 1 BIT_MASK 0x100 FORMAT "%13.11" ECU_ADDRESS 0xFD64 /end MEASUREMENT
/begin MEASUREMENT B_ba "Bedingung Beschleunigungsanreicherung (Anzeige)" UWORD B_TRUE 1 100 0 1 BIT_MASK 0x20 FORMAT "%13.11" ECU_ADDRESS 0xFD60 /end MEASUREMENT
/begin MEASUREMENT B_bag "Bedingung starke Beschleunigungsanreicherung" UWORD B_TRUE 1 100 0 1 BIT_MASK 0x40 FORMAT "%13.11" ECU_ADDRESS 0xFD60 /end MEASUREMENT
/begin MEASUREMENT B_bkva "Bedingung BKV angesteuert" UWORD B_TRUE 1 100 0 1 BIT_MASK 0x800 FORMAT "%13.11" ECU_ADDRESS 0xFD1E /end MEASUREMENT
/begin MEASUREMENT B_bkvv "Bedingung BKV verbaut (für Auswertung Bremse)" UWORD B_TRUE 1 100 0 1 BIT_MASK 0x1000 FORMAT "%13.11" ECU_ADDRESS 0xFD1E /end MEASUREMENT
/begin MEASUREMENT B_bkvvc "Bedingung BKV verbaut (Rohsignal)" UWORD B_TRUE 1 100 0 1 BIT_MASK 0x2000 FORMAT "%13.11" ECU_ADDRESS 0xFD1E /end MEASUREMENT
/begin MEASUREMENT B_bl "Bedingung Bremslichtschalter betätigt" UWORD B_TRUE 1 100 0 1 BIT_MASK 0x800 FORMAT "%13.11" ECU_ADDRESS 0xFD48 /end MEASUREMENT
/begin MEASUREMENT B_bm "Bedingung Bezugsmarke erkannt" UWORD B_TRUE 1 100 0 1 BIT_MASK 0x8 FORMAT "%13.11" ECU_ADDRESS 0xFD2C /end MEASUREMENT
/begin MEASUREMENT B_br "Bedingung Bremstestschalter betätigt" UWORD B_TRUE 1 100 0 1 BIT_MASK 0x1000 FORMAT "%13.11" ECU_ADDRESS 0xFD48 /end MEASUREMENT
/begin MEASUREMENT B_br1en "Bedingung Empfang Botschaft Bremse 1" UWORD B_TRUE 1 100 0 1 BIT_MASK 0x4000 FORMAT "%13.11" ECU_ADDRESS 0xFD1E /end MEASUREMENT
/begin MEASUREMENT B_br2k "Bedingung Bremse betätigt 2-kanalig erkannt" UWORD B_TRUE 1 100 0 1 BIT_MASK 0x2000 FORMAT "%13.11" ECU_ADDRESS 0xFD48 /end MEASUREMENT
/begin MEASUREMENT B_brems "Bedingung Bremse betätigt" UWORD B_TRUE 1 100 0 1 BIT_MASK 0x4000 FORMAT "%13.11" ECU_ADDRESS 0xFD48 /end MEASUREMENT
/begin MEASUREMENT B_cfgra "Bedingung fehlerhafte CAN-Botschaft GRA-Bediensignale" UWORD B_TRUE 1 100 0 1 BIT_MASK 0x4000 FORMAT "%13.11" ECU_ADDRESS 0xFD4E /end MEASUREMENT
/begin MEASUREMENT B_cfkuka "Bedingung Berechnung Korrekturfaktor UK-Adaption" UWORD B_TRUE 1 100 0 1 BIT_MASK 0x10 FORMAT "%13.11" ECU_ADDRESS 0xFD68 /end MEASUREMENT
/begin MEASUREMENT B_cfkuka2 "Bedingung Berechnung Korrekturfaktor UK-Adaption Bank 2" UWORD B_TRUE 1 100 0 1 BIT_MASK 0x20 FORMAT "%13.11" ECU_ADDRESS 0xFD68 /end MEASUREMENT
/begin MEASUREMENT B_cfuka "Bedingung UK-Adaptionsfaktor berechnen" UWORD B_TRUE 1 100 0 1 BIT_MASK 0x40 FORMAT "%13.11" ECU_ADDRESS 0xFD68 /end MEASUREMENT
/begin MEASUREMENT B_cfuka2 "Bedingung UK-Adaptionsfaktor berechnen (Bank 2)" UWORD B_TRUE 1 100 0 1 BIT_MASK 0x80 FORMAT "%13.11" ECU_ADDRESS 0xFD68 /end MEASUREMENT
/begin MEASUREMENT B_crcan "Bedingung Crash erkannt (aus plausibilisiertem CAN-Signal)" UBYTE B_TRUE 1 100 0 1 BIT_MASK 0x2 FORMAT "%13.11" ECU_ADDRESS 0x383450 /end MEASUREMENT
/begin MEASUREMENT B_crcan_20ms "" UWORD B_TRUE 1 100 0 1 BIT_MASK 0x200 FORMAT "%13.11" ECU_ADDRESS 0xFDB2 /end MEASUREMENT
/begin MEASUREMENT B_csernpl "Bedingung automatische Crashsignalerkennung unplausibel" UBYTE B_TRUE 1 100 0 1 BIT_MASK 0x1 FORMAT "%13.11" ECU_ADDRESS 0x382D18 /end MEASUREMENT
/begin MEASUREMENT B_csgra "Bedingung Checksummenfehler GRA-Botschaft" UWORD B_TRUE 1 100 0 1 BIT_MASK 0x8000 FORMAT "%13.11" ECU_ADDRESS 0xFD4E /end MEASUREMENT
/begin MEASUREMENT B_ctol "Bedingung: CAN-Signal für Öltemperatur verwendbar" UBYTE B_TRUE 1 100 0 1 BIT_MASK 0x1 FORMAT "%13.11" ECU_ADDRESS 0x3808E4 /end MEASUREMENT
/begin MEASUREMENT B_ctole "Bedingung: CAN-Signal für Öltemperatur fehlerhaft" UBYTE B_TRUE 1 100 0 1 BIT_MASK 0x2 FORMAT "%13.11" ECU_ADDRESS 0x3808E4 /end MEASUREMENT
/begin MEASUREMENT B_ctum "Bedingung: CAN-Signal für Umgebungstemperatur verwendbar" UWORD B_TRUE 1 100 0 1 BIT_MASK 0x4000 FORMAT "%13.11" ECU_ADDRESS 0xFD22 /end MEASUREMENT
/begin MEASUREMENT B_ctume "Bedingung: CAN-Signal für Umgebungstemperatur fehlerhaft" UWORD B_TRUE 1 100 0 1 BIT_MASK 0x8000 FORMAT "%13.11" ECU_ADDRESS 0xFD22 /end MEASUREMENT
/begin MEASUREMENT B_dkp1e "Bedingung Fehler DK-Poti 1" UWORD B_TRUE 1 100 0 1 BIT_MASK 0x400 FORMAT "%13.11" ECU_ADDRESS 0xFD3E /end MEASUREMENT
/begin MEASUREMENT B_dkp1ev "Bedingung Vorläufige Bereichsverletzung DK-Poti 1" UWORD B_TRUE 1 100 0 1 BIT_MASK 0x800 FORMAT "%13.11" ECU_ADDRESS 0xFD3E /end MEASUREMENT
/begin MEASUREMENT B_dkp1mn "Bedingung Bereichsverletzung DK-Poti 1 nach unten" UWORD B_TRUE 1 100 0 1 BIT_MASK 0x1000 FORMAT "%13.11" ECU_ADDRESS 0xFD3E /end MEASUREMENT
/begin MEASUREMENT B_dkp1mx "Bedingung Bereichsverletzung DK-Poti 1 nach oben" UWORD B_TRUE 1 100 0 1 BIT_MASK 0x2000 FORMAT "%13.11" ECU_ADDRESS 0xFD3E /end MEASUREMENT
/begin MEASUREMENT B_dkp1np "Bedingung DK-Poti 1 unplausibel zu Ersatzwert aus Füllung" UWORD B_TRUE 1 100 0 1 BIT_MASK 0x4000 FORMAT "%13.11" ECU_ADDRESS 0xFD3E /end MEASUREMENT
/begin MEASUREMENT B_dkp2e "Bedingung Fehler DK-Poti 2" UWORD B_TRUE 1 100 0 1 BIT_MASK 0x8000 FORMAT "%13.11" ECU_ADDRESS 0xFD3E /end MEASUREMENT
/begin MEASUREMENT B_dkp2ev "Bedingung Vorläufige Bereichsverletzung DK-Poti 2" UWORD B_TRUE 1 100 0 1 BIT_MASK 0x1 FORMAT "%13.11" ECU_ADDRESS 0xFD40 /end MEASUREMENT
/begin MEASUREMENT B_dkp2mn "Bedingung Bereichsverletzung DK-Poti 2 nach unten" UWORD B_TRUE 1 100 0 1 BIT_MASK 0x2 FORMAT "%13.11" ECU_ADDRESS 0xFD40 /end MEASUREMENT
/begin MEASUREMENT B_dkp2mx "Bedingung Bereichsverletzung DK-Poti 2 nach oben" UWORD B_TRUE 1 100 0 1 BIT_MASK 0x4 FORMAT "%13.11" ECU_ADDRESS 0xFD40 /end MEASUREMENT
/begin MEASUREMENT B_dkp2np "Bedingung DK-Poti 2 unplausibel zu Ersatzwert aus Füllung" UWORD B_TRUE 1 100 0 1 BIT_MASK 0x8 FORMAT "%13.11" ECU_ADDRESS 0xFD40 /end MEASUREMENT
/begin MEASUREMENT B_dkpaw "Bedingung DK-Poti-Auswahl für DK-Sensor-Ersatzbetrieb" UWORD B_TRUE 1 100 0 1 BIT_MASK 0x10 FORMAT "%13.11" ECU_ADDRESS 0xFD40 /end MEASUREMENT
/begin MEASUREMENT B_dksbeg "Bedingung DK-Sollwertbegrenzung" UWORD B_TRUE 1 100 0 1 BIT_MASK 0x20 FORMAT "%13.11" ECU_ADDRESS 0xFD40 /end MEASUREMENT
/begin MEASUREMENT B_ecfuka "Bedingung ÜK-Adaptionsfaktor berechnen erlaubt" UWORD B_TRUE 1 100 0 1 BIT_MASK 0x100 FORMAT "%13.11" ECU_ADDRESS 0xFD68 /end MEASUREMENT
/begin MEASUREMENT B_edks "Bedingung Fehler Drosselklappen-Sensor" UWORD B_TRUE 1 100 0 1 BIT_MASK 0x40 FORMAT "%13.11" ECU_ADDRESS 0xFD40 /end MEASUREMENT
/begin MEASUREMENT B_edsfgr "Bedingung EDS-Eingriff (als Abschaltbedingung für FGR)" UWORD B_TRUE 1 100 0 1 BIT_MASK 0x8000 FORMAT "%13.11" ECU_ADDRESS 0xFD1E /end MEASUREMENT
/begin MEASUREMENT B_edsl "Bedingung Error Ladedrucksensor" UWORD B_TRUE 1 100 0 1 BIT_MASK 0x200 FORMAT "%13.11" ECU_ADDRESS 0xFD54 /end MEASUREMENT
/begin MEASUREMENT B_edsuu "Bedingung Error Umgebungsdrucksensor nicht zeitentprellt" UBYTE B_TRUE 1 100 0 1 BIT_MASK 0x1 FORMAT "%13.11" ECU_ADDRESS 0x38332C /end MEASUREMENT
/begin MEASUREMENT B_enqsyn "Bedingung Freigabe PG-Schnellstart" UWORD B_TRUE 1 100 0 1 BIT_MASK 0x10 FORMAT "%13.11" ECU_ADDRESS 0xFD2C /end MEASUREMENT
/begin MEASUREMENT B_epwmcs "Bedingung PWM-Crash-Sensor-Signal ist fehlerhaft" UBYTE B_TRUE 1 100 0 1 BIT_MASK 0x8 FORMAT "%13.11" ECU_ADDRESS 0x382D18 /end MEASUREMENT
/begin MEASUREMENT B_erbr "Bedingung Bremsschaltersignale unplausibel" UWORD B_TRUE 1 100 0 1 BIT_MASK 0x8000 FORMAT "%13.11" ECU_ADDRESS 0xFD48 /end MEASUREMENT
/begin MEASUREMENT B_fabr "Bremsdruckschwelle durch Fahrerbetätigung überschritten aus CAN-Botschaft" UWORD B_TRUE 1 100 0 1 BIT_MASK 0x1 FORMAT "%13.11" ECU_ADDRESS 0xFD20 /end MEASUREMENT
/begin MEASUREMENT B_fbm "Bedingung Bezugsmarkenfehler => mindestens 1 Zahn zuviel oder zuwenig erkannt" UWORD B_TRUE 1 100 0 1 BIT_MASK 0x20 FORMAT "%13.11" ECU_ADDRESS 0xFD2C /end MEASUREMENT
/begin MEASUREMENT B_fdyfgr "Bedingung Eingriff Fahrdynamikfunktion (als Abschaltbedingung für FGR)" UWORD B_TRUE 1 100 0 1 BIT_MASK 0x2 FORMAT "%13.11" ECU_ADDRESS 0xFD20 /end MEASUREMENT
/begin MEASUREMENT B_ffhsc "Bedingung B_fgrhsc gesetzt während B_fgrhs" UBYTE B_TRUE 1 100 0 1 BIT_MASK 0x2 FORMAT "%13.11" ECU_ADDRESS 0x380970 /end MEASUREMENT
/begin MEASUREMENT B_fgootein "Bedingung Freigabe ON/OFF-Taster GRA für Einschalten" UBYTE B_TRUE 1 100 0 1 BIT_MASK 0x4 FORMAT "%13.11" ECU_ADDRESS 0x380970 /end MEASUREMENT
/begin MEASUREMENT B_fgrab "FGR-/ACC-Abschaltung aus der Funktion" UWORD B_TRUE 1 100 0 1 BIT_MASK 0x2000 FORMAT "%13.11" ECU_ADDRESS 0xFD4E /end MEASUREMENT
/begin MEASUREMENT B_fgrabz "Bedingung zusätzliche FGR-Abschaltung (FDR Eingriff)" UWORD B_TRUE 1 100 0 1 BIT_MASK 0x4 FORMAT "%13.11" ECU_ADDRESS 0xFD20 /end MEASUREMENT
/begin MEASUREMENT B_fgrat "Bedingung: Tip-Schalter Aus am FGR-Bedienteil betätigt" UWORD B_TRUE 1 100 0 1 BIT_MASK 0x40 FORMAT "%13.11" ECU_ADDRESS 0xFD3C /end MEASUREMENT
/begin MEASUREMENT B_fgratc "Bedingung FGR-Tipschalter Aus betätigt (vom CAN)" UWORD B_TRUE 1 100 0 1 BIT_MASK 0x1 FORMAT "%13.11" ECU_ADDRESS 0xFD50 /end MEASUREMENT
/begin MEASUREMENT B_fgrbec "Bedingung FGR-Tipschalter Beschleunigen gehalten (vom CAN)" UWORD B_TRUE 1 100 0 1 BIT_MASK 0x2 FORMAT "%13.11" ECU_ADDRESS 0xFD50 /end MEASUREMENT
/begin MEASUREMENT B_fgrdvi "Bedingung FGR-Regler Initialisierung der gespeicherten Regelabweichung" UBYTE B_TRUE 1 100 0 1 BIT_MASK 0x1 FORMAT "%13.11" ECU_ADDRESS 0x3809C4 /end MEASUREMENT
/begin MEASUREMENT B_fgren "Bedingung Fahrgeschwindigkeitsregelung aktiv (Enable)" UBYTE B_TRUE 1 100 0 1 BIT_MASK 0x1 FORMAT "%13.11" ECU_ADDRESS 0x3809C3 /end MEASUREMENT
/begin MEASUREMENT B_fgrhe "Bedingung: FGR-Bedienteil-Fehler" UWORD B_TRUE 1 100 0 1 BIT_MASK 0x80 FORMAT "%13.11" ECU_ADDRESS 0xFD3C /end MEASUREMENT
/begin MEASUREMENT B_fgrhec "Bedingung Fehler FGR-Bedienteil (vom CAN)" UWORD B_TRUE 1 100 0 1 BIT_MASK 0x4 FORMAT "%13.11" ECU_ADDRESS 0xFD50 /end MEASUREMENT
/begin MEASUREMENT B_fgrhev "Bedingung Fehler FGR-Bedienteil (vorläufig)" UBYTE B_TRUE 1 100 0 1 BIT_MASK 0x8 FORMAT "%13.11" ECU_ADDRESS 0x380970 /end MEASUREMENT
/begin MEASUREMENT B_fgrhs "Bedingung FGR-Hauptschalter (über Hw-Leitung)" UBYTE B_TRUE 1 100 0 1 BIT_MASK 0x10 FORMAT "%13.11" ECU_ADDRESS 0x380970 /end MEASUREMENT
/begin MEASUREMENT B_fgrhsa "Bedingung: FGR-Hauptschalter aus" UWORD B_TRUE 1 100 0 1 BIT_MASK 0x100 FORMAT "%13.11" ECU_ADDRESS 0xFD3C /end MEASUREMENT
/begin MEASUREMENT B_fgrhsc "Bedingung FGR-Hauptschalter ein (vom CAN)" UWORD B_TRUE 1 100 0 1 BIT_MASK 0x8 FORMAT "%13.11" ECU_ADDRESS 0xFD50 /end MEASUREMENT
/begin MEASUREMENT B_fgrsec "Bedingung FGR-Tipschalter Setzen betätigt (vom CAN)" UWORD B_TRUE 1 100 0 1 BIT_MASK 0x10 FORMAT "%13.11" ECU_ADDRESS 0xFD50 /end MEASUREMENT
/begin MEASUREMENT B_fgrtbe "Bedingung FGR-Taste Beschleunigen" UWORD B_TRUE 1 100 0 1 BIT_MASK 0x200 FORMAT "%13.11" ECU_ADDRESS 0xFD3C /end MEASUREMENT
/begin MEASUREMENT B_fgrtbh "Bedingung FGR-Taste Beschleunigen wird gehalten (kein Tip)" UWORD B_TRUE 1 100 0 1 BIT_MASK 0x400 FORMAT "%13.11" ECU_ADDRESS 0xFD3C /end MEASUREMENT
/begin MEASUREMENT B_fgrtdc "Bedingung FGR-Tipschalter Verzögern betätigt (vom CAN)" UWORD B_TRUE 1 100 0 1 BIT_MASK 0x20 FORMAT "%13.11" ECU_ADDRESS 0xFD50 /end MEASUREMENT
/begin MEASUREMENT B_fgrtse "Bedingung FGR-Taste Setzen" UWORD B_TRUE 1 100 0 1 BIT_MASK 0x800 FORMAT "%13.11" ECU_ADDRESS 0xFD3C /end MEASUREMENT
/begin MEASUREMENT B_fgrtuc "Bedingung FGR-Tipschalter Beschleunigen betätigt (vom CAN)" UWORD B_TRUE 1 100 0 1 BIT_MASK 0x40 FORMAT "%13.11" ECU_ADDRESS 0xFD50 /end MEASUREMENT
/begin MEASUREMENT B_fgrtve "Bedingung FGR-Taste Verzögern" UWORD B_TRUE 1 100 0 1 BIT_MASK 0x1000 FORMAT "%13.11" ECU_ADDRESS 0xFD3C /end MEASUREMENT
/begin MEASUREMENT B_fgrtvh "Bedingung FGR-Taste Verzögern wird gehalten (kein Tip)" UWORD B_TRUE 1 100 0 1 BIT_MASK 0x2000 FORMAT "%13.11" ECU_ADDRESS 0xFD3C /end MEASUREMENT
/begin MEASUREMENT B_fgrtwa "Bedingung FGR-Taste Wiederaufnahme" UWORD B_TRUE 1 100 0 1 BIT_MASK 0x4000 FORMAT "%13.11" ECU_ADDRESS 0xFD3C /end MEASUREMENT
/begin MEASUREMENT B_fgrvec "Bedingung FGR-Tipschalter Verzögern gehalten (vom CAN)" UWORD B_TRUE 1 100 0 1 BIT_MASK 0x80 FORMAT "%13.11" ECU_ADDRESS 0xFD50 /end MEASUREMENT
/begin MEASUREMENT B_fgrwac "Bedingung FGR-Tipschalter Wiederaufnahme betätigt (vom CAN)" UWORD B_TRUE 1 100 0 1 BIT_MASK 0x100 FORMAT "%13.11" ECU_ADDRESS 0xFD50 /end MEASUREMENT
/begin MEASUREMENT B_fkmsdks "Integratorstop fkmsdk" UWORD B_TRUE 1 100 0 1 BIT_MASK 0x40 FORMAT "%13.11" ECU_ADDRESS 0xFD56 /end MEASUREMENT
/begin MEASUREMENT B_frgbs "Bedingung Freigabe Bediensignale Fahrgeschwindigkeitsregler" UBYTE B_TRUE 1 100 0 1 BIT_MASK 0x1 FORMAT "%13.11" ECU_ADDRESS 0x3809BB /end MEASUREMENT
/begin MEASUREMENT B_furena "Bedingung Aktivierung des Füllungsreglers" UWORD B_TRUE 1 100 0 1 BIT_MASK 0x8 FORMAT "%13.11" ECU_ADDRESS 0xFD56 /end MEASUREMENT
/begin MEASUREMENT B_furpen "Bedingung Füllungsregler P-Anteil aktiv" UWORD B_TRUE 1 100 0 1 BIT_MASK 0x10 FORMAT "%13.11" ECU_ADDRESS 0xFD56 /end MEASUREMENT
/begin MEASUREMENT B_fwe "Bedingung Faktor Wiedereinsetzen" UWORD B_TRUE 1 100 0 1 BIT_MASK 0x8000 FORMAT "%13.11" ECU_ADDRESS 0xFD5E /end MEASUREMENT
/begin MEASUREMENT B_grabz "Bedingung unplausibler Botschaftszähler GRA-Botschaft" UWORD B_TRUE 1 100 0 1 BIT_MASK 0x200 FORMAT "%13.11" ECU_ADDRESS 0xFD50 /end MEASUREMENT
/begin MEASUREMENT B_grabz1 "Bedingung Botschaftszähler GRA: Zählerstandsänderung nicht kontinuierlich" UWORD B_TRUE 1 100 0 1 BIT_MASK 0x400 FORMAT "%13.11" ECU_ADDRESS 0xFD50 /end MEASUREMENT
/begin MEASUREMENT B_grabz2 "Bedingung Botschaftszähler GRA: Zählerstand  steht" UWORD B_TRUE 1 100 0 1 BIT_MASK 0x800 FORMAT "%13.11" ECU_ADDRESS 0xFD50 /end MEASUREMENT
/begin MEASUREMENT B_hag "Bedingung Höhenadaption gültig" UWORD B_TRUE 1 100 0 1 BIT_MASK 0x400 FORMAT "%13.11" ECU_ADDRESS 0xFD54 /end MEASUREMENT
/begin MEASUREMENT B_high "" UBYTE B_TRUE 1 100 0 1 BIT_MASK 0x4 FORMAT "%13.11" ECU_ADDRESS 0x380B8A /end MEASUREMENT
/begin MEASUREMENT B_hpwmcs "Bedingung PWM-Crash-Sensor-Signal i.O." UBYTE B_TRUE 1 100 0 1 BIT_MASK 0x4 FORMAT "%13.11" ECU_ADDRESS 0x382D18 /end MEASUREMENT
/begin MEASUREMENT B_hst "Bedingung Heißstart" UBYTE B_TRUE 1 100 0 1 BIT_MASK 0x1 FORMAT "%13.11" ECU_ADDRESS 0x383331 /end MEASUREMENT
/begin MEASUREMENT B_kfvswk "Bedingung Konstantfahrt vor Setzwertkorrektur" UBYTE B_TRUE 1 100 0 1 BIT_MASK 0x1 FORMAT "%13.11" ECU_ADDRESS 0x3809BE /end MEASUREMENT
/begin MEASUREMENT B_kfwee "Bedingung Kennfeld KFWEE aktiv" UWORD B_TRUE 1 100 0 1 BIT_MASK 0x10 FORMAT "%13.11" ECU_ADDRESS 0xFD58 /end MEASUREMENT
/begin MEASUREMENT B_klafbg "Eingangsgröße für KLAF ist begrenzt" UBYTE B_TRUE 1 100 0 1 BIT_MASK 0x2 FORMAT "%13.11" ECU_ADDRESS 0x3809D1 /end MEASUREMENT
/begin MEASUREMENT B_klimex "Bedingung Bit Klimaanlage existiert" UBYTE B_TRUE 1 100 0 1 BIT_MASK 0x1 FORMAT "%13.11" ECU_ADDRESS 0x380B8A /end MEASUREMENT
/begin MEASUREMENT B_klimpl "" UBYTE B_TRUE 1 100 0 1 BIT_MASK 0x2 FORMAT "%13.11" ECU_ADDRESS 0x380B8A /end MEASUREMENT
/begin MEASUREMENT B_kuppl "Bedingung Kupplungspedal betätigt" UWORD B_TRUE 1 100 0 1 BIT_MASK 0x1 FORMAT "%13.11" ECU_ADDRESS 0xFD4A /end MEASUREMENT
/begin MEASUREMENT B_kupplv "Bedingung Kupplung betätigt verzögert" UWORD B_TRUE 1 100 0 1 BIT_MASK 0x2 FORMAT "%13.11" ECU_ADDRESS 0xFD4A /end MEASUREMENT
/begin MEASUREMENT B_ldrugd "Bedingung ungedrosselt, Freigabe durch LDR" UWORD B_TRUE 1 100 0 1 BIT_MASK 0x80 FORMAT "%13.11" ECU_ADDRESS 0xFD56 /end MEASUREMENT
/begin MEASUREMENT B_llvfgr "Bedingung Leerlauf-Verbot vom FGR" UBYTE B_TRUE 1 100 0 1 BIT_MASK 0x2 FORMAT "%13.11" ECU_ADDRESS 0x3809C3 /end MEASUREMENT
/begin MEASUREMENT B_luecke "Aktuelles Segment liegt über der Referenzlücke" UWORD B_TRUE 1 100 0 1 BIT_MASK 0x40 FORMAT "%13.11" ECU_ADDRESS 0xFD2C /end MEASUREMENT
/begin MEASUREMENT B_mfact "Bedingung Medianfilter aktiv" UBYTE B_TRUE 1 100 0 1 BIT_MASK 0x4 FORMAT "%13.11" ECU_ADDRESS 0x3809D1 /end MEASUREMENT
/begin MEASUREMENT B_mluecke "Bedingung mittleres Lückensegment bei Motoren mit ungerader Zylinderanzahl" UWORD B_TRUE 1 100 0 1 BIT_MASK 0x80 FORMAT "%13.11" ECU_ADDRESS 0xFD2C /end MEASUREMENT
/begin MEASUREMENT B_mrfamx "Vorlagerungswinkel über maximales Fahrerwunschmomment aktiv" UWORD B_TRUE 1 100 0 1 BIT_MASK 0x20 FORMAT "%13.11" ECU_ADDRESS 0xFD58 /end MEASUREMENT
/begin MEASUREMENT B_msrakt "MSR-Funktion aktiviert" UWORD B_TRUE 1 100 0 1 BIT_MASK 0x8 FORMAT "%13.11" ECU_ADDRESS 0xFD20 /end MEASUREMENT
/begin MEASUREMENT B_msrdis "Bedingung MSR-Eingriff nicht zugelassen" UWORD B_TRUE 1 100 0 1 BIT_MASK 0x10 FORMAT "%13.11" ECU_ADDRESS 0xFD20 /end MEASUREMENT
/begin MEASUREMENT B_msrphnpl "Bedingung MSR-Eingriff physikalisch nicht plausibel" UWORD B_TRUE 1 100 0 1 BIT_MASK 0x20 FORMAT "%13.11" ECU_ADDRESS 0xFD20 /end MEASUREMENT
/begin MEASUREMENT B_msrtnpl "Bedingung MSR-Eingriff aufgrund Topffunktion nicht plausibel" UWORD B_TRUE 1 100 0 1 BIT_MASK 0x40 FORMAT "%13.11" ECU_ADDRESS 0xFD20 /end MEASUREMENT
/begin MEASUREMENT B_msrvnpl "Bedingung MSR-Eingriff aufgrund Geschwindigkeitsschwelle nicht plausibel" UWORD B_TRUE 1 100 0 1 BIT_MASK 0x80 FORMAT "%13.11" ECU_ADDRESS 0xFD20 /end MEASUREMENT
/begin MEASUREMENT B_msr_can "Bedingung MSR-Anforderung über CAN" UWORD B_TRUE 1 100 0 1 BIT_MASK 0x100 FORMAT "%13.11" ECU_ADDRESS 0xFD20 /end MEASUREMENT
/begin MEASUREMENT B_nmin "Bedingung Unterdrehzahl: n < NMIN" UWORD B_TRUE 1 100 0 1 BIT_MASK 0x100 FORMAT "%13.11" ECU_ADDRESS 0xFD2C /end MEASUREMENT
/begin MEASUREMENT B_nmot "Bedingung Motordrehzahl: n > NMIN" UWORD B_TRUE 1 100 0 1 BIT_MASK 0x200 FORMAT "%13.11" ECU_ADDRESS 0xFD2C /end MEASUREMENT
/begin MEASUREMENT B_nobm "Bedingung BM-Lücke nach > 60 Zähnen nicht gefunden" UWORD B_TRUE 1 100 0 1 BIT_MASK 0x400 FORMAT "%13.11" ECU_ADDRESS 0xFD2C /end MEASUREMENT
/begin MEASUREMENT B_nobm1 "Bedingung 1. BM-Lücke nach Synchronisation nicht gefunden" UBYTE B_TRUE 1 100 0 1 BIT_MASK 0x1 FORMAT "%13.11" ECU_ADDRESS 0x38331A /end MEASUREMENT
/begin MEASUREMENT B_nomsr_fr "kein ASR-/MSR-Eingriff vom FR" UWORD B_TRUE 1 100 0 1 BIT_MASK 0x200 FORMAT "%13.11" ECU_ADDRESS 0xFD20 /end MEASUREMENT
/begin MEASUREMENT B_nomsr_t "Bedingung MSR-Momentenvorgabe in diesem ME-SG nicht übernommen" UWORD B_TRUE 1 100 0 1 BIT_MASK 0x400 FORMAT "%13.11" ECU_ADDRESS 0xFD20 /end MEASUREMENT
/begin MEASUREMENT B_noph "Phasengebersignal nicht gefunden" UWORD B_TRUE 1 100 0 1 BIT_MASK 0x800 FORMAT "%13.11" ECU_ADDRESS 0xFD2C /end MEASUREMENT
/begin MEASUREMENT B_npcanswe "Bedingung Schlechtwegeinfo (CAN) nicht plausibel" UWORD B_TRUE 1 100 0 1 BIT_MASK 0x800 FORMAT "%13.11" ECU_ADDRESS 0xFD20 /end MEASUREMENT
/begin MEASUREMENT B_npwmcs "Bedingung Crash erkannt und EKP-Vorlaufverbot" UBYTE B_TRUE 1 100 0 1 BIT_MASK 0x2 FORMAT "%13.11" ECU_ADDRESS 0x382D18 /end MEASUREMENT
/begin MEASUREMENT B_nuamsr "Bedingung Nachrichtenunterbrechung bei ASR/MSR" UWORD B_TRUE 1 100 0 1 BIT_MASK 0x1000 FORMAT "%13.11" ECU_ADDRESS 0xFD20 /end MEASUREMENT
/begin MEASUREMENT B_nugra "Bedingung Nachrichtenunterbrechung GRA-Botschaft" UWORD B_TRUE 1 100 0 1 BIT_MASK 0x1000 FORMAT "%13.11" ECU_ADDRESS 0xFD50 /end MEASUREMENT
/begin MEASUREMENT B_pgxqsyn "Umschaltbedingung Phasengeber PG/PG2 für Schnellstart" UWORD B_TRUE 1 100 0 1 BIT_MASK 0x1000 FORMAT "%13.11" ECU_ADDRESS 0xFD2C /end MEASUREMENT
/begin MEASUREMENT B_phaact "Bedingung Signal Phasensensor 1 high activ" UWORD B_TRUE 1 100 0 1 BIT_MASK 0x2000 FORMAT "%13.11" ECU_ADDRESS 0xFD2C /end MEASUREMENT
/begin MEASUREMENT B_phase "Bedingung Phase low/high" UWORD B_TRUE 1 100 0 1 BIT_MASK 0x4000 FORMAT "%13.11" ECU_ADDRESS 0xFD2C /end MEASUREMENT
/begin MEASUREMENT B_phw "Bedingung Phasenwechsel seit letztem Zahn während BM-Suche" UWORD B_TRUE 1 100 0 1 BIT_MASK 0x8000 FORMAT "%13.11" ECU_ADDRESS 0xFD2C /end MEASUREMENT
/begin MEASUREMENT B_phwneg "Bedingung negative Phasenflanke im Schnellstart ausgewertet" UWORD B_TRUE 1 100 0 1 BIT_MASK 0x1 FORMAT "%13.11" ECU_ADDRESS 0xFD2E /end MEASUREMENT
/begin MEASUREMENT B_phwok "Bedingung Phasenwechsel erkannt" UWORD B_TRUE 1 100 0 1 BIT_MASK 0x2 FORMAT "%13.11" ECU_ADDRESS 0xFD2E /end MEASUREMENT
/begin MEASUREMENT B_phwpos "Bedingung positive Phasenflanke im Schnellstart ausgewertet" UWORD B_TRUE 1 100 0 1 BIT_MASK 0x4 FORMAT "%13.11" ECU_ADDRESS 0xFD2E /end MEASUREMENT
/begin MEASUREMENT B_pwmcs "Crash erkannt" UBYTE B_TRUE 1 100 0 1 BIT_MASK 0x1 FORMAT "%13.11" ECU_ADDRESS 0x383450 /end MEASUREMENT
/begin MEASUREMENT B_pwmcs_50ms "" UWORD B_TRUE 1 100 0 1 BIT_MASK 0x400 FORMAT "%13.11" ECU_ADDRESS 0xFDB2 /end MEASUREMENT
/begin MEASUREMENT B_pwmfcs "Bedingung PWM-Signal vom Airbag-SG fehlerhaft" UWORD B_TRUE 1 100 0 1 BIT_MASK 0x800 FORMAT "%13.11" ECU_ADDRESS 0xFDB2 /end MEASUREMENT
/begin MEASUREMENT B_qsyn "Bedingung Schnelle Synchronisation (quick)" UWORD B_TRUE 1 100 0 1 BIT_MASK 0x8 FORMAT "%13.11" ECU_ADDRESS 0xFD2E /end MEASUREMENT
/begin MEASUREMENT B_redkl "Freigabe Reduzierung ÜK-K- und -L-Anteil" UWORD B_TRUE 1 100 0 1 BIT_MASK 0x80 FORMAT "%13.11" ECU_ADDRESS 0xFD60 /end MEASUREMENT
/begin MEASUREMENT B_rfkuka "Bedingung Korrekturfaktor rücksetzen (ÜK-Adaption)" UWORD B_TRUE 1 100 0 1 BIT_MASK 0x200 FORMAT "%13.11" ECU_ADDRESS 0xFD68 /end MEASUREMENT
/begin MEASUREMENT B_rfkuka2 "Bedingung Korrekturfaktor rücksetzen (Bank 2) (ÜK-Adaption)" UWORD B_TRUE 1 100 0 1 BIT_MASK 0x400 FORMAT "%13.11" ECU_ADDRESS 0xFD68 /end MEASUREMENT
/begin MEASUREMENT B_savfgr "Bedingung: Schubabschalteverbot durch FGR" UBYTE B_TRUE 1 100 0 1 BIT_MASK 0x4 FORMAT "%13.11" ECU_ADDRESS 0x3809C3 /end MEASUREMENT
/begin MEASUREMENT B_savmsr "Bedingung Schubabschalteverbot bei MSR-Anforderung" UWORD B_TRUE 1 100 0 1 BIT_MASK 0x2000 FORMAT "%13.11" ECU_ADDRESS 0xFD20 /end MEASUREMENT
/begin MEASUREMENT B_startini "Startbit für Erkennung der ersten Synchronisation nach KL15 ein" UWORD B_TRUE 1 100 0 1 BIT_MASK 0x10 FORMAT "%13.11" ECU_ADDRESS 0xFD2E /end MEASUREMENT
/begin MEASUREMENT B_stendes "Bedingung Startende Einspritzung erreicht" UWORD B_TRUE 1 100 0 1 BIT_MASK 0x2 FORMAT "%13.11" ECU_ADDRESS 0xFD5C /end MEASUREMENT
/begin MEASUREMENT B_stndfr "Freigabe Füllungsregler nach Start" UWORD B_TRUE 1 100 0 1 BIT_MASK 0x20 FORMAT "%13.11" ECU_ADDRESS 0xFD56 /end MEASUREMENT
/begin MEASUREMENT B_stprel "Bedingung Entprellung von Drehzahlgebersignal gestartet" UBYTE B_TRUE 1 100 0 1 BIT_MASK 0x1 FORMAT "%13.11" ECU_ADDRESS 0x38092A /end MEASUREMENT
/begin MEASUREMENT B_swecan "Bedingung Schlechtwegstrecke CAN-Rohsignal" UWORD B_TRUE 1 100 0 1 BIT_MASK 0x4000 FORMAT "%13.11" ECU_ADDRESS 0xFD20 /end MEASUREMENT
/begin MEASUREMENT B_swe_b "Bedingung Schlechtwegstrecke erkannt duch Bit über CAN (aus ABS-SG)" UWORD B_TRUE 1 100 0 1 BIT_MASK 0x8000 FORMAT "%13.11" ECU_ADDRESS 0xFD20 /end MEASUREMENT
/begin MEASUREMENT B_syn "Bedingung Synchronisation erfolgt" UWORD B_TRUE 1 100 0 1 BIT_MASK 0x20 FORMAT "%13.11" ECU_ADDRESS 0xFD2E /end MEASUREMENT
/begin MEASUREMENT B_synbmale "Bedingung: Kein Phasengeber für Synchronisation vorhanden" UWORD B_TRUE 1 100 0 1 BIT_MASK 0x40 FORMAT "%13.11" ECU_ADDRESS 0xFD2E /end MEASUREMENT
/begin MEASUREMENT B_synph "Bedingung Synchronisation Phase" UWORD B_TRUE 1 100 0 1 BIT_MASK 0x80 FORMAT "%13.11" ECU_ADDRESS 0xFD2E /end MEASUREMENT
/begin MEASUREMENT B_tairmx "" UWORD B_TRUE 1 100 0 1 BIT_MASK 0x1000 FORMAT "%13.11" ECU_ADDRESS 0xFDB2 /end MEASUREMENT
/begin MEASUREMENT B_tairnu "" UWORD B_TRUE 1 100 0 1 BIT_MASK 0x2000 FORMAT "%13.11" ECU_ADDRESS 0xFDB2 /end MEASUREMENT
/begin MEASUREMENT B_tal "Bedingung Tank leer bzw. Reserve" UBYTE B_TRUE 1 100 0 1 BIT_MASK 0x1 FORMAT "%13.11" ECU_ADDRESS 0x383327 /end MEASUREMENT
/begin MEASUREMENT B_talval "Bedingung : Bit Tank leer gültig" UWORD B_TRUE 1 100 0 1 BIT_MASK 0x4000 FORMAT "%13.11" ECU_ADDRESS 0xFD3A /end MEASUREMENT
/begin MEASUREMENT B_tcrcan "" UWORD B_TRUE 1 100 0 1 BIT_MASK 0x4000 FORMAT "%13.11" ECU_ADDRESS 0xFDB2 /end MEASUREMENT
/begin MEASUREMENT B_tgramx "" UWORD B_TRUE 1 100 0 1 BIT_MASK 0x2000 FORMAT "%13.11" ECU_ADDRESS 0xFD50 /end MEASUREMENT
/begin MEASUREMENT B_tgranu "" UWORD B_TRUE 1 100 0 1 BIT_MASK 0x4000 FORMAT "%13.11" ECU_ADDRESS 0xFD50 /end MEASUREMENT
/begin MEASUREMENT B_tmkib "Bedingung: Motortemperatur vom Kombiinstrument betriebsbereit" UWORD B_TRUE 1 100 0 1 BIT_MASK 0x400 FORMAT "%13.11" ECU_ADDRESS 0xFD6A /end MEASUREMENT
/begin MEASUREMENT B_tmnuka "Bedingung: Minimalzeit zwischen 2 Adaptionsvorgänge läuft" UWORD B_TRUE 1 100 0 1 BIT_MASK 0x800 FORMAT "%13.11" ECU_ADDRESS 0xFD68 /end MEASUREMENT
/begin MEASUREMENT B_tootaus "Bedingung B_fgrhs und B_fgrhsc für TOOTAUS nicht gesetzt" UBYTE B_TRUE 1 100 0 1 BIT_MASK 0x20 FORMAT "%13.11" ECU_ADDRESS 0x380970 /end MEASUREMENT
/begin MEASUREMENT B_tootein "Bedingung B_fgrhs für TOOTEIN betätigt" UBYTE B_TRUE 1 100 0 1 BIT_MASK 0x40 FORMAT "%13.11" ECU_ADDRESS 0x380970 /end MEASUREMENT
/begin MEASUREMENT B_tootulb "Bedingung ON/OFF-Taster GRA unplausibel lange betätigt" UBYTE B_TRUE 1 100 0 1 BIT_MASK 0x80 FORMAT "%13.11" ECU_ADDRESS 0x380970 /end MEASUREMENT
/begin MEASUREMENT B_ubats "Bedingung: Mindestbatteriespannung für Abgastemperatursensor überschritten" UWORD B_TRUE 1 100 0 1 BIT_MASK 0x200 FORMAT "%13.11" ECU_ADDRESS 0xFD64 /end MEASUREMENT
/begin MEASUREMENT B_ubvdkp "Bedingung Batteriespannung ausreichend für Verstärkung von DK-Poti 1" UWORD B_TRUE 1 100 0 1 BIT_MASK 0x80 FORMAT "%13.11" ECU_ADDRESS 0xFD40 /end MEASUREMENT
/begin MEASUREMENT B_udk1nv "Bedingung Spannung DK-Poti 1 oberhalb des Verstärkungsbereichs" UWORD B_TRUE 1 100 0 1 BIT_MASK 0x100 FORMAT "%13.11" ECU_ADDRESS 0xFD40 /end MEASUREMENT
/begin MEASUREMENT B_ugds "DK-Sollwinkel im ungedrosselten Bereich" UBYTE B_TRUE 1 100 0 1 BIT_MASK 0x8 FORMAT "%13.11" ECU_ADDRESS 0x3809D1 /end MEASUREMENT
/begin MEASUREMENT B_uk1 "Einschaltbedingung Übergangskompensation" UWORD B_TRUE 1 100 0 1 BIT_MASK 0x100 FORMAT "%13.11" ECU_ADDRESS 0xFD60 /end MEASUREMENT
/begin MEASUREMENT B_uka "Freigabebedingung ÜK-Adaption" UWORD B_TRUE 1 100 0 1 BIT_MASK 0x1000 FORMAT "%13.11" ECU_ADDRESS 0xFD68 /end MEASUREMENT
/begin MEASUREMENT B_uka2 "Freigabebedingung ÜK-Adaption Zylinderbank 2" UWORD B_TRUE 1 100 0 1 BIT_MASK 0x2000 FORMAT "%13.11" ECU_ADDRESS 0xFD68 /end MEASUREMENT
/begin MEASUREMENT B_ukab "Bedingung gültiger Betriebsbereich für adaptive ÜK" UWORD B_TRUE 1 100 0 1 BIT_MASK 0x4000 FORMAT "%13.11" ECU_ADDRESS 0xFD68 /end MEASUREMENT
/begin MEASUREMENT B_ukabat "Bedingung Beschleunigung totzeitverschoben (ÜK-Adaption)" UWORD B_TRUE 1 100 0 1 BIT_MASK 0x8000 FORMAT "%13.11" ECU_ADDRESS 0xFD68 /end MEASUREMENT
/begin MEASUREMENT B_ukaukat "Bedingung:UK-Aktivität Anfang totzeitverschoben" UWORD B_TRUE 1 100 0 1 BIT_MASK 0x1 FORMAT "%13.11" ECU_ADDRESS 0xFD6A /end MEASUREMENT
/begin MEASUREMENT B_ukauket "Bedingung: UK-Aktivität Ende totzeitverschoben" UWORD B_TRUE 1 100 0 1 BIT_MASK 0x2 FORMAT "%13.11" ECU_ADDRESS 0xFD6A /end MEASUREMENT
/begin MEASUREMENT B_ukava "Bedingung Verzögerung (ÜK-Adaption)" UWORD B_TRUE 1 100 0 1 BIT_MASK 0x4 FORMAT "%13.11" ECU_ADDRESS 0xFD6A /end MEASUREMENT
/begin MEASUREMENT B_ukavat "Bedingung Verzögerung totzeitverschoben (ÜK-Adaption)" UWORD B_TRUE 1 100 0 1 BIT_MASK 0x8 FORMAT "%13.11" ECU_ADDRESS 0xFD6A /end MEASUREMENT
/begin MEASUREMENT B_uke "Einschaltbedingung ÜK-Ersatzwert" UWORD B_TRUE 1 100 0 1 BIT_MASK 0x200 FORMAT "%13.11" ECU_ADDRESS 0xFD60 /end MEASUREMENT
/begin MEASUREMENT B_ukg "Bedingung Ük wirkt stark" UWORD B_TRUE 1 100 0 1 BIT_MASK 0x400 FORMAT "%13.11" ECU_ADDRESS 0xFD60 /end MEASUREMENT
/begin MEASUREMENT B_ukk "Einschaltbedingung ÜK Kurzzeit-Anteil" UWORD B_TRUE 1 100 0 1 BIT_MASK 0x800 FORMAT "%13.11" ECU_ADDRESS 0xFD60 /end MEASUREMENT
/begin MEASUREMENT B_ukns "Einschaltbedingung ÜK nach Start" UWORD B_TRUE 1 100 0 1 BIT_MASK 0x1000 FORMAT "%13.11" ECU_ADDRESS 0xFD60 /end MEASUREMENT
/begin MEASUREMENT B_va "Bedingung Verzögerungsabmagerung (Anzeige)" UWORD B_TRUE 1 100 0 1 BIT_MASK 0x2000 FORMAT "%13.11" ECU_ADDRESS 0xFD60 /end MEASUREMENT
/begin MEASUREMENT B_vaau "Bedingung Verzögerungsabmagerung Aufteilung" UWORD B_TRUE 1 100 0 1 BIT_MASK 0x4000 FORMAT "%13.11" ECU_ADDRESS 0xFD60 /end MEASUREMENT
/begin MEASUREMENT B_vabsff "Bedingung Geschwindigkeit aus Bremsenbotschaft ist fehlerhaft" UWORD B_TRUE 1 100 0 1 BIT_MASK 0x1 FORMAT "%13.11" ECU_ADDRESS 0xFD22 /end MEASUREMENT
/begin MEASUREMENT B_vag "Bedingung starke Verzögerungsabmagerung" UWORD B_TRUE 1 100 0 1 BIT_MASK 0x8000 FORMAT "%13.11" ECU_ADDRESS 0xFD60 /end MEASUREMENT
/begin MEASUREMENT B_vak "Bedingung Verzögerungsabmagerung K-Anteil" UWORD B_TRUE 1 100 0 1 BIT_MASK 0x1 FORMAT "%13.11" ECU_ADDRESS 0xFD62 /end MEASUREMENT
/begin MEASUREMENT B_vakl "Bedingung Verzögerungsabmagerung L- und K-Anteil" UWORD B_TRUE 1 100 0 1 BIT_MASK 0x2 FORMAT "%13.11" ECU_ADDRESS 0xFD62 /end MEASUREMENT
/begin MEASUREMENT B_val "Bedingung Verzögerungsabmagerung L-Anteil" UWORD B_TRUE 1 100 0 1 BIT_MASK 0x4 FORMAT "%13.11" ECU_ADDRESS 0xFD62 /end MEASUREMENT
/begin MEASUREMENT B_vbemg "Bedingung Verbrennungserkennung möglich" UWORD B_TRUE 1 100 0 1 BIT_MASK 0x4 FORMAT "%13.11" ECU_ADDRESS 0xFD5C /end MEASUREMENT
/begin MEASUREMENT B_vbmg "Bedingung Verbrennung möglich" UWORD B_TRUE 1 100 0 1 BIT_MASK 0x8 FORMAT "%13.11" ECU_ADDRESS 0xFD5C /end MEASUREMENT
/begin MEASUREMENT B_vradhlff "Bedingung Radgeschwindigkeit hinten links aus Bremsenbotschaft fehlerhaft" UWORD B_TRUE 1 100 0 1 BIT_MASK 0x2 FORMAT "%13.11" ECU_ADDRESS 0xFD22 /end MEASUREMENT
/begin MEASUREMENT B_vradhrff "Bedingung Radgeschwindigkeit hinten rechts aus Bremsenbotschaft fehlerhaft" UWORD B_TRUE 1 100 0 1 BIT_MASK 0x4 FORMAT "%13.11" ECU_ADDRESS 0xFD22 /end MEASUREMENT
/begin MEASUREMENT B_vradvlff "Bedingung Radgeschwindigkeit vorne links aus Bremsenbotschaft fehlerhaft" UWORD B_TRUE 1 100 0 1 BIT_MASK 0x8 FORMAT "%13.11" ECU_ADDRESS 0xFD22 /end MEASUREMENT
/begin MEASUREMENT B_vradvrff "Bedingung Radgeschwindigkeit vorne rechts aus Bremsenbotschaft fehlerhaft" UWORD B_TRUE 1 100 0 1 BIT_MASK 0x10 FORMAT "%13.11" ECU_ADDRESS 0xFD22 /end MEASUREMENT
/begin MEASUREMENT B_wdk12ev "Bedingung Vorläufiger Gleichlauffehler der DK-Potis" UWORD B_TRUE 1 100 0 1 BIT_MASK 0x200 FORMAT "%13.11" ECU_ADDRESS 0xFD40 /end MEASUREMENT
/begin MEASUREMENT B_wdk13ev "Bedingung Vorläufige Unplausibilität zw. DK-Poti 1 und Ersatzwert aus Füllung" UWORD B_TRUE 1 100 0 1 BIT_MASK 0x400 FORMAT "%13.11" ECU_ADDRESS 0xFD40 /end MEASUREMENT
/begin MEASUREMENT B_wdk1v "Bedingung Berechnung des DK-Winkels aus verstärktem Signal von Poti 1" UWORD B_TRUE 1 100 0 1 BIT_MASK 0x800 FORMAT "%13.11" ECU_ADDRESS 0xFD40 /end MEASUREMENT
/begin MEASUREMENT B_wdk23ev "Bedingung Vorläufige Unplausibilität zw. DK-Poti 2 und Ersatzwert aus Füllung" UWORD B_TRUE 1 100 0 1 BIT_MASK 0x1000 FORMAT "%13.11" ECU_ADDRESS 0xFD40 /end MEASUREMENT
/begin MEASUREMENT B_wdk2sel "Bedingung DK-Winkel-Berechnung für Lageregler aus Poti 2" UWORD B_TRUE 1 100 0 1 BIT_MASK 0x2000 FORMAT "%13.11" ECU_ADDRESS 0xFD40 /end MEASUREMENT
/begin MEASUREMENT B_wdk2st "Bedingung DK-Winkel-Berechnung für Lageregler temporär aus Poti 2" UWORD B_TRUE 1 100 0 1 BIT_MASK 0x4000 FORMAT "%13.11" ECU_ADDRESS 0xFD40 /end MEASUREMENT
/begin MEASUREMENT B_wdkap "Bedingung: DK-Sollwert aus appl. Kennlinie bzw. im Start aus Startwinkel" UBYTE B_TRUE 1 100 0 1 BIT_MASK 0x10 FORMAT "%13.11" ECU_ADDRESS 0x3809D1 /end MEASUREMENT
/begin MEASUREMENT B_wf "Bedingung Wandfilmberechnung" UWORD B_TRUE 1 100 0 1 BIT_MASK 0x8 FORMAT "%13.11" ECU_ADDRESS 0xFD62 /end MEASUREMENT
/begin MEASUREMENT B_wks "Bedingung Wiederholkaltstart" UWORD B_TRUE 1 100 0 1 BIT_MASK 0x10 FORMAT "%13.11" ECU_ADDRESS 0xFD5C /end MEASUREMENT
/begin MEASUREMENT B_wst "Bedingung Wiederholstart" UWORD B_TRUE 1 100 0 1 BIT_MASK 0x20 FORMAT "%13.11" ECU_ADDRESS 0xFD5C /end MEASUREMENT
/begin MEASUREMENT B_wst0 "Bedingung Wiederholstart (Anteil 1: erkannte Verbrennungen)" UBYTE B_TRUE 1 100 0 1 BIT_MASK 0x2 FORMAT "%13.11" ECU_ADDRESS 0x383331 /end MEASUREMENT
/begin MEASUREMENT B_wst1 "Bedingung Wiederholstart (Anteil 2: Abstellzeit)" UWORD B_TRUE 1 100 0 1 BIT_MASK 0x40 FORMAT "%13.11" ECU_ADDRESS 0xFD5C /end MEASUREMENT
/begin MEASUREMENT B_wst2 "Bedingung Wiederholstart (Anteil1: letzter Zyklus erkannte Verbrennungen)" UWORD B_TRUE 1 100 0 1 BIT_MASK 0x80 FORMAT "%13.11" ECU_ADDRESS 0xFD5C /end MEASUREMENT
/begin MEASUREMENT B_zprel "Bedingung Zahnentprellung erfolgt" UWORD B_TRUE 1 100 0 1 BIT_MASK 0x100 FORMAT "%13.11" ECU_ADDRESS 0xFD2E /end MEASUREMENT
/begin MEASUREMENT B_zztab "Bedingung: Zahnzeitentabelle gültig" UWORD B_TRUE 1 100 0 1 BIT_MASK 0x200 FORMAT "%13.11" ECU_ADDRESS 0xFD2E /end MEASUREMENT
/begin MEASUREMENT cpaw1 "Zähler für Poti 1 bei DK-Poti-Auswahl" UBYTE dez 1 100 0 255 FORMAT "%5.1" ECU_ADDRESS 0x380977 /end MEASUREMENT
/begin MEASUREMENT cpaw2 "Zähler für Poti 2 bei DK-Poti-Auswahl" UBYTE dez 1 100 0 255 FORMAT "%5.1" ECU_ADDRESS 0x380978 /end MEASUREMENT
/begin MEASUREMENT crshDetect "" UBYTE DEZ 1 100 0 255 FORMAT "%5.1" ECU_ADDRESS 0x380B8D /end MEASUREMENT
/begin MEASUREMENT cserk "detektierte Signalquelle Crash-Sensor-Signal" UBYTE DEZ 1 100 0 255 FORMAT "%5.1" ECU_ADDRESS 0x38344F /end MEASUREMENT
/begin MEASUREMENT cs_gra "berechnte Checksumme der GRA-Botschaft" UBYTE DEZ 1 100 0 255 FORMAT "%5.1" ECU_ADDRESS 0x3809C6 /end MEASUREMENT
/begin MEASUREMENT ctbetip "Zeitzähler für Tip-Erkennung FGR-Taste Beschleunigen" UBYTE t20msxs_ub_b5p1 1 100 0 5.1 FORMAT "%5.3" ECU_ADDRESS 0x380969 /end MEASUREMENT
/begin MEASUREMENT ctdkp1 "Fehlerzeitzähler für Bereichsprüfung DK-Poti 1" UBYTE t10msxs_ub_b2p55 1 100 0 2.55 FORMAT "%5.3" ECU_ADDRESS 0x380979 /end MEASUREMENT
/begin MEASUREMENT ctdkp2 "Fehlerzeitzähler für Bereichsprüfung DK-Poti 2" UBYTE t10msxs_ub_b2p55 1 100 0 2.55 FORMAT "%5.3" ECU_ADDRESS 0x38097A /end MEASUREMENT
/begin MEASUREMENT ctdkpaw "Zeitzähler für DK-Poti-Auswahl" UBYTE t10msxs_ub_b2p55 1 100 0 2.55 FORMAT "%5.3" ECU_ADDRESS 0x38097B /end MEASUREMENT
/begin MEASUREMENT ctepfgrh "Zeitzähler für Entprellung Schalter FGR-Bedienteil" UBYTE t20msxs_ub_b5p1 1 100 0 5.1 FORMAT "%5.3" ECU_ADDRESS 0x38096A /end MEASUREMENT
/begin MEASUREMENT ctfgrab "Zeitzähler für Weitergabe der FGR-Abschaltung an die Funktionsüberwachung" UBYTE t20msxs_ub_b5p1 1 100 0 5.1 FORMAT "%5.3" ECU_ADDRESS 0x3809C2 /end MEASUREMENT
/begin MEASUREMENT ctfgrhe "Zeitzähler für Erkennung FGR-Bedienhebelfehler" UBYTE t20msxs_ub_b5p1 1 100 0 5.1 FORMAT "%5.3" ECU_ADDRESS 0x38096B /end MEASUREMENT
/begin MEASUREMENT cthsnp "Zeitzähler für Erkennung FGR-Hauptschalter nicht plausibel" UBYTE t20msxs_ub_b5p1 1 100 0 5.1 FORMAT "%5.3" ECU_ADDRESS 0x38096C /end MEASUREMENT
/begin MEASUREMENT ctol "überprüfte Öltemperatur vom CAN-Kombi" UBYTE temp_ub_q1_o60 1 100 -60 195 FORMAT "%5.1" ECU_ADDRESS 0x3808E3 /end MEASUREMENT
/begin MEASUREMENT ctootaus "Zeitzähler für Berechnung B_tootaus" UBYTE t20msxs_ub_b5p1 1 100 0 5.1 FORMAT "%5.3" ECU_ADDRESS 0x38096D /end MEASUREMENT
/begin MEASUREMENT ctootein "Zeitzähler für Berechnung B_tootein" UBYTE t20msxs_ub_b5p1 1 100 0 5.1 FORMAT "%5.3" ECU_ADDRESS 0x38096E /end MEASUREMENT
/begin MEASUREMENT ctootulb_w "Zeitzähler für Berechnung B_tootulb" UWORD t20msxs_uw_b1310 1 100 0 1310.7 FORMAT "%8.3" ECU_ADDRESS 0x381CE0 /end MEASUREMENT
/begin MEASUREMENT ctrerbr "Fehlerzähler für Bremsschalter-Plausibilisierung" UBYTE dez 1 100 0 255 FORMAT "%5.1" ECU_ADDRESS 0x38332B /end MEASUREMENT
/begin MEASUREMENT ctswk "Zeitzähler für Setzwertkorrektur" UBYTE t20msxs_ub_b5p1 1 100 0 5.1 FORMAT "%5.3" ECU_ADDRESS 0x3809BD /end MEASUREMENT
/begin MEASUREMENT ctum "überprüfte Umgebungstemperatur vom CAN-Kombi" UBYTE temp_ub_q0p75_o48 1 100 -48 143.25 FORMAT "%5.1" ECU_ADDRESS 0x38481C /end MEASUREMENT
/begin MEASUREMENT ctvetip "Zeitzähler für Tip-Erkennung FGR-Taste Verzögern" UBYTE t20msxs_ub_b5p1 1 100 0 5.1 FORMAT "%5.3" ECU_ADDRESS 0x38096F /end MEASUREMENT
/begin MEASUREMENT ctwdk12 "Fehlerzeitzähler für Gleichlaufprüfung der DK-Potis" UBYTE t10msxs_ub_b2p55 1 100 0 2.55 FORMAT "%5.3" ECU_ADDRESS 0x38097C /end MEASUREMENT
/begin MEASUREMENT ctwdk13 "Fehlerzeitzähler für Plausibilitätsprüfung DK-Poti 1 mit Ersatzwert aus Füllung" UBYTE t10msxs_ub_b2p55 1 100 0 2.55 FORMAT "%5.3" ECU_ADDRESS 0x38097D /end MEASUREMENT
/begin MEASUREMENT ctwdk23 "Fehlerzeitzähler für Plausibilitätsprüfung DK-Poti 2 mit Ersatzwert aus Füllung" UBYTE t10msxs_ub_b2p55 1 100 0 2.55 FORMAT "%5.3" ECU_ADDRESS 0x38097E /end MEASUREMENT
/begin MEASUREMENT dmrar_w "Delta Relatives Moment bei Abschaltrampe FGR" UWORD rel_uw_b200 1 100 0 199.997 FORMAT "%8.4" ECU_ADDRESS 0x381E72 /end MEASUREMENT
/begin MEASUREMENT dpdk_w "Druckabfall über Drosselklappe" UWORD p_uw_q0p039 1 100 0 2559.96 FORMAT "%8.3" ECU_ADDRESS 0x384ADC /end MEASUREMENT
/begin MEASUREMENT dpgNvBits "" UBYTE dez 1 100 0 255 FORMAT "%5.1" ECU_ADDRESS 0x38331A /end MEASUREMENT
/begin MEASUREMENT dpvdkspu_w "delta zwischen Druck vor Drosselklappe und Umgebungsdruck" UWORD p_uw_q0p039 1 100 0 2559.96 FORMAT "%8.3" ECU_ADDRESS 0x384ABC /end MEASUREMENT
/begin MEASUREMENT drkuke_w "Delta relative Kraftstoffmasse Ersatzwert" UWORD rel_uw_q0p1875 1 100 0 12287.8 FORMAT "%8.2" ECU_ADDRESS 0x38214A /end MEASUREMENT
/begin MEASUREMENT drlfuei_w "Lastkorrektur des Füllungsreglers (I-Anteil)" SWORD rel_sw_q0p0234 1 100 -768 767.977 FORMAT "%8.4" ECU_ADDRESS 0x381FBC /end MEASUREMENT
/begin MEASUREMENT drlfuep_w "Lastkorrektur des Füllungsreglers (P-Anteil)" SWORD rel_sw_q0p0234 1 100 -768 767.977 FORMAT "%8.4" ECU_ADDRESS 0x381FBE /end MEASUREMENT
/begin MEASUREMENT drlfue_w "Lastkorrektur des Füllungsreglers" SWORD rel_sw_q0p0234 1 100 -768 767.977 FORMAT "%8.4" ECU_ADDRESS 0x381FC0 /end MEASUREMENT
/begin MEASUREMENT drlm_w "Soll- Istwertdifferenz des Luftmassenreglers" SWORD rel_sw_q0p0234 1 100 -768 767.977 FORMAT "%8.4" ECU_ADDRESS 0x381FC2 /end MEASUREMENT
/begin MEASUREMENT drlsolmf_w "delta Sollfüllung für medianfilter" UWORD rel_uw_q0p0234 1 100 0 1535.98 FORMAT "%8.3" ECU_ADDRESS 0x381FCC /end MEASUREMENT
/begin MEASUREMENT dvfgr_w "Regelabweichung beim FGR" SWORD vfzg_sw_q0p00781 1 100 -256 255.992 FORMAT "%8.4" ECU_ADDRESS 0x381E74 /end MEASUREMENT
/begin MEASUREMENT dvivr_w "Differenz zwischen Ist- und Sollgeschwindigkeit beim FGR" UWORD vfzg_uw_q0p00781 1 100 0 511.992 FORMAT "%8.4" ECU_ADDRESS 0x381E76 /end MEASUREMENT
/begin MEASUREMENT dvzi_w "Differenz zwischen Ziel- und Istgeschwindigkeit" UWORD vfzg_uw_q0p0078125 1 100 0 511.992 FORMAT "%8.4" ECU_ADDRESS 0x381E6C /end MEASUREMENT
/begin MEASUREMENT dvzvi_w "Differenz zwischen Ziel- und Istgeschwindigkeit" SWORD vfzg_sw_q0p00781 1 100 -256 255.992 FORMAT "%8.4" ECU_ADDRESS 0x381E78 /end MEASUREMENT
/begin MEASUREMENT dwdkba_w "Gradient DK-Winkel" SWORD relDK_q0p02441 1 100 -800 799.976 FORMAT "%8.4" ECU_ADDRESS 0x381D24 /end MEASUREMENT
/begin MEASUREMENT dwdksumx_w "Delta Sollwinkel Drosselklappe Beginn ungedrosselt bis Maximum" UWORD rel_uw_b100 1 100 0 99.9985 FORMAT "%8.5" ECU_ADDRESS 0x384ADE /end MEASUREMENT
/begin MEASUREMENT dwdksut_w "Delta Sollwinkel Drosselklappe ab Beginn ungedrosselt bei Turbo motor" UWORD rel_uw_b100 1 100 0 99.9985 FORMAT "%8.5" ECU_ADDRESS 0x381FCE /end MEASUREMENT
/begin MEASUREMENT dwdks_w "Änderung des Drosselklappen-Sollwinkels" UWORD relDK_uw_b100 1 100 0 100 FORMAT "%8.4" ECU_ADDRESS 0x382040 /end MEASUREMENT
/begin MEASUREMENT dwfk_w "Wandfilmmengendifferenz Kurzzeitanteil" SWORD rel_sw_q0p1875 1 100 -6144 6143.81 FORMAT "%8.3" ECU_ADDRESS 0x38214C /end MEASUREMENT
/begin MEASUREMENT dwfl_w "Wandfilmmengendifferenz Langzeitanteil" SWORD rel_sw_q0p1875 1 100 -6144 6143.81 FORMAT "%8.3" ECU_ADDRESS 0x38214E /end MEASUREMENT
/begin MEASUREMENT dwf_w "Wandfilmmengendifferenz" SWORD rel_sw_q0p1875 1 100 -6144 6143.81 FORMAT "%8.3" ECU_ADDRESS 0x382150 /end MEASUREMENT
/begin MEASUREMENT edge_ctr "Index der Phasenflanke bei erkannter Schnellstartposition" SBYTE dez 1 100 -128 127 FORMAT "%5.1" ECU_ADDRESS 0xF8C0 /end MEASUREMENT
/begin MEASUREMENT ESSTTbits "Bits zur Funktion Start" UBYTE dez 1 100 0 255 FORMAT "%5.1" ECU_ADDRESS 0x383331 /end MEASUREMENT
/begin MEASUREMENT esst_snm08gkub "" UWORD dez 1 100 0 65535 FORMAT "%8.2" ECU_ADDRESS 0x384AFE /end MEASUREMENT
/begin MEASUREMENT esst_srl08gkub "" UWORD dez 1 100 0 65535 FORMAT "%8.2" ECU_ADDRESS 0x384B00 /end MEASUREMENT
/begin MEASUREMENT fawifgr_w "Fahrwiderstand für FGR" SWORD rel_q0p249 1 100 -8159.23 8158.98 FORMAT "%8.3" ECU_ADDRESS 0x381E7A /end MEASUREMENT
/begin MEASUREMENT fbakl_w "Faktor K- und L-Anteil der ÜK bei BA" SWORD fak_sw_b256 1 100 -256 255.992 FORMAT "%8.4" ECU_ADDRESS 0x384B40 /end MEASUREMENT
/begin MEASUREMENT fbans "Nachstartfaktor der ÜK bei BA" UBYTE fak_ub_b8 1 100 0 7.96875 FORMAT "%5.3" ECU_ADDRESS 0x384890 /end MEASUREMENT
/begin MEASUREMENT fbans_w "Nachstartfaktor der ÜK bei BA" UWORD fak_uw_b8 1 100 0 7.99988 FORMAT "%8.6" ECU_ADDRESS 0x384B42 /end MEASUREMENT
/begin MEASUREMENT fbavst_w "Faktor ÜK-Verstellung bei Beschleunigungsanreicherung" SWORD fak_sw_b256 1 100 -256 255.992 FORMAT "%8.4" ECU_ADDRESS 0x384B44 /end MEASUREMENT
/begin MEASUREMENT fgrbesilokbits "" UBYTE dez 1 100 0 255 FORMAT "%5.1" ECU_ADDRESS 0x3809BB /end MEASUREMENT
/begin MEASUREMENT fgrfulolokbits "" UBYTE dez 1 100 0 255 FORMAT "%5.1" ECU_ADDRESS 0x3809BE /end MEASUREMENT
/begin MEASUREMENT fgrreglausbits "" UBYTE dez 1 100 0 255 FORMAT "%5.1" ECU_ADDRESS 0x3809C3 /end MEASUREMENT
/begin MEASUREMENT fgrregllokbits "" UBYTE dez 1 100 0 255 FORMAT "%5.1" ECU_ADDRESS 0x3809C4 /end MEASUREMENT
/begin MEASUREMENT fho "Korrekturfaktor Höhe" UBYTE fak_ub_b4 1 100 0 3.98438 FORMAT "%5.3" ECU_ADDRESS 0x384868 /end MEASUREMENT
/begin MEASUREMENT fho_w "Korrekturfaktor Höhe (word)" UWORD fak_uw_b4 1 100 0 3.99994 FORMAT "%8.6" ECU_ADDRESS 0x384ABE /end MEASUREMENT
/begin MEASUREMENT fkhfm "HFM-Korrekturfaktor" UBYTE fak_ub_b2 1 100 0 1.99219 FORMAT "%5.3" ECU_ADDRESS 0x3809C7 /end MEASUREMENT
/begin MEASUREMENT fklafs_w "Faktor Ausfluß (KLAF) für wdks Bestimmung" UWORD fak_uw_b1 1 100 0 0.999985 FORMAT "%9.7" ECU_ADDRESS 0x381FD0 /end MEASUREMENT
/begin MEASUREMENT fkukaba2_w "Korrekturfaktor ÜK-Adaption BA Bank 2" UWORD fak_uw_b4 1 100 0 3.99994 FORMAT "%8.6" ECU_ADDRESS 0x3821C0 /end MEASUREMENT
/begin MEASUREMENT fkukaba_w "Korrekturfaktor ÜK-Adaption BA" UWORD fak_uw_b4 1 100 0 3.99994 FORMAT "%8.6" ECU_ADDRESS 0x3821C2 /end MEASUREMENT
/begin MEASUREMENT fkukas_w "Korrekturfaktor aufsummiert ÜK-Adaption" UWORD fak_q0p0625 1 100 0 4095.94 FORMAT "%8.3" ECU_ADDRESS 0x3821C4 /end MEASUREMENT
/begin MEASUREMENT fkukava2_w "Korrekturfaktor ÜK-Adaption VA Bank 2" UWORD fak_uw_b4 1 100 0 3.99994 FORMAT "%8.6" ECU_ADDRESS 0x3821C6 /end MEASUREMENT
/begin MEASUREMENT fkukava_w "Korrekturfaktor ÜK-Adaption VA" UWORD fak_uw_b4 1 100 0 3.99994 FORMAT "%8.6" ECU_ADDRESS 0x3821C8 /end MEASUREMENT
/begin MEASUREMENT flamsba_w "Faktor Lambdasoll bei Beschleunigungsanreicherung" UWORD fak_uw_b16 1 100 0 15.9998 FORMAT "%8.5" ECU_ADDRESS 0x384B9E /end MEASUREMENT
/begin MEASUREMENT flamsva_w "Faktor Lambdasoll bei Verzögerungsabmagerung" UWORD fak_uw_b16 1 100 0 15.9998 FORMAT "%8.5" ECU_ADDRESS 0x384BA0 /end MEASUREMENT
/begin MEASUREMENT fpvdkds "Faktor Druck vor Drosselklappe von Drucksensor" UBYTE fak_ub_b4 1 100 0 3.98438 FORMAT "%5.3" ECU_ADDRESS 0x3809CD /end MEASUREMENT
/begin MEASUREMENT fpvdkdsl_w "Faktor Druck vor Drosselklappe von Ladedrucksensor (word)" UWORD fak_uw_b4 1 100 0 3.99994 FORMAT "%8.6" ECU_ADDRESS 0x381F5E /end MEASUREMENT
/begin MEASUREMENT fpvdkdsu_w "Faktor Druck vor Drosselklappe von Umgebungsdrucksensor (word)" UWORD fak_uw_b4 1 100 0 3.99994 FORMAT "%8.6" ECU_ADDRESS 0x384AC0 /end MEASUREMENT
/begin MEASUREMENT fpvdkds_w "Faktor Druck vor Drosselklappe von Drucksensor (word)" UWORD fak_uw_b4 1 100 0 3.99994 FORMAT "%8.6" ECU_ADDRESS 0x381F60 /end MEASUREMENT
/begin MEASUREMENT frhodkr_w "Faktor Luftdichtekorrektur für DK-Durchfluß korrigiert (word)" UWORD fak_uw_b2 1 100 0 1.99997 FORMAT "%8.6" ECU_ADDRESS 0x381FD2 /end MEASUREMENT
/begin MEASUREMENT frhol_w "Faktor Luftdichte f(Ansauglufttemp., Höhe) 16-Bit" UWORD fak_uw_b2 1 100 0 1.99997 FORMAT "%8.6" ECU_ADDRESS 0x384AC2 /end MEASUREMENT
/begin MEASUREMENT fst0_w "Vorgesteuerter Startfaktor 16 Bit" UWORD fak_uw_b64 1 100 0 63.999 FORMAT "%8.5" ECU_ADDRESS 0x3820FA /end MEASUREMENT
/begin MEASUREMENT fst_w "Faktor Starteinspritzung" UWORD fak_uw_b64 1 100 0 63.999 FORMAT "%8.5" ECU_ADDRESS 0x3820FC /end MEASUREMENT
/begin MEASUREMENT fuedkLocalBits "" UBYTE dez 1 100 0 255 FORMAT "%5.1" ECU_ADDRESS 0x3809D1 /end MEASUREMENT
/begin MEASUREMENT fuepmld_w "faktor für gleitenden Übergang Druckmittelwert (Referenzdruck) bei Turbo" UWORD fak_uw_b1 1 100 0 0.999985 FORMAT "%9.7" ECU_ADDRESS 0x384AE0 /end MEASUREMENT
/begin MEASUREMENT fukabak_w "ÜK-Adaptionsfaktor (kalter Motor) BA" UWORD fak_uw_b4 1 100 0 3.99994 FORMAT "%8.6" ECU_ADDRESS 0x383CA2 /end MEASUREMENT
/begin MEASUREMENT fukabaw_w "ÜK-Adaptionsfaktor (warmer Motor) BA" UWORD fak_uw_b4 1 100 0 3.99994 FORMAT "%8.6" ECU_ADDRESS 0x383CA4 /end MEASUREMENT
/begin MEASUREMENT fukaba_w "ÜK-Adaptions-Faktor BA" UWORD fak_uw_b4 1 100 0 3.99994 FORMAT "%8.6" ECU_ADDRESS 0x384BA2 /end MEASUREMENT
/begin MEASUREMENT fukavak_w "ÜK-Adaptionsfaktor (kalter Motor) VA" UWORD fak_uw_b4 1 100 0 3.99994 FORMAT "%8.6" ECU_ADDRESS 0x383CA6 /end MEASUREMENT
/begin MEASUREMENT fukavaw_w "ÜK-Adaptionsfaktor (warmer Motor) VA" UWORD fak_uw_b4 1 100 0 3.99994 FORMAT "%8.6" ECU_ADDRESS 0x383CA8 /end MEASUREMENT
/begin MEASUREMENT fukava_w "ÜK-Adaptions-Faktor VA" UWORD fak_uw_b4 1 100 0 3.99994 FORMAT "%8.6" ECU_ADDRESS 0x384BA4 /end MEASUREMENT
/begin MEASUREMENT fvaklw_w "Faktor K- und L-Anteil der ÜK bei VA, gewichtet lambdaabhängigem Faktor fvaladif" SWORD fak_sw_b256 1 100 -256 255.992 FORMAT "%8.4" ECU_ADDRESS 0x382152 /end MEASUREMENT
/begin MEASUREMENT fvakl_w "Faktor K- und L-Anteil der ÜK bei VA" SWORD fak_sw_b256 1 100 -256 255.992 FORMAT "%8.4" ECU_ADDRESS 0x384B46 /end MEASUREMENT
/begin MEASUREMENT fvaladif "Wichtungsfaktor Verzögerungsabmagerung bei Labdaist > 1.0" UBYTE fak_ub_b1 1 100 0 0.996094 ECU_ADDRESS 0x380A05 /end MEASUREMENT
/begin MEASUREMENT fvans "Nachstartfaktor der ÜK bei VA" UBYTE fak_ub_b8 1 100 0 7.96875 FORMAT "%5.3" ECU_ADDRESS 0x384891 /end MEASUREMENT
/begin MEASUREMENT fvavst_w "Faktor ÜK-Verstellung bei Verzögerungsabmagerung" SWORD fak_sw_b256 1 100 -256 255.992 FORMAT "%8.4" ECU_ADDRESS 0x384B48 /end MEASUREMENT
/begin MEASUREMENT fwe "Faktor Wiedereinsetzen" UBYTE fak_ub_b2 1 100 0 1.99219 FORMAT "%5.3" ECU_ADDRESS 0x380A02 /end MEASUREMENT
/begin MEASUREMENT gaptooth "Stand des Zahnzählers zur Lückenabfrage" UBYTE dez 1 100 0 255 FORMAT "%5.1" ECU_ADDRESS 0xF8C1 /end MEASUREMENT
/begin MEASUREMENT GGCTOLausbits1 "" UBYTE dez 1 100 0 255 FORMAT "%5.1" ECU_ADDRESS 0x3808E4 /end MEASUREMENT
/begin MEASUREMENT ggdpgBitsKgs "" UBYTE dez 1 100 0 255 FORMAT "%5.1" ECU_ADDRESS 0x38092A /end MEASUREMENT
/begin MEASUREMENT GgdsasNvBits "" UBYTE dez 1 100 0 255 FORMAT "%5.1" ECU_ADDRESS 0x38332C /end MEASUREMENT
/begin MEASUREMENT GGFGRHlokbits0 "" UBYTE dez 1 100 0 255 FORMAT "%5.1" ECU_ADDRESS 0x380970 /end MEASUREMENT
/begin MEASUREMENT GGFSTbits "Bit-Basis fuer NC-Variablen in der GGFST" UBYTE dez 1 100 0 255 FORMAT "%5.1" ECU_ADDRESS 0x383327 /end MEASUREMENT
/begin MEASUREMENT GGHLAausbits1 "" UBYTE dez 1 100 0 255 FORMAT "%5.1" ECU_ADDRESS 0x380B8A /end MEASUREMENT
/begin MEASUREMENT kfgr_w "Verstärkungsfaktor FGR-Regler" UWORD rel_uw_b3200 1 100 0 3199.95 FORMAT "%8.3" ECU_ADDRESS 0x381E7C /end MEASUREMENT
/begin MEASUREMENT kl_twstt_w "Ausgang Kennlinie TWSTT" UWORD t1sxs_uw_q1 1 100 0 65535 FORMAT "%8.2" ECU_ADDRESS 0x384B2C /end MEASUREMENT
/begin MEASUREMENT lamsbguk "lamsbg_w zur KF-Adressierung in der ESUK" UBYTE fak_ub_b4 1 100 0 3.98438 FORMAT "%5.3" ECU_ADDRESS 0x380A06 /end MEASUREMENT
/begin MEASUREMENT ldfki_w "Ladedruck Filterzeitkonstante aus Kennfeld" UWORD zk10msxs_uw_b655 1 100 0.0100002 655.36 FORMAT "%12.8" ECU_ADDRESS 0x381F62 /end MEASUREMENT
/begin MEASUREMENT len_hiseg "Länge des letzten 'high' Phasensegmentes im Schnellstart" UBYTE dez 1 100 0 255 FORMAT "%5.1" ECU_ADDRESS 0xF8C2 /end MEASUREMENT
/begin MEASUREMENT len_loseg "Länge des letzten 'low' Phasensegmentes im Schnellstart" UBYTE dez 1 100 0 255 FORMAT "%5.1" ECU_ADDRESS 0xF8C3 /end MEASUREMENT
/begin MEASUREMENT miasrllk "indiziertes Soll-Motormoment für langsamen ASR-Eingriff" UBYTE rel_ub_b99p6 1 100 0 99.6094 FORMAT "%5.2" ECU_ADDRESS 0x3808DD /end MEASUREMENT
/begin MEASUREMENT miasrl_can "Anforderung ""langsamer ASR-Eingriff"" über CAN" UBYTE rel_ub_b99p6 1 100 0 99.6094 FORMAT "%5.2" ECU_ADDRESS 0x3808DE /end MEASUREMENT
/begin MEASUREMENT miasrl_w "Indiziertes Soll-Motormoment ASR für langsamen Eingriff" UWORD rel_uw_b100 1 100 0 99.9985 FORMAT "%8.5" ECU_ADDRESS 0x380F64 /end MEASUREMENT
/begin MEASUREMENT miasrslk "indiziertes Soll-Motormoment für schnellen ASR-Eingriff" UBYTE rel_ub_b99p6 1 100 0 99.6094 FORMAT "%5.2" ECU_ADDRESS 0x3808DF /end MEASUREMENT
/begin MEASUREMENT miasrs_can "Anforderung ""schneller ASR-Eingriff"" über CAN" UBYTE rel_ub_b99p6 1 100 0 99.6094 FORMAT "%5.2" ECU_ADDRESS 0x3808E0 /end MEASUREMENT
/begin MEASUREMENT miasrs_w "Indiziertes Soll-Motormoment ASR für schnellen Eingriff" UWORD rel_uw_b100 1 100 0 99.9985 FORMAT "%8.5" ECU_ADDRESS 0x380F66 /end MEASUREMENT
/begin MEASUREMENT mimsrlk "MSR-Eingriffsmoment" UBYTE rel_ub_b99p6 1 100 0 99.6094 FORMAT "%5.2" ECU_ADDRESS 0x3808E1 /end MEASUREMENT
/begin MEASUREMENT mimsr_can "MSR-Wunsch über CAN" UBYTE rel_ub_b99p6 1 100 0 99.6094 FORMAT "%5.2" ECU_ADDRESS 0x3808E2 /end MEASUREMENT
/begin MEASUREMENT mimsr_w "Indiziertes Soll-Motormoment MSR" UWORD rel_uw_b100 1 100 0 99.9985 FORMAT "%8.5" ECU_ADDRESS 0x380F68 /end MEASUREMENT
/begin MEASUREMENT mlhfma_w "Luftmassenabtastwert von HFM 16-Bit" UWORD m_uw_b6553p5 1 100 0 6553.5 FORMAT "%8.3" ECU_ADDRESS 0xF9A0 /end MEASUREMENT
/begin MEASUREMENT mlhfmm_w "Luftmassen HFM-Mittelwert 16Bit-Wert" UWORD m_uw_b6553p5 1 100 0 6553.5 FORMAT "%8.3" ECU_ADDRESS 0xF9A2 /end MEASUREMENT
/begin MEASUREMENT mlkge_w "Eingang in Kennfeld KLDPDK" UWORD m_uw_b6553p5 1 100 0 6553.5 FORMAT "%8.3" ECU_ADDRESS 0x384AE2 /end MEASUREMENT
/begin MEASUREMENT mlsol_w "Soll-Luftmassenstrom" UWORD m_uw_b6553p5 1 100 0 6553.5 FORMAT "%8.3" ECU_ADDRESS 0x381FD4 /end MEASUREMENT
/begin MEASUREMENT mlwdknf_w "gefilterter normierter Luftmassenstrom für Sollwinkelbestimmung Drosselklappe" UWORD m_uw_b6553p5 1 100 0 6553.5 FORMAT "%8.3" ECU_ADDRESS 0x381FD6 /end MEASUREMENT
/begin MEASUREMENT mrfgri_w "Relatives Moment Initialisierungswert für FGR-Regler" UWORD rel_uw_b200 1 100 0 199.997 FORMAT "%8.4" ECU_ADDRESS 0x381E7E /end MEASUREMENT
/begin MEASUREMENT mrfgr_w "Relative Momentenanforderung von FGR" UWORD rel_uw_b200 1 100 0 199.997 FORMAT "%8.4" ECU_ADDRESS 0x381E80 /end MEASUREMENT
/begin MEASUREMENT msdks_w "Soll-Luftmassenstrom durch Drosselvorrichtung" UWORD m_uw_b6553p5 1 100 0 6553.5 FORMAT "%8.3" ECU_ADDRESS 0x381FD8 /end MEASUREMENT
/begin MEASUREMENT mshfm1_w "Massenstrom HFM 16-Bit Größe (1.HFM)" SWORD m_sw_b3276p8 1 100 -3276.8 3276.7 FORMAT "%8.3" ECU_ADDRESS 0xF9A4 /end MEASUREMENT
/begin MEASUREMENT mshfms_w "Massenstrom HFM (signed Größe)" SWORD m_sw_b3276p8 1 100 -3276.8 3276.7 FORMAT "%8.3" ECU_ADDRESS 0xF9A6 /end MEASUREMENT
/begin MEASUREMENT mshfm_w "Massenstrom HFM 16-Bit Größe" UWORD m_uw_b6553p5 1 100 0 6553.5 FORMAT "%8.3" ECU_ADDRESS 0xF9A8 /end MEASUREMENT
/begin MEASUREMENT msndkoos_w "Normierter Luftmassenstrom für Sollwinkelbestimmung Drosselklappe" UWORD m_uw_b6553p5 1 100 0 6553.5 FORMAT "%8.3" ECU_ADDRESS 0x381FDA /end MEASUREMENT
/begin MEASUREMENT msndks_w "Normierter Soll-Luftmassenstrom durch Drosselvorrichtung" UWORD m_uw_b6553p5 1 100 0 6553.5 FORMAT "%8.3" ECU_ADDRESS 0x381FDC /end MEASUREMENT
/begin MEASUREMENT msrmdt_w "Inhalt des MSR-Plausibilitätstopfes" SWORD mdt_sw_b2556 1 100 -2556 2555.92 FORMAT "%8.3" ECU_ADDRESS 0x380F6A /end MEASUREMENT
/begin MEASUREMENT nsynggdpg "Neusynchronisationsmonitor für GGDPG" UBYTE dez 1 100 0 255 FORMAT "%5.1" ECU_ADDRESS 0x38092B /end MEASUREMENT
/begin MEASUREMENT plsol "Soll-Ladedruck" UBYTE p_ub_q10 1 100 0 2550 FORMAT "%5.0" ECU_ADDRESS 0x3809D2 /end MEASUREMENT
/begin MEASUREMENT plsol_w "Soll-Ladedruck" UWORD p_uw_q0p039 1 100 0 2559.96 FORMAT "%8.3" ECU_ADDRESS 0x381FDE /end MEASUREMENT
/begin MEASUREMENT psfil_w "gefilterter Saugrohdruck für KLAF-Berechnung in FUEDK" UWORD p_uw_q0p039 1 100 0 2559.96 FORMAT "%8.3" ECU_ADDRESS 0x381FE0 /end MEASUREMENT
/begin MEASUREMENT pspvmin_w "Minimalauswahl aus pspvdk und psspvdk" UWORD fak_uw_b2 1 100 0 1.99997 FORMAT "%8.6" ECU_ADDRESS 0x381FE2 /end MEASUREMENT
/begin MEASUREMENT pssol_w "Sollsaugrohrdruck" UWORD p_uw_q0p039 1 100 0 2559.96 FORMAT "%8.3" ECU_ADDRESS 0x381FE4 /end MEASUREMENT
/begin MEASUREMENT psspvdkb_w "Verhältnis Soll-Saugrohrdruck zu Druck vor Drosselklappe begrenzt" UWORD fak_uw_b2 1 100 0 1.99997 FORMAT "%8.6" ECU_ADDRESS 0x381FE6 /end MEASUREMENT
/begin MEASUREMENT psspvdkd_w "Verhältnis Sollsaugrohrdruck/Druck vor Drosselklappe von Drucksensor (word)" UWORD fak_uw_b4 1 100 0 3.99994 FORMAT "%8.6" ECU_ADDRESS 0x381F64 /end MEASUREMENT
/begin MEASUREMENT psspvdk_w "Verhältnis Soll-Saugrohrdruck zu Druck vor Drosselklappe" UWORD fak_uw_b2 1 100 0 1.99997 FORMAT "%8.6" ECU_ADDRESS 0x381FE8 /end MEASUREMENT
/begin MEASUREMENT pte "Tankdifferenzdruck, Eingangssignal, (nach AD-Wandler)" SBYTE p_sb_q0p25 1 100 -32 31.75 FORMAT "%5.2" ECU_ADDRESS 0x380B42 /end MEASUREMENT
/begin MEASUREMENT pterw "Tankdruckrohwert (8 Bit)" SBYTE p_sb_q0p625 1 100 -80 79.375 FORMAT "%5.2" ECU_ADDRESS 0x380B43 /end MEASUREMENT
/begin MEASUREMENT pterw_w "Tankdruckrohwert (16 Bit)" SWORD p_sw_q0p00244 1 100 -80 79.9976 FORMAT "%8.5" ECU_ADDRESS 0x382B52 /end MEASUREMENT
/begin MEASUREMENT pte_w "Tankdifferenzdruck (16 Bit)" SWORD p_sw_q0p000977 1 100 -32 31.999 FORMAT "%8.5" ECU_ADDRESS 0x382B54 /end MEASUREMENT
/begin MEASUREMENT pu "Umgebungsdruck" UBYTE p_ub_q5 1 100 0 1275 FORMAT "%5.0" ECU_ADDRESS 0x384869 /end MEASUREMENT
/begin MEASUREMENT pus_w "Umgebungsdruck ohne Umschaltung auf Ersatzwert bei Sensorfehler" UWORD p_uw_q0p039 1 100 0 2559.96 FORMAT "%8.3" ECU_ADDRESS 0x384AC4 /end MEASUREMENT
/begin MEASUREMENT pu_w "Umgebungsdruck" UWORD p_uw_q0p039 1 100 0 2559.96 FORMAT "%8.3" ECU_ADDRESS 0x384AC6 /end MEASUREMENT
/begin MEASUREMENT pvdkds "Druck vor Drosselklappe von Drucksensor" UBYTE p_ub_q10 1 100 0 2550 FORMAT "%5.0" ECU_ADDRESS 0x3809CE /end MEASUREMENT
/begin MEASUREMENT pvdkdsl_w "Druck vor Drosselklappe von Ladedrucksensor (word)" UWORD p_uw_q0p039 1 100 0 2559.96 FORMAT "%8.3" ECU_ADDRESS 0x381F66 /end MEASUREMENT
/begin MEASUREMENT pvdkdsu_w "Druck vor Drosselklappe von Umgebungsdrucksensor (word)" UWORD p_uw_q0p039 1 100 0 2559.96 FORMAT "%8.3" ECU_ADDRESS 0x384AC8 /end MEASUREMENT
/begin MEASUREMENT pvdkds_w "Druck vor Drosselklappe von Drucksensor (word)" UWORD p_uw_q0p039 1 100 0 2559.96 FORMAT "%8.3" ECU_ADDRESS 0x381F68 /end MEASUREMENT
/begin MEASUREMENT pvdkmx_w "Maximaler Druck vor Drosselklappe Ausgangswert aus Kennlinie PVDKMX" UWORD p_uw_q0p039 1 100 0 2559.96 FORMAT "%8.3" ECU_ADDRESS 0x381F6A /end MEASUREMENT
/begin MEASUREMENT pvdkr_w "Referenzdruck vor Drosselklappe" UWORD p_uw_q0p039 1 100 0 2559.96 FORMAT "%8.3" ECU_ADDRESS 0x381FEA /end MEASUREMENT
/begin MEASUREMENT pvdksf_w "gefilterter Druck vor Drosselklappe (Ladedruck) vom Drucksensor" UWORD p_uw_q0p039 1 100 0 2559.96 FORMAT "%8.3" ECU_ADDRESS 0x381F6C /end MEASUREMENT
/begin MEASUREMENT pvdkspud "Differenz zwischen Umgebungsdruck und Druck vor Drosselklappe" UBYTE p_ub_q10 1 100 0 2550 FORMAT "%5.0" ECU_ADDRESS 0x38486A /end MEASUREMENT
/begin MEASUREMENT pvdks_w "Druck vor Drosselklappe ohne Umschaltung auf Ersatzwert bei Sensorfehler" UWORD p_uw_q0p039 1 100 0 2559.96 FORMAT "%8.3" ECU_ADDRESS 0x381F6E /end MEASUREMENT
/begin MEASUREMENT pwmcs_bits "" UBYTE dez 1 100 0 255 FORMAT "%5.1" ECU_ADDRESS 0x382D18 /end MEASUREMENT
/begin MEASUREMENT pwmcs_nv_bits "" UBYTE dez 1 100 0 255 FORMAT "%5.1" ECU_ADDRESS 0x383450 /end MEASUREMENT
/begin MEASUREMENT qzzyl "Initialisierungswert Zylinderzähler bei B_qsyn" UBYTE dez 1 100 0 255 FORMAT "%5.1" ECU_ADDRESS 0x38092C /end MEASUREMENT
/begin MEASUREMENT rkuke_w "rel. Kraftstoffmasse Übergangskompensation Ersatzwert" SWORD rel_sw_q0p1875 1 100 -6144 6143.81 FORMAT "%8.3" ECU_ADDRESS 0x382154 /end MEASUREMENT
/begin MEASUREMENT rkukg_w "rel. Kraftstoffmasse Übergangskompensation" SWORD rel_sw_b1536 1 100 -1536 1535.95 FORMAT "%8.3" ECU_ADDRESS 0x382156 /end MEASUREMENT
/begin MEASUREMENT rkukkl_w "Kurz- und Langzeitanteil der UK" SWORD rel_sw_q0p1875 1 100 -6144 6143.81 FORMAT "%8.3" ECU_ADDRESS 0x382158 /end MEASUREMENT
/begin MEASUREMENT rkukkt_w "rk-Kurzzeitanteil der UK totzeitverschoben (UK-Adaption)" SWORD rel_sw_q0p1875 1 100 -6144 6143.81 FORMAT "%8.3" ECU_ADDRESS 0x3821CA /end MEASUREMENT
/begin MEASUREMENT rkukk_w "rk-Kurzzeitanteil der UK" SWORD rel_sw_q0p1875 1 100 -6144 6143.81 FORMAT "%8.3" ECU_ADDRESS 0x38215A /end MEASUREMENT
/begin MEASUREMENT rkukl_w "rk-Langzeitanteil der UK" SWORD rel_sw_q0p1875 1 100 -6144 6143.81 FORMAT "%8.3" ECU_ADDRESS 0x38215C /end MEASUREMENT
/begin MEASUREMENT rkuk_w "rel. Kraftstoffmasse Übergangskompensation ohne Verstelleingriffe" SWORD rel_sw_q0p1875 1 100 -6144 6143.81 FORMAT "%8.3" ECU_ADDRESS 0x38215E /end MEASUREMENT
/begin MEASUREMENT rlfgks_w "Korrigierte relative  Sollfrischluft (Luft, die über DK und TEV fließt)" UWORD rel_uw_q0p0234 1 100 0 1535.98 FORMAT "%8.3" ECU_ADDRESS 0x381FEC /end MEASUREMENT
/begin MEASUREMENT rlshk "Soll-Füllung höhenkorrigiert" UBYTE rel_ub_q0p75 1 100 0 191.25 FORMAT "%5.1" ECU_ADDRESS 0x384873 /end MEASUREMENT
/begin MEASUREMENT rlshk_w "Soll-Füllung höhenkorrigiert" UWORD rel_uw_q0p0234 1 100 0 1535.98 FORMAT "%8.3" ECU_ADDRESS 0x38202C /end MEASUREMENT
/begin MEASUREMENT rlvppl "Relative Luftfüllung (dichtekorrigiert) für Berechnung DK-Winkel-Ersatzwert" UBYTE rel_ub_q0p75 1 100 0 191.25 FORMAT "%5.1" ECU_ADDRESS 0x38097F /end MEASUREMENT
/begin MEASUREMENT sdwfk_w "Speicherinhalt der Wandfilmdifferenz für Kurzzeitanteil" SWORD rel_sw_q0p1875 1 100 -6144 6143.81 FORMAT "%8.3" ECU_ADDRESS 0x382160 /end MEASUREMENT
/begin MEASUREMENT sdwfl_w "Speicherinhalt der Wandfilmdifferenz für Langzeitanteil" SWORD rel_sw_q0p1875 1 100 -6144 6143.81 FORMAT "%8.3" ECU_ADDRESS 0x382162 /end MEASUREMENT
/begin MEASUREMENT stateQsyn "Zustand der Schnellstart State-Machine GEN_QSYN" UBYTE dez 1 100 0 255 FORMAT "%5.1" ECU_ADDRESS 0xF8C4 /end MEASUREMENT
/begin MEASUREMENT stfgrab_w "Statuswort Abschaltbedingungen Fahrgeschwindigkeitsregler" UWORD dez 1 100 0 65535 FORMAT "%8.2" ECU_ADDRESS 0x381E58 /end MEASUREMENT
/begin MEASUREMENT stfgrbs_w "Statuswort Bediensignale Fahrgeschwindigkeitsregler" UWORD dez 1 100 0 65535 FORMAT "%8.2" ECU_ADDRESS 0x381E64 /end MEASUREMENT
/begin MEASUREMENT stfgrfl "Statusbyte FGR-Funktionslogik" UBYTE dez 1 100 0 255 FORMAT "%5.1" ECU_ADDRESS 0x3809BF /end MEASUREMENT
/begin MEASUREMENT taats2_w "Tastverhältnis Abgastemperatursensor Bank 2" UWORD rel_uw_b100 1 100 0 99.9985 FORMAT "%8.5" ECU_ADDRESS 0x384B82 /end MEASUREMENT
/begin MEASUREMENT taats_w "Tastverhältnis Abgastemperatursensor" UWORD rel_uw_b100 1 100 0 99.9985 FORMAT "%8.5" ECU_ADDRESS 0x384B84 /end MEASUREMENT
/begin MEASUREMENT tabg2_w "Abgastemperatur Bank 2" UWORD temp_uw_q0p0195_o50 1 100 -50 1229.98 FORMAT "%8.3" ECU_ADDRESS 0x384B86 /end MEASUREMENT
/begin MEASUREMENT tabgta_kge "" UWORD rel_uw_b100 1 100 0 99.9985 FORMAT "%8.5" ECU_ADDRESS 0x384B88 /end MEASUREMENT
/begin MEASUREMENT tabg_w "Abgastemperatur" UWORD temp_uw_q0p0195_o50 1 100 -50 1229.98 FORMAT "%8.3" ECU_ADDRESS 0x384B8A /end MEASUREMENT
/begin MEASUREMENT tats2_w "Abgastemperatur aus Sensor Bank 2" UWORD temp_uw_q0p0195_o50 1 100 -50 1229.98 FORMAT "%8.3" ECU_ADDRESS 0x384B8C /end MEASUREMENT
/begin MEASUREMENT tats_w "Abgastemperatur aus Sensor" UWORD temp_uw_q0p0195_o50 1 100 -50 1229.98 FORMAT "%8.3" ECU_ADDRESS 0x384B8E /end MEASUREMENT
/begin MEASUREMENT tfwdks_w "Zeitkonstante für wdks Filterung" UWORD zk10msxs_uw_b655 1 100 0.0100002 655.36 FORMAT "%12.8" ECU_ADDRESS 0x381FEE /end MEASUREMENT
/begin MEASUREMENT timtalr_w "Timer für Verzögerung Reset Bit Tank leer" UWORD t200msxs_uw_q0p2 1 100 0 13107 FORMAT "%8.2" ECU_ADDRESS 0x384A84 /end MEASUREMENT
/begin MEASUREMENT timtals_w "Timer für Verzögerung Setzen Bit Tank leer" UWORD t200msxs_uw_q0p2 1 100 0 13107 FORMAT "%8.2" ECU_ADDRESS 0x384A86 /end MEASUREMENT
/begin MEASUREMENT tmCorCtr_w "Zähler Lückenkorrektur bei fehlendem Zahn" UWORD dez 1 100 0 65535 FORMAT "%8.2" ECU_ADDRESS 0x381A06 /end MEASUREMENT
/begin MEASUREMENT tmki "Motortemperatur aus Kombiinstrument" UBYTE temp_ub_q0p75_o48 1 100 -48 143.25 FORMAT "%5.1" ECU_ADDRESS 0x3848B4 /end MEASUREMENT
/begin MEASUREMENT tmnuka "Minimalzeit zwischen 2 Adaptionsvorgängen (ÜK-Adaption)" UWORD t10msxs_ub_b2p55 1 100 0 655.35 FORMAT "%8.4" ECU_ADDRESS 0x3821CC /end MEASUREMENT
/begin MEASUREMENT tn2fgr_w "Doppelte Nennerzeitkonstante FGR-Regler" UWORD t20msxs_uw_q0p02 1 100 0 1310.7 FORMAT "%8.3" ECU_ADDRESS 0x381E82 /end MEASUREMENT
/begin MEASUREMENT tnbm1_w "Zahnperiodenzeit des zweitletzten NBM Signals" UWORD dez 1 100 0 65535 FORMAT "%8.2" ECU_ADDRESS 0x381A08 /end MEASUREMENT
/begin MEASUREMENT tnbm2_w "Zahnperiodenzeit des drittletzten NBM Signals" UWORD dez 1 100 0 65535 FORMAT "%8.2" ECU_ADDRESS 0x381A0A /end MEASUREMENT
/begin MEASUREMENT tnbm_w "Zahnperiodenzeit des letzten NBM Signals" UWORD dez 1 100 0 65535 FORMAT "%8.2" ECU_ADDRESS 0x381A0C /end MEASUREMENT
/begin MEASUREMENT tpats "Periodendauer Abgastemperatursensor" UBYTE t100msxms_ub_b255 1 100 0 255 FORMAT "%5.1" ECU_ADDRESS 0x38489F /end MEASUREMENT
/begin MEASUREMENT tpats2 "Periodendauer Abgastemperatursensor Bank 2" UBYTE t100msxms_ub_b255 1 100 0 255 FORMAT "%5.1" ECU_ADDRESS 0x3848A0 /end MEASUREMENT
/begin MEASUREMENT tpbauka "Entrellzeit für Erkennung Beschleunigung (ÜK-Adaption)" UBYTE t10msxs_ub_b2p55 1 100 0 2.55 FORMAT "%5.3" ECU_ADDRESS 0x380A0D /end MEASUREMENT
/begin MEASUREMENT tpCorCtr_w "Zähler Lückenkorrektur bei einem zusätzlichen Zahn" UWORD dez 1 100 0 65535 FORMAT "%8.2" ECU_ADDRESS 0x381A0E /end MEASUREMENT
/begin MEASUREMENT tpvauka "Entprellzeit für Erkennung Verzögerung (ÜK-Adaption)" UBYTE t10msxs_ub_b2p55 1 100 0 2.55 FORMAT "%5.3" ECU_ADDRESS 0x380A0E /end MEASUREMENT
/begin MEASUREMENT tpwmcs "Periodendauer PWM- Signal vom Airbag- SG" UBYTE t10msxs_ub_b2p55 1 100 0 2.55 FORMAT "%5.3" ECU_ADDRESS 0x380B8E /end MEASUREMENT
/begin MEASUREMENT tspuka "Sperrzeit für Freigabe der ÜK-Adaption" UBYTE t100msxs_ub_b25p5 1 100 0 25.5 FORMAT "%5.2" ECU_ADDRESS 0x3848A3 /end MEASUREMENT
/begin MEASUREMENT tswk "Zeit für Setzwertkorrektur" UBYTE t20msxs_ub_b5p1 1 100 0 5.1 FORMAT "%5.3" ECU_ADDRESS 0x3809C0 /end MEASUREMENT
/begin MEASUREMENT ttooth10ms "Zähler 10 ms Raster ohne Zahninterrupt" UBYTE dez 1 100 0 255 FORMAT "%5.1" ECU_ADDRESS 0x38092D /end MEASUREMENT
/begin MEASUREMENT tz2fgr_w "Doppelte Zählerzeitkonstante FGR-Regler" UWORD t20msxs_uw_q0p02 1 100 0 1310.7 FORMAT "%8.3" ECU_ADDRESS 0x381E84 /end MEASUREMENT
/begin MEASUREMENT uevges_w "Übersetzungsverhältnis gesamt (Word-Groesse)" UWORD fak_q0p1 1 100 0 6553.5 FORMAT "%8.3" ECU_ADDRESS 0x381E86 /end MEASUREMENT
/begin MEASUREMENT ukafrtmo_w "Obere Schwelle Faktor Lambdaregler (fr) zur Freigabe der UK-Adaption" UWORD fak_uw_b2 1 100 0 1.99997 FORMAT "%8.6" ECU_ADDRESS 0x384BA6 /end MEASUREMENT
/begin MEASUREMENT ukafrtmu_w "Untere Schwelle Faktor Lambdaregler (fr) zur Freigabe der UK-Adaption" UWORD fak_uw_b2 1 100 0 1.99997 FORMAT "%8.6" ECU_ADDRESS 0x384BA8 /end MEASUREMENT
/begin MEASUREMENT upotpwm "PWM-Signal Heizungsanforderung" UBYTE spg_ub_b5 1 100 0 4.98047 FORMAT "%5.3" ECU_ADDRESS 0x384932 /end MEASUREMENT
/begin MEASUREMENT uzkw_w "Kurbelwellen-Umdrehungszähler" UWORD dez 1 100 0 65535 FORMAT "%8.2" ECU_ADDRESS 0x381A10 /end MEASUREMENT
/begin MEASUREMENT vamsr_w "Referenzgeschwindigkeit vom ASR/MSR-Steuergerät" UWORD vfzg_uw_b325 1 100 0 324.995 FORMAT "%8.4" ECU_ADDRESS 0x380F6C /end MEASUREMENT
/begin MEASUREMENT vfgro_w "Geschwindigkeit zur Adressierung von KFVOFFS" UWORD vfzg_uw_q0p0078125 1 100 0 511.992 FORMAT "%8.4" ECU_ADDRESS 0x381E88 /end MEASUREMENT
/begin MEASUREMENT vlast_w "Zusätzliche Offset-Geschwindigkeit für FGR-Regler bei höherer Last" UWORD vfzg_uw_q0p0078125 1 100 0 511.992 FORMAT "%8.4" ECU_ADDRESS 0x381E8A /end MEASUREMENT
/begin MEASUREMENT voffs_w "Offsetgeschwindigkeit für FGR-Regler" UWORD vfzg_uw_q0p0078125 1 100 0 511.992 FORMAT "%8.4" ECU_ADDRESS 0x381E8C /end MEASUREMENT
/begin MEASUREMENT vrad_hl_w "Radgeschwindigkeit hinten links" UWORD vrad_uw_b655 1 100 0 654.99 FORMAT "%8.4" ECU_ADDRESS 0x380F6E /end MEASUREMENT
/begin MEASUREMENT vrad_hr_w "Radgeschwindigkeit hinten rechts" UWORD vrad_uw_b655 1 100 0 654.99 FORMAT "%8.4" ECU_ADDRESS 0x380F70 /end MEASUREMENT
/begin MEASUREMENT vrad_vl_w "Radgeschwindigkeit vorne links" UWORD vrad_uw_b655 1 100 0 654.99 FORMAT "%8.4" ECU_ADDRESS 0x380F72 /end MEASUREMENT
/begin MEASUREMENT vrad_vr_w "Radgeschwindigkeit vorne rechts" UWORD vrad_uw_b655 1 100 0 654.99 FORMAT "%8.4" ECU_ADDRESS 0x380F74 /end MEASUREMENT
/begin MEASUREMENT vregl_w "Sollgeschwindigkeit für FGR-Regler" UWORD vfzg_uw_q0p0078125 1 100 0 511.992 FORMAT "%8.4" ECU_ADDRESS 0x381E6E /end MEASUREMENT
/begin MEASUREMENT vziel_w "Zielgeschwindigkeit FGR" UWORD vfzg_uw_q0p0078125 1 100 0 511.992 FORMAT "%8.4" ECU_ADDRESS 0x381E70 /end MEASUREMENT
/begin MEASUREMENT wdk1 "Drosselklappenwinkel aus Poti 1" UBYTE relDK_ub_b100 1 100 0 100 FORMAT "%5.1" ECU_ADDRESS 0x380980 /end MEASUREMENT
/begin MEASUREMENT wdk1g "DK-Winkel aus Poti 1 begrenzt u. gefiltert für Vergl. mit Ersatzwert aus Füllung" UBYTE relDK_ub_b100 1 100 0 100 FORMAT "%5.1" ECU_ADDRESS 0x380981 /end MEASUREMENT
/begin MEASUREMENT wdk1_w "DK-Winkel aus Poti 1" SWORD relDK_q0p02441 1 100 -800 799.976 FORMAT "%8.4" ECU_ADDRESS 0x381D26 /end MEASUREMENT
/begin MEASUREMENT wdk2 "Drosselklappenwinkel aus Poti 2" UBYTE relDK_ub_b100 1 100 0 100 FORMAT "%5.1" ECU_ADDRESS 0x380982 /end MEASUREMENT
/begin MEASUREMENT wdk2g "DK-Winkel aus Poti 2 begrenzt u. gefiltert für Vergl. mit Ersatzwert aus Füllung" UBYTE relDK_ub_b100 1 100 0 100 FORMAT "%5.1" ECU_ADDRESS 0x380983 /end MEASUREMENT
/begin MEASUREMENT wdk2_w "DK-Winkel aus Poti 2" SWORD relDK_q0p02441 1 100 -800 799.976 FORMAT "%8.4" ECU_ADDRESS 0x381D28 /end MEASUREMENT
/begin MEASUREMENT wdk3 "DK-Winkel-Ersatzwert aus Füllungssignal" UBYTE relDK_ub_b100 1 100 0 100 FORMAT "%5.1" ECU_ADDRESS 0x380984 /end MEASUREMENT
/begin MEASUREMENT wdkba "Drosselklappenwinkel bezogen auf unteren Anschlag" UBYTE relDK_ub_b100 1 100 0 100 FORMAT "%5.1" ECU_ADDRESS 0x380985 /end MEASUREMENT
/begin MEASUREMENT wdkba_w "Drosselklappenwinkel bezogen auf unteren Anschlag" SWORD relDK_q0p02441 1 100 -800 799.976 FORMAT "%8.4" ECU_ADDRESS 0xF92E /end MEASUREMENT
/begin MEASUREMENT wdkink_w "aktuelles Inkrement des DK-Sollwinkels" UWORD relDK_uw_b100 1 100 0 100 FORMAT "%8.4" ECU_ADDRESS 0x382042 /end MEASUREMENT
/begin MEASUREMENT wdkpmx "Maximaler Drosselklappenwinkel für Plausibilisierung mit Füllungssignal" UBYTE relDK_ub_b100 1 100 0 100 FORMAT "%5.1" ECU_ADDRESS 0x380986 /end MEASUREMENT
/begin MEASUREMENT wdks "Sollwert DK-Winkel, bezogen auf unteren Anschlag" UBYTE relDK_ub_b100 1 100 0 100 FORMAT "%5.1" ECU_ADDRESS 0x3809D3 /end MEASUREMENT
/begin MEASUREMENT wdksap_w "DK-Sollwinkel aus Applikationsblock" UWORD rel_uw_b100 1 100 0 99.9985 FORMAT "%8.5" ECU_ADDRESS 0x381FF0 /end MEASUREMENT
/begin MEASUREMENT wdksba2_w "DK-Sollwinkel nach der Begrenzung, Wert aus Rechenraster n-2" UWORD relDK_uw_b100 1 100 0 100 FORMAT "%8.4" ECU_ADDRESS 0x382044 /end MEASUREMENT
/begin MEASUREMENT wdksba_w "DK-Sollwinkel nach der Begrenzung, Wert aus Rechenraster n-1" UWORD relDK_uw_b100 1 100 0 100 FORMAT "%8.4" ECU_ADDRESS 0x382046 /end MEASUREMENT
/begin MEASUREMENT wdksbugd_w "Solldrosselklappenwinkel aus Momentenstruktur auf ungedrosselten Winkel begrenzt" UWORD rel_uw_b100 1 100 0 99.9985 FORMAT "%8.5" ECU_ADDRESS 0x381FF2 /end MEASUREMENT
/begin MEASUREMENT wdksb_w "DK-Sollwinkel nach der Begrenzung" UWORD relDK_uw_b100 1 100 0 100 FORMAT "%8.4" ECU_ADDRESS 0x382048 /end MEASUREMENT
/begin MEASUREMENT wdksfl "Flankenwechselanzeige für DK-Sollwert wdksap_w" SBYTE fak_sb_b1 1 100 -1 0.992188 FORMAT "%5.3" ECU_ADDRESS 0x3809D4 /end MEASUREMENT
/begin MEASUREMENT wdksgv_w "Drosselklappen-Sollwinkel vor Applikationsschnittstelle (gefiltert)" UWORD rel_uw_b100 1 100 0 99.9985 FORMAT "%8.5" ECU_ADDRESS 0x381FF4 /end MEASUREMENT
/begin MEASUREMENT wdksmx_w "max. Sollwert Drosselklappenwinkel" UWORD rel_uw_b100 1 100 0 99.9985 FORMAT "%8.5" ECU_ADDRESS 0x381FF6 /end MEASUREMENT
/begin MEASUREMENT wdkspa_w "prädizierter DK-Winkel, Wert aus Rechenraster n-1" UWORD relDK_uw_b100 1 100 0 100 FORMAT "%8.4" ECU_ADDRESS 0x38204A /end MEASUREMENT
/begin MEASUREMENT wdksp_w "Prädizierter Drosselklappen-Sollwinkel" UWORD relDK_uw_b100 1 100 0 100 FORMAT "%8.4" ECU_ADDRESS 0x38204C /end MEASUREMENT
/begin MEASUREMENT wdksvfl "Flankenwechselanzeige für DK-Sollwert wdksapa_w" SBYTE fak_sb_b1 1 100 -1 0.992188 FORMAT "%5.3" ECU_ADDRESS 0x3809D5 /end MEASUREMENT
/begin MEASUREMENT wdksv_w "Drosselklappen-Sollwinkel vor Applikationsschnittstelle (ungefiltert)" UWORD rel_uw_b100 1 100 0 99.9985 FORMAT "%8.5" ECU_ADDRESS 0x381FF8 /end MEASUREMENT
/begin MEASUREMENT wdkswe_w "DK-Sollwertschwelle für prädiz. Entjitterung" UWORD relDK_uw_b100 1 100 0 100 FORMAT "%8.4" ECU_ADDRESS 0x38204E /end MEASUREMENT
/begin MEASUREMENT wdks_w "Sollwert Drosselklappenwinkel, bezogen auf (unteren) Anschlag" UWORD relDK_uw_b100 1 100 0 100 FORMAT "%8.4" ECU_ADDRESS 0x382050 /end MEASUREMENT
/begin MEASUREMENT wea "Winkelmarke Einspritzabbruch" UBYTE zw_ub_q6 1 100 0 1530 FORMAT "%5.0" ECU_ADDRESS 0x384885 /end MEASUREMENT
/begin MEASUREMENT wee "Winkel Einspritzende im Normalbetrieb" UBYTE zw_ub_q6 1 100 0 1530 FORMAT "%5.0" ECU_ADDRESS 0x3809EB /end MEASUREMENT
/begin MEASUREMENT weemrfa "Winkel Einspritzende im maximalem Fahrerwunschmomment" UBYTE zw_ub_q6 1 100 0 1530 FORMAT "%5.0" ECU_ADDRESS 0x384886 /end MEASUREMENT
/begin MEASUREMENT weenst "Winkel Einspritzende nach Startende" UBYTE zw_ub_q6 1 100 0 1530 FORMAT "%5.0" ECU_ADDRESS 0x384887 /end MEASUREMENT
/begin MEASUREMENT weer "Winkel Einspritzende resultierend" UBYTE kw_q2p8125 1 100 0 717.188 FORMAT "%5.1" ECU_ADDRESS 0x3809EC /end MEASUREMENT
/begin MEASUREMENT weest "Winkel Einspritzende im Start" UBYTE zw_ub_q6 1 100 0 1530 FORMAT "%5.0" ECU_ADDRESS 0x3809ED /end MEASUREMENT
/begin MEASUREMENT wf_w "Wandfilmmenge" SWORD rel_sw_q0p1875 1 100 -6144 6143.81 FORMAT "%8.3" ECU_ADDRESS 0x382164 /end MEASUREMENT
/begin MEASUREMENT wkwbzm0_w "Winkel Kurbelwelle am Nullpunkt des Arbeitsspiels: R_syn & zzyl = 0 (word)" UWORD kw_tooth_sy 1 100 0 393210 FORMAT "%8.1" ECU_ADDRESS 0xF8CA /end MEASUREMENT
/begin MEASUREMENT wkwneg_w "Winkel Kurbelwelle bei negativer Phasenflanke im Schnellstart" UWORD kw_tooth_sy 1 100 0 393210 FORMAT "%8.1" ECU_ADDRESS 0xF8CC /end MEASUREMENT
/begin MEASUREMENT wkwpos_w "Winkel Kurbelwelle bei positiver Phasenflanke im Schnellstart" UWORD kw_tooth_sy 1 100 0 393210 FORMAT "%8.1" ECU_ADDRESS 0xF8CE /end MEASUREMENT
/begin MEASUREMENT wkwstart_w "Winkel Kurbelwelle beim Überschreiten von NMIN im Schnellstart" UWORD kw_tooth_sy 1 100 0 393210 FORMAT "%8.1" ECU_ADDRESS 0xF8D0 /end MEASUREMENT
/begin MEASUREMENT wkwsyn_w "Winkel Kurbelwelle am Beginn des Synchros (word)" UWORD kw_tooth_sy 1 100 0 393210 FORMAT "%8.1" ECU_ADDRESS 0xF7A4 /end MEASUREMENT
/begin MEASUREMENT wkw_w "Winkel Kurbelwelle (word)" UWORD kw_tooth_sy 1 100 0 393210 FORMAT "%8.1" ECU_ADDRESS 0xFE50 /end MEASUREMENT
/begin MEASUREMENT zbake "Abregelfaktor Kurzzeitanteil bei BA" UBYTE fak_q0p0039 1 100 0 0.996094 ECU_ADDRESS 0x384892 /end MEASUREMENT
/begin MEASUREMENT zbale "Abregelfaktor Langzeitanteil bei BA" UBYTE fak_ub_b0p125 1 100 0 0.124512 FORMAT "%6.4" ECU_ADDRESS 0x384893 /end MEASUREMENT
/begin MEASUREMENT zburnsum "Summe erkannter Verbrennungen im Start" UBYTE dez 1 100 0 255 FORMAT "%5.1" ECU_ADDRESS 0x3809FC /end MEASUREMENT
/begin MEASUREMENT zdelay "Zahn-Delay-Zähler im Schnellstart" UBYTE dez 1 100 0 255 FORMAT "%5.1" ECU_ADDRESS 0xF8C5 /end MEASUREMENT
/begin MEASUREMENT znbm_w "Zähler Zahninterrupt (word)" UWORD dez 1 100 0 65535 FORMAT "%8.2" ECU_ADDRESS 0xFE50 /end MEASUREMENT
/begin MEASUREMENT zpwm "Zähler Plausibilitätsprüfung PWM-Signal Periodendauer" UBYTE dez 1 100 0 255 FORMAT "%5.1" ECU_ADDRESS 0x384933 /end MEASUREMENT
/begin MEASUREMENT zpwmd "Zähler Plausibilitätsprüfung PWM-Signal Tastverhältnis" SBYTE dez 1 100 -128 127 FORMAT "%5.1" ECU_ADDRESS 0x384934 /end MEASUREMENT
/begin MEASUREMENT zrph "Zähler Raster Phasensignal" UBYTE dez 1 100 0 255 FORMAT "%5.1" ECU_ADDRESS 0x38092E /end MEASUREMENT
/begin MEASUREMENT zstfgr "Zustand Fahrgeschwindigkeitsregler" UBYTE dez 1 100 0 255 FORMAT "%5.1" ECU_ADDRESS 0x3809C1 /end MEASUREMENT
/begin MEASUREMENT zvake "Abregelfaktor Kurzzeitanteil bei VA" UBYTE fak_q0p0039 1 100 0 0.996094 ECU_ADDRESS 0x384894 /end MEASUREMENT
/begin MEASUREMENT zvale "Abregelfaktor Langzeitanteil bei VA" UBYTE fak_ub_b0p125 1 100 0 0.124512 FORMAT "%6.4" ECU_ADDRESS 0x384895 /end MEASUREMENT
/begin MEASUREMENT zylvirt "Stand Zylinderzähler vor Umsynchronisation aus Schnellstart" UBYTE dez 1 100 0 255 FORMAT "%5.1" ECU_ADDRESS 0x38092F /end MEASUREMENT
/begin MEASUREMENT zzale_ini "Initialisierungswert Zahnzähler zzseg bei aktiver Auslauferkennung (B_ale)" UBYTE dez 1 100 0 255 FORMAT "%5.1" ECU_ADDRESS 0x380930 /end MEASUREMENT
/begin MEASUREMENT zzseg "Zahnzähler im Segment" UBYTE dez 1 100 0 255 FORMAT "%5.1" ECU_ADDRESS 0xFEC4 /end MEASUREMENT
/begin MEASUREMENT zztab "Zahnzeitentabelle" UWORD dez 1 100 0 65535 FORMAT "%8.2" ARRAY_SIZE 34 ECU_ADDRESS 0xF8D2 /end MEASUREMENT
/begin MEASUREMENT zzvirt "virtueller Zahnzähler im Start bis zur Synchronisation" UBYTE dez 1 100 0 255 FORMAT "%5.1" ECU_ADDRESS 0x380931 /end MEASUREMENT
/begin MEASUREMENT zzyl "SW-Zylinderzähler" UBYTE dez 1 100 0 255 FORMAT "%5.1" ECU_ADDRESS 0xF8C6 /end MEASUREMENT
/begin MEASUREMENT zzyl_virt "Initialisierungswert Zylinderzähler bei aktiver Auslauferkennung (B_ale)" UBYTE dez 1 100 0 255 FORMAT "%5.1" ECU_ADDRESS 0x380932 /end MEASUREMENT
/begin FUNCTION ESSTT "22.50     Einspritzzeit Start"
 /begin DEF_CHARACTERISTIC DN10BURN FKSTT_0_A FKSTT_1_A FKSTT_2_A FKSTT_3_A FSTHO IMLHS KFHSTT_0_A KFHSTT_1_A KFWHSTT_0_A KFWHSTT_1_A KFWHSTT_2_A KFWHSTT_3_A KFWKSTAB KFWKSTN KFWKSTT_0_A KFWKSTT_1_A KFWKSTT_2_A KFWKSTT_3_A TANDT TANH TMH TMHSG TMK TMODT TMORSTE TMURSTE TWSTT ZBURNLIM /end DEF_CHARACTERISTIC
 /begin REF_CHARACTERISTIC CWWL /end REF_CHARACTERISTIC
 /begin IN_MEASUREMENT anztib B_nmin B_pwf B_stend B_zesync dnmot_w fho imlatm kstaa nmot tabst_w tans tansab tmot tmotab tmst vstfst /end IN_MEASUREMENT
 /begin OUT_MEASUREMENT B_hst B_stendes B_vbemg B_wks B_wst ESSTTbits fst_w /end OUT_MEASUREMENT
 /begin LOC_MEASUREMENT B_vbmg B_wst0 B_wst1 B_wst2 fst0_w kl_twstt_w zburnsum /end LOC_MEASUREMENT
 /begin SUB_FUNCTION /end SUB_FUNCTION
/end FUNCTION
/begin FUNCTION ESUK "9.80      Einspritzung Übergangskompensation"
 /begin DEF_CHARACTERISTIC DUKK FUKE FUKNSTHO FUKNSTM FVANST FWFN KFABAK KFAVAK KFBAKL_0_A KFBAKL_1_A KFBALB KFVAKL_0_A KFVAKL_1_A KFVALDIF KFVAWLA LADIFFVA RKBAUM RKUKKLU RKVAUM TNSUUK TVAG WFRL ZBAKM ZBALM ZUKE ZUKNST ZVAKM ZVALM /end DEF_CHARACTERISTIC
 /begin REF_CHARACTERISTIC SLA05ESUB SNM07ESUB STM09ESUB /end REF_CHARACTERISTIC
 /begin IN_MEASUREMENT anzti B_ll B_nswo2 B_sa B_sbblsu B_sls B_slsoff B_st B_stend drlp_w esst_sla05esub esst_snm07esub esst_stm09esub fho fukaba_w fukava_w ladiff_w lamsbg_w nmot nmot_w rlp rlp_w tmot tmst vstfba vstfva /end IN_MEASUREMENT
 /begin OUT_MEASUREMENT B_ba B_bag B_ukg B_va B_vag B_vak fvaklw_w fvaladif lamsbguk rkukg_w /end OUT_MEASUREMENT
 /begin LOC_MEASUREMENT abak anztis avak B_redkl B_uk1 B_uke B_ukk B_ukns B_vaau B_vakl B_val B_wf drkuke_w dwfk_w dwfl_w dwf_w fbakl_w fbans fbans_w fbavst_w fvakl_w fvans fvavst_w rkuke_w rkukkl_w rkukk_w rkukl_w rkuk_w sdwfk_w sdwfl_w wf_w zbake zbale zvake zvale /end LOC_MEASUREMENT
 /begin SUB_FUNCTION /end SUB_FUNCTION
/end FUNCTION
/begin FUNCTION ESUKAS "5.50      Adaption der Übergangskompensation (mit stetiger Lambda-Regelung)"
 /begin DEF_CHARACTERISTIC CUKA FKUKAO FKUKAU FLAMSBATM FLAMSVATM FUKABAKI_0_A FUKABAKI_1_A FUKABAKO_0_A FUKABAKO_1_A FUKABAKU_0_A FUKABAKU_1_A FUKABAWI_0_A FUKABAWI_1_A FUKABAWO_0_A FUKABAWO_1_A FUKABAWU_0_A FUKABAWU_1_A FUKAVAKI_0_A FUKAVAKI_1_A FUKAVAKO_0_A FUKAVAKO_1_A FUKAVAKU_0_A FUKAVAKU_1_A FUKAVAWI_0_A FUKAVAWI_1_A FUKAVAWO_0_A FUKAVAWO_1_A FUKAVAWU_0_A FUKAVAWU_1_A FVFKUKA LAMUKAF LAMUKAM NUKAO NUKAU RKUKKTUBA RKUKKTUVA RLUKAO RLUKAU TMNUUKA TMUKAK TMUKAU TMUKAW TNSUUKA TPUKUKA TSPUUKA UKAFRTMO UKAFRTMU /end DEF_CHARACTERISTIC
 /begin REF_CHARACTERISTIC STM09ESUB /end REF_CHARACTERISTIC
 /begin IN_MEASUREMENT B_dktlp B_enws B_frmax B_frmin B_lrs B_mdarv B_nldg B_nswo1 B_pwf B_slp B_te B_tehb esst_stm09esub fr_w lamsbgt_w lamzak_w nmot rkukk_w rl tlrs_w tmot tnst_w /end IN_MEASUREMENT
 /begin OUT_MEASUREMENT fukaba_w fukava_w /end OUT_MEASUREMENT
 /begin LOC_MEASUREMENT anzfkuka B_cfkuka B_cfkuka2 B_cfuka B_cfuka2 B_ecfuka B_rfkuka B_rfkuka2 B_tmnuka B_uka B_uka2 B_ukab B_ukabat B_ukaukat B_ukauket B_ukava B_ukavat fkukaba2_w fkukaba_w fkukas_w fkukava2_w fkukava_w flamsba_w flamsva_w fukabak_w fukabaw_w fukavak_w fukavaw_w rkukkt_w tmnuka tpbauka tpvauka tspuka ukafrtmo_w ukafrtmu_w /end LOC_MEASUREMENT
 /begin SUB_FUNCTION /end SUB_FUNCTION
/end FUNCTION
/begin FUNCTION ESVW "3.60      Einspritzung: Berechnung der Vorlagerungswinkel"
 /begin DEF_CHARACTERISTIC CWVWKNWS DWEEMX KFWEE KFWEEK KFWEEST_0_A KFWEEST_1_A KFWEETM MRFAVW SNM08GKUB SRL08GKUB WEAN WEEMRFAN WEESTN_0_A WEESTN_1_A ZZWEETM /end DEF_CHARACTERISTIC
 /begin REF_CHARACTERISTIC /end REF_CHARACTERISTIC
 /begin IN_MEASUREMENT anztib B_stend mrfa_w nmot rl tmot tmst uzkw_w vsvw wnwem wnwise_w wnwi_w /end IN_MEASUREMENT
 /begin OUT_MEASUREMENT esst_snm08gkub esst_srl08gkub wea wee weer /end OUT_MEASUREMENT
 /begin LOC_MEASUREMENT B_kfwee B_mrfamx weemrfa weenst weest /end LOC_MEASUREMENT
 /begin SUB_FUNCTION /end SUB_FUNCTION
/end FUNCTION
/begin FUNCTION ESWE "1.90      Einspritzung Schubabschalten Wiedereinsetzen" /begin DEF_CHARACTERISTIC FIMHU FIMWU FWEHT FWEMRFA FWET /end DEF_CHARACTERISTIC /begin REF_CHARACTERISTIC /end REF_CHARACTERISTIC /begin IN_MEASUREMENT anzti B_ll B_sa mrfa_w tmot /end IN_MEASUREMENT /begin OUT_MEASUREMENT fwe /end OUT_MEASUREMENT /begin LOC_MEASUREMENT anzwefim azylwe B_afwe B_fwe /end LOC_MEASUREMENT /begin SUB_FUNCTION /end SUB_FUNCTION /end FUNCTION
/begin FUNCTION EVI "Interruptserviceroutinen bei Einspritzausgabe" /begin DEF_CHARACTERISTIC /end DEF_CHARACTERISTIC /begin REF_CHARACTERISTIC /end REF_CHARACTERISTIC
 /begin IN_MEASUREMENT B_spontan0 B_spontan1 B_spontan2 B_spontan3 B_ti_cha0 B_ti_cha1 B_ti_cha2 B_ti_cha3 B_ti_out0 B_ti_out1 B_ti_out2 B_ti_out3 B_ti_wai0 B_ti_wai1 B_ti_wai2 B_ti_wai3 cc_cha_0 cc_cha_1 cc_cha_2 cc_cha_3 ti_ev0 ti_ev1 ti_ev2 ti_ev3 ti_tvu_w /end IN_MEASUREMENT
 /begin OUT_MEASUREMENT /end OUT_MEASUREMENT
 /begin LOC_MEASUREMENT /end LOC_MEASUREMENT
 /begin SUB_FUNCTION /end SUB_FUNCTION
/end FUNCTION
/begin FUNCTION FE "3.10      Füllungseingriffe" /begin DEF_CHARACTERISTIC /end DEF_CHARACTERISTIC /begin REF_CHARACTERISTIC /end REF_CHARACTERISTIC /begin IN_MEASUREMENT fho_w rlsol_w /end IN_MEASUREMENT /begin OUT_MEASUREMENT rlshk rlshk_w /end OUT_MEASUREMENT /begin LOC_MEASUREMENT /end LOC_MEASUREMENT /begin SUB_FUNCTION /end SUB_FUNCTION /end FUNCTION
/begin FUNCTION FGRABED "1.70      Abschaltbedingungen Fahrgeschwindigkeitsregler"
 /begin DEF_CHARACTERISTIC BFGRO BFGRU CWFGRGA_0_A CWFGRGA_1_A CWFGRGABED DNFGRMX DVIVZMX DVZVIMX NFGRMIN TDVIVZ TDVZVI TFGRABS TFGRFDY TFGRUEOB TFGRUM TFGRUNUB VFGREMAX VFGREMIN VFGRMAX VFGRMIN /end DEF_CHARACTERISTIC
 /begin REF_CHARACTERISTIC /end REF_CHARACTERISTIC
 /begin IN_MEASUREMENT bfzgl_w B_absfgr B_acc B_airbag B_brems B_dknolu B_dkpu B_dksbeg B_fdyfgr B_fgr B_fgrat B_fgren B_fgrhe B_fgrhsa B_fgr_um B_gwhs B_kuppl B_nldg B_pwgnotfr gangi nmot_w nsber_w vfgr_w vziel_w zstfgr /end IN_MEASUREMENT
 /begin OUT_MEASUREMENT stfgrab_w /end OUT_MEASUREMENT
 /begin LOC_MEASUREMENT /end LOC_MEASUREMENT
 /begin SUB_FUNCTION /end SUB_FUNCTION
/end FUNCTION
/begin FUNCTION FGRBESI "1.20      Bediensignale Fahrgeschwindigkeitsregler" /begin DEF_CHARACTERISTIC /end DEF_CHARACTERISTIC /begin REF_CHARACTERISTIC /end REF_CHARACTERISTIC
 /begin IN_MEASUREMENT B_acc B_fgrtbe B_fgrtbh B_fgrtse B_fgrtve B_fgrtvh B_fgrtwa B_gra6p stfgrab_w /end IN_MEASUREMENT
 /begin OUT_MEASUREMENT stfgrbs_w /end OUT_MEASUREMENT
 /begin LOC_MEASUREMENT B_frgbs fgrbesilokbits /end LOC_MEASUREMENT
 /begin SUB_FUNCTION /end SUB_FUNCTION
/end FUNCTION
/begin FUNCTION FGRFULO "1.20      Funktionslogik Fahrgeschwindigkeitsregler"
 /begin DEF_CHARACTERISTIC ANZTPMX BRABEVI_0_A BRABEVI_1_A BRATD BRATU CWFGRFULO DVIVZTMX DVSKNBGA_0_A DVSKNBGA_1_A DVSKNVGA_0_A DVSKNVGA_1_A DVTIPUD DVZVITMX DVZVIWA FBFGRSFW KFBRAWA_0_A KFBRAWA_1_A TSWKNBGA_0_A TSWKNBGA_1_A TSWKNVGA_0_A TSWKNVGA_1_A VREGLMAX VREGLMIN /end DEF_CHARACTERISTIC
 /begin REF_CHARACTERISTIC MRFGRMAX VFGRMAX VFGRMIN /end REF_CHARACTERISTIC
 /begin IN_MEASUREMENT B_acc B_fgr fawifgr mrfgr_w stfgrab_w stfgrbs_w uevges vfgr_w /end IN_MEASUREMENT
 /begin OUT_MEASUREMENT bfgrs_w stfgrfl vregl_w vziel_w zstfgr /end OUT_MEASUREMENT
 /begin LOC_MEASUREMENT anztip brafgr_w B_kfvswk ctswk dvzi_w fgrfulolokbits tswk /end LOC_MEASUREMENT
 /begin SUB_FUNCTION /end SUB_FUNCTION
/end FUNCTION
/begin FUNCTION FGRREGL "1.20      Regelalgorithmus Fahrgeschwindigkeitsregler"
 /begin DEF_CHARACTERISTIC CWFGRREGL_0_A CWFGRREGL_1_A DMGETAFW DVLLVO DVLLVU DVSAVO DVSAVU FGMRIDV KFVOFFS_0_A KFVOFFS_1_A KKFFGRGA_0_A KKFFGRGA_1_A KRAFGRGA_0_A KRAFGRGA_1_A MRFGRIMX MRFGRLL MRFGRMAX MRFGRSTA TFGRAR TN2FGRGA_0_A TN2FGRGA_1_A TVLADV_0_A TVLADV_1_A TZ2FGRGA_0_A TZ2FGRGA_1_A VLMXVZ_0_A VLMXVZ_1_A /end DEF_CHARACTERISTIC
 /begin REF_CHARACTERISTIC /end REF_CHARACTERISTIC
 /begin IN_MEASUREMENT B_acc B_fgr B_savacc fawifgr mracc_w mrped_w nmot stfgrab_w stfgrfl uevges vfgr_w vregl_w vziel_w zstfgr /end IN_MEASUREMENT
 /begin OUT_MEASUREMENT B_fgrab B_fgren B_llvfgr B_savfgr fgrreglausbits mrfgr_w /end OUT_MEASUREMENT
 /begin LOC_MEASUREMENT B_fgrdvi ctfgrab dmrar_w dvfgr_w dvivr_w dvzvi_w fawifgr_w fgrregllokbits kfgr_w mrfgri_w tn2fgr_w tz2fgr_w uevges_w vfgro_w vlast_w voffs_w /end LOC_MEASUREMENT
 /begin SUB_FUNCTION /end SUB_FUNCTION
/end FUNCTION
/begin FUNCTION FUEDK "21.100    Füllungssteuerung (Berechnung DK-Sollwinkel)"
 /begin DEF_CHARACTERISTIC CWFUEDK DPUPS DRLSOLMF DWDKUGD EVTMODMNDK FPWDKAPP FUEPMLD KFWDKMSN KFWDKSMX KLDPDK NRLMN NRLMNLLR PLSOLAP TFWDKSOF TWDKSV VPSSPLSWDK WDKSAPP WDKSHYS WDKSOFS ZKPSFIL ZPVDKR /end DEF_CHARACTERISTIC
 /begin REF_CHARACTERISTIC KLAF KUMSRL PSPVDKUG /end REF_CHARACTERISTIC
 /begin IN_MEASUREMENT B_fpwdkap B_ll B_llrein B_lsd B_mgbget B_nmin B_nswo1 B_plsolap B_stend B_tfwdksom B_wdksap B_wdksom drlfue_w esst_snm12feub evtmod fho_w fkmsdk_w fpbrkds_w frhodk_w ftvdk fupsrl_w lditv_w mifafu_w milsol_w ml_w mrfamx_w mrfa_w mste nmot nmot_w ofmsndk_w pdpld pirg_w pspvdk_w ps_w pu_w pvdk_w rlsol_w tfwdksom_w umsrln_w vpsspls_w vpsspu_w wdksom_w wdkugd_w wped_w /end IN_MEASUREMENT
 /begin OUT_MEASUREMENT B_fkmsdks B_ldrugd mlsol_w plsol plsol_w psfil_w pssol_w wdksap_w /end OUT_MEASUREMENT
 /begin LOC_MEASUREMENT B_klafbg B_mfact B_ugds B_wdkap dpdk_w drlsolmf_w dwdksumx_w dwdksut_w fklafs_w frhodkr_w fuedkLocalBits fuepmld_w mlkge_w mlwdknf_w msdks_w msndkoos_w msndks_w pspvmin_w psspvdkb_w psspvdk_w pvdkr_w rlfgks_w tfwdks_w wdksbugd_w wdksgv_w wdksmx_w wdksv_w /end LOC_MEASUREMENT
 /begin SUB_FUNCTION /end SUB_FUNCTION
/end FUNCTION
/begin FUNCTION FUEDKSA "1.20      Füllungsbeeinflussung über DK, Sollwertaufbereitung" /begin DEF_CHARACTERISTIC CWWDKSPE DKNOTBEGR ENTDKLL ENTDKNLL TVWDKS /end DEF_CHARACTERISTIC /begin REF_CHARACTERISTIC /end REF_CHARACTERISTIC
 /begin IN_MEASUREMENT B_dknolu B_dkpiu B_dksbeg B_i_ska_um B_ll B_wdk1v nmot wdknlp_w wdksap_w /end IN_MEASUREMENT
 /begin OUT_MEASUREMENT dwdks_w wdks wdksp_w wdks_w /end OUT_MEASUREMENT
 /begin LOC_MEASUREMENT wdkink_w wdksba2_w wdksba_w wdksb_w wdksfl wdkspa_w wdksvfl wdkswe_w /end LOC_MEASUREMENT
 /begin SUB_FUNCTION /end SUB_FUNCTION
/end FUNCTION
/begin FUNCTION FUEREG "4.80      Füllungsregelung"
 /begin DEF_CHARACTERISTIC CWFUEREG DFAFRG FPLMRM ILMRMN ILMRMX ILMRN KFPLMR KFPLMRMSR TVFRG /end DEF_CHARACTERISTIC
 /begin REF_CHARACTERISTIC SNM08FEUB /end REF_CHARACTERISTIC
 /begin IN_MEASUREMENT B_asr B_fkmsdks B_llrpd B_msr B_nswo1 B_stend esst_snm08feub nmot nmotll rlsol_w rl_w tmot /end IN_MEASUREMENT
 /begin OUT_MEASUREMENT drlfuei_w drlfuep_w drlfue_w /end OUT_MEASUREMENT
 /begin LOC_MEASUREMENT B_furena B_furpen B_stndfr drlm_w /end LOC_MEASUREMENT
 /begin SUB_FUNCTION /end SUB_FUNCTION
/end FUNCTION
/begin FUNCTION GGATS "1.40      Gebergröße Abgastemperatursensor" /begin DEF_CHARACTERISTIC TABGTA TVUBATS UBATSMN /end DEF_CHARACTERISTIC /begin REF_CHARACTERISTIC TPSATS /end REF_CHARACTERISTIC /begin IN_MEASUREMENT B_stend P_ats tabgm_w tcchats_w tccpats_w ub /end IN_MEASUREMENT /begin OUT_MEASUREMENT B_atsb B_ubats tabg2_w tabg_w tats2_w tats_w tpats tpats2 /end OUT_MEASUREMENT /begin LOC_MEASUREMENT taats2_w taats_w tabgta_kge /end LOC_MEASUREMENT /begin SUB_FUNCTION /end SUB_FUNCTION /end FUNCTION
/begin FUNCTION GGCASR "1.50      Gebergöße CAN-Signale für ASR/MSR"
 /begin DEF_CHARACTERISTIC CWMSRCAN DBZ_MN DBZ_MX KLDMASRL MSRMDTMX NOASR RAMPASR TMSRCERR TMSRCNU TVCAMSR T_ASRFGR T_NOMASR T_NOMASRTA T_NOMBR3 VMINAMSR /end DEF_CHARACTERISTIC
 /begin REF_CHARACTERISTIC CW_CAN_C CW_CAN_R_0___A CW_CAN_R_1___A CW_CAN_R_2___A CW_CAN_R_3___A CW_CAN_R_4___A CW_CAN_R_5___A CW_CAN_R_6___A CW_CAN_R_7___A MDNORM /end REF_CHARACTERISTIC
 /begin IN_MEASUREMENT B_amsrbot B_br3bot B_ctout B_nomsr_um B_statbr mdverl_w nmot tnst_w /end IN_MEASUREMENT
 /begin OUT_MEASUREMENT bz_can bz_msr B_absfgr B_amsren B_amsrf B_amsrinpl B_amsrknpl B_amsrn B_amsr_t B_asrakt B_asresp B_asr_can B_bkva B_bkvv B_bkvvc B_br1en B_edsfgr B_fabr B_fdyfgr B_fgrabz B_msrakt B_msrdis B_msrphnpl B_msrtnpl B_msrvnpl B_msr_can B_nomsr_fr B_nomsr_t B_npcanswe B_savmsr B_swecan B_swe_b B_vabsff B_vradhlff B_vradhrff B_vradvlff B_vradvrff miasrllk miasrl_can miasrl_w miasrslk miasrs_can miasrs_w mimsrlk mimsr_can mimsr_w msrmdt_w vamsr_w vrad_hl_w vrad_hr_w vrad_vl_w vrad_vr_w /end OUT_MEASUREMENT
 /begin LOC_MEASUREMENT B_nuamsr /end LOC_MEASUREMENT
 /begin SUB_FUNCTION /end SUB_FUNCTION
/end FUNCTION
/begin FUNCTION GGCGRA "1.40      Gebergröße GRA-Bedienhebel mit CAN"
 /begin DEF_CHARACTERISTIC CSGRA DBZ_GRA TGRACMX TGRACNU T_NOMGRA T_NOMGRAD T_NOMGRATA /end DEF_CHARACTERISTIC
 /begin REF_CHARACTERISTIC CW_CAN_S_0___A CW_CAN_S_1___A CW_CAN_S_2___A CW_CAN_S_3___A CW_CAN_S_4___A CW_CAN_S_5___A CW_CAN_S_6___A CW_CAN_S_7___A /end REF_CHARACTERISTIC
 /begin IN_MEASUREMENT B_ctout B_fgrat B_fgrhsa B_fgrtbe B_fgrtbh B_fgrte B_fgrtse B_fgrtve B_fgrtvh B_fgrtwa B_grabot B_gracan /end IN_MEASUREMENT
 /begin OUT_MEASUREMENT bz_gra B_cfgra B_csgra B_fgratc B_fgrbec B_fgrhec B_fgrhsc B_fgrsec B_fgrtdc B_fgrtuc B_fgrvec B_fgrwac B_grabz B_grabz1 B_grabz2 B_nugra B_tgramx B_tgranu cs_gra /end OUT_MEASUREMENT
 /begin LOC_MEASUREMENT /end LOC_MEASUREMENT
 /begin SUB_FUNCTION /end SUB_FUNCTION
/end FUNCTION
/begin FUNCTION GGCS "1.70      Gebergröße Crash-Sensor"
 /begin DEF_CHARACTERISTIC CWCS DBZ_AIR NMOTDELAY TAIRCMX TAIRCNU TBPWMCS TCONT_HILO TCRCAN TCSERC TCSERNPL TCSERP TVPWMCSR TVPWMCSS UPWMCS ZPWMCS ZPWMCSMAX /end DEF_CHARACTERISTIC
 /begin REF_CHARACTERISTIC NSTNM /end REF_CHARACTERISTIC
 /begin IN_MEASUREMENT bz_air B_aircan B_airnbot B_csair B_ctout B_kl15 B_nmot B_nuair nmot nmot_w P_crsh tmot ub /end IN_MEASUREMENT
 /begin OUT_MEASUREMENT B_airbag B_airbz B_airbz1 B_airbz2 B_crcan B_csernpl B_epwmcs B_hpwmcs B_npwmcs B_pwmcs B_tairmx B_tairnu B_tcrcan crshDetect cserk pwmcs_bits pwmcs_nv_bits /end OUT_MEASUREMENT
 /begin LOC_MEASUREMENT B_crcan_20ms B_pwmcs_50ms B_pwmfcs tpwmcs /end LOC_MEASUREMENT
 /begin SUB_FUNCTION /end SUB_FUNCTION
/end FUNCTION
/begin FUNCTION GGCTOL "1.10      Gebergröße Öltemperatur über CAN" /begin DEF_CHARACTERISTIC TVTOLC /end DEF_CHARACTERISTIC /begin REF_CHARACTERISTIC /end REF_CHARACTERISTIC /begin IN_MEASUREMENT B_ckien B_ctout B_tolcb tolc /end IN_MEASUREMENT /begin OUT_MEASUREMENT B_ctol B_ctole ctol GGCTOLausbits1 /end OUT_MEASUREMENT /begin LOC_MEASUREMENT /end LOC_MEASUREMENT /begin SUB_FUNCTION /end SUB_FUNCTION /end FUNCTION
/begin FUNCTION GGCTUM "1.10      Gebergröße Umgebungstemperatur über CAN" /begin DEF_CHARACTERISTIC TVTUMC /end DEF_CHARACTERISTIC /begin REF_CHARACTERISTIC /end REF_CHARACTERISTIC /begin IN_MEASUREMENT B_ckien B_ctout B_tumcb tumc /end IN_MEASUREMENT /begin OUT_MEASUREMENT B_ctum B_ctume ctum /end OUT_MEASUREMENT /begin LOC_MEASUREMENT /end LOC_MEASUREMENT /begin SUB_FUNCTION /end SUB_FUNCTION /end FUNCTION
/begin FUNCTION GGDPG "14.50     Gebergröße: Drehzahlgeber und Phasengeber"
 /begin DEF_CHARACTERISTIC CWNWREF DZZST DZZSTNLP NMIN NMOTQSYN OFQSYNADAP PH_MINSEG TMQSYN TPREL ZDELBMSRCH ZTPREL /end DEF_CHARACTERISTIC
 /begin REF_CHARACTERISTIC /end REF_CHARACTERISTIC
 /begin IN_MEASUREMENT B_ale B_nldg B_nlph B_nosynph B_phad B_phnldg B_phsok B_pwf B_st B_synnldg nmot nmot_w tmot wkwstop wnwsp_w /end IN_MEASUREMENT
 /begin OUT_MEASUREMENT bmLosCtr_w B_bm B_fbm B_luecke B_mluecke B_nmin B_nmot B_nobm B_nobm1 B_noph B_phaact B_phase B_qsyn B_startini B_stprel B_syn B_synph B_zprel B_zztab dpgNvBits gaptooth ggdpgBitsKgs nsynggdpg tmCorCtr_w tnbm1_w tnbm2_w tnbm_w tpCorCtr_w ttooth10ms uzkw_w wkwbzm0_w wkwsyn_w wkw_w znbm_w zrph zylvirt zzseg zztab zzvirt zzyl /end OUT_MEASUREMENT
 /begin LOC_MEASUREMENT bmzzyl B_enqsyn B_pgxqsyn B_phw B_phwneg B_phwok B_phwpos B_synbmale edge_ctr len_hiseg len_loseg qzzyl stateQsyn wkwneg_w wkwpos_w wkwstart_w zdelay zzale_ini zzyl_virt /end LOC_MEASUREMENT
 /begin SUB_FUNCTION /end SUB_FUNCTION
/end FUNCTION
/begin FUNCTION GGDSAS "4.80      Gebergröße Drucksensoren außerhalb Saugrohr"
 /begin DEF_CHARACTERISTIC DPDSVLU DPUPVDK DSLGRAD DSLOFS DSUGRAD DSUOFS FHOE KFLDFK NDSVLO NDSVLU NVGDSLL PUE PUMN PUMX PUSPSMX PVDKMN PVDKMX PVDKPSMX PVDKPUD TDDFL TDDFLUGD TDDFU TDDFUUGD TDVGDSLL UADPLMN UADPLMX UADPUMN UADPUMX WDKDSVLU WKVGDSLL ZDSU /end DEF_CHARACTERISTIC
 /begin REF_CHARACTERISTIC /end REF_CHARACTERISTIC
 /begin IN_MEASUREMENT B_nmot ftu ml_w nmot nmot_w plsol_w pspvdk_w pssol_w ps_w udsl_w udsu_w wdkba /end IN_MEASUREMENT
 /begin OUT_MEASUREMENT B_edsl B_edsuu B_hag fho fho_w fpvdkds fpvdkds_w frhol_w GgdsasNvBits pu pus_w pu_w pvdkds pvdkds_w pvdkmx_w pvdksf_w pvdkspud pvdks_w /end OUT_MEASUREMENT
 /begin LOC_MEASUREMENT anzudsl_w dpvdkspu_w fpvdkdsl_w fpvdkdsu_w ldfki_w psspvdkd_w pvdkdsl_w pvdkdsu_w /end LOC_MEASUREMENT
 /begin SUB_FUNCTION /end SUB_FUNCTION
/end FUNCTION
/begin FUNCTION GGDST "3.10      Gebergröße Drucksensor Tank" /begin DEF_CHARACTERISTIC DSTGRAD DSTOFFS KLTDS /end DEF_CHARACTERISTIC /begin REF_CHARACTERISTIC /end REF_CHARACTERISTIC /begin IN_MEASUREMENT udst_w /end IN_MEASUREMENT /begin OUT_MEASUREMENT pte pterw pterw_w pte_w /end OUT_MEASUREMENT /begin LOC_MEASUREMENT /end LOC_MEASUREMENT /begin SUB_FUNCTION /end SUB_FUNCTION /end FUNCTION
/begin FUNCTION GGDVE "2.50      Gebergrößen Drosselklappensteller"
 /begin DEF_CHARACTERISTIC DUDKP1HY DWDK12O DWDK13O DWDK23O KFWDKPP NDKPPU NWDK3 TDKPAW TFWDKPN TVPDKP1 TVPDKP2 TVPWDK12 TVPWDK13 TVPWDK23 UBVDKPO UBVDKPU UDKP1O UDKP1U UDKP2O UDKP2U WDKPMXN /end DEF_CHARACTERISTIC
 /begin REF_CHARACTERISTIC /end REF_CHARACTERISTIC
 /begin IN_MEASUREMENT B_dkpu B_ehfm B_st B_ubpvg dkpstg_w fpvdkds ftvdk nmot rl ub udkp1a_w udkp1sv udkp1vo_w udkp1vv_w udkp1v_w udkp1_w udkp2a_w udkp2_w /end IN_MEASUREMENT
 /begin OUT_MEASUREMENT B_dkp1e B_dkp1mn B_dkp1mx B_dkp1np B_dkp2e B_dkp2mn B_dkp2mx B_dkp2np B_dkpaw B_dksbeg B_edks B_wdk1v B_wdk2sel dwdkba_w wdk1_w wdk2_w wdkba wdkba_w /end OUT_MEASUREMENT
 /begin LOC_MEASUREMENT B_dkp1ev B_dkp2ev B_ubvdkp B_udk1nv B_wdk12ev B_wdk13ev B_wdk23ev B_wdk2st cpaw1 cpaw2 ctdkp1 ctdkp2 ctdkpaw ctwdk12 ctwdk13 ctwdk23 rlvppl wdk1 wdk1g wdk2 wdk2g wdk3 wdkpmx /end LOC_MEASUREMENT
 /begin SUB_FUNCTION /end SUB_FUNCTION
/end FUNCTION
/begin FUNCTION GGEGAS "9.60      Gebergröße Brems- und Kupplungsschalter" /begin DEF_CHARACTERISTIC CWGGEGAS TEPBRKUP TVERBR TVKUP TVKUPV ZERBR /end DEF_CHARACTERISTIC /begin REF_CHARACTERISTIC /end REF_CHARACTERISTIC
 /begin IN_MEASUREMENT B_autget B_bkva B_bkvv B_fabr B_pwf B_vnull S_bls S_brs S_kupp /end IN_MEASUREMENT
 /begin OUT_MEASUREMENT B_br2k B_brems B_kuppl B_kupplv ctrerbr /end OUT_MEASUREMENT
 /begin LOC_MEASUREMENT B_bl B_br B_erbr /end LOC_MEASUREMENT
 /begin SUB_FUNCTION /end SUB_FUNCTION
/end FUNCTION
/begin FUNCTION GGFGRH "1.90      Gebergrößen Bedienhebel für Fahrgeschwindigkeitsregler"
 /begin DEF_CHARACTERISTIC CWGGFGRH TEPFGRH TFGRHE TFGRHSNP TFGRTIP TOOTAUS TOOTEIN TOOTULB /end DEF_CHARACTERISTIC
 /begin REF_CHARACTERISTIC /end REF_CHARACTERISTIC
 /begin IN_MEASUREMENT B_acc B_cfgra B_fgrabz B_fgratc B_fgrbec B_fgrhec B_fgrhsc B_fgrsec B_fgrtdc B_fgrte B_fgrtuc B_fgrvec B_fgrwac B_gra6p B_gracan S_fgrat S_fgrhs S_fgrsv S_fgrwb /end IN_MEASUREMENT
 /begin OUT_MEASUREMENT B_fgrat B_fgrhe B_fgrhsa B_fgrtbe B_fgrtbh B_fgrtse B_fgrtve B_fgrtvh B_fgrtwa /end OUT_MEASUREMENT
 /begin LOC_MEASUREMENT B_afgrbs B_ffhsc B_fgootein B_fgrhev B_fgrhs B_tootaus B_tootein B_tootulb ctbetip ctepfgrh ctfgrhe cthsnp ctootaus ctootein ctootulb_w ctvetip GGFGRHlokbits0 /end LOC_MEASUREMENT
 /begin SUB_FUNCTION /end SUB_FUNCTION
/end FUNCTION
/begin FUNCTION GGFST "11.30     Gebergröße Tankfüllstand" /begin DEF_CHARACTERISTIC TWNSTA TWNTAL /end DEF_CHARACTERISTIC /begin REF_CHARACTERISTIC /end REF_CHARACTERISTIC /begin IN_MEASUREMENT B_ckien B_pwf B_talcan S_tal tnst_w /end IN_MEASUREMENT /begin OUT_MEASUREMENT B_tal B_talval GGFSTbits /end OUT_MEASUREMENT /begin LOC_MEASUREMENT timtalr_w timtals_w /end LOC_MEASUREMENT /begin SUB_FUNCTION /end SUB_FUNCTION /end FUNCTION
/begin FUNCTION GGGTS "2.30      Gebergröße genaues Temperatursignal" /begin DEF_CHARACTERISTIC DTMKI TMKIMN TVTMKIC TVTMKIE /end DEF_CHARACTERISTIC /begin REF_CHARACTERISTIC /end REF_CHARACTERISTIC /begin IN_MEASUREMENT B_cdgts B_ckien B_ctout B_tmkicb tmew tmkic tmot /end IN_MEASUREMENT /begin OUT_MEASUREMENT B_tmkib tmki /end OUT_MEASUREMENT /begin LOC_MEASUREMENT /end LOC_MEASUREMENT /begin SUB_FUNCTION /end SUB_FUNCTION /end FUNCTION
/begin FUNCTION GGHFM "65.20     Gebersignal HFM" /begin DEF_CHARACTERISTIC KFKHFM MLHFM MLMIN MLOFS PUKANS /end DEF_CHARACTERISTIC /begin REF_CHARACTERISTIC /end REF_CHARACTERISTIC /begin IN_MEASUREMENT fnwue nmot rl tans uhfm_w /end IN_MEASUREMENT /begin OUT_MEASUREMENT mlhfmm_w mshfm1_w mshfms_w mshfm_w /end OUT_MEASUREMENT /begin LOC_MEASUREMENT anzhfma_w fkhfm mlhfma_w /end LOC_MEASUREMENT /begin SUB_FUNCTION /end SUB_FUNCTION /end FUNCTION
/begin FUNCTION GGHLA "1.10      Gebergröße Heizleistungsanforderung"
 /begin DEF_CHARACTERISTIC TDHLA TDUHPOTI TEEUHE TFUHPOTI THUHPOTI UPOTHI UPOTLO UPWMHI UPWMLO ZPPWMX ZPWMDMN ZPWMDMX ZPWMPMN ZPWMPMX /end DEF_CHARACTERISTIC
 /begin REF_CHARACTERISTIC /end REF_CHARACTERISTIC
 /begin IN_MEASUREMENT uhepoti /end IN_MEASUREMENT
 /begin OUT_MEASUREMENT B_high B_klimex B_klimpl GGHLAausbits1 upotpwm zpwm zpwmd /end OUT_MEASUREMENT
 /begin LOC_MEASUREMENT /end LOC_MEASUREMENT
 /begin SUB_FUNCTION /end SUB_FUNCTION
/end FUNCTION
/begin COMPU_METHOD adb_uw_q0p00195 "" RAT_FUNC "%6.4" "hPa/V" COEFFS 0 65536 0 0 0 128 /end COMPU_METHOD
/begin COMPU_METHOD bfzg_sw_q4p239Em4 "" RAT_FUNC "%10.7" "m/s^2" COEFFS 0 1 0 0 0 0.0004239 /end COMPU_METHOD
/begin COMPU_METHOD B_TRUE "boolsche Zustände, positive Logik" TAB_VERB "%6.3" "" COMPU_TAB_REF B_TRUE /end COMPU_METHOD
/begin COMPU_VTAB B_TRUE "boolsche Zustände, positive Logik" TAB_VERB 2 0 "----" 1 "TRUE" /end COMPU_VTAB
/begin COMPU_METHOD DEZ "1 : 1 Umrechnug (dez/hex)" RAT_FUNC "%6.2" "" COEFFS 0 1 0 0 0 1 /end COMPU_METHOD
/begin COMPU_METHOD dez "1 : 1 Umrechnug (dez/hex)" RAT_FUNC "%6.2" "" COEFFS 0 1 0 0 0 1 /end COMPU_METHOD
/begin COMPU_METHOD dgrad_uw_q0p015 "" RAT_FUNC "%6.4" "hPa/V" COEFFS 0 65536 0 0 0 1024 /end COMPU_METHOD
/begin COMPU_METHOD fak_q0p0039 "" RAT_FUNC "%6.4" "-" COEFFS 0 256 0 0 0 1 /end COMPU_METHOD
/begin COMPU_METHOD fak_q0p015625 "" RAT_FUNC "%6.4" "hPa/(g*s)" COEFFS 0 65536 0 0 0 1024 /end COMPU_METHOD
/begin COMPU_METHOD fak_q0p0625 "" RAT_FUNC "%6.4" "-" COEFFS 0 16 0 0 0 1 /end COMPU_METHOD
/begin COMPU_METHOD fak_q0p1 "" RAT_FUNC "%6.3" "" COEFFS 0 1 0 0 0 0.1 /end COMPU_METHOD
/begin COMPU_METHOD fak_sb_b1 "" RAT_FUNC "%6.4" "-" COEFFS 0 256 0 0 0 2 /end COMPU_METHOD
/begin COMPU_METHOD fak_sw_b1 "" RAT_FUNC "%7.6" "-" COEFFS 0 65536 0 0 0 2 /end COMPU_METHOD
/begin COMPU_METHOD fak_sw_b2 "" RAT_FUNC "%7.6" "-" COEFFS 0 65536 0 0 0 4 /end COMPU_METHOD
/begin COMPU_METHOD fak_sw_b256 "" RAT_FUNC "%6.4" "-" COEFFS 0 65536 0 0 0 512 /end COMPU_METHOD
/begin COMPU_METHOD fak_ub_b0p125 "" RAT_FUNC "%6.5" "-" COEFFS 0 256 0 0 0 0.125 /end COMPU_METHOD
/begin COMPU_METHOD fak_ub_b1 "" RAT_FUNC "%6.4" "-" COEFFS 0 256 0 0 0 1 /end COMPU_METHOD
/begin COMPU_METHOD fak_ub_b16 "" RAT_FUNC "%6.4" "-" COEFFS 0 256 0 0 0 16 /end COMPU_METHOD
/begin COMPU_METHOD fak_ub_b2 "" RAT_FUNC "%6.4" "-" COEFFS 0 256 0 0 0 2 /end COMPU_METHOD
/begin COMPU_METHOD fak_ub_b4 "" RAT_FUNC "%6.4" "-" COEFFS 0 256 0 0 0 4 /end COMPU_METHOD
/begin COMPU_METHOD fak_ub_b64 "" RAT_FUNC "%6.3" "-" COEFFS 0 256 0 0 0 64 /end COMPU_METHOD
/begin COMPU_METHOD fak_ub_b8 "" RAT_FUNC "%6.4" "-" COEFFS 0 256 0 0 0 8 /end COMPU_METHOD
/begin COMPU_METHOD fak_uw_b1 "" RAT_FUNC "%7.6" "-" COEFFS 0 65536 0 0 0 1 /end COMPU_METHOD
/begin COMPU_METHOD fak_uw_b16 "" RAT_FUNC "%6.5" "-" COEFFS 0 65536 0 0 0 16 /end COMPU_METHOD
/begin COMPU_METHOD fak_uw_b2 "" RAT_FUNC "%7.6" "-" COEFFS 0 65536 0 0 0 2 /end COMPU_METHOD
/begin COMPU_METHOD fak_uw_b4 "" RAT_FUNC "%7.6" "-" COEFFS 0 65536 0 0 0 4 /end COMPU_METHOD
/begin COMPU_METHOD fak_uw_b64 "" RAT_FUNC "%6.5" "-" COEFFS 0 65536 0 0 0 64 /end COMPU_METHOD
/begin COMPU_METHOD fak_uw_b8 "" RAT_FUNC "%6.5" "-" COEFFS 0 65536 0 0 0 8 /end COMPU_METHOD
/begin COMPU_METHOD kw_q0p0156 "" RAT_FUNC "%6.4" "°KW" COEFFS 0 64 0 0 0 1 /end COMPU_METHOD
/begin COMPU_METHOD kw_q2p8125 "" RAT_FUNC "%6.2" "°KW" COEFFS 0 1 0 0 0 2.8125 /end COMPU_METHOD
/begin COMPU_METHOD kw_tooth_sy "" RAT_FUNC "%6.2" "°KW" COEFFS 0 0.166667 0 0 0 1 /end COMPU_METHOD
/begin COMPU_METHOD mdt_sw_b2556 "" RAT_FUNC "%6.4" "Nms" COEFFS 0 65536 0 0 0 5112 /end COMPU_METHOD
/begin COMPU_METHOD m_sw_b3276p8 "" RAT_FUNC "%6.3" "kg/h" COEFFS 0 1 0 0 0 0.1 /end COMPU_METHOD
/begin COMPU_METHOD m_ub_b23p3 "" RAT_FUNC "%6.3" "kg" COEFFS 0 2812.5 0 0 0 256 /end COMPU_METHOD
/begin COMPU_METHOD m_uw_b6553p5 "" RAT_FUNC "%6.3" "kg/h" COEFFS 0 1 0 0 0 0.1 /end COMPU_METHOD
/begin COMPU_METHOD nmot_ub_q0p25 "" RAT_FUNC "%6.3" "U/min" COEFFS 0 1 0 0 0 0.25 /end COMPU_METHOD
/begin COMPU_METHOD nmot_ub_q10 "" RAT_FUNC "%6.1" "U/min" COEFFS 0 1 0 0 0 10 /end COMPU_METHOD
/begin COMPU_METHOD nmot_ub_q40 "" RAT_FUNC "%6.1" "Upm" COEFFS 0 1 0 0 0 40 /end COMPU_METHOD
/begin COMPU_METHOD nmot_uw_q0p25 "" RAT_FUNC "%6.3" "U/min" COEFFS 0 1 0 0 0 0.25 /end COMPU_METHOD
/begin COMPU_METHOD p_sb_q0p25 "" RAT_FUNC "%6.3" "hPa" COEFFS 0 1 0 0 0 0.25 /end COMPU_METHOD
/begin COMPU_METHOD p_sb_q0p625 "" RAT_FUNC "%6.3" "hPa" COEFFS 0 128 0 0 0 80 /end COMPU_METHOD
/begin COMPU_METHOD p_sw_q0p000977 "" RAT_FUNC "%6.5" "hPa" COEFFS 0 65536 0 0 0 64 /end COMPU_METHOD
/begin COMPU_METHOD p_sw_q0p00244 "" RAT_FUNC "%6.4" "hPa" COEFFS 0 32768 0 0 0 80 /end COMPU_METHOD
/begin COMPU_METHOD p_sw_q0p039 "" RAT_FUNC "%6.4" "hPa" COEFFS 0 256 0 0 0 10 /end COMPU_METHOD
/begin COMPU_METHOD p_ub_q10 "" RAT_FUNC "%6.1" "hPa" COEFFS 0 1 0 0 0 10 /end COMPU_METHOD
/begin COMPU_METHOD p_ub_q5 "" RAT_FUNC "%6.2" "hPa" COEFFS 0 1 0 0 0 5 /end COMPU_METHOD
/begin COMPU_METHOD p_uw_q0p039 "" RAT_FUNC "%6.4" "hPa" COEFFS 0 256 0 0 0 10 /end COMPU_METHOD
/begin COMPU_METHOD relDK_q0p02441 "" RAT_FUNC "%6.4" "% DK" COEFFS 0 65536 0 0 0 1600 /end COMPU_METHOD
/begin COMPU_METHOD relDK_ub_b100 "" RAT_FUNC "%6.3" "% DK" COEFFS 0 255 0 0 0 100 /end COMPU_METHOD
/begin COMPU_METHOD relDK_uw_b100 "" RAT_FUNC "%6.4" "% DK" COEFFS 0 65535 0 0 0 100 /end COMPU_METHOD
/begin COMPU_METHOD relPED_uw_b100 "" RAT_FUNC "%6.4" "% PED" COEFFS 0 65535 0 0 0 100 /end COMPU_METHOD
/begin COMPU_METHOD rel_q0p009766 "" RAT_FUNC "%6.4" "%" COEFFS 0 65536 0 0 0 640 /end COMPU_METHOD
/begin COMPU_METHOD rel_q0p249 "" RAT_FUNC "%6.3" "%" COEFFS 0 1 0 0 0 0.249 /end COMPU_METHOD
/begin COMPU_METHOD rel_q0p25 "" RAT_FUNC "%6.3" "%/V" COEFFS 0 1 0 0 0 0.25 /end COMPU_METHOD
/begin COMPU_METHOD rel_sw_b1536 "" RAT_FUNC "%6.4" "%" COEFFS 0 65536 0 0 0 3072 /end COMPU_METHOD
/begin COMPU_METHOD rel_sw_b1p5 "" RAT_FUNC "%7.6" "%/(1/min)" COEFFS 0 32768 0 0 0 1.5 /end COMPU_METHOD
/begin COMPU_METHOD rel_sw_q0p0234 "" RAT_FUNC "%6.4" "%/seg" COEFFS 0 32 0 0 0 0.75 /end COMPU_METHOD
/begin COMPU_METHOD rel_sw_q0p1875 "" RAT_FUNC "%6.3" "%" COEFFS 0 65536 0 0 0 12288 /end COMPU_METHOD
/begin COMPU_METHOD rel_ub_b200 "" RAT_FUNC "%6.3" "%" COEFFS 0 256 0 0 0 200 /end COMPU_METHOD
/begin COMPU_METHOD rel_ub_b99p6 "" RAT_FUNC "%6.3" "%" COEFFS 0 256 0 0 0 100 /end COMPU_METHOD
/begin COMPU_METHOD rel_ub_q0p75 "" RAT_FUNC "%6.3" "%" COEFFS 0 1 0 0 0 0.75 /end COMPU_METHOD
/begin COMPU_METHOD rel_uw_b100 "" RAT_FUNC "%6.4" "%" COEFFS 0 65536 0 0 0 100 /end COMPU_METHOD
/begin COMPU_METHOD rel_uw_b200 "" RAT_FUNC "%6.4" "%" COEFFS 0 65536 0 0 0 200 /end COMPU_METHOD
/begin COMPU_METHOD rel_uw_b3200 "" RAT_FUNC "%6.4" "%/(km/h)" COEFFS 0 65536 0 0 0 3200 /end COMPU_METHOD
/begin COMPU_METHOD rel_uw_b6144 "" RAT_FUNC "%6.3" "%" COEFFS 0 65536 0 0 0 6144 /end COMPU_METHOD
/begin COMPU_METHOD rel_uw_q0p0234 "" RAT_FUNC "%6.4" "%" COEFFS 0 32 0 0 0 0.75 /end COMPU_METHOD
/begin COMPU_METHOD rel_uw_q0p1875 "" RAT_FUNC "%6.3" "%" COEFFS 0 65536 0 0 0 12288 /end COMPU_METHOD
/begin COMPU_METHOD spg_sw_b5 "" RAT_FUNC "%6.4" "V" COEFFS 0 1024 0 0 0 10 /end COMPU_METHOD
/begin COMPU_METHOD spg_ubatt "" RAT_FUNC "%6.4" "V" COEFFS 0 1 0 0 0 0.0704 /end COMPU_METHOD
/begin COMPU_METHOD spg_ub_b5 "" RAT_FUNC "%6.4" "V" COEFFS 0 256 0 0 0 5 /end COMPU_METHOD
/begin COMPU_METHOD spg_ub_q0p019 "" RAT_FUNC "%6.4" "V" COEFFS 0 256 0 0 0 5 /end COMPU_METHOD
/begin COMPU_METHOD spg_uw_q0p001222 "" RAT_FUNC "%6.4" "V" COEFFS 0 65536 0 0 0 80 /end COMPU_METHOD
/begin COMPU_METHOD spg_uw_q0p00488 "" RAT_FUNC "%6.4" "V" COEFFS 0 1024 0 0 0 5 /end COMPU_METHOD
/begin COMPU_METHOD t100msxms_ub_b255 "" RAT_FUNC "%6.2" "ms" COEFFS 0 1 0 0 0 1 /end COMPU_METHOD
/begin COMPU_METHOD t100msxs_ub_b25p5 "" RAT_FUNC "%6.3" "s" COEFFS 0 1 0 0 0 0.1 /end COMPU_METHOD
/begin COMPU_METHOD t100msxs_uw_b6553p5 "" RAT_FUNC "%6.3" "s" COEFFS 0 1 0 0 0 0.1 /end COMPU_METHOD
/begin COMPU_METHOD t10msxs_ub_b2p55 "" RAT_FUNC "%6.4" "s" COEFFS 0 1 0 0 0 0.01 /end COMPU_METHOD
/begin COMPU_METHOD t10msxs_uw_b655p35 "" RAT_FUNC "%6.4" "s" COEFFS 0 1 0 0 0 0.01 /end COMPU_METHOD
/begin COMPU_METHOD t1sxs_uw_b65535 "" RAT_FUNC "%6.2" "s" COEFFS 0 1 0 0 0 1 /end COMPU_METHOD
/begin COMPU_METHOD t1sxs_uw_q1 "" RAT_FUNC "%6.2" "s" COEFFS 0 1 0 0 0 1 /end COMPU_METHOD
/begin COMPU_METHOD t200msxs_uw_q0p2 "" RAT_FUNC "%6.3" "s" COEFFS 0 1 0 0 0 0.2 /end COMPU_METHOD
/begin COMPU_METHOD t20msxs_ub_b5p1 "" RAT_FUNC "%6.4" "s" COEFFS 0 1 0 0 0 0.02 /end COMPU_METHOD
/begin COMPU_METHOD t20msxs_ub_q0p02 "" RAT_FUNC "%6.4" "s" COEFFS 0 50 0 0 0 1 /end COMPU_METHOD
/begin COMPU_METHOD t20msxs_uw_b1310 "" RAT_FUNC "%6.4" "s" COEFFS 0 1 0 0 0 0.02 /end COMPU_METHOD
/begin COMPU_METHOD t20msxs_uw_q0p02 "" RAT_FUNC "%6.4" "s" COEFFS 0 1 0 0 0 0.02 /end COMPU_METHOD
/begin COMPU_METHOD t50msxs_ub_b12p75 "" RAT_FUNC "%6.4" "s" COEFFS 0 1 0 0 0 0.05 /end COMPU_METHOD
/begin COMPU_METHOD temp_ub_b191p25 "" RAT_FUNC "%6.3" "Grad C" COEFFS 0 1 0 0 0 0.75 /end COMPU_METHOD
/begin COMPU_METHOD temp_ub_q0p75_o48 "" RAT_FUNC "%6.2" "Grad C" COEFFS 0 1 48 0 0 0.75 /end COMPU_METHOD
/begin COMPU_METHOD temp_ub_q1_o60 "" RAT_FUNC "%6.2" "Grad C" COEFFS 0 1 60 0 0 1 /end COMPU_METHOD
/begin COMPU_METHOD temp_uw_q0p0195_o50 "" RAT_FUNC "%6.2" "Grad C" COEFFS 0 256 12800 0 0 5 /end COMPU_METHOD
/begin COMPU_METHOD tv_sw_q0p005 "" RAT_FUNC "%6.4" "%" COEFFS 0 1 0 0 0 0.005 /end COMPU_METHOD
/begin COMPU_METHOD vfzg_sw_q0p00781 "" RAT_FUNC "%6.4" "km/h" COEFFS 0 1 0 0 0 0.0078125 /end COMPU_METHOD
/begin COMPU_METHOD vfzg_uw_b325 "" RAT_FUNC "%6.4" "km/h" COEFFS 0 65536 0 0 0 325 /end COMPU_METHOD
/begin COMPU_METHOD vfzg_uw_b512 "" RAT_FUNC "%6.4" "km/h" COEFFS 0 65536 0 0 0 512 /end COMPU_METHOD
/begin COMPU_METHOD vfzg_uw_q0p00781 "" RAT_FUNC "%6.4" "km/h" COEFFS 0 1 0 0 0 0.0078125 /end COMPU_METHOD
/begin COMPU_METHOD vfzg_uw_q0p0078125 "" RAT_FUNC "%6.4" "km/h" COEFFS 0 1 0 0 0 0.0078125 /end COMPU_METHOD
/begin COMPU_METHOD vrad_uw_b655 "" RAT_FUNC "%6.4" "km/h" COEFFS 0 65536 0 0 0 655 /end COMPU_METHOD
/begin COMPU_METHOD zk100msxs_ub_b25p5 "" RAT_FUNC "%6.3" "s" COEFFS 0 0 256 0 10 0 /end COMPU_METHOD
/begin COMPU_METHOD zk100msxs_uw_b6553 "" RAT_FUNC "%12.4" "s" COEFFS 0 0 65536 0 10 0 /end COMPU_METHOD
/begin COMPU_METHOD zk10msxs_ub_b2p55 "" RAT_FUNC "%6.4" "s" COEFFS 0 0 255 0 100 0 /end COMPU_METHOD
/begin COMPU_METHOD zk10msxs_uw_b655 "" RAT_FUNC "%12.5" "s" COEFFS 0 0 65536 0 100 0 /end COMPU_METHOD
/begin COMPU_METHOD zk20msxs_uw_b1310 "" RAT_FUNC "%12.4" "s" COEFFS 0 0 65536 0 50 0 /end COMPU_METHOD
/begin COMPU_METHOD zw_sb_q6 "" RAT_FUNC "%6.2" "Grad KW" COEFFS 0 1 0 0 0 6 /end COMPU_METHOD
/begin COMPU_METHOD zw_ub_q6 "" RAT_FUNC "%6.2" "Grad KW" COEFFS 0 255 0 0 0 1530 /end COMPU_METHOD
/begin RECORD_LAYOUT FklWUb FNC_VALUES 1 UBYTE COLUMN_DIR DIRECT /end RECORD_LAYOUT
/begin RECORD_LAYOUT FklWUw FNC_VALUES 1 UWORD COLUMN_DIR DIRECT /end RECORD_LAYOUT
/begin RECORD_LAYOUT GkfWUb FNC_VALUES 1 UBYTE COLUMN_DIR DIRECT /end RECORD_LAYOUT
/begin RECORD_LAYOUT GklWSw FNC_VALUES 1 SWORD COLUMN_DIR DIRECT /end RECORD_LAYOUT
/begin RECORD_LAYOUT GklWUb FNC_VALUES 1 UBYTE COLUMN_DIR DIRECT /end RECORD_LAYOUT
/begin RECORD_LAYOUT GklWUw FNC_VALUES 1 UWORD COLUMN_DIR DIRECT /end RECORD_LAYOUT
/begin RECORD_LAYOUT KfAxUbAyUbSstxSwSstyUbWSw NO_AXIS_PTS_X 1 UBYTE NO_AXIS_PTS_Y 2 UBYTE AXIS_PTS_X 3 SWORD INDEX_INCR DIRECT AXIS_PTS_Y 4 UBYTE INDEX_INCR DIRECT FNC_VALUES 5 SWORD COLUMN_DIR DIRECT /end RECORD_LAYOUT
/begin RECORD_LAYOUT KfAxUbAyUbSstxUbSstyUbWSb NO_AXIS_PTS_X 1 UBYTE NO_AXIS_PTS_Y 2 UBYTE AXIS_PTS_X 3 UBYTE INDEX_INCR DIRECT AXIS_PTS_Y 4 UBYTE INDEX_INCR DIRECT FNC_VALUES 5 SBYTE COLUMN_DIR DIRECT /end RECORD_LAYOUT
/begin RECORD_LAYOUT KfAxUbAyUbSstxUbSstyUbWUb NO_AXIS_PTS_X 1 UBYTE NO_AXIS_PTS_Y 2 UBYTE AXIS_PTS_X 3 UBYTE INDEX_INCR DIRECT AXIS_PTS_Y 4 UBYTE INDEX_INCR DIRECT FNC_VALUES 5 UBYTE COLUMN_DIR DIRECT /end RECORD_LAYOUT
/begin RECORD_LAYOUT KfAxUbAyUbSstxUwSstyUbWUb NO_AXIS_PTS_X 1 UBYTE NO_AXIS_PTS_Y 2 UBYTE AXIS_PTS_X 3 UWORD INDEX_INCR DIRECT AXIS_PTS_Y 4 UBYTE INDEX_INCR DIRECT FNC_VALUES 5 UBYTE COLUMN_DIR DIRECT /end RECORD_LAYOUT
/begin RECORD_LAYOUT KfAxUwAyUwSstxUwSstyUwWUw NO_AXIS_PTS_X 1 UWORD NO_AXIS_PTS_Y 2 UWORD AXIS_PTS_X 3 UWORD INDEX_INCR DIRECT AXIS_PTS_Y 4 UWORD INDEX_INCR DIRECT FNC_VALUES 5 UWORD COLUMN_DIR DIRECT /end RECORD_LAYOUT
/begin RECORD_LAYOUT KlASwSstSwWSw NO_AXIS_PTS_X 1 SWORD AXIS_PTS_X 2 SWORD INDEX_INCR DIRECT FNC_VALUES 3 SWORD COLUMN_DIR DIRECT /end RECORD_LAYOUT
/begin RECORD_LAYOUT KlAUbSstSbWUb NO_AXIS_PTS_X 1 UBYTE AXIS_PTS_X 2 SBYTE INDEX_INCR DIRECT FNC_VALUES 3 UBYTE COLUMN_DIR DIRECT /end RECORD_LAYOUT
/begin RECORD_LAYOUT KlAUbSstUbWUb NO_AXIS_PTS_X 1 UBYTE AXIS_PTS_X 2 UBYTE INDEX_INCR DIRECT FNC_VALUES 3 UBYTE COLUMN_DIR DIRECT /end RECORD_LAYOUT
/begin RECORD_LAYOUT KlAUbSstUbWUw NO_AXIS_PTS_X 1 UBYTE AXIS_PTS_X 2 UBYTE INDEX_INCR DIRECT FNC_VALUES 3 UWORD COLUMN_DIR DIRECT /end RECORD_LAYOUT
/begin RECORD_LAYOUT KlAUwSstSwWUw NO_AXIS_PTS_X 1 UWORD AXIS_PTS_X 2 SWORD INDEX_INCR DIRECT FNC_VALUES 3 UWORD COLUMN_DIR DIRECT /end RECORD_LAYOUT
/begin RECORD_LAYOUT KlAUwSstUwWUb NO_AXIS_PTS_X 1 UWORD AXIS_PTS_X 2 UWORD INDEX_INCR DIRECT FNC_VALUES 3 UBYTE COLUMN_DIR DIRECT /end RECORD_LAYOUT
/begin RECORD_LAYOUT KlAUwSstUwWUw NO_AXIS_PTS_X 1 UWORD AXIS_PTS_X 2 UWORD INDEX_INCR DIRECT FNC_VALUES 3 UWORD COLUMN_DIR DIRECT /end RECORD_LAYOUT
/begin RECORD_LAYOUT KwSw FNC_VALUES 1 SWORD COLUMN_DIR DIRECT /end RECORD_LAYOUT
/begin RECORD_LAYOUT KwUb FNC_VALUES 1 UBYTE COLUMN_DIR DIRECT /end RECORD_LAYOUT
/begin RECORD_LAYOUT KwUw FNC_VALUES 1 UWORD COLUMN_DIR DIRECT /end RECORD_LAYOUT
/begin RECORD_LAYOUT SstAUbSstUb NO_AXIS_PTS_X 1 UBYTE AXIS_PTS_X 2 UBYTE INDEX_INCR DIRECT /end RECORD_LAYOUT
/begin RECORD_LAYOUT SstAUwSstUw NO_AXIS_PTS_X 1 UWORD AXIS_PTS_X 2 UWORD INDEX_INCR DIRECT /end RECORD_LAYOUT
/end MODULE
/end PROJECT
