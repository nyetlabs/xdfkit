/begin PROJECT P ""
/begin MODULE M ""
/begin MOD_COMMON "" BYTE_ORDER MSB_LAST S_REC_LAYOUT DAMOS /end MOD_COMMON
/begin COMPU_METHOD ident "" RAT_FUNC "%3.0" "" COEFFS 0 1 0 0 0 1 /end COMPU_METHOD
/begin COMPU_METHOD zk "" RAT_FUNC "%6.1" "ms" COEFFS 0 0 10240 0 1 40 /end COMPU_METHOD
/begin RECORD_LAYOUT Curve NO_AXIS_PTS_X 1 UBYTE AXIS_PTS_X 2 UBYTE INDEX_INCR DIRECT FNC_VALUES 3 UWORD COLUMN_DIR DIRECT /end RECORD_LAYOUT
/begin RECORD_LAYOUT Map NO_AXIS_PTS_X 1 UBYTE NO_AXIS_PTS_Y 2 UBYTE AXIS_PTS_X 3 UBYTE INDEX_INCR DIRECT AXIS_PTS_Y 4 UBYTE INDEX_INCR DIRECT FNC_VALUES 5 UBYTE COLUMN_DIR DIRECT /end RECORD_LAYOUT
/begin CHARACTERISTIC Curve "say ""hi""" CURVE 0x800010 Curve 0 ident 0 1 /begin AXIS_DESCR STD_AXIS x ident 4 0 1 /end AXIS_DESCR /end CHARACTERISTIC
/begin CHARACTERISTIC Map "m" MAP 0x800100 Map 0 ident 0 1 /begin AXIS_DESCR STD_AXIS row ident 6 0 1 /end AXIS_DESCR /begin AXIS_DESCR STD_AXIS col ident 4 0 1 /end AXIS_DESCR /end CHARACTERISTIC
/begin CHARACTERISTIC Time "t" VALUE 0x800200 Kw 0 zk 0 1 /end CHARACTERISTIC
/begin CHARACTERISTIC ID "BOSCH" ASCII 0x800300 Kwb 0 KennText 0 1 NUMBER 12 /end CHARACTERISTIC
/end MODULE
/end PROJECT
