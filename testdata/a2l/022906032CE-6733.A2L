ASAP2_VERSION 1 3
/begin PROJECT S1103A_25G5_0 "S1103A"
/begin HEADER "" VERSION "S1103A_25G5_0" PROJECT_NO S1103A_25G5_0 /end HEADER
/begin MODULE DIM ""
/begin MOD_COMMON "" BYTE_ORDER MSB_LAST ALIGNMENT_BYTE 1 ALIGNMENT_WORD 2 ALIGNMENT_LONG 2 /end MOD_COMMON
/begin CHARACTERISTIC BUSOFFCTR "" VALUE 0x8FCD76 KwUb 255.0 DEZ 0.00 255.0 FORMAT "%5.1" /end CHARACTERISTIC
/begin CHARACTERISTIC BUSOFFTIME "" VALUE 0x8FCD77 KwUb 2.550 t10msxs_ub_b2p55 0.00 2.550 FORMAT "%5.3" /end CHARACTERISTIC
/begin CHARACTERISTIC CDCCAIR "" VAL_BLK 0x8E699C KwbUw 65535.00 dez 0.00 65535.00 FORMAT "%8.2" NUMBER 4 /end CHARACTERISTIC
/begin CHARACTERISTIC CDCCAS "" VAL_BLK 0x8E69AC KwbUw 65535.00 dez 0.00 65535.00 FORMAT "%8.2" NUMBER 4 /end CHARACTERISTIC
/begin CHARACTERISTIC CDCCAT "" VAL_BLK 0x8E69B4 KwbUw 65535.00 dez 0.00 65535.00 FORMAT "%8.2" NUMBER 4 /end CHARACTERISTIC
/begin CHARACTERISTIC CDCCBR2 "" VAL_BLK 0x8E69BC KwbUw 65535.00 dez 0.00 65535.00 FORMAT "%8.2" NUMBER 4 /end CHARACTERISTIC
/begin CHARACTERISTIC CDCCBSG "" VAL_BLK 0x8E69C4 KwbUw 65535.00 dez 0.00 65535.00 FORMAT "%8.2" NUMBER 4 /end CHARACTERISTIC
/begin CHARACTERISTIC CDCCGAT "" VAL_BLK 0x8E69CC KwbUw 65535.00 dez 0.00 65535.00 FORMAT "%8.2" NUMBER 4 /end CHARACTERISTIC
/begin CHARACTERISTIC CDCCGRA "" VAL_BLK 0x8E69DC KwbUw 65535.00 dez 0.00 65535.00 FORMAT "%8.2" NUMBER 4 /end CHARACTERISTIC
/begin CHARACTERISTIC CDCLSV "" VAL_BLK 0x8E6CEC KwbUw 65535.00 dez 0.00 65535.00 FORMAT "%8.2" NUMBER 4 /end CHARACTERISTIC
/begin CHARACTERISTIC CDCLSV2 "" VAL_BLK 0x8E6CF4 KwbUw 65535.00 dez 0.00 65535.00 FORMAT "%8.2" NUMBER 4 /end CHARACTERISTIC
/begin CHARACTERISTIC CDCSWE "" VAL_BLK 0x8E6E1C KwbUw 65535.00 dez 0.00 65535.00 FORMAT "%8.2" NUMBER 4 /end CHARACTERISTIC
/begin CHARACTERISTIC CDCTOL "" VAL_BLK 0x8E6E74 KwbUw 65535.00 dez 0.00 65535.00 FORMAT "%8.2" NUMBER 4 /end CHARACTERISTIC
/begin CHARACTERISTIC CDCTUM "" VAL_BLK 0x8E6E7C KwbUw 65535.00 dez 0.00 65535.00 FORMAT "%8.2" NUMBER 4 /end CHARACTERISTIC
/begin CHARACTERISTIC CDKCAIR "" VAL_BLK 0x8E6FA4 KwbUw 65535.00 dez 0.00 65535.00 FORMAT "%8.2" NUMBER 4 /end CHARACTERISTIC
/begin CHARACTERISTIC CDKCAS "" VAL_BLK 0x8E6FB4 KwbUw 65535.00 dez 0.00 65535.00 FORMAT "%8.2" NUMBER 4 /end CHARACTERISTIC
/begin CHARACTERISTIC CDKCAT "" VAL_BLK 0x8E6FBC KwbUw 65535.00 dez 0.00 65535.00 FORMAT "%8.2" NUMBER 4 /end CHARACTERISTIC
/begin CHARACTERISTIC CDKCBR2 "" VAL_BLK 0x8E6FC4 KwbUw 65535.00 dez 0.00 65535.00 FORMAT "%8.2" NUMBER 4 /end CHARACTERISTIC
/begin CHARACTERISTIC CDKCBSG "" VAL_BLK 0x8E6FCC KwbUw 65535.00 dez 0.00 65535.00 FORMAT "%8.2" NUMBER 4 /end CHARACTERISTIC
/begin CHARACTERISTIC CDKCGAT "" VAL_BLK 0x8E6FD4 KwbUw 65535.00 dez 0.00 65535.00 FORMAT "%8.2" NUMBER 4 /end CHARACTERISTIC
/begin CHARACTERISTIC CDKCGRA "" VAL_BLK 0x8E6FE4 KwbUw 65535.00 dez 0.00 65535.00 FORMAT "%8.2" NUMBER 4 /end CHARACTERISTIC
/begin CHARACTERISTIC CDKLSV "" VAL_BLK 0x8E72F4 KwbUw 65535.00 dez 0.00 65535.00 FORMAT "%8.2" NUMBER 4 /end CHARACTERISTIC
/begin CHARACTERISTIC CDKLSV2 "" VAL_BLK 0x8E72FC KwbUw 65535.00 dez 0.00 65535.00 FORMAT "%8.2" NUMBER 4 /end CHARACTERISTIC
/begin CHARACTERISTIC CDKSWE "" VAL_BLK 0x8E7424 KwbUw 65535.00 dez 0.00 65535.00 FORMAT "%8.2" NUMBER 4 /end CHARACTERISTIC
/begin CHARACTERISTIC CDKTOL "" VAL_BLK 0x8E747C KwbUw 65535.00 dez 0.00 65535.00 FORMAT "%8.2" NUMBER 4 /end CHARACTERISTIC
/begin CHARACTERISTIC CDKTUM "" VAL_BLK 0x8E7484 KwbUw 65535.00 dez 0.00 65535.00 FORMAT "%8.2" NUMBER 4 /end CHARACTERISTIC
/begin CHARACTERISTIC CDTCAIR "" VALUE 0x8E756A KwUw 65535.00 dez 0.00 65535.00 FORMAT "%8.2" /end CHARACTERISTIC
/begin CHARACTERISTIC CDTCAS "" VALUE 0x8E756E KwUw 65535.00 dez 0.00 65535.00 FORMAT "%8.2" /end CHARACTERISTIC
/begin CHARACTERISTIC CDTCAT "" VALUE 0x8E7570 KwUw 65535.00 dez 0.00 65535.00 FORMAT "%8.2" /end CHARACTERISTIC
/begin CHARACTERISTIC CDTCBR2 "" VALUE 0x8E7572 KwUw 65535.00 dez 0.00 65535.00 FORMAT "%8.2" /end CHARACTERISTIC
/begin CHARACTERISTIC CDTCBSG "" VALUE 0x8E7574 KwUw 65535.00 dez 0.00 65535.00 FORMAT "%8.2" /end CHARACTERISTIC
/begin CHARACTERISTIC CDTCGAT "" VALUE 0x8E7576 KwUw 65535.00 dez 0.00 65535.00 FORMAT "%8.2" /end CHARACTERISTIC
/begin CHARACTERISTIC CDTCGRA "" VALUE 0x8E757A KwUw 65535.00 dez 0.00 65535.00 FORMAT "%8.2" /end CHARACTERISTIC
/begin CHARACTERISTIC CDTLSV "" VALUE 0x8E763E KwUw 65535.00 dez 0.00 65535.00 FORMAT "%8.2" /end CHARACTERISTIC
/begin CHARACTERISTIC CDTLSV2 "" VALUE 0x8E7640 KwUw 65535.00 dez 0.00 65535.00 FORMAT "%8.2" /end CHARACTERISTIC
/begin CHARACTERISTIC CDTSWE "" VALUE 0x8E768A KwUw 65535.00 dez 0.00 65535.00 FORMAT "%8.2" /end CHARACTERISTIC
/begin CHARACTERISTIC CDTTOL "" VALUE 0x8E76A0 KwUw 65535.00 dez 0.00 65535.00 FORMAT "%8.2" /end CHARACTERISTIC
/begin CHARACTERISTIC CDTTUM "" VALUE 0x8E76A2 KwUw 65535.00 dez 0.00 65535.00 FORMAT "%8.2" /end CHARACTERISTIC
/begin CHARACTERISTIC CL30LINE "" VAL_BLK 0x8E787E KwbUb 255.0 dez 0.00 255.0 FORMAT "%5.1" NUMBER 14 /end CHARACTERISTIC
/begin CHARACTERISTIC CL31LINE "" VAL_BLK 0x8E788C KwbUb 255.0 dez 0.00 255.0 FORMAT "%5.1" NUMBER 14 /end CHARACTERISTIC
/begin CHARACTERISTIC CL32LINE "" VAL_BLK 0x8E789A KwbUb 255.0 dez 0.00 255.0 FORMAT "%5.1" NUMBER 14 /end CHARACTERISTIC
/begin CHARACTERISTIC CL33LINE "" VAL_BLK 0x8E78A8 KwbUb 255.0 dez 0.00 255.0 FORMAT "%5.1" NUMBER 14 /end CHARACTERISTIC
/begin CHARACTERISTIC CL34LINE "" VAL_BLK 0x8E78B6 KwbUb 255.0 dez 0.00 255.0 FORMAT "%5.1" NUMBER 14 /end CHARACTERISTIC
/begin CHARACTERISTIC CL35LINE "" VAL_BLK 0x8E78C4 KwbUb 255.0 dez 0.00 255.0 FORMAT "%5.1" NUMBER 14 /end CHARACTERISTIC
/begin CHARACTERISTIC CL36LINE "" VAL_BLK 0x8E78D2 KwbUb 255.0 dez 0.00 255.0 FORMAT "%5.1" NUMBER 14 /end CHARACTERISTIC
/begin CHARACTERISTIC CL37LINE "" VAL_BLK 0x8E78E0 KwbUb 255.0 dez 0.00 255.0 FORMAT "%5.1" NUMBER 14 /end CHARACTERISTIC
/begin CHARACTERISTIC CL38LINE "" VAL_BLK 0x8E78EE KwbUb 255.0 dez 0.00 255.0 FORMAT "%5.1" NUMBER 14 /end CHARACTERISTIC
/begin CHARACTERISTIC CL39LINE "" VAL_BLK 0x8E78FC KwbUb 255.0 dez 0.00 255.0 FORMAT "%5.1" NUMBER 14 /end CHARACTERISTIC
/begin CHARACTERISTIC CLACAIR "" VALUE 0x8E05F6 KwUb 255.0 dez 0.00 255.0 FORMAT "%5.1" /end CHARACTERISTIC
/begin CHARACTERISTIC CLACAS "" VALUE 0x8E05F8 KwUb 255.0 dez 0.00 255.0 FORMAT "%5.1" /end CHARACTERISTIC
/begin CHARACTERISTIC CLACAT "" VALUE 0x8E05F9 KwUb 255.0 dez 0.00 255.0 FORMAT "%5.1" /end CHARACTERISTIC
/begin CHARACTERISTIC CLACBR2 "" VALUE 0x8E05FA KwUb 255.0 dez 0.00 255.0 FORMAT "%5.1" /end CHARACTERISTIC
/begin CHARACTERISTIC CLACBSG "" VALUE 0x8E05FB KwUb 255.0 dez 0.00 255.0 FORMAT "%5.1" /end CHARACTERISTIC
/begin CHARACTERISTIC CLACGAT "" VALUE 0x8E05FC KwUb 255.0 dez 0.00 255.0 FORMAT "%5.1" /end CHARACTERISTIC
/begin CHARACTERISTIC CLACGRA "" VALUE 0x8E05FE KwUb 255.0 dez 0.00 255.0 FORMAT "%5.1" /end CHARACTERISTIC
/begin CHARACTERISTIC CLALSV "" VALUE 0x8E0660 KwUb 255.0 dez 0.00 255.0 FORMAT "%5.1" /end CHARACTERISTIC
/begin CHARACTERISTIC CLALSV2 "" VALUE 0x8E0661 KwUb 255.0 dez 0.00 255.0 FORMAT "%5.1" /end CHARACTERISTIC
/begin CHARACTERISTIC CLASWE "" VALUE 0x8E0686 KwUb 255.0 dez 0.00 255.0 FORMAT "%5.1" /end CHARACTERISTIC
/begin CHARACTERISTIC CLATOL "" VALUE 0x8E0691 KwUb 255.0 dez 0.00 255.0 FORMAT "%5.1" /end CHARACTERISTIC
/begin CHARACTERISTIC CLATUM "" VALUE 0x8E0692 KwUb 255.0 dez 0.00 255.0 FORMAT "%5.1" /end CHARACTERISTIC
/begin CHARACTERISTIC CORTINC "" VALUE 0x8FCE01 KwUb 255.0 dez 0.00 255.0 FORMAT "%5.1" /end CHARACTERISTIC
/begin CHARACTERISTIC CORTINIT "" VALUE 0x8E08FB KwUb 255.0 dez 0.00 255.0 FORMAT "%5.1" /end CHARACTERISTIC
/begin CHARACTERISTIC CORTMX "" VALUE 0x8FCE02 KwUb 255.0 dez 0.00 255.0 FORMAT "%5.1" /end CHARACTERISTIC
/begin CHARACTERISTIC CSAIR "" VALUE 0x8FCD78 KwUb 255.0 DEZ 0.00 255.0 FORMAT "%5.1" /end CHARACTERISTIC
/begin CHARACTERISTIC CWBBDECJ "" VALUE 0x8E0EBF KwUb 255.0 dez 0.00 255.0 FORMAT "%5.1" /end CHARACTERISTIC
/begin CHARACTERISTIC CWCANECURA "" VALUE 0x8FCD79 KwUb 255.0 dez 0.00 255.0 FORMAT "%5.1" /end CHARACTERISTIC
/begin CHARACTERISTIC CWCANKBI "" VALUE 0x8FCD7A KwUb 255.0 DEZ 0.00 255.0 FORMAT "%5.1" /end CHARACTERISTIC
/begin CHARACTERISTIC CWCANLWS "" VALUE 0x8FCD7B KwUb 255.0 DEZ 0.00 255.0 FORMAT "%5.1" /end CHARACTERISTIC
/begin CHARACTERISTIC CWCDCUM "" VALUE 0x8E08FA KwUb 255.0 dez 0.00 255.0 FORMAT "%5.1" /end CHARACTERISTIC
/begin CHARACTERISTIC CWCOWIV "" VALUE 0x8E03A8 KwUb 255.0 dez 0.00 255.0 FORMAT "%5.1" /end CHARACTERISTIC
/begin CHARACTERISTIC CWDCFFLR "" VALUE 0x8E0CA0 KwUb 255.0 dez 0.00 255.0 FORMAT "%5.1" /end CHARACTERISTIC
/begin CHARACTERISTIC CWDDYLSU "" VALUE 0x8E0D64 KwUb 255.0 dez 0.00 255.0 FORMAT "%5.1" /end CHARACTERISTIC
/begin CHARACTERISTIC CWFLC "" VALUE 0x8FCDFF KwUb 255.0 dez 0.00 255.0 FORMAT "%5.1" /end CHARACTERISTIC
/begin CHARACTERISTIC CW_CAN_C_0___A "" VALUE 0x8E0432 KwUb 255.0 DEZ 0.00 255.0 FORMAT "%5.1" /end CHARACTERISTIC
/begin CHARACTERISTIC CW_CAN_C_1___A "" VALUE 0x8E0433 KwUb 255.0 DEZ 0.00 255.0 FORMAT "%5.1" /end CHARACTERISTIC
/begin CHARACTERISTIC CW_CAN_C_2___A "" VALUE 0x8E0434 KwUb 255.0 DEZ 0.00 255.0 FORMAT "%5.1" /end CHARACTERISTIC
/begin CHARACTERISTIC CW_CAN_C_3___A "" VALUE 0x8E0435 KwUb 255.0 DEZ 0.00 255.0 FORMAT "%5.1" /end CHARACTERISTIC
/begin CHARACTERISTIC CW_CAN_R_0___A "" VALUE 0x8E5FAC KwUw 65535.00 DEZ 0.00 65535.00 FORMAT "%8.2" /end CHARACTERISTIC
/begin CHARACTERISTIC CW_CAN_R_1___A "" VALUE 0x8E5FAE KwUw 65535.00 DEZ 0.00 65535.00 FORMAT "%8.2" /end CHARACTERISTIC
/begin CHARACTERISTIC CW_CAN_R_2___A "" VALUE 0x8E5FB0 KwUw 65535.00 DEZ 0.00 65535.00 FORMAT "%8.2" /end CHARACTERISTIC
/begin CHARACTERISTIC CW_CAN_R_3___A "" VALUE 0x8E5FB2 KwUw 65535.00 DEZ 0.00 65535.00 FORMAT "%8.2" /end CHARACTERISTIC
/begin CHARACTERISTIC CW_CAN_R_4___A "" VALUE 0x8E5FB4 KwUw 65535.00 DEZ 0.00 65535.00 FORMAT "%8.2" /end CHARACTERISTIC
/begin CHARACTERISTIC CW_CAN_R_5___A "" VALUE 0x8E5FB6 KwUw 65535.00 DEZ 0.00 65535.00 FORMAT "%8.2" /end CHARACTERISTIC
/begin CHARACTERISTIC CW_CAN_R_6___A "" VALUE 0x8E5FB8 KwUw 65535.00 DEZ 0.00 65535.00 FORMAT "%8.2" /end CHARACTERISTIC
/begin CHARACTERISTIC CW_CAN_R_7___A "" VALUE 0x8E5FBA KwUw 65535.00 DEZ 0.00 65535.00 FORMAT "%8.2" /end CHARACTERISTIC
/begin CHARACTERISTIC CW_CAN_RA "" VALUE 0x8FCD7C KwUb 255.0 DEZ 0.00 255.0 FORMAT "%5.1" /end CHARACTERISTIC
/begin CHARACTERISTIC CW_CAN_RB "" VALUE 0x8FCD7D KwUb 255.0 DEZ 0.00 255.0 FORMAT "%5.1" /end CHARACTERISTIC
/begin CHARACTERISTIC DFEMPOS "" VALUE 0x8E9C4E KwUw 3.999939 fak_uw_b4 0.00 3.999939 FORMAT "%8.6" /end CHARACTERISTIC
/begin CHARACTERISTIC DFEMPUS "" VALUE 0x8E9C50 KwUw 3.999939 fak_uw_b4 0.00 3.999939 FORMAT "%8.6" /end CHARACTERISTIC
/begin CHARACTERISTIC DFPSLBIT "" VAL_BLK 0x8E790A KwbUw 65535.00 dez 0.00 65535.00 FORMAT "%8.2" NUMBER 16 /end CHARACTERISTIC
/begin CHARACTERISTIC DFRAOS "" VALUE 0x8E9C52 KwUw 3.999939 fak_uw_b4 0.00 3.999939 FORMAT "%8.6" /end CHARACTERISTIC
/begin CHARACTERISTIC DFRAUS "" VALUE 0x8E9C54 KwUw 3.999939 fak_uw_b4 0.00 3.999939 FORMAT "%8.6" /end CHARACTERISTIC
/begin CHARACTERISTIC DFRZAMIN "" VALUE 0x8E8164 KwSw 1.999969 fak_sw_b1 -1.000000 0.9999695 FORMAT "%8.6" /end CHARACTERISTIC
/begin CHARACTERISTIC DMRLSV "" VALUE 0x8E8166 KwUw 99.99847 rel_uw_b100 0.00 99.99847 FORMAT "%8.5" /end CHARACTERISTIC
/begin CHARACTERISTIC DPBKVP "" VALUE 0x8EFFF4 KwUw 2559.961 p_uw_q0p039 0.00 2559.961 FORMAT "%8.3" /end CHARACTERISTIC
/begin CHARACTERISTIC DPBKVPMN "" VALUE 0x8EFFF6 KwUw 2559.961 p_uw_q0p039 0.00 2559.961 FORMAT "%8.3" /end CHARACTERISTIC
/begin CHARACTERISTIC DRLMXW "" VALUE 0x8E8168 KwUw 1535.977 rel_uw_q0p0234 0.00 1535.977 FORMAT "%8.3" /end CHARACTERISTIC
/begin CHARACTERISTIC DYNLSUFA "" VALUE 0x8E816A KwUw 15.99976 fak_uw_b16 0.00 15.99976 FORMAT "%8.5" /end CHARACTERISTIC
/begin CHARACTERISTIC DYNLSUMX "" VALUE 0x8E816C KwUw 15.99976 fak_uw_b16 0.00 15.99976 FORMAT "%8.5" /end CHARACTERISTIC
/begin CHARACTERISTIC DYNLSURD "" VALUE 0x8E816E KwUw 15.99976 fak_uw_b16 0.00 15.99976 FORMAT "%8.5" /end CHARACTERISTIC
/begin CHARACTERISTIC ESKONF "" VAL_BLK 0x8FCF7A KwbUb 255.0 dez 0.00 255.0 FORMAT "%5.1" NUMBER 13 /end CHARACTERISTIC
/begin CHARACTERISTIC ESKONF_AGR "" VAL_BLK 0x8FCF87 KwbUb 255.0 dez 0.00 255.0 FORMAT "%5.1" NUMBER 13 /end CHARACTERISTIC
/begin CHARACTERISTIC ESKONF_NL "" VAL_BLK 0x8FCF94 KwbUb 255.0 dez 0.00 255.0 FORMAT "%5.1" NUMBER 13 /end CHARACTERISTIC
/begin CHARACTERISTIC ESKONF_STA "" VAL_BLK 0x8FCFA1 KwbUb 255.0 dez 0.00 255.0 FORMAT "%5.1" NUMBER 13 /end CHARACTERISTIC
/begin CHARACTERISTIC FEMPOS "" VALUE 0x8E9C56 KwUw 3.999939 fak_uw_b4 0.00 3.999939 FORMAT "%8.6" /end CHARACTERISTIC
/begin CHARACTERISTIC FEMPUS "" VALUE 0x8E9C58 KwUw 3.999939 fak_uw_b4 0.00 3.999939 FORMAT "%8.6" /end CHARACTERISTIC
/begin CHARACTERISTIC FFTCAIR "" VAL_BLK 0x8E06C2 KwbUb 255.0 dez 0.00 255.0 FORMAT "%5.1" NUMBER 2 /end CHARACTERISTIC
/begin CHARACTERISTIC FFTCAS "" VAL_BLK 0x8E06C6 KwbUb 255.0 dez 0.00 255.0 FORMAT "%5.1" NUMBER 2 /end CHARACTERISTIC
/begin CHARACTERISTIC FFTCAT "" VAL_BLK 0x8E06C8 KwbUb 255.0 dez 0.00 255.0 FORMAT "%5.1" NUMBER 2 /end CHARACTERISTIC
/begin CHARACTERISTIC FFTCBR2 "" VAL_BLK 0x8E06CA KwbUb 255.0 dez 0.00 255.0 FORMAT "%5.1" NUMBER 2 /end CHARACTERISTIC
/begin CHARACTERISTIC FFTCBSG "" VAL_BLK 0x8E06CC KwbUb 255.0 dez 0.00 255.0 FORMAT "%5.1" NUMBER 2 /end CHARACTERISTIC
/begin CHARACTERISTIC FFTCGAT "" VAL_BLK 0x8E06CE KwbUb 255.0 dez 0.00 255.0 FORMAT "%5.1" NUMBER 2 /end CHARACTERISTIC
/begin CHARACTERISTIC FFTCGRA "" VAL_BLK 0x8E06D2 KwbUb 255.0 dez 0.00 255.0 FORMAT "%5.1" NUMBER 2 /end CHARACTERISTIC
/begin CHARACTERISTIC FFTLSV "" VAL_BLK 0x8E0796 KwbUb 255.0 dez 0.00 255.0 FORMAT "%5.1" NUMBER 2 /end CHARACTERISTIC
/begin CHARACTERISTIC FFTLSV2 "" VAL_BLK 0x8E0798 KwbUb 255.0 dez 0.00 255.0 FORMAT "%5.1" NUMBER 2 /end CHARACTERISTIC
/begin CHARACTERISTIC FFTSWE "" VAL_BLK 0x8E07E2 KwbUb 255.0 dez 0.00 255.0 FORMAT "%5.1" NUMBER 2 /end CHARACTERISTIC
/begin CHARACTERISTIC FFTTOL "" VAL_BLK 0x8E07F8 KwbUb 255.0 dez 0.00 255.0 FORMAT "%5.1" NUMBER 2 /end CHARACTERISTIC
/begin CHARACTERISTIC FFTTUM "" VAL_BLK 0x8E07FA KwbUb 255.0 dez 0.00 255.0 FORMAT "%5.1" NUMBER 2 /end CHARACTERISTIC
/begin CHARACTERISTIC FRAOS "" VALUE 0x8E9C5A KwUw 3.999939 fak_uw_b4_no1 -1.000000 2.999939 FORMAT "%8.6" /end CHARACTERISTIC
/begin CHARACTERISTIC FRAUS "" VALUE 0x8E9C5C KwUw 3.999939 fak_uw_b4_no1 -1.000000 2.999939 FORMAT "%8.6" /end CHARACTERISTIC
/begin CHARACTERISTIC FTEDYLSUMX "" VALUE 0x8FCE77 KwSb 127.5 fak_sb_b64 -64.00 63.50 FORMAT "%5.2" /end CHARACTERISTIC
/begin CHARACTERISTIC FWCBFT "" VALUE 0x8FCD7E KwUb 25.50 fak_q0p1 0.00 25.50 FORMAT "%5.2" /end CHARACTERISTIC
/begin CHARACTERISTIC FWCSBK "" VALUE 0x8FCD7F KwUb 0.2550 volgrd_q0p001 0.00 0.2550 FORMAT "%6.4" /end CHARACTERISTIC
/begin CHARACTERISTIC IVDYNLSU "" VALUE 0x8E8170 KwUw 15.99976 fak_uw_b16 0.00 15.99976 FORMAT "%8.5" /end CHARACTERISTIC
/begin CHARACTERISTIC KDYNFA "" VALUE 0x8E8172 KwUw 0.9999847 fak_uw_b1 0.00 0.9999847 FORMAT "%9.7" /end CHARACTERISTIC
/begin CHARACTERISTIC KDYNLSU "" VALUE 0x8E8174 KwUw 0.9999847 fak_uw_b1 0.00 0.9999847 FORMAT "%9.7" /end CHARACTERISTIC
/begin CHARACTERISTIC KFAQUERWIV "" MAP 0x8E5DAC KfAxUbAyUbSstxSwSstyUwWUw 3.000000 fak_uw_b5p12 0.00 3.000000 FORMAT "%8.6"
 /begin AXIS_DESCR STD_AXIS aquerf_w acc_sw_q3p91em4 5 -12.80000 12.79961 FORMAT "%8.5" DEPOSIT ABSOLUTE /end AXIS_DESCR
 /begin AXIS_DESCR STD_AXIS nmotfwiv_w nmot_uw_q0p25 9 0.00 16383.75 FORMAT "%8.2" DEPOSIT ABSOLUTE /end AXIS_DESCR
/end CHARACTERISTIC
/begin CHARACTERISTIC KFKOROLSW "" MAP 0x8E5E26 KfAxUbAyUbSstxUbSstyUwWUw 127.0000 s_uw_q62p5um 0.00 127.0000 FORMAT "%8.4"
 /begin AXIS_DESCR STD_AXIS toeli temp_ub_q1_o60 10 -60.00 195.0 FORMAT "%5.1" DEPOSIT ABSOLUTE /end AXIS_DESCR
 /begin AXIS_DESCR STD_AXIS nmotfwiv_w nmot_uw_q0p25 10 0.00 16383.75 FORMAT "%8.2" DEPOSIT ABSOLUTE /end AXIS_DESCR
/end CHARACTERISTIC
/begin CHARACTERISTIC KFOELKBI "" MAP 0x8E03D5 KfAxUbAyUbSstxUbSstyUbWUb 63.75 s_q63p75mm 0.00 63.75 FORMAT "%5.2"
 /begin AXIS_DESCR STD_AXIS kfoelkbi_nmot nmot_ub_q40 8 0.00 10200. FORMAT "%5.0" DEPOSIT ABSOLUTE /end AXIS_DESCR
 /begin AXIS_DESCR STD_AXIS tolc temp_ub_q1_o60 8 -60.00 195.0 FORMAT "%5.1" DEPOSIT ABSOLUTE /end AXIS_DESCR
/end CHARACTERISTIC
/begin CHARACTERISTIC KLOLFSTZ "" CURVE 0x8E5F0E KlAUbSstUwWUw 127.0000 s_uw_q62p5um 0.00 127.0000 FORMAT "%8.4"
 /begin AXIS_DESCR STD_AXIS fsttog_w t_q0p5o100ms 10 100.0000 32867.50 FORMAT "%8.2" DEPOSIT ABSOLUTE /end AXIS_DESCR
/end CHARACTERISTIC
/begin CHARACTERISTIC KLOLTBFWIV "" CURVE 0x8E03A9 KlAUbSstUbWUb 15.94 fak_ub_b16 0.00 15.94 FORMAT "%5.2"
 /begin AXIS_DESCR STD_AXIS toeli temp_ub_q1_o60 9 -60.00 195.0 FORMAT "%5.1" DEPOSIT ABSOLUTE /end AXIS_DESCR
/end CHARACTERISTIC
/begin CHARACTERISTIC KLOLTWIV "" CURVE 0x8E5F38 KlAUwSstUwWUb 255.0 temp_ub_q1_o60 -60.00 195.0 FORMAT "%5.1"
 /begin AXIS_DESCR STD_AXIS togtime_w t500msxs_q0p125 13 0.00 8191.875 FORMAT "%8.3" DEPOSIT ABSOLUTE /end AXIS_DESCR
/end CHARACTERISTIC
/begin CHARACTERISTIC KOELV "" VALUE 0x8E03BC KwUb 6.300 fak_ub_q0p05 0.00 6.300 FORMAT "%5.3" /end CHARACTERISTIC
/begin CHARACTERISTIC KTMGZYL "" VALUE 0x8E5F62 KwUw 5110.000 vol_uw_b5120_LproZyl 0.00 5110.000 FORMAT "%8.3" /end CHARACTERISTIC
/begin CHARACTERISTIC KVAKBIMX "" VALUE 0x8E03BD KwUb 261120. vol_q1024mm3 0.00 261120. FORMAT "%5.0" /end CHARACTERISTIC
/begin CHARACTERISTIC LAMDYNO "" VALUE 0x8E8176 KwUw 15.99976 fak_uw_b16 0.00 15.99976 FORMAT "%8.5" /end CHARACTERISTIC
/begin CHARACTERISTIC LAMDYNU "" VALUE 0x8E8178 KwUw 15.99976 fak_uw_b16 0.00 15.99976 FORMAT "%8.5" /end CHARACTERISTIC
/begin CHARACTERISTIC LBMINC "" VALUE 0x8FDBD6 KwUw 65535.00 dez 0.00 65535.00 FORMAT "%8.2" /end CHARACTERISTIC
/begin CHARACTERISTIC LBMINIT "" VALUE 0x8FDBD8 KwUw 65535.00 dez 0.00 65535.00 FORMAT "%8.2" /end CHARACTERISTIC
/begin CHARACTERISTIC LBMMX "" VALUE 0x8FDBDA KwUw 65535.00 dez 0.00 65535.00 FORMAT "%8.2" /end CHARACTERISTIC
/begin CHARACTERISTIC LBMSUB "" VALUE 0x8E7D4A KwUw 65535.00 dez 0.00 65535.00 FORMAT "%8.2" /end CHARACTERISTIC
/begin CHARACTERISTIC MXNLN "" VALUE 0x8E08FC KwUb 255.0 dez 0.00 255.0 FORMAT "%5.1" /end CHARACTERISTIC
/begin CHARACTERISTIC NMOTDYFA "" VALUE 0x8E0D65 KwUb 10200. nmot_ub_q40 0.00 10200. FORMAT "%5.0" /end CHARACTERISTIC
/begin CHARACTERISTIC NMOTDYNO "" VALUE 0x8E0D66 KwUb 10200. nmot_ub_q40 0.00 10200. FORMAT "%5.0" /end CHARACTERISTIC
/begin CHARACTERISTIC NMOTDYNU "" VALUE 0x8E0D67 KwUb 10200. nmot_ub_q40 0.00 10200. FORMAT "%5.0" /end CHARACTERISTIC
/begin CHARACTERISTIC NMOTMNWIV "" VALUE 0x8E5F64 KwUw 16383.75 nmot_uw_q0p25 0.00 16383.75 FORMAT "%8.2" /end CHARACTERISTIC
/begin CHARACTERISTIC NMOTMXWIV "" VALUE 0x8E5F66 KwUw 16383.75 nmot_uw_q0p25 0.00 16383.75 FORMAT "%8.2" /end CHARACTERISTIC
/begin CHARACTERISTIC NOBMINC "" VALUE 0x8E08FD KwUb 255.0 dez 0.00 255.0 FORMAT "%5.1" /end CHARACTERISTIC
/begin CHARACTERISTIC NOBMINIT "" VALUE 0x8E08FE KwUb 255.0 dez 0.00 255.0 FORMAT "%5.1" /end CHARACTERISTIC
/begin CHARACTERISTIC NOBMSTMX "" VALUE 0x8E08FF KwUb 255.0 dez 0.00 255.0 FORMAT "%5.1" /end CHARACTERISTIC
/begin CHARACTERISTIC PAFSTMNC "" VALUE 0x8E03BE KwUb 7000. fak_ub_q500 500.0 7500. FORMAT "%5.0" /end CHARACTERISTIC
/begin CHARACTERISTIC PGFLNL "" VALUE 0x8E0900 KwUb 255.0 dez 0.00 255.0 FORMAT "%5.1" /end CHARACTERISTIC
/begin CHARACTERISTIC PGFLWA "" VALUE 0x8FCE03 KwUb 255.0 dez 0.00 255.0 FORMAT "%5.1" /end CHARACTERISTIC
/begin CHARACTERISTIC POELOFFC "" VALUE 0x8E03BF KwUb 630.0 vol_ub_q10ml 0.00 630.0 FORMAT "%5.1" /end CHARACTERISTIC
/begin CHARACTERISTIC POELTOLC "" VALUE 0x8E03C0 KwUb 630.0 vol_ub_q10ml 0.00 630.0 FORMAT "%5.1" /end CHARACTERISTIC
/begin CHARACTERISTIC PSMITC "" VALUE 0x8E03C1 KwUb 631.3 s_ub_q6p25km 0.00 631.3 FORMAT "%5.1" /end CHARACTERISTIC
/begin CHARACTERISTIC PTMAXC "" VALUE 0x8E03C2 KwUb 63.00 t_ub_q1month 0.00 63.00 FORMAT "%5.2" /end CHARACTERISTIC
/begin CHARACTERISTIC PTMINC "" VALUE 0x8E03C3 KwUb 63.00 t_ub_q1month 0.00 63.00 FORMAT "%5.2" /end CHARACTERISTIC
/begin CHARACTERISTIC PTOELWIV "" VALUE 0x8E03C4 KwUb 255.0 temp_ub_q1_o60 -60.00 195.0 FORMAT "%5.1" /end CHARACTERISTIC
/begin CHARACTERISTIC PWIVMNC "" VALUE 0x8E03C5 KwUb 127000. s_ub_q1000km 0.00 127000. FORMAT "%5.0" /end CHARACTERISTIC
/begin CHARACTERISTIC PWIVMXC "" VALUE 0x8E03C6 KwUb 127000. s_ub_q1000km 0.00 127000. FORMAT "%5.0" /end CHARACTERISTIC
/begin CHARACTERISTIC RLDYNFAW "" VALUE 0x8E817A KwUw 1535.977 rel_uw_q0p0234 0.00 1535.977 FORMAT "%8.3" /end CHARACTERISTIC
/begin CHARACTERISTIC RLDYNOW "" VALUE 0x8E817C KwUw 1535.977 rel_uw_q0p0234 0.00 1535.977 FORMAT "%8.3" /end CHARACTERISTIC
/begin CHARACTERISTIC RLDYNUW "" VALUE 0x8E817E KwUw 1535.977 rel_uw_q0p0234 0.00 1535.977 FORMAT "%8.3" /end CHARACTERISTIC
/begin CHARACTERISTIC STEIGOLB "" VALUE 0x8E03C7 KwUb 0.2550 fak_ub_q0p001Lpromm 0.00 0.2550 FORMAT "%6.4" /end CHARACTERISTIC
/begin CHARACTERISTIC TCANINIDELAY "" VALUE 0x8FC501 KwUb 255.0 dez 0.00 255.0 FORMAT "%5.1" READ_ONLY /end CHARACTERISTIC
/begin CHARACTERISTIC TDBBKVP "" VALUE 0x8E3FF3 KwUb 25.50 t100msxs_ub_b25p5 0.00 25.50 FORMAT "%5.2" /end CHARACTERISTIC
/begin CHARACTERISTIC TDBUKSUE "" VALUE 0x8FDD50 KwUw 6553.500 t100msxs_uw_b6553p6 0.00 6553.500 FORMAT "%8.3" /end CHARACTERISTIC
/begin CHARACTERISTIC TDDBKVP "" VALUE 0x8E3FF4 KwUb 25.50 t100msxs_ub_b25p5 0.00 25.50 FORMAT "%5.2" /end CHARACTERISTIC
/begin CHARACTERISTIC TDEGFEMN "" VALUE 0x8E1460 KwUb 255.0 t1sxs_ub_b255 0.00 255.0 FORMAT "%5.1" /end CHARACTERISTIC
/begin CHARACTERISTIC TDEGFEMX "" VALUE 0x8E1461 KwUb 255.0 t1sxs_ub_b255 0.00 255.0 FORMAT "%5.1" /end CHARACTERISTIC
/begin CHARACTERISTIC TDEGFENO "" VALUE 0x8E1462 KwUb 255.0 t1sxs_ub_b255 0.00 255.0 FORMAT "%5.1" /end CHARACTERISTIC
/begin CHARACTERISTIC TEGA "" VALUE 0x8FE66C KwUw 655.3500 t10msxs_uw_b655p35 0.00 655.3500 FORMAT "%8.4" /end CHARACTERISTIC
/begin CHARACTERISTIC TFIRSTCANINIDELAY "" VALUE 0x8FC502 KwUb 255.0 dez 0.00 255.0 FORMAT "%5.1" READ_ONLY /end CHARACTERISTIC
/begin CHARACTERISTIC TKMTIMERR "" VALUE 0x8E0427 KwUb 255.0 t1sxs_ub_b255 0.00 255.0 FORMAT "%5.1" /end CHARACTERISTIC
/begin CHARACTERISTIC TLADEGFE "" VALUE 0x8E9C5E KwUw 65535.00 t1sxs_uw_b65535 0.00 65535.00 FORMAT "%8.2" /end CHARACTERISTIC
/begin CHARACTERISTIC TMOTNLDG "" VALUE 0x8E0901 KwUb 191.3 temp_ub_q0p75_o48 -48.00 143.3 FORMAT "%5.1" /end CHARACTERISTIC
/begin CHARACTERISTIC TNSTBKV "" VALUE 0x8EFFF8 KwUw 655.3500 t10msxs_uw_b655p35 0.00 655.3500 FORMAT "%8.4" /end CHARACTERISTIC
/begin CHARACTERISTIC TOELMNTUR "" VALUE 0x8E03C8 KwUb 255.0 temp_ub_q1_o60 -60.00 195.0 FORMAT "%5.1" /end CHARACTERISTIC
/begin CHARACTERISTIC TOELMNWIV "" VALUE 0x8E03C9 KwUb 255.0 temp_ub_q1_o60 -60.00 195.0 FORMAT "%5.1" /end CHARACTERISTIC
/begin CHARACTERISTIC TOELMXWIV "" VALUE 0x8E03CA KwUb 255.0 temp_ub_q1_o60 -60.00 195.0 FORMAT "%5.1" /end CHARACTERISTIC
/begin CHARACTERISTIC TOELTUR "" VALUE 0x8E03CB KwUb 6.313 fak_ub_b8 0.00 6.313 FORMAT "%5.3" /end CHARACTERISTIC
/begin CHARACTERISTIC TOLFSTDIS "" VALUE 0x8E5F68 KwUw 6553.500 t100msxs_uw_b6553p5 0.00 6553.500 FORMAT "%8.3" /end CHARACTERISTIC
/begin CHARACTERISTIC TOLFSTMN "" VALUE 0x8E5F6A KwUw 1023.000 t_q0p5o100ms 100.0000 1123.000 FORMAT "%8.3" /end CHARACTERISTIC
/begin CHARACTERISTIC TOLFSTMX "" VALUE 0x8E5F6C KwUw 1023.000 t_q0p5o100ms 100.0000 1123.000 FORMAT "%8.3" /end CHARACTERISTIC
/begin CHARACTERISTIC TOLFSTNVA "" VALUE 0x8E5F6E KwUw 6553.500 t100msxs_uw_b6553p5 0.00 6553.500 FORMAT "%8.3" /end CHARACTERISTIC
/begin CHARACTERISTIC TPNSE "" VALUE 0x8E0E9F KwUb 25.40 t100msxs_ub_b25p5 0.1000 25.50 FORMAT "%5.2" /end CHARACTERISTIC
/begin CHARACTERISTIC TSFCAIR "" VALUE 0x8E0839 KwUb 255.0 dez 0.00 255.0 FORMAT "%5.1" /end CHARACTERISTIC
/begin CHARACTERISTIC TSFCAS "" VALUE 0x8E083B KwUb 255.0 dez 0.00 255.0 FORMAT "%5.1" /end CHARACTERISTIC
/begin CHARACTERISTIC TSFCAT "" VALUE 0x8E083C KwUb 255.0 dez 0.00 255.0 FORMAT "%5.1" /end CHARACTERISTIC
/begin CHARACTERISTIC TSFCBR2 "" VALUE 0x8E083D KwUb 255.0 dez 0.00 255.0 FORMAT "%5.1" /end CHARACTERISTIC
/begin CHARACTERISTIC TSFCBSG "" VALUE 0x8E083E KwUb 255.0 dez 0.00 255.0 FORMAT "%5.1" /end CHARACTERISTIC
/begin CHARACTERISTIC TSFCGAT "" VALUE 0x8E083F KwUb 255.0 dez 0.00 255.0 FORMAT "%5.1" /end CHARACTERISTIC
/begin CHARACTERISTIC TSFCGRA "" VALUE 0x8E0841 KwUb 255.0 dez 0.00 255.0 FORMAT "%5.1" /end CHARACTERISTIC
/begin CHARACTERISTIC TSFLSV "" VALUE 0x8E08A3 KwUb 255.0 dez 0.00 255.0 FORMAT "%5.1" /end CHARACTERISTIC
/begin CHARACTERISTIC TSFLSV2 "" VALUE 0x8E08A4 KwUb 255.0 dez 0.00 255.0 FORMAT "%5.1" /end CHARACTERISTIC
/begin CHARACTERISTIC TSFSWE "" VALUE 0x8E08C9 KwUb 255.0 dez 0.00 255.0 FORMAT "%5.1" /end CHARACTERISTIC
/begin CHARACTERISTIC TSFTOL "" VALUE 0x8E08D4 KwUb 255.0 dez 0.00 255.0 FORMAT "%5.1" /end CHARACTERISTIC
/begin CHARACTERISTIC TSFTUM "" VALUE 0x8E08D5 KwUb 255.0 dez 0.00 255.0 FORMAT "%5.1" /end CHARACTERISTIC
/begin CHARACTERISTIC TVDRL "" VALUE 0x8E0D68 KwUb 5.100 t20msxs_ub_b5p1 0.00 5.100 FORMAT "%5.3" /end CHARACTERISTIC
/begin CHARACTERISTIC TVFKMSDK "" VALUE 0x8FCFCD KwUb 2.550 t10msxs_ub_b2p55 0.00 2.550 FORMAT "%5.3" /end CHARACTERISTIC
/begin CHARACTERISTIC TWBDCY "" VALUE 0x8E6942 KwUw 13107.00 t200msxs_uw_q0p2 0.00 13107.00 FORMAT "%8.2" /end CHARACTERISTIC
/begin CHARACTERISTIC T_KLIMADEADCTR "" VALUE 0x8FCD80 KwUb 255.0 dez 0.00 255.0 FORMAT "%5.1" /end CHARACTERISTIC
/begin CHARACTERISTIC T_KOM1CLDEAD "" VALUE 0x8FCD81 KwUb 255.0 dez 0.00 255.0 FORMAT "%5.1" /end CHARACTERISTIC
/begin CHARACTERISTIC T_NEGAT "" VALUE 0x8E0428 KwUb 25.50 t100msxs_ub_b25p5 0.00 25.50 FORMAT "%5.2" /end CHARACTERISTIC
/begin CHARACTERISTIC T_NEGE "" VALUE 0x8E0429 KwUb 2.550 t10msxs_ub_b2p55 0.00 2.550 FORMAT "%5.3" /end CHARACTERISTIC
/begin CHARACTERISTIC T_NOMAIR "" VALUE 0x8FCD82 KwUb 5.100 t20msxs_ub_b5p1 0.00 5.100 FORMAT "%5.3" /end CHARACTERISTIC
/begin CHARACTERISTIC T_NOMAIRTA "" VALUE 0x8FCD83 KwUb 5.100 t20msxs_ub_b5p1 0.00 5.100 FORMAT "%5.3" /end CHARACTERISTIC
/begin CHARACTERISTIC T_NOMASR "" VALUE 0x8FCD84 KwUb 2.550 t10msxs_ub_b2p55 0.00 2.550 FORMAT "%5.3" /end CHARACTERISTIC
/begin CHARACTERISTIC T_NOMASRTA "" VALUE 0x8FCD85 KwUb 2.550 t10msxs_ub_b2p55 0.00 2.550 FORMAT "%5.3" /end CHARACTERISTIC
/begin CHARACTERISTIC T_NOMBR2 "" VALUE 0x8FCD86 KwUb 5.100 t20msxs_ub_b5p1 0.00 5.100 FORMAT "%5.3" /end CHARACTERISTIC
/begin CHARACTERISTIC T_NOMBR3 "" VALUE 0x8FCD87 KwUb 2.550 t10msxs_ub_b2p55 0.00 2.550 FORMAT "%5.3" /end CHARACTERISTIC
/begin CHARACTERISTIC T_NOMBSG "" VALUE 0x8E042A KwUb 25.50 t100msxs_ub_b25p5 0.00 25.50 FORMAT "%5.2" /end CHARACTERISTIC
/begin CHARACTERISTIC T_NOMEGS "" VALUE 0x8FCD88 KwUb 2.550 t_q0p01 0.00 2.550 FORMAT "%5.3" /end CHARACTERISTIC
/begin CHARACTERISTIC T_NOMGAT "" VALUE 0x8E042B KwUb 25.50 t100msxs_ub_b25p5 0.00 25.50 FORMAT "%5.2" /end CHARACTERISTIC
/begin CHARACTERISTIC T_NOMKBI "" VALUE 0x8E042C KwUb 25.50 t100msxs_ub_b25p5 0.00 25.50 FORMAT "%5.2" /end CHARACTERISTIC
/begin CHARACTERISTIC T_NOMKBI1 "" VALUE 0x8FCD89 KwUb 5.100 t20msxs_ub_b5p1 0.00 5.100 FORMAT "%5.3" /end CHARACTERISTIC
/begin CHARACTERISTIC T_NOMKBI23 "" VALUE 0x8E042D KwUb 51.00 t200msxs_ub_b51 0.00 51.00 FORMAT "%5.2" /end CHARACTERISTIC
/begin CHARACTERISTIC T_NOMKLA "" VALUE 0x8FCD8A KwUb 5.100 t20msxs_ub_b5p1 0.00 5.100 FORMAT "%5.3" /end CHARACTERISTIC
/begin CHARACTERISTIC T_NOMLWS "" VALUE 0x8FCD8B KwUb 2.550 t10msxs_ub_b2p55 0.00 2.550 FORMAT "%5.3" /end CHARACTERISTIC
/begin CHARACTERISTIC T_NOMTOG "" VALUE 0x8E042E KwUb 127.5 t500msxs_ub_b127p5 0.00 127.5 FORMAT "%5.1" /end CHARACTERISTIC
/begin CHARACTERISTIC T_NOMZAS "" VALUE 0x8FCD8C KwUb 5.100 t20msxs_ub_b5p1 0.00 5.100 FORMAT "%5.3" /end CHARACTERISTIC
/begin CHARACTERISTIC T_NOMZASTA "" VALUE 0x8FCD8D KwUb 5.100 t20msxs_ub_b5p1 0.00 5.100 FORMAT "%5.3" /end CHARACTERISTIC
/begin CHARACTERISTIC T_NUBR2 "" VALUE 0x8FCD8E KwUb 5.100 t20msxs_ub_b5p1 0.00 5.100 FORMAT "%5.3" /end CHARACTERISTIC
/begin CHARACTERISTIC T_NUBSG "" VALUE 0x8E042F KwUb 25.50 t100msxs_ub_b25p5 0.00 25.50 FORMAT "%5.2" /end CHARACTERISTIC
/begin CHARACTERISTIC T_NUCINS1 "" VALUE 0x8FCD8F KwUb 5.100 t20msxs_ub_b5p1 0.00 5.100 FORMAT "%5.3" /end CHARACTERISTIC
/begin CHARACTERISTIC T_NUCINS23 "" VALUE 0x8E0430 KwUb 51.00 t200msxs_ub_b51 0.00 51.00 FORMAT "%5.2" /end CHARACTERISTIC
/begin CHARACTERISTIC T_NUKLA "" VALUE 0x8FCD90 KwUb 5.100 t20msxs_ub_b5p1 0.00 5.100 FORMAT "%5.3" /end CHARACTERISTIC
/begin CHARACTERISTIC T_NULWS "" VALUE 0x8FCD91 KwUb 2.550 t10msxs_ub_b2p55 0.00 2.550 FORMAT "%5.3" /end CHARACTERISTIC
/begin CHARACTERISTIC T_NUTOG "" VALUE 0x8E0431 KwUb 127.5 t500msxs_ub_b127p5 0.00 127.5 FORMAT "%5.1" /end CHARACTERISTIC
/begin CHARACTERISTIC UBDEKPMN "" VALUE 0x8E0EC0 KwUb 17.95 spg_ubatt 0.00 17.95 FORMAT "%5.2" /end CHARACTERISTIC
/begin CHARACTERISTIC UMNBUKSUE "" VALUE 0x8FDD52 KwUw 319.9951 spg_uw_q0p00488 0.00 319.9951 FORMAT "%8.4" /end CHARACTERISTIC
/begin CHARACTERISTIC UMXBUKSUE "" VALUE 0x8FDD54 KwUw 319.9951 spg_uw_q0p00488 0.00 319.9951 FORMAT "%8.4" /end CHARACTERISTIC
/begin CHARACTERISTIC ZAQUERWIV "" VALUE 0x8E03CC KwUb 25.4996 zk100msxs_ub_b25p5 0.100392 25.6000 FORMAT "%7.4" /end CHARACTERISTIC
/begin CHARACTERISTIC ZCANAIR "" VALUE 0x8FCD92 KwUb 5.100 t20msxs_ub_b5p1 0.00 5.100 FORMAT "%5.3" /end CHARACTERISTIC
/begin CHARACTERISTIC ZDYNFA "" VALUE 0x8E0D69 KwUb 255.0 dez 0.00 255.0 FORMAT "%5.1" /end CHARACTERISTIC
/begin CHARACTERISTIC ZDYNLSU "" VALUE 0x8E0D6A KwUb 255.0 dez 0.00 255.0 FORMAT "%5.1" /end CHARACTERISTIC
/begin CHARACTERISTIC ZKGAFRANM "" CURVE 0x8E9C60 KlAUwSstUwWUw 65534.000000 zk1sxs_uw_b65535 1.0000000000 65535.000000 FORMAT "%12.6"
 /begin AXIS_DESCR STD_AXIS pspvds_w fak_uw_b2 8 0.00 1.999969 FORMAT "%8.6" DEPOSIT ABSOLUTE /end AXIS_DESCR
/end CHARACTERISTIC
/begin CHARACTERISTIC ZLAMHP "" VALUE 0x8FDC46 KwUw 655.34999985 zk10msxs_uw_b655 0.010000152590 655.36000000 FORMAT "%12.8" /end CHARACTERISTIC
/begin CHARACTERISTIC ZLAMLP "" VALUE 0x8FDC48 KwUw 655.34999985 zk10msxs_uw_b655 0.010000152590 655.36000000 FORMAT "%12.8" /end CHARACTERISTIC
/begin CHARACTERISTIC ZNMOTWIV "" VALUE 0x8E03CD KwUb 25.4996 zk100msxs_ub_b25p5 0.100392 25.6000 FORMAT "%7.4" /end CHARACTERISTIC
/begin CHARACTERISTIC ZTOELKBI "" VALUE 0x8FD912 KwUw 655.3500 t10msxs_uw_b655p35 0.00 655.3500 FORMAT "%8.4" /end CHARACTERISTIC
/begin CHARACTERISTIC ZTOELMAX "" VALUE 0x8E5F70 KwUw 127.8750 t500msxs_q0p125 0.00 127.8750 FORMAT "%8.4" /end CHARACTERISTIC
/begin CHARACTERISTIC ZTOELMIN "" VALUE 0x8E5F72 KwUw 127.8750 t500msxs_q0p125 0.00 127.8750 FORMAT "%8.4" /end CHARACTERISTIC
/begin MEASUREMENT aeqkv_w "" UWORD fak_q2p0em8 1 100 0.00 0.001310700 FORMAT "%11.9" ECU_ADDRESS 0xF436E /end MEASUREMENT
/begin MEASUREMENT anzdyn "" UBYTE dez 1 100 0.00 255.0 FORMAT "%5.1" ECU_ADDRESS 0xF07D7 /end MEASUREMENT
/begin MEASUREMENT anzdyn2 "" UBYTE dez 1 100 0.00 255.0 FORMAT "%5.1" ECU_ADDRESS 0xF07D8 /end MEASUREMENT
/begin MEASUREMENT anzdyst "" UBYTE dez 1 100 0.00 255.0 FORMAT "%5.1" ECU_ADDRESS 0xF07D9 /end MEASUREMENT
/begin MEASUREMENT anzdyst2 "" UBYTE dez 1 100 0.00 255.0 FORMAT "%5.1" ECU_ADDRESS 0xF07DA /end MEASUREMENT
/begin MEASUREMENT aquerc "" UBYTE acc_q0p01o1p27g 1 100 -1.270 1.280 FORMAT "%5.3" ECU_ADDRESS 0xF0673 /end MEASUREMENT
/begin MEASUREMENT aquerf_w "" SWORD acc_sw_q3p91em4 1 100 -12.80000 12.79961 FORMAT "%8.5" ECU_ADDRESS 0xF4370 /end MEASUREMENT
/begin MEASUREMENT bbd2ctr "" UBYTE dez 1 100 0.00 255.0 FORMAT "%5.1" ECU_ADDRESS 0xF404B /end MEASUREMENT
/begin MEASUREMENT bbdcy "" UBYTE dez 1 100 0.00 255.0 FORMAT "%5.1" ECU_ADDRESS 0xF06CF /end MEASUREMENT
/begin MEASUREMENT bbno "" UBYTE dez 1 100 0.00 255.0 FORMAT "%5.1" ECU_ADDRESS 0x382031 /end MEASUREMENT
/begin MEASUREMENT bbsp3 "" UBYTE dez 1 100 0.00 255.0 FORMAT "%5.1" ECU_ADDRESS 0x382032 /end MEASUREMENT
/begin MEASUREMENT bbtim "" UBYTE dez 1 100 0.00 255.0 FORMAT "%5.1" ECU_ADDRESS 0xF06D0 /end MEASUREMENT
/begin MEASUREMENT bkvpea_ctr "" UBYTE dez 1 100 0.00 255.0 FORMAT "%5.1" ECU_ADDRESS 0xF41F8 /end MEASUREMENT
/begin MEASUREMENT bkvpena_ctr "" UWORD dez 1 100 0.00 1.000 BIT_MASK 0x1 FORMAT "%5.3" ECU_ADDRESS 0xF41F9 /end MEASUREMENT
/begin MEASUREMENT bz_air "" UBYTE DEZ 1 100 0.00 255.0 FORMAT "%5.1" ECU_ADDRESS 0xF0674 /end MEASUREMENT
/begin MEASUREMENT bz_anh "" UBYTE dez 1 100 0.00 255.0 FORMAT "%5.1" ECU_ADDRESS 0xF403C /end MEASUREMENT
/begin MEASUREMENT bz_bl "" UBYTE dez 1 100 0.00 255.0 FORMAT "%5.1" ECU_ADDRESS 0xF403D /end MEASUREMENT
/begin MEASUREMENT bz_can "" UBYTE DEZ 1 100 0.00 255.0 FORMAT "%5.1" ECU_ADDRESS 0xF0675 /end MEASUREMENT
/begin MEASUREMENT bz_cang1 "" UBYTE DEZ 1 100 0.00 255.0 FORMAT "%5.1" ECU_ADDRESS 0xF0676 /end MEASUREMENT
/begin MEASUREMENT bz_cange "" UBYTE DEZ 1 100 0.00 255.0 FORMAT "%5.1" ECU_ADDRESS 0xF0677 /end MEASUREMENT
/begin MEASUREMENT bz_tog "" UBYTE DEZ 1 100 0.00 255.0 FORMAT "%5.1" ECU_ADDRESS 0xF0678 /end MEASUREMENT
/begin MEASUREMENT B_aagnp "" UWORD B_TRUE 1 100 0.00 1.00000000000 BIT_MASK 0x10 FORMAT "%13.11" ECU_ADDRESS 0xFD22 /end MEASUREMENT
/begin MEASUREMENT B_aakupplc "" UWORD B_TRUE 1 100 0.00 1.00000000000 BIT_MASK 0x20 FORMAT "%13.11" ECU_ADDRESS 0xFD22 /end MEASUREMENT
/begin MEASUREMENT B_absdia "" UWORD B_TRUE 1 100 0.00 1.00000000000 BIT_MASK 0x40 FORMAT "%13.11" ECU_ADDRESS 0xFD22 /end MEASUREMENT
/begin MEASUREMENT B_absfgr "" UWORD B_TRUE 1 100 0.00 1.00000000000 BIT_MASK 0x80 FORMAT "%13.11" ECU_ADDRESS 0xFD22 /end MEASUREMENT
/begin MEASUREMENT B_adrbot "" UWORD B_TRUE 1 100 0.00 1.00000000000 BIT_MASK 0x100 FORMAT "%13.11" ECU_ADDRESS 0xFD22 /end MEASUREMENT
/begin MEASUREMENT B_aeqkvc "" UBYTE B_TRUE 1 100 0.00 1.00000000000 BIT_MASK 0x8 FORMAT "%13.11" ECU_ADDRESS 0xF0652 /end MEASUREMENT
/begin MEASUREMENT B_aircan "" UWORD B_TRUE 1 100 0.00 1.00000000000 BIT_MASK 0x200 FORMAT "%13.11" ECU_ADDRESS 0xFD22 /end MEASUREMENT
/begin MEASUREMENT B_airnbot "" UWORD B_TRUE 1 100 0.00 1.00000000000 BIT_MASK 0x400 FORMAT "%13.11" ECU_ADDRESS 0xFD22 /end MEASUREMENT
/begin MEASUREMENT B_amsrbot "" UWORD B_TRUE 1 100 0.00 1.00000000000 BIT_MASK 0x800 FORMAT "%13.11" ECU_ADDRESS 0xFD22 /end MEASUREMENT
/begin MEASUREMENT B_anherk "" UWORD B_TRUE 1 100 0.00 1.00000000000 BIT_MASK 0x1000 FORMAT "%13.11" ECU_ADDRESS 0xFD22 /end MEASUREMENT
/begin MEASUREMENT B_anhold "" UWORD B_TRUE 1 100 0.00 1.00000000000 BIT_MASK 0x2000 FORMAT "%13.11" ECU_ADDRESS 0xFD22 /end MEASUREMENT
/begin MEASUREMENT B_aquerc "" UWORD B_TRUE 1 100 0.00 1.00000000000 BIT_MASK 0x4000 FORMAT "%13.11" ECU_ADDRESS 0xFD22 /end MEASUREMENT
/begin MEASUREMENT B_asresp "" UWORD B_TRUE 1 100 0.00 1.00000000000 BIT_MASK 0x8000 FORMAT "%13.11" ECU_ADDRESS 0xFD22 /end MEASUREMENT
/begin MEASUREMENT B_asr_can "" UWORD B_TRUE 1 100 0.00 1.00000000000 BIT_MASK 0x1 FORMAT "%13.11" ECU_ADDRESS 0xFD24 /end MEASUREMENT
/begin MEASUREMENT B_avcair "" UWORD B_TRUE 1 100 0.00 1.00000000000 BIT_MASK 0x1000 FORMAT "%13.11" ECU_ADDRESS 0x382D46 /end MEASUREMENT
/begin MEASUREMENT B_avcas "" UWORD B_TRUE 1 100 0.00 1.00000000000 BIT_MASK 0x1000 FORMAT "%13.11" ECU_ADDRESS 0x382D4A /end MEASUREMENT
/begin MEASUREMENT B_avcat "" UWORD B_TRUE 1 100 0.00 1.00000000000 BIT_MASK 0x1000 FORMAT "%13.11" ECU_ADDRESS 0x382D4C /end MEASUREMENT
/begin MEASUREMENT B_avcbr2 "" UWORD B_TRUE 1 100 0.00 1.00000000000 BIT_MASK 0x1000 FORMAT "%13.11" ECU_ADDRESS 0x382D4E /end MEASUREMENT
/begin MEASUREMENT B_avcbsg "" UWORD B_TRUE 1 100 0.00 1.00000000000 BIT_MASK 0x1000 FORMAT "%13.11" ECU_ADDRESS 0x382D50 /end MEASUREMENT
/begin MEASUREMENT B_avcgat "" UWORD B_TRUE 1 100 0.00 1.00000000000 BIT_MASK 0x1000 FORMAT "%13.11" ECU_ADDRESS 0x382D52 /end MEASUREMENT
/begin MEASUREMENT B_avcgra "" UWORD B_TRUE 1 100 0.00 1.00000000000 BIT_MASK 0x1000 FORMAT "%13.11" ECU_ADDRESS 0x382D56 /end MEASUREMENT
/begin MEASUREMENT B_avtol "" UWORD B_TRUE 1 100 0.00 1.00000000000 BIT_MASK 0x1000 FORMAT "%13.11" ECU_ADDRESS 0x382E7C /end MEASUREMENT
/begin MEASUREMENT B_batnot "" UWORD B_TRUE 1 100 0.00 1.00000000000 BIT_MASK 0x2 FORMAT "%13.11" ECU_ADDRESS 0xFD24 /end MEASUREMENT
/begin MEASUREMENT B_bbdecj "" UWORD B_TRUE 1 100 0.00 1.00000000000 BIT_MASK 0x100 FORMAT "%13.11" ECU_ADDRESS 0xFD66 /end MEASUREMENT
/begin MEASUREMENT B_bbubr "" UWORD B_TRUE 1 100 0.00 1.00000000000 BIT_MASK 0x200 FORMAT "%13.11" ECU_ADDRESS 0xFD66 /end MEASUREMENT
/begin MEASUREMENT B_becair "" UWORD B_TRUE 1 100 0.00 1.00000000000 BIT_MASK 0x20 FORMAT "%13.11" ECU_ADDRESS 0x382D46 /end MEASUREMENT
/begin MEASUREMENT B_becas "" UWORD B_TRUE 1 100 0.00 1.00000000000 BIT_MASK 0x20 FORMAT "%13.11" ECU_ADDRESS 0x382D4A /end MEASUREMENT
/begin MEASUREMENT B_becat "" UWORD B_TRUE 1 100 0.00 1.00000000000 BIT_MASK 0x20 FORMAT "%13.11" ECU_ADDRESS 0x382D4C /end MEASUREMENT
/begin MEASUREMENT B_becbr2 "" UWORD B_TRUE 1 100 0.00 1.00000000000 BIT_MASK 0x20 FORMAT "%13.11" ECU_ADDRESS 0x382D4E /end MEASUREMENT
/begin MEASUREMENT B_becbsg "" UWORD B_TRUE 1 100 0.00 1.00000000000 BIT_MASK 0x20 FORMAT "%13.11" ECU_ADDRESS 0x382D50 /end MEASUREMENT
/begin MEASUREMENT B_becgat "" UWORD B_TRUE 1 100 0.00 1.00000000000 BIT_MASK 0x20 FORMAT "%13.11" ECU_ADDRESS 0x382D52 /end MEASUREMENT
/begin MEASUREMENT B_becgra "" UWORD B_TRUE 1 100 0.00 1.00000000000 BIT_MASK 0x20 FORMAT "%13.11" ECU_ADDRESS 0x382D56 /end MEASUREMENT
/begin MEASUREMENT B_bela "" UWORD B_TRUE 1 100 0.00 1.00000000000 BIT_MASK 0x4 FORMAT "%13.11" ECU_ADDRESS 0xFD24 /end MEASUREMENT
/begin MEASUREMENT B_belsv "" UWORD B_TRUE 1 100 0.00 1.00000000000 BIT_MASK 0x20 FORMAT "%13.11" ECU_ADDRESS 0x382E1A /end MEASUREMENT
/begin MEASUREMENT B_belsv2 "" UWORD B_TRUE 1 100 0.00 1.00000000000 BIT_MASK 0x20 FORMAT "%13.11" ECU_ADDRESS 0x382E1C /end MEASUREMENT
/begin MEASUREMENT B_beswe "" UWORD B_TRUE 1 100 0.00 1.00000000000 BIT_MASK 0x20 FORMAT "%13.11" ECU_ADDRESS 0x382E66 /end MEASUREMENT
/begin MEASUREMENT B_betol "" UWORD B_TRUE 1 100 0.00 1.00000000000 BIT_MASK 0x20 FORMAT "%13.11" ECU_ADDRESS 0x382E7C /end MEASUREMENT
/begin MEASUREMENT B_betum "" UWORD B_TRUE 1 100 0.00 1.00000000000 BIT_MASK 0x20 FORMAT "%13.11" ECU_ADDRESS 0x382E7E /end MEASUREMENT
/begin MEASUREMENT B_bkcair "" UWORD B_TRUE 1 100 0.00 1.00000000000 BIT_MASK 0x40 FORMAT "%13.11" ECU_ADDRESS 0x382D46 /end MEASUREMENT
/begin MEASUREMENT B_bkcas "" UWORD B_TRUE 1 100 0.00 1.00000000000 BIT_MASK 0x40 FORMAT "%13.11" ECU_ADDRESS 0x382D4A /end MEASUREMENT
/begin MEASUREMENT B_bkcat "" UWORD B_TRUE 1 100 0.00 1.00000000000 BIT_MASK 0x40 FORMAT "%13.11" ECU_ADDRESS 0x382D4C /end MEASUREMENT
/begin MEASUREMENT B_bkcbr2 "" UWORD B_TRUE 1 100 0.00 1.00000000000 BIT_MASK 0x40 FORMAT "%13.11" ECU_ADDRESS 0x382D4E /end MEASUREMENT
/begin MEASUREMENT B_bkcbsg "" UWORD B_TRUE 1 100 0.00 1.00000000000 BIT_MASK 0x40 FORMAT "%13.11" ECU_ADDRESS 0x382D50 /end MEASUREMENT
/begin MEASUREMENT B_bkcgat "" UWORD B_TRUE 1 100 0.00 1.00000000000 BIT_MASK 0x40 FORMAT "%13.11" ECU_ADDRESS 0x382D52 /end MEASUREMENT
/begin MEASUREMENT B_bkcgra "" UWORD B_TRUE 1 100 0.00 1.00000000000 BIT_MASK 0x40 FORMAT "%13.11" ECU_ADDRESS 0x382D56 /end MEASUREMENT
/begin MEASUREMENT B_bklsv "" UWORD B_TRUE 1 100 0.00 1.00000000000 BIT_MASK 0x40 FORMAT "%13.11" ECU_ADDRESS 0x382E1A /end MEASUREMENT
/begin MEASUREMENT B_bklsv2 "" UWORD B_TRUE 1 100 0.00 1.00000000000 BIT_MASK 0x40 FORMAT "%13.11" ECU_ADDRESS 0x382E1C /end MEASUREMENT
/begin MEASUREMENT B_bkswe "" UWORD B_TRUE 1 100 0.00 1.00000000000 BIT_MASK 0x40 FORMAT "%13.11" ECU_ADDRESS 0x382E66 /end MEASUREMENT
/begin MEASUREMENT B_bktol "" UWORD B_TRUE 1 100 0.00 1.00000000000 BIT_MASK 0x40 FORMAT "%13.11" ECU_ADDRESS 0x382E7C /end MEASUREMENT
/begin MEASUREMENT B_bktum "" UWORD B_TRUE 1 100 0.00 1.00000000000 BIT_MASK 0x40 FORMAT "%13.11" ECU_ADDRESS 0x382E7E /end MEASUREMENT
/begin MEASUREMENT B_bkva "" UWORD B_TRUE 1 100 0.00 1.00000000000 BIT_MASK 0x8 FORMAT "%13.11" ECU_ADDRESS 0xFD24 /end MEASUREMENT
/begin MEASUREMENT B_bkvpea "" UBYTE B_TRUE 1 100 0.00 1.00000000000 BIT_MASK 0x1 FORMAT "%13.11" ECU_ADDRESS 0xF0CA0 /end MEASUREMENT
/begin MEASUREMENT B_bkvpena "" UBYTE B_TRUE 1 100 0.00 1.00000000000 BIT_MASK 0x2 FORMAT "%13.11" ECU_ADDRESS 0xF0CA0 /end MEASUREMENT
/begin MEASUREMENT B_bkvvc "" UWORD B_TRUE 1 100 0.00 1.00000000000 BIT_MASK 0x10 FORMAT "%13.11" ECU_ADDRESS 0xFD24 /end MEASUREMENT
/begin MEASUREMENT B_blanhd "" UWORD B_TRUE 1 100 0.00 1.00000000000 BIT_MASK 0x20 FORMAT "%13.11" ECU_ADDRESS 0xFD24 /end MEASUREMENT
/begin MEASUREMENT B_blld "" UWORD B_TRUE 1 100 0.00 1.00000000000 BIT_MASK 0x40 FORMAT "%13.11" ECU_ADDRESS 0xFD24 /end MEASUREMENT
/begin MEASUREMENT B_blmd "" UWORD B_TRUE 1 100 0.00 1.00000000000 BIT_MASK 0x80 FORMAT "%13.11" ECU_ADDRESS 0xFD24 /end MEASUREMENT
/begin MEASUREMENT B_blrd "" UWORD B_TRUE 1 100 0.00 1.00000000000 BIT_MASK 0x100 FORMAT "%13.11" ECU_ADDRESS 0xFD24 /end MEASUREMENT
/begin MEASUREMENT B_br2bot "" UWORD B_TRUE 1 100 0.00 1.00000000000 BIT_MASK 0x200 FORMAT "%13.11" ECU_ADDRESS 0xFD24 /end MEASUREMENT
/begin MEASUREMENT B_br3bot "" UWORD B_TRUE 1 100 0.00 1.00000000000 BIT_MASK 0x400 FORMAT "%13.11" ECU_ADDRESS 0xFD24 /end MEASUREMENT
/begin MEASUREMENT B_bsgbot "" UWORD B_TRUE 1 100 0.00 1.00000000000 BIT_MASK 0x800 FORMAT "%13.11" ECU_ADDRESS 0xFD24 /end MEASUREMENT
/begin MEASUREMENT B_bsglue "" UWORD B_TRUE 1 100 0.00 1.00000000000 BIT_MASK 0x1000 FORMAT "%13.11" ECU_ADDRESS 0xFD24 /end MEASUREMENT
/begin MEASUREMENT B_busoffer "" UWORD B_TRUE 1 100 0.00 1.00000000000 BIT_MASK 0x2000 FORMAT "%13.11" ECU_ADDRESS 0xFD24 /end MEASUREMENT
/begin MEASUREMENT B_busoff_CAN1 "" UWORD B_TRUE 1 100 0.00 1.00000000000 BIT_MASK 0x4 FORMAT "%13.11" ECU_ADDRESS 0xFD06 /end MEASUREMENT
/begin MEASUREMENT B_busoff_CAN2 "" UWORD B_TRUE 1 100 0.00 1.00000000000 BIT_MASK 0x8 FORMAT "%13.11" ECU_ADDRESS 0xFD06 /end MEASUREMENT
/begin MEASUREMENT B_bus_off "" UWORD B_TRUE 1 100 0.00 1.00000000000 BIT_MASK 0x800 FORMAT "%13.11" ECU_ADDRESS 0xFD32 /end MEASUREMENT
/begin MEASUREMENT B_cankbi "" UBYTE B_TRUE 1 100 0.00 1.00000000000 BIT_MASK 0x1 FORMAT "%13.11" ECU_ADDRESS 0x382021 /end MEASUREMENT
/begin MEASUREMENT B_canlws "" UBYTE B_TRUE 1 100 0.00 1.00000000000 BIT_MASK 0x4 FORMAT "%13.11" ECU_ADDRESS 0x382021 /end MEASUREMENT
/begin MEASUREMENT B_cins1bot "" UWORD B_TRUE 1 100 0.00 1.00000000000 BIT_MASK 0x4000 FORMAT "%13.11" ECU_ADDRESS 0xFD24 /end MEASUREMENT
/begin MEASUREMENT B_cins2bot "" UWORD B_TRUE 1 100 0.00 1.00000000000 BIT_MASK 0x8000 FORMAT "%13.11" ECU_ADDRESS 0xFD24 /end MEASUREMENT
/begin MEASUREMENT B_cins3bot "" UWORD B_TRUE 1 100 0.00 1.00000000000 BIT_MASK 0x1 FORMAT "%13.11" ECU_ADDRESS 0xFD26 /end MEASUREMENT
/begin MEASUREMENT B_ckien "" UWORD B_TRUE 1 100 0.00 1.00000000000 BIT_MASK 0x2 FORMAT "%13.11" ECU_ADDRESS 0xFD26 /end MEASUREMENT
/begin MEASUREMENT B_clcair "" UWORD B_TRUE 1 100 0.00 1.00000000000 BIT_MASK 0x80 FORMAT "%13.11" ECU_ADDRESS 0x382D46 /end MEASUREMENT
/begin MEASUREMENT B_clcas "" UWORD B_TRUE 1 100 0.00 1.00000000000 BIT_MASK 0x80 FORMAT "%13.11" ECU_ADDRESS 0x382D4A /end MEASUREMENT
/begin MEASUREMENT B_clcat "" UWORD B_TRUE 1 100 0.00 1.00000000000 BIT_MASK 0x80 FORMAT "%13.11" ECU_ADDRESS 0x382D4C /end MEASUREMENT
/begin MEASUREMENT B_clcbr2 "" UWORD B_TRUE 1 100 0.00 1.00000000000 BIT_MASK 0x80 FORMAT "%13.11" ECU_ADDRESS 0x382D4E /end MEASUREMENT
/begin MEASUREMENT B_clcbsg "" UWORD B_TRUE 1 100 0.00 1.00000000000 BIT_MASK 0x80 FORMAT "%13.11" ECU_ADDRESS 0x382D50 /end MEASUREMENT
/begin MEASUREMENT B_clcgat "" UWORD B_TRUE 1 100 0.00 1.00000000000 BIT_MASK 0x80 FORMAT "%13.11" ECU_ADDRESS 0x382D52 /end MEASUREMENT
/begin MEASUREMENT B_clcgra "" UWORD B_TRUE 1 100 0.00 1.00000000000 BIT_MASK 0x80 FORMAT "%13.11" ECU_ADDRESS 0x382D56 /end MEASUREMENT
/begin MEASUREMENT B_cllsv "" UWORD B_TRUE 1 100 0.00 1.00000000000 BIT_MASK 0x80 FORMAT "%13.11" ECU_ADDRESS 0x382E1A /end MEASUREMENT
/begin MEASUREMENT B_cllsv2 "" UWORD B_TRUE 1 100 0.00 1.00000000000 BIT_MASK 0x80 FORMAT "%13.11" ECU_ADDRESS 0x382E1C /end MEASUREMENT
/begin MEASUREMENT B_clradlra "" UBYTE B_TRUE 1 100 0.00 1.00000000000 BIT_MASK 0x1 FORMAT "%13.11" ECU_ADDRESS 0xF07DB /end MEASUREMENT
/begin MEASUREMENT B_clswe "" UWORD B_TRUE 1 100 0.00 1.00000000000 BIT_MASK 0x80 FORMAT "%13.11" ECU_ADDRESS 0x382E66 /end MEASUREMENT
/begin MEASUREMENT B_cltol "" UWORD B_TRUE 1 100 0.00 1.00000000000 BIT_MASK 0x80 FORMAT "%13.11" ECU_ADDRESS 0x382E7C /end MEASUREMENT
/begin MEASUREMENT B_cltum "" UWORD B_TRUE 1 100 0.00 1.00000000000 BIT_MASK 0x80 FORMAT "%13.11" ECU_ADDRESS 0x382E7E /end MEASUREMENT
/begin MEASUREMENT B_csair "" UWORD B_TRUE 1 100 0.00 1.00000000000 BIT_MASK 0x4 FORMAT "%13.11" ECU_ADDRESS 0xFD26 /end MEASUREMENT
/begin MEASUREMENT B_csairio "" UWORD B_TRUE 1 100 0.00 1.00000000000 BIT_MASK 0x8 FORMAT "%13.11" ECU_ADDRESS 0xFD26 /end MEASUREMENT
/begin MEASUREMENT B_ctout "" UWORD B_TRUE 1 100 0.00 1.00000000000 BIT_MASK 0x10 FORMAT "%13.11" ECU_ADDRESS 0xFD26 /end MEASUREMENT
/begin MEASUREMENT B_cvtad_c "" UWORD B_TRUE 1 100 0.00 1.00000000000 BIT_MASK 0x20 FORMAT "%13.11" ECU_ADDRESS 0xFD26 /end MEASUREMENT
/begin MEASUREMENT B_dbkvpa "" UBYTE B_TRUE 1 100 0.00 1.00000000000 BIT_MASK 0x1 FORMAT "%13.11" ECU_ADDRESS 0xF41F7 /end MEASUREMENT
/begin MEASUREMENT B_dbuken "" UWORD B_TRUE 1 100 0.00 1.00000000000 BIT_MASK 0x4000 FORMAT "%13.11" ECU_ADDRESS 0xFD66 /end MEASUREMENT
/begin MEASUREMENT B_dcy "" UBYTE B_TRUE 1 100 0.00 1.00000000000 BIT_MASK 0x1 FORMAT "%13.11" ECU_ADDRESS 0xF06CF /end MEASUREMENT
/begin MEASUREMENT B_desee "" UWORD B_TRUE 1 100 0.00 1.00000000000 BIT_MASK 0x400 FORMAT "%13.11" ECU_ADDRESS 0xFD66 /end MEASUREMENT
/begin MEASUREMENT B_drlmx "" UBYTE B_TRUE 1 100 0.00 1.00000000000 BIT_MASK 0x2 FORMAT "%13.11" ECU_ADDRESS 0xF07DB /end MEASUREMENT
/begin MEASUREMENT B_dylsu "" UWORD B_TRUE 1 100 0.00 1.00000000000 BIT_MASK 0x2000 FORMAT "%13.11" ECU_ADDRESS 0xFD50 /end MEASUREMENT
/begin MEASUREMENT B_dylsu2 "" UWORD B_TRUE 1 100 0.00 1.00000000000 BIT_MASK 0x4000 FORMAT "%13.11" ECU_ADDRESS 0xFD50 /end MEASUREMENT
/begin MEASUREMENT B_dylsuav "" UBYTE B_TRUE 1 100 0.00 1.00000000000 BIT_MASK 0x2 FORMAT "%13.11" ECU_ADDRESS 0xF07DC /end MEASUREMENT
/begin MEASUREMENT B_dylsuav2 "" UBYTE B_TRUE 1 100 0.00 1.00000000000 BIT_MASK 0x2 FORMAT "%13.11" ECU_ADDRESS 0xF07DF /end MEASUREMENT
/begin MEASUREMENT B_dylsuf "" UBYTE B_TRUE 1 100 0.00 1.00000000000 BIT_MASK 0x1 FORMAT "%13.11" ECU_ADDRESS 0xF07DD /end MEASUREMENT
/begin MEASUREMENT B_ectal "" UWORD B_TRUE 1 100 0.00 1.00000000000 BIT_MASK 0x40 FORMAT "%13.11" ECU_ADDRESS 0xFD26 /end MEASUREMENT
/begin MEASUREMENT B_edsfgr "" UWORD B_TRUE 1 100 0.00 1.00000000000 BIT_MASK 0x80 FORMAT "%13.11" ECU_ADDRESS 0xFD26 /end MEASUREMENT
/begin MEASUREMENT B_eev "" UWORD B_TRUE 1 100 0.00 1.00000000000 BIT_MASK 0x1000 FORMAT "%13.11" ECU_ADDRESS 0xFD66 /end MEASUREMENT
/begin MEASUREMENT B_ehfmfe "" UBYTE B_TRUE 1 100 0.00 1.00000000000 BIT_MASK 0x80 FORMAT "%13.11" ECU_ADDRESS 0xF08C1 /end MEASUREMENT
/begin MEASUREMENT B_enabddg "" UBYTE B_TRUE 1 100 0.00 1.00000000000 BIT_MASK 0x1 FORMAT "%13.11" ECU_ADDRESS 0xF06EB /end MEASUREMENT
/begin MEASUREMENT B_epcden "" UBYTE B_TRUE 1 100 0.00 1.00000000000 BIT_MASK 0x2 FORMAT "%13.11" ECU_ADDRESS 0x382021 /end MEASUREMENT
/begin MEASUREMENT B_esdia "" UWORD B_TRUE 1 100 0.00 1.00000000000 BIT_MASK 0x800 FORMAT "%13.11" ECU_ADDRESS 0xFD66 /end MEASUREMENT
/begin MEASUREMENT B_ewrn_CAN1 "" UWORD B_TRUE 1 100 0.00 1.00000000000 BIT_MASK 0x10 FORMAT "%13.11" ECU_ADDRESS 0xFD06 /end MEASUREMENT
/begin MEASUREMENT B_ewrn_CAN2 "" UWORD B_TRUE 1 100 0.00 1.00000000000 BIT_MASK 0x20 FORMAT "%13.11" ECU_ADDRESS 0xFD06 /end MEASUREMENT
/begin MEASUREMENT B_fabr "" UWORD B_TRUE 1 100 0.00 1.00000000000 BIT_MASK 0x100 FORMAT "%13.11" ECU_ADDRESS 0xFD26 /end MEASUREMENT
/begin MEASUREMENT B_fdbkvp "" UBYTE B_TRUE 1 100 0.00 1.00000000000 BIT_MASK 0x2 FORMAT "%13.11" ECU_ADDRESS 0xF41F6 /end MEASUREMENT
/begin MEASUREMENT B_fempos "" UBYTE B_TRUE 1 100 0.00 1.00000000000 BIT_MASK 0x4 FORMAT "%13.11" ECU_ADDRESS 0xF08C1 /end MEASUREMENT
/begin MEASUREMENT B_fempus "" UBYTE B_TRUE 1 100 0.00 1.00000000000 BIT_MASK 0x8 FORMAT "%13.11" ECU_ADDRESS 0xF08C1 /end MEASUREMENT
/begin MEASUREMENT B_fgrabz "" UWORD B_TRUE 1 100 0.00 1.00000000000 BIT_MASK 0x200 FORMAT "%13.11" ECU_ADDRESS 0xFD26 /end MEASUREMENT
/begin MEASUREMENT B_fku_c "" UWORD B_TRUE 1 100 0.00 1.00000000000 BIT_MASK 0x400 FORMAT "%13.11" ECU_ADDRESS 0xFD26 /end MEASUREMENT
/begin MEASUREMENT B_fpbkvmx "" UBYTE B_TRUE 1 100 0.00 1.00000000000 BIT_MASK 0x4 FORMAT "%13.11" ECU_ADDRESS 0xF41F6 /end MEASUREMENT
/begin MEASUREMENT B_fst1pl "" UBYTE B_TRUE 1 100 0.00 1.00000000000 BIT_MASK 0x1 FORMAT "%13.11" ECU_ADDRESS 0xF0651 /end MEASUREMENT
/begin MEASUREMENT B_fst2pl "" UBYTE B_TRUE 1 100 0.00 1.00000000000 BIT_MASK 0x2 FORMAT "%13.11" ECU_ADDRESS 0xF0651 /end MEASUREMENT
/begin MEASUREMENT B_fst3pl "" UBYTE B_TRUE 1 100 0.00 1.00000000000 BIT_MASK 0x4 FORMAT "%13.11" ECU_ADDRESS 0xF0651 /end MEASUREMENT
/begin MEASUREMENT B_fst4pl "" UBYTE B_TRUE 1 100 0.00 1.00000000000 BIT_MASK 0x8 FORMAT "%13.11" ECU_ADDRESS 0xF0651 /end MEASUREMENT
/begin MEASUREMENT B_fstcanok "" UWORD B_TRUE 1 100 0.00 1.00000000000 BIT_MASK 0x800 FORMAT "%13.11" ECU_ADDRESS 0xFD26 /end MEASUREMENT
/begin MEASUREMENT B_ftcair "" UWORD B_TRUE 1 100 0.00 1.00000000000 BIT_MASK 0x10 FORMAT "%13.11" ECU_ADDRESS 0x382D46 /end MEASUREMENT
/begin MEASUREMENT B_ftcas "" UWORD B_TRUE 1 100 0.00 1.00000000000 BIT_MASK 0x10 FORMAT "%13.11" ECU_ADDRESS 0x382D4A /end MEASUREMENT
/begin MEASUREMENT B_ftcat "" UWORD B_TRUE 1 100 0.00 1.00000000000 BIT_MASK 0x10 FORMAT "%13.11" ECU_ADDRESS 0x382D4C /end MEASUREMENT
/begin MEASUREMENT B_ftcbr2 "" UWORD B_TRUE 1 100 0.00 1.00000000000 BIT_MASK 0x10 FORMAT "%13.11" ECU_ADDRESS 0x382D4E /end MEASUREMENT
/begin MEASUREMENT B_ftcbsg "" UWORD B_TRUE 1 100 0.00 1.00000000000 BIT_MASK 0x10 FORMAT "%13.11" ECU_ADDRESS 0x382D50 /end MEASUREMENT
/begin MEASUREMENT B_ftcgat "" UWORD B_TRUE 1 100 0.00 1.00000000000 BIT_MASK 0x10 FORMAT "%13.11" ECU_ADDRESS 0x382D52 /end MEASUREMENT
/begin MEASUREMENT B_ftcgra "" UWORD B_TRUE 1 100 0.00 1.00000000000 BIT_MASK 0x10 FORMAT "%13.11" ECU_ADDRESS 0x382D56 /end MEASUREMENT
/begin MEASUREMENT B_ftlsv "" UWORD B_TRUE 1 100 0.00 1.00000000000 BIT_MASK 0x10 FORMAT "%13.11" ECU_ADDRESS 0x382E1A /end MEASUREMENT
/begin MEASUREMENT B_ftlsv2 "" UWORD B_TRUE 1 100 0.00 1.00000000000 BIT_MASK 0x10 FORMAT "%13.11" ECU_ADDRESS 0x382E1C /end MEASUREMENT
/begin MEASUREMENT B_ftswe "" UWORD B_TRUE 1 100 0.00 1.00000000000 BIT_MASK 0x10 FORMAT "%13.11" ECU_ADDRESS 0x382E66 /end MEASUREMENT
/begin MEASUREMENT B_fttol "" UWORD B_TRUE 1 100 0.00 1.00000000000 BIT_MASK 0x10 FORMAT "%13.11" ECU_ADDRESS 0x382E7C /end MEASUREMENT
/begin MEASUREMENT B_fttum "" UWORD B_TRUE 1 100 0.00 1.00000000000 BIT_MASK 0x10 FORMAT "%13.11" ECU_ADDRESS 0x382E7E /end MEASUREMENT
/begin MEASUREMENT B_gaedegfe "" UBYTE B_TRUE 1 100 0.00 1.00000000000 BIT_MASK 0x10 FORMAT "%13.11" ECU_ADDRESS 0xF08C1 /end MEASUREMENT
/begin MEASUREMENT B_gafraos "" UBYTE B_TRUE 1 100 0.00 1.00000000000 BIT_MASK 0x1 FORMAT "%13.11" ECU_ADDRESS 0x382061 /end MEASUREMENT
/begin MEASUREMENT B_gafraus "" UBYTE B_TRUE 1 100 0.00 1.00000000000 BIT_MASK 0x2 FORMAT "%13.11" ECU_ADDRESS 0x382061 /end MEASUREMENT
/begin MEASUREMENT B_gatbot "" UWORD B_TRUE 1 100 0.00 1.00000000000 BIT_MASK 0x1000 FORMAT "%13.11" ECU_ADDRESS 0xFD26 /end MEASUREMENT
/begin MEASUREMENT B_ge1bot "" UWORD B_TRUE 1 100 0.00 1.00000000000 BIT_MASK 0x2000 FORMAT "%13.11" ECU_ADDRESS 0xFD26 /end MEASUREMENT
/begin MEASUREMENT B_ge2bot "" UWORD B_TRUE 1 100 0.00 1.00000000000 BIT_MASK 0x4000 FORMAT "%13.11" ECU_ADDRESS 0xFD26 /end MEASUREMENT
/begin MEASUREMENT B_geco_c "" UWORD B_TRUE 1 100 0.00 1.00000000000 BIT_MASK 0x8000 FORMAT "%13.11" ECU_ADDRESS 0xFD26 /end MEASUREMENT
/begin MEASUREMENT B_gekoa_c "" UWORD B_TRUE 1 100 0.00 1.00000000000 BIT_MASK 0x1 FORMAT "%13.11" ECU_ADDRESS 0xFD28 /end MEASUREMENT
/begin MEASUREMENT B_genot_c "" UWORD B_TRUE 1 100 0.00 1.00000000000 BIT_MASK 0x2 FORMAT "%13.11" ECU_ADDRESS 0xFD28 /end MEASUREMENT
/begin MEASUREMENT B_ges_c "" UWORD B_TRUE 1 100 0.00 1.00000000000 BIT_MASK 0x4 FORMAT "%13.11" ECU_ADDRESS 0xFD28 /end MEASUREMENT
/begin MEASUREMENT B_grabot "" UWORD B_TRUE 1 100 0.00 1.00000000000 BIT_MASK 0x8 FORMAT "%13.11" ECU_ADDRESS 0xFD28 /end MEASUREMENT
/begin MEASUREMENT B_grahianz "" UWORD B_TRUE 1 100 0.00 1.00000000000 BIT_MASK 0x10 FORMAT "%13.11" ECU_ADDRESS 0xFD28 /end MEASUREMENT
/begin MEASUREMENT B_gsaf1_c "" UWORD B_TRUE 1 100 0.00 1.00000000000 BIT_MASK 0x20 FORMAT "%13.11" ECU_ADDRESS 0xFD28 /end MEASUREMENT
/begin MEASUREMENT B_gsch_c "" UWORD B_TRUE 1 100 0.00 1.00000000000 BIT_MASK 0x40 FORMAT "%13.11" ECU_ADDRESS 0xFD28 /end MEASUREMENT
/begin MEASUREMENT B_haubest "" UWORD B_TRUE 1 100 0.00 1.00000000000 BIT_MASK 0x80 FORMAT "%13.11" ECU_ADDRESS 0xFD28 /end MEASUREMENT
/begin MEASUREMENT B_hlacan "" UWORD B_TRUE 1 100 0.00 1.00000000000 BIT_MASK 0x100 FORMAT "%13.11" ECU_ADDRESS 0xFD28 /end MEASUREMENT
/begin MEASUREMENT B_ilmnp "" UWORD B_TRUE 1 100 0.00 1.00000000000 BIT_MASK 0x200 FORMAT "%13.11" ECU_ADDRESS 0xFD28 /end MEASUREMENT
/begin MEASUREMENT B_insver "" UWORD B_TRUE 1 100 0.00 1.00000000000 BIT_MASK 0x400 FORMAT "%13.11" ECU_ADDRESS 0xFD28 /end MEASUREMENT
/begin MEASUREMENT B_kl50 "" UWORD B_TRUE 1 100 0.00 1.00000000000 BIT_MASK 0x800 FORMAT "%13.11" ECU_ADDRESS 0xFD28 /end MEASUREMENT
/begin MEASUREMENT B_klabot "" UWORD B_TRUE 1 100 0.00 1.00000000000 BIT_MASK 0x1000 FORMAT "%13.11" ECU_ADDRESS 0xFD28 /end MEASUREMENT
/begin MEASUREMENT B_kombi1_klima1 "" UWORD B_TRUE 1 100 0.00 1.00000000000 BIT_MASK 0x2000 FORMAT "%13.11" ECU_ADDRESS 0xFD28 /end MEASUREMENT
/begin MEASUREMENT B_kooffc "" UWORD B_TRUE 1 100 0.00 1.00000000000 BIT_MASK 0x4000 FORMAT "%13.11" ECU_ADDRESS 0xFD28 /end MEASUREMENT
/begin MEASUREMENT B_laedegfe "" UBYTE B_TRUE 1 100 0.00 1.00000000000 BIT_MASK 0x20 FORMAT "%13.11" ECU_ADDRESS 0xF08C1 /end MEASUREMENT
/begin MEASUREMENT B_lelsfbb "" UBYTE B_TRUE 1 100 0.00 1.00000000000 BIT_MASK 0x1 FORMAT "%13.11" ECU_ADDRESS 0xF0781 /end MEASUREMENT
/begin MEASUREMENT B_lelsfbb2 "" UBYTE B_TRUE 1 100 0.00 1.00000000000 BIT_MASK 0x1 FORMAT "%13.11" ECU_ADDRESS 0xF0782 /end MEASUREMENT
/begin MEASUREMENT B_lelshbb "" UBYTE B_TRUE 1 100 0.00 1.00000000000 BIT_MASK 0x2 FORMAT "%13.11" ECU_ADDRESS 0xF0781 /end MEASUREMENT
/begin MEASUREMENT B_lelshbb2 "" UBYTE B_TRUE 1 100 0.00 1.00000000000 BIT_MASK 0x2 FORMAT "%13.11" ECU_ADDRESS 0xF0782 /end MEASUREMENT
/begin MEASUREMENT B_lelsxbb "" UBYTE B_TRUE 1 100 0.00 1.00000000000 BIT_MASK 0x4 FORMAT "%13.11" ECU_ADDRESS 0xF0781 /end MEASUREMENT
/begin MEASUREMENT B_lelsxbb2 "" UBYTE B_TRUE 1 100 0.00 1.00000000000 BIT_MASK 0x4 FORMAT "%13.11" ECU_ADDRESS 0xF0782 /end MEASUREMENT
/begin MEASUREMENT B_lelsxnb "" UBYTE B_TRUE 1 100 0.00 1.00000000000 BIT_MASK 0x10 FORMAT "%13.11" ECU_ADDRESS 0xF0781 /end MEASUREMENT
/begin MEASUREMENT B_lelsxnb2 "" UBYTE B_TRUE 1 100 0.00 1.00000000000 BIT_MASK 0x10 FORMAT "%13.11" ECU_ADDRESS 0xF0782 /end MEASUREMENT
/begin MEASUREMENT B_lhold "" UWORD B_TRUE 1 100 0.00 1.00000000000 BIT_MASK 0x8000 FORMAT "%13.11" ECU_ADDRESS 0xFD28 /end MEASUREMENT
/begin MEASUREMENT B_lowra "" UWORD B_TRUE 1 100 0.00 1.00000000000 BIT_MASK 0x1 FORMAT "%13.11" ECU_ADDRESS 0xFD2A /end MEASUREMENT
/begin MEASUREMENT B_lrebwl "" UBYTE B_TRUE 1 100 0.00 1.00000000000 BIT_MASK 0x20 FORMAT "%13.11" ECU_ADDRESS 0xF0781 /end MEASUREMENT
/begin MEASUREMENT B_lrebwl2 "" UBYTE B_TRUE 1 100 0.00 1.00000000000 BIT_MASK 0x20 FORMAT "%13.11" ECU_ADDRESS 0xF0782 /end MEASUREMENT
/begin MEASUREMENT B_luesscb "" UWORD B_TRUE 1 100 0.00 1.00000000000 BIT_MASK 0x2 FORMAT "%13.11" ECU_ADDRESS 0xFD2A /end MEASUREMENT
/begin MEASUREMENT B_lwsbot "" UWORD B_TRUE 1 100 0.00 1.00000000000 BIT_MASK 0x4 FORMAT "%13.11" ECU_ADDRESS 0xFD2A /end MEASUREMENT
/begin MEASUREMENT B_lwser "" UWORD B_TRUE 1 100 0.00 1.00000000000 BIT_MASK 0x8 FORMAT "%13.11" ECU_ADDRESS 0xFD2A /end MEASUREMENT
/begin MEASUREMENT B_lwsok "" UWORD B_TRUE 1 100 0.00 1.00000000000 BIT_MASK 0x10 FORMAT "%13.11" ECU_ADDRESS 0xFD2A /end MEASUREMENT
/begin MEASUREMENT B_milfbg_c "" UWORD B_TRUE 1 100 0.00 1.00000000000 BIT_MASK 0x20 FORMAT "%13.11" ECU_ADDRESS 0xFD2A /end MEASUREMENT
/begin MEASUREMENT B_minflsu "" UWORD B_TRUE 1 100 0.00 1.00000000000 BIT_MASK 0x8000 FORMAT "%13.11" ECU_ADDRESS 0xFD50 /end MEASUREMENT
/begin MEASUREMENT B_minflsu2 "" UWORD B_TRUE 1 100 0.00 1.00000000000 BIT_MASK 0x1 FORMAT "%13.11" ECU_ADDRESS 0xFD52 /end MEASUREMENT
/begin MEASUREMENT B_mncair "" UWORD B_TRUE 1 100 0.00 1.00000000000 BIT_MASK 0x200 FORMAT "%13.11" ECU_ADDRESS 0x382D46 /end MEASUREMENT
/begin MEASUREMENT B_mncas "" UWORD B_TRUE 1 100 0.00 1.00000000000 BIT_MASK 0x200 FORMAT "%13.11" ECU_ADDRESS 0x382D4A /end MEASUREMENT
/begin MEASUREMENT B_mncat "" UWORD B_TRUE 1 100 0.00 1.00000000000 BIT_MASK 0x200 FORMAT "%13.11" ECU_ADDRESS 0x382D4C /end MEASUREMENT
/begin MEASUREMENT B_mncbr2 "" UWORD B_TRUE 1 100 0.00 1.00000000000 BIT_MASK 0x200 FORMAT "%13.11" ECU_ADDRESS 0x382D4E /end MEASUREMENT
/begin MEASUREMENT B_mncbsg "" UWORD B_TRUE 1 100 0.00 1.00000000000 BIT_MASK 0x200 FORMAT "%13.11" ECU_ADDRESS 0x382D50 /end MEASUREMENT
/begin MEASUREMENT B_mncgat "" UWORD B_TRUE 1 100 0.00 1.00000000000 BIT_MASK 0x200 FORMAT "%13.11" ECU_ADDRESS 0x382D52 /end MEASUREMENT
/begin MEASUREMENT B_mncgra "" UWORD B_TRUE 1 100 0.00 1.00000000000 BIT_MASK 0x200 FORMAT "%13.11" ECU_ADDRESS 0x382D56 /end MEASUREMENT
/begin MEASUREMENT B_mnlsv "" UWORD B_TRUE 1 100 0.00 1.00000000000 BIT_MASK 0x200 FORMAT "%13.11" ECU_ADDRESS 0x382E1A /end MEASUREMENT
/begin MEASUREMENT B_mnlsv2 "" UWORD B_TRUE 1 100 0.00 1.00000000000 BIT_MASK 0x200 FORMAT "%13.11" ECU_ADDRESS 0x382E1C /end MEASUREMENT
/begin MEASUREMENT B_mnswe "" UWORD B_TRUE 1 100 0.00 1.00000000000 BIT_MASK 0x200 FORMAT "%13.11" ECU_ADDRESS 0x382E66 /end MEASUREMENT
/begin MEASUREMENT B_mntol "" UWORD B_TRUE 1 100 0.00 1.00000000000 BIT_MASK 0x200 FORMAT "%13.11" ECU_ADDRESS 0x382E7C /end MEASUREMENT
/begin MEASUREMENT B_mntum "" UWORD B_TRUE 1 100 0.00 1.00000000000 BIT_MASK 0x200 FORMAT "%13.11" ECU_ADDRESS 0x382E7E /end MEASUREMENT
/begin MEASUREMENT B_motaus_c "" UWORD B_TRUE 1 100 0.00 1.00000000000 BIT_MASK 0x40 FORMAT "%13.11" ECU_ADDRESS 0xFD2A /end MEASUREMENT
/begin MEASUREMENT B_msr_can "" UWORD B_TRUE 1 100 0.00 1.00000000000 BIT_MASK 0x80 FORMAT "%13.11" ECU_ADDRESS 0xFD2A /end MEASUREMENT
/begin MEASUREMENT B_mxcair "" UWORD B_TRUE 1 100 0.00 1.00000000000 BIT_MASK 0x100 FORMAT "%13.11" ECU_ADDRESS 0x382D46 /end MEASUREMENT
/begin MEASUREMENT B_mxcas "" UWORD B_TRUE 1 100 0.00 1.00000000000 BIT_MASK 0x100 FORMAT "%13.11" ECU_ADDRESS 0x382D4A /end MEASUREMENT
/begin MEASUREMENT B_mxcat "" UWORD B_TRUE 1 100 0.00 1.00000000000 BIT_MASK 0x100 FORMAT "%13.11" ECU_ADDRESS 0x382D4C /end MEASUREMENT
/begin MEASUREMENT B_mxcbr2 "" UWORD B_TRUE 1 100 0.00 1.00000000000 BIT_MASK 0x100 FORMAT "%13.11" ECU_ADDRESS 0x382D4E /end MEASUREMENT
/begin MEASUREMENT B_mxcbsg "" UWORD B_TRUE 1 100 0.00 1.00000000000 BIT_MASK 0x100 FORMAT "%13.11" ECU_ADDRESS 0x382D50 /end MEASUREMENT
/begin MEASUREMENT B_mxcgat "" UWORD B_TRUE 1 100 0.00 1.00000000000 BIT_MASK 0x100 FORMAT "%13.11" ECU_ADDRESS 0x382D52 /end MEASUREMENT
/begin MEASUREMENT B_mxcgra "" UWORD B_TRUE 1 100 0.00 1.00000000000 BIT_MASK 0x100 FORMAT "%13.11" ECU_ADDRESS 0x382D56 /end MEASUREMENT
/begin MEASUREMENT B_mxlsv "" UWORD B_TRUE 1 100 0.00 1.00000000000 BIT_MASK 0x100 FORMAT "%13.11" ECU_ADDRESS 0x382E1A /end MEASUREMENT
/begin MEASUREMENT B_mxlsv2 "" UWORD B_TRUE 1 100 0.00 1.00000000000 BIT_MASK 0x100 FORMAT "%13.11" ECU_ADDRESS 0x382E1C /end MEASUREMENT
/begin MEASUREMENT B_mxswe "" UWORD B_TRUE 1 100 0.00 1.00000000000 BIT_MASK 0x100 FORMAT "%13.11" ECU_ADDRESS 0x382E66 /end MEASUREMENT
/begin MEASUREMENT B_mxtol "" UWORD B_TRUE 1 100 0.00 1.00000000000 BIT_MASK 0x100 FORMAT "%13.11" ECU_ADDRESS 0x382E7C /end MEASUREMENT
/begin MEASUREMENT B_mxtum "" UWORD B_TRUE 1 100 0.00 1.00000000000 BIT_MASK 0x100 FORMAT "%13.11" ECU_ADDRESS 0x382E7E /end MEASUREMENT
/begin MEASUREMENT B_ncdlsu "" UBYTE B_TRUE 1 100 0.00 1.00000000000 BIT_MASK 0x2 FORMAT "%13.11" ECU_ADDRESS 0xF07DD /end MEASUREMENT
/begin MEASUREMENT B_ncdlsu2 "" UBYTE B_TRUE 1 100 0.00 1.00000000000 BIT_MASK 0x4 FORMAT "%13.11" ECU_ADDRESS 0xF07DD /end MEASUREMENT
/begin MEASUREMENT B_neair "" UWORD B_TRUE 1 100 0.00 1.00000000000 BIT_MASK 0x100 FORMAT "%13.11" ECU_ADDRESS 0xFD2A /end MEASUREMENT
/begin MEASUREMENT B_neamsr "" UWORD B_TRUE 1 100 0.00 1.00000000000 BIT_MASK 0x200 FORMAT "%13.11" ECU_ADDRESS 0xFD2A /end MEASUREMENT
/begin MEASUREMENT B_nebr2 "" UWORD B_TRUE 1 100 0.00 1.00000000000 BIT_MASK 0x400 FORMAT "%13.11" ECU_ADDRESS 0xFD2A /end MEASUREMENT
/begin MEASUREMENT B_nebr3 "" UWORD B_TRUE 1 100 0.00 1.00000000000 BIT_MASK 0x800 FORMAT "%13.11" ECU_ADDRESS 0xFD2A /end MEASUREMENT
/begin MEASUREMENT B_nebsg "" UWORD B_TRUE 1 100 0.00 1.00000000000 BIT_MASK 0x1000 FORMAT "%13.11" ECU_ADDRESS 0xFD2A /end MEASUREMENT
/begin MEASUREMENT B_necins1 "" UWORD B_TRUE 1 100 0.00 1.00000000000 BIT_MASK 0x2000 FORMAT "%13.11" ECU_ADDRESS 0xFD2A /end MEASUREMENT
/begin MEASUREMENT B_necins2 "" UWORD B_TRUE 1 100 0.00 1.00000000000 BIT_MASK 0x4000 FORMAT "%13.11" ECU_ADDRESS 0xFD2A /end MEASUREMENT
/begin MEASUREMENT B_necins3 "" UWORD B_TRUE 1 100 0.00 1.00000000000 BIT_MASK 0x8000 FORMAT "%13.11" ECU_ADDRESS 0xFD2A /end MEASUREMENT
/begin MEASUREMENT B_negat "" UBYTE B_TRUE 1 100 0.00 1.00000000000 BIT_MASK 0x40 FORMAT "%13.11" ECU_ADDRESS 0x382020 /end MEASUREMENT
/begin MEASUREMENT B_nege "" UWORD B_TRUE 1 100 0.00 1.00000000000 BIT_MASK 0x1 FORMAT "%13.11" ECU_ADDRESS 0xFD2C /end MEASUREMENT
/begin MEASUREMENT B_nekla "" UWORD B_TRUE 1 100 0.00 1.00000000000 BIT_MASK 0x2 FORMAT "%13.11" ECU_ADDRESS 0xFD2C /end MEASUREMENT
/begin MEASUREMENT B_nelws "" UWORD B_TRUE 1 100 0.00 1.00000000000 BIT_MASK 0x4 FORMAT "%13.11" ECU_ADDRESS 0xFD2C /end MEASUREMENT
/begin MEASUREMENT B_netog "" UWORD B_TRUE 1 100 0.00 1.00000000000 BIT_MASK 0x8 FORMAT "%13.11" ECU_ADDRESS 0xFD2C /end MEASUREMENT
/begin MEASUREMENT B_newtog "" UBYTE B_TRUE 1 100 0.00 1.00000000000 BIT_MASK 0x1 FORMAT "%13.11" ECU_ADDRESS 0xF0652 /end MEASUREMENT
/begin MEASUREMENT B_nezas "" UWORD B_TRUE 1 100 0.00 1.00000000000 BIT_MASK 0x10 FORMAT "%13.11" ECU_ADDRESS 0xFD2C /end MEASUREMENT
/begin MEASUREMENT B_nlanbsg1 "" UWORD B_TRUE 1 100 0.00 1.00000000000 BIT_MASK 0x20 FORMAT "%13.11" ECU_ADDRESS 0xFD2C /end MEASUREMENT
/begin MEASUREMENT B_nlanbsg2 "" UWORD B_TRUE 1 100 0.00 1.00000000000 BIT_MASK 0x40 FORMAT "%13.11" ECU_ADDRESS 0xFD2C /end MEASUREMENT
/begin MEASUREMENT B_nlbm "" UWORD B_TRUE 1 100 0.00 1.00000000000 BIT_MASK 0x8000 FORMAT "%13.11" ECU_ADDRESS 0xFD3E /end MEASUREMENT
/begin MEASUREMENT B_nlbzanf "" UWORD B_TRUE 1 100 0.00 1.00000000000 BIT_MASK 0x80 FORMAT "%13.11" ECU_ADDRESS 0xFD2C /end MEASUREMENT
/begin MEASUREMENT B_nlbzanf2 "" UWORD B_TRUE 1 100 0.00 1.00000000000 BIT_MASK 0x100 FORMAT "%13.11" ECU_ADDRESS 0xFD2C /end MEASUREMENT
/begin MEASUREMENT B_nldg "" UWORD B_TRUE 1 100 0.00 1.00000000000 BIT_MASK 0x1 FORMAT "%13.11" ECU_ADDRESS 0xFD40 /end MEASUREMENT
/begin MEASUREMENT B_nlnobm "" UWORD B_TRUE 1 100 0.00 1.00000000000 BIT_MASK 0x2 FORMAT "%13.11" ECU_ADDRESS 0xFD40 /end MEASUREMENT
/begin MEASUREMENT B_nlnon "" UWORD B_TRUE 1 100 0.00 1.00000000000 BIT_MASK 0x4 FORMAT "%13.11" ECU_ADDRESS 0xFD40 /end MEASUREMENT
/begin MEASUREMENT B_no "" UBYTE B_TRUE 1 100 0.00 1.00000000000 BIT_MASK 0x1 FORMAT "%13.11" ECU_ADDRESS 0x382031 /end MEASUREMENT
/begin MEASUREMENT B_nobmflr1 "" UWORD B_TRUE 1 100 0.00 1.00000000000 BIT_MASK 0x8 FORMAT "%13.11" ECU_ADDRESS 0xFD40 /end MEASUREMENT
/begin MEASUREMENT B_nobmflr2 "" UWORD B_TRUE 1 100 0.00 1.00000000000 BIT_MASK 0x10 FORMAT "%13.11" ECU_ADDRESS 0xFD40 /end MEASUREMENT
/begin MEASUREMENT B_nocorflr "" UWORD B_TRUE 1 100 0.00 1.00000000000 BIT_MASK 0x20 FORMAT "%13.11" ECU_ADDRESS 0xFD40 /end MEASUREMENT
/begin MEASUREMENT B_npcair "" UWORD B_TRUE 1 100 0.00 1.00000000000 BIT_MASK 0x800 FORMAT "%13.11" ECU_ADDRESS 0x382D46 /end MEASUREMENT
/begin MEASUREMENT B_npcanswe "" UWORD B_TRUE 1 100 0.00 1.00000000000 BIT_MASK 0x200 FORMAT "%13.11" ECU_ADDRESS 0xFD2C /end MEASUREMENT
/begin MEASUREMENT B_npcas "" UWORD B_TRUE 1 100 0.00 1.00000000000 BIT_MASK 0x800 FORMAT "%13.11" ECU_ADDRESS 0x382D4A /end MEASUREMENT
/begin MEASUREMENT B_npcat "" UWORD B_TRUE 1 100 0.00 1.00000000000 BIT_MASK 0x800 FORMAT "%13.11" ECU_ADDRESS 0x382D4C /end MEASUREMENT
/begin MEASUREMENT B_npcbr2 "" UWORD B_TRUE 1 100 0.00 1.00000000000 BIT_MASK 0x800 FORMAT "%13.11" ECU_ADDRESS 0x382D4E /end MEASUREMENT
/begin MEASUREMENT B_npcbsg "" UWORD B_TRUE 1 100 0.00 1.00000000000 BIT_MASK 0x800 FORMAT "%13.11" ECU_ADDRESS 0x382D50 /end MEASUREMENT
/begin MEASUREMENT B_npcgat "" UWORD B_TRUE 1 100 0.00 1.00000000000 BIT_MASK 0x800 FORMAT "%13.11" ECU_ADDRESS 0x382D52 /end MEASUREMENT
/begin MEASUREMENT B_npcgra "" UWORD B_TRUE 1 100 0.00 1.00000000000 BIT_MASK 0x800 FORMAT "%13.11" ECU_ADDRESS 0x382D56 /end MEASUREMENT
/begin MEASUREMENT B_nplsv "" UWORD B_TRUE 1 100 0.00 1.00000000000 BIT_MASK 0x800 FORMAT "%13.11" ECU_ADDRESS 0x382E1A /end MEASUREMENT
/begin MEASUREMENT B_nplsv2 "" UWORD B_TRUE 1 100 0.00 1.00000000000 BIT_MASK 0x800 FORMAT "%13.11" ECU_ADDRESS 0x382E1C /end MEASUREMENT
/begin MEASUREMENT B_npswe "" UWORD B_TRUE 1 100 0.00 1.00000000000 BIT_MASK 0x800 FORMAT "%13.11" ECU_ADDRESS 0x382E66 /end MEASUREMENT
/begin MEASUREMENT B_nptol "" UWORD B_TRUE 1 100 0.00 1.00000000000 BIT_MASK 0x800 FORMAT "%13.11" ECU_ADDRESS 0x382E7C /end MEASUREMENT
/begin MEASUREMENT B_nptum "" UWORD B_TRUE 1 100 0.00 1.00000000000 BIT_MASK 0x800 FORMAT "%13.11" ECU_ADDRESS 0x382E7E /end MEASUREMENT
/begin MEASUREMENT B_nuair "" UWORD B_TRUE 1 100 0.00 1.00000000000 BIT_MASK 0x400 FORMAT "%13.11" ECU_ADDRESS 0xFD2C /end MEASUREMENT
/begin MEASUREMENT B_nuamsr "" UWORD B_TRUE 1 100 0.00 1.00000000000 BIT_MASK 0x800 FORMAT "%13.11" ECU_ADDRESS 0xFD2C /end MEASUREMENT
/begin MEASUREMENT B_nubr2 "" UWORD B_TRUE 1 100 0.00 1.00000000000 BIT_MASK 0x1000 FORMAT "%13.11" ECU_ADDRESS 0xFD2C /end MEASUREMENT
/begin MEASUREMENT B_nubr3 "" UWORD B_TRUE 1 100 0.00 1.00000000000 BIT_MASK 0x2000 FORMAT "%13.11" ECU_ADDRESS 0xFD2C /end MEASUREMENT
/begin MEASUREMENT B_nubsg "" UWORD B_TRUE 1 100 0.00 1.00000000000 BIT_MASK 0x4000 FORMAT "%13.11" ECU_ADDRESS 0xFD2C /end MEASUREMENT
/begin MEASUREMENT B_nucins2 "" UWORD B_TRUE 1 100 0.00 1.00000000000 BIT_MASK 0x8000 FORMAT "%13.11" ECU_ADDRESS 0xFD2C /end MEASUREMENT
/begin MEASUREMENT B_nugat "" UBYTE B_TRUE 1 100 0.00 1.00000000000 BIT_MASK 0x10 FORMAT "%13.11" ECU_ADDRESS 0x382020 /end MEASUREMENT
/begin MEASUREMENT B_nuge "" UWORD B_TRUE 1 100 0.00 1.00000000000 BIT_MASK 0x1 FORMAT "%13.11" ECU_ADDRESS 0xFD2E /end MEASUREMENT
/begin MEASUREMENT B_nukla "" UWORD B_TRUE 1 100 0.00 1.00000000000 BIT_MASK 0x2 FORMAT "%13.11" ECU_ADDRESS 0xFD2E /end MEASUREMENT
/begin MEASUREMENT B_nutog "" UWORD B_TRUE 1 100 0.00 1.00000000000 BIT_MASK 0x4 FORMAT "%13.11" ECU_ADDRESS 0xFD2E /end MEASUREMENT
/begin MEASUREMENT B_nuzas "" UWORD B_TRUE 1 100 0.00 1.00000000000 BIT_MASK 0x8 FORMAT "%13.11" ECU_ADDRESS 0xFD2E /end MEASUREMENT
/begin MEASUREMENT B_olfst1er "" UBYTE B_TRUE 1 100 0.00 1.00000000000 BIT_MASK 0x10 FORMAT "%13.11" ECU_ADDRESS 0xF0651 /end MEASUREMENT
/begin MEASUREMENT B_olfst2er "" UBYTE B_TRUE 1 100 0.00 1.00000000000 BIT_MASK 0x20 FORMAT "%13.11" ECU_ADDRESS 0xF0651 /end MEASUREMENT
/begin MEASUREMENT B_olfst3er "" UBYTE B_TRUE 1 100 0.00 1.00000000000 BIT_MASK 0x40 FORMAT "%13.11" ECU_ADDRESS 0xF0651 /end MEASUREMENT
/begin MEASUREMENT B_olfst4er "" UBYTE B_TRUE 1 100 0.00 1.00000000000 BIT_MASK 0x80 FORMAT "%13.11" ECU_ADDRESS 0xF0651 /end MEASUREMENT
/begin MEASUREMENT B_olfstc "" UBYTE B_TRUE 1 100 0.00 1.00000000000 BIT_MASK 0x8 FORMAT "%13.11" ECU_ADDRESS 0xF0650 /end MEASUREMENT
/begin MEASUREMENT B_olfstdis "" UBYTE B_TRUE 1 100 0.00 1.00000000000 BIT_MASK 0x20 FORMAT "%13.11" ECU_ADDRESS 0xF0650 /end MEASUREMENT
/begin MEASUREMENT B_olfstnva "" UBYTE B_TRUE 1 100 0.00 1.00000000000 BIT_MASK 0x10 FORMAT "%13.11" ECU_ADDRESS 0xF0650 /end MEASUREMENT
/begin MEASUREMENT B_olfstok "" UBYTE B_TRUE 1 100 0.00 1.00000000000 BIT_MASK 0x4 FORMAT "%13.11" ECU_ADDRESS 0xF0650 /end MEASUREMENT
/begin MEASUREMENT B_olfstpl "" UBYTE B_TRUE 1 100 0.00 1.00000000000 BIT_MASK 0x2 FORMAT "%13.11" ECU_ADDRESS 0xF0650 /end MEASUREMENT
/begin MEASUREMENT B_olswarn "" UBYTE B_TRUE 1 100 0.00 1.00000000000 BIT_MASK 0x4 FORMAT "%13.11" ECU_ADDRESS 0xF0652 /end MEASUREMENT
/begin MEASUREMENT B_pycair "" UWORD B_TRUE 1 100 0.00 1.00000000000 BIT_MASK 0x2000 FORMAT "%13.11" ECU_ADDRESS 0x382D46 /end MEASUREMENT
/begin MEASUREMENT B_pycas "" UWORD B_TRUE 1 100 0.00 1.00000000000 BIT_MASK 0x2000 FORMAT "%13.11" ECU_ADDRESS 0x382D4A /end MEASUREMENT
/begin MEASUREMENT B_pycat "" UWORD B_TRUE 1 100 0.00 1.00000000000 BIT_MASK 0x2000 FORMAT "%13.11" ECU_ADDRESS 0x382D4C /end MEASUREMENT
/begin MEASUREMENT B_pycbr2 "" UWORD B_TRUE 1 100 0.00 1.00000000000 BIT_MASK 0x2000 FORMAT "%13.11" ECU_ADDRESS 0x382D4E /end MEASUREMENT
/begin MEASUREMENT B_pycbsg "" UWORD B_TRUE 1 100 0.00 1.00000000000 BIT_MASK 0x2000 FORMAT "%13.11" ECU_ADDRESS 0x382D50 /end MEASUREMENT
/begin MEASUREMENT B_pycgat "" UWORD B_TRUE 1 100 0.00 1.00000000000 BIT_MASK 0x2000 FORMAT "%13.11" ECU_ADDRESS 0x382D52 /end MEASUREMENT
/begin MEASUREMENT B_pycgra "" UWORD B_TRUE 1 100 0.00 1.00000000000 BIT_MASK 0x2000 FORMAT "%13.11" ECU_ADDRESS 0x382D56 /end MEASUREMENT
/begin MEASUREMENT B_pytol "" UWORD B_TRUE 1 100 0.00 1.00000000000 BIT_MASK 0x2000 FORMAT "%13.11" ECU_ADDRESS 0x382E7C /end MEASUREMENT
/begin MEASUREMENT B_rdbkvp "" UBYTE B_TRUE 1 100 0.00 1.00000000000 BIT_MASK 0x2 FORMAT "%13.11" ECU_ADDRESS 0xF41F7 /end MEASUREMENT
/begin MEASUREMENT B_rdbkvpps "" UBYTE B_TRUE 1 100 0.00 1.00000000000 BIT_MASK 0x8 FORMAT "%13.11" ECU_ADDRESS 0xF41F7 /end MEASUREMENT
/begin MEASUREMENT B_redylsu "" UBYTE B_TRUE 1 100 0.00 1.00000000000 BIT_MASK 0x2 FORMAT "%13.11" ECU_ADDRESS 0xF07DE /end MEASUREMENT
/begin MEASUREMENT B_redylsu2 "" UBYTE B_TRUE 1 100 0.00 1.00000000000 BIT_MASK 0x2 FORMAT "%13.11" ECU_ADDRESS 0xF07E0 /end MEASUREMENT
/begin MEASUREMENT B_renair "" UWORD B_TRUE 1 100 0.00 1.00000000000 BIT_MASK 0x10 FORMAT "%13.11" ECU_ADDRESS 0xFD2E /end MEASUREMENT
/begin MEASUREMENT B_renamsr "" UWORD B_TRUE 1 100 0.00 1.00000000000 BIT_MASK 0x20 FORMAT "%13.11" ECU_ADDRESS 0xFD2E /end MEASUREMENT
/begin MEASUREMENT B_renbsg "" UWORD B_TRUE 1 100 0.00 1.00000000000 BIT_MASK 0x40 FORMAT "%13.11" ECU_ADDRESS 0xFD2E /end MEASUREMENT
/begin MEASUREMENT B_rencins1 "" UWORD B_TRUE 1 100 0.00 1.00000000000 BIT_MASK 0x80 FORMAT "%13.11" ECU_ADDRESS 0xFD2E /end MEASUREMENT
/begin MEASUREMENT B_rengat "" UWORD B_TRUE 1 100 0.00 1.00000000000 BIT_MASK 0x100 FORMAT "%13.11" ECU_ADDRESS 0xFD2E /end MEASUREMENT
/begin MEASUREMENT B_renge1 "" UWORD B_TRUE 1 100 0.00 1.00000000000 BIT_MASK 0x200 FORMAT "%13.11" ECU_ADDRESS 0xFD2E /end MEASUREMENT
/begin MEASUREMENT B_renkla "" UWORD B_TRUE 1 100 0.00 1.00000000000 BIT_MASK 0x400 FORMAT "%13.11" ECU_ADDRESS 0xFD2E /end MEASUREMENT
/begin MEASUREMENT B_renlws "" UWORD B_TRUE 1 100 0.00 1.00000000000 BIT_MASK 0x800 FORMAT "%13.11" ECU_ADDRESS 0xFD2E /end MEASUREMENT
/begin MEASUREMENT B_rentog "" UWORD B_TRUE 1 100 0.00 1.00000000000 BIT_MASK 0x1000 FORMAT "%13.11" ECU_ADDRESS 0xFD2E /end MEASUREMENT
/begin MEASUREMENT B_renzas "" UWORD B_TRUE 1 100 0.00 1.00000000000 BIT_MASK 0x2000 FORMAT "%13.11" ECU_ADDRESS 0xFD2E /end MEASUREMENT
/begin MEASUREMENT B_rtdbkvp "" UBYTE B_TRUE 1 100 0.00 1.00000000000 BIT_MASK 0x4 FORMAT "%13.11" ECU_ADDRESS 0xF41F7 /end MEASUREMENT
/begin MEASUREMENT B_sacc "" UWORD B_TRUE 1 100 0.00 1.00000000000 BIT_MASK 0x4000 FORMAT "%13.11" ECU_ADDRESS 0xFD2E /end MEASUREMENT
/begin MEASUREMENT B_sacvt_c "" UWORD B_TRUE 1 100 0.00 1.00000000000 BIT_MASK 0x8000 FORMAT "%13.11" ECU_ADDRESS 0xFD2E /end MEASUREMENT
/begin MEASUREMENT B_sccair "" UWORD B_TRUE 1 100 0.00 1.00000000000 BIT_MASK 0x4000 FORMAT "%13.11" ECU_ADDRESS 0x382D46 /end MEASUREMENT
/begin MEASUREMENT B_sccas "" UWORD B_TRUE 1 100 0.00 1.00000000000 BIT_MASK 0x4000 FORMAT "%13.11" ECU_ADDRESS 0x382D4A /end MEASUREMENT
/begin MEASUREMENT B_sccat "" UWORD B_TRUE 1 100 0.00 1.00000000000 BIT_MASK 0x4000 FORMAT "%13.11" ECU_ADDRESS 0x382D4C /end MEASUREMENT
/begin MEASUREMENT B_sccbr2 "" UWORD B_TRUE 1 100 0.00 1.00000000000 BIT_MASK 0x4000 FORMAT "%13.11" ECU_ADDRESS 0x382D4E /end MEASUREMENT
/begin MEASUREMENT B_sccbsg "" UWORD B_TRUE 1 100 0.00 1.00000000000 BIT_MASK 0x4000 FORMAT "%13.11" ECU_ADDRESS 0x382D50 /end MEASUREMENT
/begin MEASUREMENT B_sccgat "" UWORD B_TRUE 1 100 0.00 1.00000000000 BIT_MASK 0x4000 FORMAT "%13.11" ECU_ADDRESS 0x382D52 /end MEASUREMENT
/begin MEASUREMENT B_sccgra "" UWORD B_TRUE 1 100 0.00 1.00000000000 BIT_MASK 0x4000 FORMAT "%13.11" ECU_ADDRESS 0x382D56 /end MEASUREMENT
/begin MEASUREMENT B_sctol "" UWORD B_TRUE 1 100 0.00 1.00000000000 BIT_MASK 0x4000 FORMAT "%13.11" ECU_ADDRESS 0x382E7C /end MEASUREMENT
/begin MEASUREMENT B_setmnbm "" UBYTE B_TRUE 1 100 0.00 1.00000000000 BIT_MASK 0x2 FORMAT "%13.11" ECU_ADDRESS 0xF06EB /end MEASUREMENT
/begin MEASUREMENT B_setmxbm "" UBYTE B_TRUE 1 100 0.00 1.00000000000 BIT_MASK 0x4 FORMAT "%13.11" ECU_ADDRESS 0xF06EB /end MEASUREMENT
/begin MEASUREMENT B_setnpbm "" UBYTE B_TRUE 1 100 0.00 1.00000000000 BIT_MASK 0x8 FORMAT "%13.11" ECU_ADDRESS 0xF06EB /end MEASUREMENT
/begin MEASUREMENT B_setsibm "" UBYTE B_TRUE 1 100 0.00 1.00000000000 BIT_MASK 0x10 FORMAT "%13.11" ECU_ADDRESS 0xF06EB /end MEASUREMENT
/begin MEASUREMENT B_sfsc "" UWORD B_TRUE 1 100 0.00 1.00000000000 BIT_MASK 0x1 FORMAT "%13.11" ECU_ADDRESS 0xFD30 /end MEASUREMENT
/begin MEASUREMENT B_sh_act "" UWORD B_TRUE 1 100 0.00 1.00000000000 BIT_MASK 0x2 FORMAT "%13.11" ECU_ADDRESS 0xFD30 /end MEASUREMENT
/begin MEASUREMENT B_sh_mvw "" UWORD B_TRUE 1 100 0.00 1.00000000000 BIT_MASK 0x4 FORMAT "%13.11" ECU_ADDRESS 0xFD30 /end MEASUREMENT
/begin MEASUREMENT B_sicair "" UWORD B_TRUE 1 100 0.00 1.00000000000 BIT_MASK 0x400 FORMAT "%13.11" ECU_ADDRESS 0x382D46 /end MEASUREMENT
/begin MEASUREMENT B_sicas "" UWORD B_TRUE 1 100 0.00 1.00000000000 BIT_MASK 0x400 FORMAT "%13.11" ECU_ADDRESS 0x382D4A /end MEASUREMENT
/begin MEASUREMENT B_sicat "" UWORD B_TRUE 1 100 0.00 1.00000000000 BIT_MASK 0x400 FORMAT "%13.11" ECU_ADDRESS 0x382D4C /end MEASUREMENT
/begin MEASUREMENT B_sicbr2 "" UWORD B_TRUE 1 100 0.00 1.00000000000 BIT_MASK 0x400 FORMAT "%13.11" ECU_ADDRESS 0x382D4E /end MEASUREMENT
/begin MEASUREMENT B_sicbsg "" UWORD B_TRUE 1 100 0.00 1.00000000000 BIT_MASK 0x400 FORMAT "%13.11" ECU_ADDRESS 0x382D50 /end MEASUREMENT
/begin MEASUREMENT B_sicgat "" UWORD B_TRUE 1 100 0.00 1.00000000000 BIT_MASK 0x400 FORMAT "%13.11" ECU_ADDRESS 0x382D52 /end MEASUREMENT
/begin MEASUREMENT B_sicgra "" UWORD B_TRUE 1 100 0.00 1.00000000000 BIT_MASK 0x400 FORMAT "%13.11" ECU_ADDRESS 0x382D56 /end MEASUREMENT
/begin MEASUREMENT B_silsv "" UWORD B_TRUE 1 100 0.00 1.00000000000 BIT_MASK 0x400 FORMAT "%13.11" ECU_ADDRESS 0x382E1A /end MEASUREMENT
/begin MEASUREMENT B_silsv2 "" UWORD B_TRUE 1 100 0.00 1.00000000000 BIT_MASK 0x400 FORMAT "%13.11" ECU_ADDRESS 0x382E1C /end MEASUREMENT
/begin MEASUREMENT B_siswe "" UWORD B_TRUE 1 100 0.00 1.00000000000 BIT_MASK 0x400 FORMAT "%13.11" ECU_ADDRESS 0x382E66 /end MEASUREMENT
/begin MEASUREMENT B_sitol "" UWORD B_TRUE 1 100 0.00 1.00000000000 BIT_MASK 0x400 FORMAT "%13.11" ECU_ADDRESS 0x382E7C /end MEASUREMENT
/begin MEASUREMENT B_situm "" UWORD B_TRUE 1 100 0.00 1.00000000000 BIT_MASK 0x400 FORMAT "%13.11" ECU_ADDRESS 0x382E7E /end MEASUREMENT
/begin MEASUREMENT B_skoc "" UWORD B_TRUE 1 100 0.00 1.00000000000 BIT_MASK 0x8 FORMAT "%13.11" ECU_ADDRESS 0xFD30 /end MEASUREMENT
/begin MEASUREMENT B_sksc "" UWORD B_TRUE 1 100 0.00 1.00000000000 BIT_MASK 0x10 FORMAT "%13.11" ECU_ADDRESS 0xFD30 /end MEASUREMENT
/begin MEASUREMENT B_sleepa "" UWORD B_TRUE 1 100 0.00 1.00000000000 BIT_MASK 0x20 FORMAT "%13.11" ECU_ADDRESS 0xFD30 /end MEASUREMENT
/begin MEASUREMENT B_sp3 "" UBYTE B_TRUE 1 100 0.00 1.00000000000 BIT_MASK 0x1 FORMAT "%13.11" ECU_ADDRESS 0x382032 /end MEASUREMENT
/begin MEASUREMENT B_spdiaga "" UBYTE B_TRUE 1 100 0.00 1.00000000000 BIT_MASK 0x40 FORMAT "%13.11" ECU_ADDRESS 0xF07DE /end MEASUREMENT
/begin MEASUREMENT B_spdlsu "" UBYTE B_TRUE 1 100 0.00 1.00000000000 BIT_MASK 0x80 FORMAT "%13.11" ECU_ADDRESS 0xF07DE /end MEASUREMENT
/begin MEASUREMENT B_spdlsu2 "" UBYTE B_TRUE 1 100 0.00 1.00000000000 BIT_MASK 0x4 FORMAT "%13.11" ECU_ADDRESS 0xF07E0 /end MEASUREMENT
/begin MEASUREMENT B_stcal "" UBYTE B_TRUE 1 100 0.00 1.00000000000 BIT_MASK 0x1 FORMAT "%13.11" ECU_ADDRESS 0xF07DE /end MEASUREMENT
/begin MEASUREMENT B_stcal2 "" UBYTE B_TRUE 1 100 0.00 1.00000000000 BIT_MASK 0x1 FORMAT "%13.11" ECU_ADDRESS 0xF07E0 /end MEASUREMENT
/begin MEASUREMENT B_stcdyn "" UBYTE B_TRUE 1 100 0.00 1.00000000000 BIT_MASK 0x8 FORMAT "%13.11" ECU_ADDRESS 0xF07DC /end MEASUREMENT
/begin MEASUREMENT B_stcdyn2 "" UBYTE B_TRUE 1 100 0.00 1.00000000000 BIT_MASK 0x8 FORMAT "%13.11" ECU_ADDRESS 0xF07DF /end MEASUREMENT
/begin MEASUREMENT B_stesp "" UWORD B_TRUE 1 100 0.00 1.00000000000 BIT_MASK 0x40 FORMAT "%13.11" ECU_ADDRESS 0xFD30 /end MEASUREMENT
/begin MEASUREMENT B_subuk "" UWORD B_TRUE 1 100 0.00 1.00000000000 BIT_MASK 0x8000 FORMAT "%13.11" ECU_ADDRESS 0xFD66 /end MEASUREMENT
/begin MEASUREMENT B_swecan "" UWORD B_TRUE 1 100 0.00 1.00000000000 BIT_MASK 0x80 FORMAT "%13.11" ECU_ADDRESS 0xFD30 /end MEASUREMENT
/begin MEASUREMENT B_syserr "" UBYTE B_TRUE 1 100 0.00 1.00000000000 BIT_MASK 0x2 FORMAT "%13.11" ECU_ADDRESS 0xF404B /end MEASUREMENT
/begin MEASUREMENT B_syserrk "" UBYTE B_TRUE 1 100 0.00 1.00000000000 BIT_MASK 0x4 FORMAT "%13.11" ECU_ADDRESS 0xF404B /end MEASUREMENT
/begin MEASUREMENT B_tabcan "" UWORD B_TRUE 1 100 0.00 1.00000000000 BIT_MASK 0x100 FORMAT "%13.11" ECU_ADDRESS 0xFD30 /end MEASUREMENT
/begin MEASUREMENT B_talcan "" UWORD B_TRUE 1 100 0.00 1.00000000000 BIT_MASK 0x200 FORMAT "%13.11" ECU_ADDRESS 0xFD30 /end MEASUREMENT
/begin MEASUREMENT B_talkbi "" UWORD B_TRUE 1 100 0.00 1.00000000000 BIT_MASK 0x400 FORMAT "%13.11" ECU_ADDRESS 0xFD30 /end MEASUREMENT
/begin MEASUREMENT B_tepvb "" UWORD B_TRUE 1 100 0.00 1.00000000000 BIT_MASK 0x2 FORMAT "%13.11" ECU_ADDRESS 0xFD6E /end MEASUREMENT
/begin MEASUREMENT B_terrbr1 "" UWORD B_TRUE 1 100 0.00 1.00000000000 BIT_MASK 0x800 FORMAT "%13.11" ECU_ADDRESS 0xFD30 /end MEASUREMENT
/begin MEASUREMENT B_terrbr2 "" UWORD B_TRUE 1 100 0.00 1.00000000000 BIT_MASK 0x1000 FORMAT "%13.11" ECU_ADDRESS 0xFD30 /end MEASUREMENT
/begin MEASUREMENT B_terrbr3 "" UWORD B_TRUE 1 100 0.00 1.00000000000 BIT_MASK 0x2000 FORMAT "%13.11" ECU_ADDRESS 0xFD30 /end MEASUREMENT
/begin MEASUREMENT B_terrge "" UWORD B_TRUE 1 100 0.00 1.00000000000 BIT_MASK 0x4000 FORMAT "%13.11" ECU_ADDRESS 0xFD30 /end MEASUREMENT
/begin MEASUREMENT B_terrkla "" UWORD B_TRUE 1 100 0.00 1.00000000000 BIT_MASK 0x8000 FORMAT "%13.11" ECU_ADDRESS 0xFD30 /end MEASUREMENT
/begin MEASUREMENT B_tfstok "" UWORD B_TRUE 1 100 0.00 1.00000000000 BIT_MASK 0x1 FORMAT "%13.11" ECU_ADDRESS 0xFD32 /end MEASUREMENT
/begin MEASUREMENT B_tim "" UBYTE B_TRUE 1 100 0.00 1.00000000000 BIT_MASK 0x1 FORMAT "%13.11" ECU_ADDRESS 0xF06D0 /end MEASUREMENT
/begin MEASUREMENT B_tmkicb "" UWORD B_TRUE 1 100 0.00 1.00000000000 BIT_MASK 0x2 FORMAT "%13.11" ECU_ADDRESS 0xFD32 /end MEASUREMENT
/begin MEASUREMENT B_tmpksub "" UBYTE B_TRUE 1 100 0.00 1.00000000000 BIT_MASK 0x1 FORMAT "%13.11" ECU_ADDRESS 0xF0879 /end MEASUREMENT
/begin MEASUREMENT B_togbot "" UWORD B_TRUE 1 100 0.00 1.00000000000 BIT_MASK 0x4 FORMAT "%13.11" ECU_ADDRESS 0xFD32 /end MEASUREMENT
/begin MEASUREMENT B_togerr "" UWORD B_TRUE 1 100 0.00 1.00000000000 BIT_MASK 0x8 FORMAT "%13.11" ECU_ADDRESS 0xFD32 /end MEASUREMENT
/begin MEASUREMENT B_togmu "" UWORD B_TRUE 1 100 0.00 1.00000000000 BIT_MASK 0x10 FORMAT "%13.11" ECU_ADDRESS 0xFD32 /end MEASUREMENT
/begin MEASUREMENT B_togpu "" UWORD B_TRUE 1 100 0.00 1.00000000000 BIT_MASK 0x20 FORMAT "%13.11" ECU_ADDRESS 0xFD32 /end MEASUREMENT
/begin MEASUREMENT B_tolcb "" UBYTE B_TRUE 1 100 0.00 1.00000000000 BIT_MASK 0x10 FORMAT "%13.11" ECU_ADDRESS 0xF064F /end MEASUREMENT
/begin MEASUREMENT B_tolcbwiv "" UBYTE B_TRUE 1 100 0.00 1.00000000000 BIT_MASK 0x20 FORMAT "%13.11" ECU_ADDRESS 0xF064F /end MEASUREMENT
/begin MEASUREMENT B_tolfst "" UBYTE B_TRUE 1 100 0.00 1.00000000000 BIT_MASK 0x2 FORMAT "%13.11" ECU_ADDRESS 0xF0652 /end MEASUREMENT
/begin MEASUREMENT B_tolfstc "" UBYTE B_TRUE 1 100 0.00 1.00000000000 BIT_MASK 0x1 FORMAT "%13.11" ECU_ADDRESS 0xF064F /end MEASUREMENT
/begin MEASUREMENT B_trip "" UBYTE B_TRUE 1 100 0.00 1.00000000000 BIT_MASK 0x1 FORMAT "%13.11" ECU_ADDRESS 0xF404B /end MEASUREMENT
/begin MEASUREMENT B_tumcb "" UWORD B_TRUE 1 100 0.00 1.00000000000 BIT_MASK 0x40 FORMAT "%13.11" ECU_ADDRESS 0xFD32 /end MEASUREMENT
/begin MEASUREMENT B_tvera "" UBYTE B_TRUE 1 100 0.00 1.00000000000 BIT_MASK 0x10 FORMAT "%13.11" ECU_ADDRESS 0xF0652 /end MEASUREMENT
/begin MEASUREMENT B_tverac "" UBYTE B_TRUE 1 100 0.00 1.00000000000 BIT_MASK 0x4 FORMAT "%13.11" ECU_ADDRESS 0xF064F /end MEASUREMENT
/begin MEASUREMENT B_valdyn "" UBYTE B_TRUE 1 100 0.00 1.00000000000 BIT_MASK 0x10 FORMAT "%13.11" ECU_ADDRESS 0xF07DC /end MEASUREMENT
/begin MEASUREMENT B_valdyn2 "" UBYTE B_TRUE 1 100 0.00 1.00000000000 BIT_MASK 0x10 FORMAT "%13.11" ECU_ADDRESS 0xF07DF /end MEASUREMENT
/begin MEASUREMENT B_wowarn "" UBYTE B_TRUE 1 100 0.00 1.00000000000 BIT_MASK 0x8 FORMAT "%13.11" ECU_ADDRESS 0xF064F /end MEASUREMENT
/begin MEASUREMENT B_wswarn "" UBYTE B_TRUE 1 100 0.00 1.00000000000 BIT_MASK 0x2 FORMAT "%13.11" ECU_ADDRESS 0xF064F /end MEASUREMENT
/begin MEASUREMENT B_zasbot "" UWORD B_TRUE 1 100 0.00 1.00000000000 BIT_MASK 0x80 FORMAT "%13.11" ECU_ADDRESS 0xFD32 /end MEASUREMENT
/begin MEASUREMENT B_zask15 "" UWORD B_TRUE 1 100 0.00 1.00000000000 BIT_MASK 0x100 FORMAT "%13.11" ECU_ADDRESS 0xFD32 /end MEASUREMENT
/begin MEASUREMENT B_zask15v "" UWORD B_TRUE 1 100 0.00 1.00000000000 BIT_MASK 0x200 FORMAT "%13.11" ECU_ADDRESS 0xFD32 /end MEASUREMENT
/begin MEASUREMENT B_zbkvtest "" UBYTE B_TRUE 1 100 0.00 1.00000000000 BIT_MASK 0x1 FORMAT "%13.11" ECU_ADDRESS 0xF41F6 /end MEASUREMENT
/begin MEASUREMENT B_zges_c "" UWORD B_TRUE 1 100 0.00 1.00000000000 BIT_MASK 0x400 FORMAT "%13.11" ECU_ADDRESS 0xFD32 /end MEASUREMENT
/begin MEASUREMENT B_zhfmfe "" UBYTE B_TRUE 1 100 0.00 1.00000000000 BIT_MASK 0x40 FORMAT "%13.11" ECU_ADDRESS 0xF08C1 /end MEASUREMENT
/begin MEASUREMENT B_zolfst "" UBYTE B_TRUE 1 100 0.00 1.00000000000 BIT_MASK 0x20 FORMAT "%13.11" ECU_ADDRESS 0xF0652 /end MEASUREMENT
/begin MEASUREMENT B_ztoelpl "" UBYTE B_TRUE 1 100 0.00 1.00000000000 BIT_MASK 0x1 FORMAT "%13.11" ECU_ADDRESS 0xF0650 /end MEASUREMENT
/begin MEASUREMENT canbits1 "" UBYTE dez 1 100 0.00 255.0 FORMAT "%5.1" ECU_ADDRESS 0x382020 /end MEASUREMENT
/begin MEASUREMENT can_nv_bits "" UBYTE dez 1 100 0.00 255.0 FORMAT "%5.1" ECU_ADDRESS 0x382021 /end MEASUREMENT
/begin MEASUREMENT cs_air "" UBYTE DEZ 1 100 0.00 255.0 FORMAT "%5.1" ECU_ADDRESS 0xF067E /end MEASUREMENT
/begin MEASUREMENT ctrerf1 "" UBYTE dez 1 100 0.00 255.0 FORMAT "%5.1" ECU_ADDRESS 0xF404C /end MEASUREMENT
/begin MEASUREMENT ctrerfk1 "" UBYTE dez 1 100 0.00 255.0 FORMAT "%5.1" ECU_ADDRESS 0xF404D /end MEASUREMENT
/begin MEASUREMENT ctrrdy1 "" UBYTE dez 1 100 0.00 255.0 FORMAT "%5.1" ECU_ADDRESS 0xF404E /end MEASUREMENT
/begin MEASUREMENT ctrsfp "" UBYTE dez 1 100 0.00 255.0 FORMAT "%5.1" ECU_ADDRESS 0xF404F /end MEASUREMENT
/begin MEASUREMENT ctrzyf0 "" UBYTE dez 1 100 0.00 255.0 FORMAT "%5.1" ECU_ADDRESS 0xF4050 /end MEASUREMENT
/begin MEASUREMENT ctrzyf1 "" UBYTE dez 1 100 0.00 255.0 FORMAT "%5.1" ECU_ADDRESS 0xF4051 /end MEASUREMENT
/begin MEASUREMENT dbkvpelokbits "" UBYTE dez 1 100 0.00 255.0 FORMAT "%5.1" ECU_ADDRESS 0xF0CA0 /end MEASUREMENT
/begin MEASUREMENT DCFFLRLokBits1 "" UBYTE dez 1 100 0.00 255.0 FORMAT "%5.1" ECU_ADDRESS 0xF0781 /end MEASUREMENT
/begin MEASUREMENT DCFFLRLokBits2 "" UBYTE dez 1 100 0.00 255.0 FORMAT "%5.1" ECU_ADDRESS 0xF0782 /end MEASUREMENT
/begin MEASUREMENT dcycnt "" UWORD dez 1 100 0.00 65535.00 FORMAT "%8.2" ECU_ADDRESS 0x384052 /end MEASUREMENT
/begin MEASUREMENT DEGFEintbits "" UBYTE dez 1 100 0.00 255.0 FORMAT "%5.1" ECU_ADDRESS 0x382061 /end MEASUREMENT
/begin MEASUREMENT degfe_bits1 "" UBYTE dez 1 100 0.00 255.0 FORMAT "%5.1" ECU_ADDRESS 0xF08C1 /end MEASUREMENT
/begin MEASUREMENT dekpe "" UBYTE dez 1 100 0.00 255.0 FORMAT "%5.1" ECU_ADDRESS 0xF40B3 /end MEASUREMENT
/begin MEASUREMENT dfcmFcm "" UBYTE dez 1 100 0.00 255.0 FORMAT "%5.1" ECU_ADDRESS 0x382033 /end MEASUREMENT
/begin MEASUREMENT dfcmNo "" UBYTE dez 1 100 0.00 255.0 FORMAT "%5.1" ECU_ADDRESS 0x382034 /end MEASUREMENT
/begin MEASUREMENT dfcmSfp "" UBYTE dez 1 100 0.00 255.0 FORMAT "%5.1" ECU_ADDRESS 0x382035 /end MEASUREMENT
/begin MEASUREMENT dfpmEpclState "" UWORD dez 1 100 0.00 65535.00 FORMAT "%8.2" ECU_ADDRESS 0x382A86 /end MEASUREMENT
/begin MEASUREMENT dfpmMilState "" UWORD dez 1 100 0.00 65535.00 FORMAT "%8.2" ECU_ADDRESS 0x382A87 /end MEASUREMENT
/begin MEASUREMENT dfp_ap "" UBYTE dez 1 100 0.00 255.0 FORMAT "%5.1" ECU_ADDRESS 0x382036 /end MEASUREMENT
/begin MEASUREMENT dgafram_w "" UWORD fak_uw_b4_no1 1 100 -1.000000 2.999939 FORMAT "%8.6" ECU_ADDRESS 0x38406E /end MEASUREMENT
/begin MEASUREMENT dgafra_w "" UWORD fak_uw_b4_no1 1 100 -1.000000 2.999939 FORMAT "%8.6" ECU_ADDRESS 0x384070 /end MEASUREMENT
/begin MEASUREMENT dlws_w "" SWORD dlw_sw_q0p04375 1 100 -1434.044 1434.000 FORMAT "%8.3" ECU_ADDRESS 0xF142C /end MEASUREMENT
/begin MEASUREMENT dmrlsv_w "" UWORD rel_uw_b100 1 100 0.00 99.99847 FORMAT "%8.5" ECU_ADDRESS 0xF4514 /end MEASUREMENT
/begin MEASUREMENT dolfst1_w "" SWORD vol_q62p5ul 1 100 -2048.000 2047.938 FORMAT "%8.3" ECU_ADDRESS 0xF4380 /end MEASUREMENT
/begin MEASUREMENT dolfst2_w "" SWORD vol_q62p5ul 1 100 -2048.000 2047.938 FORMAT "%8.3" ECU_ADDRESS 0xF4382 /end MEASUREMENT
/begin MEASUREMENT dolfst3_w "" SWORD vol_q62p5ul 1 100 -2048.000 2047.938 FORMAT "%8.3" ECU_ADDRESS 0xF4384 /end MEASUREMENT
/begin MEASUREMENT dolfst4_w "" SWORD vol_q62p5ul 1 100 -2048.000 2047.938 FORMAT "%8.3" ECU_ADDRESS 0xF4386 /end MEASUREMENT
/begin MEASUREMENT dpbkvpa_w "" UWORD p_uw_q0p039 1 100 0.00 2559.961 FORMAT "%8.3" ECU_ADDRESS 0xF4FE0 /end MEASUREMENT
/begin MEASUREMENT dynlsu2_w "" UWORD fak_uw_b16 1 100 0.00 15.99976 FORMAT "%8.5" ECU_ADDRESS 0x382ED4 /end MEASUREMENT
/begin MEASUREMENT dynlsu_w "" UWORD fak_uw_b16 1 100 0.00 15.99976 FORMAT "%8.5" ECU_ADDRESS 0x382ED6 /end MEASUREMENT
/begin MEASUREMENT ekpfz "" UBYTE dez 1 100 0.00 255.0 FORMAT "%5.1" ECU_ADDRESS 0xF40B4 /end MEASUREMENT
/begin MEASUREMENT ekppz "" UBYTE dez 1 100 0.00 255.0 FORMAT "%5.1" ECU_ADDRESS 0xF40B5 /end MEASUREMENT
/begin MEASUREMENT E_cair "" UWORD B_TRUE 1 100 0.00 1.00000000000 BIT_MASK 0x1 FORMAT "%13.11" ECU_ADDRESS 0x382D46 /end MEASUREMENT
/begin MEASUREMENT E_cas "" UWORD B_TRUE 1 100 0.00 1.00000000000 BIT_MASK 0x1 FORMAT "%13.11" ECU_ADDRESS 0x382D4A /end MEASUREMENT
/begin MEASUREMENT E_cat "" UWORD B_TRUE 1 100 0.00 1.00000000000 BIT_MASK 0x1 FORMAT "%13.11" ECU_ADDRESS 0x382D4C /end MEASUREMENT
/begin MEASUREMENT E_cbr2 "" UWORD B_TRUE 1 100 0.00 1.00000000000 BIT_MASK 0x1 FORMAT "%13.11" ECU_ADDRESS 0x382D4E /end MEASUREMENT
/begin MEASUREMENT E_cbsg "" UWORD B_TRUE 1 100 0.00 1.00000000000 BIT_MASK 0x1 FORMAT "%13.11" ECU_ADDRESS 0x382D50 /end MEASUREMENT
/begin MEASUREMENT E_cgat "" UWORD B_TRUE 1 100 0.00 1.00000000000 BIT_MASK 0x1 FORMAT "%13.11" ECU_ADDRESS 0x382D52 /end MEASUREMENT
/begin MEASUREMENT E_cgra "" UWORD B_TRUE 1 100 0.00 1.00000000000 BIT_MASK 0x1 FORMAT "%13.11" ECU_ADDRESS 0x382D56 /end MEASUREMENT
/begin MEASUREMENT E_lsv "" UWORD B_TRUE 1 100 0.00 1.00000000000 BIT_MASK 0x1 FORMAT "%13.11" ECU_ADDRESS 0x382E1A /end MEASUREMENT
/begin MEASUREMENT E_lsv2 "" UWORD B_TRUE 1 100 0.00 1.00000000000 BIT_MASK 0x1 FORMAT "%13.11" ECU_ADDRESS 0x382E1C /end MEASUREMENT
/begin MEASUREMENT E_swe "" UWORD B_TRUE 1 100 0.00 1.00000000000 BIT_MASK 0x1 FORMAT "%13.11" ECU_ADDRESS 0x382E66 /end MEASUREMENT
/begin MEASUREMENT E_tol "" UWORD B_TRUE 1 100 0.00 1.00000000000 BIT_MASK 0x1 FORMAT "%13.11" ECU_ADDRESS 0x382E7C /end MEASUREMENT
/begin MEASUREMENT E_tum "" UWORD B_TRUE 1 100 0.00 1.00000000000 BIT_MASK 0x1 FORMAT "%13.11" ECU_ADDRESS 0x382E7E /end MEASUREMENT
/begin MEASUREMENT faquer "" UBYTE fak_ub_q0p02 1 100 0.00 5.100 FORMAT "%5.3" ECU_ADDRESS 0xF4023 /end MEASUREMENT
/begin MEASUREMENT faquerrd "" UBYTE dez 1 100 0.00 255.0 FORMAT "%5.1" ECU_ADDRESS 0xF4024 /end MEASUREMENT
/begin MEASUREMENT fcmcla_00_A "" UBYTE default 1 100 0.00 255.0 FORMAT "%5.1" ECU_ADDRESS 0x382A8D /end MEASUREMENT
/begin MEASUREMENT fcmcla_01_A "" UBYTE default 1 100 0.00 255.0 FORMAT "%5.1" ECU_ADDRESS 0x382AAF /end MEASUREMENT
/begin MEASUREMENT fcmcla_02_A "" UBYTE default 1 100 0.00 255.0 FORMAT "%5.1" ECU_ADDRESS 0x382AD1 /end MEASUREMENT
/begin MEASUREMENT fcmcla_03_A "" UBYTE default 1 100 0.00 255.0 FORMAT "%5.1" ECU_ADDRESS 0x382AF3 /end MEASUREMENT
/begin MEASUREMENT fcmcla_04_A "" UBYTE default 1 100 0.00 255.0 FORMAT "%5.1" ECU_ADDRESS 0x382B15 /end MEASUREMENT
/begin MEASUREMENT fcmcla_05_A "" UBYTE default 1 100 0.00 255.0 FORMAT "%5.1" ECU_ADDRESS 0x382B37 /end MEASUREMENT
/begin MEASUREMENT fcmcla_06_A "" UBYTE default 1 100 0.00 255.0 FORMAT "%5.1" ECU_ADDRESS 0x382B59 /end MEASUREMENT
/begin MEASUREMENT fcmcla_07_A "" UBYTE default 1 100 0.00 255.0 FORMAT "%5.1" ECU_ADDRESS 0x382B7B /end MEASUREMENT
/begin MEASUREMENT fcmcla_08_A "" UBYTE default 1 100 0.00 255.0 FORMAT "%5.1" ECU_ADDRESS 0x382B9D /end MEASUREMENT
/begin MEASUREMENT fcmcla_09_A "" UBYTE default 1 100 0.00 255.0 FORMAT "%5.1" ECU_ADDRESS 0x382BBF /end MEASUREMENT
/begin MEASUREMENT fcmcla_10_A "" UBYTE default 1 100 0.00 255.0 FORMAT "%5.1" ECU_ADDRESS 0x382BE1 /end MEASUREMENT
/begin MEASUREMENT fcmcla_11_A "" UBYTE default 1 100 0.00 255.0 FORMAT "%5.1" ECU_ADDRESS 0x382C03 /end MEASUREMENT
/begin MEASUREMENT fcmcla_12_A "" UBYTE default 1 100 0.00 255.0 FORMAT "%5.1" ECU_ADDRESS 0x382C25 /end MEASUREMENT
/begin MEASUREMENT fcmcla_13_A "" UBYTE default 1 100 0.00 255.0 FORMAT "%5.1" ECU_ADDRESS 0x382C47 /end MEASUREMENT
/begin MEASUREMENT fcmcla_14_A "" UBYTE default 1 100 0.00 255.0 FORMAT "%5.1" ECU_ADDRESS 0x382C69 /end MEASUREMENT
/begin MEASUREMENT fcmcla_15_A "" UBYTE default 1 100 0.00 255.0 FORMAT "%5.1" ECU_ADDRESS 0x382C8B /end MEASUREMENT
/begin MEASUREMENT fcmcla_16_A "" UBYTE default 1 100 0.00 255.0 FORMAT "%5.1" ECU_ADDRESS 0x382CAD /end MEASUREMENT
/begin MEASUREMENT fcmcla_17_A "" UBYTE default 1 100 0.00 255.0 FORMAT "%5.1" ECU_ADDRESS 0x382CCF /end MEASUREMENT
/begin MEASUREMENT fcmcla_18_A "" UBYTE default 1 100 0.00 255.0 FORMAT "%5.1" ECU_ADDRESS 0x382CF1 /end MEASUREMENT
/begin MEASUREMENT fcmcla_19_A "" UBYTE default 1 100 0.00 255.0 FORMAT "%5.1" ECU_ADDRESS 0x382D13 /end MEASUREMENT
/begin MEASUREMENT fcmdfp_00_A "" UBYTE dfp_verbal 1 100 0.00 192.000000000 FORMAT "%13.9" ECU_ADDRESS 0x382A88 /end MEASUREMENT
/begin MEASUREMENT fcmdfp_01_A "" UBYTE dfp_verbal 1 100 0.00 192.000000000 FORMAT "%13.9" ECU_ADDRESS 0x382AAA /end MEASUREMENT
/begin MEASUREMENT fcmdfp_02_A "" UBYTE dfp_verbal 1 100 0.00 192.000000000 FORMAT "%13.9" ECU_ADDRESS 0x382ACC /end MEASUREMENT
/begin MEASUREMENT fcmdfp_03_A "" UBYTE dfp_verbal 1 100 0.00 192.000000000 FORMAT "%13.9" ECU_ADDRESS 0x382AEE /end MEASUREMENT
/begin MEASUREMENT fcmdfp_04_A "" UBYTE dfp_verbal 1 100 0.00 192.000000000 FORMAT "%13.9" ECU_ADDRESS 0x382B10 /end MEASUREMENT
/begin MEASUREMENT fcmdfp_05_A "" UBYTE dfp_verbal 1 100 0.00 192.000000000 FORMAT "%13.9" ECU_ADDRESS 0x382B32 /end MEASUREMENT
/begin MEASUREMENT fcmdfp_06_A "" UBYTE dfp_verbal 1 100 0.00 192.000000000 FORMAT "%13.9" ECU_ADDRESS 0x382B54 /end MEASUREMENT
/begin MEASUREMENT fcmdfp_07_A "" UBYTE dfp_verbal 1 100 0.00 192.000000000 FORMAT "%13.9" ECU_ADDRESS 0x382B76 /end MEASUREMENT
/begin MEASUREMENT fcmdfp_08_A "" UBYTE dfp_verbal 1 100 0.00 192.000000000 FORMAT "%13.9" ECU_ADDRESS 0x382B98 /end MEASUREMENT
/begin MEASUREMENT fcmdfp_09_A "" UBYTE dfp_verbal 1 100 0.00 192.000000000 FORMAT "%13.9" ECU_ADDRESS 0x382BBA /end MEASUREMENT
/begin MEASUREMENT fcmdfp_10_A "" UBYTE dfp_verbal 1 100 0.00 192.000000000 FORMAT "%13.9" ECU_ADDRESS 0x382BDC /end MEASUREMENT
/begin MEASUREMENT fcmdfp_11_A "" UBYTE dfp_verbal 1 100 0.00 192.000000000 FORMAT "%13.9" ECU_ADDRESS 0x382BFE /end MEASUREMENT
/begin MEASUREMENT fcmdfp_12_A "" UBYTE dfp_verbal 1 100 0.00 192.000000000 FORMAT "%13.9" ECU_ADDRESS 0x382C20 /end MEASUREMENT
/begin MEASUREMENT fcmdfp_13_A "" UBYTE dfp_verbal 1 100 0.00 192.000000000 FORMAT "%13.9" ECU_ADDRESS 0x382C42 /end MEASUREMENT
/begin MEASUREMENT fcmdfp_14_A "" UBYTE dfp_verbal 1 100 0.00 192.000000000 FORMAT "%13.9" ECU_ADDRESS 0x382C64 /end MEASUREMENT
/begin MEASUREMENT fcmdfp_15_A "" UBYTE dfp_verbal 1 100 0.00 192.000000000 FORMAT "%13.9" ECU_ADDRESS 0x382C86 /end MEASUREMENT
/begin MEASUREMENT fcmdfp_16_A "" UBYTE dfp_verbal 1 100 0.00 192.000000000 FORMAT "%13.9" ECU_ADDRESS 0x382CA8 /end MEASUREMENT
/begin MEASUREMENT fcmdfp_17_A "" UBYTE dfp_verbal 1 100 0.00 192.000000000 FORMAT "%13.9" ECU_ADDRESS 0x382CCA /end MEASUREMENT
/begin MEASUREMENT fcmdfp_18_A "" UBYTE dfp_verbal 1 100 0.00 192.000000000 FORMAT "%13.9" ECU_ADDRESS 0x382CEC /end MEASUREMENT
/begin MEASUREMENT fcmdfp_19_A "" UBYTE dfp_verbal 1 100 0.00 192.000000000 FORMAT "%13.9" ECU_ADDRESS 0x382D0E /end MEASUREMENT
/begin MEASUREMENT fcmdlc_00_A "" UBYTE default 1 100 0.00 255.0 FORMAT "%5.1" ECU_ADDRESS 0x382A90 /end MEASUREMENT
/begin MEASUREMENT fcmdlc_01_A "" UBYTE default 1 100 0.00 255.0 FORMAT "%5.1" ECU_ADDRESS 0x382AB2 /end MEASUREMENT
/begin MEASUREMENT fcmdlc_02_A "" UBYTE default 1 100 0.00 255.0 FORMAT "%5.1" ECU_ADDRESS 0x382AD4 /end MEASUREMENT
/begin MEASUREMENT fcmdlc_03_A "" UBYTE default 1 100 0.00 255.0 FORMAT "%5.1" ECU_ADDRESS 0x382AF6 /end MEASUREMENT
/begin MEASUREMENT fcmdlc_04_A "" UBYTE default 1 100 0.00 255.0 FORMAT "%5.1" ECU_ADDRESS 0x382B18 /end MEASUREMENT
/begin MEASUREMENT fcmdlc_05_A "" UBYTE default 1 100 0.00 255.0 FORMAT "%5.1" ECU_ADDRESS 0x382B3A /end MEASUREMENT
/begin MEASUREMENT fcmdlc_06_A "" UBYTE default 1 100 0.00 255.0 FORMAT "%5.1" ECU_ADDRESS 0x382B5C /end MEASUREMENT
/begin MEASUREMENT fcmdlc_07_A "" UBYTE default 1 100 0.00 255.0 FORMAT "%5.1" ECU_ADDRESS 0x382B7E /end MEASUREMENT
/begin MEASUREMENT fcmdlc_08_A "" UBYTE default 1 100 0.00 255.0 FORMAT "%5.1" ECU_ADDRESS 0x382BA0 /end MEASUREMENT
/begin MEASUREMENT fcmdlc_09_A "" UBYTE default 1 100 0.00 255.0 FORMAT "%5.1" ECU_ADDRESS 0x382BC2 /end MEASUREMENT
/begin MEASUREMENT fcmdlc_10_A "" UBYTE default 1 100 0.00 255.0 FORMAT "%5.1" ECU_ADDRESS 0x382BE4 /end MEASUREMENT
/begin MEASUREMENT fcmdlc_11_A "" UBYTE default 1 100 0.00 255.0 FORMAT "%5.1" ECU_ADDRESS 0x382C06 /end MEASUREMENT
/begin MEASUREMENT fcmdlc_12_A "" UBYTE default 1 100 0.00 255.0 FORMAT "%5.1" ECU_ADDRESS 0x382C28 /end MEASUREMENT
/begin MEASUREMENT fcmdlc_13_A "" UBYTE default 1 100 0.00 255.0 FORMAT "%5.1" ECU_ADDRESS 0x382C4A /end MEASUREMENT
/begin MEASUREMENT fcmdlc_14_A "" UBYTE default 1 100 0.00 255.0 FORMAT "%5.1" ECU_ADDRESS 0x382C6C /end MEASUREMENT
/begin MEASUREMENT fcmdlc_15_A "" UBYTE default 1 100 0.00 255.0 FORMAT "%5.1" ECU_ADDRESS 0x382C8E /end MEASUREMENT
/begin MEASUREMENT fcmdlc_16_A "" UBYTE default 1 100 0.00 255.0 FORMAT "%5.1" ECU_ADDRESS 0x382CB0 /end MEASUREMENT
/begin MEASUREMENT fcmdlc_17_A "" UBYTE default 1 100 0.00 255.0 FORMAT "%5.1" ECU_ADDRESS 0x382CD2 /end MEASUREMENT
/begin MEASUREMENT fcmdlc_18_A "" UBYTE default 1 100 0.00 255.0 FORMAT "%5.1" ECU_ADDRESS 0x382CF4 /end MEASUREMENT
/begin MEASUREMENT fcmdlc_19_A "" UBYTE default 1 100 0.00 255.0 FORMAT "%5.1" ECU_ADDRESS 0x382D16 /end MEASUREMENT
/begin MEASUREMENT fcmEnd "" UBYTE dez 1 100 0.00 255.0 FORMAT "%5.1" ECU_ADDRESS 0x382037 /end MEASUREMENT
/begin MEASUREMENT fcmfes_00_A "" UBYTE default 1 100 0.00 255.0 FORMAT "%5.1" ECU_ADDRESS 0x382A8C /end MEASUREMENT
/begin MEASUREMENT fcmfes_01_A "" UBYTE default 1 100 0.00 255.0 FORMAT "%5.1" ECU_ADDRESS 0x382AAE /end MEASUREMENT
/begin MEASUREMENT fcmfes_02_A "" UBYTE default 1 100 0.00 255.0 FORMAT "%5.1" ECU_ADDRESS 0x382AD0 /end MEASUREMENT
/begin MEASUREMENT fcmfes_03_A "" UBYTE default 1 100 0.00 255.0 FORMAT "%5.1" ECU_ADDRESS 0x382AF2 /end MEASUREMENT
/begin MEASUREMENT fcmfes_04_A "" UBYTE default 1 100 0.00 255.0 FORMAT "%5.1" ECU_ADDRESS 0x382B14 /end MEASUREMENT
/begin MEASUREMENT fcmfes_05_A "" UBYTE default 1 100 0.00 255.0 FORMAT "%5.1" ECU_ADDRESS 0x382B36 /end MEASUREMENT
/begin MEASUREMENT fcmfes_06_A "" UBYTE default 1 100 0.00 255.0 FORMAT "%5.1" ECU_ADDRESS 0x382B58 /end MEASUREMENT
/begin MEASUREMENT fcmfes_07_A "" UBYTE default 1 100 0.00 255.0 FORMAT "%5.1" ECU_ADDRESS 0x382B7A /end MEASUREMENT
/begin MEASUREMENT fcmfes_08_A "" UBYTE default 1 100 0.00 255.0 FORMAT "%5.1" ECU_ADDRESS 0x382B9C /end MEASUREMENT
/begin MEASUREMENT fcmfes_09_A "" UBYTE default 1 100 0.00 255.0 FORMAT "%5.1" ECU_ADDRESS 0x382BBE /end MEASUREMENT
/begin MEASUREMENT fcmfes_10_A "" UBYTE default 1 100 0.00 255.0 FORMAT "%5.1" ECU_ADDRESS 0x382BE0 /end MEASUREMENT
/begin MEASUREMENT fcmfes_11_A "" UBYTE default 1 100 0.00 255.0 FORMAT "%5.1" ECU_ADDRESS 0x382C02 /end MEASUREMENT
/begin MEASUREMENT fcmfes_12_A "" UBYTE default 1 100 0.00 255.0 FORMAT "%5.1" ECU_ADDRESS 0x382C24 /end MEASUREMENT
/begin MEASUREMENT fcmfes_13_A "" UBYTE default 1 100 0.00 255.0 FORMAT "%5.1" ECU_ADDRESS 0x382C46 /end MEASUREMENT
/begin MEASUREMENT fcmfes_14_A "" UBYTE default 1 100 0.00 255.0 FORMAT "%5.1" ECU_ADDRESS 0x382C68 /end MEASUREMENT
/begin MEASUREMENT fcmfes_15_A "" UBYTE default 1 100 0.00 255.0 FORMAT "%5.1" ECU_ADDRESS 0x382C8A /end MEASUREMENT
/begin MEASUREMENT fcmfes_16_A "" UBYTE default 1 100 0.00 255.0 FORMAT "%5.1" ECU_ADDRESS 0x382CAC /end MEASUREMENT
/begin MEASUREMENT fcmfes_17_A "" UBYTE default 1 100 0.00 255.0 FORMAT "%5.1" ECU_ADDRESS 0x382CCE /end MEASUREMENT
/begin MEASUREMENT fcmfes_18_A "" UBYTE default 1 100 0.00 255.0 FORMAT "%5.1" ECU_ADDRESS 0x382CF0 /end MEASUREMENT
/begin MEASUREMENT fcmfes_19_A "" UBYTE default 1 100 0.00 255.0 FORMAT "%5.1" ECU_ADDRESS 0x382D12 /end MEASUREMENT
/begin MEASUREMENT fcmflc_00_A "" UBYTE default 1 100 0.00 255.0 FORMAT "%5.1" ECU_ADDRESS 0x382A8E /end MEASUREMENT
/begin MEASUREMENT fcmflc_01_A "" UBYTE default 1 100 0.00 255.0 FORMAT "%5.1" ECU_ADDRESS 0x382AB0 /end MEASUREMENT
/begin MEASUREMENT fcmflc_02_A "" UBYTE default 1 100 0.00 255.0 FORMAT "%5.1" ECU_ADDRESS 0x382AD2 /end MEASUREMENT
/begin MEASUREMENT fcmflc_03_A "" UBYTE default 1 100 0.00 255.0 FORMAT "%5.1" ECU_ADDRESS 0x382AF4 /end MEASUREMENT
/begin MEASUREMENT fcmflc_04_A "" UBYTE default 1 100 0.00 255.0 FORMAT "%5.1" ECU_ADDRESS 0x382B16 /end MEASUREMENT
/begin MEASUREMENT fcmflc_05_A "" UBYTE default 1 100 0.00 255.0 FORMAT "%5.1" ECU_ADDRESS 0x382B38 /end MEASUREMENT
/begin MEASUREMENT fcmflc_06_A "" UBYTE default 1 100 0.00 255.0 FORMAT "%5.1" ECU_ADDRESS 0x382B5A /end MEASUREMENT
/begin MEASUREMENT fcmflc_07_A "" UBYTE default 1 100 0.00 255.0 FORMAT "%5.1" ECU_ADDRESS 0x382B7C /end MEASUREMENT
/begin MEASUREMENT fcmflc_08_A "" UBYTE default 1 100 0.00 255.0 FORMAT "%5.1" ECU_ADDRESS 0x382B9E /end MEASUREMENT
/begin MEASUREMENT fcmflc_09_A "" UBYTE default 1 100 0.00 255.0 FORMAT "%5.1" ECU_ADDRESS 0x382BC0 /end MEASUREMENT
/begin MEASUREMENT fcmflc_10_A "" UBYTE default 1 100 0.00 255.0 FORMAT "%5.1" ECU_ADDRESS 0x382BE2 /end MEASUREMENT
/begin MEASUREMENT fcmflc_11_A "" UBYTE default 1 100 0.00 255.0 FORMAT "%5.1" ECU_ADDRESS 0x382C04 /end MEASUREMENT
/begin MEASUREMENT fcmflc_12_A "" UBYTE default 1 100 0.00 255.0 FORMAT "%5.1" ECU_ADDRESS 0x382C26 /end MEASUREMENT
/begin MEASUREMENT fcmflc_13_A "" UBYTE default 1 100 0.00 255.0 FORMAT "%5.1" ECU_ADDRESS 0x382C48 /end MEASUREMENT
/begin MEASUREMENT fcmflc_14_A "" UBYTE default 1 100 0.00 255.0 FORMAT "%5.1" ECU_ADDRESS 0x382C6A /end MEASUREMENT
/begin MEASUREMENT fcmflc_15_A "" UBYTE default 1 100 0.00 255.0 FORMAT "%5.1" ECU_ADDRESS 0x382C8C /end MEASUREMENT
/begin MEASUREMENT fcmflc_16_A "" UBYTE default 1 100 0.00 255.0 FORMAT "%5.1" ECU_ADDRESS 0x382CAE /end MEASUREMENT
/begin MEASUREMENT fcmflc_17_A "" UBYTE default 1 100 0.00 255.0 FORMAT "%5.1" ECU_ADDRESS 0x382CD0 /end MEASUREMENT
/begin MEASUREMENT fcmflc_18_A "" UBYTE default 1 100 0.00 255.0 FORMAT "%5.1" ECU_ADDRESS 0x382CF2 /end MEASUREMENT
/begin MEASUREMENT fcmflc_19_A "" UBYTE default 1 100 0.00 255.0 FORMAT "%5.1" ECU_ADDRESS 0x382D14 /end MEASUREMENT
/begin MEASUREMENT fcmfps_00_A "" UBYTE default 1 100 0.00 255.0 FORMAT "%5.1" ECU_ADDRESS 0x382A8A /end MEASUREMENT
/begin MEASUREMENT fcmfps_01_A "" UBYTE default 1 100 0.00 255.0 FORMAT "%5.1" ECU_ADDRESS 0x382AAC /end MEASUREMENT
/begin MEASUREMENT fcmfps_02_A "" UBYTE default 1 100 0.00 255.0 FORMAT "%5.1" ECU_ADDRESS 0x382ACE /end MEASUREMENT
/begin MEASUREMENT fcmfps_03_A "" UBYTE default 1 100 0.00 255.0 FORMAT "%5.1" ECU_ADDRESS 0x382AF0 /end MEASUREMENT
/begin MEASUREMENT fcmfps_04_A "" UBYTE default 1 100 0.00 255.0 FORMAT "%5.1" ECU_ADDRESS 0x382B12 /end MEASUREMENT
/begin MEASUREMENT fcmfps_05_A "" UBYTE default 1 100 0.00 255.0 FORMAT "%5.1" ECU_ADDRESS 0x382B34 /end MEASUREMENT
/begin MEASUREMENT fcmfps_06_A "" UBYTE default 1 100 0.00 255.0 FORMAT "%5.1" ECU_ADDRESS 0x382B56 /end MEASUREMENT
/begin MEASUREMENT fcmfps_07_A "" UBYTE default 1 100 0.00 255.0 FORMAT "%5.1" ECU_ADDRESS 0x382B78 /end MEASUREMENT
/begin MEASUREMENT fcmfps_08_A "" UBYTE default 1 100 0.00 255.0 FORMAT "%5.1" ECU_ADDRESS 0x382B9A /end MEASUREMENT
/begin MEASUREMENT fcmfps_09_A "" UBYTE default 1 100 0.00 255.0 FORMAT "%5.1" ECU_ADDRESS 0x382BBC /end MEASUREMENT
/begin MEASUREMENT fcmfps_10_A "" UBYTE default 1 100 0.00 255.0 FORMAT "%5.1" ECU_ADDRESS 0x382BDE /end MEASUREMENT
/begin MEASUREMENT fcmfps_11_A "" UBYTE default 1 100 0.00 255.0 FORMAT "%5.1" ECU_ADDRESS 0x382C00 /end MEASUREMENT
/begin MEASUREMENT fcmfps_12_A "" UBYTE default 1 100 0.00 255.0 FORMAT "%5.1" ECU_ADDRESS 0x382C22 /end MEASUREMENT
/begin MEASUREMENT fcmfps_13_A "" UBYTE default 1 100 0.00 255.0 FORMAT "%5.1" ECU_ADDRESS 0x382C44 /end MEASUREMENT
/begin MEASUREMENT fcmfps_14_A "" UBYTE default 1 100 0.00 255.0 FORMAT "%5.1" ECU_ADDRESS 0x382C66 /end MEASUREMENT
/begin MEASUREMENT fcmfps_15_A "" UBYTE default 1 100 0.00 255.0 FORMAT "%5.1" ECU_ADDRESS 0x382C88 /end MEASUREMENT
/begin MEASUREMENT fcmfps_16_A "" UBYTE default 1 100 0.00 255.0 FORMAT "%5.1" ECU_ADDRESS 0x382CAA /end MEASUREMENT
/begin MEASUREMENT fcmfps_17_A "" UBYTE default 1 100 0.00 255.0 FORMAT "%5.1" ECU_ADDRESS 0x382CCC /end MEASUREMENT
/begin MEASUREMENT fcmfps_18_A "" UBYTE default 1 100 0.00 255.0 FORMAT "%5.1" ECU_ADDRESS 0x382CEE /end MEASUREMENT
/begin MEASUREMENT fcmfps_19_A "" UBYTE default 1 100 0.00 255.0 FORMAT "%5.1" ECU_ADDRESS 0x382D10 /end MEASUREMENT
/begin MEASUREMENT fcmfrz0_00_A "" UBYTE default 1 100 0.00 255.0 FORMAT "%5.1" ECU_ADDRESS 0x382A91 /end MEASUREMENT
/begin MEASUREMENT fcmfrz0_01_A "" UBYTE default 1 100 0.00 255.0 FORMAT "%5.1" ECU_ADDRESS 0x382AB3 /end MEASUREMENT
/begin MEASUREMENT fcmfrz0_02_A "" UBYTE default 1 100 0.00 255.0 FORMAT "%5.1" ECU_ADDRESS 0x382AD5 /end MEASUREMENT
/begin MEASUREMENT fcmfrz0_03_A "" UBYTE default 1 100 0.00 255.0 FORMAT "%5.1" ECU_ADDRESS 0x382AF7 /end MEASUREMENT
/begin MEASUREMENT fcmfrz0_04_A "" UBYTE default 1 100 0.00 255.0 FORMAT "%5.1" ECU_ADDRESS 0x382B19 /end MEASUREMENT
/begin MEASUREMENT fcmfrz0_05_A "" UBYTE default 1 100 0.00 255.0 FORMAT "%5.1" ECU_ADDRESS 0x382B3B /end MEASUREMENT
/begin MEASUREMENT fcmfrz0_06_A "" UBYTE default 1 100 0.00 255.0 FORMAT "%5.1" ECU_ADDRESS 0x382B5D /end MEASUREMENT
/begin MEASUREMENT fcmfrz0_07_A "" UBYTE default 1 100 0.00 255.0 FORMAT "%5.1" ECU_ADDRESS 0x382B7F /end MEASUREMENT
/begin MEASUREMENT fcmfrz0_08_A "" UBYTE default 1 100 0.00 255.0 FORMAT "%5.1" ECU_ADDRESS 0x382BA1 /end MEASUREMENT
/begin MEASUREMENT fcmfrz0_09_A "" UBYTE default 1 100 0.00 255.0 FORMAT "%5.1" ECU_ADDRESS 0x382BC3 /end MEASUREMENT
/begin MEASUREMENT fcmfrz0_10_A "" UBYTE default 1 100 0.00 255.0 FORMAT "%5.1" ECU_ADDRESS 0x382BE5 /end MEASUREMENT
/begin MEASUREMENT fcmfrz0_11_A "" UBYTE default 1 100 0.00 255.0 FORMAT "%5.1" ECU_ADDRESS 0x382C07 /end MEASUREMENT
/begin MEASUREMENT fcmfrz0_12_A "" UBYTE default 1 100 0.00 255.0 FORMAT "%5.1" ECU_ADDRESS 0x382C29 /end MEASUREMENT
/begin MEASUREMENT fcmfrz0_13_A "" UBYTE default 1 100 0.00 255.0 FORMAT "%5.1" ECU_ADDRESS 0x382C4B /end MEASUREMENT
/begin MEASUREMENT fcmfrz0_14_A "" UBYTE default 1 100 0.00 255.0 FORMAT "%5.1" ECU_ADDRESS 0x382C6D /end MEASUREMENT
/begin MEASUREMENT fcmfrz0_15_A "" UBYTE default 1 100 0.00 255.0 FORMAT "%5.1" ECU_ADDRESS 0x382C8F /end MEASUREMENT
/begin MEASUREMENT fcmfrz0_16_A "" UBYTE default 1 100 0.00 255.0 FORMAT "%5.1" ECU_ADDRESS 0x382CB1 /end MEASUREMENT
/begin MEASUREMENT fcmfrz0_17_A "" UBYTE default 1 100 0.00 255.0 FORMAT "%5.1" ECU_ADDRESS 0x382CD3 /end MEASUREMENT
/begin MEASUREMENT fcmfrz0_18_A "" UBYTE default 1 100 0.00 255.0 FORMAT "%5.1" ECU_ADDRESS 0x382CF5 /end MEASUREMENT
/begin MEASUREMENT fcmfrz0_19_A "" UBYTE default 1 100 0.00 255.0 FORMAT "%5.1" ECU_ADDRESS 0x382D17 /end MEASUREMENT
/begin MEASUREMENT fcmfrz1_00_A "" UBYTE default 1 100 0.00 255.0 FORMAT "%5.1" ECU_ADDRESS 0x382A92 /end MEASUREMENT
/begin MEASUREMENT fcmfrz1_01_A "" UBYTE default 1 100 0.00 255.0 FORMAT "%5.1" ECU_ADDRESS 0x382AB4 /end MEASUREMENT
/begin MEASUREMENT fcmfrz1_02_A "" UBYTE default 1 100 0.00 255.0 FORMAT "%5.1" ECU_ADDRESS 0x382AD6 /end MEASUREMENT
/begin MEASUREMENT fcmfrz1_03_A "" UBYTE default 1 100 0.00 255.0 FORMAT "%5.1" ECU_ADDRESS 0x382AF8 /end MEASUREMENT
/begin MEASUREMENT fcmfrz1_04_A "" UBYTE default 1 100 0.00 255.0 FORMAT "%5.1" ECU_ADDRESS 0x382B1A /end MEASUREMENT
/begin MEASUREMENT fcmfrz1_05_A "" UBYTE default 1 100 0.00 255.0 FORMAT "%5.1" ECU_ADDRESS 0x382B3C /end MEASUREMENT
/begin MEASUREMENT fcmfrz1_06_A "" UBYTE default 1 100 0.00 255.0 FORMAT "%5.1" ECU_ADDRESS 0x382B5E /end MEASUREMENT
/begin MEASUREMENT fcmfrz1_07_A "" UBYTE default 1 100 0.00 255.0 FORMAT "%5.1" ECU_ADDRESS 0x382B80 /end MEASUREMENT
/begin MEASUREMENT fcmfrz1_08_A "" UBYTE default 1 100 0.00 255.0 FORMAT "%5.1" ECU_ADDRESS 0x382BA2 /end MEASUREMENT
/begin MEASUREMENT fcmfrz1_09_A "" UBYTE default 1 100 0.00 255.0 FORMAT "%5.1" ECU_ADDRESS 0x382BC4 /end MEASUREMENT
/begin MEASUREMENT fcmfrz1_10_A "" UBYTE default 1 100 0.00 255.0 FORMAT "%5.1" ECU_ADDRESS 0x382BE6 /end MEASUREMENT
/begin MEASUREMENT fcmfrz1_11_A "" UBYTE default 1 100 0.00 255.0 FORMAT "%5.1" ECU_ADDRESS 0x382C08 /end MEASUREMENT
/begin MEASUREMENT fcmfrz1_12_A "" UBYTE default 1 100 0.00 255.0 FORMAT "%5.1" ECU_ADDRESS 0x382C2A /end MEASUREMENT
/begin MEASUREMENT fcmfrz1_13_A "" UBYTE default 1 100 0.00 255.0 FORMAT "%5.1" ECU_ADDRESS 0x382C4C /end MEASUREMENT
/begin MEASUREMENT fcmfrz1_14_A "" UBYTE default 1 100 0.00 255.0 FORMAT "%5.1" ECU_ADDRESS 0x382C6E /end MEASUREMENT
/begin MEASUREMENT fcmfrz1_15_A "" UBYTE default 1 100 0.00 255.0 FORMAT "%5.1" ECU_ADDRESS 0x382C90 /end MEASUREMENT
/begin MEASUREMENT fcmfrz1_16_A "" UBYTE default 1 100 0.00 255.0 FORMAT "%5.1" ECU_ADDRESS 0x382CB2 /end MEASUREMENT
/begin MEASUREMENT fcmfrz1_17_A "" UBYTE default 1 100 0.00 255.0 FORMAT "%5.1" ECU_ADDRESS 0x382CD4 /end MEASUREMENT
/begin MEASUREMENT fcmfrz1_18_A "" UBYTE default 1 100 0.00 255.0 FORMAT "%5.1" ECU_ADDRESS 0x382CF6 /end MEASUREMENT
/begin MEASUREMENT fcmfrz1_19_A "" UBYTE default 1 100 0.00 255.0 FORMAT "%5.1" ECU_ADDRESS 0x382D18 /end MEASUREMENT
/begin MEASUREMENT fcmfrz10_00_A "" UBYTE default 1 100 0.00 255.0 FORMAT "%5.1" ECU_ADDRESS 0x382A9B /end MEASUREMENT
/begin MEASUREMENT fcmfrz10_01_A "" UBYTE default 1 100 0.00 255.0 FORMAT "%5.1" ECU_ADDRESS 0x382ABD /end MEASUREMENT
/begin MEASUREMENT fcmfrz10_02_A "" UBYTE default 1 100 0.00 255.0 FORMAT "%5.1" ECU_ADDRESS 0x382ADF /end MEASUREMENT
/begin MEASUREMENT fcmfrz10_03_A "" UBYTE default 1 100 0.00 255.0 FORMAT "%5.1" ECU_ADDRESS 0x382B01 /end MEASUREMENT
/begin MEASUREMENT fcmfrz10_04_A "" UBYTE default 1 100 0.00 255.0 FORMAT "%5.1" ECU_ADDRESS 0x382B23 /end MEASUREMENT
/begin MEASUREMENT fcmfrz10_05_A "" UBYTE default 1 100 0.00 255.0 FORMAT "%5.1" ECU_ADDRESS 0x382B45 /end MEASUREMENT
/begin MEASUREMENT fcmfrz10_06_A "" UBYTE default 1 100 0.00 255.0 FORMAT "%5.1" ECU_ADDRESS 0x382B67 /end MEASUREMENT
/begin MEASUREMENT fcmfrz10_07_A "" UBYTE default 1 100 0.00 255.0 FORMAT "%5.1" ECU_ADDRESS 0x382B89 /end MEASUREMENT
/begin MEASUREMENT fcmfrz10_08_A "" UBYTE default 1 100 0.00 255.0 FORMAT "%5.1" ECU_ADDRESS 0x382BAB /end MEASUREMENT
/begin MEASUREMENT fcmfrz10_09_A "" UBYTE default 1 100 0.00 255.0 FORMAT "%5.1" ECU_ADDRESS 0x382BCD /end MEASUREMENT
/begin MEASUREMENT fcmfrz10_10_A "" UBYTE default 1 100 0.00 255.0 FORMAT "%5.1" ECU_ADDRESS 0x382BEF /end MEASUREMENT
/begin MEASUREMENT fcmfrz10_11_A "" UBYTE default 1 100 0.00 255.0 FORMAT "%5.1" ECU_ADDRESS 0x382C11 /end MEASUREMENT
/begin MEASUREMENT fcmfrz10_12_A "" UBYTE default 1 100 0.00 255.0 FORMAT "%5.1" ECU_ADDRESS 0x382C33 /end MEASUREMENT
/begin MEASUREMENT fcmfrz10_13_A "" UBYTE default 1 100 0.00 255.0 FORMAT "%5.1" ECU_ADDRESS 0x382C55 /end MEASUREMENT
/begin MEASUREMENT fcmfrz10_14_A "" UBYTE default 1 100 0.00 255.0 FORMAT "%5.1" ECU_ADDRESS 0x382C77 /end MEASUREMENT
/begin MEASUREMENT fcmfrz10_15_A "" UBYTE default 1 100 0.00 255.0 FORMAT "%5.1" ECU_ADDRESS 0x382C99 /end MEASUREMENT
/begin MEASUREMENT fcmfrz10_16_A "" UBYTE default 1 100 0.00 255.0 FORMAT "%5.1" ECU_ADDRESS 0x382CBB /end MEASUREMENT
/begin MEASUREMENT fcmfrz10_17_A "" UBYTE default 1 100 0.00 255.0 FORMAT "%5.1" ECU_ADDRESS 0x382CDD /end MEASUREMENT
/begin MEASUREMENT fcmfrz10_18_A "" UBYTE default 1 100 0.00 255.0 FORMAT "%5.1" ECU_ADDRESS 0x382CFF /end MEASUREMENT
/begin MEASUREMENT fcmfrz10_19_A "" UBYTE default 1 100 0.00 255.0 FORMAT "%5.1" ECU_ADDRESS 0x382D21 /end MEASUREMENT
/begin MEASUREMENT fcmfrz2_00_A "" UBYTE default 1 100 0.00 255.0 FORMAT "%5.1" ECU_ADDRESS 0x382A93 /end MEASUREMENT
/begin MEASUREMENT fcmfrz2_01_A "" UBYTE default 1 100 0.00 255.0 FORMAT "%5.1" ECU_ADDRESS 0x382AB5 /end MEASUREMENT
/begin MEASUREMENT fcmfrz2_02_A "" UBYTE default 1 100 0.00 255.0 FORMAT "%5.1" ECU_ADDRESS 0x382AD7 /end MEASUREMENT
/begin MEASUREMENT fcmfrz2_03_A "" UBYTE default 1 100 0.00 255.0 FORMAT "%5.1" ECU_ADDRESS 0x382AF9 /end MEASUREMENT
/begin MEASUREMENT fcmfrz2_04_A "" UBYTE default 1 100 0.00 255.0 FORMAT "%5.1" ECU_ADDRESS 0x382B1B /end MEASUREMENT
/begin MEASUREMENT fcmfrz2_05_A "" UBYTE default 1 100 0.00 255.0 FORMAT "%5.1" ECU_ADDRESS 0x382B3D /end MEASUREMENT
/begin MEASUREMENT fcmfrz2_06_A "" UBYTE default 1 100 0.00 255.0 FORMAT "%5.1" ECU_ADDRESS 0x382B5F /end MEASUREMENT
/begin MEASUREMENT fcmfrz2_07_A "" UBYTE default 1 100 0.00 255.0 FORMAT "%5.1" ECU_ADDRESS 0x382B81 /end MEASUREMENT
/begin MEASUREMENT fcmfrz2_08_A "" UBYTE default 1 100 0.00 255.0 FORMAT "%5.1" ECU_ADDRESS 0x382BA3 /end MEASUREMENT
/begin MEASUREMENT fcmfrz2_09_A "" UBYTE default 1 100 0.00 255.0 FORMAT "%5.1" ECU_ADDRESS 0x382BC5 /end MEASUREMENT
/begin MEASUREMENT fcmfrz2_10_A "" UBYTE default 1 100 0.00 255.0 FORMAT "%5.1" ECU_ADDRESS 0x382BE7 /end MEASUREMENT
/begin MEASUREMENT fcmfrz2_11_A "" UBYTE default 1 100 0.00 255.0 FORMAT "%5.1" ECU_ADDRESS 0x382C09 /end MEASUREMENT
/begin MEASUREMENT fcmfrz2_12_A "" UBYTE default 1 100 0.00 255.0 FORMAT "%5.1" ECU_ADDRESS 0x382C2B /end MEASUREMENT
/begin MEASUREMENT fcmfrz2_13_A "" UBYTE default 1 100 0.00 255.0 FORMAT "%5.1" ECU_ADDRESS 0x382C4D /end MEASUREMENT
/begin MEASUREMENT fcmfrz2_14_A "" UBYTE default 1 100 0.00 255.0 FORMAT "%5.1" ECU_ADDRESS 0x382C6F /end MEASUREMENT
/begin MEASUREMENT fcmfrz2_15_A "" UBYTE default 1 100 0.00 255.0 FORMAT "%5.1" ECU_ADDRESS 0x382C91 /end MEASUREMENT
/begin MEASUREMENT fcmfrz2_16_A "" UBYTE default 1 100 0.00 255.0 FORMAT "%5.1" ECU_ADDRESS 0x382CB3 /end MEASUREMENT
/begin MEASUREMENT fcmfrz2_17_A "" UBYTE default 1 100 0.00 255.0 FORMAT "%5.1" ECU_ADDRESS 0x382CD5 /end MEASUREMENT
/begin MEASUREMENT fcmfrz2_18_A "" UBYTE default 1 100 0.00 255.0 FORMAT "%5.1" ECU_ADDRESS 0x382CF7 /end MEASUREMENT
/begin MEASUREMENT fcmfrz2_19_A "" UBYTE default 1 100 0.00 255.0 FORMAT "%5.1" ECU_ADDRESS 0x382D19 /end MEASUREMENT
/begin MEASUREMENT fcmfrz3_00_A "" UBYTE default 1 100 0.00 255.0 FORMAT "%5.1" ECU_ADDRESS 0x382A94 /end MEASUREMENT
/begin MEASUREMENT fcmfrz3_01_A "" UBYTE default 1 100 0.00 255.0 FORMAT "%5.1" ECU_ADDRESS 0x382AB6 /end MEASUREMENT
/begin MEASUREMENT fcmfrz3_02_A "" UBYTE default 1 100 0.00 255.0 FORMAT "%5.1" ECU_ADDRESS 0x382AD8 /end MEASUREMENT
/begin MEASUREMENT fcmfrz3_03_A "" UBYTE default 1 100 0.00 255.0 FORMAT "%5.1" ECU_ADDRESS 0x382AFA /end MEASUREMENT
/begin MEASUREMENT fcmfrz3_04_A "" UBYTE default 1 100 0.00 255.0 FORMAT "%5.1" ECU_ADDRESS 0x382B1C /end MEASUREMENT
/begin MEASUREMENT fcmfrz3_05_A "" UBYTE default 1 100 0.00 255.0 FORMAT "%5.1" ECU_ADDRESS 0x382B3E /end MEASUREMENT
/begin MEASUREMENT fcmfrz3_06_A "" UBYTE default 1 100 0.00 255.0 FORMAT "%5.1" ECU_ADDRESS 0x382B60 /end MEASUREMENT
/begin MEASUREMENT fcmfrz3_07_A "" UBYTE default 1 100 0.00 255.0 FORMAT "%5.1" ECU_ADDRESS 0x382B82 /end MEASUREMENT
/begin MEASUREMENT fcmfrz3_08_A "" UBYTE default 1 100 0.00 255.0 FORMAT "%5.1" ECU_ADDRESS 0x382BA4 /end MEASUREMENT
/begin MEASUREMENT fcmfrz3_09_A "" UBYTE default 1 100 0.00 255.0 FORMAT "%5.1" ECU_ADDRESS 0x382BC6 /end MEASUREMENT
/begin MEASUREMENT fcmfrz3_10_A "" UBYTE default 1 100 0.00 255.0 FORMAT "%5.1" ECU_ADDRESS 0x382BE8 /end MEASUREMENT
/begin MEASUREMENT fcmfrz3_11_A "" UBYTE default 1 100 0.00 255.0 FORMAT "%5.1" ECU_ADDRESS 0x382C0A /end MEASUREMENT
/begin MEASUREMENT fcmfrz3_12_A "" UBYTE default 1 100 0.00 255.0 FORMAT "%5.1" ECU_ADDRESS 0x382C2C /end MEASUREMENT
/begin MEASUREMENT fcmfrz3_13_A "" UBYTE default 1 100 0.00 255.0 FORMAT "%5.1" ECU_ADDRESS 0x382C4E /end MEASUREMENT
/begin MEASUREMENT fcmfrz3_14_A "" UBYTE default 1 100 0.00 255.0 FORMAT "%5.1" ECU_ADDRESS 0x382C70 /end MEASUREMENT
/begin MEASUREMENT fcmfrz3_15_A "" UBYTE default 1 100 0.00 255.0 FORMAT "%5.1" ECU_ADDRESS 0x382C92 /end MEASUREMENT
/begin MEASUREMENT fcmfrz3_16_A "" UBYTE default 1 100 0.00 255.0 FORMAT "%5.1" ECU_ADDRESS 0x382CB4 /end MEASUREMENT
/begin MEASUREMENT fcmfrz3_17_A "" UBYTE default 1 100 0.00 255.0 FORMAT "%5.1" ECU_ADDRESS 0x382CD6 /end MEASUREMENT
/begin MEASUREMENT fcmfrz3_18_A "" UBYTE default 1 100 0.00 255.0 FORMAT "%5.1" ECU_ADDRESS 0x382CF8 /end MEASUREMENT
/begin MEASUREMENT fcmfrz3_19_A "" UBYTE default 1 100 0.00 255.0 FORMAT "%5.1" ECU_ADDRESS 0x382D1A /end MEASUREMENT
/begin MEASUREMENT fcmfrz4_00_A "" UBYTE default 1 100 0.00 255.0 FORMAT "%5.1" ECU_ADDRESS 0x382A95 /end MEASUREMENT
/begin MEASUREMENT fcmfrz4_01_A "" UBYTE default 1 100 0.00 255.0 FORMAT "%5.1" ECU_ADDRESS 0x382AB7 /end MEASUREMENT
/begin MEASUREMENT fcmfrz4_02_A "" UBYTE default 1 100 0.00 255.0 FORMAT "%5.1" ECU_ADDRESS 0x382AD9 /end MEASUREMENT
/begin MEASUREMENT fcmfrz4_03_A "" UBYTE default 1 100 0.00 255.0 FORMAT "%5.1" ECU_ADDRESS 0x382AFB /end MEASUREMENT
/begin MEASUREMENT fcmfrz4_04_A "" UBYTE default 1 100 0.00 255.0 FORMAT "%5.1" ECU_ADDRESS 0x382B1D /end MEASUREMENT
/begin MEASUREMENT fcmfrz4_05_A "" UBYTE default 1 100 0.00 255.0 FORMAT "%5.1" ECU_ADDRESS 0x382B3F /end MEASUREMENT
/begin MEASUREMENT fcmfrz4_06_A "" UBYTE default 1 100 0.00 255.0 FORMAT "%5.1" ECU_ADDRESS 0x382B61 /end MEASUREMENT
/begin MEASUREMENT fcmfrz4_07_A "" UBYTE default 1 100 0.00 255.0 FORMAT "%5.1" ECU_ADDRESS 0x382B83 /end MEASUREMENT
/begin MEASUREMENT fcmfrz4_08_A "" UBYTE default 1 100 0.00 255.0 FORMAT "%5.1" ECU_ADDRESS 0x382BA5 /end MEASUREMENT
/begin MEASUREMENT fcmfrz4_09_A "" UBYTE default 1 100 0.00 255.0 FORMAT "%5.1" ECU_ADDRESS 0x382BC7 /end MEASUREMENT
/begin MEASUREMENT fcmfrz4_10_A "" UBYTE default 1 100 0.00 255.0 FORMAT "%5.1" ECU_ADDRESS 0x382BE9 /end MEASUREMENT
/begin MEASUREMENT fcmfrz4_11_A "" UBYTE default 1 100 0.00 255.0 FORMAT "%5.1" ECU_ADDRESS 0x382C0B /end MEASUREMENT
/begin MEASUREMENT fcmfrz4_12_A "" UBYTE default 1 100 0.00 255.0 FORMAT "%5.1" ECU_ADDRESS 0x382C2D /end MEASUREMENT
/begin MEASUREMENT fcmfrz4_13_A "" UBYTE default 1 100 0.00 255.0 FORMAT "%5.1" ECU_ADDRESS 0x382C4F /end MEASUREMENT
/begin MEASUREMENT fcmfrz4_14_A "" UBYTE default 1 100 0.00 255.0 FORMAT "%5.1" ECU_ADDRESS 0x382C71 /end MEASUREMENT
/begin MEASUREMENT fcmfrz4_15_A "" UBYTE default 1 100 0.00 255.0 FORMAT "%5.1" ECU_ADDRESS 0x382C93 /end MEASUREMENT
/begin MEASUREMENT fcmfrz4_16_A "" UBYTE default 1 100 0.00 255.0 FORMAT "%5.1" ECU_ADDRESS 0x382CB5 /end MEASUREMENT
/begin MEASUREMENT fcmfrz4_17_A "" UBYTE default 1 100 0.00 255.0 FORMAT "%5.1" ECU_ADDRESS 0x382CD7 /end MEASUREMENT
/begin MEASUREMENT fcmfrz4_18_A "" UBYTE default 1 100 0.00 255.0 FORMAT "%5.1" ECU_ADDRESS 0x382CF9 /end MEASUREMENT
/begin MEASUREMENT fcmfrz4_19_A "" UBYTE default 1 100 0.00 255.0 FORMAT "%5.1" ECU_ADDRESS 0x382D1B /end MEASUREMENT
/begin MEASUREMENT fcmfrz5_00_A "" UBYTE default 1 100 0.00 255.0 FORMAT "%5.1" ECU_ADDRESS 0x382A96 /end MEASUREMENT
/begin MEASUREMENT fcmfrz5_01_A "" UBYTE default 1 100 0.00 255.0 FORMAT "%5.1" ECU_ADDRESS 0x382AB8 /end MEASUREMENT
/begin MEASUREMENT fcmfrz5_02_A "" UBYTE default 1 100 0.00 255.0 FORMAT "%5.1" ECU_ADDRESS 0x382ADA /end MEASUREMENT
/begin MEASUREMENT fcmfrz5_03_A "" UBYTE default 1 100 0.00 255.0 FORMAT "%5.1" ECU_ADDRESS 0x382AFC /end MEASUREMENT
/begin MEASUREMENT fcmfrz5_04_A "" UBYTE default 1 100 0.00 255.0 FORMAT "%5.1" ECU_ADDRESS 0x382B1E /end MEASUREMENT
/begin MEASUREMENT fcmfrz5_05_A "" UBYTE default 1 100 0.00 255.0 FORMAT "%5.1" ECU_ADDRESS 0x382B40 /end MEASUREMENT
/begin MEASUREMENT fcmfrz5_06_A "" UBYTE default 1 100 0.00 255.0 FORMAT "%5.1" ECU_ADDRESS 0x382B62 /end MEASUREMENT
/begin MEASUREMENT fcmfrz5_07_A "" UBYTE default 1 100 0.00 255.0 FORMAT "%5.1" ECU_ADDRESS 0x382B84 /end MEASUREMENT
/begin MEASUREMENT fcmfrz5_08_A "" UBYTE default 1 100 0.00 255.0 FORMAT "%5.1" ECU_ADDRESS 0x382BA6 /end MEASUREMENT
/begin MEASUREMENT fcmfrz5_09_A "" UBYTE default 1 100 0.00 255.0 FORMAT "%5.1" ECU_ADDRESS 0x382BC8 /end MEASUREMENT
/begin MEASUREMENT fcmfrz5_10_A "" UBYTE default 1 100 0.00 255.0 FORMAT "%5.1" ECU_ADDRESS 0x382BEA /end MEASUREMENT
/begin MEASUREMENT fcmfrz5_11_A "" UBYTE default 1 100 0.00 255.0 FORMAT "%5.1" ECU_ADDRESS 0x382C0C /end MEASUREMENT
/begin MEASUREMENT fcmfrz5_12_A "" UBYTE default 1 100 0.00 255.0 FORMAT "%5.1" ECU_ADDRESS 0x382C2E /end MEASUREMENT
/begin MEASUREMENT fcmfrz5_13_A "" UBYTE default 1 100 0.00 255.0 FORMAT "%5.1" ECU_ADDRESS 0x382C50 /end MEASUREMENT
/begin MEASUREMENT fcmfrz5_14_A "" UBYTE default 1 100 0.00 255.0 FORMAT "%5.1" ECU_ADDRESS 0x382C72 /end MEASUREMENT
/begin MEASUREMENT fcmfrz5_15_A "" UBYTE default 1 100 0.00 255.0 FORMAT "%5.1" ECU_ADDRESS 0x382C94 /end MEASUREMENT
/begin MEASUREMENT fcmfrz5_16_A "" UBYTE default 1 100 0.00 255.0 FORMAT "%5.1" ECU_ADDRESS 0x382CB6 /end MEASUREMENT
/begin MEASUREMENT fcmfrz5_17_A "" UBYTE default 1 100 0.00 255.0 FORMAT "%5.1" ECU_ADDRESS 0x382CD8 /end MEASUREMENT
/begin MEASUREMENT fcmfrz5_18_A "" UBYTE default 1 100 0.00 255.0 FORMAT "%5.1" ECU_ADDRESS 0x382CFA /end MEASUREMENT
/begin MEASUREMENT fcmfrz5_19_A "" UBYTE default 1 100 0.00 255.0 FORMAT "%5.1" ECU_ADDRESS 0x382D1C /end MEASUREMENT
/begin MEASUREMENT fcmfrz6_00_A "" UBYTE default 1 100 0.00 255.0 FORMAT "%5.1" ECU_ADDRESS 0x382A97 /end MEASUREMENT
/begin MEASUREMENT fcmfrz6_01_A "" UBYTE default 1 100 0.00 255.0 FORMAT "%5.1" ECU_ADDRESS 0x382AB9 /end MEASUREMENT
/begin MEASUREMENT fcmfrz6_02_A "" UBYTE default 1 100 0.00 255.0 FORMAT "%5.1" ECU_ADDRESS 0x382ADB /end MEASUREMENT
/begin MEASUREMENT fcmfrz6_03_A "" UBYTE default 1 100 0.00 255.0 FORMAT "%5.1" ECU_ADDRESS 0x382AFD /end MEASUREMENT
/begin MEASUREMENT fcmfrz6_04_A "" UBYTE default 1 100 0.00 255.0 FORMAT "%5.1" ECU_ADDRESS 0x382B1F /end MEASUREMENT
/begin MEASUREMENT fcmfrz6_05_A "" UBYTE default 1 100 0.00 255.0 FORMAT "%5.1" ECU_ADDRESS 0x382B41 /end MEASUREMENT
/begin MEASUREMENT fcmfrz6_06_A "" UBYTE default 1 100 0.00 255.0 FORMAT "%5.1" ECU_ADDRESS 0x382B63 /end MEASUREMENT
/begin MEASUREMENT fcmfrz6_07_A "" UBYTE default 1 100 0.00 255.0 FORMAT "%5.1" ECU_ADDRESS 0x382B85 /end MEASUREMENT
/begin MEASUREMENT fcmfrz6_08_A "" UBYTE default 1 100 0.00 255.0 FORMAT "%5.1" ECU_ADDRESS 0x382BA7 /end MEASUREMENT
/begin MEASUREMENT fcmfrz6_09_A "" UBYTE default 1 100 0.00 255.0 FORMAT "%5.1" ECU_ADDRESS 0x382BC9 /end MEASUREMENT
/begin MEASUREMENT fcmfrz6_10_A "" UBYTE default 1 100 0.00 255.0 FORMAT "%5.1" ECU_ADDRESS 0x382BEB /end MEASUREMENT
/begin MEASUREMENT fcmfrz6_11_A "" UBYTE default 1 100 0.00 255.0 FORMAT "%5.1" ECU_ADDRESS 0x382C0D /end MEASUREMENT
/begin MEASUREMENT fcmfrz6_12_A "" UBYTE default 1 100 0.00 255.0 FORMAT "%5.1" ECU_ADDRESS 0x382C2F /end MEASUREMENT
/begin MEASUREMENT fcmfrz6_13_A "" UBYTE default 1 100 0.00 255.0 FORMAT "%5.1" ECU_ADDRESS 0x382C51 /end MEASUREMENT
/begin MEASUREMENT fcmfrz6_14_A "" UBYTE default 1 100 0.00 255.0 FORMAT "%5.1" ECU_ADDRESS 0x382C73 /end MEASUREMENT
/begin MEASUREMENT fcmfrz6_15_A "" UBYTE default 1 100 0.00 255.0 FORMAT "%5.1" ECU_ADDRESS 0x382C95 /end MEASUREMENT
/begin MEASUREMENT fcmfrz6_16_A "" UBYTE default 1 100 0.00 255.0 FORMAT "%5.1" ECU_ADDRESS 0x382CB7 /end MEASUREMENT
/begin MEASUREMENT fcmfrz6_17_A "" UBYTE default 1 100 0.00 255.0 FORMAT "%5.1" ECU_ADDRESS 0x382CD9 /end MEASUREMENT
/begin MEASUREMENT fcmfrz6_18_A "" UBYTE default 1 100 0.00 255.0 FORMAT "%5.1" ECU_ADDRESS 0x382CFB /end MEASUREMENT
/begin MEASUREMENT fcmfrz6_19_A "" UBYTE default 1 100 0.00 255.0 FORMAT "%5.1" ECU_ADDRESS 0x382D1D /end MEASUREMENT
/begin MEASUREMENT fcmfrz7_00_A "" UBYTE default 1 100 0.00 255.0 FORMAT "%5.1" ECU_ADDRESS 0x382A98 /end MEASUREMENT
/begin MEASUREMENT fcmfrz7_01_A "" UBYTE default 1 100 0.00 255.0 FORMAT "%5.1" ECU_ADDRESS 0x382ABA /end MEASUREMENT
/begin MEASUREMENT fcmfrz7_02_A "" UBYTE default 1 100 0.00 255.0 FORMAT "%5.1" ECU_ADDRESS 0x382ADC /end MEASUREMENT
/begin MEASUREMENT fcmfrz7_03_A "" UBYTE default 1 100 0.00 255.0 FORMAT "%5.1" ECU_ADDRESS 0x382AFE /end MEASUREMENT
/begin MEASUREMENT fcmfrz7_04_A "" UBYTE default 1 100 0.00 255.0 FORMAT "%5.1" ECU_ADDRESS 0x382B20 /end MEASUREMENT
/begin MEASUREMENT fcmfrz7_05_A "" UBYTE default 1 100 0.00 255.0 FORMAT "%5.1" ECU_ADDRESS 0x382B42 /end MEASUREMENT
/begin MEASUREMENT fcmfrz7_06_A "" UBYTE default 1 100 0.00 255.0 FORMAT "%5.1" ECU_ADDRESS 0x382B64 /end MEASUREMENT
/begin MEASUREMENT fcmfrz7_07_A "" UBYTE default 1 100 0.00 255.0 FORMAT "%5.1" ECU_ADDRESS 0x382B86 /end MEASUREMENT
/begin MEASUREMENT fcmfrz7_08_A "" UBYTE default 1 100 0.00 255.0 FORMAT "%5.1" ECU_ADDRESS 0x382BA8 /end MEASUREMENT
/begin MEASUREMENT fcmfrz7_09_A "" UBYTE default 1 100 0.00 255.0 FORMAT "%5.1" ECU_ADDRESS 0x382BCA /end MEASUREMENT
/begin MEASUREMENT fcmfrz7_10_A "" UBYTE default 1 100 0.00 255.0 FORMAT "%5.1" ECU_ADDRESS 0x382BEC /end MEASUREMENT
/begin MEASUREMENT fcmfrz7_11_A "" UBYTE default 1 100 0.00 255.0 FORMAT "%5.1" ECU_ADDRESS 0x382C0E /end MEASUREMENT
/begin MEASUREMENT fcmfrz7_12_A "" UBYTE default 1 100 0.00 255.0 FORMAT "%5.1" ECU_ADDRESS 0x382C30 /end MEASUREMENT
/begin MEASUREMENT fcmfrz7_13_A "" UBYTE default 1 100 0.00 255.0 FORMAT "%5.1" ECU_ADDRESS 0x382C52 /end MEASUREMENT
/begin MEASUREMENT fcmfrz7_14_A "" UBYTE default 1 100 0.00 255.0 FORMAT "%5.1" ECU_ADDRESS 0x382C74 /end MEASUREMENT
/begin MEASUREMENT fcmfrz7_15_A "" UBYTE default 1 100 0.00 255.0 FORMAT "%5.1" ECU_ADDRESS 0x382C96 /end MEASUREMENT
/begin MEASUREMENT fcmfrz7_16_A "" UBYTE default 1 100 0.00 255.0 FORMAT "%5.1" ECU_ADDRESS 0x382CB8 /end MEASUREMENT
/begin MEASUREMENT fcmfrz7_17_A "" UBYTE default 1 100 0.00 255.0 FORMAT "%5.1" ECU_ADDRESS 0x382CDA /end MEASUREMENT
/begin MEASUREMENT fcmfrz7_18_A "" UBYTE default 1 100 0.00 255.0 FORMAT "%5.1" ECU_ADDRESS 0x382CFC /end MEASUREMENT
/begin MEASUREMENT fcmfrz7_19_A "" UBYTE default 1 100 0.00 255.0 FORMAT "%5.1" ECU_ADDRESS 0x382D1E /end MEASUREMENT
/begin MEASUREMENT fcmfrz8_00_A "" UBYTE default 1 100 0.00 255.0 FORMAT "%5.1" ECU_ADDRESS 0x382A99 /end MEASUREMENT
/begin MEASUREMENT fcmfrz8_01_A "" UBYTE default 1 100 0.00 255.0 FORMAT "%5.1" ECU_ADDRESS 0x382ABB /end MEASUREMENT
/begin MEASUREMENT fcmfrz8_02_A "" UBYTE default 1 100 0.00 255.0 FORMAT "%5.1" ECU_ADDRESS 0x382ADD /end MEASUREMENT
/begin MEASUREMENT fcmfrz8_03_A "" UBYTE default 1 100 0.00 255.0 FORMAT "%5.1" ECU_ADDRESS 0x382AFF /end MEASUREMENT
/begin MEASUREMENT fcmfrz8_04_A "" UBYTE default 1 100 0.00 255.0 FORMAT "%5.1" ECU_ADDRESS 0x382B21 /end MEASUREMENT
/begin MEASUREMENT fcmfrz8_05_A "" UBYTE default 1 100 0.00 255.0 FORMAT "%5.1" ECU_ADDRESS 0x382B43 /end MEASUREMENT
/begin MEASUREMENT fcmfrz8_06_A "" UBYTE default 1 100 0.00 255.0 FORMAT "%5.1" ECU_ADDRESS 0x382B65 /end MEASUREMENT
/begin MEASUREMENT fcmfrz8_07_A "" UBYTE default 1 100 0.00 255.0 FORMAT "%5.1" ECU_ADDRESS 0x382B87 /end MEASUREMENT
/begin MEASUREMENT fcmfrz8_08_A "" UBYTE default 1 100 0.00 255.0 FORMAT "%5.1" ECU_ADDRESS 0x382BA9 /end MEASUREMENT
/begin MEASUREMENT fcmfrz8_09_A "" UBYTE default 1 100 0.00 255.0 FORMAT "%5.1" ECU_ADDRESS 0x382BCB /end MEASUREMENT
/begin MEASUREMENT fcmfrz8_10_A "" UBYTE default 1 100 0.00 255.0 FORMAT "%5.1" ECU_ADDRESS 0x382BED /end MEASUREMENT
/begin MEASUREMENT fcmfrz8_11_A "" UBYTE default 1 100 0.00 255.0 FORMAT "%5.1" ECU_ADDRESS 0x382C0F /end MEASUREMENT
/begin MEASUREMENT fcmfrz8_12_A "" UBYTE default 1 100 0.00 255.0 FORMAT "%5.1" ECU_ADDRESS 0x382C31 /end MEASUREMENT
/begin MEASUREMENT fcmfrz8_13_A "" UBYTE default 1 100 0.00 255.0 FORMAT "%5.1" ECU_ADDRESS 0x382C53 /end MEASUREMENT
/begin MEASUREMENT fcmfrz8_14_A "" UBYTE default 1 100 0.00 255.0 FORMAT "%5.1" ECU_ADDRESS 0x382C75 /end MEASUREMENT
/begin MEASUREMENT fcmfrz8_15_A "" UBYTE default 1 100 0.00 255.0 FORMAT "%5.1" ECU_ADDRESS 0x382C97 /end MEASUREMENT
/begin MEASUREMENT fcmfrz8_16_A "" UBYTE default 1 100 0.00 255.0 FORMAT "%5.1" ECU_ADDRESS 0x382CB9 /end MEASUREMENT
/begin MEASUREMENT fcmfrz8_17_A "" UBYTE default 1 100 0.00 255.0 FORMAT "%5.1" ECU_ADDRESS 0x382CDB /end MEASUREMENT
/begin MEASUREMENT fcmfrz8_18_A "" UBYTE default 1 100 0.00 255.0 FORMAT "%5.1" ECU_ADDRESS 0x382CFD /end MEASUREMENT
/begin MEASUREMENT fcmfrz8_19_A "" UBYTE default 1 100 0.00 255.0 FORMAT "%5.1" ECU_ADDRESS 0x382D1F /end MEASUREMENT
/begin MEASUREMENT fcmfrz9_00_A "" UBYTE default 1 100 0.00 255.0 FORMAT "%5.1" ECU_ADDRESS 0x382A9A /end MEASUREMENT
/begin MEASUREMENT fcmfrz9_01_A "" UBYTE default 1 100 0.00 255.0 FORMAT "%5.1" ECU_ADDRESS 0x382ABC /end MEASUREMENT
/begin MEASUREMENT fcmfrz9_02_A "" UBYTE default 1 100 0.00 255.0 FORMAT "%5.1" ECU_ADDRESS 0x382ADE /end MEASUREMENT
/begin MEASUREMENT fcmfrz9_03_A "" UBYTE default 1 100 0.00 255.0 FORMAT "%5.1" ECU_ADDRESS 0x382B00 /end MEASUREMENT
/begin MEASUREMENT fcmfrz9_04_A "" UBYTE default 1 100 0.00 255.0 FORMAT "%5.1" ECU_ADDRESS 0x382B22 /end MEASUREMENT
/begin MEASUREMENT fcmfrz9_05_A "" UBYTE default 1 100 0.00 255.0 FORMAT "%5.1" ECU_ADDRESS 0x382B44 /end MEASUREMENT
/begin MEASUREMENT fcmfrz9_06_A "" UBYTE default 1 100 0.00 255.0 FORMAT "%5.1" ECU_ADDRESS 0x382B66 /end MEASUREMENT
/begin MEASUREMENT fcmfrz9_07_A "" UBYTE default 1 100 0.00 255.0 FORMAT "%5.1" ECU_ADDRESS 0x382B88 /end MEASUREMENT
/begin MEASUREMENT fcmfrz9_08_A "" UBYTE default 1 100 0.00 255.0 FORMAT "%5.1" ECU_ADDRESS 0x382BAA /end MEASUREMENT
/begin MEASUREMENT fcmfrz9_09_A "" UBYTE default 1 100 0.00 255.0 FORMAT "%5.1" ECU_ADDRESS 0x382BCC /end MEASUREMENT
/begin MEASUREMENT fcmfrz9_10_A "" UBYTE default 1 100 0.00 255.0 FORMAT "%5.1" ECU_ADDRESS 0x382BEE /end MEASUREMENT
/begin MEASUREMENT fcmfrz9_11_A "" UBYTE default 1 100 0.00 255.0 FORMAT "%5.1" ECU_ADDRESS 0x382C10 /end MEASUREMENT
/begin MEASUREMENT fcmfrz9_12_A "" UBYTE default 1 100 0.00 255.0 FORMAT "%5.1" ECU_ADDRESS 0x382C32 /end MEASUREMENT
/begin MEASUREMENT fcmfrz9_13_A "" UBYTE default 1 100 0.00 255.0 FORMAT "%5.1" ECU_ADDRESS 0x382C54 /end MEASUREMENT
/begin MEASUREMENT fcmfrz9_14_A "" UBYTE default 1 100 0.00 255.0 FORMAT "%5.1" ECU_ADDRESS 0x382C76 /end MEASUREMENT
/begin MEASUREMENT fcmfrz9_15_A "" UBYTE default 1 100 0.00 255.0 FORMAT "%5.1" ECU_ADDRESS 0x382C98 /end MEASUREMENT
/begin MEASUREMENT fcmfrz9_16_A "" UBYTE default 1 100 0.00 255.0 FORMAT "%5.1" ECU_ADDRESS 0x382CBA /end MEASUREMENT
/begin MEASUREMENT fcmfrz9_17_A "" UBYTE default 1 100 0.00 255.0 FORMAT "%5.1" ECU_ADDRESS 0x382CDC /end MEASUREMENT
/begin MEASUREMENT fcmfrz9_18_A "" UBYTE default 1 100 0.00 255.0 FORMAT "%5.1" ECU_ADDRESS 0x382CFE /end MEASUREMENT
/begin MEASUREMENT fcmfrz9_19_A "" UBYTE default 1 100 0.00 255.0 FORMAT "%5.1" ECU_ADDRESS 0x382D20 /end MEASUREMENT
/begin MEASUREMENT fcmhlc_00_A "" UBYTE default 1 100 0.00 255.0 FORMAT "%5.1" ECU_ADDRESS 0x382A8F /end MEASUREMENT
/begin MEASUREMENT fcmhlc_01_A "" UBYTE default 1 100 0.00 255.0 FORMAT "%5.1" ECU_ADDRESS 0x382AB1 /end MEASUREMENT
/begin MEASUREMENT fcmhlc_02_A "" UBYTE default 1 100 0.00 255.0 FORMAT "%5.1" ECU_ADDRESS 0x382AD3 /end MEASUREMENT
/begin MEASUREMENT fcmhlc_03_A "" UBYTE default 1 100 0.00 255.0 FORMAT "%5.1" ECU_ADDRESS 0x382AF5 /end MEASUREMENT
/begin MEASUREMENT fcmhlc_04_A "" UBYTE default 1 100 0.00 255.0 FORMAT "%5.1" ECU_ADDRESS 0x382B17 /end MEASUREMENT
/begin MEASUREMENT fcmhlc_05_A "" UBYTE default 1 100 0.00 255.0 FORMAT "%5.1" ECU_ADDRESS 0x382B39 /end MEASUREMENT
/begin MEASUREMENT fcmhlc_06_A "" UBYTE default 1 100 0.00 255.0 FORMAT "%5.1" ECU_ADDRESS 0x382B5B /end MEASUREMENT
/begin MEASUREMENT fcmhlc_07_A "" UBYTE default 1 100 0.00 255.0 FORMAT "%5.1" ECU_ADDRESS 0x382B7D /end MEASUREMENT
/begin MEASUREMENT fcmhlc_08_A "" UBYTE default 1 100 0.00 255.0 FORMAT "%5.1" ECU_ADDRESS 0x382B9F /end MEASUREMENT
/begin MEASUREMENT fcmhlc_09_A "" UBYTE default 1 100 0.00 255.0 FORMAT "%5.1" ECU_ADDRESS 0x382BC1 /end MEASUREMENT
/begin MEASUREMENT fcmhlc_10_A "" UBYTE default 1 100 0.00 255.0 FORMAT "%5.1" ECU_ADDRESS 0x382BE3 /end MEASUREMENT
/begin MEASUREMENT fcmhlc_11_A "" UBYTE default 1 100 0.00 255.0 FORMAT "%5.1" ECU_ADDRESS 0x382C05 /end MEASUREMENT
/begin MEASUREMENT fcmhlc_12_A "" UBYTE default 1 100 0.00 255.0 FORMAT "%5.1" ECU_ADDRESS 0x382C27 /end MEASUREMENT
/begin MEASUREMENT fcmhlc_13_A "" UBYTE default 1 100 0.00 255.0 FORMAT "%5.1" ECU_ADDRESS 0x382C49 /end MEASUREMENT
/begin MEASUREMENT fcmhlc_14_A "" UBYTE default 1 100 0.00 255.0 FORMAT "%5.1" ECU_ADDRESS 0x382C6B /end MEASUREMENT
/begin MEASUREMENT fcmhlc_15_A "" UBYTE default 1 100 0.00 255.0 FORMAT "%5.1" ECU_ADDRESS 0x382C8D /end MEASUREMENT
/begin MEASUREMENT fcmhlc_16_A "" UBYTE default 1 100 0.00 255.0 FORMAT "%5.1" ECU_ADDRESS 0x382CAF /end MEASUREMENT
/begin MEASUREMENT fcmhlc_17_A "" UBYTE default 1 100 0.00 255.0 FORMAT "%5.1" ECU_ADDRESS 0x382CD1 /end MEASUREMENT
/begin MEASUREMENT fcmhlc_18_A "" UBYTE default 1 100 0.00 255.0 FORMAT "%5.1" ECU_ADDRESS 0x382CF3 /end MEASUREMENT
/begin MEASUREMENT fcmhlc_19_A "" UBYTE default 1 100 0.00 255.0 FORMAT "%5.1" ECU_ADDRESS 0x382D15 /end MEASUREMENT
/begin MEASUREMENT fcmhz_00_A "" UBYTE default 1 100 0.00 255.0 FORMAT "%5.1" ECU_ADDRESS 0x382AA8 /end MEASUREMENT
/begin MEASUREMENT fcmhz_01_A "" UBYTE default 1 100 0.00 255.0 FORMAT "%5.1" ECU_ADDRESS 0x382ACA /end MEASUREMENT
/begin MEASUREMENT fcmhz_02_A "" UBYTE default 1 100 0.00 255.0 FORMAT "%5.1" ECU_ADDRESS 0x382AEC /end MEASUREMENT
/begin MEASUREMENT fcmhz_03_A "" UBYTE default 1 100 0.00 255.0 FORMAT "%5.1" ECU_ADDRESS 0x382B0E /end MEASUREMENT
/begin MEASUREMENT fcmhz_04_A "" UBYTE default 1 100 0.00 255.0 FORMAT "%5.1" ECU_ADDRESS 0x382B30 /end MEASUREMENT
/begin MEASUREMENT fcmhz_05_A "" UBYTE default 1 100 0.00 255.0 FORMAT "%5.1" ECU_ADDRESS 0x382B52 /end MEASUREMENT
/begin MEASUREMENT fcmhz_06_A "" UBYTE default 1 100 0.00 255.0 FORMAT "%5.1" ECU_ADDRESS 0x382B74 /end MEASUREMENT
/begin MEASUREMENT fcmhz_07_A "" UBYTE default 1 100 0.00 255.0 FORMAT "%5.1" ECU_ADDRESS 0x382B96 /end MEASUREMENT
/begin MEASUREMENT fcmhz_08_A "" UBYTE default 1 100 0.00 255.0 FORMAT "%5.1" ECU_ADDRESS 0x382BB8 /end MEASUREMENT
/begin MEASUREMENT fcmhz_09_A "" UBYTE default 1 100 0.00 255.0 FORMAT "%5.1" ECU_ADDRESS 0x382BDA /end MEASUREMENT
/begin MEASUREMENT fcmhz_10_A "" UBYTE default 1 100 0.00 255.0 FORMAT "%5.1" ECU_ADDRESS 0x382BFC /end MEASUREMENT
/begin MEASUREMENT fcmhz_11_A "" UBYTE default 1 100 0.00 255.0 FORMAT "%5.1" ECU_ADDRESS 0x382C1E /end MEASUREMENT
/begin MEASUREMENT fcmhz_12_A "" UBYTE default 1 100 0.00 255.0 FORMAT "%5.1" ECU_ADDRESS 0x382C40 /end MEASUREMENT
/begin MEASUREMENT fcmhz_13_A "" UBYTE default 1 100 0.00 255.0 FORMAT "%5.1" ECU_ADDRESS 0x382C62 /end MEASUREMENT
/begin MEASUREMENT fcmhz_14_A "" UBYTE default 1 100 0.00 255.0 FORMAT "%5.1" ECU_ADDRESS 0x382C84 /end MEASUREMENT
/begin MEASUREMENT fcmhz_15_A "" UBYTE default 1 100 0.00 255.0 FORMAT "%5.1" ECU_ADDRESS 0x382CA6 /end MEASUREMENT
/begin MEASUREMENT fcmhz_16_A "" UBYTE default 1 100 0.00 255.0 FORMAT "%5.1" ECU_ADDRESS 0x382CC8 /end MEASUREMENT
/begin MEASUREMENT fcmhz_17_A "" UBYTE default 1 100 0.00 255.0 FORMAT "%5.1" ECU_ADDRESS 0x382CEA /end MEASUREMENT
/begin MEASUREMENT fcmhz_18_A "" UBYTE default 1 100 0.00 255.0 FORMAT "%5.1" ECU_ADDRESS 0x382D0C /end MEASUREMENT
/begin MEASUREMENT fcmhz_19_A "" UBYTE default 1 100 0.00 255.0 FORMAT "%5.1" ECU_ADDRESS 0x382D2E /end MEASUREMENT
/begin MEASUREMENT FCMTab "" UWORD dez 1 100 0.00 65535.00 FORMAT "%8.2" ECU_ADDRESS 0x382A88 /end MEASUREMENT
/begin MEASUREMENT fcmtsf_00_A "" UBYTE default 1 100 0.00 255.0 FORMAT "%5.1" ECU_ADDRESS 0x382A89 /end MEASUREMENT
/begin MEASUREMENT fcmtsf_01_A "" UBYTE default 1 100 0.00 255.0 FORMAT "%5.1" ECU_ADDRESS 0x382AAB /end MEASUREMENT
/begin MEASUREMENT fcmtsf_02_A "" UBYTE default 1 100 0.00 255.0 FORMAT "%5.1" ECU_ADDRESS 0x382ACD /end MEASUREMENT
/begin MEASUREMENT fcmtsf_03_A "" UBYTE default 1 100 0.00 255.0 FORMAT "%5.1" ECU_ADDRESS 0x382AEF /end MEASUREMENT
/begin MEASUREMENT fcmtsf_04_A "" UBYTE default 1 100 0.00 255.0 FORMAT "%5.1" ECU_ADDRESS 0x382B11 /end MEASUREMENT
/begin MEASUREMENT fcmtsf_05_A "" UBYTE default 1 100 0.00 255.0 FORMAT "%5.1" ECU_ADDRESS 0x382B33 /end MEASUREMENT
/begin MEASUREMENT fcmtsf_06_A "" UBYTE default 1 100 0.00 255.0 FORMAT "%5.1" ECU_ADDRESS 0x382B55 /end MEASUREMENT
/begin MEASUREMENT fcmtsf_07_A "" UBYTE default 1 100 0.00 255.0 FORMAT "%5.1" ECU_ADDRESS 0x382B77 /end MEASUREMENT
/begin MEASUREMENT fcmtsf_08_A "" UBYTE default 1 100 0.00 255.0 FORMAT "%5.1" ECU_ADDRESS 0x382B99 /end MEASUREMENT
/begin MEASUREMENT fcmtsf_09_A "" UBYTE default 1 100 0.00 255.0 FORMAT "%5.1" ECU_ADDRESS 0x382BBB /end MEASUREMENT
/begin MEASUREMENT fcmtsf_10_A "" UBYTE default 1 100 0.00 255.0 FORMAT "%5.1" ECU_ADDRESS 0x382BDD /end MEASUREMENT
/begin MEASUREMENT fcmtsf_11_A "" UBYTE default 1 100 0.00 255.0 FORMAT "%5.1" ECU_ADDRESS 0x382BFF /end MEASUREMENT
/begin MEASUREMENT fcmtsf_12_A "" UBYTE default 1 100 0.00 255.0 FORMAT "%5.1" ECU_ADDRESS 0x382C21 /end MEASUREMENT
/begin MEASUREMENT fcmtsf_13_A "" UBYTE default 1 100 0.00 255.0 FORMAT "%5.1" ECU_ADDRESS 0x382C43 /end MEASUREMENT
/begin MEASUREMENT fcmtsf_14_A "" UBYTE default 1 100 0.00 255.0 FORMAT "%5.1" ECU_ADDRESS 0x382C65 /end MEASUREMENT
/begin MEASUREMENT fcmtsf_15_A "" UBYTE default 1 100 0.00 255.0 FORMAT "%5.1" ECU_ADDRESS 0x382C87 /end MEASUREMENT
/begin MEASUREMENT fcmtsf_16_A "" UBYTE default 1 100 0.00 255.0 FORMAT "%5.1" ECU_ADDRESS 0x382CA9 /end MEASUREMENT
/begin MEASUREMENT fcmtsf_17_A "" UBYTE default 1 100 0.00 255.0 FORMAT "%5.1" ECU_ADDRESS 0x382CCB /end MEASUREMENT
/begin MEASUREMENT fcmtsf_18_A "" UBYTE default 1 100 0.00 255.0 FORMAT "%5.1" ECU_ADDRESS 0x382CED /end MEASUREMENT
/begin MEASUREMENT fcmtsf_19_A "" UBYTE default 1 100 0.00 255.0 FORMAT "%5.1" ECU_ADDRESS 0x382D0F /end MEASUREMENT
/begin MEASUREMENT fcmtyp_00_A "" UBYTE default 1 100 0.00 255.0 FORMAT "%5.1" ECU_ADDRESS 0x382A8B /end MEASUREMENT
/begin MEASUREMENT fcmtyp_01_A "" UBYTE default 1 100 0.00 255.0 FORMAT "%5.1" ECU_ADDRESS 0x382AAD /end MEASUREMENT
/begin MEASUREMENT fcmtyp_02_A "" UBYTE default 1 100 0.00 255.0 FORMAT "%5.1" ECU_ADDRESS 0x382ACF /end MEASUREMENT
/begin MEASUREMENT fcmtyp_03_A "" UBYTE default 1 100 0.00 255.0 FORMAT "%5.1" ECU_ADDRESS 0x382AF1 /end MEASUREMENT
/begin MEASUREMENT fcmtyp_04_A "" UBYTE default 1 100 0.00 255.0 FORMAT "%5.1" ECU_ADDRESS 0x382B13 /end MEASUREMENT
/begin MEASUREMENT fcmtyp_05_A "" UBYTE default 1 100 0.00 255.0 FORMAT "%5.1" ECU_ADDRESS 0x382B35 /end MEASUREMENT
/begin MEASUREMENT fcmtyp_06_A "" UBYTE default 1 100 0.00 255.0 FORMAT "%5.1" ECU_ADDRESS 0x382B57 /end MEASUREMENT
/begin MEASUREMENT fcmtyp_07_A "" UBYTE default 1 100 0.00 255.0 FORMAT "%5.1" ECU_ADDRESS 0x382B79 /end MEASUREMENT
/begin MEASUREMENT fcmtyp_08_A "" UBYTE default 1 100 0.00 255.0 FORMAT "%5.1" ECU_ADDRESS 0x382B9B /end MEASUREMENT
/begin MEASUREMENT fcmtyp_09_A "" UBYTE default 1 100 0.00 255.0 FORMAT "%5.1" ECU_ADDRESS 0x382BBD /end MEASUREMENT
/begin MEASUREMENT fcmtyp_10_A "" UBYTE default 1 100 0.00 255.0 FORMAT "%5.1" ECU_ADDRESS 0x382BDF /end MEASUREMENT
/begin MEASUREMENT fcmtyp_11_A "" UBYTE default 1 100 0.00 255.0 FORMAT "%5.1" ECU_ADDRESS 0x382C01 /end MEASUREMENT
/begin MEASUREMENT fcmtyp_12_A "" UBYTE default 1 100 0.00 255.0 FORMAT "%5.1" ECU_ADDRESS 0x382C23 /end MEASUREMENT
/begin MEASUREMENT fcmtyp_13_A "" UBYTE default 1 100 0.00 255.0 FORMAT "%5.1" ECU_ADDRESS 0x382C45 /end MEASUREMENT
/begin MEASUREMENT fcmtyp_14_A "" UBYTE default 1 100 0.00 255.0 FORMAT "%5.1" ECU_ADDRESS 0x382C67 /end MEASUREMENT
/begin MEASUREMENT fcmtyp_15_A "" UBYTE default 1 100 0.00 255.0 FORMAT "%5.1" ECU_ADDRESS 0x382C89 /end MEASUREMENT
/begin MEASUREMENT fcmtyp_16_A "" UBYTE default 1 100 0.00 255.0 FORMAT "%5.1" ECU_ADDRESS 0x382CAB /end MEASUREMENT
/begin MEASUREMENT fcmtyp_17_A "" UBYTE default 1 100 0.00 255.0 FORMAT "%5.1" ECU_ADDRESS 0x382CCD /end MEASUREMENT
/begin MEASUREMENT fcmtyp_18_A "" UBYTE default 1 100 0.00 255.0 FORMAT "%5.1" ECU_ADDRESS 0x382CEF /end MEASUREMENT
/begin MEASUREMENT fcmtyp_19_A "" UBYTE default 1 100 0.00 255.0 FORMAT "%5.1" ECU_ADDRESS 0x382D11 /end MEASUREMENT
/begin MEASUREMENT fkdyn_w "" UWORD fak_uw_b16 1 100 0.00 15.99976 FORMAT "%8.5" ECU_ADDRESS 0xF1A32 /end MEASUREMENT
/begin MEASUREMENT flgddg "" UBYTE dez 1 100 0.00 255.0 FORMAT "%5.1" ECU_ADDRESS 0xF06EB /end MEASUREMENT
/begin MEASUREMENT flglrs "" UBYTE dez 1 100 0.00 255.0 FORMAT "%5.1" ECU_ADDRESS 0xF4088 /end MEASUREMENT
/begin MEASUREMENT flglrs2 "" UBYTE dez 1 100 0.00 255.0 FORMAT "%5.1" ECU_ADDRESS 0xF4089 /end MEASUREMENT
/begin MEASUREMENT fr2_u "" UBYTE fak_ub_b2 1 100 0.00 1.992 FORMAT "%5.3" ECU_ADDRESS 0xF06D5 /end MEASUREMENT
/begin MEASUREMENT fra2_u "" UBYTE fak_ub_b2 1 100 0.00 1.992 FORMAT "%5.3" ECU_ADDRESS 0xF06D6 /end MEASUREMENT
/begin MEASUREMENT fram_w "" UWORD fak_uw_b4 1 100 0.00 3.999939 FORMAT "%8.6" ECU_ADDRESS 0xF460A /end MEASUREMENT
/begin MEASUREMENT fra_u "" UBYTE fak_ub_b2 1 100 0.00 1.992 FORMAT "%5.3" ECU_ADDRESS 0xF06D7 /end MEASUREMENT
/begin MEASUREMENT frmm_w "" UWORD fak_uw_b4 1 100 0.00 3.999939 FORMAT "%8.6" ECU_ADDRESS 0xF460C /end MEASUREMENT
/begin MEASUREMENT fr_u "" UBYTE fak_ub_b2 1 100 0.00 1.992 FORMAT "%5.3" ECU_ADDRESS 0xF06D8 /end MEASUREMENT
/begin MEASUREMENT fst1tog_w "" UWORD t_500msxs_q0p5no100 1 100 100.0000 32867.50 FORMAT "%8.2" ECU_ADDRESS 0xF43AE /end MEASUREMENT
/begin MEASUREMENT fst2tog_w "" UWORD t_500msxs_q0p5no100 1 100 100.0000 32867.50 FORMAT "%8.2" ECU_ADDRESS 0xF43B0 /end MEASUREMENT
/begin MEASUREMENT fst3tog_w "" UWORD t_500msxs_q0p5no100 1 100 100.0000 32867.50 FORMAT "%8.2" ECU_ADDRESS 0xF43B2 /end MEASUREMENT
/begin MEASUREMENT fst4tog_w "" UWORD t_500msxs_q0p5no100 1 100 100.0000 32867.50 FORMAT "%8.2" ECU_ADDRESS 0xF43B4 /end MEASUREMENT
/begin MEASUREMENT fsttog_w "" UWORD t_q0p5o100ms 1 100 100.0000 32867.50 FORMAT "%8.2" ECU_ADDRESS 0xF4388 /end MEASUREMENT
/begin MEASUREMENT gangauti_c "" UBYTE DEZ 1 100 0.00 255.0 FORMAT "%5.1" ECU_ADDRESS 0xF067F /end MEASUREMENT
/begin MEASUREMENT gwhpos_c "" UBYTE DEZ 1 100 0.00 255.0 FORMAT "%5.1" ECU_ADDRESS 0xF0680 /end MEASUREMENT
/begin MEASUREMENT kfoelkbi_nmot "" UBYTE nmot_ub_q40 1 100 0.00 10200. FORMAT "%5.0" ECU_ADDRESS 0xF0681 /end MEASUREMENT
/begin MEASUREMENT klah_c "" UBYTE DEZ 1 100 0.00 255.0 FORMAT "%5.1" ECU_ADDRESS 0xF0682 /end MEASUREMENT
/begin MEASUREMENT km01tr "" UWORD s_q1_km 1 100 0.00 65535.00 FORMAT "%8.2" ECU_ADDRESS 0xF43B6 /end MEASUREMENT
/begin MEASUREMENT kmstand_l "" ULONG dez 1 100 0.00 4294967295.00 FORMAT "%13.2" ECU_ADDRESS 0xF43AA /end MEASUREMENT
/begin MEASUREMENT kmstand_w "" UWORD s_q6_km 1 100 0.00 393210.0 FORMAT "%8.1" ECU_ADDRESS 0xF43B8 /end MEASUREMENT
/begin MEASUREMENT kvasumz_w "" UWORD vol_uw_q0p5mm3 1 100 0.00 32767.50 FORMAT "%8.2" ECU_ADDRESS 0xF438A /end MEASUREMENT
/begin MEASUREMENT kvasum_w "" UWORD vol_uw_q1mm3 1 100 0.00 65535.00 FORMAT "%8.2" ECU_ADDRESS 0xF438C /end MEASUREMENT
/begin MEASUREMENT lamsam2_w "" SWORD fak_q0p000244 1 100 -8.000000 7.999756 FORMAT "%8.6" ECU_ADDRESS 0xF1A34 /end MEASUREMENT
/begin MEASUREMENT lamsam_w "" SWORD fak_q0p000244 1 100 -8.000000 7.999756 FORMAT "%8.6" ECU_ADDRESS 0xF1A36 /end MEASUREMENT
/begin MEASUREMENT lws_w "" SWORD lw_sw_q0p04375 1 100 -1434.044 1434.000 FORMAT "%8.3" ECU_ADDRESS 0xF142E /end MEASUREMENT
/begin MEASUREMENT mdgbeg_c "" UBYTE md_ub_q10 1 100 0.00 2550. FORMAT "%5.0" ECU_ADDRESS 0xF0683 /end MEASUREMENT
/begin MEASUREMENT mdwange1_c "" UBYTE rel_ub_b99p6 1 100 0.00 99.61 FORMAT "%5.2" ECU_ADDRESS 0xF0684 /end MEASUREMENT
/begin MEASUREMENT miasrl_can "" UBYTE rel_ub_b99p6 1 100 0.00 99.61 FORMAT "%5.2" ECU_ADDRESS 0xF0685 /end MEASUREMENT
/begin MEASUREMENT miasrs_can "" UBYTE rel_ub_b99p6 1 100 0.00 99.61 FORMAT "%5.2" ECU_ADDRESS 0xF0686 /end MEASUREMENT
/begin MEASUREMENT migs_c "" UBYTE rel_ub_b100 1 100 0.00 99.61 FORMAT "%5.2" ECU_ADDRESS 0xF0687 /end MEASUREMENT
/begin MEASUREMENT mimsr_can "" UBYTE rel_ub_b99p6 1 100 0.00 99.61 FORMAT "%5.2" ECU_ADDRESS 0xF0688 /end MEASUREMENT
/begin MEASUREMENT mizsolv_u "" UBYTE rel_ub_b100 1 100 0.00 99.61 FORMAT "%5.2" ECU_ADDRESS 0xF06D9 /end MEASUREMENT
/begin MEASUREMENT mkllsc "" UBYTE rel_q0p39 1 100 0.00 99.61 FORMAT "%5.2" ECU_ADDRESS 0xF0689 /end MEASUREMENT
/begin MEASUREMENT mkolsc "" UBYTE md_q0p25 1 100 0.00 63.75 FORMAT "%5.2" ECU_ADDRESS 0xF068A /end MEASUREMENT
/begin MEASUREMENT mwolfstg_w "" SWORD vol_sw_q2ml 1 100 -65536.00 65534.00 FORMAT "%8.2" ECU_ADDRESS 0xF438E /end MEASUREMENT
/begin MEASUREMENT mwolfsti_w "" SWORD vol_q0p125ml 1 100 -4096.000 4095.875 FORMAT "%8.3" ECU_ADDRESS 0xF4390 /end MEASUREMENT
/begin MEASUREMENT mwolfst_w "" SWORD vol_q0p125ml 1 100 -4096.000 4095.875 FORMAT "%8.3" ECU_ADDRESS 0xF4392 /end MEASUREMENT
/begin MEASUREMENT nllcvt1_c "" UBYTE nmot_ub_q10 1 100 0.00 2550. FORMAT "%5.0" ECU_ADDRESS 0xF068B /end MEASUREMENT
/begin MEASUREMENT nmotfwiv_w "" UWORD nmot_uw_q0p25 1 100 0.00 16383.75 FORMAT "%8.2" ECU_ADDRESS 0xF4394 /end MEASUREMENT
/begin MEASUREMENT nsywin_c "" UBYTE DEZ 1 100 0.00 255.0 FORMAT "%5.1" ECU_ADDRESS 0xF068C /end MEASUREMENT
/begin MEASUREMENT nsyw_c "" UBYTE nmot_ub_q25 1 100 0.00 6375. FORMAT "%5.0" ECU_ADDRESS 0xF068D /end MEASUREMENT
/begin MEASUREMENT oelkbic "" UBYTE md_q0p25 1 100 0.00 63.75 FORMAT "%5.2" ECU_ADDRESS 0xF403E /end MEASUREMENT
/begin MEASUREMENT olfst1_w "" UWORD s_uw_q62p5um 1 100 0.00 4095.938 FORMAT "%8.3" ECU_ADDRESS 0xF4396 /end MEASUREMENT
/begin MEASUREMENT olfst2_w "" UWORD s_uw_q62p5um 1 100 0.00 4095.938 FORMAT "%8.3" ECU_ADDRESS 0xF4398 /end MEASUREMENT
/begin MEASUREMENT olfst3_w "" UWORD s_uw_q62p5um 1 100 0.00 4095.938 FORMAT "%8.3" ECU_ADDRESS 0xF439A /end MEASUREMENT
/begin MEASUREMENT olfst4_w "" UWORD s_uw_q62p5um 1 100 0.00 4095.938 FORMAT "%8.3" ECU_ADDRESS 0xF439C /end MEASUREMENT
/begin MEASUREMENT pbkvpaus_w "" UWORD p_uw_q0p039 1 100 0.00 2559.961 FORMAT "%8.3" ECU_ADDRESS 0xF4FE2 /end MEASUREMENT
/begin MEASUREMENT pbkvpdf_w "" UWORD p_uw_q0p039 1 100 0.00 2559.961 FORMAT "%8.3" ECU_ADDRESS 0xF4FE4 /end MEASUREMENT
/begin MEASUREMENT pbkvprd_w "" UWORD p_uw_q0p039 1 100 0.00 2559.961 FORMAT "%8.3" ECU_ADDRESS 0xF4FE6 /end MEASUREMENT
/begin MEASUREMENT pbkvp_w "" UWORD p_uw_q0p039 1 100 0.00 2559.961 FORMAT "%8.3" ECU_ADDRESS 0xF4FE8 /end MEASUREMENT
/begin MEASUREMENT pkodrc "" UBYTE p_q0p2 1 100 0.00 51.00 FORMAT "%5.2" ECU_ADDRESS 0xF068E /end MEASUREMENT
/begin MEASUREMENT rinh2_u "" UBYTE r_ub_q64 1 100 0.00 16320. FORMAT "%5.0" ECU_ADDRESS 0xF06DA /end MEASUREMENT
/begin MEASUREMENT rinh_u "" UBYTE r_ub_q64 1 100 0.00 16320. FORMAT "%5.0" ECU_ADDRESS 0xF06DB /end MEASUREMENT
/begin MEASUREMENT rinlsu2_u "" UBYTE r_q10 1 100 0.00 2550. FORMAT "%5.0" ECU_ADDRESS 0xF06DC /end MEASUREMENT
/begin MEASUREMENT rinlsu_u "" UBYTE r_q10 1 100 0.00 2550. FORMAT "%5.0" ECU_ADDRESS 0xF06DD /end MEASUREMENT
/begin MEASUREMENT rl_u "" UBYTE rel_ub_b100 1 100 0.00 99.61 FORMAT "%5.2" ECU_ADDRESS 0xF06DE /end MEASUREMENT
/begin MEASUREMENT rtmpks "" UBYTE dez 1 100 0.00 255.0 FORMAT "%5.1" ECU_ADDRESS 0xF40B6 /end MEASUREMENT
/begin MEASUREMENT sbmcorm "" UBYTE dez 1 100 0.00 255.0 FORMAT "%5.1" ECU_ADDRESS 0xF06EC /end MEASUREMENT
/begin MEASUREMENT sbmcorp "" UBYTE dez 1 100 0.00 255.0 FORMAT "%5.1" ECU_ADDRESS 0xF06ED /end MEASUREMENT
/begin MEASUREMENT sbmlos_w "" UWORD dez 1 100 0.00 65535.00 FORMAT "%8.2" ECU_ADDRESS 0x382EB8 /end MEASUREMENT
/begin MEASUREMENT sfpcair "" UWORD dez 1 100 0.00 65535.00 FORMAT "%8.2" ECU_ADDRESS 0x382D46 /end MEASUREMENT
/begin MEASUREMENT sfpcas "" UWORD dez 1 100 0.00 65535.00 FORMAT "%8.2" ECU_ADDRESS 0x382D4A /end MEASUREMENT
/begin MEASUREMENT sfpcat "" UWORD dez 1 100 0.00 65535.00 FORMAT "%8.2" ECU_ADDRESS 0x382D4C /end MEASUREMENT
/begin MEASUREMENT sfpcbr2 "" UWORD dez 1 100 0.00 65535.00 FORMAT "%8.2" ECU_ADDRESS 0x382D4E /end MEASUREMENT
/begin MEASUREMENT sfpcbsg "" UWORD dez 1 100 0.00 65535.00 FORMAT "%8.2" ECU_ADDRESS 0x382D50 /end MEASUREMENT
/begin MEASUREMENT sfpcgat "" UWORD dez 1 100 0.00 65535.00 FORMAT "%8.2" ECU_ADDRESS 0x382D52 /end MEASUREMENT
/begin MEASUREMENT sfpcgra "" UWORD dez 1 100 0.00 65535.00 FORMAT "%8.2" ECU_ADDRESS 0x382D56 /end MEASUREMENT
/begin MEASUREMENT sfplsv "" UWORD dez 1 100 0.00 65535.00 FORMAT "%8.2" ECU_ADDRESS 0x382E1A /end MEASUREMENT
/begin MEASUREMENT sfplsv2 "" UWORD dez 1 100 0.00 65535.00 FORMAT "%8.2" ECU_ADDRESS 0x382E1C /end MEASUREMENT
/begin MEASUREMENT sfpswe "" UWORD dez 1 100 0.00 65535.00 FORMAT "%8.2" ECU_ADDRESS 0x382E66 /end MEASUREMENT
/begin MEASUREMENT sfptol "" UWORD dez 1 100 0.00 65535.00 FORMAT "%8.2" ECU_ADDRESS 0x382E7C /end MEASUREMENT
/begin MEASUREMENT sfptum "" UWORD dez 1 100 0.00 65535.00 FORMAT "%8.2" ECU_ADDRESS 0x382E7E /end MEASUREMENT
/begin MEASUREMENT snobm "" UBYTE dez 1 100 0.00 255.0 FORMAT "%5.1" ECU_ADDRESS 0x38203B /end MEASUREMENT
/begin MEASUREMENT statwk_c "" UBYTE DEZ 1 100 0.00 255.0 FORMAT "%5.1" ECU_ADDRESS 0xF068F /end MEASUREMENT
/begin MEASUREMENT sumdol_w "" SWORD vol_sw_q2ml 1 100 -65536.00 65534.00 FORMAT "%8.2" ECU_ADDRESS 0xF439E /end MEASUREMENT
/begin MEASUREMENT sumolfst_w "" SWORD vol_sw_q0p25 1 100 -8192.000 8191.750 FORMAT "%8.3" ECU_ADDRESS 0xF43A0 /end MEASUREMENT
/begin MEASUREMENT swolfst_w "" UWORD s_uw_q62p5mm 1 100 0.00 4095.938 FORMAT "%8.3" ECU_ADDRESS 0xF43A2 /end MEASUREMENT
/begin MEASUREMENT tabcan_w "" UWORD t_q4_s 1 100 0.00 262140.0 FORMAT "%8.1" ECU_ADDRESS 0xF43BA /end MEASUREMENT
/begin MEASUREMENT tfst "" UBYTE vol_q1_l 1 100 0.00 255.0 FORMAT "%5.1" ECU_ADDRESS 0xF0690 /end MEASUREMENT
/begin MEASUREMENT tmkic "" UBYTE temp_ub_q0p75_o48 1 100 -48.00 143.3 FORMAT "%5.1" ECU_ADDRESS 0xF0691 /end MEASUREMENT
/begin MEASUREMENT tmot_u "" UBYTE temp_ub_q1_o40 1 100 -40.00 215.0 FORMAT "%5.1" ECU_ADDRESS 0xF06DF /end MEASUREMENT
/begin MEASUREMENT tmpksub "" UBYTE dez 1 100 0.00 255.0 FORMAT "%5.1" ECU_ADDRESS 0xF40B7 /end MEASUREMENT
/begin MEASUREMENT toeli "" UBYTE temp_ub_q1_o60 1 100 -60.00 195.0 FORMAT "%5.1" ECU_ADDRESS 0xF4025 /end MEASUREMENT
/begin MEASUREMENT toeltog "" UBYTE temp_ub_q1_o60 1 100 -60.00 195.0 FORMAT "%5.1" ECU_ADDRESS 0xF4026 /end MEASUREMENT
/begin MEASUREMENT toeltogk "" UBYTE temp_ub_q1_o60 1 100 -60.00 195.0 FORMAT "%5.1" ECU_ADDRESS 0xF4027 /end MEASUREMENT
/begin MEASUREMENT togtime_w "" UWORD t500msxs_q0p125 1 100 0.00 8191.875 FORMAT "%8.3" ECU_ADDRESS 0xF43BC /end MEASUREMENT
/begin MEASUREMENT tolc "" UBYTE temp_ub_q1_o60 1 100 -60.00 195.0 FORMAT "%5.1" ECU_ADDRESS 0xF4028 /end MEASUREMENT
/begin MEASUREMENT tsyn_c "" UBYTE t_q20_ms 1 100 0.00 5100. FORMAT "%5.0" ECU_ADDRESS 0xF0692 /end MEASUREMENT
/begin MEASUREMENT tumc "" UBYTE temp_ub_q0p75_o48 1 100 -48.00 143.3 FORMAT "%5.1" ECU_ADDRESS 0xF0693 /end MEASUREMENT
/begin MEASUREMENT tvluessc "" UBYTE rel_q0p4 1 100 0.00 102.0 FORMAT "%5.1" ECU_ADDRESS 0xF0694 /end MEASUREMENT
/begin MEASUREMENT TYP_cair "" UWORD B_TRUE 1 100 0.00 1.00000000000 BIT_MASK 0xf00 FORMAT "%13.11" ECU_ADDRESS 0x382D46 /end MEASUREMENT
/begin MEASUREMENT TYP_cas "" UWORD B_TRUE 1 100 0.00 1.00000000000 BIT_MASK 0xf00 FORMAT "%13.11" ECU_ADDRESS 0x382D4A /end MEASUREMENT
/begin MEASUREMENT TYP_cat "" UWORD B_TRUE 1 100 0.00 1.00000000000 BIT_MASK 0xf00 FORMAT "%13.11" ECU_ADDRESS 0x382D4C /end MEASUREMENT
/begin MEASUREMENT TYP_cbr2 "" UWORD B_TRUE 1 100 0.00 1.00000000000 BIT_MASK 0xf00 FORMAT "%13.11" ECU_ADDRESS 0x382D4E /end MEASUREMENT
/begin MEASUREMENT TYP_cbsg "" UWORD B_TRUE 1 100 0.00 1.00000000000 BIT_MASK 0xf00 FORMAT "%13.11" ECU_ADDRESS 0x382D50 /end MEASUREMENT
/begin MEASUREMENT TYP_cgat "" UWORD B_TRUE 1 100 0.00 1.00000000000 BIT_MASK 0xf00 FORMAT "%13.11" ECU_ADDRESS 0x382D52 /end MEASUREMENT
/begin MEASUREMENT TYP_cgra "" UWORD B_TRUE 1 100 0.00 1.00000000000 BIT_MASK 0xf00 FORMAT "%13.11" ECU_ADDRESS 0x382D56 /end MEASUREMENT
/begin MEASUREMENT TYP_lsv "" UWORD B_TRUE 1 100 0.00 1.00000000000 BIT_MASK 0xf00 FORMAT "%13.11" ECU_ADDRESS 0x382E1A /end MEASUREMENT
/begin MEASUREMENT TYP_lsv2 "" UWORD B_TRUE 1 100 0.00 1.00000000000 BIT_MASK 0xf00 FORMAT "%13.11" ECU_ADDRESS 0x382E1C /end MEASUREMENT
/begin MEASUREMENT TYP_swe "" UWORD B_TRUE 1 100 0.00 1.00000000000 BIT_MASK 0xf00 FORMAT "%13.11" ECU_ADDRESS 0x382E66 /end MEASUREMENT
/begin MEASUREMENT TYP_tol "" UWORD B_TRUE 1 100 0.00 1.00000000000 BIT_MASK 0xf00 FORMAT "%13.11" ECU_ADDRESS 0x382E7C /end MEASUREMENT
/begin MEASUREMENT TYP_tum "" UWORD B_TRUE 1 100 0.00 1.00000000000 BIT_MASK 0xf00 FORMAT "%13.11" ECU_ADDRESS 0x382E7E /end MEASUREMENT
/begin MEASUREMENT udkp1_u "" UBYTE spg_ub_b5 1 100 0.00 4.980 FORMAT "%5.3" ECU_ADDRESS 0xF06E0 /end MEASUREMENT
/begin MEASUREMENT udkp2_u "" UBYTE spg_ub_b5 1 100 0.00 4.980 FORMAT "%5.3" ECU_ADDRESS 0xF06E1 /end MEASUREMENT
/begin MEASUREMENT uefktge1_c "" UBYTE uefktget_ub_b25p4 1 100 0.00 25.50 FORMAT "%5.2" ECU_ADDRESS 0xF0695 /end MEASUREMENT
/begin MEASUREMENT upwg1_u "" UBYTE spg_ub_b5 1 100 0.00 4.980 FORMAT "%5.3" ECU_ADDRESS 0xF06E2 /end MEASUREMENT
/begin MEASUREMENT upwg2d_u "" UBYTE spg_ub_b5 1 100 0.00 4.980 FORMAT "%5.3" ECU_ADDRESS 0xF06E3 /end MEASUREMENT
/begin MEASUREMENT upwg2_u "" UBYTE spg_ub_b5 1 100 0.00 4.980 FORMAT "%5.3" ECU_ADDRESS 0xF06E4 /end MEASUREMENT
/begin MEASUREMENT vamsr_c "" UWORD vfzg_uw_q0p01 1 100 0.00 655.3500 FORMAT "%8.4" ECU_ADDRESS 0xF1430 /end MEASUREMENT
/begin MEASUREMENT vfzgkb_w "" UWORD vfzgkb_uw_b655 1 100 0.00 654.9900 FORMAT "%8.4" ECU_ADDRESS 0xF1432 /end MEASUREMENT
/begin MEASUREMENT vfzg_u "" UBYTE vfzg_q1p0 1 100 0.00 255.0 FORMAT "%5.1" ECU_ADDRESS 0xF06E5 /end MEASUREMENT
/begin MEASUREMENT vrad_hl_c "" UWORD vrad_uw_b655 1 100 0.00 654.9900 FORMAT "%8.4" ECU_ADDRESS 0xF1434 /end MEASUREMENT
/begin MEASUREMENT vrad_hr_c "" UWORD vrad_uw_b655 1 100 0.00 654.9900 FORMAT "%8.4" ECU_ADDRESS 0xF1436 /end MEASUREMENT
/begin MEASUREMENT vrad_vl_c "" UWORD vrad_uw_b655 1 100 0.00 654.9900 FORMAT "%8.4" ECU_ADDRESS 0xF1438 /end MEASUREMENT
/begin MEASUREMENT vrad_vr_c "" UWORD vrad_uw_b655 1 100 0.00 654.9900 FORMAT "%8.4" ECU_ADDRESS 0xF143A /end MEASUREMENT
/begin MEASUREMENT vzgrac "" UBYTE vfzg_ub_q1p25 1 100 0.00 318.8 FORMAT "%5.1" ECU_ADDRESS 0xF0696 /end MEASUREMENT
/begin MEASUREMENT wdcan "" UBYTE vol_ub_q15_o1905ml 1 100 -1905. 1920. FORMAT "%5.0" ECU_ADDRESS 0xF4029 /end MEASUREMENT
/begin MEASUREMENT wfv_w "" UWORD fak_q2p0em8 1 100 0.00 0.001310700 FORMAT "%11.9" ECU_ADDRESS 0xF43A4 /end MEASUREMENT
/begin MEASUREMENT wivchka_w "" UWORD vol_uw_q8mm3 1 100 0.00 524280.0 FORMAT "%8.1" ECU_ADDRESS 0xF43A6 /end MEASUREMENT
/begin MEASUREMENT wivchkb_w "" UWORD vol_uw_q64mm3 1 100 0.00 4194240. FORMAT "%8.0" ECU_ADDRESS 0xF43A8 /end MEASUREMENT
/begin MEASUREMENT woeldir "" UBYTE vol_ub_q15_o1905ml 1 100 -1905. 1920. FORMAT "%5.0" ECU_ADDRESS 0xF402A /end MEASUREMENT
/begin MEASUREMENT woeloff "" UBYTE vol_ub_q10ml 1 100 0.00 2550. FORMAT "%5.0" ECU_ADDRESS 0xF402B /end MEASUREMENT
/begin MEASUREMENT woeltol "" UBYTE vol_ub_q10ml 1 100 0.00 2550. FORMAT "%5.0" ECU_ADDRESS 0xF402C /end MEASUREMENT
/begin MEASUREMENT wsmit "" UBYTE s_ub_q25km 1 100 0.00 6375. FORMAT "%5.0" ECU_ADDRESS 0xF402D /end MEASUREMENT
/begin MEASUREMENT wtmax "" UBYTE t_ub_q1month 1 100 0.00 255.0 FORMAT "%5.1" ECU_ADDRESS 0xF402E /end MEASUREMENT
/begin MEASUREMENT wtmin "" UBYTE t_ub_q1month 1 100 0.00 255.0 FORMAT "%5.1" ECU_ADDRESS 0xF402F /end MEASUREMENT
/begin MEASUREMENT wwertmin "" UBYTE fak_ub_q500 1 100 0.00 127500. FORMAT "%5.0" ECU_ADDRESS 0xF4030 /end MEASUREMENT
/begin MEASUREMENT wwmax "" UBYTE s_ub_q1000km 1 100 0.00 255000. FORMAT "%5.0" ECU_ADDRESS 0xF4031 /end MEASUREMENT
/begin MEASUREMENT wwmin "" UBYTE s_ub_q1000km 1 100 0.00 255000. FORMAT "%5.0" ECU_ADDRESS 0xF4032 /end MEASUREMENT
/begin MEASUREMENT wzcan "" UBYTE dez 1 100 0.00 255.0 FORMAT "%5.1" ECU_ADDRESS 0xF4033 /end MEASUREMENT
/begin MEASUREMENT xoel "" UBYTE fak_ub_b16 1 100 0.00 15.94 FORMAT "%5.2" ECU_ADDRESS 0xF4034 /end MEASUREMENT
/begin MEASUREMENT xoelv "" UBYTE fak_ub_q0p05 1 100 0.00 12.75 FORMAT "%5.2" ECU_ADDRESS 0xF4035 /end MEASUREMENT
/begin MEASUREMENT zkvaeq "" UBYTE dez 1 100 0.00 255.0 FORMAT "%5.1" ECU_ADDRESS 0xF4036 /end MEASUREMENT
/begin MEASUREMENT zkwnpbm_w "" UWORD dez 1 100 0.00 65535.00 FORMAT "%8.2" ECU_ADDRESS 0xF1718 /end MEASUREMENT
/begin MEASUREMENT zmwolfsti "" UBYTE dez 1 100 0.00 255.0 FORMAT "%5.1" ECU_ADDRESS 0xF4037 /end MEASUREMENT
/begin MEASUREMENT zolfst "" UBYTE dez 1 100 0.00 255.0 FORMAT "%5.1" ECU_ADDRESS 0xF4038 /end MEASUREMENT
/begin MEASUREMENT zolfstdg "" UBYTE dez 1 100 0.00 255.0 FORMAT "%5.1" ECU_ADDRESS 0xF4039 /end MEASUREMENT
/begin MEASUREMENT zsdolfst "" UBYTE dez 1 100 0.00 255.0 FORMAT "%5.1" ECU_ADDRESS 0xF403A /end MEASUREMENT
/begin MEASUREMENT zsdolfstc "" UBYTE dez 1 100 0.00 255.0 FORMAT "%5.1" ECU_ADDRESS 0xF403B /end MEASUREMENT
/begin MEASUREMENT Z_cair "" UWORD B_TRUE 1 100 0.00 1.00000000000 BIT_MASK 0x2 FORMAT "%13.11" ECU_ADDRESS 0x382D46 /end MEASUREMENT
/begin MEASUREMENT Z_cas "" UWORD B_TRUE 1 100 0.00 1.00000000000 BIT_MASK 0x2 FORMAT "%13.11" ECU_ADDRESS 0x382D4A /end MEASUREMENT
/begin MEASUREMENT Z_cat "" UWORD B_TRUE 1 100 0.00 1.00000000000 BIT_MASK 0x2 FORMAT "%13.11" ECU_ADDRESS 0x382D4C /end MEASUREMENT
/begin MEASUREMENT Z_cbr2 "" UWORD B_TRUE 1 100 0.00 1.00000000000 BIT_MASK 0x2 FORMAT "%13.11" ECU_ADDRESS 0x382D4E /end MEASUREMENT
/begin MEASUREMENT Z_cbsg "" UWORD B_TRUE 1 100 0.00 1.00000000000 BIT_MASK 0x2 FORMAT "%13.11" ECU_ADDRESS 0x382D50 /end MEASUREMENT
/begin MEASUREMENT Z_cgat "" UWORD B_TRUE 1 100 0.00 1.00000000000 BIT_MASK 0x2 FORMAT "%13.11" ECU_ADDRESS 0x382D52 /end MEASUREMENT
/begin MEASUREMENT Z_cgra "" UWORD B_TRUE 1 100 0.00 1.00000000000 BIT_MASK 0x2 FORMAT "%13.11" ECU_ADDRESS 0x382D56 /end MEASUREMENT
/begin MEASUREMENT Z_ev "" UWORD B_TRUE 1 100 0.00 1.00000000000 BIT_MASK 0x2000 FORMAT "%13.11" ECU_ADDRESS 0xFD66 /end MEASUREMENT
/begin MEASUREMENT Z_lsv "" UWORD B_TRUE 1 100 0.00 1.00000000000 BIT_MASK 0x2 FORMAT "%13.11" ECU_ADDRESS 0x382E1A /end MEASUREMENT
/begin MEASUREMENT Z_lsv2 "" UWORD B_TRUE 1 100 0.00 1.00000000000 BIT_MASK 0x2 FORMAT "%13.11" ECU_ADDRESS 0x382E1C /end MEASUREMENT
/begin MEASUREMENT Z_swe "" UWORD B_TRUE 1 100 0.00 1.00000000000 BIT_MASK 0x2 FORMAT "%13.11" ECU_ADDRESS 0x382E66 /end MEASUREMENT
/begin MEASUREMENT Z_tol "" UWORD B_TRUE 1 100 0.00 1.00000000000 BIT_MASK 0x2 FORMAT "%13.11" ECU_ADDRESS 0x382E7C /end MEASUREMENT
/begin MEASUREMENT Z_tum "" UWORD B_TRUE 1 100 0.00 1.00000000000 BIT_MASK 0x2 FORMAT "%13.11" ECU_ADDRESS 0x382E7E /end MEASUREMENT
/begin FUNCTION CANECUR "5.70"
 /begin DEF_CHARACTERISTIC BUSOFFCTR BUSOFFTIME CSAIR CWCANECURA CWCANKBI CWCANLWS CW_CAN_C_0___A CW_CAN_C_1___A CW_CAN_C_2___A CW_CAN_C_3___A CW_CAN_R_0___A CW_CAN_R_1___A CW_CAN_R_2___A CW_CAN_R_3___A CW_CAN_R_4___A CW_CAN_R_5___A CW_CAN_R_6___A CW_CAN_R_7___A CW_CAN_RA CW_CAN_RB FWCBFT FWCSBK KFOELKBI TKMTIMERR T_KLIMADEADCTR T_KOM1CLDEAD T_NEGAT T_NEGE T_NOMAIR T_NOMAIRTA T_NOMASR T_NOMASRTA T_NOMBR2 T_NOMBR3 T_NOMBSG T_NOMEGS T_NOMGAT T_NOMKBI T_NOMKBI1 T_NOMKBI23 T_NOMKLA T_NOMLWS T_NOMTOG T_NOMZAS T_NOMZASTA T_NUBR2 T_NUBSG T_NUCINS1 T_NUCINS23 T_NUKLA T_NULWS T_NUTOG ZCANAIR ZTOELKBI /end DEF_CHARACTERISTIC
 /begin REF_CHARACTERISTIC CWCAUVW CWCS_0_A CWCS_1_A CWFGRABED CW_CAN_S_0___A CW_CAN_S_1___A MDIMX MDNORM NOASR NSLBZFS2 NSLBZLL2 /end REF_CHARACTERISTIC
 /begin IN_MEASUREMENT bfgrsbr bfgrs_w B_acc B_accen B_anlfr B_autget B_bl B_br B_dcy B_dknolu B_dkpu B_epcl B_fgr B_fgren B_fgrhsa B_fgrte B_fgrtse B_fs B_gracan B_gsala B_i_ska_fr B_kd B_kl15 B_kmtre B_koe B_kosrc B_kov B_kovkmtr B_kuppl B_kvakbi B_lfw B_ll B_llped B_mil B_mshlon B_msr B_nachl B_nlbzakt B_nlcan B_nldg B_nmin B_png B_pwf B_st B_stend B_tolcb B_vmax B_wdk2sel B_wuc cserk fcmEnd ffzdfp fgnsol kvakbi_w mdverl_w miautgetc miautgsc mifab_w mifa_w miges_w migs_w miist_w mimax_w mivbeb_w mivbeg_w mizwmn_w mrfamx_w mrfgr_w mrped_w nmot nmot_w nsol nstat S_bls S_brs tans tmot tnachl_w tnst_w toelk_w tolc tvluesic ub udkp1_w udkp2_w vfzg vregl_w vziel_w wpedv_w zstfgr /end IN_MEASUREMENT
 /begin OUT_MEASUREMENT aquerc bz_air bz_anh bz_bl bz_can bz_cang1 bz_cange bz_tog B_aagnp B_aakupplc B_absdia B_absfgr B_adrbot B_aircan B_airnbot B_amsrbot B_anherk B_anhold B_aquerc B_asresp B_asr_can B_batnot B_bela B_bkva B_bkvvc B_blanhd B_blld B_blmd B_blrd B_br2bot B_br3bot B_bsgbot B_bsglue B_bus_off B_cankbi B_canlws B_cins1bot B_cins2bot B_cins3bot B_ckien B_csair B_csairio B_ctout B_cvtad_c B_ectal B_edsfgr B_epcden B_fabr B_fgrabz B_fku_c B_fstcanok B_gatbot B_ge1bot B_ge2bot B_geco_c B_gekoa_c B_genot_c B_ges_c B_grabot B_grahianz B_gsaf1_c B_gsch_c B_haubest B_hlacan B_ilmnp B_insver B_kl50 B_klabot B_kombi1_klima1 B_kooffc B_lhold B_lowra B_luesscb B_lwsbot B_lwser B_lwsok B_milfbg_c B_motaus_c B_msr_can B_neair B_neamsr B_nebr2 B_nebr3 B_nebsg B_necins1 B_necins2 B_necins3 B_negat B_nege B_nekla B_nelws B_netog B_nezas B_nlanbsg1 B_nlanbsg2 B_nlbzanf B_nlbzanf2 B_npcanswe B_nuair B_nuamsr B_nubr2 B_nubr3 B_nubsg B_nucins2 B_nugat B_nuge B_nukla B_nutog B_nuzas B_renair B_renamsr B_renbsg B_rencins1 B_rengat B_renge1 B_renkla B_renlws B_rentog B_renzas B_sacc B_sacvt_c B_sfsc B_sh_act B_sh_mvw B_skoc B_sksc B_stesp B_swecan B_tabcan B_talcan B_talkbi B_terrbr1 B_terrbr2 B_terrbr3 B_terrge B_terrkla B_tfstok B_tmkicb B_togbot B_togerr B_togmu B_togpu B_tumcb B_zasbot B_zask15 B_zask15v B_zges_c canbits1 can_nv_bits cs_air dlws_w fst1tog_w fst2tog_w fst3tog_w fst4tog_w gangauti_c gwhpos_c klah_c km01tr kmstand_l kmstand_w lws_w mdgbeg_c mdwange1_c miasrl_can miasrs_can migs_c mimsr_can mkllsc mkolsc nllcvt1_c nsywin_c nsyw_c oelkbic pkodrc statwk_c tabcan_w tfst tmkic togtime_w tsyn_c tumc tvluessc uefktge1_c vamsr_c vfzgkb_w vrad_hl_c vrad_hr_c vrad_vl_c vrad_vr_c vzgrac /end OUT_MEASUREMENT
 /begin LOC_MEASUREMENT B_busoffer B_sleepa kfoelkbi_nmot /end LOC_MEASUREMENT
/end FUNCTION
/begin FUNCTION CCAN_DST "" /begin DEF_CHARACTERISTIC TCANINIDELAY TFIRSTCANINIDELAY /end DEF_CHARACTERISTIC /begin OUT_MEASUREMENT B_busoff_CAN1 B_busoff_CAN2 B_ewrn_CAN1 B_ewrn_CAN2 /end OUT_MEASUREMENT /end FUNCTION
/begin FUNCTION COWIV "2.10"
 /begin DEF_CHARACTERISTIC CWCOWIV KFAQUERWIV KFKOROLSW KLOLFSTZ KLOLTBFWIV KLOLTWIV KOELV KTMGZYL KVAKBIMX NMOTMNWIV NMOTMXWIV PAFSTMNC POELOFFC POELTOLC PSMITC PTMAXC PTMINC PTOELWIV PWIVMNC PWIVMXC STEIGOLB TOELMNTUR TOELMNWIV TOELMXWIV TOELTUR TOLFSTDIS TOLFSTMN TOLFSTMX TOLFSTNVA ZAQUERWIV ZNMOTWIV ZTOELMAX ZTOELMIN /end DEF_CHARACTERISTIC
 /begin IN_MEASUREMENT aquer bz_tog B_aquer B_nubr2 B_nutog B_togerr B_togpu fst1tog_w fst2tog_w fst3tog_w fst4tog_w kvakbi_w nmot_w togtime_w toltm /end IN_MEASUREMENT
 /begin OUT_MEASUREMENT B_tolcb B_tolcbwiv B_tolfstc B_tverac B_wowarn B_wswarn tolc wdcan wfv_w woeldir woeloff woeltol wsmit wtmax wtmin wwertmin wwmax wwmin wzcan /end OUT_MEASUREMENT
 /begin LOC_MEASUREMENT aeqkv_w aquerf_w B_aeqkvc B_fst1pl B_fst2pl B_fst3pl B_fst4pl B_newtog B_olfst1er B_olfst2er B_olfst3er B_olfst4er B_olfstc B_olfstdis B_olfstnva B_olfstok B_olfstpl B_olswarn B_tolfst B_tvera B_zolfst B_ztoelpl dolfst1_w dolfst2_w dolfst3_w dolfst4_w faquer faquerrd fsttog_w kvasumz_w kvasum_w mwolfstg_w mwolfsti_w mwolfst_w nmotfwiv_w olfst1_w olfst2_w olfst3_w olfst4_w sumdol_w sumolfst_w swolfst_w toeli toeltog toeltogk wivchka_w wivchkb_w xoel xoelv zkvaeq zmwolfsti zolfst zolfstdg zsdolfst zsdolfstc /end LOC_MEASUREMENT
/end FUNCTION
/begin FUNCTION D2CTR "2.40" /begin DEF_CHARACTERISTIC DFPSLBIT /end DEF_CHARACTERISTIC
 /begin OUT_MEASUREMENT bbd2ctr B_syserr B_syserrk B_trip ctrerf1 ctrerfk1 ctrrdy1 ctrsfp ctrzyf0 ctrzyf1 /end OUT_MEASUREMENT
/end FUNCTION
/begin FUNCTION DAKRE "2.10" /begin IN_MEASUREMENT B_abkl B_desee /end IN_MEASUREMENT /end FUNCTION
/begin FUNCTION DBKVP "1.80" /begin DEF_CHARACTERISTIC DPBKVP DPBKVPMN TDBBKVP TDDBKVP TNSTBKV /end DEF_CHARACTERISTIC /begin REF_CHARACTERISTIC FBKVP PBKVKRHY /end REF_CHARACTERISTIC
 /begin IN_MEASUREMENT B_bkvp B_brems B_cdbkvp B_cddsbkv B_fabkv dpbkvukp_w pbkv_w psspbkv_w pubkv_w tnst_w /end IN_MEASUREMENT
 /begin OUT_MEASUREMENT B_fdbkvp B_fpbkvmx B_zbkvtest /end OUT_MEASUREMENT
 /begin LOC_MEASUREMENT B_dbkvpa B_rdbkvp B_rdbkvpps B_rtdbkvp dpbkvpa_w pbkvpaus_w pbkvpdf_w pbkvprd_w pbkvp_w /end LOC_MEASUREMENT
/end FUNCTION
/begin FUNCTION DBKVPE "1.10" /begin IN_MEASUREMENT B_bkvp B_desee /end IN_MEASUREMENT /begin LOC_MEASUREMENT bkvpea_ctr bkvpena_ctr B_bkvpea B_bkvpena dbkvpelokbits /end LOC_MEASUREMENT /end FUNCTION
/begin FUNCTION DBUKSUE "1.30" /begin DEF_CHARACTERISTIC TDBUKSUE UMNBUKSUE UMXBUKSUE /end DEF_CHARACTERISTIC /begin REF_CHARACTERISTIC CWSU /end REF_CHARACTERISTIC /begin IN_MEASUREMENT B_desee B_ekp B_su udbuk_w /end IN_MEASUREMENT /begin OUT_MEASUREMENT B_dbuken B_subuk /end OUT_MEASUREMENT /end FUNCTION
/begin FUNCTION DCDACC "2.10" /begin DEF_CHARACTERISTIC CWCDCUM /end DEF_CHARACTERISTIC /end FUNCTION
/begin FUNCTION DCFFLR "1.10" /begin DEF_CHARACTERISTIC CWDCFFLR /end DEF_CHARACTERISTIC
 /begin IN_MEASUREMENT B_elsuv B_eobdlr B_eobdlr2 B_lr B_lr2 B_pspwl B_sbblsu B_sbblsu2 B_tmlr /end IN_MEASUREMENT
 /begin OUT_MEASUREMENT flglrs flglrs2 /end OUT_MEASUREMENT
 /begin LOC_MEASUREMENT B_lelsfbb B_lelsfbb2 B_lelshbb B_lelshbb2 B_lelsxbb B_lelsxbb2 B_lelsxnb B_lelsxnb2 B_lrebwl B_lrebwl2 DCFFLRLokBits1 DCFFLRLokBits2 /end LOC_MEASUREMENT
/end FUNCTION
/begin FUNCTION DCLA "7.10"
 /begin DEF_CHARACTERISTIC CL30LINE CL31LINE CL32LINE CL33LINE CL34LINE CL35LINE CL36LINE CL37LINE CL38LINE CL39LINE CWFLC /end DEF_CHARACTERISTIC
/end FUNCTION
/begin FUNCTION DDCY "15.10" /begin DEF_CHARACTERISTIC TWBDCY /end DEF_CHARACTERISTIC /begin IN_MEASUREMENT B_pwf B_stend /end IN_MEASUREMENT /begin OUT_MEASUREMENT bbdcy B_dcy dcycnt /end OUT_MEASUREMENT /end FUNCTION
/begin FUNCTION DDG "10.80"
 /begin DEF_CHARACTERISTIC CORTINC CORTINIT CORTMX LBMINC LBMINIT LBMMX LBMSUB MXNLN NOBMINC NOBMINIT NOBMSTMX PGFLNL PGFLWA TMOTNLDG /end DEF_CHARACTERISTIC
 /begin IN_MEASUREMENT bmLosCtr_w B_bm B_fbm B_motstop B_nmin B_nophnldg B_pwf B_synnldg B_zprel nmotllfil nstat nsynnldg tmCorCtr_w tmot tpCorCtr_w vfzg_w wkw_w znbm_w zrph zrph2 /end IN_MEASUREMENT
 /begin OUT_MEASUREMENT B_nldg /end OUT_MEASUREMENT
 /begin LOC_MEASUREMENT B_enabddg B_nlbm B_nlnobm B_nlnon B_nobmflr1 B_nobmflr2 B_nocorflr B_setmnbm B_setmxbm B_setnpbm B_setsibm flgddg sbmcorm sbmcorp sbmlos_w snobm zkwnpbm_w /end LOC_MEASUREMENT
/end FUNCTION
/begin FUNCTION DDPL "9.20" /begin IN_MEASUREMENT B_pwfCsErr /end IN_MEASUREMENT /end FUNCTION
/begin FUNCTION DDVE "7.30" /begin DEF_CHARACTERISTIC TPNSE /end DEF_CHARACTERISTIC
 /begin IN_MEASUREMENT B_abgle B_dkaden B_dkp1e B_dkp1mn B_dkp1mx B_dkp1np B_dkp2e B_dkp2mn B_dkp2mx B_dkp2np B_dlrbe B_dlrpide B_dveese B_fproab B_fproe B_fprook B_fprordy B_fprovb B_fprrdy B_fprzab B_fprze B_fprzvb B_lrnakt B_lrnerf B_lrnrdy B_lrnvb B_lrnws B_nlpe B_nlperf B_nlpnew B_pwf B_stend B_umae B_umauab B_wdksive dveadchst fprstep_c lrnstep_c /end IN_MEASUREMENT
/end FUNCTION
/begin FUNCTION DDYLSU "5.90"
 /begin DEF_CHARACTERISTIC CWDDYLSU DFRZAMIN DMRLSV DRLMXW DYNLSUFA DYNLSUMX DYNLSURD FTEDYLSUMX IVDYNLSU KDYNFA KDYNLSU LAMDYNO LAMDYNU NMOTDYFA NMOTDYNO NMOTDYNU RLDYNFAW RLDYNOW RLDYNUW TVDRL ZDYNFA ZDYNLSU ZLAMHP ZLAMLP /end DEF_CHARACTERISTIC
 /begin IN_MEASUREMENT B_cddylsu B_dsls B_fa B_fadylsu B_frmax B_frmax2 B_frmin B_frmin2 B_helsuip B_helsuip2 B_mdarv B_pwf B_sbblsu B_sbblsu2 B_te B_vekat B_vekat2 B_za B_za2 dfrza2_w dfrzaf2_w dfrzaf_w dfrza_w dlahi2_w dlahi_w fteadf lamsoni2_w lamsoni_w nmot rl_w /end IN_MEASUREMENT
 /begin OUT_MEASUREMENT anzdyn anzdyn2 B_clradlra B_drlmx B_dylsu B_dylsu2 B_dylsuav B_dylsuav2 B_minflsu B_minflsu2 B_stcdyn B_stcdyn2 B_valdyn B_valdyn2 dmrlsv_w dynlsu2_w dynlsu_w /end OUT_MEASUREMENT
 /begin LOC_MEASUREMENT anzdyst anzdyst2 B_dylsuf B_ncdlsu B_ncdlsu2 B_redylsu B_redylsu2 B_spdiaga B_spdlsu B_spdlsu2 B_stcal B_stcal2 fkdyn_w lamsam2_w lamsam_w /end LOC_MEASUREMENT
/end FUNCTION
/begin FUNCTION DECJ "14.30" /begin DEF_CHARACTERISTIC CWBBDECJ /end DEF_CHARACTERISTIC /begin IN_MEASUREMENT B_airbag B_dhrnio B_nmin B_ubrk B_ubrmax nmot ub /end IN_MEASUREMENT /begin OUT_MEASUREMENT B_bbdecj B_bbubr B_desee B_esdia /end OUT_MEASUREMENT /end FUNCTION
/begin FUNCTION DEGFE "6.60"
 /begin DEF_CHARACTERISTIC DFEMPOS DFEMPUS DFRAOS DFRAUS FEMPOS FEMPUS FRAOS FRAUS TDEGFEMN TDEGFEMX TDEGFENO TEGA TLADEGFE TVFKMSDK ZKGAFRANM /end DEF_CHARACTERISTIC
 /begin IN_MEASUREMENT B_cdegfe B_fedkb B_fkpvdk B_frao B_frau B_lra B_lra2 B_msndko B_pwf fkpvdkg_w fra2_w fra_w frm2_w frm_w pspvds_w /end IN_MEASUREMENT
 /begin OUT_MEASUREMENT B_ehfmfe B_fempos B_fempus B_gaedegfe B_gafraos B_gafraus B_laedegfe B_tepvb B_zhfmfe DEGFEintbits degfe_bits1 dgafram_w dgafra_w fram_w frmm_w /end OUT_MEASUREMENT
/end FUNCTION
/begin FUNCTION DEKON "" /begin DEF_CHARACTERISTIC ESKONF ESKONF_AGR ESKONF_NL ESKONF_STA /end DEF_CHARACTERISTIC /end FUNCTION
/begin FUNCTION DEKPE "11.70" /begin DEF_CHARACTERISTIC UBDEKPMN /end DEF_CHARACTERISTIC /begin IN_MEASUREMENT B_desee ub /end IN_MEASUREMENT /begin LOC_MEASUREMENT B_tmpksub dekpe ekpfz ekppz rtmpks tmpksub /end LOC_MEASUREMENT /end FUNCTION
/begin FUNCTION DEPCLE "1.20" /begin IN_MEASUREMENT B_desee B_epcl /end IN_MEASUREMENT /end FUNCTION
/begin FUNCTION DEVE "6.40" /begin IN_MEASUREMENT B_desee B_sa B_stend evz_austot /end IN_MEASUREMENT /begin OUT_MEASUREMENT B_eev Z_ev /end OUT_MEASUREMENT /end FUNCTION
/begin FUNCTION DFFT "1.90"
 /begin IN_MEASUREMENT egaspfad flglrs flglrs2 fr2_u fra2_u fra_u fr_u gangi mizsolv_u mizuvfil mi_duf mi_um ml mpfad nmot pu rinh2_u rinh_u rinlsu2_u rinlsu_u rl rml rstpfad skapfad tabgm tabgm2 tans tfst tkatm tkatm2 tmew tmot tmotlin tmot_u tmrw tumg ub udkp1_u udkp2_u upwg1_u upwg2d_u upwg2_u ushk ushk2 vfzg_u wdkba wdks wped /end IN_MEASUREMENT
/end FUNCTION
/begin FUNCTION DFFTCNV "3.70" /begin REF_CHARACTERISTIC NMAX /end REF_CHARACTERISTIC
 /begin IN_MEASUREMENT fr2_w fra2_w fra_w fr_w mizsolv_w nmot_w rinh2_w rinh_w rinlsu2_w rinlsu_w rlugd_w rl_w tmotlin udkp1_w udkp2_w upwg1_w upwg2d_w upwg2_w vfzg /end IN_MEASUREMENT
 /begin OUT_MEASUREMENT fr2_u fra2_u fra_u fr_u mizsolv_u rinh2_u rinh_u rinlsu2_u rinlsu_u rl_u tmot_u udkp1_u udkp2_u upwg1_u upwg2d_u upwg2_u vfzg_u /end OUT_MEASUREMENT
/end FUNCTION
/begin FUNCTION DFFTK "9.10" /end FUNCTION
/begin FUNCTION DFPM "3.50" /begin REF_CHARACTERISTIC CWFLC /end REF_CHARACTERISTIC
 /begin IN_MEASUREMENT bbwuc B_pwf egaspfad mi_duf mpfad nmot rstpfad skapfad tans tmot tmotlin top_w ushk ushk2 usvk usvk2 vfzg /end IN_MEASUREMENT
 /begin OUT_MEASUREMENT bbno bbsp3 bbtim B_no B_sp3 B_tim dfcmFcm dfcmNo dfcmSfp dfpmEpclState dfpmMilState dfp_ap fcmcla_00_A fcmcla_01_A fcmcla_02_A fcmcla_03_A fcmcla_04_A fcmcla_05_A fcmcla_06_A fcmcla_07_A fcmcla_08_A fcmcla_09_A fcmcla_10_A fcmcla_11_A fcmcla_12_A fcmcla_13_A fcmcla_14_A fcmcla_15_A fcmcla_16_A fcmcla_17_A fcmcla_18_A fcmcla_19_A fcmdfp_00_A fcmdfp_01_A fcmdfp_02_A fcmdfp_03_A fcmdfp_04_A fcmdfp_05_A fcmdfp_06_A fcmdfp_07_A fcmdfp_08_A fcmdfp_09_A fcmdfp_10_A fcmdfp_11_A fcmdfp_12_A fcmdfp_13_A fcmdfp_14_A fcmdfp_15_A fcmdfp_16_A fcmdfp_17_A fcmdfp_18_A fcmdfp_19_A fcmdlc_00_A fcmdlc_01_A fcmdlc_02_A fcmdlc_03_A fcmdlc_04_A fcmdlc_05_A fcmdlc_06_A fcmdlc_07_A fcmdlc_08_A fcmdlc_09_A fcmdlc_10_A fcmdlc_11_A fcmdlc_12_A fcmdlc_13_A fcmdlc_14_A fcmdlc_15_A fcmdlc_16_A fcmdlc_17_A fcmdlc_18_A fcmdlc_19_A fcmEnd fcmfes_00_A fcmfes_01_A fcmfes_02_A fcmfes_03_A fcmfes_04_A fcmfes_05_A fcmfes_06_A fcmfes_07_A fcmfes_08_A fcmfes_09_A fcmfes_10_A fcmfes_11_A fcmfes_12_A fcmfes_13_A fcmfes_14_A fcmfes_15_A fcmfes_16_A fcmfes_17_A fcmfes_18_A fcmfes_19_A fcmflc_00_A fcmflc_01_A fcmflc_02_A fcmflc_03_A fcmflc_04_A fcmflc_05_A fcmflc_06_A fcmflc_07_A fcmflc_08_A fcmflc_09_A fcmflc_10_A fcmflc_11_A fcmflc_12_A fcmflc_13_A fcmflc_14_A fcmflc_15_A fcmflc_16_A fcmflc_17_A fcmflc_18_A fcmflc_19_A fcmfps_00_A fcmfps_01_A fcmfps_02_A fcmfps_03_A fcmfps_04_A fcmfps_05_A fcmfps_06_A fcmfps_07_A fcmfps_08_A fcmfps_09_A fcmfps_10_A fcmfps_11_A fcmfps_12_A fcmfps_13_A fcmfps_14_A fcmfps_15_A fcmfps_16_A fcmfps_17_A fcmfps_18_A fcmfps_19_A fcmfrz0_00_A fcmfrz0_01_A fcmfrz0_02_A fcmfrz0_03_A fcmfrz0_04_A fcmfrz0_05_A fcmfrz0_06_A fcmfrz0_07_A fcmfrz0_08_A fcmfrz0_09_A fcmfrz0_10_A fcmfrz0_11_A fcmfrz0_12_A fcmfrz0_13_A fcmfrz0_14_A fcmfrz0_15_A fcmfrz0_16_A fcmfrz0_17_A fcmfrz0_18_A fcmfrz0_19_A fcmfrz1_00_A fcmfrz1_01_A fcmfrz1_02_A fcmfrz1_03_A fcmfrz1_04_A fcmfrz1_05_A fcmfrz1_06_A fcmfrz1_07_A fcmfrz1_08_A fcmfrz1_09_A fcmfrz1_10_A fcmfrz1_11_A fcmfrz1_12_A fcmfrz1_13_A fcmfrz1_14_A fcmfrz1_15_A fcmfrz1_16_A fcmfrz1_17_A fcmfrz1_18_A fcmfrz1_19_A fcmfrz10_00_A fcmfrz10_01_A fcmfrz10_02_A fcmfrz10_03_A fcmfrz10_04_A fcmfrz10_05_A fcmfrz10_06_A fcmfrz10_07_A fcmfrz10_08_A fcmfrz10_09_A fcmfrz10_10_A fcmfrz10_11_A fcmfrz10_12_A fcmfrz10_13_A fcmfrz10_14_A fcmfrz10_15_A fcmfrz10_16_A fcmfrz10_17_A fcmfrz10_18_A fcmfrz10_19_A fcmfrz2_00_A fcmfrz2_01_A fcmfrz2_02_A fcmfrz2_03_A fcmfrz2_04_A fcmfrz2_05_A fcmfrz2_06_A fcmfrz2_07_A fcmfrz2_08_A fcmfrz2_09_A fcmfrz2_10_A fcmfrz2_11_A fcmfrz2_12_A fcmfrz2_13_A fcmfrz2_14_A fcmfrz2_15_A fcmfrz2_16_A fcmfrz2_17_A fcmfrz2_18_A fcmfrz2_19_A fcmfrz3_00_A fcmfrz3_01_A fcmfrz3_02_A fcmfrz3_03_A fcmfrz3_04_A fcmfrz3_05_A fcmfrz3_06_A fcmfrz3_07_A fcmfrz3_08_A fcmfrz3_09_A fcmfrz3_10_A fcmfrz3_11_A fcmfrz3_12_A fcmfrz3_13_A fcmfrz3_14_A fcmfrz3_15_A fcmfrz3_16_A fcmfrz3_17_A fcmfrz3_18_A fcmfrz3_19_A fcmfrz4_00_A fcmfrz4_01_A fcmfrz4_02_A fcmfrz4_03_A fcmfrz4_04_A fcmfrz4_05_A fcmfrz4_06_A fcmfrz4_07_A fcmfrz4_08_A fcmfrz4_09_A fcmfrz4_10_A fcmfrz4_11_A fcmfrz4_12_A fcmfrz4_13_A fcmfrz4_14_A fcmfrz4_15_A fcmfrz4_16_A fcmfrz4_17_A fcmfrz4_18_A fcmfrz4_19_A fcmfrz5_00_A fcmfrz5_01_A fcmfrz5_02_A fcmfrz5_03_A fcmfrz5_04_A fcmfrz5_05_A fcmfrz5_06_A fcmfrz5_07_A fcmfrz5_08_A fcmfrz5_09_A fcmfrz5_10_A fcmfrz5_11_A fcmfrz5_12_A fcmfrz5_13_A fcmfrz5_14_A fcmfrz5_15_A fcmfrz5_16_A fcmfrz5_17_A fcmfrz5_18_A fcmfrz5_19_A fcmfrz6_00_A fcmfrz6_01_A fcmfrz6_02_A fcmfrz6_03_A fcmfrz6_04_A fcmfrz6_05_A fcmfrz6_06_A fcmfrz6_07_A fcmfrz6_08_A fcmfrz6_09_A fcmfrz6_10_A fcmfrz6_11_A fcmfrz6_12_A fcmfrz6_13_A fcmfrz6_14_A fcmfrz6_15_A fcmfrz6_16_A fcmfrz6_17_A fcmfrz6_18_A fcmfrz6_19_A fcmfrz7_00_A fcmfrz7_01_A fcmfrz7_02_A fcmfrz7_03_A fcmfrz7_04_A fcmfrz7_05_A fcmfrz7_06_A fcmfrz7_07_A fcmfrz7_08_A fcmfrz7_09_A fcmfrz7_10_A fcmfrz7_11_A fcmfrz7_12_A fcmfrz7_13_A fcmfrz7_14_A fcmfrz7_15_A fcmfrz7_16_A fcmfrz7_17_A fcmfrz7_18_A fcmfrz7_19_A fcmfrz8_00_A fcmfrz8_01_A fcmfrz8_02_A fcmfrz8_03_A fcmfrz8_04_A fcmfrz8_05_A fcmfrz8_06_A fcmfrz8_07_A fcmfrz8_08_A fcmfrz8_09_A fcmfrz8_10_A fcmfrz8_11_A fcmfrz8_12_A fcmfrz8_13_A fcmfrz8_14_A fcmfrz8_15_A fcmfrz8_16_A fcmfrz8_17_A fcmfrz8_18_A fcmfrz8_19_A fcmfrz9_00_A fcmfrz9_01_A fcmfrz9_02_A fcmfrz9_03_A fcmfrz9_04_A fcmfrz9_05_A fcmfrz9_06_A fcmfrz9_07_A fcmfrz9_08_A fcmfrz9_09_A fcmfrz9_10_A fcmfrz9_11_A fcmfrz9_12_A fcmfrz9_13_A fcmfrz9_14_A fcmfrz9_15_A fcmfrz9_16_A fcmfrz9_17_A fcmfrz9_18_A fcmfrz9_19_A fcmhlc_00_A fcmhlc_01_A fcmhlc_02_A fcmhlc_03_A fcmhlc_04_A fcmhlc_05_A fcmhlc_06_A fcmhlc_07_A fcmhlc_08_A fcmhlc_09_A fcmhlc_10_A fcmhlc_11_A fcmhlc_12_A fcmhlc_13_A fcmhlc_14_A fcmhlc_15_A fcmhlc_16_A fcmhlc_17_A fcmhlc_18_A fcmhlc_19_A fcmhz_00_A fcmhz_01_A fcmhz_02_A fcmhz_03_A fcmhz_04_A fcmhz_05_A fcmhz_06_A fcmhz_07_A fcmhz_08_A fcmhz_09_A fcmhz_10_A fcmhz_11_A fcmhz_12_A fcmhz_13_A fcmhz_14_A fcmhz_15_A fcmhz_16_A fcmhz_17_A fcmhz_18_A fcmhz_19_A FCMTab fcmtsf_00_A fcmtsf_01_A fcmtsf_02_A fcmtsf_03_A fcmtsf_04_A fcmtsf_05_A fcmtsf_06_A fcmtsf_07_A fcmtsf_08_A fcmtsf_09_A fcmtsf_10_A fcmtsf_11_A fcmtsf_12_A fcmtsf_13_A fcmtsf_14_A fcmtsf_15_A fcmtsf_16_A fcmtsf_17_A fcmtsf_18_A fcmtsf_19_A fcmtyp_00_A fcmtyp_01_A fcmtyp_02_A fcmtyp_03_A fcmtyp_04_A fcmtyp_05_A fcmtyp_06_A fcmtyp_07_A fcmtyp_08_A fcmtyp_09_A fcmtyp_10_A fcmtyp_11_A fcmtyp_12_A fcmtyp_13_A fcmtyp_14_A fcmtyp_15_A fcmtyp_16_A fcmtyp_17_A fcmtyp_18_A fcmtyp_19_A /end OUT_MEASUREMENT
/end FUNCTION
/begin FUNCTION DFPMEEP "3.50" /begin REF_CHARACTERISTIC CWFLC /end REF_CHARACTERISTIC /begin IN_MEASUREMENT B_pwf dfcmNo fcmEnd FCMTab ffzdfp /end IN_MEASUREMENT /end FUNCTION
/begin FUNCTION DFPMNL "2.20" /begin REF_CHARACTERISTIC CWFLC /end REF_CHARACTERISTIC /begin IN_MEASUREMENT B_nlobd fcmEnd /end IN_MEASUREMENT /end FUNCTION
/begin FUNCTION DFPMOVF "2.10" /begin REF_CHARACTERISTIC CWFLC /end REF_CHARACTERISTIC /begin IN_MEASUREMENT fcmEnd /end IN_MEASUREMENT /end FUNCTION
/begin FUNCTION DFPMPWF "1.10" /begin IN_MEASUREMENT fcmEnd /end IN_MEASUREMENT /end FUNCTION
/begin FUNCTION DFPM_BGELSV ""
 /begin DEF_CHARACTERISTIC CDCLSV CDCLSV2 CDKLSV CDKLSV2 CDTLSV CDTLSV2 CLALSV CLALSV2 FFTLSV FFTLSV2 TSFLSV TSFLSV2 /end DEF_CHARACTERISTIC
 /begin OUT_MEASUREMENT B_belsv B_belsv2 B_bklsv B_bklsv2 B_cllsv B_cllsv2 B_ftlsv B_ftlsv2 B_mnlsv B_mnlsv2 B_mxlsv B_mxlsv2 B_nplsv B_nplsv2 B_silsv B_silsv2 E_lsv E_lsv2 sfplsv sfplsv2 TYP_lsv TYP_lsv2 Z_lsv Z_lsv2 /end OUT_MEASUREMENT
/end FUNCTION
/begin FUNCTION DFPM_BGRBS "" /begin DEF_CHARACTERISTIC CDCSWE CDKSWE CDTSWE CLASWE FFTSWE TSFSWE /end DEF_CHARACTERISTIC
 /begin OUT_MEASUREMENT B_beswe B_bkswe B_clswe B_ftswe B_mnswe B_mxswe B_npswe B_siswe E_swe sfpswe TYP_swe Z_swe /end OUT_MEASUREMENT
/end FUNCTION
/begin FUNCTION DFPM_BGTOL "" /begin DEF_CHARACTERISTIC CDCTOL CDKTOL CDTTOL CLATOL FFTTOL TSFTOL /end DEF_CHARACTERISTIC
 /begin OUT_MEASUREMENT B_avtol B_betol B_bktol B_cltol B_fttol B_mntol B_mxtol B_nptol B_pytol B_sctol B_sitol E_tol sfptol TYP_tol Z_tol /end OUT_MEASUREMENT
/end FUNCTION
/begin FUNCTION DFPM_BGTUMG "" /begin DEF_CHARACTERISTIC CDCTUM CDKTUM CDTTUM CLATUM FFTTUM TSFTUM /end DEF_CHARACTERISTIC
 /begin OUT_MEASUREMENT B_betum B_bktum B_cltum B_fttum B_mntum B_mxtum B_nptum B_situm E_tum sfptum TYP_tum Z_tum /end OUT_MEASUREMENT
/end FUNCTION
/begin FUNCTION DFPM_CAIR "" /begin DEF_CHARACTERISTIC CDCCAIR CDKCAIR CDTCAIR CLACAIR FFTCAIR TSFCAIR /end DEF_CHARACTERISTIC
 /begin OUT_MEASUREMENT B_avcair B_becair B_bkcair B_clcair B_ftcair B_mncair B_mxcair B_npcair B_pycair B_sccair B_sicair E_cair sfpcair TYP_cair Z_cair /end OUT_MEASUREMENT
/end FUNCTION
/begin FUNCTION DFPM_CALL "" /end FUNCTION
/begin FUNCTION DFPM_CAS "" /begin DEF_CHARACTERISTIC CDCCAS CDKCAS CDTCAS CLACAS FFTCAS TSFCAS /end DEF_CHARACTERISTIC
 /begin OUT_MEASUREMENT B_avcas B_becas B_bkcas B_clcas B_ftcas B_mncas B_mxcas B_npcas B_pycas B_sccas B_sicas E_cas sfpcas TYP_cas Z_cas /end OUT_MEASUREMENT
/end FUNCTION
/begin FUNCTION DFPM_CAT "" /begin DEF_CHARACTERISTIC CDCCAT CDKCAT CDTCAT CLACAT FFTCAT TSFCAT /end DEF_CHARACTERISTIC
 /begin OUT_MEASUREMENT B_avcat B_becat B_bkcat B_clcat B_ftcat B_mncat B_mxcat B_npcat B_pycat B_sccat B_sicat E_cat sfpcat TYP_cat Z_cat /end OUT_MEASUREMENT
/end FUNCTION
/begin FUNCTION DFPM_CBEM "" /end FUNCTION
/begin FUNCTION DFPM_CBR2 "" /begin DEF_CHARACTERISTIC CDCCBR2 CDKCBR2 CDTCBR2 CLACBR2 FFTCBR2 TSFCBR2 /end DEF_CHARACTERISTIC
 /begin OUT_MEASUREMENT B_avcbr2 B_becbr2 B_bkcbr2 B_clcbr2 B_ftcbr2 B_mncbr2 B_mxcbr2 B_npcbr2 B_pycbr2 B_sccbr2 B_sicbr2 E_cbr2 sfpcbr2 TYP_cbr2 Z_cbr2 /end OUT_MEASUREMENT
/end FUNCTION
/begin FUNCTION DFPM_CBR8 "" /end FUNCTION
/begin FUNCTION DFPM_CBSG "" /begin DEF_CHARACTERISTIC CDCCBSG CDKCBSG CDTCBSG CLACBSG FFTCBSG TSFCBSG /end DEF_CHARACTERISTIC
 /begin OUT_MEASUREMENT B_avcbsg B_becbsg B_bkcbsg B_clcbsg B_ftcbsg B_mncbsg B_mxcbsg B_npcbsg B_pycbsg B_sccbsg B_sicbsg E_cbsg sfpcbsg TYP_cbsg Z_cbsg /end OUT_MEASUREMENT
/end FUNCTION
/begin FUNCTION DFPM_CDIA1 "" /end FUNCTION
/begin FUNCTION DFPM_CGAT "" /begin DEF_CHARACTERISTIC CDCCGAT CDKCGAT CDTCGAT CLACGAT FFTCGAT TSFCGAT /end DEF_CHARACTERISTIC
 /begin OUT_MEASUREMENT B_avcgat B_becgat B_bkcgat B_clcgat B_ftcgat B_mncgat B_mxcgat B_npcgat B_pycgat B_sccgat B_sicgat E_cgat sfpcgat TYP_cgat Z_cgat /end OUT_MEASUREMENT
/end FUNCTION
/begin FUNCTION DFPM_CGRA "" /begin DEF_CHARACTERISTIC CDCCGRA CDKCGRA CDTCGRA CLACGRA FFTCGRA TSFCGRA /end DEF_CHARACTERISTIC
 /begin OUT_MEASUREMENT B_avcgra B_becgra B_bkcgra B_clcgra B_ftcgra B_mncgra B_mxcgra B_npcgra B_pycgra B_sccgra B_sicgra E_cgra sfpcgra TYP_cgra Z_cgra /end OUT_MEASUREMENT
/end FUNCTION
/begin COMPU_METHOD acc_q0p01o1p27g "" RAT_FUNC "%6.3" "g" COEFFS 0 100 127 0 0 1 /end COMPU_METHOD
/begin COMPU_METHOD acc_sw_q3p91em4 "" RAT_FUNC "%6.5" "m/s^2" COEFFS 0 32768 0 0 0 12.8 /end COMPU_METHOD
/begin COMPU_METHOD B_TRUE "" TAB_VERB "%6.3" "" COMPU_TAB_REF B_TRUE /end COMPU_METHOD
/begin COMPU_VTAB B_TRUE "" TAB_VERB 2 0 "----" 1 "TRUE" /end COMPU_VTAB
/begin COMPU_METHOD DEZ "" RAT_FUNC "%6.2" "" COEFFS 0 1 0 0 0 1 /end COMPU_METHOD
/begin COMPU_METHOD dez "" RAT_FUNC "%6.2" "" COEFFS 0 1 0 0 0 1 /end COMPU_METHOD
/begin COMPU_METHOD dfp_verbal "" TAB_VERB "%6.3" "" COMPU_TAB_REF dfp_verbal /end COMPU_METHOD
/begin COMPU_VTAB dfp_verbal "" TAB_VERB 193 0 "DFP_AAA" 1 "DFP_AATUN" 2 "DFP_AKRE" 3 "DFP_ANWS" 4 "DFP_ANWSE" 5 "DFP_ASGNPL" 6 "DFP_BKVP" 7 "DFP_BKVPE" 8 "DFP_BM" 9 "DFP_BREMS" 10 "DFP_BZNPL" 11 "DFP_CAIR" 12 "DFP_CAIRP" 13 "DFP_CAS" 14 "DFP_CAT" 15 "DFP_CBR2" 16 "DFP_CBSG" 17 "DFP_CGAT" 18 "DFP_CGE" 19 "DFP_CGRA" 20 "DFP_CIF" 21 "DFP_CINS" 22 "DFP_CKLA" 23 "DFP_CLWS" 24 "DFP_CTOG" 25 "DFP_CZAS" 26 "DFP_DK" 27 "DFP_DK1P" 28 "DFP_DK2P" 29 "DFP_DPL" 30 "DFP_DSBKV" 31 "DFP_DSU" 32 "DFP_DVEE" 33 "DFP_DVEF" 34 "DFP_DVEFO" 35 "DFP_DVEL" 36 "DFP_DVEN" 37 "DFP_DVER" 38 "DFP_DVET" 39 "DFP_DVEU" 40 "DFP_DVEUB" 41 "DFP_DVEUW" 42 "DFP_DVEV" 43 "DFP_DYLSU" 44 "DFP_DYLSU2" 45 "DFP_EGFE" 46 "DFP_EGSBGR" 47 "DFP_ENWS" 48 "DFP_ENWSE" 49 "DFP_EPCLE" 50 "DFP_EV1" 51 "DFP_EV2" 52 "DFP_EV3" 53 "DFP_EV4" 54 "DFP_EV5" 55 "DFP_EV6" 56 "DFP_FKU" 57 "DFP_FP1P" 58 "DFP_FP2P" 59 "DFP_FRAO" 60 "DFP_FRAO2" 61 "DFP_FRAU" 62 "DFP_FRAU2" 63 "DFP_FRST" 64 "DFP_FRST2" 65 "DFP_GECOD" 66 "DFP_GRBH" 67 "DFP_HELSU" 68 "DFP_HELSU2" 69 "DFP_HRE" 70 "DFP_HSH" 71 "DFP_HSH2" 72 "DFP_HSHE" 73 "DFP_HSHE2" 74 "DFP_HSV" 75 "DFP_HSV2" 76 "DFP_HSVE" 77 "DFP_HSVE2" 78 "DFP_ICLSU" 79 "DFP_ICLSU2" 80 "DFP_KAT" 81 "DFP_KAT2" 82 "DFP_KPE" 83 "DFP_KRA01" 84 "DFP_KRA02" 85 "DFP_KRA03" 86 "DFP_KRA04" 87 "DFP_KRA05" 88 "DFP_KRA06" 89 "DFP_KRNT" 90 "DFP_KROF" 91 "DFP_KRTP" 92 "DFP_KS1" 93 "DFP_KS2" 94 "DFP_KS3" 95 "DFP_KS4" 96 "DFP_KUPPL" 97 "DFP_LASH" 98 "DFP_LASH2" 99 "DFP_LAVH" 100 "DFP_LAVH2" 101 "DFP_LDPE" 102 "DFP_LLR" 103 "DFP_LM" 104 "DFP_LSH" 105 "DFP_LSH2" 106 "DFP_LSHV" 107 "DFP_LSUIA" 108 "DFP_LSUIA2" 109 "DFP_LSUIP" 110 "DFP_LSUIP2" 111 "DFP_LSUKS" 112 "DFP_LSUKS2" 113 "DFP_LSUUN" 114 "DFP_LSUUN2" 115 "DFP_LSUVM" 116 "DFP_LSUVM2" 117 "DFP_LSV" 118 "DFP_LSV2" 119 "DFP_LSVV" 120 "DFP_LUE1" 121 "DFP_LUES1E" 122 "DFP_MA" 123 "DFP_MD" 124 "DFP_MD00" 125 "DFP_MD01" 126 "DFP_MD02" 127 "DFP_MD03" 128 "DFP_MD04" 129 "DFP_MD05" 130 "DFP_MDB" 131 "DFP_MFA" 132 "DFP_N" 133 "DFP_NWKW" 134 "DFP_NWKW2" 135 "DFP_NX" 136 "DFP_PH" 137 "DFP_PH2" 138 "DFP_PLLSU" 139 "DFP_PLLSU2" 140 "DFP_PWGDE" 141 "DFP_RKAT" 142 "DFP_RKAT2" 143 "DFP_RKAZ" 144 "DFP_RKAZ2" 145 "DFP_SCR" 146 "DFP_SGEEP" 147 "DFP_SGEEW" 148 "DFP_SLPE" 149 "DFP_SLS" 150 "DFP_SLS2" 151 "DFP_SLV" 152 "DFP_SLV2" 153 "DFP_SLVE" 154 "DFP_SUE" 155 "DFP_SWE" 156 "DFP_TA" 157 "DFP_TANKL" 158 "DFP_TES" 159 "DFP_TESF" 160 "DFP_TESG" 161 "DFP_TEVE" 162 "DFP_TEVE2" 163 "DFP_TKA" 164 "DFP_TM" 165 "DFP_TMKI" 166 "DFP_TOL" 167 "DFP_TUM" 168 "DFP_UB" 169 "DFP_UBR" 170 "DFP_UFMV" 171 "DFP_UFNC" 172 "DFP_UFRLIP" 173 "DFP_UFSGA" 174 "DFP_UFSGB" 175 "DFP_UFSKA" 176 "DFP_UFSPSC" 177 "DFP_ULSU" 178 "DFP_ULSU2" 179 "DFP_URRAM" 180 "DFP_URROM" 181 "DFP_URRST" 182 "DFP_VFZ" 183 "DFP_WFS" 184 "DFP_WFSRC" 185 "DFP_ZET1" 186 "DFP_ZET2" 187 "DFP_ZET3" 188 "DFP_ZET4" 189 "DFP_ZET5" 190 "DFP_ZET6" 191 "DFP_ZWPE" 192 "DFP_ZZZ" /end COMPU_VTAB
/begin COMPU_METHOD dlw_sw_q0p04375 "" RAT_FUNC "%6.4" "°/s" COEFFS 0 32767 0 0 0 1434 /end COMPU_METHOD
/begin COMPU_METHOD fak_q0p000244 "" RAT_FUNC "%6.5" "-" COEFFS 0 65536 0 0 0 16 /end COMPU_METHOD
/begin COMPU_METHOD fak_q0p1 "" RAT_FUNC "%6.3" "-" COEFFS 0 1 0 0 0 0.1 /end COMPU_METHOD
/begin COMPU_METHOD fak_q2p0em8 "" RAT_FUNC "%10.9" "-" COEFFS 0 1 0 0 0 2e-008 /end COMPU_METHOD
/begin COMPU_METHOD fak_sb_b64 "" RAT_FUNC "%6.3" "-" COEFFS 0 256 0 0 0 128 /end COMPU_METHOD
/begin COMPU_METHOD fak_sw_b1 "" RAT_FUNC "%7.6" "-" COEFFS 0 65536 0 0 0 2 /end COMPU_METHOD
/begin COMPU_METHOD fak_ub_b16 "" RAT_FUNC "%6.4" "-" COEFFS 0 256 0 0 0 16 /end COMPU_METHOD
/begin COMPU_METHOD fak_ub_b2 "" RAT_FUNC "%6.4" "-" COEFFS 0 256 0 0 0 2 /end COMPU_METHOD
/begin COMPU_METHOD fak_ub_b8 "" RAT_FUNC "%6.4" "-" COEFFS 0 256 0 0 0 8 /end COMPU_METHOD
/begin COMPU_METHOD fak_ub_q0p001Lpromm "" RAT_FUNC "%6.5" "L/mm" COEFFS 0 1 0 0 0 0.001 /end COMPU_METHOD
/begin COMPU_METHOD fak_ub_q0p02 "" RAT_FUNC "%6.4" "-" COEFFS 0 1 0 0 0 0.02 /end COMPU_METHOD
/begin COMPU_METHOD fak_ub_q0p05 "" RAT_FUNC "%6.4" "1" COEFFS 0 256 0 0 0 12.8 /end COMPU_METHOD
/begin COMPU_METHOD fak_ub_q500 "" RAT_FUNC "%6.0" "-" COEFFS 0 1 0 0 0 500 /end COMPU_METHOD
/begin COMPU_METHOD fak_uw_b1 "" RAT_FUNC "%7.6" "-" COEFFS 0 65536 0 0 0 1 /end COMPU_METHOD
/begin COMPU_METHOD fak_uw_b16 "" RAT_FUNC "%6.5" "-" COEFFS 0 65536 0 0 0 16 /end COMPU_METHOD
/begin COMPU_METHOD fak_uw_b2 "" RAT_FUNC "%7.6" "-" COEFFS 0 65536 0 0 0 2 /end COMPU_METHOD
/begin COMPU_METHOD fak_uw_b4 "" RAT_FUNC "%7.6" "-" COEFFS 0 65536 0 0 0 4 /end COMPU_METHOD
/begin COMPU_METHOD fak_uw_b4_no1 "" RAT_FUNC "%6.3" "-" COEFFS 0 65536 65536 0 0 4 /end COMPU_METHOD
/begin COMPU_METHOD fak_uw_b5p12 "" RAT_FUNC "%7.6" "" COEFFS 0 65536 0 0 0 5.12 /end COMPU_METHOD
/begin COMPU_METHOD lw_sw_q0p04375 "" RAT_FUNC "%6.4" "°" COEFFS 0 32767 0 0 0 1434 /end COMPU_METHOD
/begin COMPU_METHOD md_q0p25 "" RAT_FUNC "%6.3" "Nm" COEFFS 0 65536 0 0 0 16384 /end COMPU_METHOD
/begin COMPU_METHOD md_ub_q10 "" RAT_FUNC "%6.1" "Nm" COEFFS 0 1 0 0 0 10 /end COMPU_METHOD
/begin COMPU_METHOD nmot_ub_q10 "" RAT_FUNC "%6.1" "1/min" COEFFS 0 1 0 0 0 10 /end COMPU_METHOD
/begin COMPU_METHOD nmot_ub_q25 "" RAT_FUNC "%6.1" "Upm" COEFFS 0 1 0 0 0 25 /end COMPU_METHOD
/begin COMPU_METHOD nmot_ub_q40 "" RAT_FUNC "%6.1" "1/min" COEFFS 0 1 0 0 0 40 /end COMPU_METHOD
/begin COMPU_METHOD nmot_uw_q0p25 "" RAT_FUNC "%6.3" "1/min" COEFFS 0 1 0 0 0 0.25 /end COMPU_METHOD
/begin COMPU_METHOD p_q0p2 "" RAT_FUNC "%6.3" "bar" COEFFS 0 5 0 0 0 1 /end COMPU_METHOD
/begin COMPU_METHOD p_uw_q0p039 "" RAT_FUNC "%6.4" "hPa" COEFFS 0 256 0 0 0 10 /end COMPU_METHOD
/begin COMPU_METHOD rel_q0p39 "" RAT_FUNC "%6.3" "%" COEFFS 0 256 0 0 0 100 /end COMPU_METHOD
/begin COMPU_METHOD rel_q0p4 "" RAT_FUNC "%6.3" "%" COEFFS 0 1 0 0 0 0.4 /end COMPU_METHOD
/begin COMPU_METHOD rel_ub_b100 "" RAT_FUNC "%6.3" "%" COEFFS 0 256 0 0 0 100 /end COMPU_METHOD
/begin COMPU_METHOD rel_ub_b99p6 "" RAT_FUNC "%6.3" "%" COEFFS 0 256 0 0 0 100 /end COMPU_METHOD
/begin COMPU_METHOD rel_uw_b100 "" RAT_FUNC "%6.4" "%" COEFFS 0 65536 0 0 0 100 /end COMPU_METHOD
/begin COMPU_METHOD rel_uw_q0p0234 "" RAT_FUNC "%6.4" "%" COEFFS 0 32 0 0 0 0.75 /end COMPU_METHOD
/begin COMPU_METHOD r_q10 "" RAT_FUNC "%6.1" "Ohm" COEFFS 0 1 0 0 0 10 /end COMPU_METHOD
/begin COMPU_METHOD r_ub_q64 "" RAT_FUNC "%6.1" "Ohm" COEFFS 0 1 0 0 0 64 /end COMPU_METHOD
/begin COMPU_METHOD spg_ubatt "" RAT_FUNC "%6.4" "V" COEFFS 0 1 0 0 0 0.0704 /end COMPU_METHOD
/begin COMPU_METHOD spg_ub_b5 "" RAT_FUNC "%6.4" "V" COEFFS 0 256 0 0 0 5 /end COMPU_METHOD
/begin COMPU_METHOD spg_uw_q0p00488 "" RAT_FUNC "%6.4" "V" COEFFS 0 1024 0 0 0 5 /end COMPU_METHOD
/begin COMPU_METHOD s_q1_km "" RAT_FUNC "%6.2" "km" COEFFS 0 1 0 0 0 1 /end COMPU_METHOD
/begin COMPU_METHOD s_q63p75mm "" RAT_FUNC "%6.3" "mm" COEFFS 0 1 0 0 0 0.25 /end COMPU_METHOD
/begin COMPU_METHOD s_q6_km "" RAT_FUNC "%6.2" "km" COEFFS 0 1 0 0 0 6 /end COMPU_METHOD
/begin COMPU_METHOD s_ub_q1000km "" RAT_FUNC "%7.0" "km" COEFFS 0 1 0 0 0 1000 /end COMPU_METHOD
/begin COMPU_METHOD s_ub_q25km "" RAT_FUNC "%6.1" "km" COEFFS 0 1 0 0 0 25 /end COMPU_METHOD
/begin COMPU_METHOD s_ub_q6p25km "" RAT_FUNC "%6.2" "km" COEFFS 0 4 0 0 0 25 /end COMPU_METHOD
/begin COMPU_METHOD s_uw_q62p5mm "" RAT_FUNC "%6.4" "mm" COEFFS 0 16 0 0 0 1 /end COMPU_METHOD
/begin COMPU_METHOD s_uw_q62p5um "" RAT_FUNC "%6.4" "mm" COEFFS 0 16 0 0 0 1 /end COMPU_METHOD
/begin COMPU_METHOD t100msxs_ub_b25p5 "" RAT_FUNC "%6.3" "s" COEFFS 0 1 0 0 0 0.1 /end COMPU_METHOD
/begin COMPU_METHOD t100msxs_uw_b6553p5 "" RAT_FUNC "%6.3" "s" COEFFS 0 1 0 0 0 0.1 /end COMPU_METHOD
/begin COMPU_METHOD t100msxs_uw_b6553p6 "" RAT_FUNC "%6.3" "s" COEFFS 0 10 0 0 0 1 /end COMPU_METHOD
/begin COMPU_METHOD t10msxs_ub_b2p55 "" RAT_FUNC "%6.4" "s" COEFFS 0 1 0 0 0 0.01 /end COMPU_METHOD
/begin COMPU_METHOD t10msxs_uw_b655p35 "" RAT_FUNC "%6.4" "s" COEFFS 0 1 0 0 0 0.01 /end COMPU_METHOD
/begin COMPU_METHOD t1sxs_ub_b255 "" RAT_FUNC "%6.2" "s" COEFFS 0 1 0 0 0 1 /end COMPU_METHOD
/begin COMPU_METHOD t1sxs_uw_b65535 "" RAT_FUNC "%6.2" "s" COEFFS 0 1 0 0 0 1 /end COMPU_METHOD
/begin COMPU_METHOD t200msxs_ub_b51 "" RAT_FUNC "%6.3" "s" COEFFS 0 1 0 0 0 0.2 /end COMPU_METHOD
/begin COMPU_METHOD t200msxs_uw_q0p2 "" RAT_FUNC "%6.3" "s" COEFFS 0 1 0 0 0 0.2 /end COMPU_METHOD
/begin COMPU_METHOD t20msxs_ub_b5p1 "" RAT_FUNC "%6.4" "s" COEFFS 0 1 0 0 0 0.02 /end COMPU_METHOD
/begin COMPU_METHOD t500msxs_q0p125 "" RAT_FUNC "%6.3" "" COEFFS 0 1 0 0 0 0.125 /end COMPU_METHOD
/begin COMPU_METHOD t500msxs_ub_b127p5 "" RAT_FUNC "%6.3" "s" COEFFS 0 1 0 0 0 0.5 /end COMPU_METHOD
/begin COMPU_METHOD temp_ub_q0p75_o48 "" RAT_FUNC "%6.2" "Grad C" COEFFS 0 1 48 0 0 0.75 /end COMPU_METHOD
/begin COMPU_METHOD temp_ub_q1_o40 "" RAT_FUNC "%6.2" "Grad C" COEFFS 0 1 40 0 0 1 /end COMPU_METHOD
/begin COMPU_METHOD temp_ub_q1_o60 "" RAT_FUNC "%6.2" "Grad C" COEFFS 0 1 60 0 0 1 /end COMPU_METHOD
/begin COMPU_METHOD t_500msxs_q0p5no100 "" RAT_FUNC "%6.1" "" COEFFS 0 1 -100 0 0 0.5 /end COMPU_METHOD
/begin COMPU_METHOD t_q0p01 "" RAT_FUNC "%6.4" "s" COEFFS 0 100 0 0 0 1 /end COMPU_METHOD
/begin COMPU_METHOD t_q0p5o100ms "" RAT_FUNC "%6.1" "ms" COEFFS 0 1 -100 0 0 0.5 /end COMPU_METHOD
/begin COMPU_METHOD t_q20_ms "" RAT_FUNC "%6.1" "ms" COEFFS 0 1 0 0 0 20 /end COMPU_METHOD
/begin COMPU_METHOD t_q4_s "" RAT_FUNC "%6.2" "s" COEFFS 0 1 0 0 0 4 /end COMPU_METHOD
/begin COMPU_METHOD t_ub_q1month "" RAT_FUNC "%6.2" "month" COEFFS 0 1 0 0 0 1 /end COMPU_METHOD
/begin COMPU_METHOD uefktget_ub_b25p4 "" RAT_FUNC "%6.3" "" COEFFS 0 10 0 0 0 1 /end COMPU_METHOD
/begin COMPU_METHOD vfzgkb_uw_b655 "" RAT_FUNC "%6.4" "km/h" COEFFS 0 65536 0 0 0 655 /end COMPU_METHOD
/begin COMPU_METHOD vfzg_q1p0 "" RAT_FUNC "%6.2" "km/h" COEFFS 0 1 0 0 0 1 /end COMPU_METHOD
/begin COMPU_METHOD vfzg_ub_q1p25 "" RAT_FUNC "%6.2" "km/h" COEFFS 0 1 0 0 0 1.25 /end COMPU_METHOD
/begin COMPU_METHOD vfzg_uw_q0p01 "" RAT_FUNC "%6.4" "km/h" COEFFS 0 100 0 0 0 1 /end COMPU_METHOD
/begin COMPU_METHOD volgrd_q0p001 "" RAT_FUNC "%6.5" "L/mm" COEFFS 0 1 0 0 0 0.001 /end COMPU_METHOD
/begin COMPU_METHOD vol_q0p125ml "" RAT_FUNC "%6.3" "ml" COEFFS 0 8 0 0 0 1 /end COMPU_METHOD
/begin COMPU_METHOD vol_q1024mm3 "" RAT_FUNC "%7.0" "uL" COEFFS 0 1 0 0 0 1024 /end COMPU_METHOD
/begin COMPU_METHOD vol_q1_l "" RAT_FUNC "%6.2" "l" COEFFS 0 1 0 0 0 1 /end COMPU_METHOD
/begin COMPU_METHOD vol_q62p5ul "" RAT_FUNC "%6.4" "ml" COEFFS 0 16 0 0 0 1 /end COMPU_METHOD
/begin COMPU_METHOD vol_sw_q0p25 "" RAT_FUNC "%6.3" "ml" COEFFS 0 4 0 0 0 1 /end COMPU_METHOD
/begin COMPU_METHOD vol_sw_q2ml "" RAT_FUNC "%6.2" "ml" COEFFS 0 1 0 0 0 2 /end COMPU_METHOD
/begin COMPU_METHOD vol_ub_q10ml "" RAT_FUNC "%6.1" "ml" COEFFS 0 1 0 0 0 10 /end COMPU_METHOD
/begin COMPU_METHOD vol_ub_q15_o1905ml "" RAT_FUNC "%6.5" "ml" COEFFS 0 1 1905 0 0 15 /end COMPU_METHOD
/begin COMPU_METHOD vol_uw_b5120_LproZyl "" RAT_FUNC "%6.4" "L/Zyl" COEFFS 0 128 0 0 0 10 /end COMPU_METHOD
/begin COMPU_METHOD vol_uw_q0p5mm3 "" RAT_FUNC "%6.3" "ul" COEFFS 0 2 0 0 0 1 /end COMPU_METHOD
/begin COMPU_METHOD vol_uw_q1mm3 "" RAT_FUNC "%6.2" "ul" COEFFS 0 1 0 0 0 1 /end COMPU_METHOD
/begin COMPU_METHOD vol_uw_q64mm3 "" RAT_FUNC "%6.1" "ul" COEFFS 0 1 0 0 0 64 /end COMPU_METHOD
/begin COMPU_METHOD vol_uw_q8mm3 "" RAT_FUNC "%6.2" "ul" COEFFS 0 1 0 0 0 8 /end COMPU_METHOD
/begin COMPU_METHOD vrad_uw_b655 "" RAT_FUNC "%6.4" "km/h" COEFFS 0 65536 0 0 0 655 /end COMPU_METHOD
/begin COMPU_METHOD zk100msxs_ub_b25p5 "" RAT_FUNC "%6.3" "s" COEFFS 0 0 256 0 10 0 /end COMPU_METHOD
/begin COMPU_METHOD zk10msxs_uw_b655 "" RAT_FUNC "%6.2" "s" COEFFS 0 0 65536 0 100 0 /end COMPU_METHOD
/begin COMPU_METHOD zk1sxs_uw_b65535 "" RAT_FUNC "%6.0" "s" COEFFS 0 0 65535 0 1 0 /end COMPU_METHOD
/begin COMPU_METHOD default "" RAT_FUNC "%6.2" "" COEFFS 0 1 0 0 0 1 /end COMPU_METHOD
/begin RECORD_LAYOUT KfAxUbAyUbSstxSwSstyUwWUw NO_AXIS_PTS_X 1 UWORD NO_AXIS_PTS_Y 2 UWORD AXIS_PTS_X 3 SWORD INDEX_INCR DIRECT AXIS_PTS_Y 4 UWORD INDEX_INCR DIRECT FNC_VALUES 5 UWORD COLUMN_DIR DIRECT /end RECORD_LAYOUT
/begin RECORD_LAYOUT KfAxUbAyUbSstxUbSstyUbWUb NO_AXIS_PTS_X 1 UBYTE NO_AXIS_PTS_Y 2 UBYTE AXIS_PTS_X 3 UBYTE INDEX_INCR DIRECT AXIS_PTS_Y 4 UBYTE INDEX_INCR DIRECT FNC_VALUES 5 UBYTE COLUMN_DIR DIRECT /end RECORD_LAYOUT
/begin RECORD_LAYOUT KfAxUbAyUbSstxUbSstyUwWUw NO_AXIS_PTS_X 1 UBYTE NO_AXIS_PTS_Y 2 UBYTE AXIS_PTS_X 3 UBYTE INDEX_INCR DIRECT AXIS_PTS_Y 4 UWORD INDEX_INCR DIRECT FNC_VALUES 5 UWORD COLUMN_DIR DIRECT /end RECORD_LAYOUT
/begin RECORD_LAYOUT KlAUbSstUbWUb NO_AXIS_PTS_X 1 UBYTE AXIS_PTS_X 2 UBYTE INDEX_INCR DIRECT FNC_VALUES 3 UBYTE COLUMN_DIR DIRECT /end RECORD_LAYOUT
/begin RECORD_LAYOUT KlAUbSstUwWUw NO_AXIS_PTS_X 1 UWORD AXIS_PTS_X 2 UWORD INDEX_INCR DIRECT FNC_VALUES 3 UWORD COLUMN_DIR DIRECT /end RECORD_LAYOUT
/begin RECORD_LAYOUT KlAUwSstUwWUb NO_AXIS_PTS_X 1 UWORD AXIS_PTS_X 2 UWORD INDEX_INCR DIRECT FNC_VALUES 3 UBYTE COLUMN_DIR DIRECT /end RECORD_LAYOUT
/begin RECORD_LAYOUT KlAUwSstUwWUw NO_AXIS_PTS_X 1 UWORD AXIS_PTS_X 2 UWORD INDEX_INCR DIRECT FNC_VALUES 3 UWORD COLUMN_DIR DIRECT /end RECORD_LAYOUT
/begin RECORD_LAYOUT KwbUb FNC_VALUES 1 UBYTE COLUMN_DIR DIRECT /end RECORD_LAYOUT
/begin RECORD_LAYOUT KwbUw FNC_VALUES 1 UWORD COLUMN_DIR DIRECT /end RECORD_LAYOUT
/begin RECORD_LAYOUT KwSb FNC_VALUES 1 SBYTE COLUMN_DIR DIRECT /end RECORD_LAYOUT
/begin RECORD_LAYOUT KwSw FNC_VALUES 1 SWORD COLUMN_DIR DIRECT /end RECORD_LAYOUT
/begin RECORD_LAYOUT KwUb FNC_VALUES 1 UBYTE COLUMN_DIR DIRECT /end RECORD_LAYOUT
/begin RECORD_LAYOUT KwUw FNC_VALUES 1 UWORD COLUMN_DIR DIRECT /end RECORD_LAYOUT
/end MODULE
/end PROJECT
