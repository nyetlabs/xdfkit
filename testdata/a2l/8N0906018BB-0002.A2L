ASAP2_VERSION 1 3
/begin PROJECT X505R_24d1_0 "4019.XX"
/begin HEADER "" VERSION "X505R_24d1_0" PROJECT_NO X505R_24d1_0 /end HEADER
/begin MODULE DIM ""
/begin MOD_COMMON "" BYTE_ORDER MSB_LAST ALIGNMENT_BYTE 1 ALIGNMENT_WORD 2 ALIGNMENT_LONG 2 /end MOD_COMMON
/begin CHARACTERISTIC ANRZUEMX "Zündungszähler-Schwelle bis zu der STADAP aktiv" VALUE 0x810E3A KwUb 255.0 dez 0.00 255.0 FORMAT "%5.1" /end CHARACTERISTIC
/begin CHARACTERISTIC AUFW100M "Zusaetzlich Testverzoegerung fuer 100ms-Task" VALUE 0x81FBD2 KwUw 1310700. t20usxus_q20 0.00 1310700. FORMAT "%8.0" /end CHARACTERISTIC
/begin CHARACTERISTIC AUFW10MS "Zusaetzlich Testverzoegerung fuer 10ms-Task" VALUE 0x8117D7 KwUb 5100. t20usxus_q20 0.00 5100. FORMAT "%5.0" /end CHARACTERISTIC
/begin CHARACTERISTIC AUFW20MS "Zusaetzlich Testverzoegerung fuer 20ms-Task" VALUE 0x816B26 KwUw 1310700. t20usxus_q20 0.00 1310700. FORMAT "%8.0" /end CHARACTERISTIC
/begin CHARACTERISTIC AUFWSYNC "Zusaetzlich Testverzoegerung fuer Synchro-Task" VALUE 0x8117D8 KwUb 5100. t20usxus_q20 0.00 5100. FORMAT "%5.0" /end CHARACTERISTIC
/begin CHARACTERISTIC CDAGR "Codewort DAGR abschalten (EURO-Codierung), CD..=0 -> keine Diagnose" VALUE 0x818194 KwUb 255.0 dez 0.00 255.0 FORMAT "%5.1" /end CHARACTERISTIC
/begin CHARACTERISTIC CDAGRL "Codewort Diagnose Lagesensor abschalten (EURO-Codierung), CD..=0 -> keine Diag." VALUE 0x818195 KwUb 255.0 dez 0.00 255.0 FORMAT "%5.1" /end CHARACTERISTIC
/begin CHARACTERISTIC CDATR "Konfigurationsbyte Diagnose Abgastemperaturregelung" VALUE 0x818196 KwUb 255.0 dez 0.00 255.0 FORMAT "%5.1" /end CHARACTERISTIC
/begin CHARACTERISTIC CDATS "Konfigurationsbyte Diagnose Abgastemperatursensor" VALUE 0x818197 KwUb 255.0 dez 0.00 255.0 FORMAT "%5.1" /end CHARACTERISTIC
/begin CHARACTERISTIC CDBKVP "Codewort zur Freigabe der Diagnose Bremskraftverstärker-Pumpe DBKVP" VALUE 0x818198 KwUb 255.0 dez 0.00 255.0 FORMAT "%5.1" /end CHARACTERISTIC
/begin CHARACTERISTIC CDDSBKV "Codewort für %DDSBKV" VALUE 0x818199 KwUb 255.0 dez 0.00 255.0 FORMAT "%5.1" /end CHARACTERISTIC
/begin CHARACTERISTIC CDDST "Codewort Tankdrucksensor-Diagnose abschalten (EURO-Codierung)" VALUE 0x81819A KwUb 255.0 dez 0.00 255.0 FORMAT "%5.1" /end CHARACTERISTIC
/begin CHARACTERISTIC CDEGFE "Codewort Diagnose Eingangsgrößen Füllungserfassung" VALUE 0x81819B KwUb 255.0 dez 0.00 255.0 FORMAT "%5.1" /end CHARACTERISTIC
/begin CHARACTERISTIC CDEHFM "Codewort zum Aktivieren der %DHFM" VALUE 0x81819C KwUb 255.0 dez 0.00 255.0 FORMAT "%5.1" /end CHARACTERISTIC
/begin CHARACTERISTIC CDGGGTS "Codewort GGGTS (Kühlwassertemperatur über Kombi)" VALUE 0x81819D KwUb 255.0 dez 0.00 255.0 FORMAT "%5.1" /end CHARACTERISTIC
/begin CHARACTERISTIC CDHSH "Codewort Heizerdiagnose hinter Kat (CDHSH = 0  => keine Diagnose)" VALUE 0x81819E KwUb 255.0 dez 0.00 255.0 FORMAT "%5.1" /end CHARACTERISTIC
/begin CHARACTERISTIC CDHSHE "Eurobit für Diagnose Entstufe Lambdasondenheizung hinter Kat" VALUE 0x81819F KwUb 255.0 dez 0.00 255.0 FORMAT "%5.1" /end CHARACTERISTIC
/begin CHARACTERISTIC CDHSV "Codewort Heizerdiagnose vor Kat im (CDHSV = 0  => keine Diagnose)" VALUE 0x8181A0 KwUb 255.0 dez 0.00 255.0 FORMAT "%5.1" /end CHARACTERISTIC
/begin CHARACTERISTIC CDHSVE "Codewort DHLSE Heizer Endstufe diagnose vor Kat" VALUE 0x8181A1 KwUb 255.0 dez 0.00 255.0 FORMAT "%5.1" /end CHARACTERISTIC
/begin CHARACTERISTIC CDHSVSA "Codewort Heizerdiagnose vor Kat im Schub (CDHSVsa = 0  => keine Diagnose)" VALUE 0x8181A2 KwUb 255.0 dez 0.00 255.0 FORMAT "%5.1" /end CHARACTERISTIC
/begin CHARACTERISTIC CDKAT "Codewort Katalysator-Diagnose im OBDII-Mode (invers: Europa-Mode)" VALUE 0x8181A3 KwUb 255.0 dez 0.00 255.0 FORMAT "%5.1" /end CHARACTERISTIC
/begin CHARACTERISTIC CDKVS "Codeword DKVS aktiv/inaktiv, CD..=0 -> keine Diagnose" VALUE 0x8181A4 KwUb 255.0 dez 0.00 255.0 FORMAT "%5.1" /end CHARACTERISTIC
/begin CHARACTERISTIC CDLASH "Codewort Lambdasondenalterungsdiagnose (SHK) im OBDII-Mode (invers: Europa-Mode)" VALUE 0x8181A5 KwUb 255.0 dez 0.00 255.0 FORMAT "%5.1" /end CHARACTERISTIC
/begin CHARACTERISTIC CDLATP "Codewort Lambdasondenalterungsdiagnose (TP) im OBDII-Mode (invers: Europa-Mode)" VALUE 0x8181A6 KwUb 255.0 dez 0.00 255.0 FORMAT "%5.1" /end CHARACTERISTIC
/begin CHARACTERISTIC CDLATV "Codewort Lambdasondenalterungsdiagnose (tv) im OBDII-Mode (invers: Europa-Mode)" VALUE 0x8181A7 KwUb 255.0 dez 0.00 255.0 FORMAT "%5.1" /end CHARACTERISTIC
/begin CHARACTERISTIC CDLDP "Codewort LDP-Diagnose im OBDII-Modus (invers: Europa-Modus), CD..=0 -> keine Dia" VALUE 0x8181A8 KwUb 255.0 dez 0.00 255.0 FORMAT "%5.1" /end CHARACTERISTIC
/begin CHARACTERISTIC CDLLR "Codewort DLLR abschalten (EURO-Codierung), CD..=0 -> keine Diagnose" VALUE 0x8181A9 KwUb 255.0 dez 0.00 255.0 FORMAT "%5.1" /end CHARACTERISTIC
/begin CHARACTERISTIC CDLSA "Codewort Lambdasondenalterungsdiagnose, Konfig.-byte, für Applikationszwecke" VALUE 0x8181AA KwUb 255.0 dez 0.00 255.0 FORMAT "%5.1" /end CHARACTERISTIC
/begin CHARACTERISTIC CDLSH "Codewort Sondendiagnose hinter Kat im OBDII-Mode (invers: Europa-Mode)" VALUE 0x8181AB KwUb 255.0 dez 0.00 255.0 FORMAT "%5.1" /end CHARACTERISTIC
/begin CHARACTERISTIC CDLSV "Codewort Sondendiagnose vor KAT im OBDII-Mode" VALUE 0x8181AC KwUb 255.0 dez 0.00 255.0 FORMAT "%5.1" /end CHARACTERISTIC
/begin CHARACTERISTIC CDLSVV "Codewort Diagnose vertauschte Sonden vor Kat im OBDII-Mode (invers: Europa-Mode)" VALUE 0x8181AD KwUb 255.0 dez 0.00 255.0 FORMAT "%5.1" /end CHARACTERISTIC
/begin CHARACTERISTIC CDMD "Codewort DMD abschalten (EURO-Codierung), CD..=0 -> keine Diagnose" VALUE 0x8181AE KwUb 255.0 dez 0.00 255.0 FORMAT "%5.1" /end CHARACTERISTIC
/begin CHARACTERISTIC CDNWS "Codewort DNWS abschalten (EURO-Codierung), CD..=0 -> keine Diagnose" VALUE 0x8181AF KwUb 255.0 dez 0.00 255.0 FORMAT "%5.1" /end CHARACTERISTIC
/begin CHARACTERISTIC CDSLS "Euro-Byte für Diagnose Sekundärluft-System" VALUE 0x8181B0 KwUb 255.0 dez 0.00 255.0 FORMAT "%5.1" /end CHARACTERISTIC
/begin CHARACTERISTIC CDSWE_0_A "Codewort DSWE abschalten (EURO-Codierung), CD..=0 -> keine Diagnose" VALUE 0x81A6E6 KwUb 255.0 dez 0.00 255.0 FORMAT "%5.1" /end CHARACTERISTIC
/begin CHARACTERISTIC CDSWE_1_A "Codewort DSWE abschalten (EURO-Codierung), CD..=0 -> keine Diagnose" VALUE 0x81A6E7 KwUb 255.0 dez 0.00 255.0 FORMAT "%5.1" /end CHARACTERISTIC
/begin CHARACTERISTIC CDSWE_2_A "Codewort DSWE abschalten (EURO-Codierung), CD..=0 -> keine Diagnose" VALUE 0x81A6E8 KwUb 255.0 dez 0.00 255.0 FORMAT "%5.1" /end CHARACTERISTIC
/begin CHARACTERISTIC CDSWE_3_A "Codewort DSWE abschalten (EURO-Codierung), CD..=0 -> keine Diagnose" VALUE 0x81A6E9 KwUb 255.0 dez 0.00 255.0 FORMAT "%5.1" /end CHARACTERISTIC
/begin CHARACTERISTIC CDTANKL "Codewort DTANKL abschalten (EURO-Codierung), CD..=0 -> keine Diagnose" VALUE 0x8181B1 KwUb 255.0 dez 0.00 255.0 FORMAT "%5.1" /end CHARACTERISTIC
/begin CHARACTERISTIC CDTES "Codewort Tankentlüftungsdiagnose abschalten (EURO-Codierung), CD..=0 ->keine Dia" VALUE 0x8181B2 KwUb 255.0 dez 0.00 255.0 FORMAT "%5.1" /end CHARACTERISTIC
/begin CHARACTERISTIC CDWVERAD "Codewort : Sperrung Bedarfsadaption dmvadll für AG" VALUE 0x8181B3 KwUb 255.0 dez 0.00 255.0 FORMAT "%5.1" /end CHARACTERISTIC
/begin CHARACTERISTIC CLRSHKEB "Codewort für Freigabe LRSHKEB" VALUE 0x818301 KwUb 255.0 dez 0.00 255.0 FORMAT "%5.1" /end CHARACTERISTIC
/begin CHARACTERISTIC CWADRES "Codewort für Adaptionswerte löschen bei FSP löschen" VALUE 0x8181B4 KwUb 255.0 dez 0.00 255.0 FORMAT "%5.1" /end CHARACTERISTIC
/begin CHARACTERISTIC CWDLSU "Codewort für DLSU" VALUE 0x8181B5 KwUb 255.0 dez 0.00 255.0 FORMAT "%5.1" /end CHARACTERISTIC
/begin CHARACTERISTIC CWDMIL "Codewort ti-Dauerstrichregelung RKTI" VALUE 0x818D08 KwUb 255.0 dez 0.00 255.0 FORMAT "%5.1" /end CHARACTERISTIC
/begin CHARACTERISTIC CWERFIL "Codewort zur Auswahl Filtervar. für die Ausgabe von AS.-Fehler an das Scan Tool" VALUE 0x8181B6 KwUb 255.0 dez 0.00 255.0 FORMAT "%5.1" /end CHARACTERISTIC
/begin CHARACTERISTIC CWFASL "Codewort: Testereingriff Sekundärluftdiagnose" VALUE 0x818303 KwUb 255.0 dez 0.00 255.0 FORMAT "%5.1" /end CHARACTERISTIC
/begin CHARACTERISTIC CWGRABH "Codewort für GRA-Bedienhebel" VALUE 0x8181B7 KwUb 255.0 dez 0.00 255.0 FORMAT "%5.1" /end CHARACTERISTIC
/begin CHARACTERISTIC CWKMMILSCT "Ausgabe ""Km bei MIL on""  für Scan Tool abschalten (0 = keine Ausgabe in PID $21)" VALUE 0x8181B8 KwUb 255.0 dez 0.00 255.0 FORMAT "%5.1" /end CHARACTERISTIC
/begin CHARACTERISTIC CWKONABG "Codewort für Konfiguration Abgasbehandlung" VALUE 0x8181B9 KwUb 255.0 dez 0.00 255.0 FORMAT "%5.1" /end CHARACTERISTIC
/begin CHARACTERISTIC CWKONFLS "Beschreibung der Lambdasondenposition hinter Katalysator im Abgasstrang" VALUE 0x8181BA KwUb 255.0 dez 0.00 255.0 FORMAT "%5.1" /end CHARACTERISTIC
/begin CHARACTERISTIC CWKONFZ1_0_A "Codewort für Konfiguration Fahrzeug" VALUE 0x81A6EA KwUb 255.0 dez 0.00 255.0 FORMAT "%5.1" /end CHARACTERISTIC
/begin CHARACTERISTIC CWKONFZ1_1_A "Codewort für Konfiguration Fahrzeug" VALUE 0x81A6EB KwUb 255.0 dez 0.00 255.0 FORMAT "%5.1" /end CHARACTERISTIC
/begin CHARACTERISTIC CWKONFZ1_2_A "Codewort für Konfiguration Fahrzeug" VALUE 0x81A6EC KwUb 255.0 dez 0.00 255.0 FORMAT "%5.1" /end CHARACTERISTIC
/begin CHARACTERISTIC CWKONFZ1_3_A "Codewort für Konfiguration Fahrzeug" VALUE 0x81A6ED KwUb 255.0 dez 0.00 255.0 FORMAT "%5.1" /end CHARACTERISTIC
/begin CHARACTERISTIC CWKONLS "Codewort für Konfiguration Lambda Sonden" VALUE 0x8181BB KwUb 255.0 dez 0.00 255.0 FORMAT "%5.1" /end CHARACTERISTIC
/begin CHARACTERISTIC CWLSHA "Codewort für Lambdasonden hinter KAT Alterung in %DLSAHK" VALUE 0x8181BC KwUb 255.0 dez 0.00 255.0 FORMAT "%5.1" /end CHARACTERISTIC
/begin CHARACTERISTIC CWM9CVNSUP "Codewort Support der VITs $05 und $06 (CVN-Ausgabe) im Mode/Service $09" VALUE 0x8109B6 KwUb 255.0 dez 0.00 255.0 FORMAT "%5.1" /end CHARACTERISTIC
/begin CHARACTERISTIC CWMDAPP "Codewort Applikation ohne Drehmomentfunktionen" VALUE 0x8181BD KwUb 255.0 dez 0.00 255.0 FORMAT "%5.1" /end CHARACTERISTIC
/begin CHARACTERISTIC CWNMAXMD "Codeword Drehzahlbegrenzung" VALUE 0x8116C9 KwUb 255.0 dez 0.00 255.0 FORMAT "%5.1" /end CHARACTERISTIC
/begin CHARACTERISTIC CWNOSCAT "Codewort zum Abschalten der Scan Tool Kommunikation" VALUE 0x818404 KwUb 3.000 dez 0.00 3.000 FORMAT "%5.3" /end CHARACTERISTIC
/begin CHARACTERISTIC CWOBD "Codewort für Konfiguration OBD Zertifikationsnachweis" VALUE 0x8181BE KwUb 255.0 dez 0.00 255.0 FORMAT "%5.1" /end CHARACTERISTIC
/begin CHARACTERISTIC CWPKAPP "Codewort Applikation Druckreferenz für Kraftstoffdruckregler" VALUE 0x818D09 KwUb 255.0 dez 0.00 255.0 FORMAT "%5.1" /end CHARACTERISTIC
/begin CHARACTERISTIC CWPWF "Codewort Powerfail" VALUE 0x81A029 KwUb 255.0 dez 0.00 255.0 FORMAT "%5.1" /end CHARACTERISTIC
/begin CHARACTERISTIC CWSCTMDE "Codewort zum abschalten bestimmter Scan Tool Modes/Services (Bit=0 ->  Mode aus)" VALUE 0x8181BF KwUb 255.0 dez 0.00 255.0 FORMAT "%5.1" /end CHARACTERISTIC
/begin CHARACTERISTIC CWSLS "Codewort für Sekundärluftsystem" VALUE 0x8181C0 KwUb 255.0 dez 0.00 255.0 FORMAT "%5.1" /end CHARACTERISTIC
/begin CHARACTERISTIC CWSTADAP "Codewort Startadaption" VALUE 0x810E3B KwUb 255.0 dez 0.00 255.0 FORMAT "%5.1" /end CHARACTERISTIC
/begin CHARACTERISTIC CWTF "Codewort für Konfiguration Temperaturfühler" VALUE 0x8181C1 KwUb 255.0 dez 0.00 255.0 FORMAT "%5.1" /end CHARACTERISTIC
/begin CHARACTERISTIC CWUHR "Codewort für Uhr" VALUE 0x8181C2 KwUb 255.0 dez 0.00 255.0 FORMAT "%5.1" /end CHARACTERISTIC
/begin CHARACTERISTIC DECKSTAI "Decrement-Step für STADAP-Faktor" CURVE 0x810E3C KlAUbSstUbWSb 1.000 fak_sb_b1 -1.000 0.00 FORMAT "%5.3"
 /begin AXIS_DESCR STD_AXIS tmadb dez 3 0.00 255.0 FORMAT "%5.1" DEPOSIT ABSOLUTE /end AXIS_DESCR
/end CHARACTERISTIC
/begin CHARACTERISTIC DELTASEGMX "Schwelle delta Segmente bei Umsynchronisation nach Auslauferkennung" VALUE 0x810E43 KwUb 255.0 dez 0.00 255.0 FORMAT "%5.1" /end CHARACTERISTIC
/begin CHARACTERISTIC DMRDNW "Momentenreserve für Diagnose Nockenwelle über Tester" VALUE 0x827FF0 KwUw 99.99847 rel_uw_b100 0.00 99.99847 FORMAT "%8.5" /end CHARACTERISTIC
/begin CHARACTERISTIC DNABW "Drehzahldifferenz bei Motor abwürgen" VALUE 0x813FB0 KwSw 16383.75 nmot_sw_q0p25 -8192.000 8191.750 FORMAT "%8.3" /end CHARACTERISTIC
/begin CHARACTERISTIC DNBURN0 "Minimaler Drehzahlanstieg für erkannte Verbrennung im Bereich 0" CURVE 0x815560 KlAUwSstUwWUw 4112.000 nmot_uw_q0p25 0.00 4112.000 FORMAT "%8.3"
 /begin AXIS_DESCR STD_AXIS nmot_w nmot_uw_q0p25 12 0.00 16383.75 FORMAT "%8.2" DEPOSIT ABSOLUTE /end AXIS_DESCR
/end CHARACTERISTIC
/begin CHARACTERISTIC DNBURN1 "Minimaler Drehzahlanstieg für erkannte Verbrennung im Bereich 1" CURVE 0x815592 KlAUwSstUwWUw 4112.000 nmot_uw_q0p25 0.00 4112.000 FORMAT "%8.3"
 /begin AXIS_DESCR STD_AXIS nmot_w nmot_uw_q0p25 12 0.00 16383.75 FORMAT "%8.2" DEPOSIT ABSOLUTE /end AXIS_DESCR
/end CHARACTERISTIC
/begin CHARACTERISTIC DNBURN2 "Minimaler Drehzahlanstieg für erkannte Verbrennung im Bereich 2" CURVE 0x8155C4 KlAUwSstUwWUw 4112.000 nmot_uw_q0p25 0.00 4112.000 FORMAT "%8.3"
 /begin AXIS_DESCR STD_AXIS nmot_w nmot_uw_q0p25 12 0.00 16383.75 FORMAT "%8.2" DEPOSIT ABSOLUTE /end AXIS_DESCR
/end CHARACTERISTIC
/begin CHARACTERISTIC DNMAX "Zulässige Verminderung der Maximaldrehzahl pro Rechenschritt" VALUE 0x8169B4 KwUw 16383.75 nmot_uw_q0p25 0.00 16383.75 FORMAT "%8.2" /end CHARACTERISTIC
/begin CHARACTERISTIC DNMAXDZ "Delta-Drehzahl, Abregelung der Drehzahlgrenze bei doppelter Zündausgabe" VALUE 0x8169B6 KwUw 16383.75 nmot_uw_q0p25 0.00 16383.75 FORMAT "%8.2" /end CHARACTERISTIC
/begin CHARACTERISTIC DNMAXH "Überschreitung der Maximaldrehzahl für Einspritzausblendung an allen Zylindern" VALUE 0x8169B8 KwUw 2550.000 nmot_uw_q0p25 0.00 2550.000 FORMAT "%8.3" /end CHARACTERISTIC
/begin CHARACTERISTIC DNSIRES "Differenz Soll- und Istdrehzahl, Reset-Wert" VALUE 0x8169BA KwSw 16383.75 nmot_sw_q0p25 -8192.000 8191.750 FORMAT "%8.3" /end CHARACTERISTIC
/begin CHARACTERISTIC DPSLV "minimale Druckdifferenz Sekundärluftventi" VALUE 0x818304 KwUb 1275. p_ub_q5 0.00 1275. FORMAT "%5.0" /end CHARACTERISTIC
/begin AXIS_PTS FHO04ESUB "SST-Verteilung für Höhenfaktor" 0x81005B fho SstAUbSstUb 3.984 fak_ub_b4 4 0.00 3.984 FORMAT "%5.3" DEPOSIT ABSOLUTE /end AXIS_PTS
/begin CHARACTERISTIC FKKVS "Korrekturfaktor Kraftstoffversorgungssystem" MAP 0x81CD90 KfAxUbAyUbSstxUbSstyUwWUw 1.999969 fak_uw_b2 0.00 1.999969 FORMAT "%8.6"
 /begin AXIS_DESCR STD_AXIS nmot nmot_ub_q40 16 0.00 10200. FORMAT "%5.0" DEPOSIT ABSOLUTE /end AXIS_DESCR
 /begin AXIS_DESCR STD_AXIS tevfakge_w tinjection_sy 16 0.00 174.7600 FORMAT "%8.4" DEPOSIT ABSOLUTE /end AXIS_DESCR
/end CHARACTERISTIC
/begin CHARACTERISTIC FMSL "Faktor Korrektur Sekundärluftmasse" VALUE 0x818305 KwUb 1.992 fak_ub_b2 0.00 1.992 FORMAT "%5.3" /end CHARACTERISTIC
/begin CHARACTERISTIC FMSLOFF "Schwelle Ausräumen der Sekundärluft beendet" VALUE 0x818306 KwUb 0.9961 fak_ub_b1 0.00 0.9961 /end CHARACTERISTIC
/begin CHARACTERISTIC FMSRHOL "Dichtekorrektur der Sekundärluftmasse" CURVE 0x81A856 KlAUwSstUwWUw 1.999969 fak_uw_b2 0.00 1.999969 FORMAT "%8.6"
 /begin AXIS_DESCR STD_AXIS frhokor_w fak_uw_b4 4 0.00 3.999939 FORMAT "%8.6" DEPOSIT ABSOLUTE /end AXIS_DESCR
/end CHARACTERISTIC
/begin CHARACTERISTIC FMSTMOT "tmot- Korrektur der Sekundärluftmasse" CURVE 0x818307 KlAUbSstUbWUb 1.992 fak_ub_b2 0.00 1.992 FORMAT "%5.3"
 /begin AXIS_DESCR STD_AXIS tmot temp_ub_q0p75_o48 8 -48.00 143.3 FORMAT "%5.1" DEPOSIT ABSOLUTE /end AXIS_DESCR
/end CHARACTERISTIC
/begin CHARACTERISTIC FNWSKRE "Faktor Nockenwellen-Sollwinkelkorrektur durch klopfende Verbrennungen Einlaß" CURVE 0x81A340 KlAUbSstUbWUb 1.000 fak_ub_b2 0.00 1.000 FORMAT "%5.3"
 /begin AXIS_DESCR STD_AXIS wkrma zw_ub_qn0p75 3 -191.3 0.00 FORMAT "%5.1" DEPOSIT ABSOLUTE /end AXIS_DESCR
/end CHARACTERISTIC
/begin CHARACTERISTIC FRLFSDP "Einspritzkorrektur bei RLFS" CURVE 0x81CFC2 KlAUwSstSwWUw 1.999969 fak_uw_b2 0.00 1.999969 FORMAT "%8.6"
 /begin AXIS_DESCR STD_AXIS dpus_w p_sw_q0p078 11 -2560.000 2559.922 FORMAT "%8.3" DEPOSIT ABSOLUTE /end AXIS_DESCR
/end CHARACTERISTIC
/begin CHARACTERISTIC IMLSLMNTMS "min. Verhältnisfaktor für Einschaltung SLS in Abhängigkeit von tmst" CURVE 0x818318 KlAUbSstUbWUb 0.9961 fak_ub_b1 0.00 0.9961
 /begin AXIS_DESCR STD_AXIS tmst temp_ub_q0p75_o48 4 -48.00 143.3 FORMAT "%5.1" DEPOSIT ABSOLUTE /end AXIS_DESCR
/end CHARACTERISTIC
/begin CHARACTERISTIC IMLSLMXTMS_0_A "max. Verhältnisfaktor für Einschaltung SLS in Abhängigkeit von tmst" CURVE 0x818321 KlAUbSstUbWUb 0.9961 fak_ub_b1 0.00 0.9961
 /begin AXIS_DESCR STD_AXIS tmst temp_ub_q0p75_o48 4 -48.00 143.3 FORMAT "%5.1" DEPOSIT ABSOLUTE /end AXIS_DESCR
/end CHARACTERISTIC
/begin CHARACTERISTIC IMLSLMXTMS_1_A "max. Verhältnisfaktor für Einschaltung SLS in Abhängigkeit von tmst" CURVE 0x81832A KlAUbSstUbWUb 0.9961 fak_ub_b1 0.00 0.9961
 /begin AXIS_DESCR STD_AXIS tmst temp_ub_q0p75_o48 4 -48.00 143.3 FORMAT "%5.1" DEPOSIT ABSOLUTE /end AXIS_DESCR
/end CHARACTERISTIC
/begin CHARACTERISTIC IMLSLSA "Schwelle Luftmassenintegral für Anfang Sekundärluft im Abgas" VALUE 0x81A868 KwUw 4660.267 m_uw_b4660 0.00 4660.267 FORMAT "%8.3" /end CHARACTERISTIC
/begin CHARACTERISTIC IMLSLSE "Schwelle Luftmassenintegral für Ende Sekundärluft im Abgas" VALUE 0x81A86A KwUw 4660.267 m_uw_b4660 0.00 4660.267 FORMAT "%8.3" /end CHARACTERISTIC
/begin CHARACTERISTIC INCKSTAI "Inkrement-Step für STADAP-Faktor" CURVE 0x810E44 KlAUbSstUbWSb 0.9922 fak_sb_b1 0.00 0.9922
 /begin AXIS_DESCR STD_AXIS tmadb dez 3 0.00 255.0 FORMAT "%5.1" DEPOSIT ABSOLUTE /end AXIS_DESCR
/end CHARACTERISTIC
/begin CHARACTERISTIC ITNMXH "Verweilzeit unterhalb unterer Drehzahlgrenze vor Aktivierung der oberen Grenze" VALUE 0x8169BC KwUw 655.3500 t10msxs_uw_b655p35 0.00 655.3500 FORMAT "%8.4" /end CHARACTERISTIC
/begin CHARACTERISTIC KFFMSML "Abgasgegendruckkorrektur der Sekundärluftmasse" MAP 0x818333 KfAxUbAyUbSstxUbSstyUbWUb 1.992 fak_ub_b2 0.00 1.992 FORMAT "%5.3"
 /begin AXIS_DESCR STD_AXIS nmot nmot_ub_q40 8 0.00 10200. FORMAT "%5.0" DEPOSIT ABSOLUTE /end AXIS_DESCR
 /begin AXIS_DESCR STD_AXIS rl rel_ub_q0p75 8 0.00 191.3 FORMAT "%5.1" DEPOSIT ABSOLUTE /end AXIS_DESCR
/end CHARACTERISTIC
/begin CHARACTERISTIC KFMDST "Startmoment" MAP 0x81611E KfAxUbAyUbSstxUbSstyUbWSb 198.9 rel_sb_q0p78 -99.84 99.06 FORMAT "%5.2"
 /begin AXIS_DESCR STD_AXIS qnst fak_ub_b2 8 0.00 1.992 FORMAT "%5.3" DEPOSIT ABSOLUTE /end AXIS_DESCR
 /begin AXIS_DESCR STD_AXIS tmot temp_ub_q0p75_o48 6 -48.00 143.3 FORMAT "%5.1" DEPOSIT ABSOLUTE /end AXIS_DESCR
/end CHARACTERISTIC
/begin CHARACTERISTIC KFNSTAMX "Drehzahlschwelle für STADAP aktiv" MAP 0x810E4B KfAxUbAyUbSstxUbSstyUbWUb 10200. nmot_ub_q40 0.00 10200. FORMAT "%5.0"
 /begin AXIS_DESCR STD_AXIS fho fak_ub_b4 4 0.00 3.984 FORMAT "%5.3" DEPOSIT ABSOLUTE /end AXIS_DESCR
 /begin AXIS_DESCR STD_AXIS nstat nmot_ub_q10 4 0.00 2550. FORMAT "%5.0" DEPOSIT ABSOLUTE /end AXIS_DESCR
/end CHARACTERISTIC
/begin CHARACTERISTIC KFNWKHE "Kennfeld für Nockenwellenspreizung bei Katheizen (Einlaß)" MAP 0x828488 GkfWSw 511.9922 kw_sw_q0p0078 -256.0000 255.9922 FORMAT "%8.4"
 /begin AXIS_DESCR COM_AXIS nmot_w nmot_uw_q0p25 16 0.00 16383.75 AXIS_PTS_REF SNM16NEUW /end AXIS_DESCR
 /begin AXIS_DESCR COM_AXIS rlnw_w rel_uw_q0p0234 8 0.00 1535.977 AXIS_PTS_REF SRL08NEUW /end AXIS_DESCR
/end CHARACTERISTIC
/begin CHARACTERISTIC KFNWKHLLE "Kennfeld für Nockenwellenspreizung bei Katheizen und B_ll (Einlaß)" MAP 0x828588 GkfWSw 511.9922 kw_sw_q0p0078 -256.0000 255.9922 FORMAT "%8.4"
 /begin AXIS_DESCR COM_AXIS nmot_w nmot_uw_q0p25 5 0.00 16383.75 AXIS_PTS_REF SNM05NEUW /end AXIS_DESCR
 /begin AXIS_DESCR COM_AXIS rlnw_w rel_uw_q0p0234 5 0.00 1535.977 AXIS_PTS_REF SRL05NEUW /end AXIS_DESCR
/end CHARACTERISTIC
/begin CHARACTERISTIC KFNWKRE "Sollwinkel Nockenwelle  bei klopfender Verbrennung Einlaß" MAP 0x8285BA GkfWSw 511.9922 kw_sw_q0p0078 -256.0000 255.9922 FORMAT "%8.4"
 /begin AXIS_DESCR COM_AXIS nmot_w nmot_uw_q0p25 16 0.00 16383.75 AXIS_PTS_REF SNM16NEUW /end AXIS_DESCR
 /begin AXIS_DESCR COM_AXIS rlnw_w rel_uw_q0p0234 8 0.00 1535.977 AXIS_PTS_REF SRL08NEUW /end AXIS_DESCR
/end CHARACTERISTIC
/begin CHARACTERISTIC KFNWLLE "Kennfeld für Nockenwellenspreizung im Leerlauf (Einlaß)" MAP 0x8286BA GkfWSw 511.9922 kw_sw_q0p0078 -256.0000 255.9922 FORMAT "%8.4"
 /begin AXIS_DESCR COM_AXIS nmot_w nmot_uw_q0p25 5 0.00 16383.75 AXIS_PTS_REF SNM05NEUW /end AXIS_DESCR
 /begin AXIS_DESCR COM_AXIS rlnw_w rel_uw_q0p0234 5 0.00 1535.977 AXIS_PTS_REF SRL05NEUW /end AXIS_DESCR
/end CHARACTERISTIC
/begin CHARACTERISTIC KFNWSE "Kennfeld für Nockenwellenspreizung (Einlaß)" MAP 0x8286EC GkfWSw 511.9922 kw_sw_q0p0078 -256.0000 255.9922 FORMAT "%8.4"
 /begin AXIS_DESCR COM_AXIS nmot_w nmot_uw_q0p25 16 0.00 16383.75 AXIS_PTS_REF SNM16NEUW /end AXIS_DESCR
 /begin AXIS_DESCR COM_AXIS rlnw_w rel_uw_q0p0234 8 0.00 1535.977 AXIS_PTS_REF SRL08NEUW /end AXIS_DESCR
/end CHARACTERISTIC
/begin CHARACTERISTIC KFNWTME "Faktor Übergang von Kalt- auf Warm-Kennfelder bei Nockenwellensollwinkeln Einlaß" MAP 0x81A347 KfAxUbAyUbSstxUbSstyUbWUb 1.992 fak_ub_b2 0.00 1.992 FORMAT "%5.3"
 /begin AXIS_DESCR STD_AXIS tmot temp_ub_q0p75_o48 4 -48.00 143.3 FORMAT "%5.1" DEPOSIT ABSOLUTE /end AXIS_DESCR
 /begin AXIS_DESCR STD_AXIS tmst temp_ub_q0p75_o48 4 -48.00 143.3 FORMAT "%5.1" DEPOSIT ABSOLUTE /end AXIS_DESCR
/end CHARACTERISTIC
/begin CHARACTERISTIC KFNWWLE "Kennfeld für Nockenwellenspreizung im Warmlauf (Einlaß)" MAP 0x8287EC GkfWSw 511.9922 kw_sw_q0p0078 -256.0000 255.9922 FORMAT "%8.4"
 /begin AXIS_DESCR COM_AXIS nmot_w nmot_uw_q0p25 16 0.00 16383.75 AXIS_PTS_REF SNM16NEUW /end AXIS_DESCR
 /begin AXIS_DESCR COM_AXIS rlnw_w rel_uw_q0p0234 8 0.00 1535.977 AXIS_PTS_REF SRL08NEUW /end AXIS_DESCR
/end CHARACTERISTIC
/begin CHARACTERISTIC KFNWWLLE "Kennfeld für Nockenwellenspreizung im Warmlauf bei B_ll (Einlaß)" MAP 0x8288EC GkfWSw 511.9922 kw_sw_q0p0078 -256.0000 255.9922 FORMAT "%8.4"
 /begin AXIS_DESCR COM_AXIS nmot_w nmot_uw_q0p25 5 0.00 16383.75 AXIS_PTS_REF SNM05NEUW /end AXIS_DESCR
 /begin AXIS_DESCR COM_AXIS rlnw_w rel_uw_q0p0234 5 0.00 1535.977 AXIS_PTS_REF SRL05NEUW /end AXIS_DESCR
/end CHARACTERISTIC
/begin CHARACTERISTIC KFWNWSAPE "Kennfeld für Nockenwellenspreizung während Applikationsphase Einlass" MAP 0x82891E KfAxUwAyUwSstxUwSstyUwWSw 511.9922 kw_sw_q0p0078 -256.0000 255.9922 FORMAT "%8.4"
 /begin AXIS_DESCR STD_AXIS nmot_w nmot_uw_q0p25 12 0.00 16383.75 FORMAT "%8.2" DEPOSIT ABSOLUTE /end AXIS_DESCR
 /begin AXIS_DESCR STD_AXIS rk_w rel_uw_b3072 8 0.00 3071.953 FORMAT "%8.3" DEPOSIT ABSOLUTE /end AXIS_DESCR
/end CHARACTERISTIC
/begin CHARACTERISTIC KINMXNL "Verstärkung Integralanteil der NMAX-Regelung bei stromloser Drosselklappe" VALUE 0x8116CA KwUb 5.080 relnmot_q0p02 0.02000 5.100 FORMAT "%5.3" /end CHARACTERISTIC
/begin CHARACTERISTIC KINMXRLG "Verstärkung Integralanteil der NMAX-Regelung im Normalbetrieb" MAP 0x819E85 GkfWUb 5.100 relnmot_q0p02 0.00 5.100 FORMAT "%5.3"
 /begin AXIS_DESCR COM_AXIS rl rel_ub_q0p75 8 0.00 191.3 AXIS_PTS_REF SRL08NXUB /end AXIS_DESCR
 /begin AXIS_DESCR COM_AXIS gangi dez 8 0.00 255.0 AXIS_PTS_REF SGA08MDUB /end AXIS_DESCR
/end CHARACTERISTIC
/begin CHARACTERISTIC KLDNFHO "Wichtung Minimaler Drehzahlanstieg für erkannte Verbrennung" CURVE 0x818E0E KlAUbSstUbWUb 1.992 fak_ub_b2 0.00 1.992 FORMAT "%5.3"
 /begin AXIS_DESCR STD_AXIS fho fak_ub_b4 4 0.00 3.984 FORMAT "%5.3" DEPOSIT ABSOLUTE /end AXIS_DESCR
/end CHARACTERISTIC
/begin CHARACTERISTIC KLFNWA "Wichtung Nockenwelle Auslaß" CURVE 0x811F45 KlAUbSstUbWUb 0.9961 fak_ub_b1 0.00 0.9961 /begin AXIS_DESCR STD_AXIS fnwua fak_ub_b1 6 0.00 0.9961 DEPOSIT ABSOLUTE /end AXIS_DESCR /end CHARACTERISTIC
/begin CHARACTERISTIC KLFNWE "Wichtung Nockenwelle Einlaß" CURVE 0x811F52 KlAUbSstUbWUb 0.9961 fak_ub_b1 0.00 0.9961 /begin AXIS_DESCR STD_AXIS fnwue fak_ub_b1 6 0.00 0.9961 DEPOSIT ABSOLUTE /end AXIS_DESCR /end CHARACTERISTIC
/begin CHARACTERISTIC KLTNMXPR "Zeit für Drehzahlprädiktion der NMAX-Regelung" CURVE 0x819EC5 GklWUb 5.080 relnmot_q0p02 0.02000 5.100 FORMAT "%5.3" /begin AXIS_DESCR COM_AXIS gangi dez 8 0.00 255.0 AXIS_PTS_REF SGA08MDUB /end AXIS_DESCR /end CHARACTERISTIC
/begin CHARACTERISTIC KLTNRDE "Kennlinie für Rückdrehzahnzeiten" CURVE 0x8184A8 KlAUbSstUbWUb 255.0 t1msxms_q1 0.00 255.0 FORMAT "%5.1"
 /begin AXIS_DESCR STD_AXIS tmot temp_ub_q0p75_o48 3 -48.00 143.3 FORMAT "%5.1" DEPOSIT ABSOLUTE /end AXIS_DESCR
/end CHARACTERISTIC
/begin CHARACTERISTIC KMITIBGR "Steigungsfaktor für das Aufintegrieren von dtimx_w zur Momentenbeggrenzung" VALUE 0x818D0A KwUb 91.20 rkti_k_sy 0.00 91.20 FORMAT "%5.2" /end CHARACTERISTIC
/begin CHARACTERISTIC KRKTE "Umrechnung relative Kraftstoffmasse rk in effektive Einspritzzeit te" VALUE 0x81CFF0 KwUw 7.281667 rkti11_sy 0.00 7.281667 FORMAT "%8.6" /end CHARACTERISTIC
/begin CHARACTERISTIC KSTA0INI "Initialisierungswert STADAP-Faktor in Bereich 0" VALUE 0x810E65 KwUb 1.992 fak_ub_b2 0.00 1.992 FORMAT "%5.3" /end CHARACTERISTIC
/begin CHARACTERISTIC KSTA1INI "Initialisierungswert STADAP-Faktor in Bereich 1" VALUE 0x810E66 KwUb 1.992 fak_ub_b2 0.00 1.992 FORMAT "%5.3" /end CHARACTERISTIC
/begin CHARACTERISTIC KSTA2INI "Initialisierungswert STADAP-Faktor in Bereich 2" VALUE 0x810E67 KwUb 1.992 fak_ub_b2 0.00 1.992 FORMAT "%5.3" /end CHARACTERISTIC
/begin CHARACTERISTIC KSTAI "Arbeitsbereiche für STADAP-Faktoren" CURVE 0x810E68 KlAUbSstUbWUb 255.0 dez 0.00 255.0 FORMAT "%5.1"
 /begin AXIS_DESCR STD_AXIS tmst temp_ub_q0p75_o48 12 -48.00 143.3 FORMAT "%5.1" DEPOSIT ABSOLUTE /end AXIS_DESCR
/end CHARACTERISTIC
/begin CHARACTERISTIC KSTAMN0 "Min-Begrenzung des STADAP-Faktors in Bereich 0" VALUE 0x810E81 KwUb 1.992 fak_ub_b2 0.00 1.992 FORMAT "%5.3" /end CHARACTERISTIC
/begin CHARACTERISTIC KSTAMN1 "Min-Begrenzung des STADAP-Faktors in Bereich 1" VALUE 0x810E82 KwUb 1.992 fak_ub_b2 0.00 1.992 FORMAT "%5.3" /end CHARACTERISTIC
/begin CHARACTERISTIC KSTAMN2 "Min-Begrenzung des STADAP-Faktors in Bereich 2" VALUE 0x810E83 KwUb 1.992 fak_ub_b2 0.00 1.992 FORMAT "%5.3" /end CHARACTERISTIC
/begin CHARACTERISTIC KSTAMX0 "Max-Begrenzung des STADAP-Faktors in Bereich 0" VALUE 0x810E84 KwUb 0.9922 fak_ub_b2 1.000 1.992 FORMAT "%5.3" /end CHARACTERISTIC
/begin CHARACTERISTIC KSTAMX1 "Max-Begrenzung des STADAP-Faktors in Bereich 1" VALUE 0x810E85 KwUb 0.9922 fak_ub_b2 1.000 1.992 FORMAT "%5.3" /end CHARACTERISTIC
/begin CHARACTERISTIC KSTAMX2 "Max-Begrenzung des STADAP-Faktors in Bereich 2" VALUE 0x810E86 KwUb 0.9922 fak_ub_b2 1.000 1.992 FORMAT "%5.3" /end CHARACTERISTIC
/begin CHARACTERISTIC KSTTOPMN "Minimale Betriebsdauer seit PWF für Startmengenadaption" VALUE 0x8155F6 KwUw 393210.0 t6minxmin_q6 0.00 393210.0 FORMAT "%8.1" /end CHARACTERISTIC
/begin CHARACTERISTIC MDIMX "Maximales indiziertes Motormoment" VALUE 0x8116CB KwUb 99.61 rel_ub_b99p6 0.00 99.61 FORMAT "%5.2" /end CHARACTERISTIC
/begin CHARACTERISTIC MLSLMX "max. Motor-Luftmasse für Sekundärlufteinblasung" VALUE 0x81A86C KwUw 6553.500 m_q0p1 0.00 6553.500 FORMAT "%8.3" /end CHARACTERISTIC
/begin CHARACTERISTIC MSLUB "Sekundärluftmasse abhängig von der Batteriespannung" CURVE 0x81A86E KlAUwSstUwWUw 102.3984 m_uw_b102p4 0.00 102.3984 FORMAT "%8.4"
 /begin AXIS_DESCR STD_AXIS ubsqf_w spg_q0p00039 8 0.00 25.59961 FORMAT "%8.5" DEPOSIT ABSOLUTE /end AXIS_DESCR
/end CHARACTERISTIC
/begin CHARACTERISTIC NFANWS "Drehzahlschwelle für Funktionsanforderung NWS" VALUE 0x81A33C KwUb 10200. nmot_ub_q40 0.00 10200. FORMAT "%5.0" /end CHARACTERISTIC
/begin CHARACTERISTIC NMAX "Drehzahlbegrenzung" VALUE 0x8169BE KwUw 16383.75 nmot_uw_q0p25 0.00 16383.75 FORMAT "%8.2" /end CHARACTERISTIC
/begin CHARACTERISTIC NMAXDV "Drehzahlbegrenzung bei Fehlererkennung Geschwindigkeitssignal" VALUE 0x8169C0 KwUw 10200.00 nmot_uw_q0p25 0.00 10200.00 FORMAT "%8.2" /end CHARACTERISTIC
/begin CHARACTERISTIC NMAXDVG "Drehzahlgrenze für Automatik-Getriebe bei Fehler Geschwindigkeitssignal" CURVE 0x81FB9A GklWUw 16383.75 nmot_uw_q0p25 0.00 16383.75 FORMAT "%8.2" /begin AXIS_DESCR COM_AXIS gangi dez 8 0.00 255.0 AXIS_PTS_REF SGA08MDUB /end AXIS_DESCR /end CHARACTERISTIC
/begin CHARACTERISTIC NMAXDZ "Drehzahlgrenze bei doppelter Zündausgabe" VALUE 0x8169C2 KwUw 16383.75 nmot_uw_q0p25 0.00 16383.75 FORMAT "%8.2" /end CHARACTERISTIC
/begin CHARACTERISTIC NMAXGA "Maximal zulässige Motordrehzahl (stationär)" CURVE 0x81FBAA GklWUw 16383.75 nmot_uw_q0p25 0.00 16383.75 FORMAT "%8.2" /begin AXIS_DESCR COM_AXIS gangi dez 8 0.00 255.0 AXIS_PTS_REF SGA08MDUB /end AXIS_DESCR /end CHARACTERISTIC
/begin CHARACTERISTIC NMAXNL "Drehzahlgrenze bei Drehzahlgeber-Notlauf" VALUE 0x8169C4 KwUw 16383.75 nmot_uw_q0p25 0.00 16383.75 FORMAT "%8.2" /end CHARACTERISTIC
/begin CHARACTERISTIC NMAXOG "erhöhte Drehzahlgrenze" VALUE 0x8169C6 KwUw 16383.75 nmot_uw_q0p25 0.00 16383.75 FORMAT "%8.2" /end CHARACTERISTIC
/begin CHARACTERISTIC NMKFNWLLE "Drehzahlschwelle zur Aktivierung LL-Sollwinkelkennfelder bei Einlaßnockenwelle" VALUE 0x8171AC KwUw 16383.75 nmot_uw_q0p25 0.00 16383.75 FORMAT "%8.2" /end CHARACTERISTIC
/begin CHARACTERISTIC NMOTRDE "Drehzahlschwelle zur Freigabe der Funktion RDE" VALUE 0x8109C3 KwUb 2550. nmot_ub_q10 0.00 2550. FORMAT "%5.0" /end CHARACTERISTIC
/begin CHARACTERISTIC NMXDAEF "Maximaldrehzahl bei Drosselklappen-Antrieb-Ersatzbetrieb" CURVE 0x8116CC KlAUbSstUbWUb 10200. nmot_ub_q40 0.00 10200. FORMAT "%5.0"
 /begin AXIS_DESCR STD_AXIS wped relPED_ub_b100 6 0.00 100.0 FORMAT "%5.1" DEPOSIT ABSOLUTE /end AXIS_DESCR
/end CHARACTERISTIC
/begin CHARACTERISTIC NMXDKPU "Maximaldrehzahl bei Sicherheitskraftstoffabschaltung (SKA)" VALUE 0x8169C8 KwUw 16383.75 nmot_uw_q0p25 0.00 16383.75 FORMAT "%8.2" /end CHARACTERISTIC
/begin CHARACTERISTIC NMXPNL "Verstärkung Proportionalanteil der NMAX-Regelung bei stromloser Drosselklappe" VALUE 0x819ECD KwUb 0.9961 relnmot_q0p0039 0.00 0.9961 /end CHARACTERISTIC
/begin CHARACTERISTIC NMXPRLG "Verstärkung Proportionalanteil der NMAX-Regelung im Normalbetrieb" MAP 0x819ECE GkfWUb 0.9961 relnmot_q0p0039 0.00 0.9961
 /begin AXIS_DESCR COM_AXIS rl rel_ub_q0p75 8 0.00 191.3 AXIS_PTS_REF SRL08NXUB /end AXIS_DESCR
 /begin AXIS_DESCR COM_AXIS gangi dez 8 0.00 255.0 AXIS_PTS_REF SGA08MDUB /end AXIS_DESCR
/end CHARACTERISTIC
/begin CHARACTERISTIC NSTAK "Anlassdrehzahlschwelle für Hochlauferkennung" VALUE 0x8155F8 KwUw 16383.75 nmot_uw_q0p25 0.00 16383.75 FORMAT "%8.2" /end CHARACTERISTIC
/begin CHARACTERISTIC NSWO1 "Drehzahlschwelle 1 Umschaltg. zur Rechenzeitersparnis" VALUE 0x8181C3 KwUb 10200. nmot_ub_q40 0.00 10200. FORMAT "%5.0" /end CHARACTERISTIC
/begin CHARACTERISTIC NSWO2 "Drehzahlschwelle 2 Umschaltg. zur Rechenzeitersparnis" VALUE 0x8181C4 KwUb 10200. nmot_ub_q40 0.00 10200. FORMAT "%5.0" /end CHARACTERISTIC
/begin CHARACTERISTIC PSAPES "Saugrohrdruck für Applikation Einspritzung" VALUE 0x81CFF2 KwUw 2559.961 p_uw_q0p039 0.00 2559.961 FORMAT "%8.3" /end CHARACTERISTIC
/begin CHARACTERISTIC PVMITIBGR "P-Verstärkungsfaktor für Momentenbegrenzung bei Dauerstricheinspritzung" VALUE 0x818D0B KwUb 9.120 rkti_p_sy 0.00 9.120 FORMAT "%5.3" /end CHARACTERISTIC
/begin CHARACTERISTIC RDUNDEF "Winkelbereich in dem keine Plausibilisierung des Rückdrehverdachts möglich ist" VALUE 0x8109C4 KwUb 1530. kw_q6 0.00 1530. FORMAT "%5.0" /end CHARACTERISTIC
/begin CHARACTERISTIC RESETMAX "Schalter zum Resetieren von perfmax_w" VALUE 0x819F87 KwUb 1.000 dez 0.00 1.000 FORMAT "%5.3" /end CHARACTERISTIC
/begin AXIS_PTS SAN12ESUW "SST-Verteilung für den begrenzten Einspritzzähler anztib_w" 0x813024 anztib_w SstAUwSstUw 65535.00 dez 12 0.00 65535.00 FORMAT "%8.2" DEPOSIT ABSOLUTE /end AXIS_PTS
/begin AXIS_PTS SDK10TEUB "wdkba abhängige Stützstellen (Anzahl 10)" 0x8181C6 wdkba SstAUbSstUb 100.0 relDK_ub_b100 10 0.00 100.0 FORMAT "%5.1" DEPOSIT ABSOLUTE /end AXIS_PTS
/begin AXIS_PTS SEZ06TMUB "Stützstellenverteilung, Zündwinkelwirkungsgrad" 0x8181D1 etazwimt SstAUbSstUb 127.5 rel_ub_b127p5 6 0.00 127.5 FORMAT "%5.1" DEPOSIT ABSOLUTE /end AXIS_PTS
/begin AXIS_PTS SFR05TEUB "frmit abhängige Stützstellen (Anzahl 5)" 0x8181D8 frmit SstAUbSstUb 1.992 fak_ub_b2 5 0.00 1.992 FORMAT "%5.3" DEPOSIT ABSOLUTE /end AXIS_PTS
/begin AXIS_PTS SGA06MDUB "Stützstellenverteilung Ist Gang 6 Sst." 0x81A7F4 gangi SstAUbSstUb 255.0 dez 6 0.00 255.0 FORMAT "%5.1" DEPOSIT ABSOLUTE /end AXIS_PTS
/begin AXIS_PTS SGA08MDUB "Stützstellenverteilung Ist Gang 8 Sst." 0x810060 gangi SstAUbSstUb 255.0 dez 8 0.00 255.0 FORMAT "%5.1" DEPOSIT ABSOLUTE /end AXIS_PTS
/begin CHARACTERISTIC SGIDB8 "Baugruppe Hardware" ASCII 0x819F80 KtxC 255.0 defaultAscii 0.00 255.0 NUMBER 3 /end CHARACTERISTIC
/begin CHARACTERISTIC SGIDB9 "Sorte Hardware" ASCII 0x819F84 KtxC 255.0 defaultAscii 0.00 255.0 NUMBER 2 /end CHARACTERISTIC
/begin AXIS_PTS SKS06ESUB "SST-Verteilung für den Startadaptionsfaktor kstaa" 0x810069 kstaa SstAUbSstUb 1.992 fak_ub_b2 6 0.00 1.992 FORMAT "%5.3" DEPOSIT ABSOLUTE /end AXIS_PTS
/begin AXIS_PTS SLA05ESUB "Stützstellenverteilung Regelabweichung Lambda, 5 Sst." 0x81303E ladiff_w SstAUwSstUw 1.999969 fak_sw_b1 5 0.00 1.999969 FORMAT "%8.6" DEPOSIT ABSOLUTE /end AXIS_PTS
/begin AXIS_PTS SLD04LDUB "Stützstellenverteilung für Ladedruckregelung" 0x810070 lde SstAUbSstUb 2550. p_sb_q10 4 0.00 2550. FORMAT "%5.0" DEPOSIT ABSOLUTE /end AXIS_PTS
/begin AXIS_PTS SLX06TMUW "Stützstellenverteilung, Lambdasoll" 0x81A7FC lamsbg_w SstAUwSstUw 15.99976 fak_uw_b16 6 0.00 15.99976 FORMAT "%8.5" DEPOSIT ABSOLUTE /end AXIS_PTS
/begin AXIS_PTS SM108LHSW "dlashk_w abhängige Stützstellen (Anzahl 8)" 0x81A80A dlashkm_w SstASwSstSw 1.999969 fak_sw_b1 8 -1.000000 0.9999695 FORMAT "%8.6" DEPOSIT ABSOLUTE /end AXIS_PTS
/begin AXIS_PTS SMI04LLUB "Stützstellenverteilung: ind. Moment für Momentenreserve" 0x81304A mifa_w SstAUwSstUw 99.99847 rel_uw_b100 4 0.00 99.99847 FORMAT "%8.5" DEPOSIT ABSOLUTE /end AXIS_PTS
/begin AXIS_PTS SML05DKUB_0_A "Stützstellenvert. Luftmasse" 0x8181DE ml SstAUbSstUb 1020. m_ub_b1020 5 0.00 1020. FORMAT "%5.0" DEPOSIT ABSOLUTE /end AXIS_PTS
/begin AXIS_PTS SML05DKUB_1_A "Stützstellenvert. Luftmasse" 0x8181E4 ml SstAUbSstUb 1020. m_ub_b1020 5 0.00 1020. FORMAT "%5.0" DEPOSIT ABSOLUTE /end AXIS_PTS
/begin AXIS_PTS SML06TEUB "ml abhängige Stützstellen (Anzahl 6)" 0x8181EA ml SstAUbSstUb 1020. m_ub_b1020 6 0.00 1020. FORMAT "%5.0" DEPOSIT ABSOLUTE /end AXIS_PTS
/begin AXIS_PTS SML06TMUW "Stützstellenverteilung, Luftmasse, 6 Stützstellen" 0x81A81C ml_w SstAUwSstUw 6553.500 m_uw_b6553p5 6 0.00 6553.500 FORMAT "%8.3" DEPOSIT ABSOLUTE /end AXIS_PTS
/begin AXIS_PTS SML07TMUW "Stützstellenverteilung, Luftmasse, 7 Stützstellen" 0x81A82A ml_w SstAUwSstUw 6553.500 m_uw_b6553p5 7 0.00 6553.500 FORMAT "%8.3" DEPOSIT ABSOLUTE /end AXIS_PTS
/begin AXIS_PTS SML08LHUB_0_A "ml abhängige Stützstellen (Anzahl 8)" 0x8181F1 ml SstAUbSstUb 1020. m_ub_b1020 8 0.00 1020. FORMAT "%5.0" DEPOSIT ABSOLUTE /end AXIS_PTS
/begin AXIS_PTS SML08LHUB_1_A "ml abhängige Stützstellen (Anzahl 8)" 0x8181FA ml SstAUbSstUb 1020. m_ub_b1020 8 0.00 1020. FORMAT "%5.0" DEPOSIT ABSOLUTE /end AXIS_PTS
/begin AXIS_PTS SMT06TMUW "Stützstellenverteilung, Luftmasse, 6 Stützstellen" 0x81A83A ml_w SstAUwSstUw 6553.500 m_uw_b6553p5 6 0.00 6553.500 FORMAT "%8.3" DEPOSIT ABSOLUTE /end AXIS_PTS
/begin AXIS_PTS SNG06LLSB "Stützstellenverteilung Drehzahlgradient, 6 Sst." 0x810075 ngfil SstAUbSstSb 25500. nmotg_sb_q100 6 -12800. 12700. FORMAT "%5.0" DEPOSIT ABSOLUTE /end AXIS_PTS
/begin AXIS_PTS SNM05DKUB_0_A "Stützstellenvert. nmot" 0x818203 nmot SstAUbSstUb 10200. nmot_ub_q40 5 0.00 10200. FORMAT "%5.0" DEPOSIT ABSOLUTE /end AXIS_PTS
/begin AXIS_PTS SNM05DKUB_1_A "Stützstellenvert. nmot" 0x818209 nmot SstAUbSstUb 10200. nmot_ub_q40 5 0.00 10200. FORMAT "%5.0" DEPOSIT ABSOLUTE /end AXIS_PTS
/begin AXIS_PTS SNM05NEUW "Drehzahlstützstellen Nockenwellensollwinkel Einlaß" 0x813054 nmot_w SstAUwSstUw 16383.75 nmot_uw_q0p25 5 0.00 16383.75 FORMAT "%8.2" DEPOSIT ABSOLUTE /end AXIS_PTS
/begin AXIS_PTS SNM05NWUB "Drehzahlstützstellen Nockenwellensollwinkel" 0x81820F nmot SstAUbSstUb 10200. nmot_ub_q40 5 0.00 10200. FORMAT "%5.0" DEPOSIT ABSOLUTE /end AXIS_PTS
/begin AXIS_PTS SNM06GKUB "Stützstellen KFLAMKR, DLAMOB" 0x818215 nmot SstAUbSstUb 10200. nmot_ub_q40 6 0.00 10200. FORMAT "%5.0" DEPOSIT ABSOLUTE /end AXIS_PTS
/begin AXIS_PTS SNM06LLUB "Sützstellenverteilung für Motordrehzahl" 0x813060 nmot_w SstAUwSstUw 16383.75 nmot_uw_q0p25 6 0.00 16383.75 FORMAT "%8.2" DEPOSIT ABSOLUTE /end AXIS_PTS
/begin AXIS_PTS SNM06MDUW "Rover" 0x81A848 nmot_w SstAUwSstUw 16383.75 nmot_uw_q0p25 6 0.00 16383.75 FORMAT "%8.2" DEPOSIT ABSOLUTE /end AXIS_PTS
/begin AXIS_PTS SNM07ESUB "Stützstellenverteilung Drehzahl, 7 Sst." 0x81821C nmot SstAUbSstUb 10200. nmot_ub_q40 7 0.00 10200. FORMAT "%5.0" DEPOSIT ABSOLUTE /end AXIS_PTS
/begin AXIS_PTS SNM07LSUW "Stützstellenverteilung Reglerparameter LRS" 0x81306E nmot_w SstAUwSstUw 16383.75 nmot_uw_q0p25 7 0.00 16383.75 FORMAT "%8.2" DEPOSIT ABSOLUTE /end AXIS_PTS
/begin AXIS_PTS SNM08DMUB "SST-Verteilung in DMD, 8 Drehzahl-SST" 0x81007C nmot SstAUbSstUb 10200. nmot_ub_q40 8 0.00 10200. FORMAT "%5.0" DEPOSIT ABSOLUTE /end AXIS_PTS
/begin AXIS_PTS SNM08FEUB "Stützstellenverteilung Drehzahl, 08 Sst., Füllungseingriffe" 0x818224 nmot SstAUbSstUb 10200. nmot_ub_q40 8 0.00 10200. FORMAT "%5.0" DEPOSIT ABSOLUTE /end AXIS_PTS
/begin AXIS_PTS SNM08LDUB "Stützstellenverteilung für Ladedruckregelung" 0x810085 nmot SstAUbSstUb 10200. nmot_ub_q40 8 0.00 10200. FORMAT "%5.0" DEPOSIT ABSOLUTE /end AXIS_PTS
/begin AXIS_PTS SNM08LDUW "Stützstellenverteilung für Ladedruckregelung" 0x81307E nmot_w SstAUwSstUw 16383.75 nmot_uw_q0p25 8 0.00 16383.75 FORMAT "%8.2" DEPOSIT ABSOLUTE /end AXIS_PTS
/begin AXIS_PTS SNM08LHUB "nmot abhängige Stützstellen (Anzahl 8)" 0x81822D nmot SstAUbSstUb 10200. nmot_ub_q40 8 0.00 10200. FORMAT "%5.0" DEPOSIT ABSOLUTE /end AXIS_PTS
/begin AXIS_PTS SNM08OPUB "Stützstellenverteilung für Motordrehzahl nmot" 0x81008E nmot SstAUbSstUb 10200. nmot_ub_q40 8 0.00 10200. FORMAT "%5.0" DEPOSIT ABSOLUTE /end AXIS_PTS
/begin AXIS_PTS SNM08__UB "Stützstellenverteilung Drehzahl, 8 Sst." 0x818236 nmot SstAUbSstUb 10200. nmot_ub_q40 8 0.00 10200. FORMAT "%5.0" DEPOSIT ABSOLUTE /end AXIS_PTS
/begin AXIS_PTS SNM10LSUB "Stützstellenverteilung Kat-Vorsteuerwert LRS" 0x810097 nmot SstAUbSstUb 10200. nmot_ub_q40 10 0.00 10200. FORMAT "%5.0" DEPOSIT ABSOLUTE /end AXIS_PTS
/begin AXIS_PTS SNM10TEUB "nmot abhängige Stützstellen (Anzahl 10)" 0x81823F nmot SstAUbSstUb 10200. nmot_ub_q40 10 0.00 10200. FORMAT "%5.0" DEPOSIT ABSOLUTE /end AXIS_PTS
/begin AXIS_PTS SNM12ESUB "SST-Verteilung für die Motordrehzahl nmot" 0x8100A2 nmot SstAUbSstUb 10200. nmot_ub_q40 12 0.00 10200. FORMAT "%5.0" DEPOSIT ABSOLUTE /end AXIS_PTS
/begin AXIS_PTS SNM12FEUB "Stützstellen für WDKSMX, WDKUGDN" 0x8100AF nmot SstAUbSstUb 10200. nmot_ub_q40 12 0.00 10200. FORMAT "%5.0" DEPOSIT ABSOLUTE /end AXIS_PTS
/begin AXIS_PTS SNM12LDUW "Stützstellenverteilung für Ladedruckregelung" 0x813090 nmot_w SstAUwSstUw 16383.75 nmot_uw_q0p25 12 0.00 16383.75 FORMAT "%8.2" DEPOSIT ABSOLUTE /end AXIS_PTS
/begin AXIS_PTS SNM16CIUB "Stützstellenverteilung Drehzahl, 16 Sst." 0x81824A nmot SstAUbSstUb 10200. nmot_ub_q40 16 0.00 10200. FORMAT "%5.0" DEPOSIT ABSOLUTE /end AXIS_PTS
/begin AXIS_PTS SNM16KRDYUB "" 0x81825B nmot SstAUbSstUb 10200. nmot_ub_q40 16 0.00 10200. FORMAT "%5.0" DEPOSIT ABSOLUTE /end AXIS_PTS
/begin AXIS_PTS SNM16KRUB "Stützstellenverteilung Drehzahl, 16 Sst." 0x81826C nmot SstAUbSstUb 10200. nmot_ub_q40 16 0.00 10200. FORMAT "%5.0" DEPOSIT ABSOLUTE /end AXIS_PTS
/begin AXIS_PTS SNM16LDUB "Stützstellenverteilung für Ladedruckregelung" 0x8100BC nmot SstAUbSstUb 10200. nmot_ub_q40 16 0.00 10200. FORMAT "%5.0" DEPOSIT ABSOLUTE /end AXIS_PTS
/begin AXIS_PTS SNM16LDUW "Stützstellenverteilung für Ladedruckregelung" 0x8130AA nmot_w SstAUwSstUw 16383.75 nmot_uw_q0p25 16 0.00 16383.75 FORMAT "%8.2" DEPOSIT ABSOLUTE /end AXIS_PTS
/begin AXIS_PTS SNM16NEUW "Drehzahlstützstellen Nockenwellensollwinkel Einlaß" 0x8130CC nmot_w SstAUwSstUw 16383.75 nmot_uw_q0p25 16 0.00 16383.75 FORMAT "%8.2" DEPOSIT ABSOLUTE /end AXIS_PTS
/begin AXIS_PTS SNM16OPUW "Stützstellenverteilung Drehzahl" 0x8130EE nmot_w SstAUwSstUw 16383.75 nmot_uw_q0p25 16 0.00 16383.75 FORMAT "%8.2" DEPOSIT ABSOLUTE /end AXIS_PTS
/begin AXIS_PTS SNM16ZUUW "Stützstellenverteilung Drehzahl, 16 Sst." 0x813110 nmot_w SstAUwSstUw 16383.75 nmot_uw_q0p25 16 0.00 16383.75 FORMAT "%8.2" DEPOSIT ABSOLUTE /end AXIS_PTS
/begin AXIS_PTS SPU08LDUB "Stützstellenverteilung für Ladedruckregelung" 0x8100CD pu SstAUbSstUb 1275. p_ub_q5 8 0.00 1275. FORMAT "%5.0" DEPOSIT ABSOLUTE /end AXIS_PTS
/begin AXIS_PTS SQM05TEUB "Luftmassenquotient-abhängige Stützstellen (Anzahl =5)" 0x8100D6 qmsdyn SstAUbSstUb 15.94 fak_ub_b16 5 0.00 15.94 FORMAT "%5.2" DEPOSIT ABSOLUTE /end AXIS_PTS
/begin AXIS_PTS SRL03KRUB "Stützstellenverteilung relative Füllung, 3 Sst." 0x81827D rl SstAUbSstUb 191.3 rel_ub_q0p75 3 0.00 191.3 FORMAT "%5.1" DEPOSIT ABSOLUTE /end AXIS_PTS
/begin AXIS_PTS SRL04KRUB "Stützstellenverteilung relative Füllung, 4 Sst." 0x818281 rl SstAUbSstUb 191.3 rel_ub_q0p75 4 0.00 191.3 FORMAT "%5.1" DEPOSIT ABSOLUTE /end AXIS_PTS
/begin AXIS_PTS SRL05NEUW "Laststützstellen Nockenwellensollwinkel Einlaß" 0x813132 rlnw_w SstAUwSstUw 1535.977 rel_uw_q0p0234 5 0.00 1535.977 FORMAT "%8.3" DEPOSIT ABSOLUTE /end AXIS_PTS
/begin AXIS_PTS SRL06ESUB "Sst-Verteilung für die relative Füllung rl" 0x8100DC rl SstAUbSstUb 191.3 rel_ub_q0p75 6 0.00 191.3 FORMAT "%5.1" DEPOSIT ABSOLUTE /end AXIS_PTS
/begin AXIS_PTS SRL06GKUB "Stützstellen KFLAMKRL, KFLAFWL, KFLAMKR" 0x818286 rl SstAUbSstUb 191.3 rel_ub_q0p75 6 0.00 191.3 FORMAT "%5.1" DEPOSIT ABSOLUTE /end AXIS_PTS
/begin AXIS_PTS SRL06KRUB "" 0x81828D rl SstAUbSstUb 191.3 rel_ub_q0p75 6 0.00 191.3 FORMAT "%5.1" DEPOSIT ABSOLUTE /end AXIS_PTS
/begin AXIS_PTS SRL08DMUB "SST-Verteilung in DMD, 8 Last-SST" 0x8100E3 rl SstAUbSstUb 191.3 rel_ub_q0p75 8 0.00 191.3 FORMAT "%5.1" DEPOSIT ABSOLUTE /end AXIS_PTS
/begin AXIS_PTS SRL08LSUW "Stützstellenverteilung Reglerparameter" 0x81313E rl_w SstAUwSstUw 1535.977 rel_uw_q0p0234 8 0.00 1535.977 FORMAT "%8.3" DEPOSIT ABSOLUTE /end AXIS_PTS
/begin AXIS_PTS SRL08NEUW "Laststützstellen Nockenwellensollwinkel Einlaß" 0x813150 rlnw_w SstAUwSstUw 1535.977 rel_uw_q0p0234 8 0.00 1535.977 FORMAT "%8.3" DEPOSIT ABSOLUTE /end AXIS_PTS
/begin AXIS_PTS SRL08NXUB "Stützstellenverteilung relative Luftfüllung 8 Sst." 0x818294 rl SstAUbSstUb 191.3 rel_ub_q0p75 8 0.00 191.3 FORMAT "%5.1" DEPOSIT ABSOLUTE /end AXIS_PTS
/begin AXIS_PTS SRL10LSUB "Stützstellenverteilung Kat-Vorsteuerwert LRS" 0x8100EC rl SstAUbSstUb 191.3 rel_ub_q0p75 10 0.00 191.3 FORMAT "%5.1" DEPOSIT ABSOLUTE /end AXIS_PTS
/begin AXIS_PTS SRL12ESUB "Sst-Verteilung für die relative Füllung rl" 0x8100F7 rl SstAUbSstUb 191.3 rel_ub_q0p75 12 0.00 191.3 FORMAT "%5.1" DEPOSIT ABSOLUTE /end AXIS_PTS
/begin AXIS_PTS SRL12ZUUW "Stützstellenverteilung relative Luftfüllung, 12 St." 0x813162 rl_w SstAUwSstUw 1535.977 rel_uw_q0p0234 12 0.00 1535.977 FORMAT "%8.3" DEPOSIT ABSOLUTE /end AXIS_PTS
/begin AXIS_PTS ST107TMUB "Stützstellenverteilung, Starttemperatur an Sonde vorne" 0x81829D tabgmst SstAUbSstUb 1275. temp_ub_q5_o50 7 -50.00 1225. FORMAT "%5.0" DEPOSIT ABSOLUTE /end AXIS_PTS
/begin AXIS_PTS ST307TMUB "Stützstellenverteilung, Starttemperatur an Sonde hinten" 0x8182A5 tkatmst SstAUbSstUb 1275. temp_ub_q5_o50 7 -50.00 1225. FORMAT "%5.0" DEPOSIT ABSOLUTE /end AXIS_PTS
/begin AXIS_PTS STA04LLUB "Stützstellenverteilung: tans für Momentenreserve" 0x81317C tans SstAUwSstUw 49151.25 temp_ub_q0p75_o48 4 -48.00000 49103.25 FORMAT "%8.2" DEPOSIT ABSOLUTE /end AXIS_PTS
/begin AXIS_PTS STA06ESUB "SST-Verteilung für die Ansauglufttemperatur" 0x8182AD tans SstAUbSstUb 191.3 temp_ub_q0p75_o48 6 -48.00 143.3 FORMAT "%5.1" DEPOSIT ABSOLUTE /end AXIS_PTS
/begin AXIS_PTS STA08LDUB "Stützstellenverteilung für Ladedruckregelung" 0x810104 tans SstAUbSstUb 191.3 temp_ub_q0p75_o48 8 -48.00 143.3 FORMAT "%5.1" DEPOSIT ABSOLUTE /end AXIS_PTS
/begin AXIS_PTS STA12WLUB "SST-Verteilung für die Ansauglufttemperatur" 0x81010D tans SstAUbSstUb 191.3 temp_ub_q0p75_o48 12 -48.00 143.3 FORMAT "%5.1" DEPOSIT ABSOLUTE /end AXIS_PTS
/begin AXIS_PTS STK04SAUB "SST-Verteilung Kattemperatur für Funktion SAWE" 0x8182B4 tkatm SstAUbSstUb 1275. temp_ub_q5_o50 4 -50.00 1225. FORMAT "%5.0" DEPOSIT ABSOLUTE /end AXIS_PTS
/begin AXIS_PTS STM04FEUB "Stützstellenverteilung Motortemperatur" 0x81011A tmot SstAUbSstUb 191.3 temp_ub_q0p75_o48 4 -48.00 143.3 FORMAT "%5.1" DEPOSIT ABSOLUTE /end AXIS_PTS
/begin AXIS_PTS STM04SAUB "Stützstellenverteilung Motortemperatur, 4 Sst." 0x81011F tmot SstAUbSstUb 191.3 temp_ub_q0p75_o48 4 -48.00 143.3 FORMAT "%5.1" DEPOSIT ABSOLUTE /end AXIS_PTS
/begin AXIS_PTS STM05SAUB "Stützstellenverteilung" 0x8182B9 tmot SstAUbSstUb 191.3 temp_ub_q0p75_o48 5 -48.00 143.3 FORMAT "%5.1" DEPOSIT ABSOLUTE /end AXIS_PTS
/begin AXIS_PTS STM05TMUB "Stützstellenverteilung, Motorstarttemperatur" 0x8182BF tmst SstAUbSstUb 191.3 temp_ub_q0p75_o48 5 -48.00 143.3 FORMAT "%5.1" DEPOSIT ABSOLUTE /end AXIS_PTS
/begin AXIS_PTS STM06LLUB "Stützstellenverteilung Motortemperatur, 6 Sst." 0x8182C5 tmot SstAUbSstUb 191.3 temp_ub_q0p75_o48 6 -48.00 143.3 FORMAT "%5.1" DEPOSIT ABSOLUTE /end AXIS_PTS
/begin AXIS_PTS STM06__UB "Stützstellenverteilung Motortemperatur, 6 Sst." 0x8182CC tmot SstAUbSstUb 191.3 temp_ub_q0p75_o48 6 -48.00 143.3 FORMAT "%5.1" DEPOSIT ABSOLUTE /end AXIS_PTS
/begin AXIS_PTS STM08DMUB "8 Motortemperaturstützstellen für DMD" 0x810124 tmot SstAUbSstUb 191.3 temp_ub_q0p75_o48 8 -48.00 143.3 FORMAT "%5.1" DEPOSIT ABSOLUTE /end AXIS_PTS
/begin AXIS_PTS STM08GKUB "8 Motortemperaturstützstellen für KFLAFWL" 0x8182D3 tmot SstAUbSstUb 191.3 temp_ub_q0p75_o48 8 -48.00 143.3 FORMAT "%5.1" DEPOSIT ABSOLUTE /end AXIS_PTS
/begin AXIS_PTS STM08MDUB "Stützstellenverteilung: tmot für Drehmomentwandler" 0x8182DC tmot SstAUbSstUb 191.3 temp_ub_q0p75_o48 8 -48.00 143.3 FORMAT "%5.1" DEPOSIT ABSOLUTE /end AXIS_PTS
/begin AXIS_PTS STM08OPUB "" 0x81012D tmot SstAUbSstUb 191.3 temp_ub_q0p75_o48 8 -48.00 143.3 FORMAT "%5.1" DEPOSIT ABSOLUTE /end AXIS_PTS
/begin AXIS_PTS STM09ESUB "Stützstellenverteilung Motortemperatur, 9 Sst." 0x8182E5 tmot SstAUbSstUb 191.3 temp_ub_q0p75_o48 9 -48.00 143.3 FORMAT "%5.1" DEPOSIT ABSOLUTE /end AXIS_PTS
/begin AXIS_PTS STM10__UB "" 0x8182EF tmot SstAUbSstUb 191.3 temp_ub_q0p75_o48 10 -48.00 143.3 FORMAT "%5.1" DEPOSIT ABSOLUTE /end AXIS_PTS
/begin AXIS_PTS STM12ESUB "SST-Verteilung für die Motortemperatur tmot" 0x810136 tmot SstAUbSstUb 191.3 temp_ub_q0p75_o48 12 -48.00 143.3 FORMAT "%5.1" DEPOSIT ABSOLUTE /end AXIS_PTS
/begin AXIS_PTS STN06LLUB "Stützstellenverteilung: Zeit nach Start; für Drehzahlverlauf nach Start" 0x8182FA tnst SstAUbSstUb 255.0 t1sxs_ub_b255 6 0.00 255.0 FORMAT "%5.1" DEPOSIT ABSOLUTE /end AXIS_PTS
/begin AXIS_PTS STS08LDUB "Stützstellenverteilung tsel für Ladedruckregelung" 0x810143 tsel SstAUbSstUb 191.3 temp_ub_q0p75_o48 8 -48.00 143.3 FORMAT "%5.1" DEPOSIT ABSOLUTE /end AXIS_PTS
/begin AXIS_PTS STS12ESUB "SST-Verteilung für Motorstarttemperatur" 0x81014C tmst SstAUbSstUb 191.3 temp_ub_q0p75_o48 12 -48.00 143.3 FORMAT "%5.1" DEPOSIT ABSOLUTE /end AXIS_PTS
/begin AXIS_PTS SVP12LDUW "Stützstellenverteilung für vpssplg bei LDR" 0x813186 vpssplg_w SstAUwSstUw 3.999939 fak_uw_b4 12 0.00 3.999939 FORMAT "%8.6" DEPOSIT ABSOLUTE /end AXIS_PTS
/begin AXIS_PTS SWP08OPUB "Stützstellenverteilung für Pedalstellung wped" 0x810159 wped SstAUbSstUb 100.0 relPED_ub_b100 8 0.00 100.0 FORMAT "%5.1" DEPOSIT ABSOLUTE /end AXIS_PTS
/begin CHARACTERISTIC TASLSO "obere Ansauglufttemperaturschwelle für Sekundärluftsystem" VALUE 0x818385 KwUb 191.3 temp_ub_q0p75_o48 -48.00 143.3 FORMAT "%5.1" /end CHARACTERISTIC
/begin CHARACTERISTIC TASLSU "untere Ansauglufttemperaturschwelle für Sekundärluftsystem" VALUE 0x818386 KwUb 191.3 temp_ub_q0p75_o48 -48.00 143.3 FORMAT "%5.1" /end CHARACTERISTIC
/begin CHARACTERISTIC TDDSLA "Dauer Sekundärlufteinblasung für Adaptionsphase" VALUE 0x818387 KwUb 25.50 t100msxs_ub_b25p5 0.00 25.50 FORMAT "%5.2" /end CHARACTERISTIC
/begin CHARACTERISTIC TDSLKT "Dauer Kurztest Sekundärluftdiagnose für Massenmessung" VALUE 0x818388 KwUb 25.50 t100msxs_ub_b25p5 0.00 25.50 FORMAT "%5.2" /end CHARACTERISTIC
/begin CHARACTERISTIC TEMIN "minimales TE" VALUE 0x81553A KwUw 174.7600 tinjection_sy 0.00 174.7600 FORMAT "%8.4" /end CHARACTERISTIC
/begin CHARACTERISTIC TEMINVA "minimales TE bei VA" VALUE 0x81553C KwUw 174.7600 tinjection_sy 0.00 174.7600 FORMAT "%8.4" /end CHARACTERISTIC
/begin CHARACTERISTIC TFASLAMN "Mindestzeit nach Katheizen für Testeranforderung Sekundärluftdiagnose" VALUE 0x81A890 KwUw 6553.500 t100msxs_uw_b6553p6 0.00 6553.500 FORMAT "%8.3" /end CHARACTERISTIC
/begin CHARACTERISTIC TLMSSLAB "Entprellzeit für Abbruch Sekundärluftanfettung" VALUE 0x818389 KwUb 25.40 t100msxs_ub_b25p5 0.1000 25.50 FORMAT "%5.2" /end CHARACTERISTIC
/begin CHARACTERISTIC TLMSSLMX "Maximale Zeit für Sekundärluftanfettung im Leerlauf" VALUE 0x81838A KwUb 255.0 t100msxs_ub_b255 0.00 255.0 FORMAT "%5.1" /end CHARACTERISTIC
/begin CHARACTERISTIC TMADB0 "Motortemperaturbereich 0 für Berechnung Kaltstartanreicherung" VALUE 0x810E87 KwUb 255.0 dez 0.00 255.0 FORMAT "%5.1" /end CHARACTERISTIC
/begin CHARACTERISTIC TMADB1 "Motortemperaturbereich 1 für Berechnung Kaltstartanreicherung" VALUE 0x810E88 KwUb 255.0 dez 0.00 255.0 FORMAT "%5.1" /end CHARACTERISTIC
/begin CHARACTERISTIC TMADB2 "Motortemperaturbereich 2 für Berechnung Kaltstartanreicherung" VALUE 0x810E89 KwUb 255.0 dez 0.00 255.0 FORMAT "%5.1" /end CHARACTERISTIC
/begin CHARACTERISTIC TMFASLMN "Motortemperaturschwelle Testeranforderung Sekundärluftdiagnose" VALUE 0x81838B KwUb 191.3 temp_ub_q0p75_o48 -48.00 143.3 FORMAT "%5.1" /end CHARACTERISTIC
/begin CHARACTERISTIC TMLIM "TMOT Schwelle für  KSTAA aktiv im Nachstart" VALUE 0x810E8A KwUb 191.3 temp_ub_q0p75_o48 -48.00 143.3 FORMAT "%5.1" /end CHARACTERISTIC
/begin CHARACTERISTIC TMNWLLKHE "Motortemperaturschwelle zur Aktivierung Katheiz KF im Leerlauf Einlaßnockenwelle" VALUE 0x811F5F KwUb 191.3 temp_ub_q0p75_o48 -48.00 143.3 FORMAT "%5.1" /end CHARACTERISTIC
/begin CHARACTERISTIC TMOD8TE "Aktivzeit für TE-Dichtheitsprüfung in Mode 8" VALUE 0x81B406 KwUw 65535.00 t1sxs_uw_q1 0.00 65535.00 FORMAT "%8.2" /end CHARACTERISTIC
/begin CHARACTERISTIC TMOTNMX "Motortemperatur-Schwelle für Aktivierung der erhöhten Drehzahlgrenze" VALUE 0x81FBBA KwUb 191.3 temp_ub_q0p75_o48 -48.00 143.3 FORMAT "%5.1" /end CHARACTERISTIC
/begin CHARACTERISTIC TMSSLO "obere Starttemperaturschwelle für Sekundärluft" VALUE 0x81838C KwUb 191.3 temp_ub_q0p75_o48 -48.00 143.3 FORMAT "%5.1" /end CHARACTERISTIC
/begin CHARACTERISTIC TMSSLSTO "obere Temperaturschwelle für Sekundärluft im Start" VALUE 0x81838D KwUb 191.3 temp_ub_q0p75_o48 -48.00 143.3 FORMAT "%5.1" /end CHARACTERISTIC
/begin CHARACTERISTIC TMSSLSTU "untere Temperaturschwelle für Sekundärluft im Start" VALUE 0x81838E KwUb 191.3 temp_ub_q0p75_o48 -48.00 143.3 FORMAT "%5.1" /end CHARACTERISTIC
/begin CHARACTERISTIC TMSSLU "untere Starttemperaturschwelle für Sekundärluft" VALUE 0x81838F KwUb 191.3 temp_ub_q0p75_o48 -48.00 143.3 FORMAT "%5.1" /end CHARACTERISTIC
/begin CHARACTERISTIC TNMXH "Maximale Zeitdauer für erhöhte Drehzahlgrenze" VALUE 0x8169CA KwUw 655.3500 t10msxs_uw_b655p35 0.00 655.3500 FORMAT "%8.4" /end CHARACTERISTIC
/begin CHARACTERISTIC TNWAPTE "Zeit Einlassnockenwelle in Aktivposition bei Testereingriff" VALUE 0x81A33D KwUb 12.70 t50msxs_q0p05 0.05000 12.75 FORMAT "%5.2" /end CHARACTERISTIC
/begin CHARACTERISTIC TNWFARE "Zeitkonstante für Sollwinkelaufsteuerung der Einlassnockenwelle durch  Tester" VALUE 0x827FF2 KwUw 3276.7499992 zk50msxs_uw_b3276p8 0.050000762951 3276.8000000 FORMAT "%12.7" /end CHARACTERISTIC
/begin CHARACTERISTIC TNWPPTE "Zeit Einlassnockenwelle in Passivposition bei Testereingriff" VALUE 0x81A33E KwUb 12.70 t50msxs_q0p05 0.05000 12.75 FORMAT "%5.2" /end CHARACTERISTIC
/begin CHARACTERISTIC TNWSABGKE "Zeitkonstante für Sollwertänderungsbegrenzung Einlaßnockenwelle kalt" CURVE 0x811F60 GklWUb 2.54000 zk10msxs_ub_b2p55 0.0100000 2.55000 FORMAT "%7.5"
 /begin AXIS_DESCR COM_AXIS nmot nmot_ub_q40 5 0.00 10200. AXIS_PTS_REF SNM05NWUB /end AXIS_DESCR
/end CHARACTERISTIC
/begin CHARACTERISTIC TNWSNABGE "Zeitkonstante für negative Sollwertänderungsbegrenzung Einlaßnockenwelle" CURVE 0x811F65 GklWUb 2.54000 zk10msxs_ub_b2p55 0.0100000 2.55000 FORMAT "%7.5"
 /begin AXIS_DESCR COM_AXIS nmot nmot_ub_q40 5 0.00 10200. AXIS_PTS_REF SNM05NWUB /end AXIS_DESCR
/end CHARACTERISTIC
/begin CHARACTERISTIC TNWSPABGE "Zeitkonstante für positive Sollwertänderungsbegrenzung Einlaßnockenwelle" CURVE 0x811F6A GklWUb 2.54000 zk10msxs_ub_b2p55 0.0100000 2.55000 FORMAT "%7.5"
 /begin AXIS_DESCR COM_AXIS nmot nmot_ub_q40 5 0.00 10200. AXIS_PTS_REF SNM05NWUB /end AXIS_DESCR
/end CHARACTERISTIC
/begin CHARACTERISTIC TNWVBGNE "Zeit bis Verstellung der Einlassnockenwelle durch Tester beginnt" VALUE 0x81A33F KwUb 12.70 t50msxs_q0p05 0.05000 12.75 FORMAT "%5.2" /end CHARACTERISTIC
/begin CHARACTERISTIC TSLABB "Verweilzeit für Sekundärluft- Abbruchbedingung" VALUE 0x818390 KwUb 25.40 t100msxs_ub_b25p5 0.1000 25.50 FORMAT "%5.2" /end CHARACTERISTIC
/begin CHARACTERISTIC TSLPMN "Mindesteinschaltdauer der Sekundärluftpumpe" VALUE 0x818391 KwUb 25.40 t100msxs_ub_b25p5 0.1000 25.50 FORMAT "%5.2" /end CHARACTERISTIC
/begin CHARACTERISTIC TSLUBST "Entprellzeit für Sekundärluft ein im Start bei UBSLSTMN" VALUE 0x818392 KwUb 25.50 t100msxs_ub_b25p5 0.00 25.50 FORMAT "%5.2" /end CHARACTERISTIC
/begin CHARACTERISTIC TVDSLOFF "Zeitverzögerung Schließen Sekundärluftventil bei Adaption/Kurztrip" VALUE 0x818393 KwUb 25.50 t100msxs_ub_b25p5 0.00 25.50 FORMAT "%5.2" /end CHARACTERISTIC
/begin CHARACTERISTIC TVSLVOFF "Zeitverzögerung Schließen Sekundärluftventil" VALUE 0x818394 KwUb 25.50 t100msxs_ub_b25p5 0.00 25.50 FORMAT "%5.2" /end CHARACTERISTIC
/begin CHARACTERISTIC TVSLVON "Zeitverzögerung Öffnen Sekundärluftventil" VALUE 0x818395 KwUb 25.40 t100msxs_ub_b25p5 0.1000 25.50 FORMAT "%5.2" /end CHARACTERISTIC
/begin CHARACTERISTIC TVTSPEV "Korrektur der Einspritzzeit in Abhängigkeit von evtmod" CURVE 0x81CFF4 KlAUwSstUwWUw 174.7600 tinjection_sy 0.00 174.7600 FORMAT "%8.4"
 /begin AXIS_DESCR STD_AXIS evtmodev temp_ub_q0p75_o48 4 -48.00000 49103.25 FORMAT "%8.2" DEPOSIT ABSOLUTE /end AXIS_DESCR
/end CHARACTERISTIC
/begin CHARACTERISTIC TVUB "Spannungskorrektur" CURVE 0x81553E KlAUbSstUbWUw 174.7600 tinjection_sy 0.00 174.7600 FORMAT "%8.4"
 /begin AXIS_DESCR STD_AXIS ub spg_ubatt 5 0.00 17.95 FORMAT "%5.2" DEPOSIT ABSOLUTE /end AXIS_DESCR
/end CHARACTERISTIC
/begin CHARACTERISTIC UBDTRDE "Batteriespannungsabfall für Erkennung 'Starter eingerückt'" VALUE 0x8184AF KwUb 17.95 spg_ubatt 0.00 17.95 FORMAT "%5.2" /end CHARACTERISTIC
/begin CHARACTERISTIC UBKST "Ubat-Schwelle für ZUBKSTMX" VALUE 0x810E8B KwUb 17.95 spg_ubatt 0.00 17.95 FORMAT "%5.2" /end CHARACTERISTIC
/begin CHARACTERISTIC UBKSTMX "Anzahlschwelle Ubat unter UBKST für Adaptionssperrung" VALUE 0x810E8C KwUb 255.0 dez 0.00 255.0 FORMAT "%5.1" /end CHARACTERISTIC
/begin CHARACTERISTIC UBSLMN "min. Spannung für Sekundärluft ein" VALUE 0x81A892 KwUw 25.59961 spg_q0p00039 0.00 25.59961 FORMAT "%8.5" /end CHARACTERISTIC
/begin CHARACTERISTIC UBSLMX "max. Spannung für Sekundärluft ein" VALUE 0x81A894 KwUw 25.59961 spg_q0p00039 0.00 25.59961 FORMAT "%8.5" /end CHARACTERISTIC
/begin CHARACTERISTIC UBSLSTMN "min.Spannung für Sekundärluft ein im Start" VALUE 0x81A896 KwUw 25.59961 spg_q0p00039 0.00 25.59961 FORMAT "%8.5" /end CHARACTERISTIC
/begin CHARACTERISTIC VNMX "Geschwindigkeits-Schwelle für Aktivierung der erhöhten Drehzahlgrenze" VALUE 0x8116D9 KwUb 318.8 vfzg_ub_q1p25 0.00 318.8 FORMAT "%5.1" /end CHARACTERISTIC
/begin CHARACTERISTIC VSLS "Schwelle Fahrzeuggeschwindigkeit für SLS ein" VALUE 0x818396 KwUb 318.8 vfzg_ub_q1p25 0.00 318.8 FORMAT "%5.1" /end CHARACTERISTIC
/begin CHARACTERISTIC WAD0T1 "Wichtungsfaktor Adaptionsbereich 0 zu 1" VALUE 0x810E8D KwUb 15.94 fak_ub_b16 0.00 15.94 FORMAT "%5.2" /end CHARACTERISTIC
/begin CHARACTERISTIC WAD0T2 "Wichtungsfaktor Adaptionsbereich 0 zu 2" VALUE 0x810E8E KwUb 15.94 fak_ub_b16 0.00 15.94 FORMAT "%5.2" /end CHARACTERISTIC
/begin CHARACTERISTIC WAD1T0 "Wichtungsfaktor Adaptionsbereich 1 zu 0" VALUE 0x810E8F KwUb 15.94 fak_ub_b16 0.00 15.94 FORMAT "%5.2" /end CHARACTERISTIC
/begin CHARACTERISTIC WAD1T2 "Wichtungsfaktor Adaptionsbereich 1 zu 2" VALUE 0x810E90 KwUb 15.94 fak_ub_b16 0.00 15.94 FORMAT "%5.2" /end CHARACTERISTIC
/begin CHARACTERISTIC WAD2T0 "Wichtungsfaktor Adaptionsbereich 2 zu 0" VALUE 0x810E91 KwUb 15.94 fak_ub_b16 0.00 15.94 FORMAT "%5.2" /end CHARACTERISTIC
/begin CHARACTERISTIC WAD2T1 "Wichtungsfaktor Adaptionsbereich 2 zu 1" VALUE 0x810E92 KwUb 15.94 fak_ub_b16 0.00 15.94 FORMAT "%5.2" /end CHARACTERISTIC
/begin CHARACTERISTIC WESSOT "Winkel Einlass schliesst spät bis OT" VALUE 0x810004 KwUb 717.2 kw_q2p8125 0.00 717.2 FORMAT "%5.1" /end CHARACTERISTIC
/begin CHARACTERISTIC WNWBKVE "Winkel NW-Position  mit min. Überschneidung Einlaßnockenwelle bei BKV leer" VALUE 0x8171AE KwSw 511.9922 kw_sw_q0p0078 -256.0000 255.9922 FORMAT "%8.4" /end CHARACTERISTIC
/begin CHARACTERISTIC WNWDSHKE "Deltasollwinkel Nockenwelle Korrektur Katheizen über Höhe Einlaß" CURVE 0x828A0A KlAUwSstUwWSw 511.9922 kw_sw_q0p0078 -256.0000 255.9922 FORMAT "%8.4"
 /begin AXIS_DESCR STD_AXIS fho_w fak_uw_b4 4 0.00 3.999939 FORMAT "%8.6" DEPOSIT ABSOLUTE /end AXIS_DESCR
/end CHARACTERISTIC
/begin CHARACTERISTIC WNWREO "Winkel Einlassventil öffnet in Referenzposition bezogen auf Ladungswechsel(LWOT)" VALUE 0x8171B0 KwSw 511.9922 kw_sw_q0p0078 -256.0000 255.9922 FORMAT "%8.4" /end CHARACTERISTIC
/begin CHARACTERISTIC WNWSAMXE "Maxwert zur Berechnung der Sollwertänderungsbegrenzung Einlass Nockenwelle" VALUE 0x828A1C KwUw 255.9961 kw_q0p0039 0.00 255.9961 FORMAT "%8.4" /end CHARACTERISTIC
/begin CHARACTERISTIC WNWSEAPP "Applikationswert für den Einlaß-Nockenwellensollwinkel" VALUE 0x828A1E KwSw 511.9922 kw_sw_q0p0078 -256.0000 255.9922 FORMAT "%8.4" /end CHARACTERISTIC
/begin CHARACTERISTIC WNWSMNA "Minimal zulässiger Sollwert für Nockenwellenverstellung Auslass schliesst (LWOT)" VALUE 0x827FDE KwSw 511.9922 kw_sw_q0p0078 -256.0000 255.9922 FORMAT "%8.4" /end CHARACTERISTIC
/begin CHARACTERISTIC WNWSMNE "Minimal zulässiger Sollwert für Nockenwellenverstellung Einlass öffnet (LWOT)" VALUE 0x828A20 KwSw 511.9922 kw_sw_q0p0078 -256.0000 255.9922 FORMAT "%8.4" /end CHARACTERISTIC
/begin CHARACTERISTIC WNWSMXA "Maximal zulässiger Sollwert für Nockenwellenverstellung Auslass schliesst (LWOT)" VALUE 0x827FE0 KwSw 511.9922 kw_sw_q0p0078 -256.0000 255.9922 FORMAT "%8.4" /end CHARACTERISTIC
/begin CHARACTERISTIC WNWSMXE "Maximal zulässiger Sollwert für Nockenwellenverstellung Einlass öffnet (LWOT)" VALUE 0x828A22 KwSw 511.9922 kw_sw_q0p0078 -256.0000 255.9922 FORMAT "%8.4" /end CHARACTERISTIC
/begin CHARACTERISTIC WNWSTE "Sollwinkel für Einlaßnockenwellenposition während Start" CURVE 0x828A24 KlAUbSstSwWSw 511.9922 kw_sw_q0p0078 -256.0000 255.9922 FORMAT "%8.4"
 /begin AXIS_DESCR STD_AXIS tmot temp_ub_q0p75_o48 4 -24624.00 24527.25 FORMAT "%8.2" DEPOSIT ABSOLUTE /end AXIS_DESCR
/end CHARACTERISTIC
/begin CHARACTERISTIC WNWSWOFE "Sollwinkel für Einlaßnockenwellenposition bei S_KL15 = aus" CURVE 0x828A36 KlAUbSstSwWSw 511.9922 kw_sw_q0p0078 -256.0000 255.9922 FORMAT "%8.4"
 /begin AXIS_DESCR STD_AXIS tumg temp_ub_q0p75_o48 4 -24624.00 24527.25 FORMAT "%8.2" DEPOSIT ABSOLUTE /end AXIS_DESCR
/end CHARACTERISTIC
/begin CHARACTERISTIC WNWUEMXT "theoretisch maximaler Nockenwellenüberschneidungswinkel" VALUE 0x818302 KwUb 127.5 kw_ub_q0p5 0.00 127.5 FORMAT "%5.1" /end CHARACTERISTIC
/begin CHARACTERISTIC ZBURNABR "Verbrennungsanzahl für Entscheidung Adaptionsabbruch" VALUE 0x810E93 KwUb 255.0 dez 0.00 255.0 FORMAT "%5.1" /end CHARACTERISTIC
/begin CHARACTERISTIC ZBURNDEC "Zu überschreitende Verbrennungsanzahl für ""Abmagern""" VALUE 0x810E94 KwUb 255.0 dez 0.00 255.0 FORMAT "%5.1" /end CHARACTERISTIC
/begin CHARACTERISTIC ZBURNSOL "Erforderliche Verbrennungsanzahl für ""keine Anreicherung""" VALUE 0x810E95 KwUb 255.0 dez 0.00 255.0 FORMAT "%5.1" /end CHARACTERISTIC
/begin CHARACTERISTIC ZFLMSSL "Zeitkonstante Gemischanteil Sekundärluft" VALUE 0x818397 KwUb 25.4996 zk100msxs_ub_b25p5 0.100392 25.6000 FORMAT "%7.4" /end CHARACTERISTIC
/begin CHARACTERISTIC ZKSLPOFF "Zeitkonstante Runterlauf Sekundärluftgebläse" VALUE 0x818398 KwUb 25.4996 zk100msxs_ub_b25p5 0.100392 25.6000 FORMAT "%7.4" /end CHARACTERISTIC
/begin CHARACTERISTIC ZKSLPON "Zeitkonstante Hochlauf Sekundärluftgebläse" VALUE 0x818399 KwUb 25.4996 zk100msxs_ub_b25p5 0.100392 25.6000 FORMAT "%7.4" /end CHARACTERISTIC
/begin CHARACTERISTIC ZKSLSOFML "Zeitkonstante Ausräumen der Sekundärluft nach Ventil schließen" CURVE 0x81A898 KlAUwSstUwWUw 6553.4999985 zk100msxs_uw_b6553 0.10000152590 6553.6000000 FORMAT "%12.7"
 /begin AXIS_DESCR STD_AXIS ml_w m_uw_b6553p5 4 0.00 6553.500 FORMAT "%8.3" DEPOSIT ABSOLUTE /end AXIS_DESCR
/end CHARACTERISTIC
/begin CHARACTERISTIC ZKSLSONML "Zeitkonstante Einbringen der Sekundärluft nach Ventil öffnen" CURVE 0x81A8AA KlAUwSstUwWUw 6553.4999985 zk100msxs_uw_b6553 0.10000152590 6553.6000000 FORMAT "%12.7"
 /begin AXIS_DESCR STD_AXIS ml_w m_uw_b6553p5 4 0.00 6553.500 FORMAT "%8.3" DEPOSIT ABSOLUTE /end AXIS_DESCR
/end CHARACTERISTIC
/begin CHARACTERISTIC ZSYNABR "Zündungsanzahl für Entscheidung Adaptionsabbruch" VALUE 0x810E96 KwUb 255.0 dez 0.00 255.0 FORMAT "%5.1" /end CHARACTERISTIC
/begin CHARACTERISTIC ZSYNAUSW "Anzahl Zündungen (Synchros) bis Auswerten" VALUE 0x810E97 KwUb 255.0 dez 0.00 255.0 FORMAT "%5.1" /end CHARACTERISTIC
/begin CHARACTERISTIC ZTSPEV "Zeitkonstante zur Bildung der Spulentemperatur eines Einspritzventils" VALUE 0x81D006 KwUw 6553.4999985 zk100msxs_uw_b6553 0.10000152590 6553.6000000 FORMAT "%12.7" /end CHARACTERISTIC
/begin MEASUREMENT adastep "Adaptionsschritt für STADAP-Faktor" SBYTE fak_sb_b1 1 100 -1 0.992188 FORMAT "%5.3" ECU_ADDRESS 0x380A41 /end MEASUREMENT
/begin MEASUREMENT bfgrsbr "FGR-Sollbeschleunigung bei aktivem Bremseneingriff" UBYTE bfgrsc_ub_q0p024_o3p984 1 100 -3.984 2.136 FORMAT "%5.3" ECU_ADDRESS 0x38088E /end MEASUREMENT
/begin MEASUREMENT bglbzausbits "" UBYTE dez 1 100 0 255 FORMAT "%5.1" ECU_ADDRESS 0x384800 /end MEASUREMENT
/begin MEASUREMENT B_4wd "Bedingung Allrad-Antrieb" UWORD B_TRUE 1 100 0 1 BIT_MASK 0x1 FORMAT "%13.11" ECU_ADDRESS 0xFD00 /end MEASUREMENT
/begin MEASUREMENT B_abstnl "Bedingung Abstellzeitermittlung über SG-Nachlauf" UWORD B_TRUE 1 100 0 1 BIT_MASK 0x2 FORMAT "%13.11" ECU_ADDRESS 0xFD00 /end MEASUREMENT
/begin MEASUREMENT B_abw "Bedingung Abwürgen Motor" UBYTE B_TRUE 1 100 0 1 BIT_MASK 0x8 FORMAT "%13.11" ECU_ADDRESS 0x380969 /end MEASUREMENT
/begin MEASUREMENT B_accab "Bedingung: ACC-Abschaltung aus Funktionsebene" UWORD B_TRUE 1 100 0 1 BIT_MASK 0x1 FORMAT "%13.11" ECU_ADDRESS 0xFD0A /end MEASUREMENT
/begin MEASUREMENT B_ad "Bedingung Adaption erlaubt" UWORD B_TRUE 1 100 0 1 BIT_MASK 0x1 FORMAT "%13.11" ECU_ADDRESS 0x384B1C /end MEASUREMENT
/begin MEASUREMENT B_adb0 "Bedingung Adaptionsbereich 0" UWORD B_TRUE 1 100 0 1 BIT_MASK 0x2 FORMAT "%13.11" ECU_ADDRESS 0x384B1C /end MEASUREMENT
/begin MEASUREMENT B_adb1 "Bedingung Adaptionsbereich 1" UWORD B_TRUE 1 100 0 1 BIT_MASK 0x4 FORMAT "%13.11" ECU_ADDRESS 0x384B1C /end MEASUREMENT
/begin MEASUREMENT B_adb2 "Bedingung Adaptionsbereich 2" UWORD B_TRUE 1 100 0 1 BIT_MASK 0x8 FORMAT "%13.11" ECU_ADDRESS 0x384B1C /end MEASUREMENT
/begin MEASUREMENT B_adlck "Richtungsabhängige Startadaptionssperre" UWORD B_TRUE 1 100 0 1 BIT_MASK 0x10 FORMAT "%13.11" ECU_ADDRESS 0x384B1C /end MEASUREMENT
/begin MEASUREMENT B_adrkra "Bedingung Adaptionswerte von KR resetieren bei Fehlerspeicher löschen" UWORD B_TRUE 1 100 0 1 BIT_MASK 0x4 FORMAT "%13.11" ECU_ADDRESS 0xFD00 /end MEASUREMENT
/begin MEASUREMENT B_adrldra "Ladedruck Adaptionswerte löschen bei Fehlerspeicher löschen" UWORD B_TRUE 1 100 0 1 BIT_MASK 0x8 FORMAT "%13.11" ECU_ADDRESS 0xFD00 /end MEASUREMENT
/begin MEASUREMENT B_adrlra "Bedingung Adaptionswerte LRA resetieren bei Fehlerspeicher löschen" UWORD B_TRUE 1 100 0 1 BIT_MASK 0x10 FORMAT "%13.11" ECU_ADDRESS 0xFD00 /end MEASUREMENT
/begin MEASUREMENT B_adrmdver "Bedingung Verlustmomentenadaption löschen bei Fehlerspeicher Lösschen" UWORD B_TRUE 1 100 0 1 BIT_MASK 0x20 FORMAT "%13.11" ECU_ADDRESS 0xFD00 /end MEASUREMENT
/begin MEASUREMENT B_adrmsdk "Bedingung Adaptionswerte DK  resetieren bei Fehlerspeicher löschen" UWORD B_TRUE 1 100 0 1 BIT_MASK 0x40 FORMAT "%13.11" ECU_ADDRESS 0xFD00 /end MEASUREMENT
/begin MEASUREMENT B_adrsta "Bedingung Adaptionswerte von STADAP resetieren bei Fehlerspeicher löschen" UWORD B_TRUE 1 100 0 1 BIT_MASK 0x80 FORMAT "%13.11" ECU_ADDRESS 0xFD00 /end MEASUREMENT
/begin MEASUREMENT B_agrlrasp "Bedingung Sperren der Gemischadaption während der AGR-Kennlinienadaption" UWORD B_TRUE 1 100 0 1 BIT_MASK 0x2 FORMAT "%13.11" ECU_ADDRESS 0xFD0A /end MEASUREMENT
/begin MEASUREMENT B_anlaus "Bedingung für Anlasser ausgerückt" UBYTE B_TRUE 1 100 0 1 BIT_MASK 0x1 FORMAT "%13.11" ECU_ADDRESS 0x380969 /end MEASUREMENT
/begin MEASUREMENT B_asc_reg "CAN-Botschaft: ASC regelt (mit Bremsen-Eingriff)" UWORD B_TRUE 1 100 0 1 BIT_MASK 0x4 FORMAT "%13.11" ECU_ADDRESS 0xFD0A /end MEASUREMENT
/begin MEASUREMENT B_asrfz "Bedingung für ASR im Fahrzeug" UWORD B_TRUE 1 100 0 1 BIT_MASK 0x100 FORMAT "%13.11" ECU_ADDRESS 0xFD00 /end MEASUREMENT
/begin MEASUREMENT B_ausw "Bedingung Auswerten nach Verbrennungen" UWORD B_TRUE 1 100 0 1 BIT_MASK 0x20 FORMAT "%13.11" ECU_ADDRESS 0x384B1C /end MEASUREMENT
/begin MEASUREMENT B_autget "Bedingung Automatikgetriebe" UWORD B_TRUE 1 100 0 1 BIT_MASK 0x200 FORMAT "%13.11" ECU_ADDRESS 0xFD00 /end MEASUREMENT
/begin MEASUREMENT B_burn "letzte Verbrennung als erfolgreich erkannt (dnmot_w > dnburnsol)" UWORD B_TRUE 1 100 0 1 BIT_MASK 0x4000 FORMAT "%13.11" ECU_ADDRESS 0xFD5C /end MEASUREMENT
/begin MEASUREMENT B_bzsync "" UWORD B_TRUE 1 100 0 1 BIT_MASK 0x8 FORMAT "%13.11" ECU_ADDRESS 0xFD06 /end MEASUREMENT
/begin MEASUREMENT B_cdagr "Funktion über Codewort CDAGR freigegeben" UWORD B_TRUE 1 100 0 1 BIT_MASK 0x8000 FORMAT "%13.11" ECU_ADDRESS 0x380BF2 /end MEASUREMENT
/begin MEASUREMENT B_cdagrl "Funktion über Codewort CDAGRL freigeben" UWORD B_TRUE 1 100 0 1 BIT_MASK 0x200 FORMAT "%13.11" ECU_ADDRESS 0x380BF4 /end MEASUREMENT
/begin MEASUREMENT B_cdanws "Funktion über Codewort CDNWS freigegeben (Auslaß)" UWORD B_TRUE 1 100 0 1 BIT_MASK 0x2000 FORMAT "%13.11" ECU_ADDRESS 0x380BF4 /end MEASUREMENT
/begin MEASUREMENT B_cdatr "Bedingung: Diagnose Abgastemperaturregelung freigegeben" UWORD B_TRUE 1 100 0 1 BIT_MASK 0x400 FORMAT "%13.11" ECU_ADDRESS 0x380BF2 /end MEASUREMENT
/begin MEASUREMENT B_cdats "Bedingung Diagnose Abgastemperatursensor freigegeben" UWORD B_TRUE 1 100 0 1 BIT_MASK 0x200 FORMAT "%13.11" ECU_ADDRESS 0x380BF2 /end MEASUREMENT
/begin MEASUREMENT B_cdbkvp "Funktion über Codewort CDBKVP freigegeben" UWORD B_TRUE 1 100 0 1 BIT_MASK 0x20 FORMAT "%13.11" ECU_ADDRESS 0x380BF6 /end MEASUREMENT
/begin MEASUREMENT B_cddsbkv "Funktion über Codewort CDDSBKV freigegeben" UWORD B_TRUE 1 100 0 1 BIT_MASK 0x10 FORMAT "%13.11" ECU_ADDRESS 0x380BF6 /end MEASUREMENT
/begin MEASUREMENT B_cddst "Funktion über Codewort CDDST freigegeben" UWORD B_TRUE 1 100 0 1 BIT_MASK 0x1000 FORMAT "%13.11" ECU_ADDRESS 0x380BF2 /end MEASUREMENT
/begin MEASUREMENT B_cdegfe "Bedingung: Diagnose DEGFE freigegeben." UWORD B_TRUE 1 100 0 1 BIT_MASK 0x40 FORMAT "%13.11" ECU_ADDRESS 0x380BF6 /end MEASUREMENT
/begin MEASUREMENT B_cdehfm "Funktion %DHFM über Codewort CDEHFM in %KONCW freigegeben" UWORD B_TRUE 1 100 0 1 BIT_MASK 0x4000 FORMAT "%13.11" ECU_ADDRESS 0x380BF4 /end MEASUREMENT
/begin MEASUREMENT B_cdenws "Funktion über Codewort CDNWS freigegeben (Einlaß)" UWORD B_TRUE 1 100 0 1 BIT_MASK 0x2 FORMAT "%13.11" ECU_ADDRESS 0x380BF4 /end MEASUREMENT
/begin MEASUREMENT B_cdgts "Bedingung: Funktion GGGTS über Codewort CDGGGTS freigeben" UWORD B_TRUE 1 100 0 1 BIT_MASK 0x400 FORMAT "%13.11" ECU_ADDRESS 0xFD00 /end MEASUREMENT
/begin MEASUREMENT B_cdhsh "Funktion über Codewort CDHSH freigegeben" UWORD B_TRUE 1 100 0 1 BIT_MASK 0x80 FORMAT "%13.11" ECU_ADDRESS 0x380BF2 /end MEASUREMENT
/begin MEASUREMENT B_cdhshe "Funktion über Codewort CDHSHE freigegeben" UWORD B_TRUE 1 100 0 1 BIT_MASK 0x80 FORMAT "%13.11" ECU_ADDRESS 0x380BF4 /end MEASUREMENT
/begin MEASUREMENT B_cdhsv "Funktion über Codewort CDHSV freigegeben" UWORD B_TRUE 1 100 0 1 BIT_MASK 0x40 FORMAT "%13.11" ECU_ADDRESS 0x380BF2 /end MEASUREMENT
/begin MEASUREMENT B_cdhsve "Funktion über Codewort CDHSVE freigegeben" UWORD B_TRUE 1 100 0 1 BIT_MASK 0x100 FORMAT "%13.11" ECU_ADDRESS 0x380BF4 /end MEASUREMENT
/begin MEASUREMENT B_cdhsvsa "Funktion über Codewort CDHSVSA freigegeben" UWORD B_TRUE 1 100 0 1 BIT_MASK 0x800 FORMAT "%13.11" ECU_ADDRESS 0x380BF4 /end MEASUREMENT
/begin MEASUREMENT B_cdkat "Funktion über Codewort CDKAT freigegeben" UWORD B_TRUE 1 100 0 1 BIT_MASK 0x100 FORMAT "%13.11" ECU_ADDRESS 0x380BF2 /end MEASUREMENT
/begin MEASUREMENT B_cdkvs "Funktion über Codewort CDKVS freigegeben" UWORD B_TRUE 1 100 0 1 BIT_MASK 0x800 FORMAT "%13.11" ECU_ADDRESS 0x380BF2 /end MEASUREMENT
/begin MEASUREMENT B_cdlash "Funktion über Codewort CDLASH freigegeben" UWORD B_TRUE 1 100 0 1 BIT_MASK 0x40 FORMAT "%13.11" ECU_ADDRESS 0x380BF4 /end MEASUREMENT
/begin MEASUREMENT B_cdlatp "Funktion über Codewort CDLATP freigegeben" UWORD B_TRUE 1 100 0 1 BIT_MASK 0x10 FORMAT "%13.11" ECU_ADDRESS 0x380BF4 /end MEASUREMENT
/begin MEASUREMENT B_cdlatv "Funktion über Codewort CDLATV freigeben" UWORD B_TRUE 1 100 0 1 BIT_MASK 0x20 FORMAT "%13.11" ECU_ADDRESS 0x380BF4 /end MEASUREMENT
/begin MEASUREMENT B_cdldp "Funktion über Codewort CDLDP freigegeben" UWORD B_TRUE 1 100 0 1 BIT_MASK 0x4000 FORMAT "%13.11" ECU_ADDRESS 0x380BF2 /end MEASUREMENT
/begin MEASUREMENT B_cdllr "Funktion über Codewort CDLLR freigegeben" UWORD B_TRUE 1 100 0 1 BIT_MASK 0x8 FORMAT "%13.11" ECU_ADDRESS 0x380BF4 /end MEASUREMENT
/begin MEASUREMENT B_cdlsa "Funktion über Codewort CDLSA freigegeben" UWORD B_TRUE 1 100 0 1 BIT_MASK 0x20 FORMAT "%13.11" ECU_ADDRESS 0x380BF2 /end MEASUREMENT
/begin MEASUREMENT B_cdlsh "Funktion über Codewort CDLSH freigegeben" UWORD B_TRUE 1 100 0 1 BIT_MASK 0x10 FORMAT "%13.11" ECU_ADDRESS 0x380BF2 /end MEASUREMENT
/begin MEASUREMENT B_cdlsv "Funktion über Codewort CDLSV freigegeben" UWORD B_TRUE 1 100 0 1 BIT_MASK 0x8 FORMAT "%13.11" ECU_ADDRESS 0x380BF2 /end MEASUREMENT
/begin MEASUREMENT B_cdlsvv "Funktion über Codewort CDLSVV freigegeben" UWORD B_TRUE 1 100 0 1 BIT_MASK 0x400 FORMAT "%13.11" ECU_ADDRESS 0x380BF4 /end MEASUREMENT
/begin MEASUREMENT B_cdmd "Funktion über Codewort CDMD freigegeben" UWORD B_TRUE 1 100 0 1 BIT_MASK 0x1 FORMAT "%13.11" ECU_ADDRESS 0x380BF2 /end MEASUREMENT
/begin MEASUREMENT B_cdnws "Funktion über Codewort CDNWS freigegeben" UWORD B_TRUE 1 100 0 1 BIT_MASK 0x4 FORMAT "%13.11" ECU_ADDRESS 0x380BF4 /end MEASUREMENT
/begin MEASUREMENT B_cdsls "Funktion über Codewort CDSLS freigegeben" UWORD B_TRUE 1 100 0 1 BIT_MASK 0x1 FORMAT "%13.11" ECU_ADDRESS 0x380BF4 /end MEASUREMENT
/begin MEASUREMENT B_cdswe "Funktion über Codewort CDSWE freigegeben" UWORD B_TRUE 1 100 0 1 BIT_MASK 0x2 FORMAT "%13.11" ECU_ADDRESS 0x380BF2 /end MEASUREMENT
/begin MEASUREMENT B_cdtankl "Funktion über Codewort CDTANKL freigegeben" UWORD B_TRUE 1 100 0 1 BIT_MASK 0x4 FORMAT "%13.11" ECU_ADDRESS 0x380BF2 /end MEASUREMENT
/begin MEASUREMENT B_cdtes "Funktion über Codewort CDTES freigegeben" UWORD B_TRUE 1 100 0 1 BIT_MASK 0x2000 FORMAT "%13.11" ECU_ADDRESS 0x380BF2 /end MEASUREMENT
/begin MEASUREMENT B_cvt "Bedingung continuously variable transmission" UWORD B_TRUE 1 100 0 1 BIT_MASK 0x800 FORMAT "%13.11" ECU_ADDRESS 0xFD00 /end MEASUREMENT
/begin MEASUREMENT B_cwlshdyn "Beding. Abschaltung für Teilfunktion Dynamikprüfung Sonde hinter KAT in %DLSAHK" UWORD B_TRUE 1 100 0 1 BIT_MASK 0x1000 FORMAT "%13.11" ECU_ADDRESS 0xFD00 /end MEASUREMENT
/begin MEASUREMENT B_cwlshmf "Beding. Ein/Abschaltung Schwingungsprüfung für Einmalprüfung Sonde hinter KAT" UWORD B_TRUE 1 100 0 1 BIT_MASK 0x2000 FORMAT "%13.11" ECU_ADDRESS 0xFD00 /end MEASUREMENT
/begin MEASUREMENT B_cwlshsch "Bedingung Abschaltung für Teilfunktion im Schub Sonde hinter KAT in %DLSAHK" UWORD B_TRUE 1 100 0 1 BIT_MASK 0x4000 FORMAT "%13.11" ECU_ADDRESS 0xFD00 /end MEASUREMENT
/begin MEASUREMENT B_cwlshvl "Bed. Abschaltung für Teilfunktion im Vollastbetrieb Sonde hinter KAT in %DLSAHK" UWORD B_TRUE 1 100 0 1 BIT_MASK 0x80 FORMAT "%13.11" ECU_ADDRESS 0x380BF6 /end MEASUREMENT
/begin MEASUREMENT B_decr "Bedingung Dekrementierung Startadaptionsfaktor" UWORD B_TRUE 1 100 0 1 BIT_MASK 0x40 FORMAT "%13.11" ECU_ADDRESS 0x384B1C /end MEASUREMENT
/begin MEASUREMENT B_dknolu "Bedingung Drosselklappensteller stromlos" UWORD B_TRUE 1 100 0 1 BIT_MASK 0x800 FORMAT "%13.11" ECU_ADDRESS 0xFD4A /end MEASUREMENT
/begin MEASUREMENT B_dknot "Bedingung DK-Poti-Notfahren aktiv" UWORD B_TRUE 1 100 0 1 BIT_MASK 0x1000 FORMAT "%13.11" ECU_ADDRESS 0xFD4A /end MEASUREMENT
/begin MEASUREMENT B_dkpiu "Bedingung: irreversible SKA" UWORD B_TRUE 1 100 0 1 BIT_MASK 0x2000 FORMAT "%13.11" ECU_ADDRESS 0xFD4A /end MEASUREMENT
/begin MEASUREMENT B_dkpru "Bedingung: reversible SKA" UWORD B_TRUE 1 100 0 1 BIT_MASK 0x4000 FORMAT "%13.11" ECU_ADDRESS 0xFD4A /end MEASUREMENT
/begin MEASUREMENT B_dkpu "Bedingung Sicherheitskraftstoffabschaltung (SKA)" UWORD B_TRUE 1 100 0 1 BIT_MASK 0x8000 FORMAT "%13.11" ECU_ADDRESS 0xFD4A /end MEASUREMENT
/begin MEASUREMENT B_dktb "Bedingung: Beginn der Katdiagnose" UWORD B_TRUE 1 100 0 1 BIT_MASK 0x8 FORMAT "%13.11" ECU_ADDRESS 0xFD0A /end MEASUREMENT
/begin MEASUREMENT B_dkunb "Bedingung: Drosselklappenposition unbekannt" UWORD B_TRUE 1 100 0 1 BIT_MASK 0x1 FORMAT "%13.11" ECU_ADDRESS 0xFD4C /end MEASUREMENT
/begin MEASUREMENT B_dlahieg "I-Anteil der Führungsregelung eingeschwungen" UWORD B_TRUE 1 100 0 1 BIT_MASK 0x10 FORMAT "%13.11" ECU_ADDRESS 0xFD0A /end MEASUREMENT
/begin MEASUREMENT B_dmmtev "TEV-schließen wegen Bedingung Endstufentest DMTL-Magnetventil" UWORD B_TRUE 1 100 0 1 BIT_MASK 0x20 FORMAT "%13.11" ECU_ADDRESS 0xFD0A /end MEASUREMENT
/begin MEASUREMENT B_dmtltz "Bedingung TEV soll geschlossen werden" UWORD B_TRUE 1 100 0 1 BIT_MASK 0x40 FORMAT "%13.11" ECU_ADDRESS 0xFD0A /end MEASUREMENT
/begin MEASUREMENT B_dslreset "Bedingung: Zurücksetzen Sekundärluftadaption/Kurztest" UWORD B_TRUE 1 100 0 1 BIT_MASK 0x2 FORMAT "%13.11" ECU_ADDRESS 0x3849B2 /end MEASUREMENT
/begin MEASUREMENT B_dslset "Bedingung: Setzen Sekundärluftadaption/Kurztest" UWORD B_TRUE 1 100 0 1 BIT_MASK 0x1 FORMAT "%13.11" ECU_ADDRESS 0x3849B2 /end MEASUREMENT
/begin MEASUREMENT B_dslsk "Bedingung Diagnose Sekundärluftsystem für Kurztest" UWORD B_TRUE 1 100 0 1 BIT_MASK 0x80 FORMAT "%13.11" ECU_ADDRESS 0xFD0A /end MEASUREMENT
/begin MEASUREMENT B_dslvh "Bedingung Ladedrucksensor vorhanden" UWORD B_TRUE 1 100 0 1 BIT_MASK 0x8000 FORMAT "%13.11" ECU_ADDRESS 0xFD00 /end MEASUREMENT
/begin MEASUREMENT B_dssv "Bedingung Saugrohr-Drucksensor vorhanden als Hauptlastsensor" UWORD B_TRUE 1 100 0 1 BIT_MASK 0x1 FORMAT "%13.11" ECU_ADDRESS 0xFD02 /end MEASUREMENT
/begin MEASUREMENT B_dssvnl "Bedingung Saugrohr-Drucksensor als Nebenlastsensor vorhanden" UWORD B_TRUE 1 100 0 1 BIT_MASK 0x2 FORMAT "%13.11" ECU_ADDRESS 0xFD02 /end MEASUREMENT
/begin MEASUREMENT B_dsuv "Umgebungsdrucksensor ist vorhanden" UWORD B_TRUE 1 100 0 1 BIT_MASK 0x4 FORMAT "%13.11" ECU_ADDRESS 0xFD02 /end MEASUREMENT
/begin MEASUREMENT B_dtmbh "Bedingung Temperaturkorrektur bei Blochheizerkennung" UWORD B_TRUE 1 100 0 1 BIT_MASK 0x100 FORMAT "%13.11" ECU_ADDRESS 0xFD0A /end MEASUREMENT
/begin MEASUREMENT B_enabrde "Bedingung für Freigabe der Rückdreherkennung" UWORD B_TRUE 1 100 0 1 BIT_MASK 0x20 FORMAT "%13.11" ECU_ADDRESS 0xFD2A /end MEASUREMENT
/begin MEASUREMENT B_enimiti "Bedingung Freigabe des Reglers zur Momentenbegrenzung bei Dauereinspritzung" UBYTE B_TRUE 1 100 0 1 BIT_MASK 0x1 FORMAT "%13.11" ECU_ADDRESS 0x380A38 /end MEASUREMENT
/begin MEASUREMENT B_faats "Bedingung Funktionsanforderung Abgastemperatursensor" UWORD B_TRUE 1 100 0 1 BIT_MASK 0x200 FORMAT "%13.11" ECU_ADDRESS 0xFD0A /end MEASUREMENT
/begin MEASUREMENT B_fanwftve "Bedingung Testerverstellzyklus Diagnose NWS aktiv (Einlass)" UBYTE B_TRUE 1 100 0 1 BIT_MASK 0x40 FORMAT "%13.11" ECU_ADDRESS 0x380BBB /end MEASUREMENT
/begin MEASUREMENT B_fanwsea "Bedingung Funktionsanforderung Diagnose NWS aktiv (Einlaß)" UBYTE B_TRUE 1 100 0 1 BIT_MASK 0x20 FORMAT "%13.11" ECU_ADDRESS 0x380BBB /end MEASUREMENT
/begin MEASUREMENT B_fanwstae "Umschaltung auf Sollwertvorgabe durch Tester bei Einlassnockenwelle" UBYTE B_TRUE 1 100 0 1 BIT_MASK 0x10 FORMAT "%13.11" ECU_ADDRESS 0x380BBB /end MEASUREMENT
/begin MEASUREMENT B_fanwte "Funktionsanforderung Diagnose Nockenwellensteuerung durch Tester (Einlass)" UBYTE B_TRUE 1 100 0 1 BIT_MASK 0x80 FORMAT "%13.11" ECU_ADDRESS 0x380BBB /end MEASUREMENT
/begin MEASUREMENT B_faskno "Bedingung Funktionsanforderung Speicherkatdiagnose" UWORD B_TRUE 1 100 0 1 BIT_MASK 0x400 FORMAT "%13.11" ECU_ADDRESS 0xFD0A /end MEASUREMENT
/begin MEASUREMENT B_fasla "Bedingung: externe Anforderung an Sekundärluft aktiv" UWORD B_TRUE 1 100 0 1 BIT_MASK 0x2000 FORMAT "%13.11" ECU_ADDRESS 0xFD0C /end MEASUREMENT
/begin MEASUREMENT B_fgrbr "Bedingung FGR-Bremseneingriff freigegeben" UBYTE B_TRUE 1 100 0 1 BIT_MASK 0x2 FORMAT "%13.11" ECU_ADDRESS 0x384800 /end MEASUREMENT
/begin MEASUREMENT B_fhz "Bedingung Frontscheibenheizung" UWORD B_TRUE 1 100 0 1 BIT_MASK 0x800 FORMAT "%13.11" ECU_ADDRESS 0xFD0A /end MEASUREMENT
/begin MEASUREMENT B_firstSyn "" UWORD B_TRUE 1 100 0 1 BIT_MASK 0x10 FORMAT "%13.11" ECU_ADDRESS 0xFD06 /end MEASUREMENT
/begin MEASUREMENT B_fpwdkap "DK-Steuerung direkt über Fahrpedal" UWORD B_TRUE 1 100 0 1 BIT_MASK 0x8 FORMAT "%13.11" ECU_ADDRESS 0xFD02 /end MEASUREMENT
/begin MEASUREMENT B_gang0 "Bedingung kein Gang eingelegt" UWORD B_TRUE 1 100 0 1 BIT_MASK 0x1000 FORMAT "%13.11" ECU_ADDRESS 0xFD0A /end MEASUREMENT
/begin MEASUREMENT B_gra6p "Bedingung 6-Positionen-Lenkstockhebel für GRA-Bedienung" UWORD B_TRUE 1 100 0 1 BIT_MASK 0x10 FORMAT "%13.11" ECU_ADDRESS 0xFD02 /end MEASUREMENT
/begin MEASUREMENT B_gracan "Bedingung Empfang der GRA-Bediensignale über CAN" UWORD B_TRUE 1 100 0 1 BIT_MASK 0x20 FORMAT "%13.11" ECU_ADDRESS 0xFD02 /end MEASUREMENT
/begin MEASUREMENT B_hfmv "Bedingung HFM vorhanden" UWORD B_TRUE 1 100 0 1 BIT_MASK 0x40 FORMAT "%13.11" ECU_ADDRESS 0xFD02 /end MEASUREMENT
/begin MEASUREMENT B_incr "Bedingung Inkrementierung Startadaptionsfaktor" UWORD B_TRUE 1 100 0 1 BIT_MASK 0x80 FORMAT "%13.11" ECU_ADDRESS 0x384B1C /end MEASUREMENT
/begin MEASUREMENT B_intats "" UWORD B_TRUE 1 100 0 1 BIT_MASK 0x800 FORMAT "%13.11" ECU_ADDRESS 0xFD06 /end MEASUREMENT
/begin MEASUREMENT B_intatserr "" UWORD B_TRUE 1 100 0 1 BIT_MASK 0x1000 FORMAT "%13.11" ECU_ADDRESS 0xFD06 /end MEASUREMENT
/begin MEASUREMENT B_intatsfirstneg "" UWORD B_TRUE 1 100 0 1 BIT_MASK 0x2000 FORMAT "%13.11" ECU_ADDRESS 0xFD06 /end MEASUREMENT
/begin MEASUREMENT B_intatsfirstpos "" UWORD B_TRUE 1 100 0 1 BIT_MASK 0x4000 FORMAT "%13.11" ECU_ADDRESS 0xFD06 /end MEASUREMENT
/begin MEASUREMENT B_itnmxh "Bedingung: Verweilzeit unterhalb Drehzahlgrenze abgelaufen" UWORD B_TRUE 1 100 0 1 BIT_MASK 0x80 FORMAT "%13.11" ECU_ADDRESS 0xFD8E /end MEASUREMENT
/begin MEASUREMENT B_i_ska_fr "FR-Fehlerreaktion irreversible SKA (Sicherheits-Kraftstoff-Abschaltung)" UWORD B_TRUE 1 100 0 1 BIT_MASK 0x2 FORMAT "%13.11" ECU_ADDRESS 0xFD4C /end MEASUREMENT
/begin MEASUREMENT B_katfz "Bedingung Kat in Fahrzeug eingebaut" UWORD B_TRUE 1 100 0 1 BIT_MASK 0x80 FORMAT "%13.11" ECU_ADDRESS 0xFD02 /end MEASUREMENT
/begin MEASUREMENT B_kath "Bedingung Kat Heizung in Fahrzeug eingebaut" UWORD B_TRUE 1 100 0 1 BIT_MASK 0x100 FORMAT "%13.11" ECU_ADDRESS 0xFD02 /end MEASUREMENT
/begin MEASUREMENT B_kmmilsct "Ausgabe ""km bei MIL on"" für Scan Tool abschalten (0 = keine Ausgabe in PID $21)" UWORD B_TRUE 1 100 0 1 BIT_MASK 0x200 FORMAT "%13.11" ECU_ADDRESS 0xFD02 /end MEASUREMENT
/begin MEASUREMENT B_kosrc "Bedingung für Klimakompressors-Leistungsreduzierung" UWORD B_TRUE 1 100 0 1 BIT_MASK 0x2000 FORMAT "%13.11" ECU_ADDRESS 0xFD0A /end MEASUREMENT
/begin MEASUREMENT B_kstai "Bedingung Inkrementierung/Dekrementierung Startadaptionsfaktor" UWORD B_TRUE 1 100 0 1 BIT_MASK 0x100 FORMAT "%13.11" ECU_ADDRESS 0x384B1C /end MEASUREMENT
/begin MEASUREMENT B_kstaue "Startmengenadaptionswerte beim nächsten Start gültig" UWORD B_TRUE 1 100 0 1 BIT_MASK 0x200 FORMAT "%13.11" ECU_ADDRESS 0x384B1C /end MEASUREMENT
/begin MEASUREMENT B_ldsafw "LDR läuft auf Steuerung mit Festwert LDRAPP" UWORD B_TRUE 1 100 0 1 BIT_MASK 0x400 FORMAT "%13.11" ECU_ADDRESS 0xFD02 /end MEASUREMENT
/begin MEASUREMENT B_ldsapp "LDR läuft auf Steuerung mit KFLDRAPP" UWORD B_TRUE 1 100 0 1 BIT_MASK 0x800 FORMAT "%13.11" ECU_ADDRESS 0xFD02 /end MEASUREMENT
/begin MEASUREMENT B_lmsslof "Bedingung Lambda-Motor-Soll-Sekundärluftanteil, Aus" UWORD B_TRUE 1 100 0 1 BIT_MASK 0x4000 FORMAT "%13.11" ECU_ADDRESS 0xFD0C /end MEASUREMENT
/begin MEASUREMENT B_ls3 "Bedingung 3. Lambda-Sonde nach Auslaß vorbaut (Bank1)" UWORD B_TRUE 1 100 0 1 BIT_MASK 0x1000 FORMAT "%13.11" ECU_ADDRESS 0xFD02 /end MEASUREMENT
/begin MEASUREMENT B_ls32 "Bedingung 3. Lambda-Sonde nach Auslaß vorbaut (Bank2)" UWORD B_TRUE 1 100 0 1 BIT_MASK 0x2000 FORMAT "%13.11" ECU_ADDRESS 0xFD02 /end MEASUREMENT
/begin MEASUREMENT B_ls4 "Bedingung 4. Lambda-Sonde nach Auslaß vorbaut (Bank1)" UWORD B_TRUE 1 100 0 1 BIT_MASK 0x4000 FORMAT "%13.11" ECU_ADDRESS 0xFD02 /end MEASUREMENT
/begin MEASUREMENT B_ls42 "Bedingung 4. Lambda-Sonde nach Auslaß vorbaut (Bank2)" UWORD B_TRUE 1 100 0 1 BIT_MASK 0x8000 FORMAT "%13.11" ECU_ADDRESS 0xFD02 /end MEASUREMENT
/begin MEASUREMENT B_lsh "Bedingung Lambda-Sonde hinter Kat verbaut" UWORD B_TRUE 1 100 0 1 BIT_MASK 0x1 FORMAT "%13.11" ECU_ADDRESS 0xFD04 /end MEASUREMENT
/begin MEASUREMENT B_lsh2 "Bedingung Lambda-Sonde hinter Kat verbaut (Bank2)" UWORD B_TRUE 1 100 0 1 BIT_MASK 0x2 FORMAT "%13.11" ECU_ADDRESS 0xFD04 /end MEASUREMENT
/begin MEASUREMENT B_lsv "Bedingung Lambda-Sonde vor Kat verbaut, 1. Sonde nach Auslaß (Bank1)" UWORD B_TRUE 1 100 0 1 BIT_MASK 0x4 FORMAT "%13.11" ECU_ADDRESS 0xFD04 /end MEASUREMENT
/begin MEASUREMENT B_lsv2 "Bedingung Lambda-Sonde vor Kat verbaut, 1. Sonde nach Auslaß (Bank2)" UWORD B_TRUE 1 100 0 1 BIT_MASK 0x8 FORMAT "%13.11" ECU_ADDRESS 0xFD04 /end MEASUREMENT
/begin MEASUREMENT B_lsvvsp "Bedingung Vertauschte Lambda-Sonden, Regelung sperren" UWORD B_TRUE 1 100 0 1 BIT_MASK 0x4000 FORMAT "%13.11" ECU_ADDRESS 0xFD0A /end MEASUREMENT
/begin MEASUREMENT B_m8te "Bedingung Fkt-Anforderung Tankentlüftung nach SAE J1979 Mode 8 TID $01" UBYTE B_TRUE 1 100 0 1 BIT_MASK 0x1 FORMAT "%13.11" ECU_ADDRESS 0x380944 /end MEASUREMENT
/begin MEASUREMENT B_m9cvn "Bedingung zur Berechnung der Checksumme (CVN) nach SAE/ISO Mode/Service $09" UBYTE B_TRUE 1 100 0 1 BIT_MASK 0x1 FORMAT "%13.11" ECU_ADDRESS 0x380945 /end MEASUREMENT
/begin MEASUREMENT B_m9cvnclr "Bedingung zum Löschen der Checksumme (CVN)" UBYTE B_TRUE 1 100 0 1 BIT_MASK 0x2 FORMAT "%13.11" ECU_ADDRESS 0x380944 /end MEASUREMENT
/begin MEASUREMENT B_m9cvnout "Bedingung; Checksumme (CVN) im Mode/Service $09 mind. 1-mal ausgegeben" UBYTE B_TRUE 1 100 0 1 BIT_MASK 0x2 FORMAT "%13.11" ECU_ADDRESS 0x380945 /end MEASUREMENT
/begin MEASUREMENT B_mde8e "Bedingung Mode $08 erlaubt" UWORD B_TRUE 1 100 0 1 BIT_MASK 0x10 FORMAT "%13.11" ECU_ADDRESS 0xFD04 /end MEASUREMENT
/begin MEASUREMENT B_mde9e "Bedingung Mode $09 erlaubt" UWORD B_TRUE 1 100 0 1 BIT_MASK 0x20 FORMAT "%13.11" ECU_ADDRESS 0xFD04 /end MEASUREMENT
/begin MEASUREMENT B_motstop "Bedingung für Abruch von Einspritzung und Zündung" UWORD B_TRUE 1 100 0 1 BIT_MASK 0x40 FORMAT "%13.11" ECU_ADDRESS 0xFD2A /end MEASUREMENT
/begin MEASUREMENT B_msloff "Sekundärluftmasse ausgeräumt nach Sekundärluftphase" UWORD B_TRUE 1 100 0 1 BIT_MASK 0x8000 FORMAT "%13.11" ECU_ADDRESS 0xFD0C /end MEASUREMENT
/begin MEASUREMENT B_mslon "Sekundärluftmasse eingeschwungen nach Start der Sekundärluft" UWORD B_TRUE 1 100 0 1 BIT_MASK 0x1 FORMAT "%13.11" ECU_ADDRESS 0xFD0E /end MEASUREMENT
/begin MEASUREMENT B_mt "Bedingung Handschaltgetriebe" UWORD B_TRUE 1 100 0 1 BIT_MASK 0x40 FORMAT "%13.11" ECU_ADDRESS 0xFD04 /end MEASUREMENT
/begin MEASUREMENT B_niveau "Bedingung Fahrzeugkarosse höhenverstellbar" UWORD B_TRUE 1 100 0 1 BIT_MASK 0x80 FORMAT "%13.11" ECU_ADDRESS 0xFD04 /end MEASUREMENT
/begin MEASUREMENT B_nlasicOBP "" UBYTE B_TRUE 1 100 0 1 BIT_MASK 0x2 FORMAT "%13.11" ECU_ADDRESS 0x3831EE /end MEASUREMENT
/begin MEASUREMENT B_nlbzakt "Anhebung der Leerlaufdrehzahl für Bordnetzspannung aktiv" UBYTE B_TRUE 1 100 0 1 BIT_MASK 0x1 FORMAT "%13.11" ECU_ADDRESS 0x384800 /end MEASUREMENT
/begin MEASUREMENT B_nlfrOBP "" UBYTE B_TRUE 1 100 0 1 BIT_MASK 0x1 FORMAT "%13.11" ECU_ADDRESS 0x3831EE /end MEASUREMENT
/begin MEASUREMENT B_nlOBP "" UBYTE B_TRUE 1 100 0 1 BIT_MASK 0x4 FORMAT "%13.11" ECU_ADDRESS 0x3831EE /end MEASUREMENT
/begin MEASUREMENT B_nmax "Bedingung Drehzahlbegrenzung aktiv" UWORD B_TRUE 1 100 0 1 BIT_MASK 0x100 FORMAT "%13.11" ECU_ADDRESS 0xFD8E /end MEASUREMENT
/begin MEASUREMENT B_nmaxd "Bedingung Drehzahlbegrenzung mit Einspritzausblendung an allen Zylindern" UWORD B_TRUE 1 100 0 1 BIT_MASK 0x200 FORMAT "%13.11" ECU_ADDRESS 0xFD8E /end MEASUREMENT
/begin MEASUREMENT B_nmaxext "Externe Drehzahlbegrenzung aktiv" UWORD B_TRUE 1 100 0 1 BIT_MASK 0x8000 FORMAT "%13.11" ECU_ADDRESS 0xFD0A /end MEASUREMENT
/begin MEASUREMENT B_noacc_fr "Bedingung keine Übernahme des ACC-Momentes aus Funktionsebene" UWORD B_TRUE 1 100 0 1 BIT_MASK 0x1 FORMAT "%13.11" ECU_ADDRESS 0xFD0C /end MEASUREMENT
/begin MEASUREMENT B_nodec "Bedingung kein Dekrementieren des Startadaptionsfactors innerhalb dieses Starts" UWORD B_TRUE 1 100 0 1 BIT_MASK 0x400 FORMAT "%13.11" ECU_ADDRESS 0x384B1C /end MEASUREMENT
/begin MEASUREMENT B_noinc "Bedingung kein Inkrementieren des Startadaptionsfaktors innerhalb dieses Starts" UWORD B_TRUE 1 100 0 1 BIT_MASK 0x800 FORMAT "%13.11" ECU_ADDRESS 0x384B1C /end MEASUREMENT
/begin MEASUREMENT B_nosigats "Bedingung: kein PWM-Signal Abgastemperatursensor" UWORD B_TRUE 1 100 0 1 BIT_MASK 0x8000 FORMAT "%13.11" ECU_ADDRESS 0xFD06 /end MEASUREMENT
/begin MEASUREMENT B_notlu_fr "Anforderung Notluftfahren vom Funktionsrechner" UWORD B_TRUE 1 100 0 1 BIT_MASK 0x4 FORMAT "%13.11" ECU_ADDRESS 0xFD4C /end MEASUREMENT
/begin MEASUREMENT B_nswo1 "Bedingung Drehzahl > NSWO1" UWORD B_TRUE 1 100 0 1 BIT_MASK 0x100 FORMAT "%13.11" ECU_ADDRESS 0xFD04 /end MEASUREMENT
/begin MEASUREMENT B_nswo2 "Bedingung Drehzahl > NSWO2" UWORD B_TRUE 1 100 0 1 BIT_MASK 0x200 FORMAT "%13.11" ECU_ADDRESS 0xFD04 /end MEASUREMENT
/begin MEASUREMENT B_nweapte "Ende der Ansteuerung Einlassnockenwelle in Aktivposition durch Tester" UBYTE B_TRUE 1 100 0 1 BIT_MASK 0x4 FORMAT "%13.11" ECU_ADDRESS 0x380BBE /end MEASUREMENT
/begin MEASUREMENT B_nwseve "Eingeschränkte Nockenwellenverstellung aktiv Einlassnockenwelle" UBYTE B_TRUE 1 100 0 1 BIT_MASK 0x1 FORMAT "%13.11" ECU_ADDRESS 0x380BBC /end MEASUREMENT
/begin MEASUREMENT B_nwtve "Bedingung NW-Tastverhältnis im PWM-Interrupt (Einlaß)" UBYTE B_TRUE 1 100 0 1 BIT_MASK 0x1 FORMAT "%13.11" ECU_ADDRESS 0x380BB2 /end MEASUREMENT
/begin MEASUREMENT B_pdcvn "Prüfbit" UWORD B_TRUE 1 100 0 1 BIT_MASK 0x2 FORMAT "%13.11" ECU_ADDRESS 0xFD0C /end MEASUREMENT
/begin MEASUREMENT B_plsolap "Umschaltbedingung: Soll-Ladedruck auf Applikationssolladedruck" UWORD B_TRUE 1 100 0 1 BIT_MASK 0x400 FORMAT "%13.11" ECU_ADDRESS 0xFD04 /end MEASUREMENT
/begin MEASUREMENT B_png "Bedingung Planetennachgelege vorhanden" UWORD B_TRUE 1 100 0 1 BIT_MASK 0x800 FORMAT "%13.11" ECU_ADDRESS 0xFD04 /end MEASUREMENT
/begin MEASUREMENT B_portStatusOld "" UWORD B_TRUE 1 100 0 1 BIT_MASK 0x1 FORMAT "%13.11" ECU_ADDRESS 0xFD08 /end MEASUREMENT
/begin MEASUREMENT B_pug "Bedingung Umgebungsdruck gültig" UBYTE B_TRUE 1 100 0 1 BIT_MASK 0x2 FORMAT "%13.11" ECU_ADDRESS 0x380890 /end MEASUREMENT
/begin MEASUREMENT B_pwf "Bedingung Powerfail" UWORD B_TRUE 1 100 0 1 BIT_MASK 0x4000 FORMAT "%13.11" ECU_ADDRESS 0xFD9A /end MEASUREMENT
/begin MEASUREMENT B_pwfCsErr "Bedingung Checksummenfehler nach Powerfail" UWORD B_TRUE 1 100 0 1 BIT_MASK 0x8000 FORMAT "%13.11" ECU_ADDRESS 0xFD9A /end MEASUREMENT
/begin MEASUREMENT B_pwofnwe "Ansteuerverbot der Einlassnockenwelle auf Grund eines Hauptrelaisleitungsabfalls" UWORD B_TRUE 1 100 0 1 BIT_MASK 0x4 FORMAT "%13.11" ECU_ADDRESS 0xFD0C /end MEASUREMENT
/begin MEASUREMENT B_rdeplaus "Bedingung: Rückdreher plausibel" UWORD B_TRUE 1 100 0 1 BIT_MASK 0x80 FORMAT "%13.11" ECU_ADDRESS 0xFD2A /end MEASUREMENT
/begin MEASUREMENT B_rdeundef "Bedingung: Rückdreher undefiniert / keine Aussage möglich" UWORD B_TRUE 1 100 0 1 BIT_MASK 0x100 FORMAT "%13.11" ECU_ADDRESS 0xFD2A /end MEASUREMENT
/begin MEASUREMENT B_ripuv "Bedingung Strom-Pumpen für Sonde vor KAT" UWORD B_TRUE 1 100 0 1 BIT_MASK 0x8 FORMAT "%13.11" ECU_ADDRESS 0xFD0C /end MEASUREMENT
/begin MEASUREMENT B_savacc "Bedingung: Schubabschalteverbot von ACC" UWORD B_TRUE 1 100 0 1 BIT_MASK 0x10 FORMAT "%13.11" ECU_ADDRESS 0xFD0C /end MEASUREMENT
/begin MEASUREMENT B_savmd "Bedingung: Schubabschalteverbot wegen Momentenanforderung" UWORD B_TRUE 1 100 0 1 BIT_MASK 0x20 FORMAT "%13.11" ECU_ADDRESS 0xFD0C /end MEASUREMENT
/begin MEASUREMENT B_sfsc "Bedingung heizb. Frontscheibe eingeschaltet aus CAN-Botschaft Clima1" UWORD B_TRUE 1 100 0 1 BIT_MASK 0x40 FORMAT "%13.11" ECU_ADDRESS 0xFD0C /end MEASUREMENT
/begin MEASUREMENT B_sgs "Bedingung: Momenteingriff zur Drehzahlsynchronisation bei Getriebeschaltung" UWORD B_TRUE 1 100 0 1 BIT_MASK 0x80 FORMAT "%13.11" ECU_ADDRESS 0xFD0C /end MEASUREMENT
/begin MEASUREMENT B_sh_act "Bedingung Standheizung eingeschaltet (aus Clima1)" UWORD B_TRUE 1 100 0 1 BIT_MASK 0x100 FORMAT "%13.11" ECU_ADDRESS 0xFD0C /end MEASUREMENT
/begin MEASUREMENT B_sh_mvw "Bedingung Standheizung arbeitet im großen Kreis (aus Clima1)" UWORD B_TRUE 1 100 0 1 BIT_MASK 0x200 FORMAT "%13.11" ECU_ADDRESS 0xFD0C /end MEASUREMENT
/begin MEASUREMENT B_sldsl4 "Bedingung: Freigabe Sekundärluft für Diagnosephase 4" UWORD B_TRUE 1 100 0 1 BIT_MASK 0x4 FORMAT "%13.11" ECU_ADDRESS 0x3849B2 /end MEASUREMENT
/begin MEASUREMENT B_slkhof "Bedingung Abschalten der Sekundärluftpumpe durch imlpr-Schwelle" UWORD B_TRUE 1 100 0 1 BIT_MASK 0x2 FORMAT "%13.11" ECU_ADDRESS 0xFD0E /end MEASUREMENT
/begin MEASUREMENT B_slkt "Bedingung: Freigabe Sekundärluft für Kurztest" UWORD B_TRUE 1 100 0 1 BIT_MASK 0x8 FORMAT "%13.11" ECU_ADDRESS 0x3849B2 /end MEASUREMENT
/begin MEASUREMENT B_slp "Bedingung für Sekundärluftpumpe" UWORD B_TRUE 1 100 0 1 BIT_MASK 0x4 FORMAT "%13.11" ECU_ADDRESS 0xFD0E /end MEASUREMENT
/begin MEASUREMENT B_slpanst "Bit zur Auswertung des Endstufenfehler in der %SLS" UWORD B_TRUE 1 100 0 1 BIT_MASK 0x400 FORMAT "%13.11" ECU_ADDRESS 0x3849B2 /end MEASUREMENT
/begin MEASUREMENT B_slpena "Bedingung Einschalten der Sekundärluftpumpe" UWORD B_TRUE 1 100 0 1 BIT_MASK 0x10 FORMAT "%13.11" ECU_ADDRESS 0x3849B2 /end MEASUREMENT
/begin MEASUREMENT B_slpmn "Mindestbetriebszeit der Sekundärluftpumpe" UWORD B_TRUE 1 100 0 1 BIT_MASK 0x8 FORMAT "%13.11" ECU_ADDRESS 0xFD0E /end MEASUREMENT
/begin MEASUREMENT B_slpmn2 "Mindestbetriebszeit der Sekundärluftpumpe2 bei seperater Ansteuerung" UWORD B_TRUE 1 100 0 1 BIT_MASK 0x10 FORMAT "%13.11" ECU_ADDRESS 0xFD0E /end MEASUREMENT
/begin MEASUREMENT B_slpoff "Sekundärluftpumpe abgeschaltet" UWORD B_TRUE 1 100 0 1 BIT_MASK 0x20 FORMAT "%13.11" ECU_ADDRESS 0xFD0E /end MEASUREMENT
/begin MEASUREMENT B_slpofst "Bedingung für Setzen Flip Flop  B_slpoff" UWORD B_TRUE 1 100 0 1 BIT_MASK 0x20 FORMAT "%13.11" ECU_ADDRESS 0x3849B2 /end MEASUREMENT
/begin MEASUREMENT B_sls "Bedingung Sekundärluft aktiv" UWORD B_TRUE 1 100 0 1 BIT_MASK 0x40 FORMAT "%13.11" ECU_ADDRESS 0xFD0E /end MEASUREMENT
/begin MEASUREMENT B_slsadap "Bedingung: Sekundärluftmassenadaption" UWORD B_TRUE 1 100 0 1 BIT_MASK 0x80 FORMAT "%13.11" ECU_ADDRESS 0xFD0E /end MEASUREMENT
/begin MEASUREMENT B_slsdis "Bedingung für  Abschalten der Sekundärluftpumpe" UWORD B_TRUE 1 100 0 1 BIT_MASK 0x80 FORMAT "%13.11" ECU_ADDRESS 0x3849B2 /end MEASUREMENT
/begin MEASUREMENT B_slserr "Bedingungen sperren Einschalten der Sekundärluftpumpe" UWORD B_TRUE 1 100 0 1 BIT_MASK 0x100 FORMAT "%13.11" ECU_ADDRESS 0x3849B2 /end MEASUREMENT
/begin MEASUREMENT B_slsfz "Bedingung SLS in Fahrzeug eingebaut" UWORD B_TRUE 1 100 0 1 BIT_MASK 0x1000 FORMAT "%13.11" ECU_ADDRESS 0xFD04 /end MEASUREMENT
/begin MEASUREMENT B_slsinhi "Bedingung sperrt Setzen von Bit B_sls" UWORD B_TRUE 1 100 0 1 BIT_MASK 0x40 FORMAT "%13.11" ECU_ADDRESS 0x3849B2 /end MEASUREMENT
/begin MEASUREMENT B_slsoab "Bedingung SLS ohne Abbruchkriterium durchgeführt" UWORD B_TRUE 1 100 0 1 BIT_MASK 0x100 FORMAT "%13.11" ECU_ADDRESS 0xFD0E /end MEASUREMENT
/begin MEASUREMENT B_slsoff "Sekundärlufteinblasung nach Ausräumen der Sekundärluft beendet" UWORD B_TRUE 1 100 0 1 BIT_MASK 0x200 FORMAT "%13.11" ECU_ADDRESS 0xFD0E /end MEASUREMENT
/begin MEASUREMENT B_slv "Bedingung für Sekundärluftventil" UWORD B_TRUE 1 100 0 1 BIT_MASK 0x400 FORMAT "%13.11" ECU_ADDRESS 0xFD0E /end MEASUREMENT
/begin MEASUREMENT B_slvanst "Bit zur Auswertung des Endstufenfehler in der %SLS" UWORD B_TRUE 1 100 0 1 BIT_MASK 0x200 FORMAT "%13.11" ECU_ADDRESS 0x3849B2 /end MEASUREMENT
/begin MEASUREMENT B_spldd "Bedinung Verriegelung der Diagnose Ladedruckregelung" UBYTE B_TRUE 1 100 0 1 BIT_MASK 0x1 FORMAT "%13.11" ECU_ADDRESS 0x380890 /end MEASUREMENT
/begin MEASUREMENT B_staa "Bedingung Startadaption aktiv im Nachstart" UWORD B_TRUE 1 100 0 1 BIT_MASK 0x8000 FORMAT "%13.11" ECU_ADDRESS 0xFD5C /end MEASUREMENT
/begin MEASUREMENT B_stdperr "Bedingung Adaptionsende aufgrund erkanntem Fehler" UWORD B_TRUE 1 100 0 1 BIT_MASK 0x1000 FORMAT "%13.11" ECU_ADDRESS 0x384B1C /end MEASUREMENT
/begin MEASUREMENT B_svuerf "Bedingung Sondenspannung vor KAT erfassen" UWORD B_TRUE 1 100 0 1 BIT_MASK 0x400 FORMAT "%13.11" ECU_ADDRESS 0xFD0C /end MEASUREMENT
/begin MEASUREMENT B_t8slow "" UWORD B_TRUE 1 100 0 1 BIT_MASK 0x2 FORMAT "%13.11" ECU_ADDRESS 0xFD08 /end MEASUREMENT
/begin MEASUREMENT B_temin "Bedingung TEMIN-Begrenzung aktiv, Bank 1" UWORD B_TRUE 1 100 0 1 BIT_MASK 0x8000 FORMAT "%13.11" ECU_ADDRESS 0xFD58 /end MEASUREMENT
/begin MEASUREMENT B_tfu "Bedingung Temperaturfühler Umgebung vorhanden" UWORD B_TRUE 1 100 0 1 BIT_MASK 0x2000 FORMAT "%13.11" ECU_ADDRESS 0xFD04 /end MEASUREMENT
/begin MEASUREMENT B_tnmxh "Bedingung: Zeitdauer für erhöhte Drehzahlgrenze abgelaufen" UWORD B_TRUE 1 100 0 1 BIT_MASK 0x400 FORMAT "%13.11" ECU_ADDRESS 0xFD8E /end MEASUREMENT
/begin MEASUREMENT B_ubkst "Ubat-Schwelle ZUBKSTMX mal unterschritten" UWORD B_TRUE 1 100 0 1 BIT_MASK 0x1 FORMAT "%13.11" ECU_ADDRESS 0xFD5E /end MEASUREMENT
/begin MEASUREMENT B_uhrrmin "Bedingung Uhr mit relativem Minutenzähler" UWORD B_TRUE 1 100 0 1 BIT_MASK 0x4000 FORMAT "%13.11" ECU_ADDRESS 0xFD04 /end MEASUREMENT
/begin MEASUREMENT B_uhrrsec "Bedingung Uhr mit relativem Sekundenzähler" UWORD B_TRUE 1 100 0 1 BIT_MASK 0x8000 FORMAT "%13.11" ECU_ADDRESS 0xFD04 /end MEASUREMENT
/begin MEASUREMENT B_verrueck "Bedingung Verdacht Rückdrehen" UBYTE B_TRUE 1 100 0 1 BIT_MASK 0x2 FORMAT "%13.11" ECU_ADDRESS 0x380969 /end MEASUREMENT
/begin MEASUREMENT B_vs "Bedingung Ventilhub gross" UWORD B_TRUE 1 100 0 1 BIT_MASK 0x800 FORMAT "%13.11" ECU_ADDRESS 0xFD0C /end MEASUREMENT
/begin MEASUREMENT B_waitgap "Bedingung: Warten auf nächste Lückenüberprüfung bei RDE" UBYTE B_TRUE 1 100 0 1 BIT_MASK 0x4 FORMAT "%13.11" ECU_ADDRESS 0x380969 /end MEASUREMENT
/begin MEASUREMENT B_wdksap "DK-Steuerung über Festwert, Bit 1 hat Priorität" UWORD B_TRUE 1 100 0 1 BIT_MASK 0x1 FORMAT "%13.11" ECU_ADDRESS 0xFD06 /end MEASUREMENT
/begin MEASUREMENT B_wnws0e "Bedingung NW-Sollwertvorgabe ist 0" UBYTE B_TRUE 1 100 0 1 BIT_MASK 0x1 FORMAT "%13.11" ECU_ADDRESS 0x380BBD /end MEASUREMENT
/begin MEASUREMENT B_zwappl "Bedingung Zündwinkelapplikation ohne Drehmomenteingriffe" UWORD B_TRUE 1 100 0 1 BIT_MASK 0x2 FORMAT "%13.11" ECU_ADDRESS 0xFD06 /end MEASUREMENT
/begin MEASUREMENT ccperSav "" UWORD dez 1 100 0 65535 FORMAT "%8.2" ECU_ADDRESS 0xF7BA /end MEASUREMENT
/begin MEASUREMENT ccpwSav "" UWORD dez 1 100 0 65535 FORMAT "%8.2" ECU_ADDRESS 0xF7BC /end MEASUREMENT
/begin MEASUREMENT cd_bits1_w "" UWORD dez 1 100 0 65535 FORMAT "%8.2" ECU_ADDRESS 0x380BF2 /end MEASUREMENT
/begin MEASUREMENT cd_bits2_w "" UWORD dez 1 100 0 65535 FORMAT "%8.2" ECU_ADDRESS 0x380BF4 /end MEASUREMENT
/begin MEASUREMENT cd_bits3_w "" UWORD dez 1 100 0 65535 FORMAT "%8.2" ECU_ADDRESS 0x380BF6 /end MEASUREMENT
/begin MEASUREMENT cntbg_w "Anzahl Aufrufe des BG-Rasters pro Berechnungsintervall" UWORD dez 1 100 0 65535 FORMAT "%8.2" ECU_ADDRESS 0x38280A /end MEASUREMENT
/begin MEASUREMENT ctr_RSABlock "" UWORD dez 1 100 0 65535 FORMAT "%8.2" ECU_ADDRESS 0x38278C /end MEASUREMENT
/begin MEASUREMENT cw_erfil "Status Codewort Filtervariante für Ausgabe der AS-Fehler an GST" UBYTE dez 1 100 0 255 FORMAT "%5.1" ECU_ADDRESS 0x380888 /end MEASUREMENT
/begin MEASUREMENT cw_obd "Status Codewort CWOBD" UBYTE dez 1 100 0 255 FORMAT "%5.1" ECU_ADDRESS 0x380889 /end MEASUREMENT
/begin MEASUREMENT cyclebg_w "Laufzeit des Background-Task" UWORD runtime2_sy 1 100 0 699040 FORMAT "%8.1" ECU_ADDRESS 0x38534A /end MEASUREMENT
/begin MEASUREMENT daseBitW3 "" UWORD dez 1 100 0 65535 FORMAT "%8.2" ECU_ADDRESS 0xFDB8 /end MEASUREMENT
/begin MEASUREMENT devoff "EV-Ausblendmaske bei Testeranforderung" UBYTE dez 1 100 0 255 FORMAT "%5.1" ECU_ADDRESS 0x38088F /end MEASUREMENT
/begin MEASUREMENT dmdmess "" UBYTE dez 1 100 0 255 FORMAT "%5.1" ECU_ADDRESS 0x384801 /end MEASUREMENT
/begin MEASUREMENT dmnmxi_w "Drehmoment aus Integralanteil der NMAX-Regelung" SWORD rel_sw_b100 1 100 -100 99.9969 FORMAT "%8.4" ECU_ADDRESS 0x3826BE /end MEASUREMENT
/begin MEASUREMENT dmnmxp_w "Drehmoment aus Proportionalanteil der NMAX-Regelung" SWORD rel_sw_b100 1 100 -100 99.9969 FORMAT "%8.4" ECU_ADDRESS 0x3826C0 /end MEASUREMENT
/begin MEASUREMENT dmrdagr_w "Momentenreserve für Diagnose AGR" UWORD rel_uw_b100 1 100 0 99.9985 FORMAT "%8.5" ECU_ADDRESS 0x38498E /end MEASUREMENT
/begin MEASUREMENT dmrdnw_w "Momentenreserve für Diagnose über Tester" UWORD rel_uw_b100 1 100 0 99.9985 FORMAT "%8.5" ECU_ADDRESS 0x3853D0 /end MEASUREMENT
/begin MEASUREMENT dnburns_w "Minimaler Drehzahlanstieg für Erkennung einer Verbrennung" SWORD nmot_sw_q0p25 1 100 -8192 8191.75 FORMAT "%8.3" ECU_ADDRESS 0x382078 /end MEASUREMENT
/begin MEASUREMENT dnsi_w "Differenz zwischen Soll- und Ist-Motordrehzahl" SWORD nmot_sw_q0p25 1 100 -8192 8191.75 FORMAT "%8.3" ECU_ADDRESS 0x3826C2 /end MEASUREMENT
/begin MEASUREMENT dpbkvppa_w "Druckdelta das in der Zeit TDDBKVP durch BKV-Pumpe evakuiert werden kann" UWORD p_uw_q0p039 1 100 0 2559.96 FORMAT "%8.3" ECU_ADDRESS 0x384990 /end MEASUREMENT
/begin MEASUREMENT dpus_w "Delta Druck Umgebung Saugrohr" SWORD p_sw_q0p078 1 100 -2560 2559.92 FORMAT "%8.3" ECU_ADDRESS 0x384AEC /end MEASUREMENT
/begin MEASUREMENT dtimx_w "Differenz zwischen max.Einspritzzeit und theoretischer max. Einspritzzeit" SWORD tinjection_sy 1 100 -87.3813 87.3787 FORMAT "%8.5" ECU_ADDRESS 0x384AEE /end MEASUREMENT
/begin MEASUREMENT dtmbhb "Temperaturkorrektur bei Blockheizerkennung (berechneter Wert)" SBYTE temp_sb_q0p75 1 100 -96 95.25 FORMAT "%5.2" ECU_ADDRESS 0x384802 /end MEASUREMENT
/begin MEASUREMENT dynPeriod "" SWORD dez 1 100 -32768 32767 FORMAT "%8.2" ECU_ADDRESS 0x380BFA /end MEASUREMENT
/begin MEASUREMENT errorCntTcsort "" UBYTE dez 1 100 0 255 FORMAT "%5.1" ECU_ADDRESS 0x384822 /end MEASUREMENT
/begin MEASUREMENT esst_fho04esub "" UWORD dez 1 100 0 65535 FORMAT "%8.2" ECU_ADDRESS 0x380C9C /end MEASUREMENT
/begin MEASUREMENT esst_san12esuw "" UWORD dez 1 100 0 65535 FORMAT "%8.2" ECU_ADDRESS 0x380C9E /end MEASUREMENT
/begin MEASUREMENT esst_sdk10teub "" UWORD dez 1 100 0 65535 FORMAT "%8.2" ECU_ADDRESS 0x384936 /end MEASUREMENT
/begin MEASUREMENT esst_sez06tmub "" UWORD dez 1 100 0 65535 FORMAT "%8.2" ECU_ADDRESS 0x384938 /end MEASUREMENT
/begin MEASUREMENT esst_sfr05teub "" UWORD dez 1 100 0 65535 FORMAT "%8.2" ECU_ADDRESS 0x38493A /end MEASUREMENT
/begin MEASUREMENT esst_sga06mdub "" UWORD dez 1 100 0 65535 FORMAT "%8.2" ECU_ADDRESS 0x38493C /end MEASUREMENT
/begin MEASUREMENT esst_sga08mdub "" UWORD dez 1 100 0 65535 FORMAT "%8.2" ECU_ADDRESS 0x380CA0 /end MEASUREMENT
/begin MEASUREMENT esst_sks06esub "" UWORD dez 1 100 0 65535 FORMAT "%8.2" ECU_ADDRESS 0x380CA2 /end MEASUREMENT
/begin MEASUREMENT esst_sla05esub "" UWORD dez 1 100 0 65535 FORMAT "%8.2" ECU_ADDRESS 0x380CA4 /end MEASUREMENT
/begin MEASUREMENT esst_sld04ldub "" UWORD dez 1 100 0 65535 FORMAT "%8.2" ECU_ADDRESS 0x380CA6 /end MEASUREMENT
/begin MEASUREMENT esst_slx06tmuw "" UWORD dez 1 100 0 65535 FORMAT "%8.2" ECU_ADDRESS 0x38493E /end MEASUREMENT
/begin MEASUREMENT esst_sm108lhsw "" UWORD dez 1 100 0 65535 FORMAT "%8.2" ECU_ADDRESS 0x384940 /end MEASUREMENT
/begin MEASUREMENT esst_smi04llub "" UWORD dez 1 100 0 65535 FORMAT "%8.2" ECU_ADDRESS 0x380CA8 /end MEASUREMENT
/begin MEASUREMENT esst_sml05dkub "" UWORD dez 1 100 0 65535 FORMAT "%8.2" ECU_ADDRESS 0x384942 /end MEASUREMENT
/begin MEASUREMENT esst_sml06teub "" UWORD dez 1 100 0 65535 FORMAT "%8.2" ECU_ADDRESS 0x384944 /end MEASUREMENT
/begin MEASUREMENT esst_sml06tmuw "" UWORD dez 1 100 0 65535 FORMAT "%8.2" ECU_ADDRESS 0x384946 /end MEASUREMENT
/begin MEASUREMENT esst_sml07tmuw "" UWORD dez 1 100 0 65535 FORMAT "%8.2" ECU_ADDRESS 0x384948 /end MEASUREMENT
/begin MEASUREMENT esst_sml08lhub "" UWORD dez 1 100 0 65535 FORMAT "%8.2" ECU_ADDRESS 0x38494A /end MEASUREMENT
/begin MEASUREMENT esst_smt06tmuw "" UWORD dez 1 100 0 65535 FORMAT "%8.2" ECU_ADDRESS 0x38494C /end MEASUREMENT
/begin MEASUREMENT esst_sng06llsb "" UWORD dez 1 100 0 65535 FORMAT "%8.2" ECU_ADDRESS 0x380CAA /end MEASUREMENT
/begin MEASUREMENT esst_snm05dkub "" UWORD dez 1 100 0 65535 FORMAT "%8.2" ECU_ADDRESS 0x38494E /end MEASUREMENT
/begin MEASUREMENT esst_snm05neuw "" UWORD dez 1 100 0 65535 FORMAT "%8.2" ECU_ADDRESS 0x380CAC /end MEASUREMENT
/begin MEASUREMENT esst_snm05nwub "" UWORD dez 1 100 0 65535 FORMAT "%8.2" ECU_ADDRESS 0x384950 /end MEASUREMENT
/begin MEASUREMENT esst_snm06gkub "" UWORD dez 1 100 0 65535 FORMAT "%8.2" ECU_ADDRESS 0x384952 /end MEASUREMENT
/begin MEASUREMENT esst_snm06llub "" UWORD dez 1 100 0 65535 FORMAT "%8.2" ECU_ADDRESS 0x380CAE /end MEASUREMENT
/begin MEASUREMENT esst_snm06mduw "" UWORD dez 1 100 0 65535 FORMAT "%8.2" ECU_ADDRESS 0x384954 /end MEASUREMENT
/begin MEASUREMENT esst_snm07esub "" UWORD dez 1 100 0 65535 FORMAT "%8.2" ECU_ADDRESS 0x384956 /end MEASUREMENT
/begin MEASUREMENT esst_snm07lsuw "" UWORD dez 1 100 0 65535 FORMAT "%8.2" ECU_ADDRESS 0x380CB0 /end MEASUREMENT
/begin MEASUREMENT esst_snm08dmub "" UWORD dez 1 100 0 65535 FORMAT "%8.2" ECU_ADDRESS 0x380CB2 /end MEASUREMENT
/begin MEASUREMENT esst_snm08feub "" UWORD dez 1 100 0 65535 FORMAT "%8.2" ECU_ADDRESS 0x384958 /end MEASUREMENT
/begin MEASUREMENT esst_snm08ldub "" UWORD dez 1 100 0 65535 FORMAT "%8.2" ECU_ADDRESS 0x380CB4 /end MEASUREMENT
/begin MEASUREMENT esst_snm08lduw "" UWORD dez 1 100 0 65535 FORMAT "%8.2" ECU_ADDRESS 0x380CB6 /end MEASUREMENT
/begin MEASUREMENT esst_snm08lhub "" UWORD dez 1 100 0 65535 FORMAT "%8.2" ECU_ADDRESS 0x38495A /end MEASUREMENT
/begin MEASUREMENT esst_snm08opub "" UWORD dez 1 100 0 65535 FORMAT "%8.2" ECU_ADDRESS 0x380CB8 /end MEASUREMENT
/begin MEASUREMENT esst_snm08__ub "" UWORD dez 1 100 0 65535 FORMAT "%8.2" ECU_ADDRESS 0x38495C /end MEASUREMENT
/begin MEASUREMENT esst_snm10lsub "" UWORD dez 1 100 0 65535 FORMAT "%8.2" ECU_ADDRESS 0x380CBA /end MEASUREMENT
/begin MEASUREMENT esst_snm10teub "" UWORD dez 1 100 0 65535 FORMAT "%8.2" ECU_ADDRESS 0x38495E /end MEASUREMENT
/begin MEASUREMENT esst_snm12esub "" UWORD dez 1 100 0 65535 FORMAT "%8.2" ECU_ADDRESS 0x380CBC /end MEASUREMENT
/begin MEASUREMENT esst_snm12feub "" UWORD dez 1 100 0 65535 FORMAT "%8.2" ECU_ADDRESS 0x380CBE /end MEASUREMENT
/begin MEASUREMENT esst_snm12lduw "" UWORD dez 1 100 0 65535 FORMAT "%8.2" ECU_ADDRESS 0x380CC0 /end MEASUREMENT
/begin MEASUREMENT esst_snm16ciub "" UWORD dez 1 100 0 65535 FORMAT "%8.2" ECU_ADDRESS 0x384960 /end MEASUREMENT
/begin MEASUREMENT esst_snm16krdyub "" UWORD dez 1 100 0 65535 FORMAT "%8.2" ECU_ADDRESS 0x384962 /end MEASUREMENT
/begin MEASUREMENT esst_snm16krub "" UWORD dez 1 100 0 65535 FORMAT "%8.2" ECU_ADDRESS 0x384964 /end MEASUREMENT
/begin MEASUREMENT esst_snm16ldub "" UWORD dez 1 100 0 65535 FORMAT "%8.2" ECU_ADDRESS 0x380CC2 /end MEASUREMENT
/begin MEASUREMENT esst_snm16lduw "" UWORD dez 1 100 0 65535 FORMAT "%8.2" ECU_ADDRESS 0x380CC4 /end MEASUREMENT
/begin MEASUREMENT esst_snm16neuw "" UWORD dez 1 100 0 65535 FORMAT "%8.2" ECU_ADDRESS 0x380CC6 /end MEASUREMENT
/begin MEASUREMENT esst_snm16opuw "" UWORD dez 1 100 0 65535 FORMAT "%8.2" ECU_ADDRESS 0x380CC8 /end MEASUREMENT
/begin MEASUREMENT esst_snm16zuuw "" UWORD dez 1 100 0 65535 FORMAT "%8.2" ECU_ADDRESS 0x380CCA /end MEASUREMENT
/begin MEASUREMENT esst_spu08ldub "" UWORD dez 1 100 0 65535 FORMAT "%8.2" ECU_ADDRESS 0x380CCC /end MEASUREMENT
/begin MEASUREMENT esst_sqm05teub "" UWORD dez 1 100 0 65535 FORMAT "%8.2" ECU_ADDRESS 0x380CCE /end MEASUREMENT
/begin MEASUREMENT esst_srl03krub "" UWORD dez 1 100 0 65535 FORMAT "%8.2" ECU_ADDRESS 0x384966 /end MEASUREMENT
/begin MEASUREMENT esst_srl04krub "" UWORD dez 1 100 0 65535 FORMAT "%8.2" ECU_ADDRESS 0x384968 /end MEASUREMENT
/begin MEASUREMENT esst_srl05neuw "" UWORD dez 1 100 0 65535 FORMAT "%8.2" ECU_ADDRESS 0x38496A /end MEASUREMENT
/begin MEASUREMENT esst_srl06esub "" UWORD dez 1 100 0 65535 FORMAT "%8.2" ECU_ADDRESS 0x380CD0 /end MEASUREMENT
/begin MEASUREMENT esst_srl06gkub "" UWORD dez 1 100 0 65535 FORMAT "%8.2" ECU_ADDRESS 0x38496C /end MEASUREMENT
/begin MEASUREMENT esst_srl06krub "" UWORD dez 1 100 0 65535 FORMAT "%8.2" ECU_ADDRESS 0x38496E /end MEASUREMENT
/begin MEASUREMENT esst_srl08dmub "" UWORD dez 1 100 0 65535 FORMAT "%8.2" ECU_ADDRESS 0x380CD2 /end MEASUREMENT
/begin MEASUREMENT esst_srl08lsuw "" UWORD dez 1 100 0 65535 FORMAT "%8.2" ECU_ADDRESS 0x380CD4 /end MEASUREMENT
/begin MEASUREMENT esst_srl08neuw "" UWORD dez 1 100 0 65535 FORMAT "%8.2" ECU_ADDRESS 0x384970 /end MEASUREMENT
/begin MEASUREMENT esst_srl08nxub "" UWORD dez 1 100 0 65535 FORMAT "%8.2" ECU_ADDRESS 0x384972 /end MEASUREMENT
/begin MEASUREMENT esst_srl10lsub "" UWORD dez 1 100 0 65535 FORMAT "%8.2" ECU_ADDRESS 0x380CD6 /end MEASUREMENT
/begin MEASUREMENT esst_srl12esub "" UWORD dez 1 100 0 65535 FORMAT "%8.2" ECU_ADDRESS 0x380CD8 /end MEASUREMENT
/begin MEASUREMENT esst_srl12zuuw "" UWORD dez 1 100 0 65535 FORMAT "%8.2" ECU_ADDRESS 0x380CDA /end MEASUREMENT
/begin MEASUREMENT esst_st107tmub "" UWORD dez 1 100 0 65535 FORMAT "%8.2" ECU_ADDRESS 0x384974 /end MEASUREMENT
/begin MEASUREMENT esst_st307tmub "" UWORD dez 1 100 0 65535 FORMAT "%8.2" ECU_ADDRESS 0x384976 /end MEASUREMENT
/begin MEASUREMENT esst_sta04llub "" UWORD dez 1 100 0 65535 FORMAT "%8.2" ECU_ADDRESS 0x380CDC /end MEASUREMENT
/begin MEASUREMENT esst_sta06esub "" UWORD dez 1 100 0 65535 FORMAT "%8.2" ECU_ADDRESS 0x384978 /end MEASUREMENT
/begin MEASUREMENT esst_sta08ldub "" UWORD dez 1 100 0 65535 FORMAT "%8.2" ECU_ADDRESS 0x380CDE /end MEASUREMENT
/begin MEASUREMENT esst_sta12wlub "" UWORD dez 1 100 0 65535 FORMAT "%8.2" ECU_ADDRESS 0x380CE0 /end MEASUREMENT
/begin MEASUREMENT esst_stk04saub "" UWORD dez 1 100 0 65535 FORMAT "%8.2" ECU_ADDRESS 0x38497A /end MEASUREMENT
/begin MEASUREMENT esst_stm04feub "" UWORD dez 1 100 0 65535 FORMAT "%8.2" ECU_ADDRESS 0x380CE2 /end MEASUREMENT
/begin MEASUREMENT esst_stm04saub "" UWORD dez 1 100 0 65535 FORMAT "%8.2" ECU_ADDRESS 0x380CE4 /end MEASUREMENT
/begin MEASUREMENT esst_stm05saub "" UWORD dez 1 100 0 65535 FORMAT "%8.2" ECU_ADDRESS 0x38497C /end MEASUREMENT
/begin MEASUREMENT esst_stm05tmub "" UWORD dez 1 100 0 65535 FORMAT "%8.2" ECU_ADDRESS 0x38497E /end MEASUREMENT
/begin MEASUREMENT esst_stm06llub "" UWORD dez 1 100 0 65535 FORMAT "%8.2" ECU_ADDRESS 0x384980 /end MEASUREMENT
/begin MEASUREMENT esst_stm06__ub "" UWORD dez 1 100 0 65535 FORMAT "%8.2" ECU_ADDRESS 0x384982 /end MEASUREMENT
/begin MEASUREMENT esst_stm08dmub "" UWORD dez 1 100 0 65535 FORMAT "%8.2" ECU_ADDRESS 0x380CE6 /end MEASUREMENT
/begin MEASUREMENT esst_stm08gkub "" UWORD dez 1 100 0 65535 FORMAT "%8.2" ECU_ADDRESS 0x384984 /end MEASUREMENT
/begin MEASUREMENT esst_stm08mdub "" UWORD dez 1 100 0 65535 FORMAT "%8.2" ECU_ADDRESS 0x384986 /end MEASUREMENT
/begin MEASUREMENT esst_stm08opub "" UWORD dez 1 100 0 65535 FORMAT "%8.2" ECU_ADDRESS 0x380CE8 /end MEASUREMENT
/begin MEASUREMENT esst_stm09esub "" UWORD dez 1 100 0 65535 FORMAT "%8.2" ECU_ADDRESS 0x384988 /end MEASUREMENT
/begin MEASUREMENT esst_stm10__ub "" UWORD dez 1 100 0 65535 FORMAT "%8.2" ECU_ADDRESS 0x38498A /end MEASUREMENT
/begin MEASUREMENT esst_stm12esub "" UWORD dez 1 100 0 65535 FORMAT "%8.2" ECU_ADDRESS 0x380CEA /end MEASUREMENT
/begin MEASUREMENT esst_stn06llub "" UWORD dez 1 100 0 65535 FORMAT "%8.2" ECU_ADDRESS 0x38498C /end MEASUREMENT
/begin MEASUREMENT esst_sts08ldub "" UWORD dez 1 100 0 65535 FORMAT "%8.2" ECU_ADDRESS 0x380CEC /end MEASUREMENT
/begin MEASUREMENT esst_sts12esub "" UWORD dez 1 100 0 65535 FORMAT "%8.2" ECU_ADDRESS 0x380CEE /end MEASUREMENT
/begin MEASUREMENT esst_svp12lduw "" UWORD dez 1 100 0 65535 FORMAT "%8.2" ECU_ADDRESS 0x380CF0 /end MEASUREMENT
/begin MEASUREMENT esst_swp08opub "" UWORD dez 1 100 0 65535 FORMAT "%8.2" ECU_ADDRESS 0x380CF2 /end MEASUREMENT
/begin MEASUREMENT evtmodev "Spulentemperatur eines Einspritzventils" UBYTE temp_ub_q0p75_o48 1 100 -48 143.25 FORMAT "%5.1" ECU_ADDRESS 0x384875 /end MEASUREMENT
/begin MEASUREMENT facipkr_w "Interpolationsfaktor zur Neuberechnung von wkraipol" SWORD fak_q0p0039 1 100 -128 127.996 FORMAT "%8.4" ECU_ADDRESS 0x383254 /end MEASUREMENT
/begin MEASUREMENT flamsl_w "Faktor Lambdaänderung durch Sekundärluft" UWORD fak_uw_b16 1 100 0 15.9998 FORMAT "%8.5" ECU_ADDRESS 0x3849A4 /end MEASUREMENT
/begin MEASUREMENT flmssl "Faktor Lambda-Motor-Soll-Sekundärluftanteil" UBYTE fak_ub_b1 1 100 0 0.996094 ECU_ADDRESS 0x384808 /end MEASUREMENT
/begin MEASUREMENT fmsagd "Korrekturfaktor Abgasgegendruck der Sekundärluftmasse" UBYTE fak_ub_b2 1 100 0 1.99219 FORMAT "%5.3" ECU_ADDRESS 0x384809 /end MEASUREMENT
/begin MEASUREMENT fmsldyn "Faktor Dynamikbeschreibung Sekundärluft" UBYTE fak_ub_b1 1 100 0 0.996094 ECU_ADDRESS 0x38480A /end MEASUREMENT
/begin MEASUREMENT fmslkor "Faktor zur Korrektur der Sekundärluftmasse" UBYTE fak_ub_b8 1 100 0 7.96875 FORMAT "%5.3" ECU_ADDRESS 0x38480B /end MEASUREMENT
/begin MEASUREMENT fmslrho "Dichtekorrektur der Sekundärluftmasse" UBYTE fak_ub_b2 1 100 0 1.99219 FORMAT "%5.3" ECU_ADDRESS 0x38480C /end MEASUREMENT
/begin MEASUREMENT fmsltm "tmot- Korrektur der Sekundärluftmasse" UBYTE fak_ub_b2 1 100 0 1.99219 FORMAT "%5.3" ECU_ADDRESS 0x38480D /end MEASUREMENT
/begin MEASUREMENT fnwaa "Faktor Wichtung NW-Auslaß" UBYTE fak_ub_b1 1 100 0 0.996094 ECU_ADDRESS 0x380BB9 /end MEASUREMENT
/begin MEASUREMENT fnwea "Faktor Wichtung NW-Einlaß" UBYTE fak_ub_b1 1 100 0 0.996094 ECU_ADDRESS 0x380BBA /end MEASUREMENT
/begin MEASUREMENT fnwua "Gewichtungsfaktor Nockenwellenüberschneidung (Auslaß)" UBYTE fak_ub_b1 1 100 0 0.996094 ECU_ADDRESS 0x384919 /end MEASUREMENT
/begin MEASUREMENT fnwue "Gewichtungsfaktor Nockenwellenüberschneidung (Einlaß)" UBYTE fak_ub_b1 1 100 0 0.996094 ECU_ADDRESS 0x38491A /end MEASUREMENT
/begin MEASUREMENT fnwu_w "Faktor Nockenwellen Gesamtüberschneidung" UWORD fak_uw_b2 1 100 0 1.99997 FORMAT "%8.6" ECU_ADDRESS 0x3853B2 /end MEASUREMENT
/begin MEASUREMENT fnwwarme "Faktor Nockenwellensollwinkel Übergang kalt -> Warmkennfelder Einlaß" UBYTE fak_ub_b2 1 100 0 1.99219 FORMAT "%5.3" ECU_ADDRESS 0x384928 /end MEASUREMENT
/begin MEASUREMENT frkte_w "Faktor Umrechnung rel. Kraftstoffmasse rk in effekt. Einspritzzeit te" UWORD rkti11_sy 1 100 0 7.28167 FORMAT "%8.6" ECU_ADDRESS 0x384AF0 /end MEASUREMENT
/begin MEASUREMENT fslpdyn "Faktor Dynamikbeschreibung Sekundärluftpumpe" UBYTE fak_ub_b1 1 100 0 0.996094 ECU_ADDRESS 0x38480E /end MEASUREMENT
/begin MEASUREMENT ftek_w "Korrekturfaktor für effektive Einspritzzeit" UWORD fak_uw_b2 1 100 0 1.99997 FORMAT "%8.6" ECU_ADDRESS 0x38202C /end MEASUREMENT
/begin MEASUREMENT grundwert "Abstand SW-Bezugsmarke zu OT in °KW" UBYTE dez 1 100 0 255 FORMAT "%5.1" ECU_ADDRESS 0x38088A /end MEASUREMENT
/begin MEASUREMENT imllaka_w "Integrator Fettfläche für Katalysator-Ausräumen" UWORD dez 1 100 0 65535 FORMAT "%8.2" ECU_ADDRESS 0x380CF4 /end MEASUREMENT
/begin MEASUREMENT imlsla_w "Luftmassenintegral für Einbringen der Sekundärluft" UWORD m_uw_b4660 1 100 0 4660.27 FORMAT "%8.3" ECU_ADDRESS 0x3849A6 /end MEASUREMENT
/begin MEASUREMENT imlsle_w "Luftmassenintegral für Ende der Sekundärluft im Abgas" UWORD m_uw_b4660 1 100 0 4660.27 FORMAT "%8.3" ECU_ADDRESS 0x3849A8 /end MEASUREMENT
/begin MEASUREMENT itnmaxp_w "Timer abwärts für Aktivierungsdauer der alternativen Reglerabstimmung" UWORD t10msxs_uw_b655p35 1 100 0 655.35 FORMAT "%8.4" ECU_ADDRESS 0x3826C4 /end MEASUREMENT
/begin MEASUREMENT itnmxh_w "Timer abwärts, Zeitdauer unterhalb unterer Drehzahlgrenze" UWORD t10msxs_uw_b655p35 1 100 0 655.35 FORMAT "%8.4" ECU_ADDRESS 0x3826C6 /end MEASUREMENT
/begin MEASUREMENT kinmx "Verstärkung Integralanteil der NMAX-Regelung" UBYTE relnmot_q0p02 1 100 0 5.1 FORMAT "%5.3" ECU_ADDRESS 0x3848EE /end MEASUREMENT
/begin MEASUREMENT ksta0 "Kaltstartanreicherung Bereich 0, gepuffert" UBYTE fak_ub_b2 1 100 0 1.99219 FORMAT "%5.3" ECU_ADDRESS 0x383132 /end MEASUREMENT
/begin MEASUREMENT ksta0w "Kaltstartanreicherung Bereich 0, aktuell eingerechnet" UBYTE fak_ub_b2 1 100 0 1.99219 FORMAT "%5.3" ECU_ADDRESS 0x380A42 /end MEASUREMENT
/begin MEASUREMENT ksta1 "Kaltstartanreicherung Bereich 1, gepuffert" UBYTE fak_ub_b2 1 100 0 1.99219 FORMAT "%5.3" ECU_ADDRESS 0x383133 /end MEASUREMENT
/begin MEASUREMENT ksta1w "Kaltstartanreicherung Bereich 1, aktuell eingerechnet" UBYTE fak_ub_b2 1 100 0 1.99219 FORMAT "%5.3" ECU_ADDRESS 0x380A43 /end MEASUREMENT
/begin MEASUREMENT ksta2 "Kaltstartanreicherung Bereich 2, gepuffert" UBYTE fak_ub_b2 1 100 0 1.99219 FORMAT "%5.3" ECU_ADDRESS 0x383134 /end MEASUREMENT
/begin MEASUREMENT ksta2w "Kaltstartanreicherung Bereich 2, aktuell eingerechnet" UBYTE fak_ub_b2 1 100 0 1.99219 FORMAT "%5.3" ECU_ADDRESS 0x380A44 /end MEASUREMENT
/begin MEASUREMENT kstaa "Aktueller Startmengenadaptionsfaktor" UBYTE fak_ub_b2 1 100 0 1.99219 FORMAT "%5.3" ECU_ADDRESS 0x380A45 /end MEASUREMENT
/begin MEASUREMENT laufz100_w "Laufzeit 100ms-Task" UWORD runtime1_sy 1 100 0 43690 FORMAT "%8.2" ECU_ADDRESS 0x38534C /end MEASUREMENT
/begin MEASUREMENT laufz10m_w "Laufzeit 10ms-Task" UWORD runtime1_sy 1 100 0 43690 FORMAT "%8.2" ECU_ADDRESS 0x38280C /end MEASUREMENT
/begin MEASUREMENT laufz1m_w "Laufzeit 1ms-Task" UWORD runtime1_sy 1 100 0 43690 FORMAT "%8.2" ECU_ADDRESS 0xFA14 /end MEASUREMENT
/begin MEASUREMENT laufz1s_w "Laufzeit 1000ms-Task" UWORD runtime1_sy 1 100 0 43690 FORMAT "%8.2" ECU_ADDRESS 0x38534E /end MEASUREMENT
/begin MEASUREMENT laufz200_w "Laufzeit 200ms-Task" UWORD runtime1_sy 1 100 0 43690 FORMAT "%8.2" ECU_ADDRESS 0x385350 /end MEASUREMENT
/begin MEASUREMENT laufz20m_w "Laufzeit 20ms-Task" UWORD runtime1_sy 1 100 0 43690 FORMAT "%8.2" ECU_ADDRESS 0x38280E /end MEASUREMENT
/begin MEASUREMENT laufz2m_w "Laufzeit 2ms-Task" UWORD runtime1_sy 1 100 0 43690 FORMAT "%8.2" ECU_ADDRESS 0xFA16 /end MEASUREMENT
/begin MEASUREMENT laufz50m_w "Laufzeit 50ms-Task" UWORD runtime1_sy 1 100 0 43690 FORMAT "%8.2" ECU_ADDRESS 0x385352 /end MEASUREMENT
/begin MEASUREMENT laufz5m_w "Laufzeit 5ms-Task" UWORD runtime1_sy 1 100 0 43690 FORMAT "%8.2" ECU_ADDRESS 0xFA18 /end MEASUREMENT
/begin MEASUREMENT laufzbg_w "Laufzeit fuer Background-Task" UWORD runtime1_sy 1 100 0 43690 FORMAT "%8.2" ECU_ADDRESS 0x385354 /end MEASUREMENT
/begin MEASUREMENT laufzmbg_w "gemittelte Laufzeit fuer Background-Task" UWORD runtime1_sy 1 100 0 43690 FORMAT "%8.2" ECU_ADDRESS 0x385356 /end MEASUREMENT
/begin MEASUREMENT laufzmfa_w "Laufzeit MFA-Interrupt" UWORD runtime1_sy 1 100 0 43690 FORMAT "%8.2" ECU_ADDRESS 0x382810 /end MEASUREMENT
/begin MEASUREMENT laufzsyn2_w "" UWORD runtime1_sy 1 100 0 43690 FORMAT "%8.2" ECU_ADDRESS 0x382812 /end MEASUREMENT
/begin MEASUREMENT laufzsyn_w "Laufzeit Synchro-Task" UWORD runtime1_sy 1 100 0 43690 FORMAT "%8.2" ECU_ADDRESS 0x382814 /end MEASUREMENT
/begin MEASUREMENT lzmaxnmot "Drehzahl waehrend maximaler Last" UBYTE nmot_ub_q40 1 100 0 10200 FORMAT "%5.0" ECU_ADDRESS 0x3831EF /end MEASUREMENT
/begin MEASUREMENT lzmaxrl "Relative Luftfuellung waehrend maximaler Last" UBYTE rel_ub_b99p6 1 100 0 99.6094 FORMAT "%5.2" ECU_ADDRESS 0x3831F0 /end MEASUREMENT
/begin MEASUREMENT lzmaxstate "Bitbasis fuer Statusbits" UBYTE dez 1 100 0 255 FORMAT "%5.1" ECU_ADDRESS 0x3831F1 /end MEASUREMENT
/begin MEASUREMENT lzmaxwdkba "Relativer Drosselklappenwinkel waehrend maximaler Last" UBYTE relDK_ub_b100 1 100 0 100 FORMAT "%5.1" ECU_ADDRESS 0x3831F2 /end MEASUREMENT
/begin MEASUREMENT lzmaxwped "Relativer Fahrpedalwinkel waehrend maximaler Last" UBYTE rel_ub_b99p6 1 100 0 99.6094 FORMAT "%5.2" ECU_ADDRESS 0x3831F3 /end MEASUREMENT
/begin MEASUREMENT lzs_dash "Bedingung B_dash waehrend maximaler Last aufgetreten" UBYTE B_TRUE 1 100 0 1 BIT_MASK 0x10 FORMAT "%13.11" ECU_ADDRESS 0x3831F1 /end MEASUREMENT
/begin MEASUREMENT lzs_kr "Bedingung B_kr waehrend maximaler Last aufgetreten" UBYTE B_TRUE 1 100 0 1 BIT_MASK 0x1 FORMAT "%13.11" ECU_ADDRESS 0x3831F1 /end MEASUREMENT
/begin MEASUREMENT lzs_ldr "Bedingung B_ldr waehrend maximaler Last aufgetreten" UBYTE B_TRUE 1 100 0 1 BIT_MASK 0x4 FORMAT "%13.11" ECU_ADDRESS 0x3831F1 /end MEASUREMENT
/begin MEASUREMENT lzs_lr "Bedingung B_lr waehrend maximaler Last aufgetreten" UBYTE B_TRUE 1 100 0 1 BIT_MASK 0x2 FORMAT "%13.11" ECU_ADDRESS 0x3831F1 /end MEASUREMENT
/begin MEASUREMENT lzs_lsd "Bedingung B_lsd waehrend maximaler Last aufgetreten" UBYTE B_TRUE 1 100 0 1 BIT_MASK 0x8 FORMAT "%13.11" ECU_ADDRESS 0x3831F1 /end MEASUREMENT
/begin MEASUREMENT lzs_sa "Bedingung B_sa waehrend maximaler Last aufgetreten" UBYTE B_TRUE 1 100 0 1 BIT_MASK 0x20 FORMAT "%13.11" ECU_ADDRESS 0x3831F1 /end MEASUREMENT
/begin MEASUREMENT mibgrbr_w "begrenztes Moment aus Bremsanforderung" UWORD rel_uw_b100 1 100 0 99.9985 FORMAT "%8.5" ECU_ADDRESS 0x384992 /end MEASUREMENT
/begin MEASUREMENT mibgrtm_w "begrenztes Moment aus Motortemperaturregelung" UWORD rel_uw_b100 1 100 0 99.9985 FORMAT "%8.5" ECU_ADDRESS 0x384994 /end MEASUREMENT
/begin MEASUREMENT mifabh_w "begrenztes ind. Motormoment Fahrerwunsch (sample & hold)" UWORD rel_uw_b100 1 100 0 99.9985 FORMAT "%8.5" ECU_ADDRESS 0x384C6A /end MEASUREMENT
/begin MEASUREMENT migsl_w "Inneres Soll-Motormoment zur Füllungsbegrenzung bei GSf" UWORD dez 1 100 0 65535 FORMAT "%8.2" ECU_ADDRESS 0x384996 /end MEASUREMENT
/begin MEASUREMENT minmxb_w "indiziertes Soll-Moment für NMAX-Begrenzung ohne Begrenzung" SWORD rel_sw_b100 1 100 -100 99.9969 FORMAT "%8.4" ECU_ADDRESS 0x3826C8 /end MEASUREMENT
/begin MEASUREMENT minmx_w "Momentenanforderung der Drehzahlbegrenzung" UWORD rel_uw_b100 1 100 0 99.9985 FORMAT "%8.5" ECU_ADDRESS 0x3826CA /end MEASUREMENT
/begin MEASUREMENT misgsl_w "Inneres Soll-Motormoment luftseitig für Drehzahlsynchr. bei Getriebeschaltung" UWORD dez 1 100 0 65535 FORMAT "%8.2" ECU_ADDRESS 0x384998 /end MEASUREMENT
/begin MEASUREMENT mistt "Startmoment" UBYTE rel_ub_b99p6 1 100 0 99.6094 FORMAT "%5.2" ECU_ADDRESS 0x380B0E /end MEASUREMENT
/begin MEASUREMENT mitibgri_w "I-Anteil für begrenztes Moment aus ti-Regelung bei ununterbrochener Einspritzung" UWORD rel_uw_b100 1 100 0 99.9985 FORMAT "%8.5" ECU_ADDRESS 0x384AF2 /end MEASUREMENT
/begin MEASUREMENT mitibgrp_w "P-Anteil für begrenztes Moment aus ti-Regelung bei ununterbrochener Einspritzung" SWORD rel_uw_b100 1 100 -50 49.9985 FORMAT "%8.5" ECU_ADDRESS 0x384AF4 /end MEASUREMENT
/begin MEASUREMENT mitibgr_w "begrenztes Moment aus ti-Regelung bei ununterbrochener Einspritzung" UWORD rel_uw_b100 1 100 0 99.9985 FORMAT "%8.5" ECU_ADDRESS 0x384AF6 /end MEASUREMENT
/begin MEASUREMENT mkbgr_w "maximales Kupplungsmoment von Automatikgetriebe" UWORD rel_uw_b100 1 100 0 99.9985 FORMAT "%8.5" ECU_ADDRESS 0x380CF6 /end MEASUREMENT
/begin MEASUREMENT mracc_w "Relativer Momentenwunsch von ACC" UWORD rel_uw_b200 1 100 0 199.997 FORMAT "%8.4" ECU_ADDRESS 0x380CF8 /end MEASUREMENT
/begin MEASUREMENT msl "Sekundärluftmassenstrom" UBYTE m_ub_q0p4 1 100 0 102 FORMAT "%5.1" ECU_ADDRESS 0x38480F /end MEASUREMENT
/begin MEASUREMENT mslkorr_w "korr. Sekundärluftmassenstrom unter Berücksichtigung der Pumpendynamik (Bank1)" UWORD m_uw_b6553p5 1 100 0 6553.5 FORMAT "%8.3" ECU_ADDRESS 0x3849AA /end MEASUREMENT
/begin MEASUREMENT mslpub_w "Sekundärluftmassenstrom, batteriespannungsabhängig 16-Bit" UWORD m_uw_b6553p5 1 100 0 6553.5 FORMAT "%8.3" ECU_ADDRESS 0x3849AC /end MEASUREMENT
/begin MEASUREMENT mslstat "statischer Sekundärluftmassenstrom" UBYTE m_ub_q0p4 1 100 0 102 FORMAT "%5.1" ECU_ADDRESS 0x384810 /end MEASUREMENT
/begin MEASUREMENT mslstat_w "statische Sekundärluftmassestrom, 16-Bit" UWORD m_uw_b6553p5 1 100 0 6553.5 FORMAT "%8.3" ECU_ADDRESS 0x3849AE /end MEASUREMENT
/begin MEASUREMENT msl_w "Sekundärluftmassenstrom 16-Bit Wert" UWORD m_uw_b6553p5 1 100 0 6553.5 FORMAT "%8.3" ECU_ADDRESS 0x3849B0 /end MEASUREMENT
/begin MEASUREMENT nmaxdvg_w "gangabhängige Drehzahlbegrenzung bei Fehlererkennung Geschwindigkeitssignal" UWORD nmot_uw_q0p25 1 100 0 16383.8 FORMAT "%8.2" ECU_ADDRESS 0x384C6C /end MEASUREMENT
/begin MEASUREMENT nmaxext_w "Externe Drehzahlgrenze" UWORD nmot_uw_q0p25 1 100 0 16383.8 FORMAT "%8.2" ECU_ADDRESS 0x380CFA /end MEASUREMENT
/begin MEASUREMENT nmaxga_w "Maximal zulässige gangabhängige Motordrehzahl" UWORD nmot_uw_q0p25 1 100 0 16383.8 FORMAT "%8.2" ECU_ADDRESS 0x384C6E /end MEASUREMENT
/begin MEASUREMENT nmax_w "Drehzahlgrenze ohne Berücksichtigung von Drosselklappen-Fehlern" UWORD nmot_uw_q0p25 1 100 0 16383.8 FORMAT "%8.2" ECU_ADDRESS 0x3826CC /end MEASUREMENT
/begin MEASUREMENT nmotpr_w "Prädizierte Motordrehzahl für NMAX-Regelung" UWORD nmot_uw_q0p25 1 100 0 16383.8 FORMAT "%8.2" ECU_ADDRESS 0x3826CE /end MEASUREMENT
/begin MEASUREMENT nmxpr "Verstärkung Proportionalanteil der NMAX-Regelung" UBYTE relnmot_q0p0039 1 100 0 0.996094 ECU_ADDRESS 0x3848EF /end MEASUREMENT
/begin MEASUREMENT nsber_w "Solldrehzahl für NMAX-Regelung" UWORD nmot_uw_q0p25 1 100 0 16383.8 FORMAT "%8.2" ECU_ADDRESS 0x3826D0 /end MEASUREMENT
/begin MEASUREMENT nturbc_w "Wandler-Turbinendrehzahl über CAN" UWORD dez 1 100 0 65535 FORMAT "%8.2" ECU_ADDRESS 0x380CFC /end MEASUREMENT
/begin MEASUREMENT NWEVOausbits01 "" UBYTE dez 1 100 0 255 FORMAT "%5.1" ECU_ADDRESS 0x380BBC /end MEASUREMENT
/begin MEASUREMENT NWSOLLEausbits "" UBYTE dez 1 100 0 255 FORMAT "%5.1" ECU_ADDRESS 0x380BBD /end MEASUREMENT
/begin MEASUREMENT NWSOLLElokbits "" UBYTE dez 1 100 0 255 FORMAT "%5.1" ECU_ADDRESS 0x380BBE /end MEASUREMENT
/begin MEASUREMENT NWSYVARausbits "" UBYTE dez 1 100 0 255 FORMAT "%5.1" ECU_ADDRESS 0x380BB2 /end MEASUREMENT
/begin MEASUREMENT OBPSWOFFbits "" UBYTE dez 1 100 0 255 FORMAT "%5.1" ECU_ADDRESS 0x3831EE /end MEASUREMENT
/begin MEASUREMENT pbrint_w "Partialdruck (Inertgas+Luft) im Brennraum durch internes AGR" UWORD p_uw_q0p039 1 100 0 2559.96 FORMAT "%8.3" ECU_ADDRESS 0x380CFE /end MEASUREMENT
/begin MEASUREMENT perffilt_w "Gefilterte Systemauslastung" UWORD rel_q0p025 1 100 0 1638.38 FORMAT "%8.3" ECU_ADDRESS 0x382816 /end MEASUREMENT
/begin MEASUREMENT perfilt_bg "Gefilterte Systemauslastung, berechnet im Background-Task" UWORD rel_uw_b100 1 100 0 99.9985 FORMAT "%8.5" ECU_ADDRESS 0x382818 /end MEASUREMENT
/begin MEASUREMENT perfmax_w "Maximale system Belastung" UWORD rel_q0p025 1 100 0 1638.38 FORMAT "%8.3" ECU_ADDRESS 0x383AAC /end MEASUREMENT
/begin MEASUREMENT perform_bg "Aktuelle Systemauslastung, berechnet im Background-Task" UWORD rel_uw_b100 1 100 0 99.9985 FORMAT "%8.5" ECU_ADDRESS 0x38281A /end MEASUREMENT
/begin MEASUREMENT perform_w "Aktuelle Systemauslastung" UWORD rel_q0p025 1 100 0 1638.38 FORMAT "%8.3" ECU_ADDRESS 0x38281C /end MEASUREMENT
/begin MEASUREMENT peri40ms_w "periode of 50ms-task" UWORD runtime2_sy 1 100 0 699040 FORMAT "%8.1" ECU_ADDRESS 0x38281E /end MEASUREMENT
/begin MEASUREMENT psl "Öldruck von der Servo-Lenkung" UBYTE dez 1 100 0 255 FORMAT "%5.1" ECU_ADDRESS 0x384803 /end MEASUREMENT
/begin MEASUREMENT qnst "Drehzahlquotient im Start" UBYTE fak_ub_b2 1 100 0 1.99219 FORMAT "%5.3" ECU_ADDRESS 0x380B0F /end MEASUREMENT
/begin MEASUREMENT rdeBits "" UBYTE dez 1 100 0 255 FORMAT "%5.1" ECU_ADDRESS 0x380969 /end MEASUREMENT
/begin MEASUREMENT resetMonIdx "" UWORD dez 1 100 0 65535 FORMAT "%8.2" ECU_ADDRESS 0x384056 /end MEASUREMENT
/begin MEASUREMENT RKTIlokbits "" UBYTE dez 1 100 0 255 FORMAT "%5.1" ECU_ADDRESS 0x380A38 /end MEASUREMENT
/begin MEASUREMENT rlossCtr_w "Zähler der jeden Task-Verlust" UWORD dez 1 100 0 65535 FORMAT "%8.2" ECU_ADDRESS 0x383AAE /end MEASUREMENT
/begin MEASUREMENT rlshk_w "Soll-Füllung höhenkorrigiert" UWORD rel_uw_q0p0234 1 100 0 1535.98 FORMAT "%8.3" ECU_ADDRESS 0x380D00 /end MEASUREMENT
/begin MEASUREMENT rstMon "" UWORD dez 1 100 0 65535 FORMAT "%8.2" ARRAY_SIZE 12 ECU_ADDRESS 0x384058 /end MEASUREMENT
/begin MEASUREMENT scattBits "" UBYTE dez 1 100 0 255 FORMAT "%5.1" ECU_ADDRESS 0x380944 /end MEASUREMENT
/begin MEASUREMENT SLSlokBits "" UWORD dez 1 100 0 65535 FORMAT "%8.2" ECU_ADDRESS 0x3849B2 /end MEASUREMENT
/begin MEASUREMENT stactr "Startadaptionscounter" UBYTE dez 1 100 0 255 FORMAT "%5.1" ECU_ADDRESS 0x380A46 /end MEASUREMENT
/begin MEASUREMENT STADAPlokBits "" UWORD dez 1 100 0 65535 FORMAT "%8.2" ECU_ADDRESS 0x384B1C /end MEASUREMENT
/begin MEASUREMENT statetnwe "Anzeige: aktueller Zustand bei Ansteuerung Einlaßnockenwelle durch Tester" UBYTE dez 1 100 0 255 FORMAT "%5.1" ECU_ADDRESS 0x384927 /end MEASUREMENT
/begin MEASUREMENT swadp1AusBits "" UBYTE dez 1 100 0 255 FORMAT "%5.1" ECU_ADDRESS 0x380890 /end MEASUREMENT
/begin MEASUREMENT synstate "Aktueller Synchronisierzustand" UBYTE dez 1 100 0 255 FORMAT "%5.1" ECU_ADDRESS 0xF8CB /end MEASUREMENT
/begin MEASUREMENT synstate_o "Sychronisationszustand des vorherigen Synchros" UBYTE dez 1 100 0 255 FORMAT "%5.1" ECU_ADDRESS 0xF8CC /end MEASUREMENT
/begin MEASUREMENT systemStackUsage "" UWORD fak_uw_b1 1 100 0 0.999985 FORMAT "%9.7" ECU_ADDRESS 0x38536C /end MEASUREMENT
/begin MEASUREMENT S_NLENAS "" UWORD B_TRUE 1 100 0 1 BIT_MASK 0x4 FORMAT "%13.11" ECU_ADDRESS 0xFD90 /end MEASUREMENT
/begin MEASUREMENT t8ichactr "" UBYTE dez 1 100 0 255 FORMAT "%5.1" ECU_ADDRESS 0xF7B8 /end MEASUREMENT
/begin MEASUREMENT t8iCur "" UWORD dez 1 100 0 65535 FORMAT "%8.2" ECU_ADDRESS 0xF7BE /end MEASUREMENT
/begin MEASUREMENT t8iSav "" UWORD dez 1 100 0 65535 FORMAT "%8.2" ECU_ADDRESS 0xF7C0 /end MEASUREMENT
/begin MEASUREMENT talsuf "gefilterte Abgastemperatur aus Modell" UBYTE temp_ub_q5_o50 1 100 -50 1225 FORMAT "%5.0" ECU_ADDRESS 0x384804 /end MEASUREMENT
/begin MEASUREMENT tavhkm_w "Abgastemperatur vor Hauptkat aus Modell" UWORD temp_q0p0234_o273 1 100 -273.15 1262.83 FORMAT "%8.3" ECU_ADDRESS 0x38499A /end MEASUREMENT
/begin MEASUREMENT tcchats_w "Highzeit Abgastemperatursensor von CC-Einheit" UWORD dez 1 100 0 65535 FORMAT "%8.2" ECU_ADDRESS 0xF7C2 /end MEASUREMENT
/begin MEASUREMENT tccpats_w "Periodendauer Abgastemperatursensor von CC-Einheit" UWORD dez 1 100 0 65535 FORMAT "%8.2" ECU_ADDRESS 0xF7C4 /end MEASUREMENT
/begin MEASUREMENT tevfakge_w "Adressierung Kennfeld FKKVS mit effektiver Einspritzzeit vor Feinabgleich" UWORD tinjection_sy 1 100 0 174.76 FORMAT "%8.4" ECU_ADDRESS 0x38202E /end MEASUREMENT
/begin MEASUREMENT tevfa_w "effektive Einspritzzeit vor Feinabgleich (word)" UWORD tinjection_sy 1 100 0 174.76 FORMAT "%8.4" ECU_ADDRESS 0x382030 /end MEASUREMENT
/begin MEASUREMENT te_w "effektive Einspritzzeit (word)" UWORD tinjection_sy 1 100 0 174.76 FORMAT "%8.4" ECU_ADDRESS 0x382032 /end MEASUREMENT
/begin MEASUREMENT timevovCtrOld "" UWORD dez 1 100 0 65535 FORMAT "%8.2" ECU_ADDRESS 0xF7C6 /end MEASUREMENT
/begin MEASUREMENT timxth_w "theoretische maximale Einspritzzeit" UWORD tinjection_sy 1 100 0 174.76 FORMAT "%8.4" ECU_ADDRESS 0x384AF8 /end MEASUREMENT
/begin MEASUREMENT timx_w "maximale Einspritzzeit" UWORD tinjection_sy 1 100 0 174.76 FORMAT "%8.4" ECU_ADDRESS 0x384AFA /end MEASUREMENT
/begin MEASUREMENT ti_b1 "Einspritzzeit für EV's auf Bank1" UWORD tinjection_sy 1 100 0 174.76 FORMAT "%8.4" ECU_ADDRESS 0x382034 /end MEASUREMENT
/begin MEASUREMENT ti_b2 "Einspritzzeit für EV's auf Bank2" UWORD tinjection_sy 1 100 0 174.76 FORMAT "%8.4" ECU_ADDRESS 0x382036 /end MEASUREMENT
/begin MEASUREMENT ti_tvu_w "Batteriespannungsabhängige Einspritzzeitkorrektur CPU-Quantisierung" UWORD tinjection_sy 1 100 0 174.76 FORMAT "%8.4" ECU_ADDRESS 0xF9CE /end MEASUREMENT
/begin MEASUREMENT ti_w "Einspritzzeit" UWORD tinjection5_sy 1 100 0 873.8 FORMAT "%8.4" ECU_ADDRESS 0x382038 /end MEASUREMENT
/begin MEASUREMENT tkihkm_w "Temperatur Katalysator im Hauptkat aus Modell" UWORD temp_q0p0234_o273 1 100 -273.15 1262.83 FORMAT "%8.3" ECU_ADDRESS 0x38499C /end MEASUREMENT
/begin MEASUREMENT tmadb "Bereich Motortemperatur für Startmengenadaption" UBYTE dez 1 100 0 255 FORMAT "%5.1" ECU_ADDRESS 0x380A47 /end MEASUREMENT
/begin MEASUREMENT tnachlOBP "" UWORD t100msxs_uw_b6553p6 1 100 0 6553.5 FORMAT "%8.3" ECU_ADDRESS 0x383AAA /end MEASUREMENT
/begin MEASUREMENT tnbmrde "Zahnperiodenzeit des letzten nbm Signals (in 1ms Raster)" UBYTE t1msxms_q1 1 100 0 255 FORMAT "%5.1" ECU_ADDRESS 0xF8C0 /end MEASUREMENT
/begin MEASUREMENT tnbmrde1 "Zahnperiodenzeit des zweitletzten nbm Signals (in 1ms Raster)" UBYTE t1msxms_q1 1 100 0 255 FORMAT "%5.1" ECU_ADDRESS 0xF8C1 /end MEASUREMENT
/begin MEASUREMENT tnbmrde2 "Zahnperiodenzeit des drittletzten nbm Signals (in 1ms Raster)" UBYTE t1msxms_q1 1 100 0 255 FORMAT "%5.1" ECU_ADDRESS 0xF8C2 /end MEASUREMENT
/begin MEASUREMENT tnmax_w "Zeit bis zur Umschaltung der Abstimmung der Drehzahlbegrenzung" UWORD t10msxs_uw_b655p35 1 100 0 655.35 FORMAT "%8.4" ECU_ADDRESS 0x384C70 /end MEASUREMENT
/begin MEASUREMENT tnmxh_w "Timer abwärts für Zeit oberhalb der unteren Drehzahlgrenze" UWORD t10msxs_uw_b655p35 1 100 0 655.35 FORMAT "%8.4" ECU_ADDRESS 0x3826D2 /end MEASUREMENT
/begin MEASUREMENT tnwsbge "Zeitkonstante für Sollwertänderungsbegrenzung Einlassnockenwelle" UBYTE zk10msxs_ub_b2p55 1 100 0.01 2.55 FORMAT "%5.3" ECU_ADDRESS 0x380BBF /end MEASUREMENT
/begin MEASUREMENT toelk_w "(Motor-) Öltemperatur, Ausgabe in Grad C, intern in Kelvin" UWORD temp_q0p0234_o273 1 100 -273.15 1262.83 FORMAT "%8.3" ECU_ADDRESS 0x38499E /end MEASUREMENT
/begin MEASUREMENT tr_zahn "Zahnzähler (Winkel an TR-Marke)" UWORD dez 1 100 0 65535 FORMAT "%8.2" ECU_ADDRESS 0xF7A4 /end MEASUREMENT
/begin MEASUREMENT tr_zahn2 "Zahnzähler (Winkel an TR-Marke)" UWORD dez 1 100 0 65535 FORMAT "%8.2" ECU_ADDRESS 0xF7A6 /end MEASUREMENT
/begin MEASUREMENT tr_zeit "Timerstand zum Zeitpunkt der TR-Marke" UWORD dez 1 100 0 65535 FORMAT "%8.2" ECU_ADDRESS 0xF7A8 /end MEASUREMENT
/begin MEASUREMENT tr_zeit2 "Timerstand zum Zeitpunkt der TR-Marke" UWORD dez 1 100 0 65535 FORMAT "%8.2" ECU_ADDRESS 0xF7AA /end MEASUREMENT
/begin MEASUREMENT tr_zeit_msb "" UBYTE dez 1 100 0 255 FORMAT "%5.1" ECU_ADDRESS 0xF7A2 /end MEASUREMENT
/begin MEASUREMENT ttvie_w "Zeitpunkt des TV-Interrupts (Einlaß)" UWORD dez 1 100 0 65535 FORMAT "%8.2" ECU_ADDRESS 0x382BD8 /end MEASUREMENT
/begin MEASUREMENT tum_ein "Umgebungstemperatur für Abstellzeitberechnung" UBYTE temp_ub_q0p75_o48 1 100 -48 143.25 FORMAT "%5.1" ECU_ADDRESS 0x384805 /end MEASUREMENT
/begin MEASUREMENT tvsp_w "Einspritzzeit Verzugszeit in Abhängigkeit von evtmod" UWORD tinjection_sy 1 100 0 174.76 FORMAT "%8.4" ECU_ADDRESS 0x384AFC /end MEASUREMENT
/begin MEASUREMENT tvu_w "Batteriespannungskorrektur" UWORD tinjection_sy 1 100 0 174.76 FORMAT "%8.4" ECU_ADDRESS 0x38203A /end MEASUREMENT
/begin MEASUREMENT ubrde "Batteriespannungsschwelle für Anlasser ausgerückt" UBYTE spg_ubatt 1 100 0 17.952 FORMAT "%5.2" ECU_ADDRESS 0x38096A /end MEASUREMENT
/begin MEASUREMENT userStackUsage "" UWORD fak_uw_b1 1 100 0 0.999985 FORMAT "%9.7" ECU_ADDRESS 0x38536E /end MEASUREMENT
/begin MEASUREMENT usvk "Spannung Lambdasonde vor Kat" UBYTE spg_ub_q0p0052_o0p2 1 100 -0.2 1.13 FORMAT "%5.3" ECU_ADDRESS 0x384806 /end MEASUREMENT
/begin MEASUREMENT usvk2 "Spannung Lambdasonde vor Kat 2" UBYTE spg_ub_q0p0052_o0p2 1 100 -0.2 1.13 FORMAT "%5.3" ECU_ADDRESS 0x384807 /end MEASUREMENT
/begin MEASUREMENT wdnwse_w "Sollwinkeldifferenz am Eingang Änderungsbegrenzung Einlaßnockenwelle" SWORD kw_sw_q0p0078 1 100 -256 255.992 FORMAT "%8.4" ECU_ADDRESS 0x382BEE /end MEASUREMENT
/begin MEASUREMENT wessbm "Winkel Einlass schliesst spät bis Bezugsmarke" UBYTE kw_q2p8125 1 100 0 717.188 FORMAT "%5.1" ECU_ADDRESS 0x38088B /end MEASUREMENT
/begin MEASUREMENT wkwas_rde "Korrigierter Winkel im Arbeitsspiel für RDE" UBYTE kw_q6 1 100 0 1530 FORMAT "%5.0" ECU_ADDRESS 0x38096B /end MEASUREMENT
/begin MEASUREMENT wnwdshke_w "Deltasollwinkel Nockenwelle Einlaß Höhenkorrektur bei Katheizen" SWORD kw_sw_q0p0078 1 100 -256 255.992 FORMAT "%8.4" ECU_ADDRESS 0x3853DA /end MEASUREMENT
/begin MEASUREMENT wnwehom_w "Vorsteuerwert für NW-Sollwinkel im Homogenbetrieb Einlaß" SWORD kw_sw_q0p0078 1 100 -256 255.992 FORMAT "%8.4" ECU_ADDRESS 0x3853DC /end MEASUREMENT
/begin MEASUREMENT wnwem "Nockenwellenwinkel Einlaß (Mittelwert)" SBYTE kw_q0p5 1 100 -64 63.5 FORMAT "%5.2" ECU_ADDRESS 0x380891 /end MEASUREMENT
/begin MEASUREMENT wnweos "Sollwinkel für Nockenwelle Einlaß öffnet" UBYTE kw_ub_q0p5 1 100 0 127.5 FORMAT "%5.1" ECU_ADDRESS 0x384929 /end MEASUREMENT
/begin MEASUREMENT wnwgv_w "Gesamtverstellwinkel  Ein- und Auslass Nockenwelle" UWORD kw_uw_q0p0078 1 100 0 511.992 FORMAT "%8.4" ECU_ADDRESS 0x3853B4 /end MEASUREMENT
/begin MEASUREMENT wnwise_w "Istwinkel für Einlaßnockenwelle" SWORD kw_q0p0039 1 100 -128 127.996 FORMAT "%8.4" ECU_ADDRESS 0x382BDA /end MEASUREMENT
/begin MEASUREMENT wnwi_w "Istwinkel für Nockenwelle (word)" SWORD kw_sw_b128 1 100 -128 127.996 FORMAT "%8.4" ECU_ADDRESS 0x3849A0 /end MEASUREMENT
/begin MEASUREMENT wnwkhe_w "Sollwinkel Nockenwelle Einlaß bei Katheizen" SWORD kw_sw_q0p0078 1 100 -256 255.992 FORMAT "%8.4" ECU_ADDRESS 0x3853DE /end MEASUREMENT
/begin MEASUREMENT wnwkhlle_w "Sollwinkel Nockenwelle Einlaß bei Katheizen und B_ll" SWORD kw_sw_q0p0078 1 100 -256 255.992 FORMAT "%8.4" ECU_ADDRESS 0x3853E0 /end MEASUREMENT
/begin MEASUREMENT wnwsae_w "aktiver Sollwinkel, der aus den verschiedenen Kennfeldern selektiert wurde Einla" SWORD kw_sw_q0p0078 1 100 -256 255.992 FORMAT "%8.4" ECU_ADDRESS 0x3853E2 /end MEASUREMENT
/begin MEASUREMENT wnwsape_w "Sollwinkel Einlassnockenwelle aus Kennfeld oder Festwert für Applikationszwecke" SWORD kw_sw_q0p0078 1 100 -256 255.992 FORMAT "%8.4" ECU_ADDRESS 0x3853E4 /end MEASUREMENT
/begin MEASUREMENT wnwsbge_w "Sollwert Nockewellenverstellung nach Änderungsbegrenzung Einlassnockenwelle" SWORD kw_sw_q0p0078 1 100 -256 255.992 FORMAT "%8.4" ECU_ADDRESS 0x382BF0 /end MEASUREMENT
/begin MEASUREMENT wnwsemx "max. erlaubter NW-Einlaß-Sollwinkel" UBYTE kw_ub_q0p5 1 100 0 127.5 FORMAT "%5.1" ECU_ADDRESS 0x38492A /end MEASUREMENT
/begin MEASUREMENT wnwseve2_w "Sollwinkel für eingeschränkte Nockenwellenverstellung Einlass 2" SWORD kw_sw_q0p0078 1 100 -256 255.992 FORMAT "%8.4" ECU_ADDRESS 0x3853D4 /end MEASUREMENT
/begin MEASUREMENT wnwseve_w "Sollwinkel für eingeschränkte Nockenwellenverstellung Einlass" SWORD kw_sw_q0p0078 1 100 -256 255.992 FORMAT "%8.4" ECU_ADDRESS 0x3853D6 /end MEASUREMENT
/begin MEASUREMENT wnwse_w "Sollwinkel Nockenwelle Einlass öffnet" SWORD kw_sw_q0p0078 1 100 -256 255.992 FORMAT "%8.4" ECU_ADDRESS 0x382BF2 /end MEASUREMENT
/begin MEASUREMENT wnwsfae_w "Sollwinkel bei Testereingriff Einlassnockenwelle" SWORD kw_sw_q0p0078 1 100 -256 255.992 FORMAT "%8.4" ECU_ADDRESS 0x3853D2 /end MEASUREMENT
/begin MEASUREMENT wnwskwe_w "Sollwinkel Nockenwelle Einlaß aus Kalt oder Warmkennfeld" SWORD kw_sw_q0p0078 1 100 -256 255.992 FORMAT "%8.4" ECU_ADDRESS 0x3853E6 /end MEASUREMENT
/begin MEASUREMENT wnwskwke_w "Sollwinkel Nockenwelle Einlaß aus Kalt oder Warmkennfeld mit Klopfeingriff" SWORD kw_sw_q0p0078 1 100 -256 255.992 FORMAT "%8.4" ECU_ADDRESS 0x3853E8 /end MEASUREMENT
/begin MEASUREMENT wnwskwle_w "Sollwinkel Nockenwelle Einlaß aus Kalt oder Warmkennfeld bei B_ll" SWORD kw_sw_q0p0078 1 100 -256 255.992 FORMAT "%8.4" ECU_ADDRESS 0x3853EA /end MEASUREMENT
/begin MEASUREMENT wnwsmne_w "minimaler Sollwinkel Nockenwelle Einlaß öffnet" SWORD kw_sw_q0p0078 1 100 -256 255.992 FORMAT "%8.4" ECU_ADDRESS 0x3853EC /end MEASUREMENT
/begin MEASUREMENT wnwsmxe_w "maximaler Sollwinkel Nockenwelle Einlaß öffnet" SWORD kw_sw_q0p0078 1 100 -256 255.992 FORMAT "%8.4" ECU_ADDRESS 0x3853EE /end MEASUREMENT
/begin MEASUREMENT wnwsswe_w "gespeicherter Nockenwellensollwinkel Einlaß" SWORD kw_sw_q0p0078 1 100 -256 255.992 FORMAT "%8.4" ECU_ADDRESS 0x382BF4 /end MEASUREMENT
/begin MEASUREMENT wnwstvh_w "Sollwinkel bei Verstellstop durch umschalten der Nockenhöhe Einlassnockenwelle" SWORD kw_sw_q0p0078 1 100 -256 255.992 FORMAT "%8.4" ECU_ADDRESS 0x3853D8 /end MEASUREMENT
/begin MEASUREMENT wnwue "Winkel Nockenwellenueberschneidung" UBYTE kw_q0p5 1 100 0 127.5 FORMAT "%5.1" ECU_ADDRESS 0x38491B /end MEASUREMENT
/begin MEASUREMENT wnwue_w "Winkel Nockenwellenueberschneidung" UWORD kw_q0p0019 1 100 0 127.998 FORMAT "%8.4" ECU_ADDRESS 0x3853B6 /end MEASUREMENT
/begin MEASUREMENT wnwug_w "Grundüberschneidungswinkel  Ein- und Auslass Nockenwelle" SWORD kw_sw_q0p0078 1 100 -256 255.992 FORMAT "%8.4" ECU_ADDRESS 0x3853B8 /end MEASUREMENT
/begin MEASUREMENT wnwu_w "Gesamtüberschneidungswinkel  Ein- und Auslass Nockenw. incl. Grundüberschneidung" SWORD kw_sw_q0p0078 1 100 -256 255.992 FORMAT "%8.4" ECU_ADDRESS 0x3853BA /end MEASUREMENT
/begin MEASUREMENT wnwva_w "Verstellwinkel  Auslass Nockenwelle" SWORD kw_sw_q0p0078 1 100 -256 255.992 FORMAT "%8.4" ECU_ADDRESS 0x3853BC /end MEASUREMENT
/begin MEASUREMENT wnwve_w "Verstellwinkel  Einlass Nockenwelle" SWORD kw_sw_q0p0078 1 100 -256 255.992 FORMAT "%8.4" ECU_ADDRESS 0x3853BE /end MEASUREMENT
/begin MEASUREMENT wnwvg_w "Gesamtverstellwinkel der Nockenwelle" UWORD kw_q0p0019 1 100 0 127.998 FORMAT "%8.4" ECU_ADDRESS 0x3853C0 /end MEASUREMENT
/begin MEASUREMENT wnwvumxa_w "Max. möglicher Überschneidungswinkel durch Verstellung der Auslass-Nockenwelle" UWORD kw_uw_q0p0078 1 100 0 511.992 FORMAT "%8.4" ECU_ADDRESS 0x3853C2 /end MEASUREMENT
/begin MEASUREMENT wnwvumxe_w "Max. möglicher Überschneidungswinkel durch Verstellung der Einlass-Nockenwelle" UWORD kw_uw_q0p0078 1 100 0 511.992 FORMAT "%8.4" ECU_ADDRESS 0x3853C4 /end MEASUREMENT
/begin MEASUREMENT wnwvumx_w "Max. möglicher Überschneidungswinkel durch Verstellung der Nockenwelle(n)" UWORD kw_uw_q0p0078 1 100 0 511.992 FORMAT "%8.4" ECU_ADDRESS 0x3853C6 /end MEASUREMENT
/begin MEASUREMENT wnwvu_w "Überschneidungswinkel  Ein- und Auslass Nockenw.  nur durch Verstellung" UWORD kw_uw_q0p0078 1 100 0 511.992 FORMAT "%8.4" ECU_ADDRESS 0x3853C8 /end MEASUREMENT
/begin MEASUREMENT zburn "Anzahl erkannter Verbrennungen" UBYTE dez 1 100 0 255 FORMAT "%5.1" ECU_ADDRESS 0x380A48 /end MEASUREMENT
/begin MEASUREMENT zburnsu "Summe aller erkannten Verbrennungen während ZSYNABR" UBYTE dez 1 100 0 255 FORMAT "%5.1" ECU_ADDRESS 0x380A49 /end MEASUREMENT
/begin MEASUREMENT zsynchro "Anzahl Zündungen bis Auswertung der Verbrennungen" UBYTE dez 1 100 0 255 FORMAT "%5.1" ECU_ADDRESS 0x380A4A /end MEASUREMENT
/begin MEASUREMENT zsynsu "Zündungszähler für Begrenzung Startmengenadaption" UBYTE dez 1 100 0 255 FORMAT "%5.1" ECU_ADDRESS 0x380A4B /end MEASUREMENT
/begin MEASUREMENT zubkst "Zähler: UBatt < UBKST" UBYTE dez 1 100 0 255 FORMAT "%5.1" ECU_ADDRESS 0x380A4C /end MEASUREMENT
/begin MEASUREMENT zzbank "Zylinderzuordnung zu Einspritzbänken" UWORD dez 1 100 0 65535 FORMAT "%8.2" ECU_ADDRESS 0x380BF8 /end MEASUREMENT
/begin MEASUREMENT zzylzue "SW-Zylinderzähler für Zündungsberechnung" UBYTE dez 1 100 0 255 FORMAT "%5.1" ECU_ADDRESS 0x38088C /end MEASUREMENT
/begin FUNCTION NMAXMD "4.80      Drehzahlbegrenzung"
 /begin DEF_CHARACTERISTIC CWNMAXMD DNMAX DNMAXDZ DNMAXH DNSIRES ITNMXH KINMXNL KINMXRLG KLTNMXPR MDIMX NMAX NMAXDV NMAXDVG NMAXDZ NMAXGA NMAXNL NMAXOG NMXDAEF NMXDKPU NMXPNL NMXPRLG TMOTNMX TNMXH VNMX /end DEF_CHARACTERISTIC
 /begin REF_CHARACTERISTIC SGA08MDUB SRL08NXUB /end REF_CHARACTERISTIC
 /begin IN_MEASUREMENT B_autget B_dknolu B_dkpu B_dopzue B_nldg B_nmaxext esst_sga08mdub esst_srl08nxub gangi mifab_w ngfil_w nmaxext_w nmot_w rl tmot vfzg wped /end IN_MEASUREMENT
 /begin OUT_MEASUREMENT B_nmax B_nmaxd minmx_w nsber_w /end OUT_MEASUREMENT
 /begin LOC_MEASUREMENT B_itnmxh B_tnmxh dmnmxi_w dmnmxp_w dnsi_w itnmaxp_w itnmxh_w kinmx mifabh_w minmxb_w nmaxdvg_w nmaxga_w nmax_w nmotpr_w nmxpr tnmax_w tnmxh_w /end LOC_MEASUREMENT
 /begin SUB_FUNCTION /end SUB_FUNCTION
/end FUNCTION
/begin FUNCTION NWEVO "1.10      Nockenwelle: eingeschränkte Verstellmöglichkeiten wegen Öldruck" /begin DEF_CHARACTERISTIC /end DEF_CHARACTERISTIC /begin REF_CHARACTERISTIC WNWREO /end REF_CHARACTERISTIC /begin IN_MEASUREMENT wnwe_w /end IN_MEASUREMENT /begin OUT_MEASUREMENT B_nwseve NWEVOausbits01 wnwseve2_w wnwseve_w /end OUT_MEASUREMENT /begin LOC_MEASUREMENT wnwstvh_w /end LOC_MEASUREMENT /begin SUB_FUNCTION /end SUB_FUNCTION /end FUNCTION
/begin FUNCTION NWFW "2.10      Berechnung Faktor Winkel Nockenwelle" /begin DEF_CHARACTERISTIC KLFNWA KLFNWE /end DEF_CHARACTERISTIC /begin REF_CHARACTERISTIC /end REF_CHARACTERISTIC /begin IN_MEASUREMENT fnwua fnwue /end IN_MEASUREMENT /begin OUT_MEASUREMENT fnwaa fnwea /end OUT_MEASUREMENT /begin LOC_MEASUREMENT /end LOC_MEASUREMENT /begin SUB_FUNCTION /end SUB_FUNCTION /end FUNCTION
/begin FUNCTION NWSFAT "1.30      Nockenwellensteuerung, Sollwertvorgabe durch Tester" /begin DEF_CHARACTERISTIC DMRDNW NFANWS TNWAPTE TNWFARE TNWPPTE TNWVBGNE /end DEF_CHARACTERISTIC /begin REF_CHARACTERISTIC /end REF_CHARACTERISTIC /begin IN_MEASUREMENT B_dnwse B_fa B_fanwse nmot wnwsmne_w wnwsmxe_w /end IN_MEASUREMENT
 /begin OUT_MEASUREMENT B_fanwftve B_fanwsea B_fanwstae B_fanwte dmrdnw_w wnwsfae_w /end OUT_MEASUREMENT
 /begin LOC_MEASUREMENT statetnwe /end LOC_MEASUREMENT
 /begin SUB_FUNCTION /end SUB_FUNCTION
/end FUNCTION
/begin FUNCTION NWSOLLE "2.60      Sollwertvorgabe NWS (Einlaßseitig)"
 /begin DEF_CHARACTERISTIC FNWSKRE KFNWKHE KFNWKHLLE KFNWKRE KFNWLLE KFNWSE KFNWTME KFNWWLE KFNWWLLE KFWNWSAPE NMKFNWLLE TMNWLLKHE TNWSABGKE TNWSNABGE TNWSPABGE WNWBKVE WNWDSHKE WNWREO WNWSAMXE WNWSEAPP WNWSMNE WNWSMXE WNWSTE WNWSWOFE /end DEF_CHARACTERISTIC
 /begin REF_CHARACTERISTIC SNM05NEUW SNM05NWUB SNM16NEUW SRL05NEUW SRL08NEUW /end REF_CHARACTERISTIC
 /begin IN_MEASUREMENT B_bkvnwab B_dnwse B_enwsve B_fanwsea B_fanwstae B_ll B_nwrpose B_nws B_nwsapkfe B_nwsappe B_nwseve B_nwskflle B_nwsst B_wnwsmxfe esst_snm05neuw esst_snm05nwub esst_snm16neuw esst_srl05neuw esst_srl08neuw fho_w fnwkhe nmot nmot_w rk_w rlnw_w tmot tmst tumg wkrma wnwe_w wnwseve_w wnwsfae_w /end IN_MEASUREMENT
 /begin OUT_MEASUREMENT B_wnws0e NWSOLLEausbits wnwehom_w wnweos wnwsemx wnwse_w wnwsmne_w wnwsmxe_w /end OUT_MEASUREMENT
 /begin LOC_MEASUREMENT B_nweapte fnwwarme NWSOLLElokbits tnwsbge wdnwse_w wnwdshke_w wnwkhe_w wnwkhlle_w wnwsae_w wnwsape_w wnwsbge_w wnwskwe_w wnwskwke_w wnwskwle_w wnwsswe_w /end LOC_MEASUREMENT
 /begin SUB_FUNCTION /end SUB_FUNCTION
/end FUNCTION
/begin FUNCTION NWSYVAR "2.20      Nockenwellen-Systemvarianten" /begin DEF_CHARACTERISTIC /end DEF_CHARACTERISTIC /begin REF_CHARACTERISTIC /end REF_CHARACTERISTIC /begin IN_MEASUREMENT wnwi_ad_w /end IN_MEASUREMENT /begin OUT_MEASUREMENT B_nwtve NWSYVARausbits ttvie_w wnwise_w /end OUT_MEASUREMENT /begin LOC_MEASUREMENT /end LOC_MEASUREMENT /begin SUB_FUNCTION /end SUB_FUNCTION /end FUNCTION
/begin FUNCTION NWWUE "5.20      Berechnung der Nockenwellenüberschneidung" /begin DEF_CHARACTERISTIC WNWSMNA WNWSMXA /end DEF_CHARACTERISTIC /begin REF_CHARACTERISTIC WNWREO /end REF_CHARACTERISTIC /begin IN_MEASUREMENT wnwe_w wnwsmne_w wnwsmxe_w /end IN_MEASUREMENT
 /begin OUT_MEASUREMENT fnwua fnwue fnwu_w wnwue wnwue_w wnwvg_w wnwvumxa_w wnwvumxe_w wnwvumx_w wnwvu_w /end OUT_MEASUREMENT
 /begin LOC_MEASUREMENT wnwgv_w wnwug_w wnwu_w wnwva_w wnwve_w /end LOC_MEASUREMENT
 /begin SUB_FUNCTION /end SUB_FUNCTION
/end FUNCTION
/begin FUNCTION OBPC_71 "" /begin DEF_CHARACTERISTIC SGIDB8 SGIDB9 /end DEF_CHARACTERISTIC /begin REF_CHARACTERISTIC CNSDEF SGIDB7 VARDEF /end REF_CHARACTERISTIC /begin IN_MEASUREMENT B_kl15 /end IN_MEASUREMENT
 /begin OUT_MEASUREMENT B_nlasicOBP B_nlfrOBP B_nlOBP OBPSWOFFbits S_NLENAS tnachlOBP /end OUT_MEASUREMENT
 /begin LOC_MEASUREMENT /end LOC_MEASUREMENT
 /begin SUB_FUNCTION /end SUB_FUNCTION
/end FUNCTION
/begin FUNCTION OBP_CAN "" /begin DEF_CHARACTERISTIC /end DEF_CHARACTERISTIC /begin REF_CHARACTERISTIC /end REF_CHARACTERISTIC /begin IN_MEASUREMENT /end IN_MEASUREMENT /begin OUT_MEASUREMENT /end OUT_MEASUREMENT /begin LOC_MEASUREMENT /end LOC_MEASUREMENT /begin SUB_FUNCTION /end SUB_FUNCTION /end FUNCTION
/begin FUNCTION OBP_EEP "" /begin DEF_CHARACTERISTIC /end DEF_CHARACTERISTIC /begin REF_CHARACTERISTIC /end REF_CHARACTERISTIC /begin IN_MEASUREMENT /end IN_MEASUREMENT /begin OUT_MEASUREMENT /end OUT_MEASUREMENT /begin LOC_MEASUREMENT /end LOC_MEASUREMENT /begin SUB_FUNCTION /end SUB_FUNCTION /end FUNCTION
/begin FUNCTION obp_t "" /begin DEF_CHARACTERISTIC /end DEF_CHARACTERISTIC /begin REF_CHARACTERISTIC /end REF_CHARACTERISTIC /begin IN_MEASUREMENT B_nlOBP /end IN_MEASUREMENT /begin OUT_MEASUREMENT /end OUT_MEASUREMENT /begin LOC_MEASUREMENT /end LOC_MEASUREMENT /begin SUB_FUNCTION /end SUB_FUNCTION /end FUNCTION
/begin FUNCTION PHAS "Phaseninterrupt" /begin DEF_CHARACTERISTIC /end DEF_CHARACTERISTIC /begin REF_CHARACTERISTIC /end REF_CHARACTERISTIC /begin IN_MEASUREMENT B_nldg B_phase B_phnegtiv B_switchpg zrph /end IN_MEASUREMENT /begin OUT_MEASUREMENT /end OUT_MEASUREMENT /begin LOC_MEASUREMENT /end LOC_MEASUREMENT /begin SUB_FUNCTION /end SUB_FUNCTION /end FUNCTION
/begin FUNCTION PK "" /begin DEF_CHARACTERISTIC /end DEF_CHARACTERISTIC /begin REF_CHARACTERISTIC /end REF_CHARACTERISTIC /begin IN_MEASUREMENT /end IN_MEASUREMENT /begin OUT_MEASUREMENT /end OUT_MEASUREMENT /begin LOC_MEASUREMENT /end LOC_MEASUREMENT /begin SUB_FUNCTION /end SUB_FUNCTION /end FUNCTION
/begin FUNCTION POWERFA "" /begin DEF_CHARACTERISTIC /end DEF_CHARACTERISTIC /begin REF_CHARACTERISTIC /end REF_CHARACTERISTIC /begin IN_MEASUREMENT /end IN_MEASUREMENT /begin OUT_MEASUREMENT B_pwfCsErr /end OUT_MEASUREMENT /begin LOC_MEASUREMENT /end LOC_MEASUREMENT /begin SUB_FUNCTION /end SUB_FUNCTION /end FUNCTION
/begin FUNCTION PROKON "4.20      Projektkonfiguration"
 /begin DEF_CHARACTERISTIC CDAGR CDAGRL CDATR CDATS CDBKVP CDDSBKV CDDST CDEGFE CDEHFM CDGGGTS CDHSH CDHSHE CDHSV CDHSVE CDHSVSA CDKAT CDKVS CDLASH CDLATP CDLATV CDLDP CDLLR CDLSA CDLSH CDLSV CDLSVV CDMD CDNWS CDSLS CDSWE_0_A CDSWE_1_A CDSWE_2_A CDSWE_3_A CDTANKL CDTES CDWVERAD CWADRES CWDLSU CWERFIL CWGRABH CWKMMILSCT CWKONABG CWKONFLS CWKONFZ1_0_A CWKONFZ1_1_A CWKONFZ1_2_A CWKONFZ1_3_A CWKONLS CWLSHA CWMDAPP CWOBD CWSCTMDE CWSLS CWTF CWUHR NSWO1 NSWO2 WESSOT /end DEF_CHARACTERISTIC
 /begin REF_CHARACTERISTIC /end REF_CHARACTERISTIC
 /begin IN_MEASUREMENT nmot /end IN_MEASUREMENT
 /begin OUT_MEASUREMENT B_4wd B_abstnl B_adrkra B_adrldra B_adrlra B_adrmdver B_adrmsdk B_adrsta B_asrfz B_autget B_cdagr B_cdagrl B_cdanws B_cdatr B_cdats B_cdbkvp B_cddsbkv B_cddst B_cdegfe B_cdehfm B_cdenws B_cdgts B_cdhsh B_cdhshe B_cdhsv B_cdhsve B_cdhsvsa B_cdkat B_cdkvs B_cdlash B_cdlatp B_cdlatv B_cdldp B_cdllr B_cdlsa B_cdlsh B_cdlsv B_cdlsvv B_cdmd B_cdnws B_cdsls B_cdswe B_cdtankl B_cdtes B_cvt B_cwlshdyn B_cwlshmf B_cwlshsch B_cwlshvl B_dslvh B_dssv B_dssvnl B_dsuv B_fpwdkap B_gra6p B_gracan B_hfmv B_katfz B_kath B_kmmilsct B_ldsafw B_ldsapp B_ls3 B_ls32 B_ls4 B_ls42 B_lsh B_lsh2 B_lsv B_lsv2 B_mde8e B_mde9e B_mt B_niveau B_nswo1 B_nswo2 B_plsolap B_png B_slsfz B_tfu B_uhrrmin B_uhrrsec B_wdksap B_zwappl cd_bits1_w cd_bits2_w cd_bits3_w cw_erfil cw_obd grundwert wessbm zzbank /end OUT_MEASUREMENT
 /begin LOC_MEASUREMENT /end LOC_MEASUREMENT
 /begin SUB_FUNCTION /end SUB_FUNCTION
/end FUNCTION
/begin FUNCTION PWMATS "" /begin DEF_CHARACTERISTIC /end DEF_CHARACTERISTIC /begin REF_CHARACTERISTIC /end REF_CHARACTERISTIC /begin IN_MEASUREMENT B_timev_inc timevovCtr /end IN_MEASUREMENT /begin OUT_MEASUREMENT B_intats B_intatserr tcchats_w tccpats_w /end OUT_MEASUREMENT
 /begin LOC_MEASUREMENT B_intatsfirstneg B_intatsfirstpos B_nosigats B_portStatusOld B_t8slow ccperSav ccpwSav t8ichactr t8iCur t8iSav timevovCtrOld /end LOC_MEASUREMENT
 /begin SUB_FUNCTION /end SUB_FUNCTION
/end FUNCTION
/begin FUNCTION RDE "1.40      Rückdreherkennung" /begin DEF_CHARACTERISTIC DNABW KLTNRDE NMOTRDE RDUNDEF UBDTRDE /end DEF_CHARACTERISTIC /begin REF_CHARACTERISTIC /end REF_CHARACTERISTIC
 /begin IN_MEASUREMENT B_fbm B_nmin dnmot_w nmotll synstate tmot ub vfzg_w wkwbzm0_w wkw_w wub zzseg /end IN_MEASUREMENT
 /begin OUT_MEASUREMENT B_enabrde B_motstop B_rdeplaus B_rdeundef /end OUT_MEASUREMENT
 /begin LOC_MEASUREMENT B_abw B_anlaus B_verrueck B_waitgap rdeBits tnbmrde tnbmrde1 tnbmrde2 ubrde wkwas_rde /end LOC_MEASUREMENT
 /begin SUB_FUNCTION /end SUB_FUNCTION
/end FUNCTION
/begin FUNCTION RKTI "11.40     Einspritzdauerberechnung ti aus relativer Kraftstoffmasse rk"
 /begin DEF_CHARACTERISTIC CWDMIL CWPKAPP FKKVS FRLFSDP KMITIBGR KRKTE PSAPES PVMITIBGR TEMIN TEMINVA TVTSPEV TVUB ZTSPEV /end DEF_CHARACTERISTIC
 /begin REF_CHARACTERISTIC /end REF_CHARACTERISTIC
 /begin IN_MEASUREMENT B_ba B_bag B_stend B_va evtmod mifab_w nmot nmot_w ps_w pu_w rk_w ub vsfpses /end IN_MEASUREMENT
 /begin OUT_MEASUREMENT B_temin dtimx_w evtmodev mitibgr_w timxth_w timx_w ti_b1 ti_b2 ti_tvu_w ti_w tvsp_w /end OUT_MEASUREMENT
 /begin LOC_MEASUREMENT B_enimiti dpus_w frkte_w ftek_w mitibgri_w mitibgrp_w RKTIlokbits tevfakge_w tevfa_w te_w tvu_w /end LOC_MEASUREMENT
 /begin SUB_FUNCTION /end SUB_FUNCTION
/end FUNCTION
/begin FUNCTION RSA "" /begin DEF_CHARACTERISTIC /end DEF_CHARACTERISTIC /begin REF_CHARACTERISTIC /end REF_CHARACTERISTIC /begin IN_MEASUREMENT /end IN_MEASUREMENT /begin OUT_MEASUREMENT /end OUT_MEASUREMENT /begin LOC_MEASUREMENT ctr_RSABlock /end LOC_MEASUREMENT /begin SUB_FUNCTION /end SUB_FUNCTION /end FUNCTION
/begin FUNCTION rstmon "Reset Monitor" /begin DEF_CHARACTERISTIC /end DEF_CHARACTERISTIC /begin REF_CHARACTERISTIC /end REF_CHARACTERISTIC /begin IN_MEASUREMENT /end IN_MEASUREMENT /begin OUT_MEASUREMENT resetMonIdx /end OUT_MEASUREMENT /begin LOC_MEASUREMENT rstMon /end LOC_MEASUREMENT /begin SUB_FUNCTION /end SUB_FUNCTION /end FUNCTION
/begin FUNCTION RUNTIME "" /begin DEF_CHARACTERISTIC AUFW100M AUFW10MS AUFW20MS AUFWSYNC RESETMAX /end DEF_CHARACTERISTIC /begin REF_CHARACTERISTIC /end REF_CHARACTERISTIC
 /begin IN_MEASUREMENT B_dash B_kr B_ldr B_llr B_lrs B_lsd B_sa nmot rl wdkba wped /end IN_MEASUREMENT
 /begin OUT_MEASUREMENT cyclebg_w laufz100_w laufz10m_w laufz1m_w laufz1s_w laufz200_w laufz20m_w laufz2m_w laufz50m_w laufz5m_w laufzbg_w laufzmbg_w laufzmfa_w laufzsyn2_w laufzsyn_w lzmaxnmot lzmaxrl lzmaxstate lzmaxwdkba lzmaxwped lzs_dash lzs_kr lzs_ldr lzs_lr lzs_lsd lzs_sa perffilt_w perfilt_bg perfmax_w perform_bg perform_w peri40ms_w rlossCtr_w /end OUT_MEASUREMENT
 /begin LOC_MEASUREMENT cntbg_w /end LOC_MEASUREMENT
 /begin SUB_FUNCTION /end SUB_FUNCTION
/end FUNCTION
/begin FUNCTION SCATT "20.90     SCAN TOOL-Testerschnittstelle" /begin DEF_CHARACTERISTIC /end DEF_CHARACTERISTIC /begin REF_CHARACTERISTIC /end REF_CHARACTERISTIC /begin IN_MEASUREMENT B_m9cvnout B_mde8e B_mde9e fcmEnd /end IN_MEASUREMENT /begin OUT_MEASUREMENT B_m8te B_m9cvnclr scattBits /end OUT_MEASUREMENT /begin LOC_MEASUREMENT /end LOC_MEASUREMENT /begin SUB_FUNCTION /end SUB_FUNCTION /end FUNCTION
/begin FUNCTION SLS "88.180    Sekundärluftsteuerung"
 /begin DEF_CHARACTERISTIC CWFASL DPSLV FMSL FMSLOFF FMSRHOL FMSTMOT IMLSLMNTMS IMLSLMXTMS_0_A IMLSLMXTMS_1_A IMLSLSA IMLSLSE KFFMSML MLSLMX MSLUB TASLSO TASLSU TDDSLA TDSLKT TFASLAMN TLMSSLAB TLMSSLMX TMFASLMN TMSSLO TMSSLSTO TMSSLSTU TMSSLU TSLABB TSLPMN TSLUBST TVDSLOFF TVSLVOFF TVSLVON UBSLMN UBSLMX UBSLSTMN VSLS ZFLMSSL ZKSLPOFF ZKSLPON ZKSLSOFML ZKSLSONML /end DEF_CHARACTERISTIC
 /begin REF_CHARACTERISTIC CWSLS /end REF_CHARACTERISTIC
 /begin IN_MEASUREMENT ATMbits B_atmtpl B_brems B_dslfa B_dslsp4 B_dspe B_fa B_fasls B_fs B_kh B_kha B_khab B_kuppl B_ll B_mslmn B_nmot B_slsfz B_st B_stend fmsla frhokor_w imlpr mlbb_w ml_w nmot ps_w pu rl tans tmot tmst tnst_w ubsqf_w verhmsb_w vfzg /end IN_MEASUREMENT
 /begin OUT_MEASUREMENT B_fasla B_lmsslof B_msloff B_slkhof B_slp B_slpmn B_slpmn2 B_slpoff B_sls B_slsadap B_slsoab B_slsoff B_slv flamsl_w flmssl fmslrho msl mslstat mslstat_w msl_w /end OUT_MEASUREMENT
 /begin LOC_MEASUREMENT B_dslreset B_dslset B_mslon B_sldsl4 B_slkt B_slpanst B_slpena B_slpofst B_slsdis B_slserr B_slsinhi B_slvanst fmsagd fmsldyn fmslkor fmsltm fslpdyn imlsla_w imlsle_w mslkorr_w mslpub_w SLSlokBits /end LOC_MEASUREMENT
 /begin SUB_FUNCTION /end SUB_FUNCTION
/end FUNCTION
/begin FUNCTION SREAKT "7.70      EGAS: Sicherheitskonzept, Fehlerreaktionen" /begin DEF_CHARACTERISTIC /end DEF_CHARACTERISTIC /begin REF_CHARACTERISTIC /end REF_CHARACTERISTIC
 /begin IN_MEASUREMENT B_appnolu B_dkp1e B_dkp2e B_dkpaw B_dlrbe B_dlrpide B_fproab B_fprzab B_i_ska_um B_nlpne B_ubdve B_ub_ok B_umauab B_wdksive /end IN_MEASUREMENT
 /begin OUT_MEASUREMENT B_dknolu B_dknot B_dkpiu B_dkpru B_dkpu B_i_ska_fr B_notlu_fr /end OUT_MEASUREMENT
 /begin LOC_MEASUREMENT B_dkunb /end LOC_MEASUREMENT
 /begin SUB_FUNCTION /end SUB_FUNCTION
/end FUNCTION
/begin FUNCTION SSTB ""
 /begin DEF_CHARACTERISTIC FHO04ESUB SAN12ESUW SDK10TEUB SEZ06TMUB SFR05TEUB SGA06MDUB SGA08MDUB SKS06ESUB SLA05ESUB SLD04LDUB SLX06TMUW SM108LHSW SMI04LLUB SML05DKUB_0_A SML05DKUB_1_A SML06TEUB SML06TMUW SML07TMUW SML08LHUB_0_A SML08LHUB_1_A SMT06TMUW SNG06LLSB SNM05DKUB_0_A SNM05DKUB_1_A SNM05NEUW SNM05NWUB SNM06GKUB SNM06LLUB SNM06MDUW SNM07ESUB SNM07LSUW SNM08DMUB SNM08FEUB SNM08LDUB SNM08LDUW SNM08LHUB SNM08OPUB SNM08__UB SNM10LSUB SNM10TEUB SNM12ESUB SNM12FEUB SNM12LDUW SNM16CIUB SNM16KRDYUB SNM16KRUB SNM16LDUB SNM16LDUW SNM16NEUW SNM16OPUW SNM16ZUUW SPU08LDUB SQM05TEUB SRL03KRUB SRL04KRUB SRL05NEUW SRL06ESUB SRL06GKUB SRL06KRUB SRL08DMUB SRL08LSUW SRL08NEUW SRL08NXUB SRL10LSUB SRL12ESUB SRL12ZUUW ST107TMUB ST307TMUB STA04LLUB STA06ESUB STA08LDUB STA12WLUB STK04SAUB STM04FEUB STM04SAUB STM05SAUB STM05TMUB STM06LLUB STM06__UB STM08DMUB STM08GKUB STM08MDUB STM08OPUB STM09ESUB STM10__UB STM12ESUB STN06LLUB STS08LDUB STS12ESUB SVP12LDUW SWP08OPUB /end DEF_CHARACTERISTIC
 /begin REF_CHARACTERISTIC /end REF_CHARACTERISTIC
 /begin IN_MEASUREMENT anztib_w dlashkm_w etazwimt fho frmit gangi imlatm_w kstaa ladiff_w lamsbg_w lde mifa_w ml ml_w msabg ngfil nmot nmot_w plsolr_w pu qmsdyn rl rlnw_w rlp rl_w tabgmst tabstatm_w tans tkatm tkatmst tmot tmst tnst tsel vpssplg_w vpsspu_w wdkba wkrmdy_w wkrmstat_w wkrmsu_w wped /end IN_MEASUREMENT
 /begin OUT_MEASUREMENT esst_fho04esub esst_san12esuw esst_sdk10teub esst_sez06tmub esst_sfr05teub esst_sga06mdub esst_sga08mdub esst_sks06esub esst_sla05esub esst_sld04ldub esst_slx06tmuw esst_sm108lhsw esst_smi04llub esst_sml05dkub esst_sml06teub esst_sml06tmuw esst_sml07tmuw esst_sml08lhub esst_smt06tmuw esst_sng06llsb esst_snm05dkub esst_snm05neuw esst_snm05nwub esst_snm06gkub esst_snm06llub esst_snm06mduw esst_snm07esub esst_snm07lsuw esst_snm08dmub esst_snm08feub esst_snm08ldub esst_snm08lduw esst_snm08lhub esst_snm08opub esst_snm08__ub esst_snm10lsub esst_snm10teub esst_snm12esub esst_snm12feub esst_snm12lduw esst_snm16ciub esst_snm16krdyub esst_snm16krub esst_snm16ldub esst_snm16lduw esst_snm16neuw esst_snm16opuw esst_snm16zuuw esst_spu08ldub esst_sqm05teub esst_srl03krub esst_srl04krub esst_srl05neuw esst_srl06esub esst_srl06gkub esst_srl06krub esst_srl08dmub esst_srl08lsuw esst_srl08neuw esst_srl08nxub esst_srl10lsub esst_srl12esub esst_srl12zuuw esst_st107tmub esst_st307tmub esst_sta04llub esst_sta06esub esst_sta08ldub esst_sta12wlub esst_stk04saub esst_stm04feub esst_stm04saub esst_stm05saub esst_stm05tmub esst_stm06llub esst_stm06__ub esst_stm08dmub esst_stm08gkub esst_stm08mdub esst_stm08opub esst_stm09esub esst_stm10__ub esst_stm12esub esst_stn06llub esst_sts08ldub esst_sts12esub esst_svp12lduw esst_swp08opub /end OUT_MEASUREMENT
 /begin LOC_MEASUREMENT /end LOC_MEASUREMENT
 /begin SUB_FUNCTION /end SUB_FUNCTION
/end FUNCTION
/begin FUNCTION STACKMON "" /begin DEF_CHARACTERISTIC /end DEF_CHARACTERISTIC /begin REF_CHARACTERISTIC /end REF_CHARACTERISTIC /begin IN_MEASUREMENT /end IN_MEASUREMENT /begin OUT_MEASUREMENT systemStackUsage userStackUsage /end OUT_MEASUREMENT /begin LOC_MEASUREMENT /end LOC_MEASUREMENT /begin SUB_FUNCTION /end SUB_FUNCTION /end FUNCTION
/begin FUNCTION STADAP "6.70      Startmengen-Adaption"
 /begin DEF_CHARACTERISTIC ANRZUEMX CWSTADAP DECKSTAI DELTASEGMX DNBURN0 DNBURN1 DNBURN2 INCKSTAI KFNSTAMX KLDNFHO KSTA0INI KSTA1INI KSTA2INI KSTAI KSTAMN0 KSTAMN1 KSTAMN2 KSTAMX0 KSTAMX1 KSTAMX2 KSTTOPMN NSTAK TMADB0 TMADB1 TMADB2 TMLIM UBKST UBKSTMX WAD0T1 WAD0T2 WAD1T0 WAD1T2 WAD2T0 WAD2T1 ZBURNABR ZBURNDEC ZBURNSOL ZSYNABR ZSYNAUSW /end DEF_CHARACTERISTIC
 /begin REF_CHARACTERISTIC /end REF_CHARACTERISTIC
 /begin IN_MEASUREMENT B_adrsta B_nmin B_pwf B_stend B_vbemg B_wks deltaseg_w dnmot_w E_ev1 E_ev2 E_ev3 E_ev4 E_frao E_frau E_n E_ph E_rkat E_tankl E_tm E_ub fho nmot nmot_w nstat tmot tmst top_w ub vfzg /end IN_MEASUREMENT
 /begin OUT_MEASUREMENT B_staa kstaa /end OUT_MEASUREMENT
 /begin LOC_MEASUREMENT adastep B_ad B_adb0 B_adb1 B_adb2 B_adlck B_ausw B_burn B_decr B_incr B_kstai B_kstaue B_nodec B_noinc B_stdperr B_ubkst dnburns_w ksta0 ksta0w ksta1 ksta1w ksta2 ksta2w stactr STADAPlokBits tmadb zburn zburnsu zsynchro zsynsu zubkst /end LOC_MEASUREMENT
 /begin SUB_FUNCTION /end SUB_FUNCTION
/end FUNCTION
/begin FUNCTION STARTUF "" /begin DEF_CHARACTERISTIC CWPWF /end DEF_CHARACTERISTIC /begin REF_CHARACTERISTIC /end REF_CHARACTERISTIC /begin IN_MEASUREMENT /end IN_MEASUREMENT /begin OUT_MEASUREMENT B_pwf /end OUT_MEASUREMENT /begin LOC_MEASUREMENT /end LOC_MEASUREMENT /begin SUB_FUNCTION /end SUB_FUNCTION /end FUNCTION
/begin FUNCTION STMD "5.10      Startmoment" /begin DEF_CHARACTERISTIC KFMDST /end DEF_CHARACTERISTIC /begin REF_CHARACTERISTIC /end REF_CHARACTERISTIC /begin IN_MEASUREMENT B_llrein mdverl_w nmotll nsst tmot /end IN_MEASUREMENT /begin OUT_MEASUREMENT mistt /end OUT_MEASUREMENT /begin LOC_MEASUREMENT qnst /end LOC_MEASUREMENT /begin SUB_FUNCTION /end SUB_FUNCTION /end FUNCTION
/begin FUNCTION SWADP "Software-Adapter" /begin DEF_CHARACTERISTIC CLRSHKEB WNWUEMXT /end DEF_CHARACTERISTIC /begin REF_CHARACTERISTIC NMAXOG /end REF_CHARACTERISTIC
 /begin IN_MEASUREMENT B_abstgp B_acc B_br2k B_edsuu B_kow B_kuppl B_nmin B_sa B_stend B_zdcv nmot_w pirg_w rlshk tumg vfzg_w /end IN_MEASUREMENT
 /begin OUT_MEASUREMENT bfgrsbr bglbzausbits B_accab B_agrlrasp B_asc_reg B_dktb B_dlahieg B_dmmtev B_dmtltz B_dslsk B_dtmbh B_faats B_faskno B_fgrbr B_fhz B_gang0 B_kosrc B_lsvvsp B_nlbzakt B_nmaxext B_noacc_fr B_pdcvn B_pug B_pwofnwe B_ripuv B_savacc B_savmd B_sfsc B_sgs B_sh_act B_sh_mvw B_spldd B_svuerf B_vs devoff dmdmess dmrdagr_w dtmbhb imllaka_w mibgrbr_w mibgrtm_w migsl_w misgsl_w mkbgr_w mracc_w nmaxext_w nturbc_w pbrint_w psl rlshk_w swadp1AusBits talsuf tavhkm_w tkihkm_w toelk_w usvk usvk2 wnwem wnwi_w /end OUT_MEASUREMENT
 /begin LOC_MEASUREMENT daseBitW3 dpbkvppa_w facipkr_w tum_ein /end LOC_MEASUREMENT
 /begin SUB_FUNCTION /end SUB_FUNCTION
/end FUNCTION
/begin FUNCTION SYK051 "" /begin DEF_CHARACTERISTIC /end DEF_CHARACTERISTIC /begin REF_CHARACTERISTIC /end REF_CHARACTERISTIC /begin IN_MEASUREMENT /end IN_MEASUREMENT /begin OUT_MEASUREMENT /end OUT_MEASUREMENT /begin LOC_MEASUREMENT /end LOC_MEASUREMENT /begin SUB_FUNCTION /end SUB_FUNCTION /end FUNCTION
/begin FUNCTION SYNC71 "" /begin DEF_CHARACTERISTIC /end DEF_CHARACTERISTIC /begin REF_CHARACTERISTIC /end REF_CHARACTERISTIC /begin IN_MEASUREMENT B_nosynph /end IN_MEASUREMENT
 /begin OUT_MEASUREMENT B_bzsync B_firstSyn tr_zahn tr_zahn2 tr_zeit tr_zeit2 tr_zeit_msb zzylzue /end OUT_MEASUREMENT
 /begin LOC_MEASUREMENT /end LOC_MEASUREMENT
 /begin SUB_FUNCTION /end SUB_FUNCTION
/end FUNCTION
/begin FUNCTION SYSYNC "3.20      System-Synchronisation" /begin DEF_CHARACTERISTIC /end DEF_CHARACTERISTIC /begin REF_CHARACTERISTIC /end REF_CHARACTERISTIC /begin IN_MEASUREMENT /end IN_MEASUREMENT /begin OUT_MEASUREMENT synstate synstate_o /end OUT_MEASUREMENT /begin LOC_MEASUREMENT /end LOC_MEASUREMENT /begin SUB_FUNCTION /end SUB_FUNCTION /end FUNCTION
/begin FUNCTION SY_DFPM3 "" /begin DEF_CHARACTERISTIC /end DEF_CHARACTERISTIC /begin REF_CHARACTERISTIC /end REF_CHARACTERISTIC /begin IN_MEASUREMENT /end IN_MEASUREMENT /begin OUT_MEASUREMENT /end OUT_MEASUREMENT /begin LOC_MEASUREMENT /end LOC_MEASUREMENT /begin SUB_FUNCTION /end SUB_FUNCTION /end FUNCTION
/begin FUNCTION T71XXX_T "" /begin DEF_CHARACTERISTIC /end DEF_CHARACTERISTIC /begin REF_CHARACTERISTIC /end REF_CHARACTERISTIC /begin IN_MEASUREMENT B_nachl swOffDlBits /end IN_MEASUREMENT /begin OUT_MEASUREMENT dynPeriod /end OUT_MEASUREMENT /begin LOC_MEASUREMENT /end LOC_MEASUREMENT /begin SUB_FUNCTION /end SUB_FUNCTION /end FUNCTION
/begin FUNCTION TC1MOD "20.140    Testerkommunikation CARB; Mode 1" /begin DEF_CHARACTERISTIC /end DEF_CHARACTERISTIC /begin REF_CHARACTERISTIC CWOBD /end REF_CHARACTERISTIC
 /begin IN_MEASUREMENT B_cdkvs B_cdmd B_kmmilsct B_lsh B_milstat B_sls B_slsfz evsup1 flglrs fra_w fr_w iplsuvj_w kmstmil_w lalsuvj_w mshfm_w nmot_w ready rml tanslin tmotlin udkp1_w ushkj vfzg zwzyl1 /end IN_MEASUREMENT
 /begin OUT_MEASUREMENT /end OUT_MEASUREMENT
 /begin LOC_MEASUREMENT /end LOC_MEASUREMENT
 /begin SUB_FUNCTION /end SUB_FUNCTION
/end FUNCTION
/begin FUNCTION TC2MOD "20.70     Testerkommunikation CARB; Mode 2" /begin DEF_CHARACTERISTIC /end DEF_CHARACTERISTIC /begin REF_CHARACTERISTIC /end REF_CHARACTERISTIC /begin IN_MEASUREMENT ffzdfp /end IN_MEASUREMENT /begin OUT_MEASUREMENT /end OUT_MEASUREMENT /begin LOC_MEASUREMENT /end LOC_MEASUREMENT /begin SUB_FUNCTION /end SUB_FUNCTION /end FUNCTION
/begin FUNCTION TC5MOD "20.40     Testerkommunikation CARB; Mode 5, Ausgabe Sondenmeßwerte" /begin DEF_CHARACTERISTIC /end DEF_CHARACTERISTIC
 /begin REF_CHARACTERISTIC DLAHISATO DLAHISATU DYNLSUTO DYNLSUTU LAMSSAMN LAMSSAMX USMNSHMN USMNSHMX USMXSHMN USMXSHMX USRHKSHJ /end REF_CHARACTERISTIC
 /begin IN_MEASUREMENT B_lsh B_lsh2 dlahisa dynlsusa lamsisa lamsosa usmnshn usmxshn /end IN_MEASUREMENT
 /begin OUT_MEASUREMENT /end OUT_MEASUREMENT
 /begin LOC_MEASUREMENT /end LOC_MEASUREMENT
 /begin SUB_FUNCTION /end SUB_FUNCTION
/end FUNCTION
/begin FUNCTION TC6MOD "20.100    Testerkommunikation CARB/EOBD; Mode/Service 6, Ausgabe Prüfschwellen" /begin DEF_CHARACTERISTIC /end DEF_CHARACTERISTIC /begin REF_CHARACTERISTIC /end REF_CHARACTERISTIC
 /begin IN_MEASUREMENT B_cdkat B_cdldp B_cdsls B_cdtes B_cwdslt B_cwdthm m6cmsl m6cmslv m6cthm m6smslv_w m6smsl_w m6sthm_w m6wmslv_w m6wmsl_w m6wthm_w tc6katc tc6kats tc6katw tc6ldpc tc6ldps tc6ldpw tc6tesc tc6tess tc6tesw /end IN_MEASUREMENT
 /begin OUT_MEASUREMENT /end OUT_MEASUREMENT
 /begin LOC_MEASUREMENT /end LOC_MEASUREMENT
 /begin SUB_FUNCTION /end SUB_FUNCTION
/end FUNCTION
/begin FUNCTION TC8MOD "21.40     Testerkommunikation CARB; Mode 8, Funktionsaktivierungen" /begin DEF_CHARACTERISTIC TMOD8TE /end DEF_CHARACTERISTIC /begin REF_CHARACTERISTIC /end REF_CHARACTERISTIC /begin IN_MEASUREMENT B_ll B_m8te /end IN_MEASUREMENT /begin OUT_MEASUREMENT /end OUT_MEASUREMENT /begin LOC_MEASUREMENT /end LOC_MEASUREMENT /begin SUB_FUNCTION /end SUB_FUNCTION /end FUNCTION
/begin FUNCTION TC9MOD "8.20      Testerkommunikation CARB; Mode 9, Request Vehicle Information" /begin DEF_CHARACTERISTIC CWM9CVNSUP /end DEF_CHARACTERISTIC /begin REF_CHARACTERISTIC SGIDB1 SGIDB3 /end REF_CHARACTERISTIC /begin IN_MEASUREMENT B_cksbrdy cvnh_w cvnl_w nmot_w /end IN_MEASUREMENT /begin OUT_MEASUREMENT B_m9cvn B_m9cvnout /end OUT_MEASUREMENT /begin LOC_MEASUREMENT /end LOC_MEASUREMENT /begin SUB_FUNCTION /end SUB_FUNCTION /end FUNCTION
/begin FUNCTION TCKOMUE "2.10      Testerkommunikation CARB; Kommunikationsaufbau Übersicht" /begin DEF_CHARACTERISTIC CWNOSCAT /end DEF_CHARACTERISTIC /begin REF_CHARACTERISTIC /end REF_CHARACTERISTIC /begin IN_MEASUREMENT /end IN_MEASUREMENT /begin OUT_MEASUREMENT /end OUT_MEASUREMENT /begin LOC_MEASUREMENT /end LOC_MEASUREMENT /begin SUB_FUNCTION /end SUB_FUNCTION /end FUNCTION
/begin FUNCTION TCSORT "3.30      Testerkommunikation CARB; Sortierfunktion" /begin DEF_CHARACTERISTIC /end DEF_CHARACTERISTIC /begin REF_CHARACTERISTIC /end REF_CHARACTERISTIC /begin IN_MEASUREMENT cw_erfil fcmEnd FCMTab ffzdfp /end IN_MEASUREMENT /begin OUT_MEASUREMENT errorCntTcsort /end OUT_MEASUREMENT /begin LOC_MEASUREMENT /end LOC_MEASUREMENT /begin SUB_FUNCTION /end SUB_FUNCTION /end FUNCTION
/begin COMPU_METHOD bfgrsc_ub_q0p024_o3p984 "" RAT_FUNC "%6.3" "m/s^2" COEFFS 0 1 3.984 0 0 0.024 /end COMPU_METHOD
/begin COMPU_METHOD B_TRUE "boolsche Zustände, positive Logik" TAB_VERB "%6.3" "" COMPU_TAB_REF B_TRUE /end COMPU_METHOD
/begin COMPU_VTAB B_TRUE "boolsche Zustände, positive Logik" TAB_VERB 2 0 "----" 1 "TRUE" /end COMPU_VTAB
/begin COMPU_METHOD dez "1 : 1 Umrechnug (dez/hex)" RAT_FUNC "%6.2" "" COEFFS 0 1 0 0 0 1 /end COMPU_METHOD
/begin COMPU_METHOD fak_q0p0039 "" RAT_FUNC "%6.4" "-" COEFFS 0 256 0 0 0 1 /end COMPU_METHOD
/begin COMPU_METHOD fak_sb_b1 "" RAT_FUNC "%6.4" "-" COEFFS 0 256 0 0 0 2 /end COMPU_METHOD
/begin COMPU_METHOD fak_sw_b1 "" RAT_FUNC "%7.6" "-" COEFFS 0 65536 0 0 0 2 /end COMPU_METHOD
/begin COMPU_METHOD fak_ub_b1 "" RAT_FUNC "%6.4" "-" COEFFS 0 256 0 0 0 1 /end COMPU_METHOD
/begin COMPU_METHOD fak_ub_b16 "" RAT_FUNC "%6.4" "-" COEFFS 0 256 0 0 0 16 /end COMPU_METHOD
/begin COMPU_METHOD fak_ub_b2 "" RAT_FUNC "%6.4" "-" COEFFS 0 256 0 0 0 2 /end COMPU_METHOD
/begin COMPU_METHOD fak_ub_b4 "" RAT_FUNC "%6.4" "-" COEFFS 0 256 0 0 0 4 /end COMPU_METHOD
/begin COMPU_METHOD fak_ub_b8 "" RAT_FUNC "%6.4" "-" COEFFS 0 256 0 0 0 8 /end COMPU_METHOD
/begin COMPU_METHOD fak_uw_b1 "" RAT_FUNC "%7.6" "-" COEFFS 0 65536 0 0 0 1 /end COMPU_METHOD
/begin COMPU_METHOD fak_uw_b16 "" RAT_FUNC "%6.5" "-" COEFFS 0 65536 0 0 0 16 /end COMPU_METHOD
/begin COMPU_METHOD fak_uw_b2 "" RAT_FUNC "%7.6" "-" COEFFS 0 65536 0 0 0 2 /end COMPU_METHOD
/begin COMPU_METHOD fak_uw_b4 "" RAT_FUNC "%7.6" "-" COEFFS 0 65536 0 0 0 4 /end COMPU_METHOD
/begin COMPU_METHOD kw_q0p0019 "" RAT_FUNC "%6.4" "°KW" COEFFS 0 512 0 0 0 1 /end COMPU_METHOD
/begin COMPU_METHOD kw_q0p0039 "" RAT_FUNC "%6.4" "°KW" COEFFS 0 256 0 0 0 1 /end COMPU_METHOD
/begin COMPU_METHOD kw_q0p5 "" RAT_FUNC "%6.3" "°KW" COEFFS 0 2 0 0 0 1 /end COMPU_METHOD
/begin COMPU_METHOD kw_q2p8125 "" RAT_FUNC "%6.2" "°KW" COEFFS 0 1 0 0 0 2.8125 /end COMPU_METHOD
/begin COMPU_METHOD kw_q6 "" RAT_FUNC "%6.2" "°KW" COEFFS 0 1 0 0 0 6 /end COMPU_METHOD
/begin COMPU_METHOD kw_sw_b128 "" RAT_FUNC "%6.4" "°KW" COEFFS 0 65536 0 0 0 256 /end COMPU_METHOD
/begin COMPU_METHOD kw_sw_q0p0078 "" RAT_FUNC "%6.4" "°KW" COEFFS 0 128 0 0 0 1 /end COMPU_METHOD
/begin COMPU_METHOD kw_ub_q0p5 "" RAT_FUNC "%6.3" "°KW" COEFFS 0 256 0 0 0 128 /end COMPU_METHOD
/begin COMPU_METHOD kw_uw_q0p0078 "" RAT_FUNC "%6.4" "°KW" COEFFS 0 128 0 0 0 1 /end COMPU_METHOD
/begin COMPU_METHOD m_q0p1 "" RAT_FUNC "%6.3" "kg/h" COEFFS 0 10 0 0 0 1 /end COMPU_METHOD
/begin COMPU_METHOD m_ub_b1020 "" RAT_FUNC "%6.2" "kg/h" COEFFS 0 1 0 0 0 4 /end COMPU_METHOD
/begin COMPU_METHOD m_ub_q0p4 "" RAT_FUNC "%6.3" "kg" COEFFS 0 1 0 0 0 0.4 /end COMPU_METHOD
/begin COMPU_METHOD m_uw_b102p4 "" RAT_FUNC "%6.4" "kg/h" COEFFS 0 65536 0 0 0 102.4 /end COMPU_METHOD
/begin COMPU_METHOD m_uw_b4660 "" RAT_FUNC "%6.4" "g" COEFFS 0 3600 0 0 0 256 /end COMPU_METHOD
/begin COMPU_METHOD m_uw_b6553p5 "" RAT_FUNC "%6.3" "kg/h" COEFFS 0 1 0 0 0 0.1 /end COMPU_METHOD
/begin COMPU_METHOD nmotg_sb_q100 "" RAT_FUNC "%6.0" "U/min/s" COEFFS 0 1 0 0 0 100 /end COMPU_METHOD
/begin COMPU_METHOD nmot_sw_q0p25 "" RAT_FUNC "%6.3" "U/min" COEFFS 0 1 0 0 0 0.25 /end COMPU_METHOD
/begin COMPU_METHOD nmot_ub_q10 "" RAT_FUNC "%6.1" "U/min" COEFFS 0 1 0 0 0 10 /end COMPU_METHOD
/begin COMPU_METHOD nmot_ub_q40 "" RAT_FUNC "%6.1" "Upm" COEFFS 0 1 0 0 0 40 /end COMPU_METHOD
/begin COMPU_METHOD nmot_uw_q0p25 "" RAT_FUNC "%6.3" "U/min" COEFFS 0 1 0 0 0 0.25 /end COMPU_METHOD
/begin COMPU_METHOD p_sb_q10 "" RAT_FUNC "%6.1" "hPa" COEFFS 0 1 0 0 0 10 /end COMPU_METHOD
/begin COMPU_METHOD p_sw_q0p078 "" RAT_FUNC "%6.4" "hPa" COEFFS 0 65536 0 0 0 5120 /end COMPU_METHOD
/begin COMPU_METHOD p_ub_q5 "" RAT_FUNC "%6.2" "hPa" COEFFS 0 1 0 0 0 5 /end COMPU_METHOD
/begin COMPU_METHOD p_uw_q0p039 "" RAT_FUNC "%6.4" "hPa" COEFFS 0 256 0 0 0 10 /end COMPU_METHOD
/begin COMPU_METHOD relDK_ub_b100 "" RAT_FUNC "%6.3" "% DK" COEFFS 0 255 0 0 0 100 /end COMPU_METHOD
/begin COMPU_METHOD relnmot_q0p0039 "" RAT_FUNC "%6.4" "%/(U/min)" COEFFS 0 256 0 0 0 1 /end COMPU_METHOD
/begin COMPU_METHOD relnmot_q0p02 "" RAT_FUNC "%6.4" "%/(U/min)/s" COEFFS 0 1 0 0 0 0.02 /end COMPU_METHOD
/begin COMPU_METHOD relPED_ub_b100 "" RAT_FUNC "%6.3" "% PED" COEFFS 0 255 0 0 0 100 /end COMPU_METHOD
/begin COMPU_METHOD rel_q0p025 "" RAT_FUNC "%6.4" "%" COEFFS 0 1 0 0 0 0.025 /end COMPU_METHOD
/begin COMPU_METHOD rel_sb_q0p78 "" RAT_FUNC "%6.3" "%" COEFFS 0 1 0 0 0 0.78 /end COMPU_METHOD
/begin COMPU_METHOD rel_sw_b100 "" RAT_FUNC "%6.4" "%" COEFFS 0 32768 0 0 0 100 /end COMPU_METHOD
/begin COMPU_METHOD rel_ub_b127p5 "" RAT_FUNC "%6.3" "%" COEFFS 0 2 0 0 0 1 /end COMPU_METHOD
/begin COMPU_METHOD rel_ub_b99p6 "" RAT_FUNC "%6.3" "%" COEFFS 0 256 0 0 0 100 /end COMPU_METHOD
/begin COMPU_METHOD rel_ub_q0p75 "" RAT_FUNC "%6.3" "%" COEFFS 0 1 0 0 0 0.75 /end COMPU_METHOD
/begin COMPU_METHOD rel_uw_b100 "" RAT_FUNC "%6.4" "%" COEFFS 0 65536 0 0 0 100 /end COMPU_METHOD
/begin COMPU_METHOD rel_uw_b200 "" RAT_FUNC "%6.4" "%" COEFFS 0 65536 0 0 0 200 /end COMPU_METHOD
/begin COMPU_METHOD rel_uw_b3072 "" RAT_FUNC "%6.4" "%" COEFFS 0 65536 0 0 0 3072 /end COMPU_METHOD
/begin COMPU_METHOD rel_uw_q0p0234 "" RAT_FUNC "%6.4" "%" COEFFS 0 32 0 0 0 0.75 /end COMPU_METHOD
/begin COMPU_METHOD rkti11_sy "" RAT_FUNC "%6.5" "ms/%" COEFFS 0 9000 0 0 0 1 /end COMPU_METHOD
/begin COMPU_METHOD rkti_k_sy "" RAT_FUNC "%6.3" "%/(ms*s)" COEFFS 0 2.7962 0 0 0 1 /end COMPU_METHOD
/begin COMPU_METHOD rkti_p_sy "" RAT_FUNC "%6.4" "%/ms" COEFFS 0 27.962 0 0 0 1 /end COMPU_METHOD
/begin COMPU_METHOD runtime1_sy "" RAT_FUNC "%6.3" "us" COEFFS 0 1.5 0 0 0 1 /end COMPU_METHOD
/begin COMPU_METHOD runtime2_sy "" RAT_FUNC "%6.1" "us" COEFFS 0 0.09375 0 0 0 1 /end COMPU_METHOD
/begin COMPU_METHOD spg_q0p00039 "" RAT_FUNC "%6.5" "V" COEFFS 0 1 0 0 0 0.000390625 /end COMPU_METHOD
/begin COMPU_METHOD spg_ubatt "" RAT_FUNC "%6.4" "V" COEFFS 0 1 0 0 0 0.0704 /end COMPU_METHOD
/begin COMPU_METHOD spg_ub_q0p0052_o0p2 "" RAT_FUNC "%6.3" "V" COEFFS 0 255 51 0 0 1.33 /end COMPU_METHOD
/begin COMPU_METHOD t100msxs_ub_b255 "" RAT_FUNC "%6.2" "s" COEFFS 0 1 0 0 0 1 /end COMPU_METHOD
/begin COMPU_METHOD t100msxs_ub_b25p5 "" RAT_FUNC "%6.3" "s" COEFFS 0 1 0 0 0 0.1 /end COMPU_METHOD
/begin COMPU_METHOD t100msxs_uw_b6553p6 "" RAT_FUNC "%6.3" "s" COEFFS 0 10 0 0 0 1 /end COMPU_METHOD
/begin COMPU_METHOD t10msxs_uw_b655p35 "" RAT_FUNC "%6.4" "s" COEFFS 0 1 0 0 0 0.01 /end COMPU_METHOD
/begin COMPU_METHOD t1msxms_q1 "" RAT_FUNC "%6.2" "ms" COEFFS 0 1 0 0 0 1 /end COMPU_METHOD
/begin COMPU_METHOD t1sxs_ub_b255 "" RAT_FUNC "%6.2" "s" COEFFS 0 1 0 0 0 1 /end COMPU_METHOD
/begin COMPU_METHOD t1sxs_uw_q1 "" RAT_FUNC "%6.2" "s" COEFFS 0 1 0 0 0 1 /end COMPU_METHOD
/begin COMPU_METHOD t20usxus_q20 "" RAT_FUNC "%6.1" "us" COEFFS 0 1 0 0 0 20 /end COMPU_METHOD
/begin COMPU_METHOD t50msxs_q0p05 "" RAT_FUNC "%6.4" "s" COEFFS 0 1 0 0 0 0.05 /end COMPU_METHOD
/begin COMPU_METHOD t6minxmin_q6 "" RAT_FUNC "%6.2" "min" COEFFS 0 1 0 0 0 6 /end COMPU_METHOD
/begin COMPU_METHOD temp_q0p0234_o273 "" RAT_FUNC "%6.1" "Grad C" COEFFS 0 1 273.15 0 0 0.0234375 /end COMPU_METHOD
/begin COMPU_METHOD temp_sb_q0p75 "" RAT_FUNC "%6.3" "Grad C" COEFFS 0 1 0 0 0 0.75 /end COMPU_METHOD
/begin COMPU_METHOD temp_ub_q0p75_o48 "" RAT_FUNC "%6.2" "Grad C" COEFFS 0 1 48 0 0 0.75 /end COMPU_METHOD
/begin COMPU_METHOD temp_ub_q5_o50 "" RAT_FUNC "%6.2" "Grad C" COEFFS 0 1 50 0 0 5 /end COMPU_METHOD
/begin COMPU_METHOD tinjection5_sy "" RAT_FUNC "%6.4" "ms" COEFFS 0 75 0 0 0 1 /end COMPU_METHOD
/begin COMPU_METHOD tinjection_sy "" RAT_FUNC "%6.4" "ms" COEFFS 0 375 0 0 0 1 /end COMPU_METHOD
/begin COMPU_METHOD vfzg_ub_q1p25 "" RAT_FUNC "%6.2" "km/h" COEFFS 0 1 0 0 0 1.25 /end COMPU_METHOD
/begin COMPU_METHOD zk100msxs_ub_b25p5 "" RAT_FUNC "%6.3" "s" COEFFS 0 0 256 0 10 0 /end COMPU_METHOD
/begin COMPU_METHOD zk100msxs_uw_b6553 "" RAT_FUNC "%12.4" "s" COEFFS 0 0 65536 0 10 0 /end COMPU_METHOD
/begin COMPU_METHOD zk10msxs_ub_b2p55 "" RAT_FUNC "%6.4" "s" COEFFS 0 0 255 0 100 0 /end COMPU_METHOD
/begin COMPU_METHOD zk50msxs_uw_b3276p8 "" RAT_FUNC "%12.4" "s" COEFFS 0 0 65536 0 20 0 /end COMPU_METHOD
/begin COMPU_METHOD zw_ub_qn0p75 "" RAT_FUNC "%6.4" "grad KW" COEFFS 0 1 0 0 0 -0.75 /end COMPU_METHOD
/begin COMPU_METHOD defaultAscii "" RAT_FUNC "%6.2" "" COEFFS 0 1 0 0 0 1 /end COMPU_METHOD
/begin RECORD_LAYOUT GkfWSw FNC_VALUES 1 SWORD COLUMN_DIR DIRECT /end RECORD_LAYOUT
/begin RECORD_LAYOUT GkfWUb FNC_VALUES 1 UBYTE COLUMN_DIR DIRECT /end RECORD_LAYOUT
/begin RECORD_LAYOUT GklWUb FNC_VALUES 1 UBYTE COLUMN_DIR DIRECT /end RECORD_LAYOUT
/begin RECORD_LAYOUT GklWUw FNC_VALUES 1 UWORD COLUMN_DIR DIRECT /end RECORD_LAYOUT
/begin RECORD_LAYOUT KfAxUbAyUbSstxUbSstyUbWSb NO_AXIS_PTS_X 1 UBYTE NO_AXIS_PTS_Y 2 UBYTE AXIS_PTS_X 3 UBYTE INDEX_INCR DIRECT AXIS_PTS_Y 4 UBYTE INDEX_INCR DIRECT FNC_VALUES 5 SBYTE COLUMN_DIR DIRECT /end RECORD_LAYOUT
/begin RECORD_LAYOUT KfAxUbAyUbSstxUbSstyUbWUb NO_AXIS_PTS_X 1 UBYTE NO_AXIS_PTS_Y 2 UBYTE AXIS_PTS_X 3 UBYTE INDEX_INCR DIRECT AXIS_PTS_Y 4 UBYTE INDEX_INCR DIRECT FNC_VALUES 5 UBYTE COLUMN_DIR DIRECT /end RECORD_LAYOUT
/begin RECORD_LAYOUT KfAxUbAyUbSstxUbSstyUwWUw NO_AXIS_PTS_X 1 UBYTE NO_AXIS_PTS_Y 2 UBYTE AXIS_PTS_X 3 UBYTE INDEX_INCR DIRECT AXIS_PTS_Y 4 UWORD INDEX_INCR DIRECT FNC_VALUES 5 UWORD COLUMN_DIR DIRECT /end RECORD_LAYOUT
/begin RECORD_LAYOUT KfAxUwAyUwSstxUwSstyUwWSw NO_AXIS_PTS_X 1 UWORD NO_AXIS_PTS_Y 2 UWORD AXIS_PTS_X 3 UWORD INDEX_INCR DIRECT AXIS_PTS_Y 4 UWORD INDEX_INCR DIRECT FNC_VALUES 5 SWORD COLUMN_DIR DIRECT /end RECORD_LAYOUT
/begin RECORD_LAYOUT KlAUbSstSwWSw NO_AXIS_PTS_X 1 SWORD AXIS_PTS_X 2 SWORD INDEX_INCR DIRECT FNC_VALUES 3 SWORD COLUMN_DIR DIRECT /end RECORD_LAYOUT
/begin RECORD_LAYOUT KlAUbSstUbWSb NO_AXIS_PTS_X 1 UBYTE AXIS_PTS_X 2 UBYTE INDEX_INCR DIRECT FNC_VALUES 3 SBYTE COLUMN_DIR DIRECT /end RECORD_LAYOUT
/begin RECORD_LAYOUT KlAUbSstUbWUb NO_AXIS_PTS_X 1 UBYTE AXIS_PTS_X 2 UBYTE INDEX_INCR DIRECT FNC_VALUES 3 UBYTE COLUMN_DIR DIRECT /end RECORD_LAYOUT
/begin RECORD_LAYOUT KlAUbSstUbWUw NO_AXIS_PTS_X 1 UBYTE AXIS_PTS_X 2 UBYTE INDEX_INCR DIRECT FNC_VALUES 3 UWORD COLUMN_DIR DIRECT /end RECORD_LAYOUT
/begin RECORD_LAYOUT KlAUwSstSwWUw NO_AXIS_PTS_X 1 UWORD AXIS_PTS_X 2 SWORD INDEX_INCR DIRECT FNC_VALUES 3 UWORD COLUMN_DIR DIRECT /end RECORD_LAYOUT
/begin RECORD_LAYOUT KlAUwSstUwWSw NO_AXIS_PTS_X 1 UWORD AXIS_PTS_X 2 UWORD INDEX_INCR DIRECT FNC_VALUES 3 SWORD COLUMN_DIR DIRECT /end RECORD_LAYOUT
/begin RECORD_LAYOUT KlAUwSstUwWUw NO_AXIS_PTS_X 1 UWORD AXIS_PTS_X 2 UWORD INDEX_INCR DIRECT FNC_VALUES 3 UWORD COLUMN_DIR DIRECT /end RECORD_LAYOUT
/begin RECORD_LAYOUT KtxC FNC_VALUES 1 UBYTE COLUMN_DIR DIRECT /end RECORD_LAYOUT
/begin RECORD_LAYOUT KwSw FNC_VALUES 1 SWORD COLUMN_DIR DIRECT /end RECORD_LAYOUT
/begin RECORD_LAYOUT KwUb FNC_VALUES 1 UBYTE COLUMN_DIR DIRECT /end RECORD_LAYOUT
/begin RECORD_LAYOUT KwUw FNC_VALUES 1 UWORD COLUMN_DIR DIRECT /end RECORD_LAYOUT
/begin RECORD_LAYOUT SstASwSstSw NO_AXIS_PTS_X 1 SWORD AXIS_PTS_X 2 SWORD INDEX_INCR DIRECT /end RECORD_LAYOUT
/begin RECORD_LAYOUT SstAUbSstSb NO_AXIS_PTS_X 1 UBYTE AXIS_PTS_X 2 SBYTE INDEX_INCR DIRECT /end RECORD_LAYOUT
/begin RECORD_LAYOUT SstAUbSstUb NO_AXIS_PTS_X 1 UBYTE AXIS_PTS_X 2 UBYTE INDEX_INCR DIRECT /end RECORD_LAYOUT
/begin RECORD_LAYOUT SstAUwSstUw NO_AXIS_PTS_X 1 UWORD AXIS_PTS_X 2 UWORD INDEX_INCR DIRECT /end RECORD_LAYOUT
/end MODULE
/end PROJECT
