ASAP2_VERSION 1 3
/begin PROJECT S1103A_25G5_0 "S1103A"
/begin HEADER "" VERSION "S1103A_25G5_0" PROJECT_NO S1103A_25G5_0 /end HEADER
/begin MODULE DIM ""
/begin MOD_COMMON "" BYTE_ORDER MSB_LAST ALIGNMENT_BYTE 1 ALIGNMENT_WORD 2 ALIGNMENT_LONG 2 /end MOD_COMMON
/begin CHARACTERISTIC CDCCGE "" VAL_BLK 0x8E69D4 KwbUw 65535.00 dez 0.00 65535.00 FORMAT "%8.2" NUMBER 4 /end CHARACTERISTIC
/begin CHARACTERISTIC CDCDPL "" VAL_BLK 0x8E6A2C KwbUw 65535.00 dez 0.00 65535.00 FORMAT "%8.2" NUMBER 4 /end CHARACTERISTIC
/begin CHARACTERISTIC CDCDSBKV "" VAL_BLK 0x8E6A34 KwbUw 65535.00 dez 0.00 65535.00 FORMAT "%8.2" NUMBER 4 /end CHARACTERISTIC
/begin CHARACTERISTIC CDCFRAO "" VAL_BLK 0x8E6B1C KwbUw 65535.00 dez 0.00 65535.00 FORMAT "%8.2" NUMBER 4 /end CHARACTERISTIC
/begin CHARACTERISTIC CDCFRAO2 "" VAL_BLK 0x8E6B24 KwbUw 65535.00 dez 0.00 65535.00 FORMAT "%8.2" NUMBER 4 /end CHARACTERISTIC
/begin CHARACTERISTIC CDCFRAU "" VAL_BLK 0x8E6B2C KwbUw 65535.00 dez 0.00 65535.00 FORMAT "%8.2" NUMBER 4 /end CHARACTERISTIC
/begin CHARACTERISTIC CDCFRAU2 "" VAL_BLK 0x8E6B34 KwbUw 65535.00 dez 0.00 65535.00 FORMAT "%8.2" NUMBER 4 /end CHARACTERISTIC
/begin CHARACTERISTIC CDCFRST "" VAL_BLK 0x8E6B3C KwbUw 65535.00 dez 0.00 65535.00 FORMAT "%8.2" NUMBER 4 /end CHARACTERISTIC
/begin CHARACTERISTIC CDCFRST2 "" VAL_BLK 0x8E6B44 KwbUw 65535.00 dez 0.00 65535.00 FORMAT "%8.2" NUMBER 4 /end CHARACTERISTIC
/begin CHARACTERISTIC CDCGECOD "" VAL_BLK 0x8E6B4C KwbUw 65535.00 dez 0.00 65535.00 FORMAT "%8.2" NUMBER 4 /end CHARACTERISTIC
/begin CHARACTERISTIC CDCKAT "" VAL_BLK 0x8E6BC4 KwbUw 65535.00 dez 0.00 65535.00 FORMAT "%8.2" NUMBER 4 /end CHARACTERISTIC
/begin CHARACTERISTIC CDCKAT2 "" VAL_BLK 0x8E6BCC KwbUw 65535.00 dez 0.00 65535.00 FORMAT "%8.2" NUMBER 4 /end CHARACTERISTIC
/begin CHARACTERISTIC CDCKRA01 "" VAL_BLK 0x8E6BDC KwbUw 65535.00 dez 0.00 65535.00 FORMAT "%8.2" NUMBER 4 /end CHARACTERISTIC
/begin CHARACTERISTIC CDCKRA02 "" VAL_BLK 0x8E6BE4 KwbUw 65535.00 dez 0.00 65535.00 FORMAT "%8.2" NUMBER 4 /end CHARACTERISTIC
/begin CHARACTERISTIC CDCKRA03 "" VAL_BLK 0x8E6BEC KwbUw 65535.00 dez 0.00 65535.00 FORMAT "%8.2" NUMBER 4 /end CHARACTERISTIC
/begin CHARACTERISTIC CDCKRA04 "" VAL_BLK 0x8E6BF4 KwbUw 65535.00 dez 0.00 65535.00 FORMAT "%8.2" NUMBER 4 /end CHARACTERISTIC
/begin CHARACTERISTIC CDCKRA05 "" VAL_BLK 0x8E6BFC KwbUw 65535.00 dez 0.00 65535.00 FORMAT "%8.2" NUMBER 4 /end CHARACTERISTIC
/begin CHARACTERISTIC CDCKRA06 "" VAL_BLK 0x8E6C04 KwbUw 65535.00 dez 0.00 65535.00 FORMAT "%8.2" NUMBER 4 /end CHARACTERISTIC
/begin CHARACTERISTIC CDCKRNT "" VAL_BLK 0x8E6C0C KwbUw 65535.00 dez 0.00 65535.00 FORMAT "%8.2" NUMBER 4 /end CHARACTERISTIC
/begin CHARACTERISTIC CDCKROF "" VAL_BLK 0x8E6C14 KwbUw 65535.00 dez 0.00 65535.00 FORMAT "%8.2" NUMBER 4 /end CHARACTERISTIC
/begin CHARACTERISTIC CDCKRTP "" VAL_BLK 0x8E6C1C KwbUw 65535.00 dez 0.00 65535.00 FORMAT "%8.2" NUMBER 4 /end CHARACTERISTIC
/begin CHARACTERISTIC CDCKS1 "" VAL_BLK 0x8E6C24 KwbUw 65535.00 dez 0.00 65535.00 FORMAT "%8.2" NUMBER 4 /end CHARACTERISTIC
/begin CHARACTERISTIC CDCKS2 "" VAL_BLK 0x8E6C2C KwbUw 65535.00 dez 0.00 65535.00 FORMAT "%8.2" NUMBER 4 /end CHARACTERISTIC
/begin CHARACTERISTIC CDCKS3 "" VAL_BLK 0x8E6C34 KwbUw 65535.00 dez 0.00 65535.00 FORMAT "%8.2" NUMBER 4 /end CHARACTERISTIC
/begin CHARACTERISTIC CDCKS4 "" VAL_BLK 0x8E6C3C KwbUw 65535.00 dez 0.00 65535.00 FORMAT "%8.2" NUMBER 4 /end CHARACTERISTIC
/begin CHARACTERISTIC CDCKUPPL "" VAL_BLK 0x8E6C44 KwbUw 65535.00 dez 0.00 65535.00 FORMAT "%8.2" NUMBER 4 /end CHARACTERISTIC
/begin CHARACTERISTIC CDCLASH "" VAL_BLK 0x8E6C4C KwbUw 65535.00 dez 0.00 65535.00 FORMAT "%8.2" NUMBER 4 /end CHARACTERISTIC
/begin CHARACTERISTIC CDCLASH2 "" VAL_BLK 0x8E6C54 KwbUw 65535.00 dez 0.00 65535.00 FORMAT "%8.2" NUMBER 4 /end CHARACTERISTIC
/begin CHARACTERISTIC CDCLAVH "" VAL_BLK 0x8E6C5C KwbUw 65535.00 dez 0.00 65535.00 FORMAT "%8.2" NUMBER 4 /end CHARACTERISTIC
/begin CHARACTERISTIC CDCLAVH2 "" VAL_BLK 0x8E6C64 KwbUw 65535.00 dez 0.00 65535.00 FORMAT "%8.2" NUMBER 4 /end CHARACTERISTIC
/begin CHARACTERISTIC CDCLLR "" VAL_BLK 0x8E6C74 KwbUw 65535.00 dez 0.00 65535.00 FORMAT "%8.2" NUMBER 4 /end CHARACTERISTIC
/begin CHARACTERISTIC CDCLM "" VAL_BLK 0x8E6C7C KwbUw 65535.00 dez 0.00 65535.00 FORMAT "%8.2" NUMBER 4 /end CHARACTERISTIC
/begin CHARACTERISTIC CDCLSH "" VAL_BLK 0x8E6C84 KwbUw 65535.00 dez 0.00 65535.00 FORMAT "%8.2" NUMBER 4 /end CHARACTERISTIC
/begin CHARACTERISTIC CDCLSH2 "" VAL_BLK 0x8E6C8C KwbUw 65535.00 dez 0.00 65535.00 FORMAT "%8.2" NUMBER 4 /end CHARACTERISTIC
/begin CHARACTERISTIC CDCLSVV "" VAL_BLK 0x8E6CFC KwbUw 65535.00 dez 0.00 65535.00 FORMAT "%8.2" NUMBER 4 /end CHARACTERISTIC
/begin CHARACTERISTIC CDCLUE1 "" VAL_BLK 0x8E6D04 KwbUw 65535.00 DEZ 0.00 65535.00 FORMAT "%8.2" NUMBER 4 /end CHARACTERISTIC
/begin CHARACTERISTIC CDCMD "" VAL_BLK 0x8E6D1C KwbUw 65535.00 dez 0.00 65535.00 FORMAT "%8.2" NUMBER 4 /end CHARACTERISTIC
/begin CHARACTERISTIC CDCMD00 "" VAL_BLK 0x8E6D24 KwbUw 65535.00 dez 0.00 65535.00 FORMAT "%8.2" NUMBER 4 /end CHARACTERISTIC
/begin CHARACTERISTIC CDCMD01 "" VAL_BLK 0x8E6D2C KwbUw 65535.00 dez 0.00 65535.00 FORMAT "%8.2" NUMBER 4 /end CHARACTERISTIC
/begin CHARACTERISTIC CDCMD02 "" VAL_BLK 0x8E6D34 KwbUw 65535.00 dez 0.00 65535.00 FORMAT "%8.2" NUMBER 4 /end CHARACTERISTIC
/begin CHARACTERISTIC CDCMD03 "" VAL_BLK 0x8E6D3C KwbUw 65535.00 dez 0.00 65535.00 FORMAT "%8.2" NUMBER 4 /end CHARACTERISTIC
/begin CHARACTERISTIC CDCMD04 "" VAL_BLK 0x8E6D44 KwbUw 65535.00 dez 0.00 65535.00 FORMAT "%8.2" NUMBER 4 /end CHARACTERISTIC
/begin CHARACTERISTIC CDCMD05 "" VAL_BLK 0x8E6D4C KwbUw 65535.00 dez 0.00 65535.00 FORMAT "%8.2" NUMBER 4 /end CHARACTERISTIC
/begin CHARACTERISTIC CDCMFA "" VAL_BLK 0x8E6D5C KwbUw 65535.00 dez 0.00 65535.00 FORMAT "%8.2" NUMBER 4 /end CHARACTERISTIC
/begin CHARACTERISTIC CDCNWKW "" VAL_BLK 0x8E6D6C KwbUw 65535.00 dez 0.00 65535.00 FORMAT "%8.2" NUMBER 4 /end CHARACTERISTIC
/begin CHARACTERISTIC CDCNWKW2 "" VAL_BLK 0x8E6D74 KwbUw 65535.00 dez 0.00 65535.00 FORMAT "%8.2" NUMBER 4 /end CHARACTERISTIC
/begin CHARACTERISTIC CDCNX "" VAL_BLK 0x8E6D7C KwbUw 65535.00 dez 0.00 65535.00 FORMAT "%8.2" NUMBER 4 /end CHARACTERISTIC
/begin CHARACTERISTIC CDCPH "" VAL_BLK 0x8E6D84 KwbUw 65535.00 dez 0.00 65535.00 FORMAT "%8.2" NUMBER 4 /end CHARACTERISTIC
/begin CHARACTERISTIC CDCPH2 "" VAL_BLK 0x8E6D8C KwbUw 65535.00 dez 0.00 65535.00 FORMAT "%8.2" NUMBER 4 /end CHARACTERISTIC
/begin CHARACTERISTIC CDCPLLSU "" VAL_BLK 0x8E6D94 KwbUw 65535.00 dez 0.00 65535.00 FORMAT "%8.2" NUMBER 4 /end CHARACTERISTIC
/begin CHARACTERISTIC CDCPLLSU2 "" VAL_BLK 0x8E6D9C KwbUw 65535.00 dez 0.00 65535.00 FORMAT "%8.2" NUMBER 4 /end CHARACTERISTIC
/begin CHARACTERISTIC CDCRKAT "" VAL_BLK 0x8E6DAC KwbUw 65535.00 dez 0.00 65535.00 FORMAT "%8.2" NUMBER 4 /end CHARACTERISTIC
/begin CHARACTERISTIC CDCRKAT2 "" VAL_BLK 0x8E6DB4 KwbUw 65535.00 dez 0.00 65535.00 FORMAT "%8.2" NUMBER 4 /end CHARACTERISTIC
/begin CHARACTERISTIC CDCRKAZ "" VAL_BLK 0x8E6DBC KwbUw 65535.00 dez 0.00 65535.00 FORMAT "%8.2" NUMBER 4 /end CHARACTERISTIC
/begin CHARACTERISTIC CDCRKAZ2 "" VAL_BLK 0x8E6DC4 KwbUw 65535.00 dez 0.00 65535.00 FORMAT "%8.2" NUMBER 4 /end CHARACTERISTIC
/begin CHARACTERISTIC CDCSGEEP "" VAL_BLK 0x8E6DD4 KwbUw 65535.00 dez 0.00 65535.00 FORMAT "%8.2" NUMBER 4 /end CHARACTERISTIC
/begin CHARACTERISTIC CDCSLS "" VAL_BLK 0x8E6DEC KwbUw 65535.00 dez 0.00 65535.00 FORMAT "%8.2" NUMBER 4 /end CHARACTERISTIC
/begin CHARACTERISTIC CDCSLS2 "" VAL_BLK 0x8E6DF4 KwbUw 65535.00 dez 0.00 65535.00 FORMAT "%8.2" NUMBER 4 /end CHARACTERISTIC
/begin CHARACTERISTIC CDCSLV "" VAL_BLK 0x8E6DFC KwbUw 65535.00 dez 0.00 65535.00 FORMAT "%8.2" NUMBER 4 /end CHARACTERISTIC
/begin CHARACTERISTIC CDCSLV2 "" VAL_BLK 0x8E6E04 KwbUw 65535.00 dez 0.00 65535.00 FORMAT "%8.2" NUMBER 4 /end CHARACTERISTIC
/begin CHARACTERISTIC CDCTANKL "" VAL_BLK 0x8E6E2C KwbUw 65535.00 dez 0.00 65535.00 FORMAT "%8.2" NUMBER 4 /end CHARACTERISTIC
/begin CHARACTERISTIC CDCTES "" VAL_BLK 0x8E6E34 KwbUw 65535.00 dez 0.00 65535.00 FORMAT "%8.2" NUMBER 4 /end CHARACTERISTIC
/begin CHARACTERISTIC CDCTESF "" VAL_BLK 0x8E6E3C KwbUw 65535.00 dez 0.00 65535.00 FORMAT "%8.2" NUMBER 4 /end CHARACTERISTIC
/begin CHARACTERISTIC CDCTESG "" VAL_BLK 0x8E6E44 KwbUw 65535.00 dez 0.00 65535.00 FORMAT "%8.2" NUMBER 4 /end CHARACTERISTIC
/begin CHARACTERISTIC CDCTEVE2 "" VAL_BLK 0x8E6E54 KwbUw 65535.00 dez 0.00 65535.00 FORMAT "%8.2" NUMBER 4 /end CHARACTERISTIC
/begin CHARACTERISTIC CDCUFMV "" VAL_BLK 0x8E6E94 KwbUw 65535.00 dez 0.00 65535.00 FORMAT "%8.2" NUMBER 4 /end CHARACTERISTIC
/begin CHARACTERISTIC CDCUFNC "" VAL_BLK 0x8E6E9C KwbUw 65535.00 dez 0.00 65535.00 FORMAT "%8.2" NUMBER 4 /end CHARACTERISTIC
/begin CHARACTERISTIC CDCUFRLIP "" VAL_BLK 0x8E6EA4 KwbUw 65535.00 dez 0.00 65535.00 FORMAT "%8.2" NUMBER 4 /end CHARACTERISTIC
/begin CHARACTERISTIC CDCUFSGA "" VAL_BLK 0x8E6EAC KwbUw 65535.00 dez 0.00 65535.00 FORMAT "%8.2" NUMBER 4 /end CHARACTERISTIC
/begin CHARACTERISTIC CDCUFSGB "" VAL_BLK 0x8E6EB4 KwbUw 65535.00 dez 0.00 65535.00 FORMAT "%8.2" NUMBER 4 /end CHARACTERISTIC
/begin CHARACTERISTIC CDCUFSKA "" VAL_BLK 0x8E6EBC KwbUw 65535.00 dez 0.00 65535.00 FORMAT "%8.2" NUMBER 4 /end CHARACTERISTIC
/begin CHARACTERISTIC CDCUFSPSC "" VAL_BLK 0x8E6EC4 KwbUw 65535.00 dez 0.00 65535.00 FORMAT "%8.2" NUMBER 4 /end CHARACTERISTIC
/begin CHARACTERISTIC CDCULSU "" VAL_BLK 0x8E6ECC KwbUw 65535.00 dez 0.00 65535.00 FORMAT "%8.2" NUMBER 4 /end CHARACTERISTIC
/begin CHARACTERISTIC CDCULSU2 "" VAL_BLK 0x8E6ED4 KwbUw 65535.00 dez 0.00 65535.00 FORMAT "%8.2" NUMBER 4 /end CHARACTERISTIC
/begin CHARACTERISTIC CDCURRAM "" VAL_BLK 0x8E6EDC KwbUw 65535.00 dez 0.00 65535.00 FORMAT "%8.2" NUMBER 4 /end CHARACTERISTIC
/begin CHARACTERISTIC CDCURROM "" VAL_BLK 0x8E6EE4 KwbUw 65535.00 dez 0.00 65535.00 FORMAT "%8.2" NUMBER 4 /end CHARACTERISTIC
/begin CHARACTERISTIC CDCURRST "" VAL_BLK 0x8E6EEC KwbUw 65535.00 dez 0.00 65535.00 FORMAT "%8.2" NUMBER 4 /end CHARACTERISTIC
/begin CHARACTERISTIC CDCVFZ "" VAL_BLK 0x8E6EF4 KwbUw 65535.00 dez 0.00 65535.00 FORMAT "%8.2" NUMBER 4 /end CHARACTERISTIC
/begin CHARACTERISTIC CDKCGE "" VAL_BLK 0x8E6FDC KwbUw 65535.00 dez 0.00 65535.00 FORMAT "%8.2" NUMBER 4 /end CHARACTERISTIC
/begin CHARACTERISTIC CDKDPL "" VAL_BLK 0x8E7034 KwbUw 65535.00 dez 0.00 65535.00 FORMAT "%8.2" NUMBER 4 /end CHARACTERISTIC
/begin CHARACTERISTIC CDKDSBKV "" VAL_BLK 0x8E703C KwbUw 65535.00 dez 0.00 65535.00 FORMAT "%8.2" NUMBER 4 /end CHARACTERISTIC
/begin CHARACTERISTIC CDKFRAO "" VAL_BLK 0x8E7124 KwbUw 65535.00 dez 0.00 65535.00 FORMAT "%8.2" NUMBER 4 /end CHARACTERISTIC
/begin CHARACTERISTIC CDKFRAO2 "" VAL_BLK 0x8E712C KwbUw 65535.00 dez 0.00 65535.00 FORMAT "%8.2" NUMBER 4 /end CHARACTERISTIC
/begin CHARACTERISTIC CDKFRAU "" VAL_BLK 0x8E7134 KwbUw 65535.00 dez 0.00 65535.00 FORMAT "%8.2" NUMBER 4 /end CHARACTERISTIC
/begin CHARACTERISTIC CDKFRAU2 "" VAL_BLK 0x8E713C KwbUw 65535.00 dez 0.00 65535.00 FORMAT "%8.2" NUMBER 4 /end CHARACTERISTIC
/begin CHARACTERISTIC CDKFRST "" VAL_BLK 0x8E7144 KwbUw 65535.00 dez 0.00 65535.00 FORMAT "%8.2" NUMBER 4 /end CHARACTERISTIC
/begin CHARACTERISTIC CDKFRST2 "" VAL_BLK 0x8E714C KwbUw 65535.00 dez 0.00 65535.00 FORMAT "%8.2" NUMBER 4 /end CHARACTERISTIC
/begin CHARACTERISTIC CDKGECOD "" VAL_BLK 0x8E7154 KwbUw 65535.00 dez 0.00 65535.00 FORMAT "%8.2" NUMBER 4 /end CHARACTERISTIC
/begin CHARACTERISTIC CDKKAT "" VAL_BLK 0x8E71CC KwbUw 65535.00 dez 0.00 65535.00 FORMAT "%8.2" NUMBER 4 /end CHARACTERISTIC
/begin CHARACTERISTIC CDKKAT2 "" VAL_BLK 0x8E71D4 KwbUw 65535.00 dez 0.00 65535.00 FORMAT "%8.2" NUMBER 4 /end CHARACTERISTIC
/begin CHARACTERISTIC CDKKRA01 "" VAL_BLK 0x8E71E4 KwbUw 65535.00 dez 0.00 65535.00 FORMAT "%8.2" NUMBER 4 /end CHARACTERISTIC
/begin CHARACTERISTIC CDKKRA02 "" VAL_BLK 0x8E71EC KwbUw 65535.00 dez 0.00 65535.00 FORMAT "%8.2" NUMBER 4 /end CHARACTERISTIC
/begin CHARACTERISTIC CDKKRA03 "" VAL_BLK 0x8E71F4 KwbUw 65535.00 dez 0.00 65535.00 FORMAT "%8.2" NUMBER 4 /end CHARACTERISTIC
/begin CHARACTERISTIC CDKKRA04 "" VAL_BLK 0x8E71FC KwbUw 65535.00 dez 0.00 65535.00 FORMAT "%8.2" NUMBER 4 /end CHARACTERISTIC
/begin CHARACTERISTIC CDKKRA05 "" VAL_BLK 0x8E7204 KwbUw 65535.00 dez 0.00 65535.00 FORMAT "%8.2" NUMBER 4 /end CHARACTERISTIC
/begin CHARACTERISTIC CDKKRA06 "" VAL_BLK 0x8E720C KwbUw 65535.00 dez 0.00 65535.00 FORMAT "%8.2" NUMBER 4 /end CHARACTERISTIC
/begin CHARACTERISTIC CDKKRNT "" VAL_BLK 0x8E7214 KwbUw 65535.00 dez 0.00 65535.00 FORMAT "%8.2" NUMBER 4 /end CHARACTERISTIC
/begin CHARACTERISTIC CDKKROF "" VAL_BLK 0x8E721C KwbUw 65535.00 dez 0.00 65535.00 FORMAT "%8.2" NUMBER 4 /end CHARACTERISTIC
/begin CHARACTERISTIC CDKKRTP "" VAL_BLK 0x8E7224 KwbUw 65535.00 dez 0.00 65535.00 FORMAT "%8.2" NUMBER 4 /end CHARACTERISTIC
/begin CHARACTERISTIC CDKKS1 "" VAL_BLK 0x8E722C KwbUw 65535.00 dez 0.00 65535.00 FORMAT "%8.2" NUMBER 4 /end CHARACTERISTIC
/begin CHARACTERISTIC CDKKS2 "" VAL_BLK 0x8E7234 KwbUw 65535.00 dez 0.00 65535.00 FORMAT "%8.2" NUMBER 4 /end CHARACTERISTIC
/begin CHARACTERISTIC CDKKS3 "" VAL_BLK 0x8E723C KwbUw 65535.00 dez 0.00 65535.00 FORMAT "%8.2" NUMBER 4 /end CHARACTERISTIC
/begin CHARACTERISTIC CDKKS4 "" VAL_BLK 0x8E7244 KwbUw 65535.00 dez 0.00 65535.00 FORMAT "%8.2" NUMBER 4 /end CHARACTERISTIC
/begin CHARACTERISTIC CDKKUPPL "" VAL_BLK 0x8E724C KwbUw 65535.00 dez 0.00 65535.00 FORMAT "%8.2" NUMBER 4 /end CHARACTERISTIC
/begin CHARACTERISTIC CDKLASH "" VAL_BLK 0x8E7254 KwbUw 65535.00 dez 0.00 65535.00 FORMAT "%8.2" NUMBER 4 /end CHARACTERISTIC
/begin CHARACTERISTIC CDKLASH2 "" VAL_BLK 0x8E725C KwbUw 65535.00 dez 0.00 65535.00 FORMAT "%8.2" NUMBER 4 /end CHARACTERISTIC
/begin CHARACTERISTIC CDKLAVH "" VAL_BLK 0x8E7264 KwbUw 65535.00 dez 0.00 65535.00 FORMAT "%8.2" NUMBER 4 /end CHARACTERISTIC
/begin CHARACTERISTIC CDKLAVH2 "" VAL_BLK 0x8E726C KwbUw 65535.00 dez 0.00 65535.00 FORMAT "%8.2" NUMBER 4 /end CHARACTERISTIC
/begin CHARACTERISTIC CDKLLR "" VAL_BLK 0x8E727C KwbUw 65535.00 dez 0.00 65535.00 FORMAT "%8.2" NUMBER 4 /end CHARACTERISTIC
/begin CHARACTERISTIC CDKLM "" VAL_BLK 0x8E7284 KwbUw 65535.00 dez 0.00 65535.00 FORMAT "%8.2" NUMBER 4 /end CHARACTERISTIC
/begin CHARACTERISTIC CDKLSH "" VAL_BLK 0x8E728C KwbUw 65535.00 dez 0.00 65535.00 FORMAT "%8.2" NUMBER 4 /end CHARACTERISTIC
/begin CHARACTERISTIC CDKLSH2 "" VAL_BLK 0x8E7294 KwbUw 65535.00 dez 0.00 65535.00 FORMAT "%8.2" NUMBER 4 /end CHARACTERISTIC
/begin CHARACTERISTIC CDKLSVV "" VAL_BLK 0x8E7304 KwbUw 65535.00 dez 0.00 65535.00 FORMAT "%8.2" NUMBER 4 /end CHARACTERISTIC
/begin CHARACTERISTIC CDKLUE1 "" VAL_BLK 0x8E730C KwbUw 65535.00 DEZ 0.00 65535.00 FORMAT "%8.2" NUMBER 4 /end CHARACTERISTIC
/begin CHARACTERISTIC CDKMD "" VAL_BLK 0x8E7324 KwbUw 65535.00 dez 0.00 65535.00 FORMAT "%8.2" NUMBER 4 /end CHARACTERISTIC
/begin CHARACTERISTIC CDKMD00 "" VAL_BLK 0x8E732C KwbUw 65535.00 dez 0.00 65535.00 FORMAT "%8.2" NUMBER 4 /end CHARACTERISTIC
/begin CHARACTERISTIC CDKMD01 "" VAL_BLK 0x8E7334 KwbUw 65535.00 dez 0.00 65535.00 FORMAT "%8.2" NUMBER 4 /end CHARACTERISTIC
/begin CHARACTERISTIC CDKMD02 "" VAL_BLK 0x8E733C KwbUw 65535.00 dez 0.00 65535.00 FORMAT "%8.2" NUMBER 4 /end CHARACTERISTIC
/begin CHARACTERISTIC CDKMD03 "" VAL_BLK 0x8E7344 KwbUw 65535.00 dez 0.00 65535.00 FORMAT "%8.2" NUMBER 4 /end CHARACTERISTIC
/begin CHARACTERISTIC CDKMD04 "" VAL_BLK 0x8E734C KwbUw 65535.00 dez 0.00 65535.00 FORMAT "%8.2" NUMBER 4 /end CHARACTERISTIC
/begin CHARACTERISTIC CDKMD05 "" VAL_BLK 0x8E7354 KwbUw 65535.00 dez 0.00 65535.00 FORMAT "%8.2" NUMBER 4 /end CHARACTERISTIC
/begin CHARACTERISTIC CDKMFA "" VAL_BLK 0x8E7364 KwbUw 65535.00 dez 0.00 65535.00 FORMAT "%8.2" NUMBER 4 /end CHARACTERISTIC
/begin CHARACTERISTIC CDKNWKW "" VAL_BLK 0x8E7374 KwbUw 65535.00 dez 0.00 65535.00 FORMAT "%8.2" NUMBER 4 /end CHARACTERISTIC
/begin CHARACTERISTIC CDKNWKW2 "" VAL_BLK 0x8E737C KwbUw 65535.00 dez 0.00 65535.00 FORMAT "%8.2" NUMBER 4 /end CHARACTERISTIC
/begin CHARACTERISTIC CDKNX "" VAL_BLK 0x8E7384 KwbUw 65535.00 dez 0.00 65535.00 FORMAT "%8.2" NUMBER 4 /end CHARACTERISTIC
/begin CHARACTERISTIC CDKPH "" VAL_BLK 0x8E738C KwbUw 65535.00 dez 0.00 65535.00 FORMAT "%8.2" NUMBER 4 /end CHARACTERISTIC
/begin CHARACTERISTIC CDKPH2 "" VAL_BLK 0x8E7394 KwbUw 65535.00 dez 0.00 65535.00 FORMAT "%8.2" NUMBER 4 /end CHARACTERISTIC
/begin CHARACTERISTIC CDKPLLSU "" VAL_BLK 0x8E739C KwbUw 65535.00 dez 0.00 65535.00 FORMAT "%8.2" NUMBER 4 /end CHARACTERISTIC
/begin CHARACTERISTIC CDKPLLSU2 "" VAL_BLK 0x8E73A4 KwbUw 65535.00 dez 0.00 65535.00 FORMAT "%8.2" NUMBER 4 /end CHARACTERISTIC
/begin CHARACTERISTIC CDKRKAT "" VAL_BLK 0x8E73B4 KwbUw 65535.00 dez 0.00 65535.00 FORMAT "%8.2" NUMBER 4 /end CHARACTERISTIC
/begin CHARACTERISTIC CDKRKAT2 "" VAL_BLK 0x8E73BC KwbUw 65535.00 dez 0.00 65535.00 FORMAT "%8.2" NUMBER 4 /end CHARACTERISTIC
/begin CHARACTERISTIC CDKRKAZ "" VAL_BLK 0x8E73C4 KwbUw 65535.00 dez 0.00 65535.00 FORMAT "%8.2" NUMBER 4 /end CHARACTERISTIC
/begin CHARACTERISTIC CDKRKAZ2 "" VAL_BLK 0x8E73CC KwbUw 65535.00 dez 0.00 65535.00 FORMAT "%8.2" NUMBER 4 /end CHARACTERISTIC
/begin CHARACTERISTIC CDKSGEEP "" VAL_BLK 0x8E73DC KwbUw 65535.00 dez 0.00 65535.00 FORMAT "%8.2" NUMBER 4 /end CHARACTERISTIC
/begin CHARACTERISTIC CDKSLS "" VAL_BLK 0x8E73F4 KwbUw 65535.00 dez 0.00 65535.00 FORMAT "%8.2" NUMBER 4 /end CHARACTERISTIC
/begin CHARACTERISTIC CDKSLS2 "" VAL_BLK 0x8E73FC KwbUw 65535.00 dez 0.00 65535.00 FORMAT "%8.2" NUMBER 4 /end CHARACTERISTIC
/begin CHARACTERISTIC CDKSLV "" VAL_BLK 0x8E7404 KwbUw 65535.00 dez 0.00 65535.00 FORMAT "%8.2" NUMBER 4 /end CHARACTERISTIC
/begin CHARACTERISTIC CDKSLV2 "" VAL_BLK 0x8E740C KwbUw 65535.00 dez 0.00 65535.00 FORMAT "%8.2" NUMBER 4 /end CHARACTERISTIC
/begin CHARACTERISTIC CDKTANKL "" VAL_BLK 0x8E7434 KwbUw 65535.00 dez 0.00 65535.00 FORMAT "%8.2" NUMBER 4 /end CHARACTERISTIC
/begin CHARACTERISTIC CDKTES "" VAL_BLK 0x8E743C KwbUw 65535.00 dez 0.00 65535.00 FORMAT "%8.2" NUMBER 4 /end CHARACTERISTIC
/begin CHARACTERISTIC CDKTESF "" VAL_BLK 0x8E7444 KwbUw 65535.00 dez 0.00 65535.00 FORMAT "%8.2" NUMBER 4 /end CHARACTERISTIC
/begin CHARACTERISTIC CDKTESG "" VAL_BLK 0x8E744C KwbUw 65535.00 dez 0.00 65535.00 FORMAT "%8.2" NUMBER 4 /end CHARACTERISTIC
/begin CHARACTERISTIC CDKTEVE2 "" VAL_BLK 0x8E745C KwbUw 65535.00 dez 0.00 65535.00 FORMAT "%8.2" NUMBER 4 /end CHARACTERISTIC
/begin CHARACTERISTIC CDKUFMV "" VAL_BLK 0x8E749C KwbUw 65535.00 dez 0.00 65535.00 FORMAT "%8.2" NUMBER 4 /end CHARACTERISTIC
/begin CHARACTERISTIC CDKUFNC "" VAL_BLK 0x8E74A4 KwbUw 65535.00 dez 0.00 65535.00 FORMAT "%8.2" NUMBER 4 /end CHARACTERISTIC
/begin CHARACTERISTIC CDKUFRLIP "" VAL_BLK 0x8E74AC KwbUw 65535.00 dez 0.00 65535.00 FORMAT "%8.2" NUMBER 4 /end CHARACTERISTIC
/begin CHARACTERISTIC CDKUFSGA "" VAL_BLK 0x8E74B4 KwbUw 65535.00 dez 0.00 65535.00 FORMAT "%8.2" NUMBER 4 /end CHARACTERISTIC
/begin CHARACTERISTIC CDKUFSGB "" VAL_BLK 0x8E74BC KwbUw 65535.00 dez 0.00 65535.00 FORMAT "%8.2" NUMBER 4 /end CHARACTERISTIC
/begin CHARACTERISTIC CDKUFSKA "" VAL_BLK 0x8E74C4 KwbUw 65535.00 dez 0.00 65535.00 FORMAT "%8.2" NUMBER 4 /end CHARACTERISTIC
/begin CHARACTERISTIC CDKUFSPSC "" VAL_BLK 0x8E74CC KwbUw 65535.00 dez 0.00 65535.00 FORMAT "%8.2" NUMBER 4 /end CHARACTERISTIC
/begin CHARACTERISTIC CDKULSU "" VAL_BLK 0x8E74D4 KwbUw 65535.00 dez 0.00 65535.00 FORMAT "%8.2" NUMBER 4 /end CHARACTERISTIC
/begin CHARACTERISTIC CDKULSU2 "" VAL_BLK 0x8E74DC KwbUw 65535.00 dez 0.00 65535.00 FORMAT "%8.2" NUMBER 4 /end CHARACTERISTIC
/begin CHARACTERISTIC CDKURRAM "" VAL_BLK 0x8E74E4 KwbUw 65535.00 dez 0.00 65535.00 FORMAT "%8.2" NUMBER 4 /end CHARACTERISTIC
/begin CHARACTERISTIC CDKURROM "" VAL_BLK 0x8E74EC KwbUw 65535.00 dez 0.00 65535.00 FORMAT "%8.2" NUMBER 4 /end CHARACTERISTIC
/begin CHARACTERISTIC CDKURRST "" VAL_BLK 0x8E74F4 KwbUw 65535.00 dez 0.00 65535.00 FORMAT "%8.2" NUMBER 4 /end CHARACTERISTIC
/begin CHARACTERISTIC CDKVFZ "" VAL_BLK 0x8E74FC KwbUw 65535.00 dez 0.00 65535.00 FORMAT "%8.2" NUMBER 4 /end CHARACTERISTIC
/begin CHARACTERISTIC CDTCGE "" VALUE 0x8E7578 KwUw 65535.00 dez 0.00 65535.00 FORMAT "%8.2" /end CHARACTERISTIC
/begin CHARACTERISTIC CDTDPL "" VALUE 0x8E758E KwUw 65535.00 dez 0.00 65535.00 FORMAT "%8.2" /end CHARACTERISTIC
/begin CHARACTERISTIC CDTDSBKV "" VALUE 0x8E7590 KwUw 65535.00 dez 0.00 65535.00 FORMAT "%8.2" /end CHARACTERISTIC
/begin CHARACTERISTIC CDTFRAO "" VALUE 0x8E75CA KwUw 65535.00 dez 0.00 65535.00 FORMAT "%8.2" /end CHARACTERISTIC
/begin CHARACTERISTIC CDTFRAO2 "" VALUE 0x8E75CC KwUw 65535.00 dez 0.00 65535.00 FORMAT "%8.2" /end CHARACTERISTIC
/begin CHARACTERISTIC CDTFRAU "" VALUE 0x8E75CE KwUw 65535.00 dez 0.00 65535.00 FORMAT "%8.2" /end CHARACTERISTIC
/begin CHARACTERISTIC CDTFRAU2 "" VALUE 0x8E75D0 KwUw 65535.00 dez 0.00 65535.00 FORMAT "%8.2" /end CHARACTERISTIC
/begin CHARACTERISTIC CDTFRST "" VALUE 0x8E75D2 KwUw 65535.00 dez 0.00 65535.00 FORMAT "%8.2" /end CHARACTERISTIC
/begin CHARACTERISTIC CDTFRST2 "" VALUE 0x8E75D4 KwUw 65535.00 dez 0.00 65535.00 FORMAT "%8.2" /end CHARACTERISTIC
/begin CHARACTERISTIC CDTGECOD "" VALUE 0x8E75D6 KwUw 65535.00 dez 0.00 65535.00 FORMAT "%8.2" /end CHARACTERISTIC
/begin CHARACTERISTIC CDTKAT "" VALUE 0x8E75F4 KwUw 65535.00 dez 0.00 65535.00 FORMAT "%8.2" /end CHARACTERISTIC
/begin CHARACTERISTIC CDTKAT2 "" VALUE 0x8E75F6 KwUw 65535.00 dez 0.00 65535.00 FORMAT "%8.2" /end CHARACTERISTIC
/begin CHARACTERISTIC CDTKRA01 "" VALUE 0x8E75FA KwUw 65535.00 dez 0.00 65535.00 FORMAT "%8.2" /end CHARACTERISTIC
/begin CHARACTERISTIC CDTKRA02 "" VALUE 0x8E75FC KwUw 65535.00 dez 0.00 65535.00 FORMAT "%8.2" /end CHARACTERISTIC
/begin CHARACTERISTIC CDTKRA03 "" VALUE 0x8E75FE KwUw 65535.00 dez 0.00 65535.00 FORMAT "%8.2" /end CHARACTERISTIC
/begin CHARACTERISTIC CDTKRA04 "" VALUE 0x8E7600 KwUw 65535.00 dez 0.00 65535.00 FORMAT "%8.2" /end CHARACTERISTIC
/begin CHARACTERISTIC CDTKRA05 "" VALUE 0x8E7602 KwUw 65535.00 dez 0.00 65535.00 FORMAT "%8.2" /end CHARACTERISTIC
/begin CHARACTERISTIC CDTKRA06 "" VALUE 0x8E7604 KwUw 65535.00 dez 0.00 65535.00 FORMAT "%8.2" /end CHARACTERISTIC
/begin CHARACTERISTIC CDTKRNT "" VALUE 0x8E7606 KwUw 65535.00 dez 0.00 65535.00 FORMAT "%8.2" /end CHARACTERISTIC
/begin CHARACTERISTIC CDTKROF "" VALUE 0x8E7608 KwUw 65535.00 dez 0.00 65535.00 FORMAT "%8.2" /end CHARACTERISTIC
/begin CHARACTERISTIC CDTKRTP "" VALUE 0x8E760A KwUw 65535.00 dez 0.00 65535.00 FORMAT "%8.2" /end CHARACTERISTIC
/begin CHARACTERISTIC CDTKS1 "" VALUE 0x8E760C KwUw 65535.00 dez 0.00 65535.00 FORMAT "%8.2" /end CHARACTERISTIC
/begin CHARACTERISTIC CDTKS2 "" VALUE 0x8E760E KwUw 65535.00 dez 0.00 65535.00 FORMAT "%8.2" /end CHARACTERISTIC
/begin CHARACTERISTIC CDTKS3 "" VALUE 0x8E7610 KwUw 65535.00 dez 0.00 65535.00 FORMAT "%8.2" /end CHARACTERISTIC
/begin CHARACTERISTIC CDTKS4 "" VALUE 0x8E7612 KwUw 65535.00 dez 0.00 65535.00 FORMAT "%8.2" /end CHARACTERISTIC
/begin CHARACTERISTIC CDTKUPPL "" VALUE 0x8E7614 KwUw 65535.00 dez 0.00 65535.00 FORMAT "%8.2" /end CHARACTERISTIC
/begin CHARACTERISTIC CDTLASH "" VALUE 0x8E7616 KwUw 65535.00 dez 0.00 65535.00 FORMAT "%8.2" /end CHARACTERISTIC
/begin CHARACTERISTIC CDTLASH2 "" VALUE 0x8E7618 KwUw 65535.00 dez 0.00 65535.00 FORMAT "%8.2" /end CHARACTERISTIC
/begin CHARACTERISTIC CDTLAVH "" VALUE 0x8E761A KwUw 65535.00 dez 0.00 65535.00 FORMAT "%8.2" /end CHARACTERISTIC
/begin CHARACTERISTIC CDTLAVH2 "" VALUE 0x8E761C KwUw 65535.00 dez 0.00 65535.00 FORMAT "%8.2" /end CHARACTERISTIC
/begin CHARACTERISTIC CDTLLR "" VALUE 0x8E7620 KwUw 65535.00 dez 0.00 65535.00 FORMAT "%8.2" /end CHARACTERISTIC
/begin CHARACTERISTIC CDTLM "" VALUE 0x8E7622 KwUw 65535.00 dez 0.00 65535.00 FORMAT "%8.2" /end CHARACTERISTIC
/begin CHARACTERISTIC CDTLSH "" VALUE 0x8E7624 KwUw 65535.00 dez 0.00 65535.00 FORMAT "%8.2" /end CHARACTERISTIC
/begin CHARACTERISTIC CDTLSH2 "" VALUE 0x8E7626 KwUw 65535.00 dez 0.00 65535.00 FORMAT "%8.2" /end CHARACTERISTIC
/begin CHARACTERISTIC CDTLSVV "" VALUE 0x8E7642 KwUw 65535.00 dez 0.00 65535.00 FORMAT "%8.2" /end CHARACTERISTIC
/begin CHARACTERISTIC CDTLUE1 "" VALUE 0x8E7644 KwUw 65535.00 DEZ 0.00 65535.00 FORMAT "%8.2" /end CHARACTERISTIC
/begin CHARACTERISTIC CDTMD "" VALUE 0x8E764A KwUw 65535.00 dez 0.00 65535.00 FORMAT "%8.2" /end CHARACTERISTIC
/begin CHARACTERISTIC CDTMD00 "" VALUE 0x8E764C KwUw 65535.00 dez 0.00 65535.00 FORMAT "%8.2" /end CHARACTERISTIC
/begin CHARACTERISTIC CDTMD01 "" VALUE 0x8E764E KwUw 65535.00 dez 0.00 65535.00 FORMAT "%8.2" /end CHARACTERISTIC
/begin CHARACTERISTIC CDTMD02 "" VALUE 0x8E7650 KwUw 65535.00 dez 0.00 65535.00 FORMAT "%8.2" /end CHARACTERISTIC
/begin CHARACTERISTIC CDTMD03 "" VALUE 0x8E7652 KwUw 65535.00 dez 0.00 65535.00 FORMAT "%8.2" /end CHARACTERISTIC
/begin CHARACTERISTIC CDTMD04 "" VALUE 0x8E7654 KwUw 65535.00 dez 0.00 65535.00 FORMAT "%8.2" /end CHARACTERISTIC
/begin CHARACTERISTIC CDTMD05 "" VALUE 0x8E7656 KwUw 65535.00 dez 0.00 65535.00 FORMAT "%8.2" /end CHARACTERISTIC
/begin CHARACTERISTIC CDTMFA "" VALUE 0x8E765A KwUw 65535.00 dez 0.00 65535.00 FORMAT "%8.2" /end CHARACTERISTIC
/begin CHARACTERISTIC CDTNWKW "" VALUE 0x8E765E KwUw 65535.00 dez 0.00 65535.00 FORMAT "%8.2" /end CHARACTERISTIC
/begin CHARACTERISTIC CDTNWKW2 "" VALUE 0x8E7660 KwUw 65535.00 dez 0.00 65535.00 FORMAT "%8.2" /end CHARACTERISTIC
/begin CHARACTERISTIC CDTNX "" VALUE 0x8E7662 KwUw 65535.00 dez 0.00 65535.00 FORMAT "%8.2" /end CHARACTERISTIC
/begin CHARACTERISTIC CDTPH "" VALUE 0x8E7664 KwUw 65535.00 dez 0.00 65535.00 FORMAT "%8.2" /end CHARACTERISTIC
/begin CHARACTERISTIC CDTPH2 "" VALUE 0x8E7666 KwUw 65535.00 dez 0.00 65535.00 FORMAT "%8.2" /end CHARACTERISTIC
/begin CHARACTERISTIC CDTPLLSU "" VALUE 0x8E7668 KwUw 65535.00 dez 0.00 65535.00 FORMAT "%8.2" /end CHARACTERISTIC
/begin CHARACTERISTIC CDTPLLSU2 "" VALUE 0x8E766A KwUw 65535.00 dez 0.00 65535.00 FORMAT "%8.2" /end CHARACTERISTIC
/begin CHARACTERISTIC CDTRKAT "" VALUE 0x8E766E KwUw 65535.00 dez 0.00 65535.00 FORMAT "%8.2" /end CHARACTERISTIC
/begin CHARACTERISTIC CDTRKAT2 "" VALUE 0x8E7670 KwUw 65535.00 dez 0.00 65535.00 FORMAT "%8.2" /end CHARACTERISTIC
/begin CHARACTERISTIC CDTRKAZ "" VALUE 0x8E7672 KwUw 65535.00 dez 0.00 65535.00 FORMAT "%8.2" /end CHARACTERISTIC
/begin CHARACTERISTIC CDTRKAZ2 "" VALUE 0x8E7674 KwUw 65535.00 dez 0.00 65535.00 FORMAT "%8.2" /end CHARACTERISTIC
/begin CHARACTERISTIC CDTSGEEP "" VALUE 0x8E7678 KwUw 65535.00 dez 0.00 65535.00 FORMAT "%8.2" /end CHARACTERISTIC
/begin CHARACTERISTIC CDTSLS "" VALUE 0x8E767E KwUw 65535.00 dez 0.00 65535.00 FORMAT "%8.2" /end CHARACTERISTIC
/begin CHARACTERISTIC CDTSLS2 "" VALUE 0x8E7680 KwUw 65535.00 dez 0.00 65535.00 FORMAT "%8.2" /end CHARACTERISTIC
/begin CHARACTERISTIC CDTSLV "" VALUE 0x8E7682 KwUw 65535.00 dez 0.00 65535.00 FORMAT "%8.2" /end CHARACTERISTIC
/begin CHARACTERISTIC CDTSLV2 "" VALUE 0x8E7684 KwUw 65535.00 dez 0.00 65535.00 FORMAT "%8.2" /end CHARACTERISTIC
/begin CHARACTERISTIC CDTTANKL "" VALUE 0x8E768E KwUw 65535.00 dez 0.00 65535.00 FORMAT "%8.2" /end CHARACTERISTIC
/begin CHARACTERISTIC CDTTES "" VALUE 0x8E7690 KwUw 65535.00 dez 0.00 65535.00 FORMAT "%8.2" /end CHARACTERISTIC
/begin CHARACTERISTIC CDTTESF "" VALUE 0x8E7692 KwUw 65535.00 dez 0.00 65535.00 FORMAT "%8.2" /end CHARACTERISTIC
/begin CHARACTERISTIC CDTTESG "" VALUE 0x8E7694 KwUw 65535.00 dez 0.00 65535.00 FORMAT "%8.2" /end CHARACTERISTIC
/begin CHARACTERISTIC CDTTEVE2 "" VALUE 0x8E7698 KwUw 65535.00 dez 0.00 65535.00 FORMAT "%8.2" /end CHARACTERISTIC
/begin CHARACTERISTIC CDTUFMV "" VALUE 0x8E76A8 KwUw 65535.00 dez 0.00 65535.00 FORMAT "%8.2" /end CHARACTERISTIC
/begin CHARACTERISTIC CDTUFNC "" VALUE 0x8E76AA KwUw 65535.00 dez 0.00 65535.00 FORMAT "%8.2" /end CHARACTERISTIC
/begin CHARACTERISTIC CDTUFRLIP "" VALUE 0x8E76AC KwUw 65535.00 dez 0.00 65535.00 FORMAT "%8.2" /end CHARACTERISTIC
/begin CHARACTERISTIC CDTUFSGA "" VALUE 0x8E76AE KwUw 65535.00 dez 0.00 65535.00 FORMAT "%8.2" /end CHARACTERISTIC
/begin CHARACTERISTIC CDTUFSGB "" VALUE 0x8E76B0 KwUw 65535.00 dez 0.00 65535.00 FORMAT "%8.2" /end CHARACTERISTIC
/begin CHARACTERISTIC CDTUFSKA "" VALUE 0x8E76B2 KwUw 65535.00 dez 0.00 65535.00 FORMAT "%8.2" /end CHARACTERISTIC
/begin CHARACTERISTIC CDTUFSPSC "" VALUE 0x8E76B4 KwUw 65535.00 dez 0.00 65535.00 FORMAT "%8.2" /end CHARACTERISTIC
/begin CHARACTERISTIC CDTULSU "" VALUE 0x8E76B6 KwUw 65535.00 dez 0.00 65535.00 FORMAT "%8.2" /end CHARACTERISTIC
/begin CHARACTERISTIC CDTULSU2 "" VALUE 0x8E76B8 KwUw 65535.00 dez 0.00 65535.00 FORMAT "%8.2" /end CHARACTERISTIC
/begin CHARACTERISTIC CDTURRAM "" VALUE 0x8E76BA KwUw 65535.00 dez 0.00 65535.00 FORMAT "%8.2" /end CHARACTERISTIC
/begin CHARACTERISTIC CDTURROM "" VALUE 0x8E76BC KwUw 65535.00 dez 0.00 65535.00 FORMAT "%8.2" /end CHARACTERISTIC
/begin CHARACTERISTIC CDTURRST "" VALUE 0x8E76BE KwUw 65535.00 dez 0.00 65535.00 FORMAT "%8.2" /end CHARACTERISTIC
/begin CHARACTERISTIC CDTVFZ "" VALUE 0x8E76C0 KwUw 65535.00 dez 0.00 65535.00 FORMAT "%8.2" /end CHARACTERISTIC
/begin CHARACTERISTIC CLACGE "" VALUE 0x8E05FD KwUb 255.0 dez 0.00 255.0 FORMAT "%5.1" /end CHARACTERISTIC
/begin CHARACTERISTIC CLADPL "" VALUE 0x8E0608 KwUb 255.0 dez 0.00 255.0 FORMAT "%5.1" /end CHARACTERISTIC
/begin CHARACTERISTIC CLADSBKV "" VALUE 0x8E0609 KwUb 255.0 dez 0.00 255.0 FORMAT "%5.1" /end CHARACTERISTIC
/begin CHARACTERISTIC CLAFRAO "" VALUE 0x8E0626 KwUb 255.0 dez 0.00 255.0 FORMAT "%5.1" /end CHARACTERISTIC
/begin CHARACTERISTIC CLAFRAO2 "" VALUE 0x8E0627 KwUb 255.0 dez 0.00 255.0 FORMAT "%5.1" /end CHARACTERISTIC
/begin CHARACTERISTIC CLAFRAU "" VALUE 0x8E0628 KwUb 255.0 dez 0.00 255.0 FORMAT "%5.1" /end CHARACTERISTIC
/begin CHARACTERISTIC CLAFRAU2 "" VALUE 0x8E0629 KwUb 255.0 dez 0.00 255.0 FORMAT "%5.1" /end CHARACTERISTIC
/begin CHARACTERISTIC CLAFRST "" VALUE 0x8E062A KwUb 255.0 dez 0.00 255.0 FORMAT "%5.1" /end CHARACTERISTIC
/begin CHARACTERISTIC CLAFRST2 "" VALUE 0x8E062B KwUb 255.0 dez 0.00 255.0 FORMAT "%5.1" /end CHARACTERISTIC
/begin CHARACTERISTIC CLAGECOD "" VALUE 0x8E062C KwUb 255.0 dez 0.00 255.0 FORMAT "%5.1" /end CHARACTERISTIC
/begin CHARACTERISTIC CLAKAT "" VALUE 0x8E063B KwUb 255.0 dez 0.00 255.0 FORMAT "%5.1" /end CHARACTERISTIC
/begin CHARACTERISTIC CLAKAT2 "" VALUE 0x8E063C KwUb 255.0 dez 0.00 255.0 FORMAT "%5.1" /end CHARACTERISTIC
/begin CHARACTERISTIC CLAKRA01 "" VALUE 0x8E063E KwUb 255.0 dez 0.00 255.0 FORMAT "%5.1" /end CHARACTERISTIC
/begin CHARACTERISTIC CLAKRA02 "" VALUE 0x8E063F KwUb 255.0 dez 0.00 255.0 FORMAT "%5.1" /end CHARACTERISTIC
/begin CHARACTERISTIC CLAKRA03 "" VALUE 0x8E0640 KwUb 255.0 dez 0.00 255.0 FORMAT "%5.1" /end CHARACTERISTIC
/begin CHARACTERISTIC CLAKRA04 "" VALUE 0x8E0641 KwUb 255.0 dez 0.00 255.0 FORMAT "%5.1" /end CHARACTERISTIC
/begin CHARACTERISTIC CLAKRA05 "" VALUE 0x8E0642 KwUb 255.0 dez 0.00 255.0 FORMAT "%5.1" /end CHARACTERISTIC
/begin CHARACTERISTIC CLAKRA06 "" VALUE 0x8E0643 KwUb 255.0 dez 0.00 255.0 FORMAT "%5.1" /end CHARACTERISTIC
/begin CHARACTERISTIC CLAKRNT "" VALUE 0x8E0644 KwUb 255.0 dez 0.00 255.0 FORMAT "%5.1" /end CHARACTERISTIC
/begin CHARACTERISTIC CLAKROF "" VALUE 0x8E0645 KwUb 255.0 dez 0.00 255.0 FORMAT "%5.1" /end CHARACTERISTIC
/begin CHARACTERISTIC CLAKRTP "" VALUE 0x8E0646 KwUb 255.0 dez 0.00 255.0 FORMAT "%5.1" /end CHARACTERISTIC
/begin CHARACTERISTIC CLAKS1 "" VALUE 0x8E0647 KwUb 255.0 dez 0.00 255.0 FORMAT "%5.1" /end CHARACTERISTIC
/begin CHARACTERISTIC CLAKS2 "" VALUE 0x8E0648 KwUb 255.0 dez 0.00 255.0 FORMAT "%5.1" /end CHARACTERISTIC
/begin CHARACTERISTIC CLAKS3 "" VALUE 0x8E0649 KwUb 255.0 dez 0.00 255.0 FORMAT "%5.1" /end CHARACTERISTIC
/begin CHARACTERISTIC CLAKS4 "" VALUE 0x8E064A KwUb 255.0 dez 0.00 255.0 FORMAT "%5.1" /end CHARACTERISTIC
/begin CHARACTERISTIC CLAKUPPL "" VALUE 0x8E064B KwUb 255.0 dez 0.00 255.0 FORMAT "%5.1" /end CHARACTERISTIC
/begin CHARACTERISTIC CLALASH "" VALUE 0x8E064C KwUb 255.0 dez 0.00 255.0 FORMAT "%5.1" /end CHARACTERISTIC
/begin CHARACTERISTIC CLALASH2 "" VALUE 0x8E064D KwUb 255.0 dez 0.00 255.0 FORMAT "%5.1" /end CHARACTERISTIC
/begin CHARACTERISTIC CLALAVH "" VALUE 0x8E064E KwUb 255.0 dez 0.00 255.0 FORMAT "%5.1" /end CHARACTERISTIC
/begin CHARACTERISTIC CLALAVH2 "" VALUE 0x8E064F KwUb 255.0 dez 0.00 255.0 FORMAT "%5.1" /end CHARACTERISTIC
/begin CHARACTERISTIC CLALLR "" VALUE 0x8E0651 KwUb 255.0 dez 0.00 255.0 FORMAT "%5.1" /end CHARACTERISTIC
/begin CHARACTERISTIC CLALM "" VALUE 0x8E0652 KwUb 255.0 dez 0.00 255.0 FORMAT "%5.1" /end CHARACTERISTIC
/begin CHARACTERISTIC CLALSH "" VALUE 0x8E0653 KwUb 255.0 dez 0.00 255.0 FORMAT "%5.1" /end CHARACTERISTIC
/begin CHARACTERISTIC CLALSH2 "" VALUE 0x8E0654 KwUb 255.0 dez 0.00 255.0 FORMAT "%5.1" /end CHARACTERISTIC
/begin CHARACTERISTIC CLALSVV "" VALUE 0x8E0662 KwUb 255.0 dez 0.00 255.0 FORMAT "%5.1" /end CHARACTERISTIC
/begin CHARACTERISTIC CLALUE1 "" VALUE 0x8E0663 KwUb 255.0 DEZ 0.00 255.0 FORMAT "%5.1" /end CHARACTERISTIC
/begin CHARACTERISTIC CLAMD "" VALUE 0x8E0666 KwUb 255.0 dez 0.00 255.0 FORMAT "%5.1" /end CHARACTERISTIC
/begin CHARACTERISTIC CLAMD00 "" VALUE 0x8E0667 KwUb 255.0 dez 0.00 255.0 FORMAT "%5.1" /end CHARACTERISTIC
/begin CHARACTERISTIC CLAMD01 "" VALUE 0x8E0668 KwUb 255.0 dez 0.00 255.0 FORMAT "%5.1" /end CHARACTERISTIC
/begin CHARACTERISTIC CLAMD02 "" VALUE 0x8E0669 KwUb 255.0 dez 0.00 255.0 FORMAT "%5.1" /end CHARACTERISTIC
/begin CHARACTERISTIC CLAMD03 "" VALUE 0x8E066A KwUb 255.0 dez 0.00 255.0 FORMAT "%5.1" /end CHARACTERISTIC
/begin CHARACTERISTIC CLAMD04 "" VALUE 0x8E066B KwUb 255.0 dez 0.00 255.0 FORMAT "%5.1" /end CHARACTERISTIC
/begin CHARACTERISTIC CLAMD05 "" VALUE 0x8E066C KwUb 255.0 dez 0.00 255.0 FORMAT "%5.1" /end CHARACTERISTIC
/begin CHARACTERISTIC CLAMFA "" VALUE 0x8E066E KwUb 255.0 dez 0.00 255.0 FORMAT "%5.1" /end CHARACTERISTIC
/begin CHARACTERISTIC CLANWKW "" VALUE 0x8E0670 KwUb 255.0 dez 0.00 255.0 FORMAT "%5.1" /end CHARACTERISTIC
/begin CHARACTERISTIC CLANWKW2 "" VALUE 0x8E0671 KwUb 255.0 dez 0.00 255.0 FORMAT "%5.1" /end CHARACTERISTIC
/begin CHARACTERISTIC CLANX "" VALUE 0x8E0672 KwUb 255.0 dez 0.00 255.0 FORMAT "%5.1" /end CHARACTERISTIC
/begin CHARACTERISTIC CLAPH "" VALUE 0x8E0673 KwUb 255.0 dez 0.00 255.0 FORMAT "%5.1" /end CHARACTERISTIC
/begin CHARACTERISTIC CLAPH2 "" VALUE 0x8E0674 KwUb 255.0 dez 0.00 255.0 FORMAT "%5.1" /end CHARACTERISTIC
/begin CHARACTERISTIC CLAPLLSU "" VALUE 0x8E0675 KwUb 255.0 dez 0.00 255.0 FORMAT "%5.1" /end CHARACTERISTIC
/begin CHARACTERISTIC CLAPLLSU2 "" VALUE 0x8E0676 KwUb 255.0 dez 0.00 255.0 FORMAT "%5.1" /end CHARACTERISTIC
/begin CHARACTERISTIC CLARKAT "" VALUE 0x8E0678 KwUb 255.0 dez 0.00 255.0 FORMAT "%5.1" /end CHARACTERISTIC
/begin CHARACTERISTIC CLARKAT2 "" VALUE 0x8E0679 KwUb 255.0 dez 0.00 255.0 FORMAT "%5.1" /end CHARACTERISTIC
/begin CHARACTERISTIC CLARKAZ "" VALUE 0x8E067A KwUb 255.0 dez 0.00 255.0 FORMAT "%5.1" /end CHARACTERISTIC
/begin CHARACTERISTIC CLARKAZ2 "" VALUE 0x8E067B KwUb 255.0 dez 0.00 255.0 FORMAT "%5.1" /end CHARACTERISTIC
/begin CHARACTERISTIC CLASGEEP "" VALUE 0x8E067D KwUb 255.0 dez 0.00 255.0 FORMAT "%5.1" /end CHARACTERISTIC
/begin CHARACTERISTIC CLASLS "" VALUE 0x8E0680 KwUb 255.0 dez 0.00 255.0 FORMAT "%5.1" /end CHARACTERISTIC
/begin CHARACTERISTIC CLASLS2 "" VALUE 0x8E0681 KwUb 255.0 dez 0.00 255.0 FORMAT "%5.1" /end CHARACTERISTIC
/begin CHARACTERISTIC CLASLV "" VALUE 0x8E0682 KwUb 255.0 dez 0.00 255.0 FORMAT "%5.1" /end CHARACTERISTIC
/begin CHARACTERISTIC CLASLV2 "" VALUE 0x8E0683 KwUb 255.0 dez 0.00 255.0 FORMAT "%5.1" /end CHARACTERISTIC
/begin CHARACTERISTIC CLATANKL "" VALUE 0x8E0688 KwUb 255.0 dez 0.00 255.0 FORMAT "%5.1" /end CHARACTERISTIC
/begin CHARACTERISTIC CLATES "" VALUE 0x8E0689 KwUb 255.0 dez 0.00 255.0 FORMAT "%5.1" /end CHARACTERISTIC
/begin CHARACTERISTIC CLATESF "" VALUE 0x8E068A KwUb 255.0 dez 0.00 255.0 FORMAT "%5.1" /end CHARACTERISTIC
/begin CHARACTERISTIC CLATESG "" VALUE 0x8E068B KwUb 255.0 dez 0.00 255.0 FORMAT "%5.1" /end CHARACTERISTIC
/begin CHARACTERISTIC CLATEVE2 "" VALUE 0x8E068D KwUb 255.0 dez 0.00 255.0 FORMAT "%5.1" /end CHARACTERISTIC
/begin CHARACTERISTIC CLAUFMV "" VALUE 0x8E0695 KwUb 255.0 dez 0.00 255.0 FORMAT "%5.1" /end CHARACTERISTIC
/begin CHARACTERISTIC CLAUFNC "" VALUE 0x8E0696 KwUb 255.0 dez 0.00 255.0 FORMAT "%5.1" /end CHARACTERISTIC
/begin CHARACTERISTIC CLAUFRLIP "" VALUE 0x8E0697 KwUb 255.0 dez 0.00 255.0 FORMAT "%5.1" /end CHARACTERISTIC
/begin CHARACTERISTIC CLAUFSGA "" VALUE 0x8E0698 KwUb 255.0 dez 0.00 255.0 FORMAT "%5.1" /end CHARACTERISTIC
/begin CHARACTERISTIC CLAUFSGB "" VALUE 0x8E0699 KwUb 255.0 dez 0.00 255.0 FORMAT "%5.1" /end CHARACTERISTIC
/begin CHARACTERISTIC CLAUFSKA "" VALUE 0x8E069A KwUb 255.0 dez 0.00 255.0 FORMAT "%5.1" /end CHARACTERISTIC
/begin CHARACTERISTIC CLAUFSPSC "" VALUE 0x8E069B KwUb 255.0 dez 0.00 255.0 FORMAT "%5.1" /end CHARACTERISTIC
/begin CHARACTERISTIC CLAULSU "" VALUE 0x8E069C KwUb 255.0 dez 0.00 255.0 FORMAT "%5.1" /end CHARACTERISTIC
/begin CHARACTERISTIC CLAULSU2 "" VALUE 0x8E069D KwUb 255.0 dez 0.00 255.0 FORMAT "%5.1" /end CHARACTERISTIC
/begin CHARACTERISTIC CLAURRAM "" VALUE 0x8E069E KwUb 255.0 dez 0.00 255.0 FORMAT "%5.1" /end CHARACTERISTIC
/begin CHARACTERISTIC CLAURROM "" VALUE 0x8E069F KwUb 255.0 dez 0.00 255.0 FORMAT "%5.1" /end CHARACTERISTIC
/begin CHARACTERISTIC CLAURRST "" VALUE 0x8E06A0 KwUb 255.0 dez 0.00 255.0 FORMAT "%5.1" /end CHARACTERISTIC
/begin CHARACTERISTIC CLAVFZ "" VALUE 0x8E06A1 KwUb 255.0 dez 0.00 255.0 FORMAT "%5.1" /end CHARACTERISTIC
/begin CHARACTERISTIC FFTCGE "" VAL_BLK 0x8E06D0 KwbUb 255.0 dez 0.00 255.0 FORMAT "%5.1" NUMBER 2 /end CHARACTERISTIC
/begin CHARACTERISTIC FFTDPL "" VAL_BLK 0x8E06E6 KwbUb 255.0 dez 0.00 255.0 FORMAT "%5.1" NUMBER 2 /end CHARACTERISTIC
/begin CHARACTERISTIC FFTDSBKV "" VAL_BLK 0x8E06E8 KwbUb 255.0 dez 0.00 255.0 FORMAT "%5.1" NUMBER 2 /end CHARACTERISTIC
/begin CHARACTERISTIC FFTFRAO "" VAL_BLK 0x8E0722 KwbUb 255.0 dez 0.00 255.0 FORMAT "%5.1" NUMBER 2 /end CHARACTERISTIC
/begin CHARACTERISTIC FFTFRAO2 "" VAL_BLK 0x8E0724 KwbUb 255.0 dez 0.00 255.0 FORMAT "%5.1" NUMBER 2 /end CHARACTERISTIC
/begin CHARACTERISTIC FFTFRAU "" VAL_BLK 0x8E0726 KwbUb 255.0 dez 0.00 255.0 FORMAT "%5.1" NUMBER 2 /end CHARACTERISTIC
/begin CHARACTERISTIC FFTFRAU2 "" VAL_BLK 0x8E0728 KwbUb 255.0 dez 0.00 255.0 FORMAT "%5.1" NUMBER 2 /end CHARACTERISTIC
/begin CHARACTERISTIC FFTFRST "" VAL_BLK 0x8E072A KwbUb 255.0 dez 0.00 255.0 FORMAT "%5.1" NUMBER 2 /end CHARACTERISTIC
/begin CHARACTERISTIC FFTFRST2 "" VAL_BLK 0x8E072C KwbUb 255.0 dez 0.00 255.0 FORMAT "%5.1" NUMBER 2 /end CHARACTERISTIC
/begin CHARACTERISTIC FFTGECOD "" VAL_BLK 0x8E072E KwbUb 255.0 dez 0.00 255.0 FORMAT "%5.1" NUMBER 2 /end CHARACTERISTIC
/begin CHARACTERISTIC FFTKAT "" VAL_BLK 0x8E074C KwbUb 255.0 dez 0.00 255.0 FORMAT "%5.1" NUMBER 2 /end CHARACTERISTIC
/begin CHARACTERISTIC FFTKAT2 "" VAL_BLK 0x8E074E KwbUb 255.0 dez 0.00 255.0 FORMAT "%5.1" NUMBER 2 /end CHARACTERISTIC
/begin CHARACTERISTIC FFTKRA01 "" VAL_BLK 0x8E0752 KwbUb 255.0 dez 0.00 255.0 FORMAT "%5.1" NUMBER 2 /end CHARACTERISTIC
/begin CHARACTERISTIC FFTKRA02 "" VAL_BLK 0x8E0754 KwbUb 255.0 dez 0.00 255.0 FORMAT "%5.1" NUMBER 2 /end CHARACTERISTIC
/begin CHARACTERISTIC FFTKRA03 "" VAL_BLK 0x8E0756 KwbUb 255.0 dez 0.00 255.0 FORMAT "%5.1" NUMBER 2 /end CHARACTERISTIC
/begin CHARACTERISTIC FFTKRA04 "" VAL_BLK 0x8E0758 KwbUb 255.0 dez 0.00 255.0 FORMAT "%5.1" NUMBER 2 /end CHARACTERISTIC
/begin CHARACTERISTIC FFTKRA05 "" VAL_BLK 0x8E075A KwbUb 255.0 dez 0.00 255.0 FORMAT "%5.1" NUMBER 2 /end CHARACTERISTIC
/begin CHARACTERISTIC FFTKRA06 "" VAL_BLK 0x8E075C KwbUb 255.0 dez 0.00 255.0 FORMAT "%5.1" NUMBER 2 /end CHARACTERISTIC
/begin CHARACTERISTIC FFTKRNT "" VAL_BLK 0x8E075E KwbUb 255.0 dez 0.00 255.0 FORMAT "%5.1" NUMBER 2 /end CHARACTERISTIC
/begin CHARACTERISTIC FFTKROF "" VAL_BLK 0x8E0760 KwbUb 255.0 dez 0.00 255.0 FORMAT "%5.1" NUMBER 2 /end CHARACTERISTIC
/begin CHARACTERISTIC FFTKRTP "" VAL_BLK 0x8E0762 KwbUb 255.0 dez 0.00 255.0 FORMAT "%5.1" NUMBER 2 /end CHARACTERISTIC
/begin CHARACTERISTIC FFTKS1 "" VAL_BLK 0x8E0764 KwbUb 255.0 dez 0.00 255.0 FORMAT "%5.1" NUMBER 2 /end CHARACTERISTIC
/begin CHARACTERISTIC FFTKS2 "" VAL_BLK 0x8E0766 KwbUb 255.0 dez 0.00 255.0 FORMAT "%5.1" NUMBER 2 /end CHARACTERISTIC
/begin CHARACTERISTIC FFTKS3 "" VAL_BLK 0x8E0768 KwbUb 255.0 dez 0.00 255.0 FORMAT "%5.1" NUMBER 2 /end CHARACTERISTIC
/begin CHARACTERISTIC FFTKS4 "" VAL_BLK 0x8E076A KwbUb 255.0 dez 0.00 255.0 FORMAT "%5.1" NUMBER 2 /end CHARACTERISTIC
/begin CHARACTERISTIC FFTKUPPL "" VAL_BLK 0x8E076C KwbUb 255.0 dez 0.00 255.0 FORMAT "%5.1" NUMBER 2 /end CHARACTERISTIC
/begin CHARACTERISTIC FFTLASH "" VAL_BLK 0x8E076E KwbUb 255.0 dez 0.00 255.0 FORMAT "%5.1" NUMBER 2 /end CHARACTERISTIC
/begin CHARACTERISTIC FFTLASH2 "" VAL_BLK 0x8E0770 KwbUb 255.0 dez 0.00 255.0 FORMAT "%5.1" NUMBER 2 /end CHARACTERISTIC
/begin CHARACTERISTIC FFTLAVH "" VAL_BLK 0x8E0772 KwbUb 255.0 dez 0.00 255.0 FORMAT "%5.1" NUMBER 2 /end CHARACTERISTIC
/begin CHARACTERISTIC FFTLAVH2 "" VAL_BLK 0x8E0774 KwbUb 255.0 dez 0.00 255.0 FORMAT "%5.1" NUMBER 2 /end CHARACTERISTIC
/begin CHARACTERISTIC FFTLLR "" VAL_BLK 0x8E0778 KwbUb 255.0 dez 0.00 255.0 FORMAT "%5.1" NUMBER 2 /end CHARACTERISTIC
/begin CHARACTERISTIC FFTLM "" VAL_BLK 0x8E077A KwbUb 255.0 dez 0.00 255.0 FORMAT "%5.1" NUMBER 2 /end CHARACTERISTIC
/begin CHARACTERISTIC FFTLSH "" VAL_BLK 0x8E077C KwbUb 255.0 dez 0.00 255.0 FORMAT "%5.1" NUMBER 2 /end CHARACTERISTIC
/begin CHARACTERISTIC FFTLSH2 "" VAL_BLK 0x8E077E KwbUb 255.0 dez 0.00 255.0 FORMAT "%5.1" NUMBER 2 /end CHARACTERISTIC
/begin CHARACTERISTIC FFTLSVV "" VAL_BLK 0x8E079A KwbUb 255.0 dez 0.00 255.0 FORMAT "%5.1" NUMBER 2 /end CHARACTERISTIC
/begin CHARACTERISTIC FFTLUE1 "" VAL_BLK 0x8E079C KwbUb 255.0 DEZ 0.00 255.0 FORMAT "%5.1" NUMBER 2 /end CHARACTERISTIC
/begin CHARACTERISTIC FFTMD "" VAL_BLK 0x8E07A2 KwbUb 255.0 dez 0.00 255.0 FORMAT "%5.1" NUMBER 2 /end CHARACTERISTIC
/begin CHARACTERISTIC FFTMD00 "" VAL_BLK 0x8E07A4 KwbUb 255.0 dez 0.00 255.0 FORMAT "%5.1" NUMBER 2 /end CHARACTERISTIC
/begin CHARACTERISTIC FFTMD01 "" VAL_BLK 0x8E07A6 KwbUb 255.0 dez 0.00 255.0 FORMAT "%5.1" NUMBER 2 /end CHARACTERISTIC
/begin CHARACTERISTIC FFTMD02 "" VAL_BLK 0x8E07A8 KwbUb 255.0 dez 0.00 255.0 FORMAT "%5.1" NUMBER 2 /end CHARACTERISTIC
/begin CHARACTERISTIC FFTMD03 "" VAL_BLK 0x8E07AA KwbUb 255.0 dez 0.00 255.0 FORMAT "%5.1" NUMBER 2 /end CHARACTERISTIC
/begin CHARACTERISTIC FFTMD04 "" VAL_BLK 0x8E07AC KwbUb 255.0 dez 0.00 255.0 FORMAT "%5.1" NUMBER 2 /end CHARACTERISTIC
/begin CHARACTERISTIC FFTMD05 "" VAL_BLK 0x8E07AE KwbUb 255.0 dez 0.00 255.0 FORMAT "%5.1" NUMBER 2 /end CHARACTERISTIC
/begin CHARACTERISTIC FFTMFA "" VAL_BLK 0x8E07B2 KwbUb 255.0 dez 0.00 255.0 FORMAT "%5.1" NUMBER 2 /end CHARACTERISTIC
/begin CHARACTERISTIC FFTNWKW "" VAL_BLK 0x8E07B6 KwbUb 255.0 dez 0.00 255.0 FORMAT "%5.1" NUMBER 2 /end CHARACTERISTIC
/begin CHARACTERISTIC FFTNWKW2 "" VAL_BLK 0x8E07B8 KwbUb 255.0 dez 0.00 255.0 FORMAT "%5.1" NUMBER 2 /end CHARACTERISTIC
/begin CHARACTERISTIC FFTNX "" VAL_BLK 0x8E07BA KwbUb 255.0 dez 0.00 255.0 FORMAT "%5.1" NUMBER 2 /end CHARACTERISTIC
/begin CHARACTERISTIC FFTPH "" VAL_BLK 0x8E07BC KwbUb 255.0 dez 0.00 255.0 FORMAT "%5.1" NUMBER 2 /end CHARACTERISTIC
/begin CHARACTERISTIC FFTPH2 "" VAL_BLK 0x8E07BE KwbUb 255.0 dez 0.00 255.0 FORMAT "%5.1" NUMBER 2 /end CHARACTERISTIC
/begin CHARACTERISTIC FFTPLLSU "" VAL_BLK 0x8E07C0 KwbUb 255.0 dez 0.00 255.0 FORMAT "%5.1" NUMBER 2 /end CHARACTERISTIC
/begin CHARACTERISTIC FFTPLLSU2 "" VAL_BLK 0x8E07C2 KwbUb 255.0 dez 0.00 255.0 FORMAT "%5.1" NUMBER 2 /end CHARACTERISTIC
/begin CHARACTERISTIC FFTRKAT "" VAL_BLK 0x8E07C6 KwbUb 255.0 dez 0.00 255.0 FORMAT "%5.1" NUMBER 2 /end CHARACTERISTIC
/begin CHARACTERISTIC FFTRKAT2 "" VAL_BLK 0x8E07C8 KwbUb 255.0 dez 0.00 255.0 FORMAT "%5.1" NUMBER 2 /end CHARACTERISTIC
/begin CHARACTERISTIC FFTRKAZ "" VAL_BLK 0x8E07CA KwbUb 255.0 dez 0.00 255.0 FORMAT "%5.1" NUMBER 2 /end CHARACTERISTIC
/begin CHARACTERISTIC FFTRKAZ2 "" VAL_BLK 0x8E07CC KwbUb 255.0 dez 0.00 255.0 FORMAT "%5.1" NUMBER 2 /end CHARACTERISTIC
/begin CHARACTERISTIC FFTSGEEP "" VAL_BLK 0x8E07D0 KwbUb 255.0 dez 0.00 255.0 FORMAT "%5.1" NUMBER 2 /end CHARACTERISTIC
/begin CHARACTERISTIC FFTSLS "" VAL_BLK 0x8E07D6 KwbUb 255.0 dez 0.00 255.0 FORMAT "%5.1" NUMBER 2 /end CHARACTERISTIC
/begin CHARACTERISTIC FFTSLS2 "" VAL_BLK 0x8E07D8 KwbUb 255.0 dez 0.00 255.0 FORMAT "%5.1" NUMBER 2 /end CHARACTERISTIC
/begin CHARACTERISTIC FFTSLV "" VAL_BLK 0x8E07DA KwbUb 255.0 dez 0.00 255.0 FORMAT "%5.1" NUMBER 2 /end CHARACTERISTIC
/begin CHARACTERISTIC FFTSLV2 "" VAL_BLK 0x8E07DC KwbUb 255.0 dez 0.00 255.0 FORMAT "%5.1" NUMBER 2 /end CHARACTERISTIC
/begin CHARACTERISTIC FFTTANKL "" VAL_BLK 0x8E07E6 KwbUb 255.0 dez 0.00 255.0 FORMAT "%5.1" NUMBER 2 /end CHARACTERISTIC
/begin CHARACTERISTIC FFTTES "" VAL_BLK 0x8E07E8 KwbUb 255.0 dez 0.00 255.0 FORMAT "%5.1" NUMBER 2 /end CHARACTERISTIC
/begin CHARACTERISTIC FFTTESF "" VAL_BLK 0x8E07EA KwbUb 255.0 dez 0.00 255.0 FORMAT "%5.1" NUMBER 2 /end CHARACTERISTIC
/begin CHARACTERISTIC FFTTESG "" VAL_BLK 0x8E07EC KwbUb 255.0 dez 0.00 255.0 FORMAT "%5.1" NUMBER 2 /end CHARACTERISTIC
/begin CHARACTERISTIC FFTTEVE2 "" VAL_BLK 0x8E07F0 KwbUb 255.0 dez 0.00 255.0 FORMAT "%5.1" NUMBER 2 /end CHARACTERISTIC
/begin CHARACTERISTIC FFTUFMV "" VAL_BLK 0x8E0800 KwbUb 255.0 dez 0.00 255.0 FORMAT "%5.1" NUMBER 2 /end CHARACTERISTIC
/begin CHARACTERISTIC FFTUFNC "" VAL_BLK 0x8E0802 KwbUb 255.0 dez 0.00 255.0 FORMAT "%5.1" NUMBER 2 /end CHARACTERISTIC
/begin CHARACTERISTIC FFTUFRLIP "" VAL_BLK 0x8E0804 KwbUb 255.0 dez 0.00 255.0 FORMAT "%5.1" NUMBER 2 /end CHARACTERISTIC
/begin CHARACTERISTIC FFTUFSGA "" VAL_BLK 0x8E0806 KwbUb 255.0 dez 0.00 255.0 FORMAT "%5.1" NUMBER 2 /end CHARACTERISTIC
/begin CHARACTERISTIC FFTUFSGB "" VAL_BLK 0x8E0808 KwbUb 255.0 dez 0.00 255.0 FORMAT "%5.1" NUMBER 2 /end CHARACTERISTIC
/begin CHARACTERISTIC FFTUFSKA "" VAL_BLK 0x8E080A KwbUb 255.0 dez 0.00 255.0 FORMAT "%5.1" NUMBER 2 /end CHARACTERISTIC
/begin CHARACTERISTIC FFTUFSPSC "" VAL_BLK 0x8E080C KwbUb 255.0 dez 0.00 255.0 FORMAT "%5.1" NUMBER 2 /end CHARACTERISTIC
/begin CHARACTERISTIC FFTULSU "" VAL_BLK 0x8E080E KwbUb 255.0 dez 0.00 255.0 FORMAT "%5.1" NUMBER 2 /end CHARACTERISTIC
/begin CHARACTERISTIC FFTULSU2 "" VAL_BLK 0x8E0810 KwbUb 255.0 dez 0.00 255.0 FORMAT "%5.1" NUMBER 2 /end CHARACTERISTIC
/begin CHARACTERISTIC FFTURRAM "" VAL_BLK 0x8E0812 KwbUb 255.0 dez 0.00 255.0 FORMAT "%5.1" NUMBER 2 /end CHARACTERISTIC
/begin CHARACTERISTIC FFTURROM "" VAL_BLK 0x8E0814 KwbUb 255.0 dez 0.00 255.0 FORMAT "%5.1" NUMBER 2 /end CHARACTERISTIC
/begin CHARACTERISTIC FFTURRST "" VAL_BLK 0x8E0816 KwbUb 255.0 dez 0.00 255.0 FORMAT "%5.1" NUMBER 2 /end CHARACTERISTIC
/begin CHARACTERISTIC FFTVFZ "" VAL_BLK 0x8E0818 KwbUb 255.0 dez 0.00 255.0 FORMAT "%5.1" NUMBER 2 /end CHARACTERISTIC
/begin CHARACTERISTIC TSFCGE "" VALUE 0x8E0840 KwUb 255.0 dez 0.00 255.0 FORMAT "%5.1" /end CHARACTERISTIC
/begin CHARACTERISTIC TSFDPL "" VALUE 0x8E084B KwUb 255.0 dez 0.00 255.0 FORMAT "%5.1" /end CHARACTERISTIC
/begin CHARACTERISTIC TSFDSBKV "" VALUE 0x8E084C KwUb 255.0 dez 0.00 255.0 FORMAT "%5.1" /end CHARACTERISTIC
/begin CHARACTERISTIC TSFFRAO "" VALUE 0x8E0869 KwUb 255.0 dez 0.00 255.0 FORMAT "%5.1" /end CHARACTERISTIC
/begin CHARACTERISTIC TSFFRAO2 "" VALUE 0x8E086A KwUb 255.0 dez 0.00 255.0 FORMAT "%5.1" /end CHARACTERISTIC
/begin CHARACTERISTIC TSFFRAU "" VALUE 0x8E086B KwUb 255.0 dez 0.00 255.0 FORMAT "%5.1" /end CHARACTERISTIC
/begin CHARACTERISTIC TSFFRAU2 "" VALUE 0x8E086C KwUb 255.0 dez 0.00 255.0 FORMAT "%5.1" /end CHARACTERISTIC
/begin CHARACTERISTIC TSFFRST "" VALUE 0x8E086D KwUb 255.0 dez 0.00 255.0 FORMAT "%5.1" /end CHARACTERISTIC
/begin CHARACTERISTIC TSFFRST2 "" VALUE 0x8E086E KwUb 255.0 dez 0.00 255.0 FORMAT "%5.1" /end CHARACTERISTIC
/begin CHARACTERISTIC TSFGECOD "" VALUE 0x8E086F KwUb 255.0 dez 0.00 255.0 FORMAT "%5.1" /end CHARACTERISTIC
/begin CHARACTERISTIC TSFKAT "" VALUE 0x8E087E KwUb 255.0 dez 0.00 255.0 FORMAT "%5.1" /end CHARACTERISTIC
/begin CHARACTERISTIC TSFKAT2 "" VALUE 0x8E087F KwUb 255.0 dez 0.00 255.0 FORMAT "%5.1" /end CHARACTERISTIC
/begin CHARACTERISTIC TSFKRA01 "" VALUE 0x8E0881 KwUb 255.0 dez 0.00 255.0 FORMAT "%5.1" /end CHARACTERISTIC
/begin CHARACTERISTIC TSFKRA02 "" VALUE 0x8E0882 KwUb 255.0 dez 0.00 255.0 FORMAT "%5.1" /end CHARACTERISTIC
/begin CHARACTERISTIC TSFKRA03 "" VALUE 0x8E0883 KwUb 255.0 dez 0.00 255.0 FORMAT "%5.1" /end CHARACTERISTIC
/begin CHARACTERISTIC TSFKRA04 "" VALUE 0x8E0884 KwUb 255.0 dez 0.00 255.0 FORMAT "%5.1" /end CHARACTERISTIC
/begin CHARACTERISTIC TSFKRA05 "" VALUE 0x8E0885 KwUb 255.0 dez 0.00 255.0 FORMAT "%5.1" /end CHARACTERISTIC
/begin CHARACTERISTIC TSFKRA06 "" VALUE 0x8E0886 KwUb 255.0 dez 0.00 255.0 FORMAT "%5.1" /end CHARACTERISTIC
/begin CHARACTERISTIC TSFKRNT "" VALUE 0x8E0887 KwUb 255.0 dez 0.00 255.0 FORMAT "%5.1" /end CHARACTERISTIC
/begin CHARACTERISTIC TSFKROF "" VALUE 0x8E0888 KwUb 255.0 dez 0.00 255.0 FORMAT "%5.1" /end CHARACTERISTIC
/begin CHARACTERISTIC TSFKRTP "" VALUE 0x8E0889 KwUb 255.0 dez 0.00 255.0 FORMAT "%5.1" /end CHARACTERISTIC
/begin CHARACTERISTIC TSFKS1 "" VALUE 0x8E088A KwUb 255.0 dez 0.00 255.0 FORMAT "%5.1" /end CHARACTERISTIC
/begin CHARACTERISTIC TSFKS2 "" VALUE 0x8E088B KwUb 255.0 dez 0.00 255.0 FORMAT "%5.1" /end CHARACTERISTIC
/begin CHARACTERISTIC TSFKS3 "" VALUE 0x8E088C KwUb 255.0 dez 0.00 255.0 FORMAT "%5.1" /end CHARACTERISTIC
/begin CHARACTERISTIC TSFKS4 "" VALUE 0x8E088D KwUb 255.0 dez 0.00 255.0 FORMAT "%5.1" /end CHARACTERISTIC
/begin CHARACTERISTIC TSFKUPPL "" VALUE 0x8E088E KwUb 255.0 dez 0.00 255.0 FORMAT "%5.1" /end CHARACTERISTIC
/begin CHARACTERISTIC TSFLASH "" VALUE 0x8E088F KwUb 255.0 dez 0.00 255.0 FORMAT "%5.1" /end CHARACTERISTIC
/begin CHARACTERISTIC TSFLASH2 "" VALUE 0x8E0890 KwUb 255.0 dez 0.00 255.0 FORMAT "%5.1" /end CHARACTERISTIC
/begin CHARACTERISTIC TSFLAVH "" VALUE 0x8E0891 KwUb 255.0 dez 0.00 255.0 FORMAT "%5.1" /end CHARACTERISTIC
/begin CHARACTERISTIC TSFLAVH2 "" VALUE 0x8E0892 KwUb 255.0 dez 0.00 255.0 FORMAT "%5.1" /end CHARACTERISTIC
/begin CHARACTERISTIC TSFLLR "" VALUE 0x8E0894 KwUb 255.0 dez 0.00 255.0 FORMAT "%5.1" /end CHARACTERISTIC
/begin CHARACTERISTIC TSFLM "" VALUE 0x8E0895 KwUb 255.0 dez 0.00 255.0 FORMAT "%5.1" /end CHARACTERISTIC
/begin CHARACTERISTIC TSFLSH "" VALUE 0x8E0896 KwUb 255.0 dez 0.00 255.0 FORMAT "%5.1" /end CHARACTERISTIC
/begin CHARACTERISTIC TSFLSH2 "" VALUE 0x8E0897 KwUb 255.0 dez 0.00 255.0 FORMAT "%5.1" /end CHARACTERISTIC
/begin CHARACTERISTIC TSFLSVV "" VALUE 0x8E08A5 KwUb 255.0 dez 0.00 255.0 FORMAT "%5.1" /end CHARACTERISTIC
/begin CHARACTERISTIC TSFLUE1 "" VALUE 0x8E08A6 KwUb 255.0 DEZ 0.00 255.0 FORMAT "%5.1" /end CHARACTERISTIC
/begin CHARACTERISTIC TSFMD "" VALUE 0x8E08A9 KwUb 255.0 dez 0.00 255.0 FORMAT "%5.1" /end CHARACTERISTIC
/begin CHARACTERISTIC TSFMD00 "" VALUE 0x8E08AA KwUb 255.0 dez 0.00 255.0 FORMAT "%5.1" /end CHARACTERISTIC
/begin CHARACTERISTIC TSFMD01 "" VALUE 0x8E08AB KwUb 255.0 dez 0.00 255.0 FORMAT "%5.1" /end CHARACTERISTIC
/begin CHARACTERISTIC TSFMD02 "" VALUE 0x8E08AC KwUb 255.0 dez 0.00 255.0 FORMAT "%5.1" /end CHARACTERISTIC
/begin CHARACTERISTIC TSFMD03 "" VALUE 0x8E08AD KwUb 255.0 dez 0.00 255.0 FORMAT "%5.1" /end CHARACTERISTIC
/begin CHARACTERISTIC TSFMD04 "" VALUE 0x8E08AE KwUb 255.0 dez 0.00 255.0 FORMAT "%5.1" /end CHARACTERISTIC
/begin CHARACTERISTIC TSFMD05 "" VALUE 0x8E08AF KwUb 255.0 dez 0.00 255.0 FORMAT "%5.1" /end CHARACTERISTIC
/begin CHARACTERISTIC TSFMFA "" VALUE 0x8E08B1 KwUb 255.0 dez 0.00 255.0 FORMAT "%5.1" /end CHARACTERISTIC
/begin CHARACTERISTIC TSFNWKW "" VALUE 0x8E08B3 KwUb 255.0 dez 0.00 255.0 FORMAT "%5.1" /end CHARACTERISTIC
/begin CHARACTERISTIC TSFNWKW2 "" VALUE 0x8E08B4 KwUb 255.0 dez 0.00 255.0 FORMAT "%5.1" /end CHARACTERISTIC
/begin CHARACTERISTIC TSFNX "" VALUE 0x8E08B5 KwUb 255.0 dez 0.00 255.0 FORMAT "%5.1" /end CHARACTERISTIC
/begin CHARACTERISTIC TSFPH "" VALUE 0x8E08B6 KwUb 255.0 dez 0.00 255.0 FORMAT "%5.1" /end CHARACTERISTIC
/begin CHARACTERISTIC TSFPH2 "" VALUE 0x8E08B7 KwUb 255.0 dez 0.00 255.0 FORMAT "%5.1" /end CHARACTERISTIC
/begin CHARACTERISTIC TSFPLLSU "" VALUE 0x8E08B8 KwUb 255.0 dez 0.00 255.0 FORMAT "%5.1" /end CHARACTERISTIC
/begin CHARACTERISTIC TSFPLLSU2 "" VALUE 0x8E08B9 KwUb 255.0 dez 0.00 255.0 FORMAT "%5.1" /end CHARACTERISTIC
/begin CHARACTERISTIC TSFRKAT "" VALUE 0x8E08BB KwUb 255.0 dez 0.00 255.0 FORMAT "%5.1" /end CHARACTERISTIC
/begin CHARACTERISTIC TSFRKAT2 "" VALUE 0x8E08BC KwUb 255.0 dez 0.00 255.0 FORMAT "%5.1" /end CHARACTERISTIC
/begin CHARACTERISTIC TSFRKAZ "" VALUE 0x8E08BD KwUb 255.0 dez 0.00 255.0 FORMAT "%5.1" /end CHARACTERISTIC
/begin CHARACTERISTIC TSFRKAZ2 "" VALUE 0x8E08BE KwUb 255.0 dez 0.00 255.0 FORMAT "%5.1" /end CHARACTERISTIC
/begin CHARACTERISTIC TSFSGEEP "" VALUE 0x8E08C0 KwUb 255.0 dez 0.00 255.0 FORMAT "%5.1" /end CHARACTERISTIC
/begin CHARACTERISTIC TSFSLS "" VALUE 0x8E08C3 KwUb 255.0 dez 0.00 255.0 FORMAT "%5.1" /end CHARACTERISTIC
/begin CHARACTERISTIC TSFSLS2 "" VALUE 0x8E08C4 KwUb 255.0 dez 0.00 255.0 FORMAT "%5.1" /end CHARACTERISTIC
/begin CHARACTERISTIC TSFSLV "" VALUE 0x8E08C5 KwUb 255.0 dez 0.00 255.0 FORMAT "%5.1" /end CHARACTERISTIC
/begin CHARACTERISTIC TSFSLV2 "" VALUE 0x8E08C6 KwUb 255.0 dez 0.00 255.0 FORMAT "%5.1" /end CHARACTERISTIC
/begin CHARACTERISTIC TSFTANKL "" VALUE 0x8E08CB KwUb 255.0 dez 0.00 255.0 FORMAT "%5.1" /end CHARACTERISTIC
/begin CHARACTERISTIC TSFTES "" VALUE 0x8E08CC KwUb 255.0 dez 0.00 255.0 FORMAT "%5.1" /end CHARACTERISTIC
/begin CHARACTERISTIC TSFTESF "" VALUE 0x8E08CD KwUb 255.0 dez 0.00 255.0 FORMAT "%5.1" /end CHARACTERISTIC
/begin CHARACTERISTIC TSFTESG "" VALUE 0x8E08CE KwUb 255.0 dez 0.00 255.0 FORMAT "%5.1" /end CHARACTERISTIC
/begin CHARACTERISTIC TSFTEVE2 "" VALUE 0x8E08D0 KwUb 255.0 dez 0.00 255.0 FORMAT "%5.1" /end CHARACTERISTIC
/begin CHARACTERISTIC TSFUFMV "" VALUE 0x8E08D8 KwUb 255.0 dez 0.00 255.0 FORMAT "%5.1" /end CHARACTERISTIC
/begin CHARACTERISTIC TSFUFNC "" VALUE 0x8E08D9 KwUb 255.0 dez 0.00 255.0 FORMAT "%5.1" /end CHARACTERISTIC
/begin CHARACTERISTIC TSFUFRLIP "" VALUE 0x8E08DA KwUb 255.0 dez 0.00 255.0 FORMAT "%5.1" /end CHARACTERISTIC
/begin CHARACTERISTIC TSFUFSGA "" VALUE 0x8E08DB KwUb 255.0 dez 0.00 255.0 FORMAT "%5.1" /end CHARACTERISTIC
/begin CHARACTERISTIC TSFUFSGB "" VALUE 0x8E08DC KwUb 255.0 dez 0.00 255.0 FORMAT "%5.1" /end CHARACTERISTIC
/begin CHARACTERISTIC TSFUFSKA "" VALUE 0x8E08DD KwUb 255.0 dez 0.00 255.0 FORMAT "%5.1" /end CHARACTERISTIC
/begin CHARACTERISTIC TSFUFSPSC "" VALUE 0x8E08DE KwUb 255.0 dez 0.00 255.0 FORMAT "%5.1" /end CHARACTERISTIC
/begin CHARACTERISTIC TSFULSU "" VALUE 0x8E08DF KwUb 255.0 dez 0.00 255.0 FORMAT "%5.1" /end CHARACTERISTIC
/begin CHARACTERISTIC TSFULSU2 "" VALUE 0x8E08E0 KwUb 255.0 dez 0.00 255.0 FORMAT "%5.1" /end CHARACTERISTIC
/begin CHARACTERISTIC TSFURRAM "" VALUE 0x8E08E1 KwUb 255.0 dez 0.00 255.0 FORMAT "%5.1" /end CHARACTERISTIC
/begin CHARACTERISTIC TSFURROM "" VALUE 0x8E08E2 KwUb 255.0 dez 0.00 255.0 FORMAT "%5.1" /end CHARACTERISTIC
/begin CHARACTERISTIC TSFURRST "" VALUE 0x8E08E3 KwUb 255.0 dez 0.00 255.0 FORMAT "%5.1" /end CHARACTERISTIC
/begin CHARACTERISTIC TSFVFZ "" VALUE 0x8E08E4 KwUb 255.0 dez 0.00 255.0 FORMAT "%5.1" /end CHARACTERISTIC
/begin MEASUREMENT B_avgecod "" UWORD B_TRUE 1 100 0.00 1.00000000000 BIT_MASK 0x1000 FORMAT "%13.11" ECU_ADDRESS 0x382DB2 /end MEASUREMENT
/begin MEASUREMENT B_avtes "" UWORD B_TRUE 1 100 0.00 1.00000000000 BIT_MASK 0x1000 FORMAT "%13.11" ECU_ADDRESS 0x382E6C /end MEASUREMENT
/begin MEASUREMENT B_becge "" UWORD B_TRUE 1 100 0.00 1.00000000000 BIT_MASK 0x20 FORMAT "%13.11" ECU_ADDRESS 0x382D54 /end MEASUREMENT
/begin MEASUREMENT B_bedpl "" UWORD B_TRUE 1 100 0.00 1.00000000000 BIT_MASK 0x20 FORMAT "%13.11" ECU_ADDRESS 0x382D6A /end MEASUREMENT
/begin MEASUREMENT B_bedsbkv "" UWORD B_TRUE 1 100 0.00 1.00000000000 BIT_MASK 0x20 FORMAT "%13.11" ECU_ADDRESS 0x382D6C /end MEASUREMENT
/begin MEASUREMENT B_befrao "" UWORD B_TRUE 1 100 0.00 1.00000000000 BIT_MASK 0x20 FORMAT "%13.11" ECU_ADDRESS 0x382DA6 /end MEASUREMENT
/begin MEASUREMENT B_befrao2 "" UWORD B_TRUE 1 100 0.00 1.00000000000 BIT_MASK 0x20 FORMAT "%13.11" ECU_ADDRESS 0x382DA8 /end MEASUREMENT
/begin MEASUREMENT B_befrau "" UWORD B_TRUE 1 100 0.00 1.00000000000 BIT_MASK 0x20 FORMAT "%13.11" ECU_ADDRESS 0x382DAA /end MEASUREMENT
/begin MEASUREMENT B_befrau2 "" UWORD B_TRUE 1 100 0.00 1.00000000000 BIT_MASK 0x20 FORMAT "%13.11" ECU_ADDRESS 0x382DAC /end MEASUREMENT
/begin MEASUREMENT B_befrst "" UWORD B_TRUE 1 100 0.00 1.00000000000 BIT_MASK 0x20 FORMAT "%13.11" ECU_ADDRESS 0x382DAE /end MEASUREMENT
/begin MEASUREMENT B_befrst2 "" UWORD B_TRUE 1 100 0.00 1.00000000000 BIT_MASK 0x20 FORMAT "%13.11" ECU_ADDRESS 0x382DB0 /end MEASUREMENT
/begin MEASUREMENT B_begecod "" UWORD B_TRUE 1 100 0.00 1.00000000000 BIT_MASK 0x20 FORMAT "%13.11" ECU_ADDRESS 0x382DB2 /end MEASUREMENT
/begin MEASUREMENT B_bekat "" UWORD B_TRUE 1 100 0.00 1.00000000000 BIT_MASK 0x20 FORMAT "%13.11" ECU_ADDRESS 0x382DD0 /end MEASUREMENT
/begin MEASUREMENT B_bekat2 "" UWORD B_TRUE 1 100 0.00 1.00000000000 BIT_MASK 0x20 FORMAT "%13.11" ECU_ADDRESS 0x382DD2 /end MEASUREMENT
/begin MEASUREMENT B_bekrnt "" UWORD B_TRUE 1 100 0.00 1.00000000000 BIT_MASK 0x20 FORMAT "%13.11" ECU_ADDRESS 0x382DE2 /end MEASUREMENT
/begin MEASUREMENT B_bekrof "" UWORD B_TRUE 1 100 0.00 1.00000000000 BIT_MASK 0x20 FORMAT "%13.11" ECU_ADDRESS 0x382DE4 /end MEASUREMENT
/begin MEASUREMENT B_bekrtp "" UWORD B_TRUE 1 100 0.00 1.00000000000 BIT_MASK 0x20 FORMAT "%13.11" ECU_ADDRESS 0x382DE6 /end MEASUREMENT
/begin MEASUREMENT B_beks1 "" UWORD B_TRUE 1 100 0.00 1.00000000000 BIT_MASK 0x20 FORMAT "%13.11" ECU_ADDRESS 0x382DE8 /end MEASUREMENT
/begin MEASUREMENT B_beks2 "" UWORD B_TRUE 1 100 0.00 1.00000000000 BIT_MASK 0x20 FORMAT "%13.11" ECU_ADDRESS 0x382DEA /end MEASUREMENT
/begin MEASUREMENT B_beks3 "" UWORD B_TRUE 1 100 0.00 1.00000000000 BIT_MASK 0x20 FORMAT "%13.11" ECU_ADDRESS 0x382DEC /end MEASUREMENT
/begin MEASUREMENT B_beks4 "" UWORD B_TRUE 1 100 0.00 1.00000000000 BIT_MASK 0x20 FORMAT "%13.11" ECU_ADDRESS 0x382DEE /end MEASUREMENT
/begin MEASUREMENT B_bekuppl "" UWORD B_TRUE 1 100 0.00 1.00000000000 BIT_MASK 0x20 FORMAT "%13.11" ECU_ADDRESS 0x382DF0 /end MEASUREMENT
/begin MEASUREMENT B_belash "" UWORD B_TRUE 1 100 0.00 1.00000000000 BIT_MASK 0x20 FORMAT "%13.11" ECU_ADDRESS 0x382DF2 /end MEASUREMENT
/begin MEASUREMENT B_belash2 "" UWORD B_TRUE 1 100 0.00 1.00000000000 BIT_MASK 0x20 FORMAT "%13.11" ECU_ADDRESS 0x382DF4 /end MEASUREMENT
/begin MEASUREMENT B_belavh "" UWORD B_TRUE 1 100 0.00 1.00000000000 BIT_MASK 0x20 FORMAT "%13.11" ECU_ADDRESS 0x382DF6 /end MEASUREMENT
/begin MEASUREMENT B_belavh2 "" UWORD B_TRUE 1 100 0.00 1.00000000000 BIT_MASK 0x20 FORMAT "%13.11" ECU_ADDRESS 0x382DF8 /end MEASUREMENT
/begin MEASUREMENT B_bellr "" UWORD B_TRUE 1 100 0.00 1.00000000000 BIT_MASK 0x20 FORMAT "%13.11" ECU_ADDRESS 0x382DFC /end MEASUREMENT
/begin MEASUREMENT B_belm "" UWORD B_TRUE 1 100 0.00 1.00000000000 BIT_MASK 0x20 FORMAT "%13.11" ECU_ADDRESS 0x382DFE /end MEASUREMENT
/begin MEASUREMENT B_belsh "" UWORD B_TRUE 1 100 0.00 1.00000000000 BIT_MASK 0x20 FORMAT "%13.11" ECU_ADDRESS 0x382E00 /end MEASUREMENT
/begin MEASUREMENT B_belsh2 "" UWORD B_TRUE 1 100 0.00 1.00000000000 BIT_MASK 0x20 FORMAT "%13.11" ECU_ADDRESS 0x382E02 /end MEASUREMENT
/begin MEASUREMENT B_belsvv "" UWORD B_TRUE 1 100 0.00 1.00000000000 BIT_MASK 0x20 FORMAT "%13.11" ECU_ADDRESS 0x382E1E /end MEASUREMENT
/begin MEASUREMENT B_belue1 "" UWORD B_TRUE 1 100 0.00 1.00000000000 BIT_MASK 0x20 FORMAT "%13.11" ECU_ADDRESS 0x382E20 /end MEASUREMENT
/begin MEASUREMENT B_bemd "" UWORD B_TRUE 1 100 0.00 1.00000000000 BIT_MASK 0x20 FORMAT "%13.11" ECU_ADDRESS 0x382E26 /end MEASUREMENT
/begin MEASUREMENT B_bemd00 "" UWORD B_TRUE 1 100 0.00 1.00000000000 BIT_MASK 0x20 FORMAT "%13.11" ECU_ADDRESS 0x382E28 /end MEASUREMENT
/begin MEASUREMENT B_bemd01 "" UWORD B_TRUE 1 100 0.00 1.00000000000 BIT_MASK 0x20 FORMAT "%13.11" ECU_ADDRESS 0x382E2A /end MEASUREMENT
/begin MEASUREMENT B_bemd02 "" UWORD B_TRUE 1 100 0.00 1.00000000000 BIT_MASK 0x20 FORMAT "%13.11" ECU_ADDRESS 0x382E2C /end MEASUREMENT
/begin MEASUREMENT B_bemd03 "" UWORD B_TRUE 1 100 0.00 1.00000000000 BIT_MASK 0x20 FORMAT "%13.11" ECU_ADDRESS 0x382E2E /end MEASUREMENT
/begin MEASUREMENT B_bemd04 "" UWORD B_TRUE 1 100 0.00 1.00000000000 BIT_MASK 0x20 FORMAT "%13.11" ECU_ADDRESS 0x382E30 /end MEASUREMENT
/begin MEASUREMENT B_bemd05 "" UWORD B_TRUE 1 100 0.00 1.00000000000 BIT_MASK 0x20 FORMAT "%13.11" ECU_ADDRESS 0x382E32 /end MEASUREMENT
/begin MEASUREMENT B_bemfa "" UWORD B_TRUE 1 100 0.00 1.00000000000 BIT_MASK 0x20 FORMAT "%13.11" ECU_ADDRESS 0x382E36 /end MEASUREMENT
/begin MEASUREMENT B_benwkw "" UWORD B_TRUE 1 100 0.00 1.00000000000 BIT_MASK 0x20 FORMAT "%13.11" ECU_ADDRESS 0x382E3A /end MEASUREMENT
/begin MEASUREMENT B_benwkw2 "" UWORD B_TRUE 1 100 0.00 1.00000000000 BIT_MASK 0x20 FORMAT "%13.11" ECU_ADDRESS 0x382E3C /end MEASUREMENT
/begin MEASUREMENT B_benx "" UWORD B_TRUE 1 100 0.00 1.00000000000 BIT_MASK 0x20 FORMAT "%13.11" ECU_ADDRESS 0x382E3E /end MEASUREMENT
/begin MEASUREMENT B_beph "" UWORD B_TRUE 1 100 0.00 1.00000000000 BIT_MASK 0x20 FORMAT "%13.11" ECU_ADDRESS 0x382E40 /end MEASUREMENT
/begin MEASUREMENT B_beph2 "" UWORD B_TRUE 1 100 0.00 1.00000000000 BIT_MASK 0x20 FORMAT "%13.11" ECU_ADDRESS 0x382E42 /end MEASUREMENT
/begin MEASUREMENT B_bepllsu "" UWORD B_TRUE 1 100 0.00 1.00000000000 BIT_MASK 0x20 FORMAT "%13.11" ECU_ADDRESS 0x382E44 /end MEASUREMENT
/begin MEASUREMENT B_bepllsu2 "" UWORD B_TRUE 1 100 0.00 1.00000000000 BIT_MASK 0x20 FORMAT "%13.11" ECU_ADDRESS 0x382E46 /end MEASUREMENT
/begin MEASUREMENT B_berkat "" UWORD B_TRUE 1 100 0.00 1.00000000000 BIT_MASK 0x20 FORMAT "%13.11" ECU_ADDRESS 0x382E4A /end MEASUREMENT
/begin MEASUREMENT B_berkat2 "" UWORD B_TRUE 1 100 0.00 1.00000000000 BIT_MASK 0x20 FORMAT "%13.11" ECU_ADDRESS 0x382E4C /end MEASUREMENT
/begin MEASUREMENT B_berkaz "" UWORD B_TRUE 1 100 0.00 1.00000000000 BIT_MASK 0x20 FORMAT "%13.11" ECU_ADDRESS 0x382E4E /end MEASUREMENT
/begin MEASUREMENT B_berkaz2 "" UWORD B_TRUE 1 100 0.00 1.00000000000 BIT_MASK 0x20 FORMAT "%13.11" ECU_ADDRESS 0x382E50 /end MEASUREMENT
/begin MEASUREMENT B_besgeep "" UWORD B_TRUE 1 100 0.00 1.00000000000 BIT_MASK 0x20 FORMAT "%13.11" ECU_ADDRESS 0x382E54 /end MEASUREMENT
/begin MEASUREMENT B_besls "" UWORD B_TRUE 1 100 0.00 1.00000000000 BIT_MASK 0x20 FORMAT "%13.11" ECU_ADDRESS 0x382E5A /end MEASUREMENT
/begin MEASUREMENT B_besls2 "" UWORD B_TRUE 1 100 0.00 1.00000000000 BIT_MASK 0x20 FORMAT "%13.11" ECU_ADDRESS 0x382E5C /end MEASUREMENT
/begin MEASUREMENT B_beslv "" UWORD B_TRUE 1 100 0.00 1.00000000000 BIT_MASK 0x20 FORMAT "%13.11" ECU_ADDRESS 0x382E5E /end MEASUREMENT
/begin MEASUREMENT B_beslv2 "" UWORD B_TRUE 1 100 0.00 1.00000000000 BIT_MASK 0x20 FORMAT "%13.11" ECU_ADDRESS 0x382E60 /end MEASUREMENT
/begin MEASUREMENT B_betankl "" UWORD B_TRUE 1 100 0.00 1.00000000000 BIT_MASK 0x20 FORMAT "%13.11" ECU_ADDRESS 0x382E6A /end MEASUREMENT
/begin MEASUREMENT B_betes "" UWORD B_TRUE 1 100 0.00 1.00000000000 BIT_MASK 0x20 FORMAT "%13.11" ECU_ADDRESS 0x382E6C /end MEASUREMENT
/begin MEASUREMENT B_betesf "" UWORD B_TRUE 1 100 0.00 1.00000000000 BIT_MASK 0x20 FORMAT "%13.11" ECU_ADDRESS 0x382E6E /end MEASUREMENT
/begin MEASUREMENT B_betesg "" UWORD B_TRUE 1 100 0.00 1.00000000000 BIT_MASK 0x20 FORMAT "%13.11" ECU_ADDRESS 0x382E70 /end MEASUREMENT
/begin MEASUREMENT B_beufmv "" UWORD B_TRUE 1 100 0.00 1.00000000000 BIT_MASK 0x20 FORMAT "%13.11" ECU_ADDRESS 0x382E84 /end MEASUREMENT
/begin MEASUREMENT B_beufnc "" UWORD B_TRUE 1 100 0.00 1.00000000000 BIT_MASK 0x20 FORMAT "%13.11" ECU_ADDRESS 0x382E86 /end MEASUREMENT
/begin MEASUREMENT B_beufrlip "" UWORD B_TRUE 1 100 0.00 1.00000000000 BIT_MASK 0x20 FORMAT "%13.11" ECU_ADDRESS 0x382E88 /end MEASUREMENT
/begin MEASUREMENT B_beufsga "" UWORD B_TRUE 1 100 0.00 1.00000000000 BIT_MASK 0x20 FORMAT "%13.11" ECU_ADDRESS 0x382E8A /end MEASUREMENT
/begin MEASUREMENT B_beufsgb "" UWORD B_TRUE 1 100 0.00 1.00000000000 BIT_MASK 0x20 FORMAT "%13.11" ECU_ADDRESS 0x382E8C /end MEASUREMENT
/begin MEASUREMENT B_beufska "" UWORD B_TRUE 1 100 0.00 1.00000000000 BIT_MASK 0x20 FORMAT "%13.11" ECU_ADDRESS 0x382E8E /end MEASUREMENT
/begin MEASUREMENT B_beufspsc "" UWORD B_TRUE 1 100 0.00 1.00000000000 BIT_MASK 0x20 FORMAT "%13.11" ECU_ADDRESS 0x382E90 /end MEASUREMENT
/begin MEASUREMENT B_beulsu "" UWORD B_TRUE 1 100 0.00 1.00000000000 BIT_MASK 0x20 FORMAT "%13.11" ECU_ADDRESS 0x382E92 /end MEASUREMENT
/begin MEASUREMENT B_beulsu2 "" UWORD B_TRUE 1 100 0.00 1.00000000000 BIT_MASK 0x20 FORMAT "%13.11" ECU_ADDRESS 0x382E94 /end MEASUREMENT
/begin MEASUREMENT B_beurram "" UWORD B_TRUE 1 100 0.00 1.00000000000 BIT_MASK 0x20 FORMAT "%13.11" ECU_ADDRESS 0x382E96 /end MEASUREMENT
/begin MEASUREMENT B_beurrom "" UWORD B_TRUE 1 100 0.00 1.00000000000 BIT_MASK 0x20 FORMAT "%13.11" ECU_ADDRESS 0x382E98 /end MEASUREMENT
/begin MEASUREMENT B_beurrst "" UWORD B_TRUE 1 100 0.00 1.00000000000 BIT_MASK 0x20 FORMAT "%13.11" ECU_ADDRESS 0x382E9A /end MEASUREMENT
/begin MEASUREMENT B_bevfz "" UWORD B_TRUE 1 100 0.00 1.00000000000 BIT_MASK 0x20 FORMAT "%13.11" ECU_ADDRESS 0x382E9C /end MEASUREMENT
/begin MEASUREMENT B_bkcge "" UWORD B_TRUE 1 100 0.00 1.00000000000 BIT_MASK 0x40 FORMAT "%13.11" ECU_ADDRESS 0x382D54 /end MEASUREMENT
/begin MEASUREMENT B_bkdpl "" UWORD B_TRUE 1 100 0.00 1.00000000000 BIT_MASK 0x40 FORMAT "%13.11" ECU_ADDRESS 0x382D6A /end MEASUREMENT
/begin MEASUREMENT B_bkdsbkv "" UWORD B_TRUE 1 100 0.00 1.00000000000 BIT_MASK 0x40 FORMAT "%13.11" ECU_ADDRESS 0x382D6C /end MEASUREMENT
/begin MEASUREMENT B_bkfrao "" UWORD B_TRUE 1 100 0.00 1.00000000000 BIT_MASK 0x40 FORMAT "%13.11" ECU_ADDRESS 0x382DA6 /end MEASUREMENT
/begin MEASUREMENT B_bkfrao2 "" UWORD B_TRUE 1 100 0.00 1.00000000000 BIT_MASK 0x40 FORMAT "%13.11" ECU_ADDRESS 0x382DA8 /end MEASUREMENT
/begin MEASUREMENT B_bkfrau "" UWORD B_TRUE 1 100 0.00 1.00000000000 BIT_MASK 0x40 FORMAT "%13.11" ECU_ADDRESS 0x382DAA /end MEASUREMENT
/begin MEASUREMENT B_bkfrau2 "" UWORD B_TRUE 1 100 0.00 1.00000000000 BIT_MASK 0x40 FORMAT "%13.11" ECU_ADDRESS 0x382DAC /end MEASUREMENT
/begin MEASUREMENT B_bkfrst "" UWORD B_TRUE 1 100 0.00 1.00000000000 BIT_MASK 0x40 FORMAT "%13.11" ECU_ADDRESS 0x382DAE /end MEASUREMENT
/begin MEASUREMENT B_bkfrst2 "" UWORD B_TRUE 1 100 0.00 1.00000000000 BIT_MASK 0x40 FORMAT "%13.11" ECU_ADDRESS 0x382DB0 /end MEASUREMENT
/begin MEASUREMENT B_bkgecod "" UWORD B_TRUE 1 100 0.00 1.00000000000 BIT_MASK 0x40 FORMAT "%13.11" ECU_ADDRESS 0x382DB2 /end MEASUREMENT
/begin MEASUREMENT B_bkkat "" UWORD B_TRUE 1 100 0.00 1.00000000000 BIT_MASK 0x40 FORMAT "%13.11" ECU_ADDRESS 0x382DD0 /end MEASUREMENT
/begin MEASUREMENT B_bkkat2 "" UWORD B_TRUE 1 100 0.00 1.00000000000 BIT_MASK 0x40 FORMAT "%13.11" ECU_ADDRESS 0x382DD2 /end MEASUREMENT
/begin MEASUREMENT B_bkkrnt "" UWORD B_TRUE 1 100 0.00 1.00000000000 BIT_MASK 0x40 FORMAT "%13.11" ECU_ADDRESS 0x382DE2 /end MEASUREMENT
/begin MEASUREMENT B_bkkrof "" UWORD B_TRUE 1 100 0.00 1.00000000000 BIT_MASK 0x40 FORMAT "%13.11" ECU_ADDRESS 0x382DE4 /end MEASUREMENT
/begin MEASUREMENT B_bkkrtp "" UWORD B_TRUE 1 100 0.00 1.00000000000 BIT_MASK 0x40 FORMAT "%13.11" ECU_ADDRESS 0x382DE6 /end MEASUREMENT
/begin MEASUREMENT B_bkks1 "" UWORD B_TRUE 1 100 0.00 1.00000000000 BIT_MASK 0x40 FORMAT "%13.11" ECU_ADDRESS 0x382DE8 /end MEASUREMENT
/begin MEASUREMENT B_bkks2 "" UWORD B_TRUE 1 100 0.00 1.00000000000 BIT_MASK 0x40 FORMAT "%13.11" ECU_ADDRESS 0x382DEA /end MEASUREMENT
/begin MEASUREMENT B_bkks3 "" UWORD B_TRUE 1 100 0.00 1.00000000000 BIT_MASK 0x40 FORMAT "%13.11" ECU_ADDRESS 0x382DEC /end MEASUREMENT
/begin MEASUREMENT B_bkks4 "" UWORD B_TRUE 1 100 0.00 1.00000000000 BIT_MASK 0x40 FORMAT "%13.11" ECU_ADDRESS 0x382DEE /end MEASUREMENT
/begin MEASUREMENT B_bkkuppl "" UWORD B_TRUE 1 100 0.00 1.00000000000 BIT_MASK 0x40 FORMAT "%13.11" ECU_ADDRESS 0x382DF0 /end MEASUREMENT
/begin MEASUREMENT B_bklash "" UWORD B_TRUE 1 100 0.00 1.00000000000 BIT_MASK 0x40 FORMAT "%13.11" ECU_ADDRESS 0x382DF2 /end MEASUREMENT
/begin MEASUREMENT B_bklash2 "" UWORD B_TRUE 1 100 0.00 1.00000000000 BIT_MASK 0x40 FORMAT "%13.11" ECU_ADDRESS 0x382DF4 /end MEASUREMENT
/begin MEASUREMENT B_bklavh "" UWORD B_TRUE 1 100 0.00 1.00000000000 BIT_MASK 0x40 FORMAT "%13.11" ECU_ADDRESS 0x382DF6 /end MEASUREMENT
/begin MEASUREMENT B_bklavh2 "" UWORD B_TRUE 1 100 0.00 1.00000000000 BIT_MASK 0x40 FORMAT "%13.11" ECU_ADDRESS 0x382DF8 /end MEASUREMENT
/begin MEASUREMENT B_bkllr "" UWORD B_TRUE 1 100 0.00 1.00000000000 BIT_MASK 0x40 FORMAT "%13.11" ECU_ADDRESS 0x382DFC /end MEASUREMENT
/begin MEASUREMENT B_bklm "" UWORD B_TRUE 1 100 0.00 1.00000000000 BIT_MASK 0x40 FORMAT "%13.11" ECU_ADDRESS 0x382DFE /end MEASUREMENT
/begin MEASUREMENT B_bklsh "" UWORD B_TRUE 1 100 0.00 1.00000000000 BIT_MASK 0x40 FORMAT "%13.11" ECU_ADDRESS 0x382E00 /end MEASUREMENT
/begin MEASUREMENT B_bklsh2 "" UWORD B_TRUE 1 100 0.00 1.00000000000 BIT_MASK 0x40 FORMAT "%13.11" ECU_ADDRESS 0x382E02 /end MEASUREMENT
/begin MEASUREMENT B_bklsvv "" UWORD B_TRUE 1 100 0.00 1.00000000000 BIT_MASK 0x40 FORMAT "%13.11" ECU_ADDRESS 0x382E1E /end MEASUREMENT
/begin MEASUREMENT B_bklue1 "" UWORD B_TRUE 1 100 0.00 1.00000000000 BIT_MASK 0x40 FORMAT "%13.11" ECU_ADDRESS 0x382E20 /end MEASUREMENT
/begin MEASUREMENT B_bkmd "" UWORD B_TRUE 1 100 0.00 1.00000000000 BIT_MASK 0x40 FORMAT "%13.11" ECU_ADDRESS 0x382E26 /end MEASUREMENT
/begin MEASUREMENT B_bkmd00 "" UWORD B_TRUE 1 100 0.00 1.00000000000 BIT_MASK 0x40 FORMAT "%13.11" ECU_ADDRESS 0x382E28 /end MEASUREMENT
/begin MEASUREMENT B_bkmd01 "" UWORD B_TRUE 1 100 0.00 1.00000000000 BIT_MASK 0x40 FORMAT "%13.11" ECU_ADDRESS 0x382E2A /end MEASUREMENT
/begin MEASUREMENT B_bkmd02 "" UWORD B_TRUE 1 100 0.00 1.00000000000 BIT_MASK 0x40 FORMAT "%13.11" ECU_ADDRESS 0x382E2C /end MEASUREMENT
/begin MEASUREMENT B_bkmd03 "" UWORD B_TRUE 1 100 0.00 1.00000000000 BIT_MASK 0x40 FORMAT "%13.11" ECU_ADDRESS 0x382E2E /end MEASUREMENT
/begin MEASUREMENT B_bkmd04 "" UWORD B_TRUE 1 100 0.00 1.00000000000 BIT_MASK 0x40 FORMAT "%13.11" ECU_ADDRESS 0x382E30 /end MEASUREMENT
/begin MEASUREMENT B_bkmd05 "" UWORD B_TRUE 1 100 0.00 1.00000000000 BIT_MASK 0x40 FORMAT "%13.11" ECU_ADDRESS 0x382E32 /end MEASUREMENT
/begin MEASUREMENT B_bkmfa "" UWORD B_TRUE 1 100 0.00 1.00000000000 BIT_MASK 0x40 FORMAT "%13.11" ECU_ADDRESS 0x382E36 /end MEASUREMENT
/begin MEASUREMENT B_bknwkw "" UWORD B_TRUE 1 100 0.00 1.00000000000 BIT_MASK 0x40 FORMAT "%13.11" ECU_ADDRESS 0x382E3A /end MEASUREMENT
/begin MEASUREMENT B_bknwkw2 "" UWORD B_TRUE 1 100 0.00 1.00000000000 BIT_MASK 0x40 FORMAT "%13.11" ECU_ADDRESS 0x382E3C /end MEASUREMENT
/begin MEASUREMENT B_bknx "" UWORD B_TRUE 1 100 0.00 1.00000000000 BIT_MASK 0x40 FORMAT "%13.11" ECU_ADDRESS 0x382E3E /end MEASUREMENT
/begin MEASUREMENT B_bkph "" UWORD B_TRUE 1 100 0.00 1.00000000000 BIT_MASK 0x40 FORMAT "%13.11" ECU_ADDRESS 0x382E40 /end MEASUREMENT
/begin MEASUREMENT B_bkph2 "" UWORD B_TRUE 1 100 0.00 1.00000000000 BIT_MASK 0x40 FORMAT "%13.11" ECU_ADDRESS 0x382E42 /end MEASUREMENT
/begin MEASUREMENT B_bkpllsu "" UWORD B_TRUE 1 100 0.00 1.00000000000 BIT_MASK 0x40 FORMAT "%13.11" ECU_ADDRESS 0x382E44 /end MEASUREMENT
/begin MEASUREMENT B_bkpllsu2 "" UWORD B_TRUE 1 100 0.00 1.00000000000 BIT_MASK 0x40 FORMAT "%13.11" ECU_ADDRESS 0x382E46 /end MEASUREMENT
/begin MEASUREMENT B_bkrkat "" UWORD B_TRUE 1 100 0.00 1.00000000000 BIT_MASK 0x40 FORMAT "%13.11" ECU_ADDRESS 0x382E4A /end MEASUREMENT
/begin MEASUREMENT B_bkrkat2 "" UWORD B_TRUE 1 100 0.00 1.00000000000 BIT_MASK 0x40 FORMAT "%13.11" ECU_ADDRESS 0x382E4C /end MEASUREMENT
/begin MEASUREMENT B_bkrkaz "" UWORD B_TRUE 1 100 0.00 1.00000000000 BIT_MASK 0x40 FORMAT "%13.11" ECU_ADDRESS 0x382E4E /end MEASUREMENT
/begin MEASUREMENT B_bkrkaz2 "" UWORD B_TRUE 1 100 0.00 1.00000000000 BIT_MASK 0x40 FORMAT "%13.11" ECU_ADDRESS 0x382E50 /end MEASUREMENT
/begin MEASUREMENT B_bksgeep "" UWORD B_TRUE 1 100 0.00 1.00000000000 BIT_MASK 0x40 FORMAT "%13.11" ECU_ADDRESS 0x382E54 /end MEASUREMENT
/begin MEASUREMENT B_bksls "" UWORD B_TRUE 1 100 0.00 1.00000000000 BIT_MASK 0x40 FORMAT "%13.11" ECU_ADDRESS 0x382E5A /end MEASUREMENT
/begin MEASUREMENT B_bksls2 "" UWORD B_TRUE 1 100 0.00 1.00000000000 BIT_MASK 0x40 FORMAT "%13.11" ECU_ADDRESS 0x382E5C /end MEASUREMENT
/begin MEASUREMENT B_bkslv "" UWORD B_TRUE 1 100 0.00 1.00000000000 BIT_MASK 0x40 FORMAT "%13.11" ECU_ADDRESS 0x382E5E /end MEASUREMENT
/begin MEASUREMENT B_bkslv2 "" UWORD B_TRUE 1 100 0.00 1.00000000000 BIT_MASK 0x40 FORMAT "%13.11" ECU_ADDRESS 0x382E60 /end MEASUREMENT
/begin MEASUREMENT B_bktankl "" UWORD B_TRUE 1 100 0.00 1.00000000000 BIT_MASK 0x40 FORMAT "%13.11" ECU_ADDRESS 0x382E6A /end MEASUREMENT
/begin MEASUREMENT B_bktes "" UWORD B_TRUE 1 100 0.00 1.00000000000 BIT_MASK 0x40 FORMAT "%13.11" ECU_ADDRESS 0x382E6C /end MEASUREMENT
/begin MEASUREMENT B_bktesf "" UWORD B_TRUE 1 100 0.00 1.00000000000 BIT_MASK 0x40 FORMAT "%13.11" ECU_ADDRESS 0x382E6E /end MEASUREMENT
/begin MEASUREMENT B_bktesg "" UWORD B_TRUE 1 100 0.00 1.00000000000 BIT_MASK 0x40 FORMAT "%13.11" ECU_ADDRESS 0x382E70 /end MEASUREMENT
/begin MEASUREMENT B_bkufmv "" UWORD B_TRUE 1 100 0.00 1.00000000000 BIT_MASK 0x40 FORMAT "%13.11" ECU_ADDRESS 0x382E84 /end MEASUREMENT
/begin MEASUREMENT B_bkufnc "" UWORD B_TRUE 1 100 0.00 1.00000000000 BIT_MASK 0x40 FORMAT "%13.11" ECU_ADDRESS 0x382E86 /end MEASUREMENT
/begin MEASUREMENT B_bkufrlip "" UWORD B_TRUE 1 100 0.00 1.00000000000 BIT_MASK 0x40 FORMAT "%13.11" ECU_ADDRESS 0x382E88 /end MEASUREMENT
/begin MEASUREMENT B_bkufsga "" UWORD B_TRUE 1 100 0.00 1.00000000000 BIT_MASK 0x40 FORMAT "%13.11" ECU_ADDRESS 0x382E8A /end MEASUREMENT
/begin MEASUREMENT B_bkufsgb "" UWORD B_TRUE 1 100 0.00 1.00000000000 BIT_MASK 0x40 FORMAT "%13.11" ECU_ADDRESS 0x382E8C /end MEASUREMENT
/begin MEASUREMENT B_bkufska "" UWORD B_TRUE 1 100 0.00 1.00000000000 BIT_MASK 0x40 FORMAT "%13.11" ECU_ADDRESS 0x382E8E /end MEASUREMENT
/begin MEASUREMENT B_bkufspsc "" UWORD B_TRUE 1 100 0.00 1.00000000000 BIT_MASK 0x40 FORMAT "%13.11" ECU_ADDRESS 0x382E90 /end MEASUREMENT
/begin MEASUREMENT B_bkulsu "" UWORD B_TRUE 1 100 0.00 1.00000000000 BIT_MASK 0x40 FORMAT "%13.11" ECU_ADDRESS 0x382E92 /end MEASUREMENT
/begin MEASUREMENT B_bkulsu2 "" UWORD B_TRUE 1 100 0.00 1.00000000000 BIT_MASK 0x40 FORMAT "%13.11" ECU_ADDRESS 0x382E94 /end MEASUREMENT
/begin MEASUREMENT B_bkurram "" UWORD B_TRUE 1 100 0.00 1.00000000000 BIT_MASK 0x40 FORMAT "%13.11" ECU_ADDRESS 0x382E96 /end MEASUREMENT
/begin MEASUREMENT B_bkurrom "" UWORD B_TRUE 1 100 0.00 1.00000000000 BIT_MASK 0x40 FORMAT "%13.11" ECU_ADDRESS 0x382E98 /end MEASUREMENT
/begin MEASUREMENT B_bkurrst "" UWORD B_TRUE 1 100 0.00 1.00000000000 BIT_MASK 0x40 FORMAT "%13.11" ECU_ADDRESS 0x382E9A /end MEASUREMENT
/begin MEASUREMENT B_bkvfz "" UWORD B_TRUE 1 100 0.00 1.00000000000 BIT_MASK 0x40 FORMAT "%13.11" ECU_ADDRESS 0x382E9C /end MEASUREMENT
/begin MEASUREMENT B_clcge "" UWORD B_TRUE 1 100 0.00 1.00000000000 BIT_MASK 0x80 FORMAT "%13.11" ECU_ADDRESS 0x382D54 /end MEASUREMENT
/begin MEASUREMENT B_cldpl "" UWORD B_TRUE 1 100 0.00 1.00000000000 BIT_MASK 0x80 FORMAT "%13.11" ECU_ADDRESS 0x382D6A /end MEASUREMENT
/begin MEASUREMENT B_cldsbkv "" UWORD B_TRUE 1 100 0.00 1.00000000000 BIT_MASK 0x80 FORMAT "%13.11" ECU_ADDRESS 0x382D6C /end MEASUREMENT
/begin MEASUREMENT B_clfrao "" UWORD B_TRUE 1 100 0.00 1.00000000000 BIT_MASK 0x80 FORMAT "%13.11" ECU_ADDRESS 0x382DA6 /end MEASUREMENT
/begin MEASUREMENT B_clfrao2 "" UWORD B_TRUE 1 100 0.00 1.00000000000 BIT_MASK 0x80 FORMAT "%13.11" ECU_ADDRESS 0x382DA8 /end MEASUREMENT
/begin MEASUREMENT B_clfrau "" UWORD B_TRUE 1 100 0.00 1.00000000000 BIT_MASK 0x80 FORMAT "%13.11" ECU_ADDRESS 0x382DAA /end MEASUREMENT
/begin MEASUREMENT B_clfrau2 "" UWORD B_TRUE 1 100 0.00 1.00000000000 BIT_MASK 0x80 FORMAT "%13.11" ECU_ADDRESS 0x382DAC /end MEASUREMENT
/begin MEASUREMENT B_clfrst "" UWORD B_TRUE 1 100 0.00 1.00000000000 BIT_MASK 0x80 FORMAT "%13.11" ECU_ADDRESS 0x382DAE /end MEASUREMENT
/begin MEASUREMENT B_clfrst2 "" UWORD B_TRUE 1 100 0.00 1.00000000000 BIT_MASK 0x80 FORMAT "%13.11" ECU_ADDRESS 0x382DB0 /end MEASUREMENT
/begin MEASUREMENT B_clgecod "" UWORD B_TRUE 1 100 0.00 1.00000000000 BIT_MASK 0x80 FORMAT "%13.11" ECU_ADDRESS 0x382DB2 /end MEASUREMENT
/begin MEASUREMENT B_clkat "" UWORD B_TRUE 1 100 0.00 1.00000000000 BIT_MASK 0x80 FORMAT "%13.11" ECU_ADDRESS 0x382DD0 /end MEASUREMENT
/begin MEASUREMENT B_clkat2 "" UWORD B_TRUE 1 100 0.00 1.00000000000 BIT_MASK 0x80 FORMAT "%13.11" ECU_ADDRESS 0x382DD2 /end MEASUREMENT
/begin MEASUREMENT B_clkra01 "" UWORD B_TRUE 1 100 0.00 1.00000000000 BIT_MASK 0x80 FORMAT "%13.11" ECU_ADDRESS 0x382DD6 /end MEASUREMENT
/begin MEASUREMENT B_clkra02 "" UWORD B_TRUE 1 100 0.00 1.00000000000 BIT_MASK 0x80 FORMAT "%13.11" ECU_ADDRESS 0x382DD8 /end MEASUREMENT
/begin MEASUREMENT B_clkra03 "" UWORD B_TRUE 1 100 0.00 1.00000000000 BIT_MASK 0x80 FORMAT "%13.11" ECU_ADDRESS 0x382DDA /end MEASUREMENT
/begin MEASUREMENT B_clkra04 "" UWORD B_TRUE 1 100 0.00 1.00000000000 BIT_MASK 0x80 FORMAT "%13.11" ECU_ADDRESS 0x382DDC /end MEASUREMENT
/begin MEASUREMENT B_clkra05 "" UWORD B_TRUE 1 100 0.00 1.00000000000 BIT_MASK 0x80 FORMAT "%13.11" ECU_ADDRESS 0x382DDE /end MEASUREMENT
/begin MEASUREMENT B_clkra06 "" UWORD B_TRUE 1 100 0.00 1.00000000000 BIT_MASK 0x80 FORMAT "%13.11" ECU_ADDRESS 0x382DE0 /end MEASUREMENT
/begin MEASUREMENT B_clkrnt "" UWORD B_TRUE 1 100 0.00 1.00000000000 BIT_MASK 0x80 FORMAT "%13.11" ECU_ADDRESS 0x382DE2 /end MEASUREMENT
/begin MEASUREMENT B_clkrof "" UWORD B_TRUE 1 100 0.00 1.00000000000 BIT_MASK 0x80 FORMAT "%13.11" ECU_ADDRESS 0x382DE4 /end MEASUREMENT
/begin MEASUREMENT B_clkrtp "" UWORD B_TRUE 1 100 0.00 1.00000000000 BIT_MASK 0x80 FORMAT "%13.11" ECU_ADDRESS 0x382DE6 /end MEASUREMENT
/begin MEASUREMENT B_clks1 "" UWORD B_TRUE 1 100 0.00 1.00000000000 BIT_MASK 0x80 FORMAT "%13.11" ECU_ADDRESS 0x382DE8 /end MEASUREMENT
/begin MEASUREMENT B_clks2 "" UWORD B_TRUE 1 100 0.00 1.00000000000 BIT_MASK 0x80 FORMAT "%13.11" ECU_ADDRESS 0x382DEA /end MEASUREMENT
/begin MEASUREMENT B_clks3 "" UWORD B_TRUE 1 100 0.00 1.00000000000 BIT_MASK 0x80 FORMAT "%13.11" ECU_ADDRESS 0x382DEC /end MEASUREMENT
/begin MEASUREMENT B_clks4 "" UWORD B_TRUE 1 100 0.00 1.00000000000 BIT_MASK 0x80 FORMAT "%13.11" ECU_ADDRESS 0x382DEE /end MEASUREMENT
/begin MEASUREMENT B_clkuppl "" UWORD B_TRUE 1 100 0.00 1.00000000000 BIT_MASK 0x80 FORMAT "%13.11" ECU_ADDRESS 0x382DF0 /end MEASUREMENT
/begin MEASUREMENT B_cllash "" UWORD B_TRUE 1 100 0.00 1.00000000000 BIT_MASK 0x80 FORMAT "%13.11" ECU_ADDRESS 0x382DF2 /end MEASUREMENT
/begin MEASUREMENT B_cllash2 "" UWORD B_TRUE 1 100 0.00 1.00000000000 BIT_MASK 0x80 FORMAT "%13.11" ECU_ADDRESS 0x382DF4 /end MEASUREMENT
/begin MEASUREMENT B_cllavh "" UWORD B_TRUE 1 100 0.00 1.00000000000 BIT_MASK 0x80 FORMAT "%13.11" ECU_ADDRESS 0x382DF6 /end MEASUREMENT
/begin MEASUREMENT B_cllavh2 "" UWORD B_TRUE 1 100 0.00 1.00000000000 BIT_MASK 0x80 FORMAT "%13.11" ECU_ADDRESS 0x382DF8 /end MEASUREMENT
/begin MEASUREMENT B_clllr "" UWORD B_TRUE 1 100 0.00 1.00000000000 BIT_MASK 0x80 FORMAT "%13.11" ECU_ADDRESS 0x382DFC /end MEASUREMENT
/begin MEASUREMENT B_cllm "" UWORD B_TRUE 1 100 0.00 1.00000000000 BIT_MASK 0x80 FORMAT "%13.11" ECU_ADDRESS 0x382DFE /end MEASUREMENT
/begin MEASUREMENT B_cllsh "" UWORD B_TRUE 1 100 0.00 1.00000000000 BIT_MASK 0x80 FORMAT "%13.11" ECU_ADDRESS 0x382E00 /end MEASUREMENT
/begin MEASUREMENT B_cllsh2 "" UWORD B_TRUE 1 100 0.00 1.00000000000 BIT_MASK 0x80 FORMAT "%13.11" ECU_ADDRESS 0x382E02 /end MEASUREMENT
/begin MEASUREMENT B_cllsvv "" UWORD B_TRUE 1 100 0.00 1.00000000000 BIT_MASK 0x80 FORMAT "%13.11" ECU_ADDRESS 0x382E1E /end MEASUREMENT
/begin MEASUREMENT B_cllue1 "" UWORD B_TRUE 1 100 0.00 1.00000000000 BIT_MASK 0x80 FORMAT "%13.11" ECU_ADDRESS 0x382E20 /end MEASUREMENT
/begin MEASUREMENT B_clmd "" UWORD B_TRUE 1 100 0.00 1.00000000000 BIT_MASK 0x80 FORMAT "%13.11" ECU_ADDRESS 0x382E26 /end MEASUREMENT
/begin MEASUREMENT B_clmd00 "" UWORD B_TRUE 1 100 0.00 1.00000000000 BIT_MASK 0x80 FORMAT "%13.11" ECU_ADDRESS 0x382E28 /end MEASUREMENT
/begin MEASUREMENT B_clmd01 "" UWORD B_TRUE 1 100 0.00 1.00000000000 BIT_MASK 0x80 FORMAT "%13.11" ECU_ADDRESS 0x382E2A /end MEASUREMENT
/begin MEASUREMENT B_clmd02 "" UWORD B_TRUE 1 100 0.00 1.00000000000 BIT_MASK 0x80 FORMAT "%13.11" ECU_ADDRESS 0x382E2C /end MEASUREMENT
/begin MEASUREMENT B_clmd03 "" UWORD B_TRUE 1 100 0.00 1.00000000000 BIT_MASK 0x80 FORMAT "%13.11" ECU_ADDRESS 0x382E2E /end MEASUREMENT
/begin MEASUREMENT B_clmd04 "" UWORD B_TRUE 1 100 0.00 1.00000000000 BIT_MASK 0x80 FORMAT "%13.11" ECU_ADDRESS 0x382E30 /end MEASUREMENT
/begin MEASUREMENT B_clmd05 "" UWORD B_TRUE 1 100 0.00 1.00000000000 BIT_MASK 0x80 FORMAT "%13.11" ECU_ADDRESS 0x382E32 /end MEASUREMENT
/begin MEASUREMENT B_clmfa "" UWORD B_TRUE 1 100 0.00 1.00000000000 BIT_MASK 0x80 FORMAT "%13.11" ECU_ADDRESS 0x382E36 /end MEASUREMENT
/begin MEASUREMENT B_clnwkw "" UWORD B_TRUE 1 100 0.00 1.00000000000 BIT_MASK 0x80 FORMAT "%13.11" ECU_ADDRESS 0x382E3A /end MEASUREMENT
/begin MEASUREMENT B_clnwkw2 "" UWORD B_TRUE 1 100 0.00 1.00000000000 BIT_MASK 0x80 FORMAT "%13.11" ECU_ADDRESS 0x382E3C /end MEASUREMENT
/begin MEASUREMENT B_clnx "" UWORD B_TRUE 1 100 0.00 1.00000000000 BIT_MASK 0x80 FORMAT "%13.11" ECU_ADDRESS 0x382E3E /end MEASUREMENT
/begin MEASUREMENT B_clph "" UWORD B_TRUE 1 100 0.00 1.00000000000 BIT_MASK 0x80 FORMAT "%13.11" ECU_ADDRESS 0x382E40 /end MEASUREMENT
/begin MEASUREMENT B_clph2 "" UWORD B_TRUE 1 100 0.00 1.00000000000 BIT_MASK 0x80 FORMAT "%13.11" ECU_ADDRESS 0x382E42 /end MEASUREMENT
/begin MEASUREMENT B_clpllsu "" UWORD B_TRUE 1 100 0.00 1.00000000000 BIT_MASK 0x80 FORMAT "%13.11" ECU_ADDRESS 0x382E44 /end MEASUREMENT
/begin MEASUREMENT B_clpllsu2 "" UWORD B_TRUE 1 100 0.00 1.00000000000 BIT_MASK 0x80 FORMAT "%13.11" ECU_ADDRESS 0x382E46 /end MEASUREMENT
/begin MEASUREMENT B_clrkat "" UWORD B_TRUE 1 100 0.00 1.00000000000 BIT_MASK 0x80 FORMAT "%13.11" ECU_ADDRESS 0x382E4A /end MEASUREMENT
/begin MEASUREMENT B_clrkat2 "" UWORD B_TRUE 1 100 0.00 1.00000000000 BIT_MASK 0x80 FORMAT "%13.11" ECU_ADDRESS 0x382E4C /end MEASUREMENT
/begin MEASUREMENT B_clrkaz "" UWORD B_TRUE 1 100 0.00 1.00000000000 BIT_MASK 0x80 FORMAT "%13.11" ECU_ADDRESS 0x382E4E /end MEASUREMENT
/begin MEASUREMENT B_clrkaz2 "" UWORD B_TRUE 1 100 0.00 1.00000000000 BIT_MASK 0x80 FORMAT "%13.11" ECU_ADDRESS 0x382E50 /end MEASUREMENT
/begin MEASUREMENT B_clsgeep "" UWORD B_TRUE 1 100 0.00 1.00000000000 BIT_MASK 0x80 FORMAT "%13.11" ECU_ADDRESS 0x382E54 /end MEASUREMENT
/begin MEASUREMENT B_clsls "" UWORD B_TRUE 1 100 0.00 1.00000000000 BIT_MASK 0x80 FORMAT "%13.11" ECU_ADDRESS 0x382E5A /end MEASUREMENT
/begin MEASUREMENT B_clsls2 "" UWORD B_TRUE 1 100 0.00 1.00000000000 BIT_MASK 0x80 FORMAT "%13.11" ECU_ADDRESS 0x382E5C /end MEASUREMENT
/begin MEASUREMENT B_clslv "" UWORD B_TRUE 1 100 0.00 1.00000000000 BIT_MASK 0x80 FORMAT "%13.11" ECU_ADDRESS 0x382E5E /end MEASUREMENT
/begin MEASUREMENT B_clslv2 "" UWORD B_TRUE 1 100 0.00 1.00000000000 BIT_MASK 0x80 FORMAT "%13.11" ECU_ADDRESS 0x382E60 /end MEASUREMENT
/begin MEASUREMENT B_cltankl "" UWORD B_TRUE 1 100 0.00 1.00000000000 BIT_MASK 0x80 FORMAT "%13.11" ECU_ADDRESS 0x382E6A /end MEASUREMENT
/begin MEASUREMENT B_cltes "" UWORD B_TRUE 1 100 0.00 1.00000000000 BIT_MASK 0x80 FORMAT "%13.11" ECU_ADDRESS 0x382E6C /end MEASUREMENT
/begin MEASUREMENT B_cltesf "" UWORD B_TRUE 1 100 0.00 1.00000000000 BIT_MASK 0x80 FORMAT "%13.11" ECU_ADDRESS 0x382E6E /end MEASUREMENT
/begin MEASUREMENT B_cltesg "" UWORD B_TRUE 1 100 0.00 1.00000000000 BIT_MASK 0x80 FORMAT "%13.11" ECU_ADDRESS 0x382E70 /end MEASUREMENT
/begin MEASUREMENT B_clufmv "" UWORD B_TRUE 1 100 0.00 1.00000000000 BIT_MASK 0x80 FORMAT "%13.11" ECU_ADDRESS 0x382E84 /end MEASUREMENT
/begin MEASUREMENT B_clufnc "" UWORD B_TRUE 1 100 0.00 1.00000000000 BIT_MASK 0x80 FORMAT "%13.11" ECU_ADDRESS 0x382E86 /end MEASUREMENT
/begin MEASUREMENT B_clufrlip "" UWORD B_TRUE 1 100 0.00 1.00000000000 BIT_MASK 0x80 FORMAT "%13.11" ECU_ADDRESS 0x382E88 /end MEASUREMENT
/begin MEASUREMENT B_clufsga "" UWORD B_TRUE 1 100 0.00 1.00000000000 BIT_MASK 0x80 FORMAT "%13.11" ECU_ADDRESS 0x382E8A /end MEASUREMENT
/begin MEASUREMENT B_clufsgb "" UWORD B_TRUE 1 100 0.00 1.00000000000 BIT_MASK 0x80 FORMAT "%13.11" ECU_ADDRESS 0x382E8C /end MEASUREMENT
/begin MEASUREMENT B_clufska "" UWORD B_TRUE 1 100 0.00 1.00000000000 BIT_MASK 0x80 FORMAT "%13.11" ECU_ADDRESS 0x382E8E /end MEASUREMENT
/begin MEASUREMENT B_clufspsc "" UWORD B_TRUE 1 100 0.00 1.00000000000 BIT_MASK 0x80 FORMAT "%13.11" ECU_ADDRESS 0x382E90 /end MEASUREMENT
/begin MEASUREMENT B_clulsu "" UWORD B_TRUE 1 100 0.00 1.00000000000 BIT_MASK 0x80 FORMAT "%13.11" ECU_ADDRESS 0x382E92 /end MEASUREMENT
/begin MEASUREMENT B_clulsu2 "" UWORD B_TRUE 1 100 0.00 1.00000000000 BIT_MASK 0x80 FORMAT "%13.11" ECU_ADDRESS 0x382E94 /end MEASUREMENT
/begin MEASUREMENT B_clurram "" UWORD B_TRUE 1 100 0.00 1.00000000000 BIT_MASK 0x80 FORMAT "%13.11" ECU_ADDRESS 0x382E96 /end MEASUREMENT
/begin MEASUREMENT B_clurrom "" UWORD B_TRUE 1 100 0.00 1.00000000000 BIT_MASK 0x80 FORMAT "%13.11" ECU_ADDRESS 0x382E98 /end MEASUREMENT
/begin MEASUREMENT B_clurrst "" UWORD B_TRUE 1 100 0.00 1.00000000000 BIT_MASK 0x80 FORMAT "%13.11" ECU_ADDRESS 0x382E9A /end MEASUREMENT
/begin MEASUREMENT B_clvfz "" UWORD B_TRUE 1 100 0.00 1.00000000000 BIT_MASK 0x80 FORMAT "%13.11" ECU_ADDRESS 0x382E9C /end MEASUREMENT
/begin MEASUREMENT B_falm "" UWORD B_TRUE 1 100 0.00 1.00000000000 BIT_MASK 0x10 FORMAT "%13.11" ECU_ADDRESS 0x382DFE /end MEASUREMENT
/begin MEASUREMENT B_famfa "" UWORD B_TRUE 1 100 0.00 1.00000000000 BIT_MASK 0x10 FORMAT "%13.11" ECU_ADDRESS 0x382E36 /end MEASUREMENT
/begin MEASUREMENT B_ftcge "" UWORD B_TRUE 1 100 0.00 1.00000000000 BIT_MASK 0x10 FORMAT "%13.11" ECU_ADDRESS 0x382D54 /end MEASUREMENT
/begin MEASUREMENT B_ftdpl "" UWORD B_TRUE 1 100 0.00 1.00000000000 BIT_MASK 0x10 FORMAT "%13.11" ECU_ADDRESS 0x382D6A /end MEASUREMENT
/begin MEASUREMENT B_ftdsbkv "" UWORD B_TRUE 1 100 0.00 1.00000000000 BIT_MASK 0x10 FORMAT "%13.11" ECU_ADDRESS 0x382D6C /end MEASUREMENT
/begin MEASUREMENT B_ftfrao "" UWORD B_TRUE 1 100 0.00 1.00000000000 BIT_MASK 0x10 FORMAT "%13.11" ECU_ADDRESS 0x382DA6 /end MEASUREMENT
/begin MEASUREMENT B_ftfrao2 "" UWORD B_TRUE 1 100 0.00 1.00000000000 BIT_MASK 0x10 FORMAT "%13.11" ECU_ADDRESS 0x382DA8 /end MEASUREMENT
/begin MEASUREMENT B_ftfrau "" UWORD B_TRUE 1 100 0.00 1.00000000000 BIT_MASK 0x10 FORMAT "%13.11" ECU_ADDRESS 0x382DAA /end MEASUREMENT
/begin MEASUREMENT B_ftfrau2 "" UWORD B_TRUE 1 100 0.00 1.00000000000 BIT_MASK 0x10 FORMAT "%13.11" ECU_ADDRESS 0x382DAC /end MEASUREMENT
/begin MEASUREMENT B_ftfrst "" UWORD B_TRUE 1 100 0.00 1.00000000000 BIT_MASK 0x10 FORMAT "%13.11" ECU_ADDRESS 0x382DAE /end MEASUREMENT
/begin MEASUREMENT B_ftfrst2 "" UWORD B_TRUE 1 100 0.00 1.00000000000 BIT_MASK 0x10 FORMAT "%13.11" ECU_ADDRESS 0x382DB0 /end MEASUREMENT
/begin MEASUREMENT B_ftgecod "" UWORD B_TRUE 1 100 0.00 1.00000000000 BIT_MASK 0x10 FORMAT "%13.11" ECU_ADDRESS 0x382DB2 /end MEASUREMENT
/begin MEASUREMENT B_ftkat "" UWORD B_TRUE 1 100 0.00 1.00000000000 BIT_MASK 0x10 FORMAT "%13.11" ECU_ADDRESS 0x382DD0 /end MEASUREMENT
/begin MEASUREMENT B_ftkat2 "" UWORD B_TRUE 1 100 0.00 1.00000000000 BIT_MASK 0x10 FORMAT "%13.11" ECU_ADDRESS 0x382DD2 /end MEASUREMENT
/begin MEASUREMENT B_ftkrnt "" UWORD B_TRUE 1 100 0.00 1.00000000000 BIT_MASK 0x10 FORMAT "%13.11" ECU_ADDRESS 0x382DE2 /end MEASUREMENT
/begin MEASUREMENT B_ftkrof "" UWORD B_TRUE 1 100 0.00 1.00000000000 BIT_MASK 0x10 FORMAT "%13.11" ECU_ADDRESS 0x382DE4 /end MEASUREMENT
/begin MEASUREMENT B_ftkrtp "" UWORD B_TRUE 1 100 0.00 1.00000000000 BIT_MASK 0x10 FORMAT "%13.11" ECU_ADDRESS 0x382DE6 /end MEASUREMENT
/begin MEASUREMENT B_ftks1 "" UWORD B_TRUE 1 100 0.00 1.00000000000 BIT_MASK 0x10 FORMAT "%13.11" ECU_ADDRESS 0x382DE8 /end MEASUREMENT
/begin MEASUREMENT B_ftks2 "" UWORD B_TRUE 1 100 0.00 1.00000000000 BIT_MASK 0x10 FORMAT "%13.11" ECU_ADDRESS 0x382DEA /end MEASUREMENT
/begin MEASUREMENT B_ftks3 "" UWORD B_TRUE 1 100 0.00 1.00000000000 BIT_MASK 0x10 FORMAT "%13.11" ECU_ADDRESS 0x382DEC /end MEASUREMENT
/begin MEASUREMENT B_ftks4 "" UWORD B_TRUE 1 100 0.00 1.00000000000 BIT_MASK 0x10 FORMAT "%13.11" ECU_ADDRESS 0x382DEE /end MEASUREMENT
/begin MEASUREMENT B_ftkuppl "" UWORD B_TRUE 1 100 0.00 1.00000000000 BIT_MASK 0x10 FORMAT "%13.11" ECU_ADDRESS 0x382DF0 /end MEASUREMENT
/begin MEASUREMENT B_ftlash "" UWORD B_TRUE 1 100 0.00 1.00000000000 BIT_MASK 0x10 FORMAT "%13.11" ECU_ADDRESS 0x382DF2 /end MEASUREMENT
/begin MEASUREMENT B_ftlash2 "" UWORD B_TRUE 1 100 0.00 1.00000000000 BIT_MASK 0x10 FORMAT "%13.11" ECU_ADDRESS 0x382DF4 /end MEASUREMENT
/begin MEASUREMENT B_ftlavh "" UWORD B_TRUE 1 100 0.00 1.00000000000 BIT_MASK 0x10 FORMAT "%13.11" ECU_ADDRESS 0x382DF6 /end MEASUREMENT
/begin MEASUREMENT B_ftlavh2 "" UWORD B_TRUE 1 100 0.00 1.00000000000 BIT_MASK 0x10 FORMAT "%13.11" ECU_ADDRESS 0x382DF8 /end MEASUREMENT
/begin MEASUREMENT B_ftllr "" UWORD B_TRUE 1 100 0.00 1.00000000000 BIT_MASK 0x10 FORMAT "%13.11" ECU_ADDRESS 0x382DFC /end MEASUREMENT
/begin MEASUREMENT B_ftlsh "" UWORD B_TRUE 1 100 0.00 1.00000000000 BIT_MASK 0x10 FORMAT "%13.11" ECU_ADDRESS 0x382E00 /end MEASUREMENT
/begin MEASUREMENT B_ftlsh2 "" UWORD B_TRUE 1 100 0.00 1.00000000000 BIT_MASK 0x10 FORMAT "%13.11" ECU_ADDRESS 0x382E02 /end MEASUREMENT
/begin MEASUREMENT B_ftlsvv "" UWORD B_TRUE 1 100 0.00 1.00000000000 BIT_MASK 0x10 FORMAT "%13.11" ECU_ADDRESS 0x382E1E /end MEASUREMENT
/begin MEASUREMENT B_ftlue1 "" UWORD B_TRUE 1 100 0.00 1.00000000000 BIT_MASK 0x10 FORMAT "%13.11" ECU_ADDRESS 0x382E20 /end MEASUREMENT
/begin MEASUREMENT B_ftmd "" UWORD B_TRUE 1 100 0.00 1.00000000000 BIT_MASK 0x10 FORMAT "%13.11" ECU_ADDRESS 0x382E26 /end MEASUREMENT
/begin MEASUREMENT B_ftmd00 "" UWORD B_TRUE 1 100 0.00 1.00000000000 BIT_MASK 0x10 FORMAT "%13.11" ECU_ADDRESS 0x382E28 /end MEASUREMENT
/begin MEASUREMENT B_ftmd01 "" UWORD B_TRUE 1 100 0.00 1.00000000000 BIT_MASK 0x10 FORMAT "%13.11" ECU_ADDRESS 0x382E2A /end MEASUREMENT
/begin MEASUREMENT B_ftmd02 "" UWORD B_TRUE 1 100 0.00 1.00000000000 BIT_MASK 0x10 FORMAT "%13.11" ECU_ADDRESS 0x382E2C /end MEASUREMENT
/begin MEASUREMENT B_ftmd03 "" UWORD B_TRUE 1 100 0.00 1.00000000000 BIT_MASK 0x10 FORMAT "%13.11" ECU_ADDRESS 0x382E2E /end MEASUREMENT
/begin MEASUREMENT B_ftmd04 "" UWORD B_TRUE 1 100 0.00 1.00000000000 BIT_MASK 0x10 FORMAT "%13.11" ECU_ADDRESS 0x382E30 /end MEASUREMENT
/begin MEASUREMENT B_ftmd05 "" UWORD B_TRUE 1 100 0.00 1.00000000000 BIT_MASK 0x10 FORMAT "%13.11" ECU_ADDRESS 0x382E32 /end MEASUREMENT
/begin MEASUREMENT B_ftnwkw "" UWORD B_TRUE 1 100 0.00 1.00000000000 BIT_MASK 0x10 FORMAT "%13.11" ECU_ADDRESS 0x382E3A /end MEASUREMENT
/begin MEASUREMENT B_ftnwkw2 "" UWORD B_TRUE 1 100 0.00 1.00000000000 BIT_MASK 0x10 FORMAT "%13.11" ECU_ADDRESS 0x382E3C /end MEASUREMENT
/begin MEASUREMENT B_ftnx "" UWORD B_TRUE 1 100 0.00 1.00000000000 BIT_MASK 0x10 FORMAT "%13.11" ECU_ADDRESS 0x382E3E /end MEASUREMENT
/begin MEASUREMENT B_ftph "" UWORD B_TRUE 1 100 0.00 1.00000000000 BIT_MASK 0x10 FORMAT "%13.11" ECU_ADDRESS 0x382E40 /end MEASUREMENT
/begin MEASUREMENT B_ftph2 "" UWORD B_TRUE 1 100 0.00 1.00000000000 BIT_MASK 0x10 FORMAT "%13.11" ECU_ADDRESS 0x382E42 /end MEASUREMENT
/begin MEASUREMENT B_ftpllsu "" UWORD B_TRUE 1 100 0.00 1.00000000000 BIT_MASK 0x10 FORMAT "%13.11" ECU_ADDRESS 0x382E44 /end MEASUREMENT
/begin MEASUREMENT B_ftpllsu2 "" UWORD B_TRUE 1 100 0.00 1.00000000000 BIT_MASK 0x10 FORMAT "%13.11" ECU_ADDRESS 0x382E46 /end MEASUREMENT
/begin MEASUREMENT B_ftrkat "" UWORD B_TRUE 1 100 0.00 1.00000000000 BIT_MASK 0x10 FORMAT "%13.11" ECU_ADDRESS 0x382E4A /end MEASUREMENT
/begin MEASUREMENT B_ftrkat2 "" UWORD B_TRUE 1 100 0.00 1.00000000000 BIT_MASK 0x10 FORMAT "%13.11" ECU_ADDRESS 0x382E4C /end MEASUREMENT
/begin MEASUREMENT B_ftrkaz "" UWORD B_TRUE 1 100 0.00 1.00000000000 BIT_MASK 0x10 FORMAT "%13.11" ECU_ADDRESS 0x382E4E /end MEASUREMENT
/begin MEASUREMENT B_ftrkaz2 "" UWORD B_TRUE 1 100 0.00 1.00000000000 BIT_MASK 0x10 FORMAT "%13.11" ECU_ADDRESS 0x382E50 /end MEASUREMENT
/begin MEASUREMENT B_ftsgeep "" UWORD B_TRUE 1 100 0.00 1.00000000000 BIT_MASK 0x10 FORMAT "%13.11" ECU_ADDRESS 0x382E54 /end MEASUREMENT
/begin MEASUREMENT B_ftsls "" UWORD B_TRUE 1 100 0.00 1.00000000000 BIT_MASK 0x10 FORMAT "%13.11" ECU_ADDRESS 0x382E5A /end MEASUREMENT
/begin MEASUREMENT B_ftsls2 "" UWORD B_TRUE 1 100 0.00 1.00000000000 BIT_MASK 0x10 FORMAT "%13.11" ECU_ADDRESS 0x382E5C /end MEASUREMENT
/begin MEASUREMENT B_ftslv "" UWORD B_TRUE 1 100 0.00 1.00000000000 BIT_MASK 0x10 FORMAT "%13.11" ECU_ADDRESS 0x382E5E /end MEASUREMENT
/begin MEASUREMENT B_ftslv2 "" UWORD B_TRUE 1 100 0.00 1.00000000000 BIT_MASK 0x10 FORMAT "%13.11" ECU_ADDRESS 0x382E60 /end MEASUREMENT
/begin MEASUREMENT B_fttankl "" UWORD B_TRUE 1 100 0.00 1.00000000000 BIT_MASK 0x10 FORMAT "%13.11" ECU_ADDRESS 0x382E6A /end MEASUREMENT
/begin MEASUREMENT B_fttes "" UWORD B_TRUE 1 100 0.00 1.00000000000 BIT_MASK 0x10 FORMAT "%13.11" ECU_ADDRESS 0x382E6C /end MEASUREMENT
/begin MEASUREMENT B_fttesf "" UWORD B_TRUE 1 100 0.00 1.00000000000 BIT_MASK 0x10 FORMAT "%13.11" ECU_ADDRESS 0x382E6E /end MEASUREMENT
/begin MEASUREMENT B_fttesg "" UWORD B_TRUE 1 100 0.00 1.00000000000 BIT_MASK 0x10 FORMAT "%13.11" ECU_ADDRESS 0x382E70 /end MEASUREMENT
/begin MEASUREMENT B_ftufmv "" UWORD B_TRUE 1 100 0.00 1.00000000000 BIT_MASK 0x10 FORMAT "%13.11" ECU_ADDRESS 0x382E84 /end MEASUREMENT
/begin MEASUREMENT B_ftufnc "" UWORD B_TRUE 1 100 0.00 1.00000000000 BIT_MASK 0x10 FORMAT "%13.11" ECU_ADDRESS 0x382E86 /end MEASUREMENT
/begin MEASUREMENT B_ftufrlip "" UWORD B_TRUE 1 100 0.00 1.00000000000 BIT_MASK 0x10 FORMAT "%13.11" ECU_ADDRESS 0x382E88 /end MEASUREMENT
/begin MEASUREMENT B_ftufsga "" UWORD B_TRUE 1 100 0.00 1.00000000000 BIT_MASK 0x10 FORMAT "%13.11" ECU_ADDRESS 0x382E8A /end MEASUREMENT
/begin MEASUREMENT B_ftufsgb "" UWORD B_TRUE 1 100 0.00 1.00000000000 BIT_MASK 0x10 FORMAT "%13.11" ECU_ADDRESS 0x382E8C /end MEASUREMENT
/begin MEASUREMENT B_ftufska "" UWORD B_TRUE 1 100 0.00 1.00000000000 BIT_MASK 0x10 FORMAT "%13.11" ECU_ADDRESS 0x382E8E /end MEASUREMENT
/begin MEASUREMENT B_ftufspsc "" UWORD B_TRUE 1 100 0.00 1.00000000000 BIT_MASK 0x10 FORMAT "%13.11" ECU_ADDRESS 0x382E90 /end MEASUREMENT
/begin MEASUREMENT B_ftulsu "" UWORD B_TRUE 1 100 0.00 1.00000000000 BIT_MASK 0x10 FORMAT "%13.11" ECU_ADDRESS 0x382E92 /end MEASUREMENT
/begin MEASUREMENT B_ftulsu2 "" UWORD B_TRUE 1 100 0.00 1.00000000000 BIT_MASK 0x10 FORMAT "%13.11" ECU_ADDRESS 0x382E94 /end MEASUREMENT
/begin MEASUREMENT B_fturram "" UWORD B_TRUE 1 100 0.00 1.00000000000 BIT_MASK 0x10 FORMAT "%13.11" ECU_ADDRESS 0x382E96 /end MEASUREMENT
/begin MEASUREMENT B_fturrom "" UWORD B_TRUE 1 100 0.00 1.00000000000 BIT_MASK 0x10 FORMAT "%13.11" ECU_ADDRESS 0x382E98 /end MEASUREMENT
/begin MEASUREMENT B_fturrst "" UWORD B_TRUE 1 100 0.00 1.00000000000 BIT_MASK 0x10 FORMAT "%13.11" ECU_ADDRESS 0x382E9A /end MEASUREMENT
/begin MEASUREMENT B_ftvfz "" UWORD B_TRUE 1 100 0.00 1.00000000000 BIT_MASK 0x10 FORMAT "%13.11" ECU_ADDRESS 0x382E9C /end MEASUREMENT
/begin MEASUREMENT B_mncge "" UWORD B_TRUE 1 100 0.00 1.00000000000 BIT_MASK 0x200 FORMAT "%13.11" ECU_ADDRESS 0x382D54 /end MEASUREMENT
/begin MEASUREMENT B_mndpl "" UWORD B_TRUE 1 100 0.00 1.00000000000 BIT_MASK 0x200 FORMAT "%13.11" ECU_ADDRESS 0x382D6A /end MEASUREMENT
/begin MEASUREMENT B_mndsbkv "" UWORD B_TRUE 1 100 0.00 1.00000000000 BIT_MASK 0x200 FORMAT "%13.11" ECU_ADDRESS 0x382D6C /end MEASUREMENT
/begin MEASUREMENT B_mnfrao "" UWORD B_TRUE 1 100 0.00 1.00000000000 BIT_MASK 0x200 FORMAT "%13.11" ECU_ADDRESS 0x382DA6 /end MEASUREMENT
/begin MEASUREMENT B_mnfrao2 "" UWORD B_TRUE 1 100 0.00 1.00000000000 BIT_MASK 0x200 FORMAT "%13.11" ECU_ADDRESS 0x382DA8 /end MEASUREMENT
/begin MEASUREMENT B_mnfrau "" UWORD B_TRUE 1 100 0.00 1.00000000000 BIT_MASK 0x200 FORMAT "%13.11" ECU_ADDRESS 0x382DAA /end MEASUREMENT
/begin MEASUREMENT B_mnfrau2 "" UWORD B_TRUE 1 100 0.00 1.00000000000 BIT_MASK 0x200 FORMAT "%13.11" ECU_ADDRESS 0x382DAC /end MEASUREMENT
/begin MEASUREMENT B_mnfrst "" UWORD B_TRUE 1 100 0.00 1.00000000000 BIT_MASK 0x200 FORMAT "%13.11" ECU_ADDRESS 0x382DAE /end MEASUREMENT
/begin MEASUREMENT B_mnfrst2 "" UWORD B_TRUE 1 100 0.00 1.00000000000 BIT_MASK 0x200 FORMAT "%13.11" ECU_ADDRESS 0x382DB0 /end MEASUREMENT
/begin MEASUREMENT B_mngecod "" UWORD B_TRUE 1 100 0.00 1.00000000000 BIT_MASK 0x200 FORMAT "%13.11" ECU_ADDRESS 0x382DB2 /end MEASUREMENT
/begin MEASUREMENT B_mnkat "" UWORD B_TRUE 1 100 0.00 1.00000000000 BIT_MASK 0x200 FORMAT "%13.11" ECU_ADDRESS 0x382DD0 /end MEASUREMENT
/begin MEASUREMENT B_mnkat2 "" UWORD B_TRUE 1 100 0.00 1.00000000000 BIT_MASK 0x200 FORMAT "%13.11" ECU_ADDRESS 0x382DD2 /end MEASUREMENT
/begin MEASUREMENT B_mnkrnt "" UWORD B_TRUE 1 100 0.00 1.00000000000 BIT_MASK 0x200 FORMAT "%13.11" ECU_ADDRESS 0x382DE2 /end MEASUREMENT
/begin MEASUREMENT B_mnkrof "" UWORD B_TRUE 1 100 0.00 1.00000000000 BIT_MASK 0x200 FORMAT "%13.11" ECU_ADDRESS 0x382DE4 /end MEASUREMENT
/begin MEASUREMENT B_mnkrtp "" UWORD B_TRUE 1 100 0.00 1.00000000000 BIT_MASK 0x200 FORMAT "%13.11" ECU_ADDRESS 0x382DE6 /end MEASUREMENT
/begin MEASUREMENT B_mnks1 "" UWORD B_TRUE 1 100 0.00 1.00000000000 BIT_MASK 0x200 FORMAT "%13.11" ECU_ADDRESS 0x382DE8 /end MEASUREMENT
/begin MEASUREMENT B_mnks2 "" UWORD B_TRUE 1 100 0.00 1.00000000000 BIT_MASK 0x200 FORMAT "%13.11" ECU_ADDRESS 0x382DEA /end MEASUREMENT
/begin MEASUREMENT B_mnks3 "" UWORD B_TRUE 1 100 0.00 1.00000000000 BIT_MASK 0x200 FORMAT "%13.11" ECU_ADDRESS 0x382DEC /end MEASUREMENT
/begin MEASUREMENT B_mnks4 "" UWORD B_TRUE 1 100 0.00 1.00000000000 BIT_MASK 0x200 FORMAT "%13.11" ECU_ADDRESS 0x382DEE /end MEASUREMENT
/begin MEASUREMENT B_mnkuppl "" UWORD B_TRUE 1 100 0.00 1.00000000000 BIT_MASK 0x200 FORMAT "%13.11" ECU_ADDRESS 0x382DF0 /end MEASUREMENT
/begin MEASUREMENT B_mnlash "" UWORD B_TRUE 1 100 0.00 1.00000000000 BIT_MASK 0x200 FORMAT "%13.11" ECU_ADDRESS 0x382DF2 /end MEASUREMENT
/begin MEASUREMENT B_mnlash2 "" UWORD B_TRUE 1 100 0.00 1.00000000000 BIT_MASK 0x200 FORMAT "%13.11" ECU_ADDRESS 0x382DF4 /end MEASUREMENT
/begin MEASUREMENT B_mnlavh "" UWORD B_TRUE 1 100 0.00 1.00000000000 BIT_MASK 0x200 FORMAT "%13.11" ECU_ADDRESS 0x382DF6 /end MEASUREMENT
/begin MEASUREMENT B_mnlavh2 "" UWORD B_TRUE 1 100 0.00 1.00000000000 BIT_MASK 0x200 FORMAT "%13.11" ECU_ADDRESS 0x382DF8 /end MEASUREMENT
/begin MEASUREMENT B_mnllr "" UWORD B_TRUE 1 100 0.00 1.00000000000 BIT_MASK 0x200 FORMAT "%13.11" ECU_ADDRESS 0x382DFC /end MEASUREMENT
/begin MEASUREMENT B_mnlm "" UWORD B_TRUE 1 100 0.00 1.00000000000 BIT_MASK 0x200 FORMAT "%13.11" ECU_ADDRESS 0x382DFE /end MEASUREMENT
/begin MEASUREMENT B_mnlsh "" UWORD B_TRUE 1 100 0.00 1.00000000000 BIT_MASK 0x200 FORMAT "%13.11" ECU_ADDRESS 0x382E00 /end MEASUREMENT
/begin MEASUREMENT B_mnlsh2 "" UWORD B_TRUE 1 100 0.00 1.00000000000 BIT_MASK 0x200 FORMAT "%13.11" ECU_ADDRESS 0x382E02 /end MEASUREMENT
/begin MEASUREMENT B_mnlsvv "" UWORD B_TRUE 1 100 0.00 1.00000000000 BIT_MASK 0x200 FORMAT "%13.11" ECU_ADDRESS 0x382E1E /end MEASUREMENT
/begin MEASUREMENT B_mnlue1 "" UWORD B_TRUE 1 100 0.00 1.00000000000 BIT_MASK 0x200 FORMAT "%13.11" ECU_ADDRESS 0x382E20 /end MEASUREMENT
/begin MEASUREMENT B_mnmd "" UWORD B_TRUE 1 100 0.00 1.00000000000 BIT_MASK 0x200 FORMAT "%13.11" ECU_ADDRESS 0x382E26 /end MEASUREMENT
/begin MEASUREMENT B_mnmd00 "" UWORD B_TRUE 1 100 0.00 1.00000000000 BIT_MASK 0x200 FORMAT "%13.11" ECU_ADDRESS 0x382E28 /end MEASUREMENT
/begin MEASUREMENT B_mnmd01 "" UWORD B_TRUE 1 100 0.00 1.00000000000 BIT_MASK 0x200 FORMAT "%13.11" ECU_ADDRESS 0x382E2A /end MEASUREMENT
/begin MEASUREMENT B_mnmd02 "" UWORD B_TRUE 1 100 0.00 1.00000000000 BIT_MASK 0x200 FORMAT "%13.11" ECU_ADDRESS 0x382E2C /end MEASUREMENT
/begin MEASUREMENT B_mnmd03 "" UWORD B_TRUE 1 100 0.00 1.00000000000 BIT_MASK 0x200 FORMAT "%13.11" ECU_ADDRESS 0x382E2E /end MEASUREMENT
/begin MEASUREMENT B_mnmd04 "" UWORD B_TRUE 1 100 0.00 1.00000000000 BIT_MASK 0x200 FORMAT "%13.11" ECU_ADDRESS 0x382E30 /end MEASUREMENT
/begin MEASUREMENT B_mnmd05 "" UWORD B_TRUE 1 100 0.00 1.00000000000 BIT_MASK 0x200 FORMAT "%13.11" ECU_ADDRESS 0x382E32 /end MEASUREMENT
/begin MEASUREMENT B_mnmfa "" UWORD B_TRUE 1 100 0.00 1.00000000000 BIT_MASK 0x200 FORMAT "%13.11" ECU_ADDRESS 0x382E36 /end MEASUREMENT
/begin MEASUREMENT B_mnnwkw "" UWORD B_TRUE 1 100 0.00 1.00000000000 BIT_MASK 0x200 FORMAT "%13.11" ECU_ADDRESS 0x382E3A /end MEASUREMENT
/begin MEASUREMENT B_mnnwkw2 "" UWORD B_TRUE 1 100 0.00 1.00000000000 BIT_MASK 0x200 FORMAT "%13.11" ECU_ADDRESS 0x382E3C /end MEASUREMENT
/begin MEASUREMENT B_mnnx "" UWORD B_TRUE 1 100 0.00 1.00000000000 BIT_MASK 0x200 FORMAT "%13.11" ECU_ADDRESS 0x382E3E /end MEASUREMENT
/begin MEASUREMENT B_mnph "" UWORD B_TRUE 1 100 0.00 1.00000000000 BIT_MASK 0x200 FORMAT "%13.11" ECU_ADDRESS 0x382E40 /end MEASUREMENT
/begin MEASUREMENT B_mnph2 "" UWORD B_TRUE 1 100 0.00 1.00000000000 BIT_MASK 0x200 FORMAT "%13.11" ECU_ADDRESS 0x382E42 /end MEASUREMENT
/begin MEASUREMENT B_mnpllsu "" UWORD B_TRUE 1 100 0.00 1.00000000000 BIT_MASK 0x200 FORMAT "%13.11" ECU_ADDRESS 0x382E44 /end MEASUREMENT
/begin MEASUREMENT B_mnpllsu2 "" UWORD B_TRUE 1 100 0.00 1.00000000000 BIT_MASK 0x200 FORMAT "%13.11" ECU_ADDRESS 0x382E46 /end MEASUREMENT
/begin MEASUREMENT B_mnrkat "" UWORD B_TRUE 1 100 0.00 1.00000000000 BIT_MASK 0x200 FORMAT "%13.11" ECU_ADDRESS 0x382E4A /end MEASUREMENT
/begin MEASUREMENT B_mnrkat2 "" UWORD B_TRUE 1 100 0.00 1.00000000000 BIT_MASK 0x200 FORMAT "%13.11" ECU_ADDRESS 0x382E4C /end MEASUREMENT
/begin MEASUREMENT B_mnrkaz "" UWORD B_TRUE 1 100 0.00 1.00000000000 BIT_MASK 0x200 FORMAT "%13.11" ECU_ADDRESS 0x382E4E /end MEASUREMENT
/begin MEASUREMENT B_mnrkaz2 "" UWORD B_TRUE 1 100 0.00 1.00000000000 BIT_MASK 0x200 FORMAT "%13.11" ECU_ADDRESS 0x382E50 /end MEASUREMENT
/begin MEASUREMENT B_mnsgeep "" UWORD B_TRUE 1 100 0.00 1.00000000000 BIT_MASK 0x200 FORMAT "%13.11" ECU_ADDRESS 0x382E54 /end MEASUREMENT
/begin MEASUREMENT B_mnsls "" UWORD B_TRUE 1 100 0.00 1.00000000000 BIT_MASK 0x200 FORMAT "%13.11" ECU_ADDRESS 0x382E5A /end MEASUREMENT
/begin MEASUREMENT B_mnsls2 "" UWORD B_TRUE 1 100 0.00 1.00000000000 BIT_MASK 0x200 FORMAT "%13.11" ECU_ADDRESS 0x382E5C /end MEASUREMENT
/begin MEASUREMENT B_mnslv "" UWORD B_TRUE 1 100 0.00 1.00000000000 BIT_MASK 0x200 FORMAT "%13.11" ECU_ADDRESS 0x382E5E /end MEASUREMENT
/begin MEASUREMENT B_mnslv2 "" UWORD B_TRUE 1 100 0.00 1.00000000000 BIT_MASK 0x200 FORMAT "%13.11" ECU_ADDRESS 0x382E60 /end MEASUREMENT
/begin MEASUREMENT B_mntankl "" UWORD B_TRUE 1 100 0.00 1.00000000000 BIT_MASK 0x200 FORMAT "%13.11" ECU_ADDRESS 0x382E6A /end MEASUREMENT
/begin MEASUREMENT B_mntes "" UWORD B_TRUE 1 100 0.00 1.00000000000 BIT_MASK 0x200 FORMAT "%13.11" ECU_ADDRESS 0x382E6C /end MEASUREMENT
/begin MEASUREMENT B_mntesf "" UWORD B_TRUE 1 100 0.00 1.00000000000 BIT_MASK 0x200 FORMAT "%13.11" ECU_ADDRESS 0x382E6E /end MEASUREMENT
/begin MEASUREMENT B_mntesg "" UWORD B_TRUE 1 100 0.00 1.00000000000 BIT_MASK 0x200 FORMAT "%13.11" ECU_ADDRESS 0x382E70 /end MEASUREMENT
/begin MEASUREMENT B_mnufmv "" UWORD B_TRUE 1 100 0.00 1.00000000000 BIT_MASK 0x200 FORMAT "%13.11" ECU_ADDRESS 0x382E84 /end MEASUREMENT
/begin MEASUREMENT B_mnufnc "" UWORD B_TRUE 1 100 0.00 1.00000000000 BIT_MASK 0x200 FORMAT "%13.11" ECU_ADDRESS 0x382E86 /end MEASUREMENT
/begin MEASUREMENT B_mnufrlip "" UWORD B_TRUE 1 100 0.00 1.00000000000 BIT_MASK 0x200 FORMAT "%13.11" ECU_ADDRESS 0x382E88 /end MEASUREMENT
/begin MEASUREMENT B_mnufsga "" UWORD B_TRUE 1 100 0.00 1.00000000000 BIT_MASK 0x200 FORMAT "%13.11" ECU_ADDRESS 0x382E8A /end MEASUREMENT
/begin MEASUREMENT B_mnufsgb "" UWORD B_TRUE 1 100 0.00 1.00000000000 BIT_MASK 0x200 FORMAT "%13.11" ECU_ADDRESS 0x382E8C /end MEASUREMENT
/begin MEASUREMENT B_mnufska "" UWORD B_TRUE 1 100 0.00 1.00000000000 BIT_MASK 0x200 FORMAT "%13.11" ECU_ADDRESS 0x382E8E /end MEASUREMENT
/begin MEASUREMENT B_mnufspsc "" UWORD B_TRUE 1 100 0.00 1.00000000000 BIT_MASK 0x200 FORMAT "%13.11" ECU_ADDRESS 0x382E90 /end MEASUREMENT
/begin MEASUREMENT B_mnulsu "" UWORD B_TRUE 1 100 0.00 1.00000000000 BIT_MASK 0x200 FORMAT "%13.11" ECU_ADDRESS 0x382E92 /end MEASUREMENT
/begin MEASUREMENT B_mnulsu2 "" UWORD B_TRUE 1 100 0.00 1.00000000000 BIT_MASK 0x200 FORMAT "%13.11" ECU_ADDRESS 0x382E94 /end MEASUREMENT
/begin MEASUREMENT B_mnurram "" UWORD B_TRUE 1 100 0.00 1.00000000000 BIT_MASK 0x200 FORMAT "%13.11" ECU_ADDRESS 0x382E96 /end MEASUREMENT
/begin MEASUREMENT B_mnurrom "" UWORD B_TRUE 1 100 0.00 1.00000000000 BIT_MASK 0x200 FORMAT "%13.11" ECU_ADDRESS 0x382E98 /end MEASUREMENT
/begin MEASUREMENT B_mnurrst "" UWORD B_TRUE 1 100 0.00 1.00000000000 BIT_MASK 0x200 FORMAT "%13.11" ECU_ADDRESS 0x382E9A /end MEASUREMENT
/begin MEASUREMENT B_mnvfz "" UWORD B_TRUE 1 100 0.00 1.00000000000 BIT_MASK 0x200 FORMAT "%13.11" ECU_ADDRESS 0x382E9C /end MEASUREMENT
/begin MEASUREMENT B_mxcge "" UWORD B_TRUE 1 100 0.00 1.00000000000 BIT_MASK 0x100 FORMAT "%13.11" ECU_ADDRESS 0x382D54 /end MEASUREMENT
/begin MEASUREMENT B_mxdpl "" UWORD B_TRUE 1 100 0.00 1.00000000000 BIT_MASK 0x100 FORMAT "%13.11" ECU_ADDRESS 0x382D6A /end MEASUREMENT
/begin MEASUREMENT B_mxdsbkv "" UWORD B_TRUE 1 100 0.00 1.00000000000 BIT_MASK 0x100 FORMAT "%13.11" ECU_ADDRESS 0x382D6C /end MEASUREMENT
/begin MEASUREMENT B_mxfrao "" UWORD B_TRUE 1 100 0.00 1.00000000000 BIT_MASK 0x100 FORMAT "%13.11" ECU_ADDRESS 0x382DA6 /end MEASUREMENT
/begin MEASUREMENT B_mxfrao2 "" UWORD B_TRUE 1 100 0.00 1.00000000000 BIT_MASK 0x100 FORMAT "%13.11" ECU_ADDRESS 0x382DA8 /end MEASUREMENT
/begin MEASUREMENT B_mxfrau "" UWORD B_TRUE 1 100 0.00 1.00000000000 BIT_MASK 0x100 FORMAT "%13.11" ECU_ADDRESS 0x382DAA /end MEASUREMENT
/begin MEASUREMENT B_mxfrau2 "" UWORD B_TRUE 1 100 0.00 1.00000000000 BIT_MASK 0x100 FORMAT "%13.11" ECU_ADDRESS 0x382DAC /end MEASUREMENT
/begin MEASUREMENT B_mxfrst "" UWORD B_TRUE 1 100 0.00 1.00000000000 BIT_MASK 0x100 FORMAT "%13.11" ECU_ADDRESS 0x382DAE /end MEASUREMENT
/begin MEASUREMENT B_mxfrst2 "" UWORD B_TRUE 1 100 0.00 1.00000000000 BIT_MASK 0x100 FORMAT "%13.11" ECU_ADDRESS 0x382DB0 /end MEASUREMENT
/begin MEASUREMENT B_mxgecod "" UWORD B_TRUE 1 100 0.00 1.00000000000 BIT_MASK 0x100 FORMAT "%13.11" ECU_ADDRESS 0x382DB2 /end MEASUREMENT
/begin MEASUREMENT B_mxkat "" UWORD B_TRUE 1 100 0.00 1.00000000000 BIT_MASK 0x100 FORMAT "%13.11" ECU_ADDRESS 0x382DD0 /end MEASUREMENT
/begin MEASUREMENT B_mxkat2 "" UWORD B_TRUE 1 100 0.00 1.00000000000 BIT_MASK 0x100 FORMAT "%13.11" ECU_ADDRESS 0x382DD2 /end MEASUREMENT
/begin MEASUREMENT B_mxkra01 "" UWORD B_TRUE 1 100 0.00 1.00000000000 BIT_MASK 0x100 FORMAT "%13.11" ECU_ADDRESS 0x382DD6 /end MEASUREMENT
/begin MEASUREMENT B_mxkra02 "" UWORD B_TRUE 1 100 0.00 1.00000000000 BIT_MASK 0x100 FORMAT "%13.11" ECU_ADDRESS 0x382DD8 /end MEASUREMENT
/begin MEASUREMENT B_mxkra03 "" UWORD B_TRUE 1 100 0.00 1.00000000000 BIT_MASK 0x100 FORMAT "%13.11" ECU_ADDRESS 0x382DDA /end MEASUREMENT
/begin MEASUREMENT B_mxkra04 "" UWORD B_TRUE 1 100 0.00 1.00000000000 BIT_MASK 0x100 FORMAT "%13.11" ECU_ADDRESS 0x382DDC /end MEASUREMENT
/begin MEASUREMENT B_mxkra05 "" UWORD B_TRUE 1 100 0.00 1.00000000000 BIT_MASK 0x100 FORMAT "%13.11" ECU_ADDRESS 0x382DDE /end MEASUREMENT
/begin MEASUREMENT B_mxkra06 "" UWORD B_TRUE 1 100 0.00 1.00000000000 BIT_MASK 0x100 FORMAT "%13.11" ECU_ADDRESS 0x382DE0 /end MEASUREMENT
/begin MEASUREMENT B_mxkrnt "" UWORD B_TRUE 1 100 0.00 1.00000000000 BIT_MASK 0x100 FORMAT "%13.11" ECU_ADDRESS 0x382DE2 /end MEASUREMENT
/begin MEASUREMENT B_mxkrof "" UWORD B_TRUE 1 100 0.00 1.00000000000 BIT_MASK 0x100 FORMAT "%13.11" ECU_ADDRESS 0x382DE4 /end MEASUREMENT
/begin MEASUREMENT B_mxkrtp "" UWORD B_TRUE 1 100 0.00 1.00000000000 BIT_MASK 0x100 FORMAT "%13.11" ECU_ADDRESS 0x382DE6 /end MEASUREMENT
/begin MEASUREMENT B_mxks1 "" UWORD B_TRUE 1 100 0.00 1.00000000000 BIT_MASK 0x100 FORMAT "%13.11" ECU_ADDRESS 0x382DE8 /end MEASUREMENT
/begin MEASUREMENT B_mxks2 "" UWORD B_TRUE 1 100 0.00 1.00000000000 BIT_MASK 0x100 FORMAT "%13.11" ECU_ADDRESS 0x382DEA /end MEASUREMENT
/begin MEASUREMENT B_mxks3 "" UWORD B_TRUE 1 100 0.00 1.00000000000 BIT_MASK 0x100 FORMAT "%13.11" ECU_ADDRESS 0x382DEC /end MEASUREMENT
/begin MEASUREMENT B_mxks4 "" UWORD B_TRUE 1 100 0.00 1.00000000000 BIT_MASK 0x100 FORMAT "%13.11" ECU_ADDRESS 0x382DEE /end MEASUREMENT
/begin MEASUREMENT B_mxkuppl "" UWORD B_TRUE 1 100 0.00 1.00000000000 BIT_MASK 0x100 FORMAT "%13.11" ECU_ADDRESS 0x382DF0 /end MEASUREMENT
/begin MEASUREMENT B_mxlash "" UWORD B_TRUE 1 100 0.00 1.00000000000 BIT_MASK 0x100 FORMAT "%13.11" ECU_ADDRESS 0x382DF2 /end MEASUREMENT
/begin MEASUREMENT B_mxlash2 "" UWORD B_TRUE 1 100 0.00 1.00000000000 BIT_MASK 0x100 FORMAT "%13.11" ECU_ADDRESS 0x382DF4 /end MEASUREMENT
/begin MEASUREMENT B_mxlavh "" UWORD B_TRUE 1 100 0.00 1.00000000000 BIT_MASK 0x100 FORMAT "%13.11" ECU_ADDRESS 0x382DF6 /end MEASUREMENT
/begin MEASUREMENT B_mxlavh2 "" UWORD B_TRUE 1 100 0.00 1.00000000000 BIT_MASK 0x100 FORMAT "%13.11" ECU_ADDRESS 0x382DF8 /end MEASUREMENT
/begin MEASUREMENT B_mxllr "" UWORD B_TRUE 1 100 0.00 1.00000000000 BIT_MASK 0x100 FORMAT "%13.11" ECU_ADDRESS 0x382DFC /end MEASUREMENT
/begin MEASUREMENT B_mxlm "" UWORD B_TRUE 1 100 0.00 1.00000000000 BIT_MASK 0x100 FORMAT "%13.11" ECU_ADDRESS 0x382DFE /end MEASUREMENT
/begin MEASUREMENT B_mxlsh "" UWORD B_TRUE 1 100 0.00 1.00000000000 BIT_MASK 0x100 FORMAT "%13.11" ECU_ADDRESS 0x382E00 /end MEASUREMENT
/begin MEASUREMENT B_mxlsh2 "" UWORD B_TRUE 1 100 0.00 1.00000000000 BIT_MASK 0x100 FORMAT "%13.11" ECU_ADDRESS 0x382E02 /end MEASUREMENT
/begin MEASUREMENT B_mxlsvv "" UWORD B_TRUE 1 100 0.00 1.00000000000 BIT_MASK 0x100 FORMAT "%13.11" ECU_ADDRESS 0x382E1E /end MEASUREMENT
/begin MEASUREMENT B_mxlue1 "" UWORD B_TRUE 1 100 0.00 1.00000000000 BIT_MASK 0x100 FORMAT "%13.11" ECU_ADDRESS 0x382E20 /end MEASUREMENT
/begin MEASUREMENT B_mxmd "" UWORD B_TRUE 1 100 0.00 1.00000000000 BIT_MASK 0x100 FORMAT "%13.11" ECU_ADDRESS 0x382E26 /end MEASUREMENT
/begin MEASUREMENT B_mxmd00 "" UWORD B_TRUE 1 100 0.00 1.00000000000 BIT_MASK 0x100 FORMAT "%13.11" ECU_ADDRESS 0x382E28 /end MEASUREMENT
/begin MEASUREMENT B_mxmd01 "" UWORD B_TRUE 1 100 0.00 1.00000000000 BIT_MASK 0x100 FORMAT "%13.11" ECU_ADDRESS 0x382E2A /end MEASUREMENT
/begin MEASUREMENT B_mxmd02 "" UWORD B_TRUE 1 100 0.00 1.00000000000 BIT_MASK 0x100 FORMAT "%13.11" ECU_ADDRESS 0x382E2C /end MEASUREMENT
/begin MEASUREMENT B_mxmd03 "" UWORD B_TRUE 1 100 0.00 1.00000000000 BIT_MASK 0x100 FORMAT "%13.11" ECU_ADDRESS 0x382E2E /end MEASUREMENT
/begin MEASUREMENT B_mxmd04 "" UWORD B_TRUE 1 100 0.00 1.00000000000 BIT_MASK 0x100 FORMAT "%13.11" ECU_ADDRESS 0x382E30 /end MEASUREMENT
/begin MEASUREMENT B_mxmd05 "" UWORD B_TRUE 1 100 0.00 1.00000000000 BIT_MASK 0x100 FORMAT "%13.11" ECU_ADDRESS 0x382E32 /end MEASUREMENT
/begin MEASUREMENT B_mxmfa "" UWORD B_TRUE 1 100 0.00 1.00000000000 BIT_MASK 0x100 FORMAT "%13.11" ECU_ADDRESS 0x382E36 /end MEASUREMENT
/begin MEASUREMENT B_mxnwkw "" UWORD B_TRUE 1 100 0.00 1.00000000000 BIT_MASK 0x100 FORMAT "%13.11" ECU_ADDRESS 0x382E3A /end MEASUREMENT
/begin MEASUREMENT B_mxnwkw2 "" UWORD B_TRUE 1 100 0.00 1.00000000000 BIT_MASK 0x100 FORMAT "%13.11" ECU_ADDRESS 0x382E3C /end MEASUREMENT
/begin MEASUREMENT B_mxnx "" UWORD B_TRUE 1 100 0.00 1.00000000000 BIT_MASK 0x100 FORMAT "%13.11" ECU_ADDRESS 0x382E3E /end MEASUREMENT
/begin MEASUREMENT B_mxph "" UWORD B_TRUE 1 100 0.00 1.00000000000 BIT_MASK 0x100 FORMAT "%13.11" ECU_ADDRESS 0x382E40 /end MEASUREMENT
/begin MEASUREMENT B_mxph2 "" UWORD B_TRUE 1 100 0.00 1.00000000000 BIT_MASK 0x100 FORMAT "%13.11" ECU_ADDRESS 0x382E42 /end MEASUREMENT
/begin MEASUREMENT B_mxpllsu "" UWORD B_TRUE 1 100 0.00 1.00000000000 BIT_MASK 0x100 FORMAT "%13.11" ECU_ADDRESS 0x382E44 /end MEASUREMENT
/begin MEASUREMENT B_mxpllsu2 "" UWORD B_TRUE 1 100 0.00 1.00000000000 BIT_MASK 0x100 FORMAT "%13.11" ECU_ADDRESS 0x382E46 /end MEASUREMENT
/begin MEASUREMENT B_mxrkat "" UWORD B_TRUE 1 100 0.00 1.00000000000 BIT_MASK 0x100 FORMAT "%13.11" ECU_ADDRESS 0x382E4A /end MEASUREMENT
/begin MEASUREMENT B_mxrkat2 "" UWORD B_TRUE 1 100 0.00 1.00000000000 BIT_MASK 0x100 FORMAT "%13.11" ECU_ADDRESS 0x382E4C /end MEASUREMENT
/begin MEASUREMENT B_mxrkaz "" UWORD B_TRUE 1 100 0.00 1.00000000000 BIT_MASK 0x100 FORMAT "%13.11" ECU_ADDRESS 0x382E4E /end MEASUREMENT
/begin MEASUREMENT B_mxrkaz2 "" UWORD B_TRUE 1 100 0.00 1.00000000000 BIT_MASK 0x100 FORMAT "%13.11" ECU_ADDRESS 0x382E50 /end MEASUREMENT
/begin MEASUREMENT B_mxsgeep "" UWORD B_TRUE 1 100 0.00 1.00000000000 BIT_MASK 0x100 FORMAT "%13.11" ECU_ADDRESS 0x382E54 /end MEASUREMENT
/begin MEASUREMENT B_mxsls "" UWORD B_TRUE 1 100 0.00 1.00000000000 BIT_MASK 0x100 FORMAT "%13.11" ECU_ADDRESS 0x382E5A /end MEASUREMENT
/begin MEASUREMENT B_mxsls2 "" UWORD B_TRUE 1 100 0.00 1.00000000000 BIT_MASK 0x100 FORMAT "%13.11" ECU_ADDRESS 0x382E5C /end MEASUREMENT
/begin MEASUREMENT B_mxslv "" UWORD B_TRUE 1 100 0.00 1.00000000000 BIT_MASK 0x100 FORMAT "%13.11" ECU_ADDRESS 0x382E5E /end MEASUREMENT
/begin MEASUREMENT B_mxslv2 "" UWORD B_TRUE 1 100 0.00 1.00000000000 BIT_MASK 0x100 FORMAT "%13.11" ECU_ADDRESS 0x382E60 /end MEASUREMENT
/begin MEASUREMENT B_mxtankl "" UWORD B_TRUE 1 100 0.00 1.00000000000 BIT_MASK 0x100 FORMAT "%13.11" ECU_ADDRESS 0x382E6A /end MEASUREMENT
/begin MEASUREMENT B_mxtes "" UWORD B_TRUE 1 100 0.00 1.00000000000 BIT_MASK 0x100 FORMAT "%13.11" ECU_ADDRESS 0x382E6C /end MEASUREMENT
/begin MEASUREMENT B_mxtesf "" UWORD B_TRUE 1 100 0.00 1.00000000000 BIT_MASK 0x100 FORMAT "%13.11" ECU_ADDRESS 0x382E6E /end MEASUREMENT
/begin MEASUREMENT B_mxtesg "" UWORD B_TRUE 1 100 0.00 1.00000000000 BIT_MASK 0x100 FORMAT "%13.11" ECU_ADDRESS 0x382E70 /end MEASUREMENT
/begin MEASUREMENT B_mxufmv "" UWORD B_TRUE 1 100 0.00 1.00000000000 BIT_MASK 0x100 FORMAT "%13.11" ECU_ADDRESS 0x382E84 /end MEASUREMENT
/begin MEASUREMENT B_mxufnc "" UWORD B_TRUE 1 100 0.00 1.00000000000 BIT_MASK 0x100 FORMAT "%13.11" ECU_ADDRESS 0x382E86 /end MEASUREMENT
/begin MEASUREMENT B_mxufrlip "" UWORD B_TRUE 1 100 0.00 1.00000000000 BIT_MASK 0x100 FORMAT "%13.11" ECU_ADDRESS 0x382E88 /end MEASUREMENT
/begin MEASUREMENT B_mxufsga "" UWORD B_TRUE 1 100 0.00 1.00000000000 BIT_MASK 0x100 FORMAT "%13.11" ECU_ADDRESS 0x382E8A /end MEASUREMENT
/begin MEASUREMENT B_mxufsgb "" UWORD B_TRUE 1 100 0.00 1.00000000000 BIT_MASK 0x100 FORMAT "%13.11" ECU_ADDRESS 0x382E8C /end MEASUREMENT
/begin MEASUREMENT B_mxufska "" UWORD B_TRUE 1 100 0.00 1.00000000000 BIT_MASK 0x100 FORMAT "%13.11" ECU_ADDRESS 0x382E8E /end MEASUREMENT
/begin MEASUREMENT B_mxufspsc "" UWORD B_TRUE 1 100 0.00 1.00000000000 BIT_MASK 0x100 FORMAT "%13.11" ECU_ADDRESS 0x382E90 /end MEASUREMENT
/begin MEASUREMENT B_mxulsu "" UWORD B_TRUE 1 100 0.00 1.00000000000 BIT_MASK 0x100 FORMAT "%13.11" ECU_ADDRESS 0x382E92 /end MEASUREMENT
/begin MEASUREMENT B_mxulsu2 "" UWORD B_TRUE 1 100 0.00 1.00000000000 BIT_MASK 0x100 FORMAT "%13.11" ECU_ADDRESS 0x382E94 /end MEASUREMENT
/begin MEASUREMENT B_mxurram "" UWORD B_TRUE 1 100 0.00 1.00000000000 BIT_MASK 0x100 FORMAT "%13.11" ECU_ADDRESS 0x382E96 /end MEASUREMENT
/begin MEASUREMENT B_mxurrom "" UWORD B_TRUE 1 100 0.00 1.00000000000 BIT_MASK 0x100 FORMAT "%13.11" ECU_ADDRESS 0x382E98 /end MEASUREMENT
/begin MEASUREMENT B_mxurrst "" UWORD B_TRUE 1 100 0.00 1.00000000000 BIT_MASK 0x100 FORMAT "%13.11" ECU_ADDRESS 0x382E9A /end MEASUREMENT
/begin MEASUREMENT B_mxvfz "" UWORD B_TRUE 1 100 0.00 1.00000000000 BIT_MASK 0x100 FORMAT "%13.11" ECU_ADDRESS 0x382E9C /end MEASUREMENT
/begin MEASUREMENT B_npcge "" UWORD B_TRUE 1 100 0.00 1.00000000000 BIT_MASK 0x800 FORMAT "%13.11" ECU_ADDRESS 0x382D54 /end MEASUREMENT
/begin MEASUREMENT B_npddpl "" UWORD B_TRUE 1 100 0.00 1.00000000000 BIT_MASK 0x800 FORMAT "%13.11" ECU_ADDRESS 0x382D6A /end MEASUREMENT
/begin MEASUREMENT B_npdsbkv "" UWORD B_TRUE 1 100 0.00 1.00000000000 BIT_MASK 0x800 FORMAT "%13.11" ECU_ADDRESS 0x382D6C /end MEASUREMENT
/begin MEASUREMENT B_npfrao "" UWORD B_TRUE 1 100 0.00 1.00000000000 BIT_MASK 0x800 FORMAT "%13.11" ECU_ADDRESS 0x382DA6 /end MEASUREMENT
/begin MEASUREMENT B_npfrao2 "" UWORD B_TRUE 1 100 0.00 1.00000000000 BIT_MASK 0x800 FORMAT "%13.11" ECU_ADDRESS 0x382DA8 /end MEASUREMENT
/begin MEASUREMENT B_npfrau "" UWORD B_TRUE 1 100 0.00 1.00000000000 BIT_MASK 0x800 FORMAT "%13.11" ECU_ADDRESS 0x382DAA /end MEASUREMENT
/begin MEASUREMENT B_npfrau2 "" UWORD B_TRUE 1 100 0.00 1.00000000000 BIT_MASK 0x800 FORMAT "%13.11" ECU_ADDRESS 0x382DAC /end MEASUREMENT
/begin MEASUREMENT B_npfrst "" UWORD B_TRUE 1 100 0.00 1.00000000000 BIT_MASK 0x800 FORMAT "%13.11" ECU_ADDRESS 0x382DAE /end MEASUREMENT
/begin MEASUREMENT B_npfrst2 "" UWORD B_TRUE 1 100 0.00 1.00000000000 BIT_MASK 0x800 FORMAT "%13.11" ECU_ADDRESS 0x382DB0 /end MEASUREMENT
/begin MEASUREMENT B_npgecod "" UWORD B_TRUE 1 100 0.00 1.00000000000 BIT_MASK 0x800 FORMAT "%13.11" ECU_ADDRESS 0x382DB2 /end MEASUREMENT
/begin MEASUREMENT B_npkat "" UWORD B_TRUE 1 100 0.00 1.00000000000 BIT_MASK 0x800 FORMAT "%13.11" ECU_ADDRESS 0x382DD0 /end MEASUREMENT
/begin MEASUREMENT B_npkat2 "" UWORD B_TRUE 1 100 0.00 1.00000000000 BIT_MASK 0x800 FORMAT "%13.11" ECU_ADDRESS 0x382DD2 /end MEASUREMENT
/begin MEASUREMENT B_npkrnt "" UWORD B_TRUE 1 100 0.00 1.00000000000 BIT_MASK 0x800 FORMAT "%13.11" ECU_ADDRESS 0x382DE2 /end MEASUREMENT
/begin MEASUREMENT B_npkrof "" UWORD B_TRUE 1 100 0.00 1.00000000000 BIT_MASK 0x800 FORMAT "%13.11" ECU_ADDRESS 0x382DE4 /end MEASUREMENT
/begin MEASUREMENT B_npkrtp "" UWORD B_TRUE 1 100 0.00 1.00000000000 BIT_MASK 0x800 FORMAT "%13.11" ECU_ADDRESS 0x382DE6 /end MEASUREMENT
/begin MEASUREMENT B_npks1 "" UWORD B_TRUE 1 100 0.00 1.00000000000 BIT_MASK 0x800 FORMAT "%13.11" ECU_ADDRESS 0x382DE8 /end MEASUREMENT
/begin MEASUREMENT B_npks2 "" UWORD B_TRUE 1 100 0.00 1.00000000000 BIT_MASK 0x800 FORMAT "%13.11" ECU_ADDRESS 0x382DEA /end MEASUREMENT
/begin MEASUREMENT B_npks3 "" UWORD B_TRUE 1 100 0.00 1.00000000000 BIT_MASK 0x800 FORMAT "%13.11" ECU_ADDRESS 0x382DEC /end MEASUREMENT
/begin MEASUREMENT B_npks4 "" UWORD B_TRUE 1 100 0.00 1.00000000000 BIT_MASK 0x800 FORMAT "%13.11" ECU_ADDRESS 0x382DEE /end MEASUREMENT
/begin MEASUREMENT B_npkuppl "" UWORD B_TRUE 1 100 0.00 1.00000000000 BIT_MASK 0x800 FORMAT "%13.11" ECU_ADDRESS 0x382DF0 /end MEASUREMENT
/begin MEASUREMENT B_nplash "" UWORD B_TRUE 1 100 0.00 1.00000000000 BIT_MASK 0x800 FORMAT "%13.11" ECU_ADDRESS 0x382DF2 /end MEASUREMENT
/begin MEASUREMENT B_nplash2 "" UWORD B_TRUE 1 100 0.00 1.00000000000 BIT_MASK 0x800 FORMAT "%13.11" ECU_ADDRESS 0x382DF4 /end MEASUREMENT
/begin MEASUREMENT B_nplavh "" UWORD B_TRUE 1 100 0.00 1.00000000000 BIT_MASK 0x800 FORMAT "%13.11" ECU_ADDRESS 0x382DF6 /end MEASUREMENT
/begin MEASUREMENT B_nplavh2 "" UWORD B_TRUE 1 100 0.00 1.00000000000 BIT_MASK 0x800 FORMAT "%13.11" ECU_ADDRESS 0x382DF8 /end MEASUREMENT
/begin MEASUREMENT B_npllr "" UWORD B_TRUE 1 100 0.00 1.00000000000 BIT_MASK 0x800 FORMAT "%13.11" ECU_ADDRESS 0x382DFC /end MEASUREMENT
/begin MEASUREMENT B_nplm "" UWORD B_TRUE 1 100 0.00 1.00000000000 BIT_MASK 0x800 FORMAT "%13.11" ECU_ADDRESS 0x382DFE /end MEASUREMENT
/begin MEASUREMENT B_nplsh "" UWORD B_TRUE 1 100 0.00 1.00000000000 BIT_MASK 0x800 FORMAT "%13.11" ECU_ADDRESS 0x382E00 /end MEASUREMENT
/begin MEASUREMENT B_nplsh2 "" UWORD B_TRUE 1 100 0.00 1.00000000000 BIT_MASK 0x800 FORMAT "%13.11" ECU_ADDRESS 0x382E02 /end MEASUREMENT
/begin MEASUREMENT B_nplsvv "" UWORD B_TRUE 1 100 0.00 1.00000000000 BIT_MASK 0x800 FORMAT "%13.11" ECU_ADDRESS 0x382E1E /end MEASUREMENT
/begin MEASUREMENT B_nplue1 "" UWORD B_TRUE 1 100 0.00 1.00000000000 BIT_MASK 0x800 FORMAT "%13.11" ECU_ADDRESS 0x382E20 /end MEASUREMENT
/begin MEASUREMENT B_npmd "" UWORD B_TRUE 1 100 0.00 1.00000000000 BIT_MASK 0x800 FORMAT "%13.11" ECU_ADDRESS 0x382E26 /end MEASUREMENT
/begin MEASUREMENT B_npmd00 "" UWORD B_TRUE 1 100 0.00 1.00000000000 BIT_MASK 0x800 FORMAT "%13.11" ECU_ADDRESS 0x382E28 /end MEASUREMENT
/begin MEASUREMENT B_npmd01 "" UWORD B_TRUE 1 100 0.00 1.00000000000 BIT_MASK 0x800 FORMAT "%13.11" ECU_ADDRESS 0x382E2A /end MEASUREMENT
/begin MEASUREMENT B_npmd02 "" UWORD B_TRUE 1 100 0.00 1.00000000000 BIT_MASK 0x800 FORMAT "%13.11" ECU_ADDRESS 0x382E2C /end MEASUREMENT
/begin MEASUREMENT B_npmd03 "" UWORD B_TRUE 1 100 0.00 1.00000000000 BIT_MASK 0x800 FORMAT "%13.11" ECU_ADDRESS 0x382E2E /end MEASUREMENT
/begin MEASUREMENT B_npmd04 "" UWORD B_TRUE 1 100 0.00 1.00000000000 BIT_MASK 0x800 FORMAT "%13.11" ECU_ADDRESS 0x382E30 /end MEASUREMENT
/begin MEASUREMENT B_npmd05 "" UWORD B_TRUE 1 100 0.00 1.00000000000 BIT_MASK 0x800 FORMAT "%13.11" ECU_ADDRESS 0x382E32 /end MEASUREMENT
/begin MEASUREMENT B_npmfa "" UWORD B_TRUE 1 100 0.00 1.00000000000 BIT_MASK 0x800 FORMAT "%13.11" ECU_ADDRESS 0x382E36 /end MEASUREMENT
/begin MEASUREMENT B_npnwkw "" UWORD B_TRUE 1 100 0.00 1.00000000000 BIT_MASK 0x800 FORMAT "%13.11" ECU_ADDRESS 0x382E3A /end MEASUREMENT
/begin MEASUREMENT B_npnwkw2 "" UWORD B_TRUE 1 100 0.00 1.00000000000 BIT_MASK 0x800 FORMAT "%13.11" ECU_ADDRESS 0x382E3C /end MEASUREMENT
/begin MEASUREMENT B_npnx "" UWORD B_TRUE 1 100 0.00 1.00000000000 BIT_MASK 0x800 FORMAT "%13.11" ECU_ADDRESS 0x382E3E /end MEASUREMENT
/begin MEASUREMENT B_npph "" UWORD B_TRUE 1 100 0.00 1.00000000000 BIT_MASK 0x800 FORMAT "%13.11" ECU_ADDRESS 0x382E40 /end MEASUREMENT
/begin MEASUREMENT B_npph2 "" UWORD B_TRUE 1 100 0.00 1.00000000000 BIT_MASK 0x800 FORMAT "%13.11" ECU_ADDRESS 0x382E42 /end MEASUREMENT
/begin MEASUREMENT B_nppllsu "" UWORD B_TRUE 1 100 0.00 1.00000000000 BIT_MASK 0x800 FORMAT "%13.11" ECU_ADDRESS 0x382E44 /end MEASUREMENT
/begin MEASUREMENT B_nppllsu2 "" UWORD B_TRUE 1 100 0.00 1.00000000000 BIT_MASK 0x800 FORMAT "%13.11" ECU_ADDRESS 0x382E46 /end MEASUREMENT
/begin MEASUREMENT B_nprkat "" UWORD B_TRUE 1 100 0.00 1.00000000000 BIT_MASK 0x800 FORMAT "%13.11" ECU_ADDRESS 0x382E4A /end MEASUREMENT
/begin MEASUREMENT B_nprkat2 "" UWORD B_TRUE 1 100 0.00 1.00000000000 BIT_MASK 0x800 FORMAT "%13.11" ECU_ADDRESS 0x382E4C /end MEASUREMENT
/begin MEASUREMENT B_nprkaz "" UWORD B_TRUE 1 100 0.00 1.00000000000 BIT_MASK 0x800 FORMAT "%13.11" ECU_ADDRESS 0x382E4E /end MEASUREMENT
/begin MEASUREMENT B_nprkaz2 "" UWORD B_TRUE 1 100 0.00 1.00000000000 BIT_MASK 0x800 FORMAT "%13.11" ECU_ADDRESS 0x382E50 /end MEASUREMENT
/begin MEASUREMENT B_npsgeep "" UWORD B_TRUE 1 100 0.00 1.00000000000 BIT_MASK 0x800 FORMAT "%13.11" ECU_ADDRESS 0x382E54 /end MEASUREMENT
/begin MEASUREMENT B_npsls "" UWORD B_TRUE 1 100 0.00 1.00000000000 BIT_MASK 0x800 FORMAT "%13.11" ECU_ADDRESS 0x382E5A /end MEASUREMENT
/begin MEASUREMENT B_npsls2 "" UWORD B_TRUE 1 100 0.00 1.00000000000 BIT_MASK 0x800 FORMAT "%13.11" ECU_ADDRESS 0x382E5C /end MEASUREMENT
/begin MEASUREMENT B_npslv "" UWORD B_TRUE 1 100 0.00 1.00000000000 BIT_MASK 0x800 FORMAT "%13.11" ECU_ADDRESS 0x382E5E /end MEASUREMENT
/begin MEASUREMENT B_npslv2 "" UWORD B_TRUE 1 100 0.00 1.00000000000 BIT_MASK 0x800 FORMAT "%13.11" ECU_ADDRESS 0x382E60 /end MEASUREMENT
/begin MEASUREMENT B_nptankl "" UWORD B_TRUE 1 100 0.00 1.00000000000 BIT_MASK 0x800 FORMAT "%13.11" ECU_ADDRESS 0x382E6A /end MEASUREMENT
/begin MEASUREMENT B_nptes "" UWORD B_TRUE 1 100 0.00 1.00000000000 BIT_MASK 0x800 FORMAT "%13.11" ECU_ADDRESS 0x382E6C /end MEASUREMENT
/begin MEASUREMENT B_nptesf "" UWORD B_TRUE 1 100 0.00 1.00000000000 BIT_MASK 0x800 FORMAT "%13.11" ECU_ADDRESS 0x382E6E /end MEASUREMENT
/begin MEASUREMENT B_nptesg "" UWORD B_TRUE 1 100 0.00 1.00000000000 BIT_MASK 0x800 FORMAT "%13.11" ECU_ADDRESS 0x382E70 /end MEASUREMENT
/begin MEASUREMENT B_npufmv "" UWORD B_TRUE 1 100 0.00 1.00000000000 BIT_MASK 0x800 FORMAT "%13.11" ECU_ADDRESS 0x382E84 /end MEASUREMENT
/begin MEASUREMENT B_npufnc "" UWORD B_TRUE 1 100 0.00 1.00000000000 BIT_MASK 0x800 FORMAT "%13.11" ECU_ADDRESS 0x382E86 /end MEASUREMENT
/begin MEASUREMENT B_npufrlip "" UWORD B_TRUE 1 100 0.00 1.00000000000 BIT_MASK 0x800 FORMAT "%13.11" ECU_ADDRESS 0x382E88 /end MEASUREMENT
/begin MEASUREMENT B_npufsga "" UWORD B_TRUE 1 100 0.00 1.00000000000 BIT_MASK 0x800 FORMAT "%13.11" ECU_ADDRESS 0x382E8A /end MEASUREMENT
/begin MEASUREMENT B_npufsgb "" UWORD B_TRUE 1 100 0.00 1.00000000000 BIT_MASK 0x800 FORMAT "%13.11" ECU_ADDRESS 0x382E8C /end MEASUREMENT
/begin MEASUREMENT B_npufska "" UWORD B_TRUE 1 100 0.00 1.00000000000 BIT_MASK 0x800 FORMAT "%13.11" ECU_ADDRESS 0x382E8E /end MEASUREMENT
/begin MEASUREMENT B_npufspsc "" UWORD B_TRUE 1 100 0.00 1.00000000000 BIT_MASK 0x800 FORMAT "%13.11" ECU_ADDRESS 0x382E90 /end MEASUREMENT
/begin MEASUREMENT B_npulsu "" UWORD B_TRUE 1 100 0.00 1.00000000000 BIT_MASK 0x800 FORMAT "%13.11" ECU_ADDRESS 0x382E92 /end MEASUREMENT
/begin MEASUREMENT B_npulsu2 "" UWORD B_TRUE 1 100 0.00 1.00000000000 BIT_MASK 0x800 FORMAT "%13.11" ECU_ADDRESS 0x382E94 /end MEASUREMENT
/begin MEASUREMENT B_npurram "" UWORD B_TRUE 1 100 0.00 1.00000000000 BIT_MASK 0x800 FORMAT "%13.11" ECU_ADDRESS 0x382E96 /end MEASUREMENT
/begin MEASUREMENT B_npurrom "" UWORD B_TRUE 1 100 0.00 1.00000000000 BIT_MASK 0x800 FORMAT "%13.11" ECU_ADDRESS 0x382E98 /end MEASUREMENT
/begin MEASUREMENT B_npurrst "" UWORD B_TRUE 1 100 0.00 1.00000000000 BIT_MASK 0x800 FORMAT "%13.11" ECU_ADDRESS 0x382E9A /end MEASUREMENT
/begin MEASUREMENT B_npvfz "" UWORD B_TRUE 1 100 0.00 1.00000000000 BIT_MASK 0x800 FORMAT "%13.11" ECU_ADDRESS 0x382E9C /end MEASUREMENT
/begin MEASUREMENT B_pygecod "" UWORD B_TRUE 1 100 0.00 1.00000000000 BIT_MASK 0x2000 FORMAT "%13.11" ECU_ADDRESS 0x382DB2 /end MEASUREMENT
/begin MEASUREMENT B_pytes "" UWORD B_TRUE 1 100 0.00 1.00000000000 BIT_MASK 0x2000 FORMAT "%13.11" ECU_ADDRESS 0x382E6C /end MEASUREMENT
/begin MEASUREMENT B_scgecod "" UWORD B_TRUE 1 100 0.00 1.00000000000 BIT_MASK 0x4000 FORMAT "%13.11" ECU_ADDRESS 0x382DB2 /end MEASUREMENT
/begin MEASUREMENT B_sctes "" UWORD B_TRUE 1 100 0.00 1.00000000000 BIT_MASK 0x4000 FORMAT "%13.11" ECU_ADDRESS 0x382E6C /end MEASUREMENT
/begin MEASUREMENT B_sicge "" UWORD B_TRUE 1 100 0.00 1.00000000000 BIT_MASK 0x400 FORMAT "%13.11" ECU_ADDRESS 0x382D54 /end MEASUREMENT
/begin MEASUREMENT B_siddpl "" UWORD B_TRUE 1 100 0.00 1.00000000000 BIT_MASK 0x400 FORMAT "%13.11" ECU_ADDRESS 0x382D6A /end MEASUREMENT
/begin MEASUREMENT B_sidsbkv "" UWORD B_TRUE 1 100 0.00 1.00000000000 BIT_MASK 0x400 FORMAT "%13.11" ECU_ADDRESS 0x382D6C /end MEASUREMENT
/begin MEASUREMENT B_sifrao "" UWORD B_TRUE 1 100 0.00 1.00000000000 BIT_MASK 0x400 FORMAT "%13.11" ECU_ADDRESS 0x382DA6 /end MEASUREMENT
/begin MEASUREMENT B_sifrao2 "" UWORD B_TRUE 1 100 0.00 1.00000000000 BIT_MASK 0x400 FORMAT "%13.11" ECU_ADDRESS 0x382DA8 /end MEASUREMENT
/begin MEASUREMENT B_sifrau "" UWORD B_TRUE 1 100 0.00 1.00000000000 BIT_MASK 0x400 FORMAT "%13.11" ECU_ADDRESS 0x382DAA /end MEASUREMENT
/begin MEASUREMENT B_sifrau2 "" UWORD B_TRUE 1 100 0.00 1.00000000000 BIT_MASK 0x400 FORMAT "%13.11" ECU_ADDRESS 0x382DAC /end MEASUREMENT
/begin MEASUREMENT B_sifrst "" UWORD B_TRUE 1 100 0.00 1.00000000000 BIT_MASK 0x400 FORMAT "%13.11" ECU_ADDRESS 0x382DAE /end MEASUREMENT
/begin MEASUREMENT B_sifrst2 "" UWORD B_TRUE 1 100 0.00 1.00000000000 BIT_MASK 0x400 FORMAT "%13.11" ECU_ADDRESS 0x382DB0 /end MEASUREMENT
/begin MEASUREMENT B_sigecod "" UWORD B_TRUE 1 100 0.00 1.00000000000 BIT_MASK 0x400 FORMAT "%13.11" ECU_ADDRESS 0x382DB2 /end MEASUREMENT
/begin MEASUREMENT B_sikat "" UWORD B_TRUE 1 100 0.00 1.00000000000 BIT_MASK 0x400 FORMAT "%13.11" ECU_ADDRESS 0x382DD0 /end MEASUREMENT
/begin MEASUREMENT B_sikat2 "" UWORD B_TRUE 1 100 0.00 1.00000000000 BIT_MASK 0x400 FORMAT "%13.11" ECU_ADDRESS 0x382DD2 /end MEASUREMENT
/begin MEASUREMENT B_sikrnt "" UWORD B_TRUE 1 100 0.00 1.00000000000 BIT_MASK 0x400 FORMAT "%13.11" ECU_ADDRESS 0x382DE2 /end MEASUREMENT
/begin MEASUREMENT B_sikrof "" UWORD B_TRUE 1 100 0.00 1.00000000000 BIT_MASK 0x400 FORMAT "%13.11" ECU_ADDRESS 0x382DE4 /end MEASUREMENT
/begin MEASUREMENT B_sikrtp "" UWORD B_TRUE 1 100 0.00 1.00000000000 BIT_MASK 0x400 FORMAT "%13.11" ECU_ADDRESS 0x382DE6 /end MEASUREMENT
/begin MEASUREMENT B_siks1 "" UWORD B_TRUE 1 100 0.00 1.00000000000 BIT_MASK 0x400 FORMAT "%13.11" ECU_ADDRESS 0x382DE8 /end MEASUREMENT
/begin MEASUREMENT B_siks2 "" UWORD B_TRUE 1 100 0.00 1.00000000000 BIT_MASK 0x400 FORMAT "%13.11" ECU_ADDRESS 0x382DEA /end MEASUREMENT
/begin MEASUREMENT B_siks3 "" UWORD B_TRUE 1 100 0.00 1.00000000000 BIT_MASK 0x400 FORMAT "%13.11" ECU_ADDRESS 0x382DEC /end MEASUREMENT
/begin MEASUREMENT B_siks4 "" UWORD B_TRUE 1 100 0.00 1.00000000000 BIT_MASK 0x400 FORMAT "%13.11" ECU_ADDRESS 0x382DEE /end MEASUREMENT
/begin MEASUREMENT B_sikuppl "" UWORD B_TRUE 1 100 0.00 1.00000000000 BIT_MASK 0x400 FORMAT "%13.11" ECU_ADDRESS 0x382DF0 /end MEASUREMENT
/begin MEASUREMENT B_silash "" UWORD B_TRUE 1 100 0.00 1.00000000000 BIT_MASK 0x400 FORMAT "%13.11" ECU_ADDRESS 0x382DF2 /end MEASUREMENT
/begin MEASUREMENT B_silash2 "" UWORD B_TRUE 1 100 0.00 1.00000000000 BIT_MASK 0x400 FORMAT "%13.11" ECU_ADDRESS 0x382DF4 /end MEASUREMENT
/begin MEASUREMENT B_silavh "" UWORD B_TRUE 1 100 0.00 1.00000000000 BIT_MASK 0x400 FORMAT "%13.11" ECU_ADDRESS 0x382DF6 /end MEASUREMENT
/begin MEASUREMENT B_silavh2 "" UWORD B_TRUE 1 100 0.00 1.00000000000 BIT_MASK 0x400 FORMAT "%13.11" ECU_ADDRESS 0x382DF8 /end MEASUREMENT
/begin MEASUREMENT B_sillr "" UWORD B_TRUE 1 100 0.00 1.00000000000 BIT_MASK 0x400 FORMAT "%13.11" ECU_ADDRESS 0x382DFC /end MEASUREMENT
/begin MEASUREMENT B_silm "" UWORD B_TRUE 1 100 0.00 1.00000000000 BIT_MASK 0x400 FORMAT "%13.11" ECU_ADDRESS 0x382DFE /end MEASUREMENT
/begin MEASUREMENT B_silsh "" UWORD B_TRUE 1 100 0.00 1.00000000000 BIT_MASK 0x400 FORMAT "%13.11" ECU_ADDRESS 0x382E00 /end MEASUREMENT
/begin MEASUREMENT B_silsh2 "" UWORD B_TRUE 1 100 0.00 1.00000000000 BIT_MASK 0x400 FORMAT "%13.11" ECU_ADDRESS 0x382E02 /end MEASUREMENT
/begin MEASUREMENT B_silsvv "" UWORD B_TRUE 1 100 0.00 1.00000000000 BIT_MASK 0x400 FORMAT "%13.11" ECU_ADDRESS 0x382E1E /end MEASUREMENT
/begin MEASUREMENT B_silue1 "" UWORD B_TRUE 1 100 0.00 1.00000000000 BIT_MASK 0x400 FORMAT "%13.11" ECU_ADDRESS 0x382E20 /end MEASUREMENT
/begin MEASUREMENT B_simd "" UWORD B_TRUE 1 100 0.00 1.00000000000 BIT_MASK 0x400 FORMAT "%13.11" ECU_ADDRESS 0x382E26 /end MEASUREMENT
/begin MEASUREMENT B_simd00 "" UWORD B_TRUE 1 100 0.00 1.00000000000 BIT_MASK 0x400 FORMAT "%13.11" ECU_ADDRESS 0x382E28 /end MEASUREMENT
/begin MEASUREMENT B_simd01 "" UWORD B_TRUE 1 100 0.00 1.00000000000 BIT_MASK 0x400 FORMAT "%13.11" ECU_ADDRESS 0x382E2A /end MEASUREMENT
/begin MEASUREMENT B_simd02 "" UWORD B_TRUE 1 100 0.00 1.00000000000 BIT_MASK 0x400 FORMAT "%13.11" ECU_ADDRESS 0x382E2C /end MEASUREMENT
/begin MEASUREMENT B_simd03 "" UWORD B_TRUE 1 100 0.00 1.00000000000 BIT_MASK 0x400 FORMAT "%13.11" ECU_ADDRESS 0x382E2E /end MEASUREMENT
/begin MEASUREMENT B_simd04 "" UWORD B_TRUE 1 100 0.00 1.00000000000 BIT_MASK 0x400 FORMAT "%13.11" ECU_ADDRESS 0x382E30 /end MEASUREMENT
/begin MEASUREMENT B_simd05 "" UWORD B_TRUE 1 100 0.00 1.00000000000 BIT_MASK 0x400 FORMAT "%13.11" ECU_ADDRESS 0x382E32 /end MEASUREMENT
/begin MEASUREMENT B_simfa "" UWORD B_TRUE 1 100 0.00 1.00000000000 BIT_MASK 0x400 FORMAT "%13.11" ECU_ADDRESS 0x382E36 /end MEASUREMENT
/begin MEASUREMENT B_sinwkw "" UWORD B_TRUE 1 100 0.00 1.00000000000 BIT_MASK 0x400 FORMAT "%13.11" ECU_ADDRESS 0x382E3A /end MEASUREMENT
/begin MEASUREMENT B_sinwkw2 "" UWORD B_TRUE 1 100 0.00 1.00000000000 BIT_MASK 0x400 FORMAT "%13.11" ECU_ADDRESS 0x382E3C /end MEASUREMENT
/begin MEASUREMENT B_sinx "" UWORD B_TRUE 1 100 0.00 1.00000000000 BIT_MASK 0x400 FORMAT "%13.11" ECU_ADDRESS 0x382E3E /end MEASUREMENT
/begin MEASUREMENT B_siph "" UWORD B_TRUE 1 100 0.00 1.00000000000 BIT_MASK 0x400 FORMAT "%13.11" ECU_ADDRESS 0x382E40 /end MEASUREMENT
/begin MEASUREMENT B_siph2 "" UWORD B_TRUE 1 100 0.00 1.00000000000 BIT_MASK 0x400 FORMAT "%13.11" ECU_ADDRESS 0x382E42 /end MEASUREMENT
/begin MEASUREMENT B_sipllsu "" UWORD B_TRUE 1 100 0.00 1.00000000000 BIT_MASK 0x400 FORMAT "%13.11" ECU_ADDRESS 0x382E44 /end MEASUREMENT
/begin MEASUREMENT B_sipllsu2 "" UWORD B_TRUE 1 100 0.00 1.00000000000 BIT_MASK 0x400 FORMAT "%13.11" ECU_ADDRESS 0x382E46 /end MEASUREMENT
/begin MEASUREMENT B_sirkat "" UWORD B_TRUE 1 100 0.00 1.00000000000 BIT_MASK 0x400 FORMAT "%13.11" ECU_ADDRESS 0x382E4A /end MEASUREMENT
/begin MEASUREMENT B_sirkat2 "" UWORD B_TRUE 1 100 0.00 1.00000000000 BIT_MASK 0x400 FORMAT "%13.11" ECU_ADDRESS 0x382E4C /end MEASUREMENT
/begin MEASUREMENT B_sirkaz "" UWORD B_TRUE 1 100 0.00 1.00000000000 BIT_MASK 0x400 FORMAT "%13.11" ECU_ADDRESS 0x382E4E /end MEASUREMENT
/begin MEASUREMENT B_sirkaz2 "" UWORD B_TRUE 1 100 0.00 1.00000000000 BIT_MASK 0x400 FORMAT "%13.11" ECU_ADDRESS 0x382E50 /end MEASUREMENT
/begin MEASUREMENT B_sisgeep "" UWORD B_TRUE 1 100 0.00 1.00000000000 BIT_MASK 0x400 FORMAT "%13.11" ECU_ADDRESS 0x382E54 /end MEASUREMENT
/begin MEASUREMENT B_sisls "" UWORD B_TRUE 1 100 0.00 1.00000000000 BIT_MASK 0x400 FORMAT "%13.11" ECU_ADDRESS 0x382E5A /end MEASUREMENT
/begin MEASUREMENT B_sisls2 "" UWORD B_TRUE 1 100 0.00 1.00000000000 BIT_MASK 0x400 FORMAT "%13.11" ECU_ADDRESS 0x382E5C /end MEASUREMENT
/begin MEASUREMENT B_sislv "" UWORD B_TRUE 1 100 0.00 1.00000000000 BIT_MASK 0x400 FORMAT "%13.11" ECU_ADDRESS 0x382E5E /end MEASUREMENT
/begin MEASUREMENT B_sislv2 "" UWORD B_TRUE 1 100 0.00 1.00000000000 BIT_MASK 0x400 FORMAT "%13.11" ECU_ADDRESS 0x382E60 /end MEASUREMENT
/begin MEASUREMENT B_sitankl "" UWORD B_TRUE 1 100 0.00 1.00000000000 BIT_MASK 0x400 FORMAT "%13.11" ECU_ADDRESS 0x382E6A /end MEASUREMENT
/begin MEASUREMENT B_sites "" UWORD B_TRUE 1 100 0.00 1.00000000000 BIT_MASK 0x400 FORMAT "%13.11" ECU_ADDRESS 0x382E6C /end MEASUREMENT
/begin MEASUREMENT B_sitesf "" UWORD B_TRUE 1 100 0.00 1.00000000000 BIT_MASK 0x400 FORMAT "%13.11" ECU_ADDRESS 0x382E6E /end MEASUREMENT
/begin MEASUREMENT B_sitesg "" UWORD B_TRUE 1 100 0.00 1.00000000000 BIT_MASK 0x400 FORMAT "%13.11" ECU_ADDRESS 0x382E70 /end MEASUREMENT
/begin MEASUREMENT B_siufmv "" UWORD B_TRUE 1 100 0.00 1.00000000000 BIT_MASK 0x400 FORMAT "%13.11" ECU_ADDRESS 0x382E84 /end MEASUREMENT
/begin MEASUREMENT B_siufnc "" UWORD B_TRUE 1 100 0.00 1.00000000000 BIT_MASK 0x400 FORMAT "%13.11" ECU_ADDRESS 0x382E86 /end MEASUREMENT
/begin MEASUREMENT B_siufrlip "" UWORD B_TRUE 1 100 0.00 1.00000000000 BIT_MASK 0x400 FORMAT "%13.11" ECU_ADDRESS 0x382E88 /end MEASUREMENT
/begin MEASUREMENT B_siufsga "" UWORD B_TRUE 1 100 0.00 1.00000000000 BIT_MASK 0x400 FORMAT "%13.11" ECU_ADDRESS 0x382E8A /end MEASUREMENT
/begin MEASUREMENT B_siufsgb "" UWORD B_TRUE 1 100 0.00 1.00000000000 BIT_MASK 0x400 FORMAT "%13.11" ECU_ADDRESS 0x382E8C /end MEASUREMENT
/begin MEASUREMENT B_siufska "" UWORD B_TRUE 1 100 0.00 1.00000000000 BIT_MASK 0x400 FORMAT "%13.11" ECU_ADDRESS 0x382E8E /end MEASUREMENT
/begin MEASUREMENT B_siufspsc "" UWORD B_TRUE 1 100 0.00 1.00000000000 BIT_MASK 0x400 FORMAT "%13.11" ECU_ADDRESS 0x382E90 /end MEASUREMENT
/begin MEASUREMENT B_siulsu "" UWORD B_TRUE 1 100 0.00 1.00000000000 BIT_MASK 0x400 FORMAT "%13.11" ECU_ADDRESS 0x382E92 /end MEASUREMENT
/begin MEASUREMENT B_siulsu2 "" UWORD B_TRUE 1 100 0.00 1.00000000000 BIT_MASK 0x400 FORMAT "%13.11" ECU_ADDRESS 0x382E94 /end MEASUREMENT
/begin MEASUREMENT B_siurram "" UWORD B_TRUE 1 100 0.00 1.00000000000 BIT_MASK 0x400 FORMAT "%13.11" ECU_ADDRESS 0x382E96 /end MEASUREMENT
/begin MEASUREMENT B_siurrom "" UWORD B_TRUE 1 100 0.00 1.00000000000 BIT_MASK 0x400 FORMAT "%13.11" ECU_ADDRESS 0x382E98 /end MEASUREMENT
/begin MEASUREMENT B_siurrst "" UWORD B_TRUE 1 100 0.00 1.00000000000 BIT_MASK 0x400 FORMAT "%13.11" ECU_ADDRESS 0x382E9A /end MEASUREMENT
/begin MEASUREMENT B_sivfz "" UWORD B_TRUE 1 100 0.00 1.00000000000 BIT_MASK 0x400 FORMAT "%13.11" ECU_ADDRESS 0x382E9C /end MEASUREMENT
/begin MEASUREMENT E_cge "" UWORD B_TRUE 1 100 0.00 1.00000000000 BIT_MASK 0x1 FORMAT "%13.11" ECU_ADDRESS 0x382D54 /end MEASUREMENT
/begin MEASUREMENT E_dpl "" UWORD B_TRUE 1 100 0.00 1.00000000000 BIT_MASK 0x1 FORMAT "%13.11" ECU_ADDRESS 0x382D6A /end MEASUREMENT
/begin MEASUREMENT E_dsbkv "" UWORD B_TRUE 1 100 0.00 1.00000000000 BIT_MASK 0x1 FORMAT "%13.11" ECU_ADDRESS 0x382D6C /end MEASUREMENT
/begin MEASUREMENT E_frao "" UWORD B_TRUE 1 100 0.00 1.00000000000 BIT_MASK 0x1 FORMAT "%13.11" ECU_ADDRESS 0x382DA6 /end MEASUREMENT
/begin MEASUREMENT E_frao2 "" UWORD B_TRUE 1 100 0.00 1.00000000000 BIT_MASK 0x1 FORMAT "%13.11" ECU_ADDRESS 0x382DA8 /end MEASUREMENT
/begin MEASUREMENT E_frau "" UWORD B_TRUE 1 100 0.00 1.00000000000 BIT_MASK 0x1 FORMAT "%13.11" ECU_ADDRESS 0x382DAA /end MEASUREMENT
/begin MEASUREMENT E_frau2 "" UWORD B_TRUE 1 100 0.00 1.00000000000 BIT_MASK 0x1 FORMAT "%13.11" ECU_ADDRESS 0x382DAC /end MEASUREMENT
/begin MEASUREMENT E_frst "" UWORD B_TRUE 1 100 0.00 1.00000000000 BIT_MASK 0x1 FORMAT "%13.11" ECU_ADDRESS 0x382DAE /end MEASUREMENT
/begin MEASUREMENT E_frst2 "" UWORD B_TRUE 1 100 0.00 1.00000000000 BIT_MASK 0x1 FORMAT "%13.11" ECU_ADDRESS 0x382DB0 /end MEASUREMENT
/begin MEASUREMENT E_gecod "" UWORD B_TRUE 1 100 0.00 1.00000000000 BIT_MASK 0x1 FORMAT "%13.11" ECU_ADDRESS 0x382DB2 /end MEASUREMENT
/begin MEASUREMENT E_kat "" UWORD B_TRUE 1 100 0.00 1.00000000000 BIT_MASK 0x1 FORMAT "%13.11" ECU_ADDRESS 0x382DD0 /end MEASUREMENT
/begin MEASUREMENT E_kat2 "" UWORD B_TRUE 1 100 0.00 1.00000000000 BIT_MASK 0x1 FORMAT "%13.11" ECU_ADDRESS 0x382DD2 /end MEASUREMENT
/begin MEASUREMENT E_kra01 "" UWORD B_TRUE 1 100 0.00 1.00000000000 BIT_MASK 0x1 FORMAT "%13.11" ECU_ADDRESS 0x382DD6 /end MEASUREMENT
/begin MEASUREMENT E_kra02 "" UWORD B_TRUE 1 100 0.00 1.00000000000 BIT_MASK 0x1 FORMAT "%13.11" ECU_ADDRESS 0x382DD8 /end MEASUREMENT
/begin MEASUREMENT E_kra03 "" UWORD B_TRUE 1 100 0.00 1.00000000000 BIT_MASK 0x1 FORMAT "%13.11" ECU_ADDRESS 0x382DDA /end MEASUREMENT
/begin MEASUREMENT E_kra04 "" UWORD B_TRUE 1 100 0.00 1.00000000000 BIT_MASK 0x1 FORMAT "%13.11" ECU_ADDRESS 0x382DDC /end MEASUREMENT
/begin MEASUREMENT E_kra05 "" UWORD B_TRUE 1 100 0.00 1.00000000000 BIT_MASK 0x1 FORMAT "%13.11" ECU_ADDRESS 0x382DDE /end MEASUREMENT
/begin MEASUREMENT E_kra06 "" UWORD B_TRUE 1 100 0.00 1.00000000000 BIT_MASK 0x1 FORMAT "%13.11" ECU_ADDRESS 0x382DE0 /end MEASUREMENT
/begin MEASUREMENT E_krnt "" UWORD B_TRUE 1 100 0.00 1.00000000000 BIT_MASK 0x1 FORMAT "%13.11" ECU_ADDRESS 0x382DE2 /end MEASUREMENT
/begin MEASUREMENT E_krof "" UWORD B_TRUE 1 100 0.00 1.00000000000 BIT_MASK 0x1 FORMAT "%13.11" ECU_ADDRESS 0x382DE4 /end MEASUREMENT
/begin MEASUREMENT E_krtp "" UWORD B_TRUE 1 100 0.00 1.00000000000 BIT_MASK 0x1 FORMAT "%13.11" ECU_ADDRESS 0x382DE6 /end MEASUREMENT
/begin MEASUREMENT E_ks1 "" UWORD B_TRUE 1 100 0.00 1.00000000000 BIT_MASK 0x1 FORMAT "%13.11" ECU_ADDRESS 0x382DE8 /end MEASUREMENT
/begin MEASUREMENT E_ks2 "" UWORD B_TRUE 1 100 0.00 1.00000000000 BIT_MASK 0x1 FORMAT "%13.11" ECU_ADDRESS 0x382DEA /end MEASUREMENT
/begin MEASUREMENT E_ks3 "" UWORD B_TRUE 1 100 0.00 1.00000000000 BIT_MASK 0x1 FORMAT "%13.11" ECU_ADDRESS 0x382DEC /end MEASUREMENT
/begin MEASUREMENT E_ks4 "" UWORD B_TRUE 1 100 0.00 1.00000000000 BIT_MASK 0x1 FORMAT "%13.11" ECU_ADDRESS 0x382DEE /end MEASUREMENT
/begin MEASUREMENT E_kuppl "" UWORD B_TRUE 1 100 0.00 1.00000000000 BIT_MASK 0x1 FORMAT "%13.11" ECU_ADDRESS 0x382DF0 /end MEASUREMENT
/begin MEASUREMENT E_lash "" UWORD B_TRUE 1 100 0.00 1.00000000000 BIT_MASK 0x1 FORMAT "%13.11" ECU_ADDRESS 0x382DF2 /end MEASUREMENT
/begin MEASUREMENT E_lash2 "" UWORD B_TRUE 1 100 0.00 1.00000000000 BIT_MASK 0x1 FORMAT "%13.11" ECU_ADDRESS 0x382DF4 /end MEASUREMENT
/begin MEASUREMENT E_lavh "" UWORD B_TRUE 1 100 0.00 1.00000000000 BIT_MASK 0x1 FORMAT "%13.11" ECU_ADDRESS 0x382DF6 /end MEASUREMENT
/begin MEASUREMENT E_lavh2 "" UWORD B_TRUE 1 100 0.00 1.00000000000 BIT_MASK 0x1 FORMAT "%13.11" ECU_ADDRESS 0x382DF8 /end MEASUREMENT
/begin MEASUREMENT E_llr "" UWORD B_TRUE 1 100 0.00 1.00000000000 BIT_MASK 0x1 FORMAT "%13.11" ECU_ADDRESS 0x382DFC /end MEASUREMENT
/begin MEASUREMENT E_lm "" UWORD B_TRUE 1 100 0.00 1.00000000000 BIT_MASK 0x1 FORMAT "%13.11" ECU_ADDRESS 0x382DFE /end MEASUREMENT
/begin MEASUREMENT E_lsh "" UWORD B_TRUE 1 100 0.00 1.00000000000 BIT_MASK 0x1 FORMAT "%13.11" ECU_ADDRESS 0x382E00 /end MEASUREMENT
/begin MEASUREMENT E_lsh2 "" UWORD B_TRUE 1 100 0.00 1.00000000000 BIT_MASK 0x1 FORMAT "%13.11" ECU_ADDRESS 0x382E02 /end MEASUREMENT
/begin MEASUREMENT E_lsvv "" UWORD B_TRUE 1 100 0.00 1.00000000000 BIT_MASK 0x1 FORMAT "%13.11" ECU_ADDRESS 0x382E1E /end MEASUREMENT
/begin MEASUREMENT E_lue1 "" UWORD B_TRUE 1 100 0.00 1.00000000000 BIT_MASK 0x1 FORMAT "%13.11" ECU_ADDRESS 0x382E20 /end MEASUREMENT
/begin MEASUREMENT E_md "" UWORD B_TRUE 1 100 0.00 1.00000000000 BIT_MASK 0x1 FORMAT "%13.11" ECU_ADDRESS 0x382E26 /end MEASUREMENT
/begin MEASUREMENT E_md00 "" UWORD B_TRUE 1 100 0.00 1.00000000000 BIT_MASK 0x1 FORMAT "%13.11" ECU_ADDRESS 0x382E28 /end MEASUREMENT
/begin MEASUREMENT E_md01 "" UWORD B_TRUE 1 100 0.00 1.00000000000 BIT_MASK 0x1 FORMAT "%13.11" ECU_ADDRESS 0x382E2A /end MEASUREMENT
/begin MEASUREMENT E_md02 "" UWORD B_TRUE 1 100 0.00 1.00000000000 BIT_MASK 0x1 FORMAT "%13.11" ECU_ADDRESS 0x382E2C /end MEASUREMENT
/begin MEASUREMENT E_md03 "" UWORD B_TRUE 1 100 0.00 1.00000000000 BIT_MASK 0x1 FORMAT "%13.11" ECU_ADDRESS 0x382E2E /end MEASUREMENT
/begin MEASUREMENT E_md04 "" UWORD B_TRUE 1 100 0.00 1.00000000000 BIT_MASK 0x1 FORMAT "%13.11" ECU_ADDRESS 0x382E30 /end MEASUREMENT
/begin MEASUREMENT E_md05 "" UWORD B_TRUE 1 100 0.00 1.00000000000 BIT_MASK 0x1 FORMAT "%13.11" ECU_ADDRESS 0x382E32 /end MEASUREMENT
/begin MEASUREMENT E_mfa "" UWORD B_TRUE 1 100 0.00 1.00000000000 BIT_MASK 0x1 FORMAT "%13.11" ECU_ADDRESS 0x382E36 /end MEASUREMENT
/begin MEASUREMENT E_nwkw "" UWORD B_TRUE 1 100 0.00 1.00000000000 BIT_MASK 0x1 FORMAT "%13.11" ECU_ADDRESS 0x382E3A /end MEASUREMENT
/begin MEASUREMENT E_nwkw2 "" UWORD B_TRUE 1 100 0.00 1.00000000000 BIT_MASK 0x1 FORMAT "%13.11" ECU_ADDRESS 0x382E3C /end MEASUREMENT
/begin MEASUREMENT E_nx "" UWORD B_TRUE 1 100 0.00 1.00000000000 BIT_MASK 0x1 FORMAT "%13.11" ECU_ADDRESS 0x382E3E /end MEASUREMENT
/begin MEASUREMENT E_ph "" UWORD B_TRUE 1 100 0.00 1.00000000000 BIT_MASK 0x1 FORMAT "%13.11" ECU_ADDRESS 0x382E40 /end MEASUREMENT
/begin MEASUREMENT E_ph2 "" UWORD B_TRUE 1 100 0.00 1.00000000000 BIT_MASK 0x1 FORMAT "%13.11" ECU_ADDRESS 0x382E42 /end MEASUREMENT
/begin MEASUREMENT E_pllsu "" UWORD B_TRUE 1 100 0.00 1.00000000000 BIT_MASK 0x1 FORMAT "%13.11" ECU_ADDRESS 0x382E44 /end MEASUREMENT
/begin MEASUREMENT E_pllsu2 "" UWORD B_TRUE 1 100 0.00 1.00000000000 BIT_MASK 0x1 FORMAT "%13.11" ECU_ADDRESS 0x382E46 /end MEASUREMENT
/begin MEASUREMENT E_rkat "" UWORD B_TRUE 1 100 0.00 1.00000000000 BIT_MASK 0x1 FORMAT "%13.11" ECU_ADDRESS 0x382E4A /end MEASUREMENT
/begin MEASUREMENT E_rkat2 "" UWORD B_TRUE 1 100 0.00 1.00000000000 BIT_MASK 0x1 FORMAT "%13.11" ECU_ADDRESS 0x382E4C /end MEASUREMENT
/begin MEASUREMENT E_rkaz "" UWORD B_TRUE 1 100 0.00 1.00000000000 BIT_MASK 0x1 FORMAT "%13.11" ECU_ADDRESS 0x382E4E /end MEASUREMENT
/begin MEASUREMENT E_rkaz2 "" UWORD B_TRUE 1 100 0.00 1.00000000000 BIT_MASK 0x1 FORMAT "%13.11" ECU_ADDRESS 0x382E50 /end MEASUREMENT
/begin MEASUREMENT E_sgeep "" UWORD B_TRUE 1 100 0.00 1.00000000000 BIT_MASK 0x1 FORMAT "%13.11" ECU_ADDRESS 0x382E54 /end MEASUREMENT
/begin MEASUREMENT E_sls "" UWORD B_TRUE 1 100 0.00 1.00000000000 BIT_MASK 0x1 FORMAT "%13.11" ECU_ADDRESS 0x382E5A /end MEASUREMENT
/begin MEASUREMENT E_sls2 "" UWORD B_TRUE 1 100 0.00 1.00000000000 BIT_MASK 0x1 FORMAT "%13.11" ECU_ADDRESS 0x382E5C /end MEASUREMENT
/begin MEASUREMENT E_slv "" UWORD B_TRUE 1 100 0.00 1.00000000000 BIT_MASK 0x1 FORMAT "%13.11" ECU_ADDRESS 0x382E5E /end MEASUREMENT
/begin MEASUREMENT E_slv2 "" UWORD B_TRUE 1 100 0.00 1.00000000000 BIT_MASK 0x1 FORMAT "%13.11" ECU_ADDRESS 0x382E60 /end MEASUREMENT
/begin MEASUREMENT E_tankl "" UWORD B_TRUE 1 100 0.00 1.00000000000 BIT_MASK 0x1 FORMAT "%13.11" ECU_ADDRESS 0x382E6A /end MEASUREMENT
/begin MEASUREMENT E_tes "" UWORD B_TRUE 1 100 0.00 1.00000000000 BIT_MASK 0x1 FORMAT "%13.11" ECU_ADDRESS 0x382E6C /end MEASUREMENT
/begin MEASUREMENT E_tesf "" UWORD B_TRUE 1 100 0.00 1.00000000000 BIT_MASK 0x1 FORMAT "%13.11" ECU_ADDRESS 0x382E6E /end MEASUREMENT
/begin MEASUREMENT E_tesg "" UWORD B_TRUE 1 100 0.00 1.00000000000 BIT_MASK 0x1 FORMAT "%13.11" ECU_ADDRESS 0x382E70 /end MEASUREMENT
/begin MEASUREMENT E_teve2 "" UWORD B_TRUE 1 100 0.00 1.00000000000 BIT_MASK 0x1 FORMAT "%13.11" ECU_ADDRESS 0x382E74 /end MEASUREMENT
/begin MEASUREMENT E_ufmv "" UWORD B_TRUE 1 100 0.00 1.00000000000 BIT_MASK 0x1 FORMAT "%13.11" ECU_ADDRESS 0x382E84 /end MEASUREMENT
/begin MEASUREMENT E_ufnc "" UWORD B_TRUE 1 100 0.00 1.00000000000 BIT_MASK 0x1 FORMAT "%13.11" ECU_ADDRESS 0x382E86 /end MEASUREMENT
/begin MEASUREMENT E_ufrlip "" UWORD B_TRUE 1 100 0.00 1.00000000000 BIT_MASK 0x1 FORMAT "%13.11" ECU_ADDRESS 0x382E88 /end MEASUREMENT
/begin MEASUREMENT E_ufsga "" UWORD B_TRUE 1 100 0.00 1.00000000000 BIT_MASK 0x1 FORMAT "%13.11" ECU_ADDRESS 0x382E8A /end MEASUREMENT
/begin MEASUREMENT E_ufsgb "" UWORD B_TRUE 1 100 0.00 1.00000000000 BIT_MASK 0x1 FORMAT "%13.11" ECU_ADDRESS 0x382E8C /end MEASUREMENT
/begin MEASUREMENT E_ufska "" UWORD B_TRUE 1 100 0.00 1.00000000000 BIT_MASK 0x1 FORMAT "%13.11" ECU_ADDRESS 0x382E8E /end MEASUREMENT
/begin MEASUREMENT E_ufspsc "" UWORD B_TRUE 1 100 0.00 1.00000000000 BIT_MASK 0x1 FORMAT "%13.11" ECU_ADDRESS 0x382E90 /end MEASUREMENT
/begin MEASUREMENT E_ulsu "" UWORD B_TRUE 1 100 0.00 1.00000000000 BIT_MASK 0x1 FORMAT "%13.11" ECU_ADDRESS 0x382E92 /end MEASUREMENT
/begin MEASUREMENT E_ulsu2 "" UWORD B_TRUE 1 100 0.00 1.00000000000 BIT_MASK 0x1 FORMAT "%13.11" ECU_ADDRESS 0x382E94 /end MEASUREMENT
/begin MEASUREMENT E_urram "" UWORD B_TRUE 1 100 0.00 1.00000000000 BIT_MASK 0x1 FORMAT "%13.11" ECU_ADDRESS 0x382E96 /end MEASUREMENT
/begin MEASUREMENT E_urrom "" UWORD B_TRUE 1 100 0.00 1.00000000000 BIT_MASK 0x1 FORMAT "%13.11" ECU_ADDRESS 0x382E98 /end MEASUREMENT
/begin MEASUREMENT E_urrst "" UWORD B_TRUE 1 100 0.00 1.00000000000 BIT_MASK 0x1 FORMAT "%13.11" ECU_ADDRESS 0x382E9A /end MEASUREMENT
/begin MEASUREMENT E_vfz "" UWORD B_TRUE 1 100 0.00 1.00000000000 BIT_MASK 0x1 FORMAT "%13.11" ECU_ADDRESS 0x382E9C /end MEASUREMENT
/begin MEASUREMENT sfpcge "" UWORD default 1 100 0.00 65535.00 FORMAT "%8.2" ECU_ADDRESS 0x382D54 /end MEASUREMENT
/begin MEASUREMENT sfpdpl "" UWORD dez 1 100 0.00 65535.00 FORMAT "%8.2" ECU_ADDRESS 0x382D6A /end MEASUREMENT
/begin MEASUREMENT sfpdsbkv "" UWORD default 1 100 0.00 65535.00 FORMAT "%8.2" ECU_ADDRESS 0x382D6C /end MEASUREMENT
/begin MEASUREMENT sfpfrao "" UWORD dez 1 100 0.00 65535.00 FORMAT "%8.2" ECU_ADDRESS 0x382DA6 /end MEASUREMENT
/begin MEASUREMENT sfpfrao2 "" UWORD dez 1 100 0.00 65535.00 FORMAT "%8.2" ECU_ADDRESS 0x382DA8 /end MEASUREMENT
/begin MEASUREMENT sfpfrau "" UWORD dez 1 100 0.00 65535.00 FORMAT "%8.2" ECU_ADDRESS 0x382DAA /end MEASUREMENT
/begin MEASUREMENT sfpfrau2 "" UWORD dez 1 100 0.00 65535.00 FORMAT "%8.2" ECU_ADDRESS 0x382DAC /end MEASUREMENT
/begin MEASUREMENT sfpfrst "" UWORD dez 1 100 0.00 65535.00 FORMAT "%8.2" ECU_ADDRESS 0x382DAE /end MEASUREMENT
/begin MEASUREMENT sfpfrst2 "" UWORD dez 1 100 0.00 65535.00 FORMAT "%8.2" ECU_ADDRESS 0x382DB0 /end MEASUREMENT
/begin MEASUREMENT sfpgecod "" UWORD dez 1 100 0.00 65535.00 FORMAT "%8.2" ECU_ADDRESS 0x382DB2 /end MEASUREMENT
/begin MEASUREMENT sfpkat "" UWORD default 1 100 0.00 65535.00 FORMAT "%8.2" ECU_ADDRESS 0x382DD0 /end MEASUREMENT
/begin MEASUREMENT sfpkat2 "" UWORD default 1 100 0.00 65535.00 FORMAT "%8.2" ECU_ADDRESS 0x382DD2 /end MEASUREMENT
/begin MEASUREMENT sfpkra01 "" UWORD dez 1 100 0.00 65535.00 FORMAT "%8.2" ECU_ADDRESS 0x382DD6 /end MEASUREMENT
/begin MEASUREMENT sfpkra02 "" UWORD dez 1 100 0.00 65535.00 FORMAT "%8.2" ECU_ADDRESS 0x382DD8 /end MEASUREMENT
/begin MEASUREMENT sfpkra03 "" UWORD dez 1 100 0.00 65535.00 FORMAT "%8.2" ECU_ADDRESS 0x382DDA /end MEASUREMENT
/begin MEASUREMENT sfpkra04 "" UWORD dez 1 100 0.00 65535.00 FORMAT "%8.2" ECU_ADDRESS 0x382DDC /end MEASUREMENT
/begin MEASUREMENT sfpkra05 "" UWORD dez 1 100 0.00 65535.00 FORMAT "%8.2" ECU_ADDRESS 0x382DDE /end MEASUREMENT
/begin MEASUREMENT sfpkra06 "" UWORD dez 1 100 0.00 65535.00 FORMAT "%8.2" ECU_ADDRESS 0x382DE0 /end MEASUREMENT
/begin MEASUREMENT sfpkrnt "" UWORD dez 1 100 0.00 65535.00 FORMAT "%8.2" ECU_ADDRESS 0x382DE2 /end MEASUREMENT
/begin MEASUREMENT sfpkrof "" UWORD dez 1 100 0.00 65535.00 FORMAT "%8.2" ECU_ADDRESS 0x382DE4 /end MEASUREMENT
/begin MEASUREMENT sfpkrtp "" UWORD dez 1 100 0.00 65535.00 FORMAT "%8.2" ECU_ADDRESS 0x382DE6 /end MEASUREMENT
/begin MEASUREMENT sfpks1 "" UWORD dez 1 100 0.00 65535.00 FORMAT "%8.2" ECU_ADDRESS 0x382DE8 /end MEASUREMENT
/begin MEASUREMENT sfpks2 "" UWORD dez 1 100 0.00 65535.00 FORMAT "%8.2" ECU_ADDRESS 0x382DEA /end MEASUREMENT
/begin MEASUREMENT sfpks3 "" UWORD dez 1 100 0.00 65535.00 FORMAT "%8.2" ECU_ADDRESS 0x382DEC /end MEASUREMENT
/begin MEASUREMENT sfpks4 "" UWORD dez 1 100 0.00 65535.00 FORMAT "%8.2" ECU_ADDRESS 0x382DEE /end MEASUREMENT
/begin MEASUREMENT sfpkuppl "" UWORD dez 1 100 0.00 65535.00 FORMAT "%8.2" ECU_ADDRESS 0x382DF0 /end MEASUREMENT
/begin MEASUREMENT sfplash "" UWORD default 1 100 0.00 65535.00 FORMAT "%8.2" ECU_ADDRESS 0x382DF2 /end MEASUREMENT
/begin MEASUREMENT sfplash2 "" UWORD default 1 100 0.00 65535.00 FORMAT "%8.2" ECU_ADDRESS 0x382DF4 /end MEASUREMENT
/begin MEASUREMENT sfplavh "" UWORD default 1 100 0.00 65535.00 FORMAT "%8.2" ECU_ADDRESS 0x382DF6 /end MEASUREMENT
/begin MEASUREMENT sfplavh2 "" UWORD default 1 100 0.00 65535.00 FORMAT "%8.2" ECU_ADDRESS 0x382DF8 /end MEASUREMENT
/begin MEASUREMENT sfpllr "" UWORD dez 1 100 0.00 65535.00 FORMAT "%8.2" ECU_ADDRESS 0x382DFC /end MEASUREMENT
/begin MEASUREMENT sfplm "" UWORD dez 1 100 0.00 65535.00 FORMAT "%8.2" ECU_ADDRESS 0x382DFE /end MEASUREMENT
/begin MEASUREMENT sfplsh "" UWORD dez 1 100 0.00 65535.00 FORMAT "%8.2" ECU_ADDRESS 0x382E00 /end MEASUREMENT
/begin MEASUREMENT sfplsh2 "" UWORD dez 1 100 0.00 65535.00 FORMAT "%8.2" ECU_ADDRESS 0x382E02 /end MEASUREMENT
/begin MEASUREMENT sfplsvv "" UWORD dez 1 100 0.00 65535.00 FORMAT "%8.2" ECU_ADDRESS 0x382E1E /end MEASUREMENT
/begin MEASUREMENT sfplue1 "" UWORD dez 1 100 0.00 65535.00 FORMAT "%8.2" ECU_ADDRESS 0x382E20 /end MEASUREMENT
/begin MEASUREMENT sfpmd "" UWORD dez 1 100 0.00 65535.00 FORMAT "%8.2" ECU_ADDRESS 0x382E26 /end MEASUREMENT
/begin MEASUREMENT sfpmd00 "" UWORD dez 1 100 0.00 65535.00 FORMAT "%8.2" ECU_ADDRESS 0x382E28 /end MEASUREMENT
/begin MEASUREMENT sfpmd01 "" UWORD dez 1 100 0.00 65535.00 FORMAT "%8.2" ECU_ADDRESS 0x382E2A /end MEASUREMENT
/begin MEASUREMENT sfpmd02 "" UWORD dez 1 100 0.00 65535.00 FORMAT "%8.2" ECU_ADDRESS 0x382E2C /end MEASUREMENT
/begin MEASUREMENT sfpmd03 "" UWORD dez 1 100 0.00 65535.00 FORMAT "%8.2" ECU_ADDRESS 0x382E2E /end MEASUREMENT
/begin MEASUREMENT sfpmd04 "" UWORD dez 1 100 0.00 65535.00 FORMAT "%8.2" ECU_ADDRESS 0x382E30 /end MEASUREMENT
/begin MEASUREMENT sfpmd05 "" UWORD dez 1 100 0.00 65535.00 FORMAT "%8.2" ECU_ADDRESS 0x382E32 /end MEASUREMENT
/begin MEASUREMENT sfpmfa "" UWORD dez 1 100 0.00 65535.00 FORMAT "%8.2" ECU_ADDRESS 0x382E36 /end MEASUREMENT
/begin MEASUREMENT sfpnwkw "" UWORD default 1 100 0.00 65535.00 FORMAT "%8.2" ECU_ADDRESS 0x382E3A /end MEASUREMENT
/begin MEASUREMENT sfpnwkw2 "" UWORD default 1 100 0.00 65535.00 FORMAT "%8.2" ECU_ADDRESS 0x382E3C /end MEASUREMENT
/begin MEASUREMENT sfpnx "" UWORD dez 1 100 0.00 65535.00 FORMAT "%8.2" ECU_ADDRESS 0x382E3E /end MEASUREMENT
/begin MEASUREMENT sfpph "" UWORD dez 1 100 0.00 65535.00 FORMAT "%8.2" ECU_ADDRESS 0x382E40 /end MEASUREMENT
/begin MEASUREMENT sfpph2 "" UWORD dez 1 100 0.00 65535.00 FORMAT "%8.2" ECU_ADDRESS 0x382E42 /end MEASUREMENT
/begin MEASUREMENT sfppllsu "" UWORD default 1 100 0.00 65535.00 FORMAT "%8.2" ECU_ADDRESS 0x382E44 /end MEASUREMENT
/begin MEASUREMENT sfppllsu2 "" UWORD default 1 100 0.00 65535.00 FORMAT "%8.2" ECU_ADDRESS 0x382E46 /end MEASUREMENT
/begin MEASUREMENT sfprkat "" UWORD dez 1 100 0.00 65535.00 FORMAT "%8.2" ECU_ADDRESS 0x382E4A /end MEASUREMENT
/begin MEASUREMENT sfprkat2 "" UWORD dez 1 100 0.00 65535.00 FORMAT "%8.2" ECU_ADDRESS 0x382E4C /end MEASUREMENT
/begin MEASUREMENT sfprkaz "" UWORD dez 1 100 0.00 65535.00 FORMAT "%8.2" ECU_ADDRESS 0x382E4E /end MEASUREMENT
/begin MEASUREMENT sfprkaz2 "" UWORD dez 1 100 0.00 65535.00 FORMAT "%8.2" ECU_ADDRESS 0x382E50 /end MEASUREMENT
/begin MEASUREMENT sfpsgeep "" UWORD default 1 100 0.00 65535.00 FORMAT "%8.2" ECU_ADDRESS 0x382E54 /end MEASUREMENT
/begin MEASUREMENT sfpsls "" UWORD dez 1 100 0.00 65535.00 FORMAT "%8.2" ECU_ADDRESS 0x382E5A /end MEASUREMENT
/begin MEASUREMENT sfpsls2 "" UWORD dez 1 100 0.00 65535.00 FORMAT "%8.2" ECU_ADDRESS 0x382E5C /end MEASUREMENT
/begin MEASUREMENT sfpslv "" UWORD dez 1 100 0.00 65535.00 FORMAT "%8.2" ECU_ADDRESS 0x382E5E /end MEASUREMENT
/begin MEASUREMENT sfpslv2 "" UWORD dez 1 100 0.00 65535.00 FORMAT "%8.2" ECU_ADDRESS 0x382E60 /end MEASUREMENT
/begin MEASUREMENT sfptankl "" UWORD default 1 100 0.00 65535.00 FORMAT "%8.2" ECU_ADDRESS 0x382E6A /end MEASUREMENT
/begin MEASUREMENT sfptes "" UWORD default 1 100 0.00 65535.00 FORMAT "%8.2" ECU_ADDRESS 0x382E6C /end MEASUREMENT
/begin MEASUREMENT sfptesf "" UWORD default 1 100 0.00 65535.00 FORMAT "%8.2" ECU_ADDRESS 0x382E6E /end MEASUREMENT
/begin MEASUREMENT sfptesg "" UWORD default 1 100 0.00 65535.00 FORMAT "%8.2" ECU_ADDRESS 0x382E70 /end MEASUREMENT
/begin MEASUREMENT sfpteve2 "" UWORD dez 1 100 0.00 65535.00 FORMAT "%8.2" ECU_ADDRESS 0x382E74 /end MEASUREMENT
/begin MEASUREMENT sfpufmv "" UWORD dez 1 100 0.00 65535.00 FORMAT "%8.2" ECU_ADDRESS 0x382E84 /end MEASUREMENT
/begin MEASUREMENT sfpufnc "" UWORD dez 1 100 0.00 65535.00 FORMAT "%8.2" ECU_ADDRESS 0x382E86 /end MEASUREMENT
/begin MEASUREMENT sfpufrlip "" UWORD dez 1 100 0.00 65535.00 FORMAT "%8.2" ECU_ADDRESS 0x382E88 /end MEASUREMENT
/begin MEASUREMENT sfpufsga "" UWORD dez 1 100 0.00 65535.00 FORMAT "%8.2" ECU_ADDRESS 0x382E8A /end MEASUREMENT
/begin MEASUREMENT sfpufsgb "" UWORD dez 1 100 0.00 65535.00 FORMAT "%8.2" ECU_ADDRESS 0x382E8C /end MEASUREMENT
/begin MEASUREMENT sfpufska "" UWORD dez 1 100 0.00 65535.00 FORMAT "%8.2" ECU_ADDRESS 0x382E8E /end MEASUREMENT
/begin MEASUREMENT sfpufspsc "" UWORD dez 1 100 0.00 65535.00 FORMAT "%8.2" ECU_ADDRESS 0x382E90 /end MEASUREMENT
/begin MEASUREMENT sfpulsu "" UWORD default 1 100 0.00 65535.00 FORMAT "%8.2" ECU_ADDRESS 0x382E92 /end MEASUREMENT
/begin MEASUREMENT sfpulsu2 "" UWORD default 1 100 0.00 65535.00 FORMAT "%8.2" ECU_ADDRESS 0x382E94 /end MEASUREMENT
/begin MEASUREMENT sfpurram "" UWORD dez 1 100 0.00 65535.00 FORMAT "%8.2" ECU_ADDRESS 0x382E96 /end MEASUREMENT
/begin MEASUREMENT sfpurrom "" UWORD dez 1 100 0.00 65535.00 FORMAT "%8.2" ECU_ADDRESS 0x382E98 /end MEASUREMENT
/begin MEASUREMENT sfpurrst "" UWORD dez 1 100 0.00 65535.00 FORMAT "%8.2" ECU_ADDRESS 0x382E9A /end MEASUREMENT
/begin MEASUREMENT sfpvfz "" UWORD dez 1 100 0.00 65535.00 FORMAT "%8.2" ECU_ADDRESS 0x382E9C /end MEASUREMENT
/begin MEASUREMENT TYPkra01 "" UWORD B_TRUE 1 100 0.00 1.00000000000 BIT_MASK 0xf00 FORMAT "%13.11" ECU_ADDRESS 0x382DD6 /end MEASUREMENT
/begin MEASUREMENT TYPkra02 "" UWORD B_TRUE 1 100 0.00 1.00000000000 BIT_MASK 0xf00 FORMAT "%13.11" ECU_ADDRESS 0x382DD8 /end MEASUREMENT
/begin MEASUREMENT TYPkra03 "" UWORD B_TRUE 1 100 0.00 1.00000000000 BIT_MASK 0xf00 FORMAT "%13.11" ECU_ADDRESS 0x382DDA /end MEASUREMENT
/begin MEASUREMENT TYPkra04 "" UWORD B_TRUE 1 100 0.00 1.00000000000 BIT_MASK 0xf00 FORMAT "%13.11" ECU_ADDRESS 0x382DDC /end MEASUREMENT
/begin MEASUREMENT TYPkra05 "" UWORD B_TRUE 1 100 0.00 1.00000000000 BIT_MASK 0xf00 FORMAT "%13.11" ECU_ADDRESS 0x382DDE /end MEASUREMENT
/begin MEASUREMENT TYPkra06 "" UWORD B_TRUE 1 100 0.00 1.00000000000 BIT_MASK 0xf00 FORMAT "%13.11" ECU_ADDRESS 0x382DE0 /end MEASUREMENT
/begin MEASUREMENT TYP_cge "" UWORD B_TRUE 1 100 0.00 1.00000000000 BIT_MASK 0xf00 FORMAT "%13.11" ECU_ADDRESS 0x382D54 /end MEASUREMENT
/begin MEASUREMENT TYP_dpl "" UWORD B_TRUE 1 100 0.00 1.00000000000 BIT_MASK 0xf00 FORMAT "%13.11" ECU_ADDRESS 0x382D6A /end MEASUREMENT
/begin MEASUREMENT TYP_dsbkv "" UWORD B_TRUE 1 100 0.00 1.00000000000 BIT_MASK 0xf00 FORMAT "%13.11" ECU_ADDRESS 0x382D6C /end MEASUREMENT
/begin MEASUREMENT TYP_frao "" UWORD B_TRUE 1 100 0.00 1.00000000000 BIT_MASK 0xf00 FORMAT "%13.11" ECU_ADDRESS 0x382DA6 /end MEASUREMENT
/begin MEASUREMENT TYP_frao2 "" UWORD B_TRUE 1 100 0.00 1.00000000000 BIT_MASK 0xf00 FORMAT "%13.11" ECU_ADDRESS 0x382DA8 /end MEASUREMENT
/begin MEASUREMENT TYP_frau "" UWORD B_TRUE 1 100 0.00 1.00000000000 BIT_MASK 0xf00 FORMAT "%13.11" ECU_ADDRESS 0x382DAA /end MEASUREMENT
/begin MEASUREMENT TYP_frau2 "" UWORD B_TRUE 1 100 0.00 1.00000000000 BIT_MASK 0xf00 FORMAT "%13.11" ECU_ADDRESS 0x382DAC /end MEASUREMENT
/begin MEASUREMENT TYP_frst "" UWORD B_TRUE 1 100 0.00 1.00000000000 BIT_MASK 0xf00 FORMAT "%13.11" ECU_ADDRESS 0x382DAE /end MEASUREMENT
/begin MEASUREMENT TYP_frst2 "" UWORD B_TRUE 1 100 0.00 1.00000000000 BIT_MASK 0xf00 FORMAT "%13.11" ECU_ADDRESS 0x382DB0 /end MEASUREMENT
/begin MEASUREMENT TYP_gecod "" UWORD B_TRUE 1 100 0.00 1.00000000000 BIT_MASK 0xf00 FORMAT "%13.11" ECU_ADDRESS 0x382DB2 /end MEASUREMENT
/begin MEASUREMENT TYP_kat "" UWORD B_TRUE 1 100 0.00 1.00000000000 BIT_MASK 0xf00 FORMAT "%13.11" ECU_ADDRESS 0x382DD0 /end MEASUREMENT
/begin MEASUREMENT TYP_kat2 "" UWORD B_TRUE 1 100 0.00 1.00000000000 BIT_MASK 0xf00 FORMAT "%13.11" ECU_ADDRESS 0x382DD2 /end MEASUREMENT
/begin MEASUREMENT TYP_krnt "" UWORD B_TRUE 1 100 0.00 1.00000000000 BIT_MASK 0xf00 FORMAT "%13.11" ECU_ADDRESS 0x382DE2 /end MEASUREMENT
/begin MEASUREMENT TYP_krof "" UWORD B_TRUE 1 100 0.00 1.00000000000 BIT_MASK 0xf00 FORMAT "%13.11" ECU_ADDRESS 0x382DE4 /end MEASUREMENT
/begin MEASUREMENT TYP_krtp "" UWORD B_TRUE 1 100 0.00 1.00000000000 BIT_MASK 0xf00 FORMAT "%13.11" ECU_ADDRESS 0x382DE6 /end MEASUREMENT
/begin MEASUREMENT TYP_ks1 "" UWORD B_TRUE 1 100 0.00 1.00000000000 BIT_MASK 0xf00 FORMAT "%13.11" ECU_ADDRESS 0x382DE8 /end MEASUREMENT
/begin MEASUREMENT TYP_ks2 "" UWORD B_TRUE 1 100 0.00 1.00000000000 BIT_MASK 0xf00 FORMAT "%13.11" ECU_ADDRESS 0x382DEA /end MEASUREMENT
/begin MEASUREMENT TYP_ks3 "" UWORD B_TRUE 1 100 0.00 1.00000000000 BIT_MASK 0xf00 FORMAT "%13.11" ECU_ADDRESS 0x382DEC /end MEASUREMENT
/begin MEASUREMENT TYP_ks4 "" UWORD B_TRUE 1 100 0.00 1.00000000000 BIT_MASK 0xf00 FORMAT "%13.11" ECU_ADDRESS 0x382DEE /end MEASUREMENT
/begin MEASUREMENT TYP_kuppl "" UWORD B_TRUE 1 100 0.00 1.00000000000 BIT_MASK 0xf00 FORMAT "%13.11" ECU_ADDRESS 0x382DF0 /end MEASUREMENT
/begin MEASUREMENT TYP_lash "" UWORD B_TRUE 1 100 0.00 1.00000000000 BIT_MASK 0xf00 FORMAT "%13.11" ECU_ADDRESS 0x382DF2 /end MEASUREMENT
/begin MEASUREMENT TYP_lash2 "" UWORD B_TRUE 1 100 0.00 1.00000000000 BIT_MASK 0xf00 FORMAT "%13.11" ECU_ADDRESS 0x382DF4 /end MEASUREMENT
/begin MEASUREMENT TYP_lavh "" UWORD B_TRUE 1 100 0.00 1.00000000000 BIT_MASK 0xf00 FORMAT "%13.11" ECU_ADDRESS 0x382DF6 /end MEASUREMENT
/begin MEASUREMENT TYP_lavh2 "" UWORD B_TRUE 1 100 0.00 1.00000000000 BIT_MASK 0xf00 FORMAT "%13.11" ECU_ADDRESS 0x382DF8 /end MEASUREMENT
/begin MEASUREMENT TYP_LLR "" UWORD B_TRUE 1 100 0.00 1.00000000000 BIT_MASK 0xf00 FORMAT "%13.11" ECU_ADDRESS 0x382DFC /end MEASUREMENT
/begin MEASUREMENT TYP_lm "" UWORD B_TRUE 1 100 0.00 1.00000000000 BIT_MASK 0xf00 FORMAT "%13.11" ECU_ADDRESS 0x382DFE /end MEASUREMENT
/begin MEASUREMENT TYP_lsh "" UWORD B_TRUE 1 100 0.00 1.00000000000 BIT_MASK 0xf00 FORMAT "%13.11" ECU_ADDRESS 0x382E00 /end MEASUREMENT
/begin MEASUREMENT TYP_lsh2 "" UWORD B_TRUE 1 100 0.00 1.00000000000 BIT_MASK 0xf00 FORMAT "%13.11" ECU_ADDRESS 0x382E02 /end MEASUREMENT
/begin MEASUREMENT TYP_lsvv "" UWORD B_TRUE 1 100 0.00 1.00000000000 BIT_MASK 0xf00 FORMAT "%13.11" ECU_ADDRESS 0x382E1E /end MEASUREMENT
/begin MEASUREMENT TYP_lue1 "" UWORD B_TRUE 1 100 0.00 1.00000000000 BIT_MASK 0xf00 FORMAT "%13.11" ECU_ADDRESS 0x382E20 /end MEASUREMENT
/begin MEASUREMENT TYP_md "" UWORD B_TRUE 1 100 0.00 1.00000000000 BIT_MASK 0xf00 FORMAT "%13.11" ECU_ADDRESS 0x382E26 /end MEASUREMENT
/begin MEASUREMENT TYP_md00 "" UWORD B_TRUE 1 100 0.00 1.00000000000 BIT_MASK 0xf00 FORMAT "%13.11" ECU_ADDRESS 0x382E28 /end MEASUREMENT
/begin MEASUREMENT TYP_md01 "" UWORD B_TRUE 1 100 0.00 1.00000000000 BIT_MASK 0xf00 FORMAT "%13.11" ECU_ADDRESS 0x382E2A /end MEASUREMENT
/begin MEASUREMENT TYP_md02 "" UWORD B_TRUE 1 100 0.00 1.00000000000 BIT_MASK 0xf00 FORMAT "%13.11" ECU_ADDRESS 0x382E2C /end MEASUREMENT
/begin MEASUREMENT TYP_md03 "" UWORD B_TRUE 1 100 0.00 1.00000000000 BIT_MASK 0xf00 FORMAT "%13.11" ECU_ADDRESS 0x382E2E /end MEASUREMENT
/begin MEASUREMENT TYP_md04 "" UWORD B_TRUE 1 100 0.00 1.00000000000 BIT_MASK 0xf00 FORMAT "%13.11" ECU_ADDRESS 0x382E30 /end MEASUREMENT
/begin MEASUREMENT TYP_md05 "" UWORD B_TRUE 1 100 0.00 1.00000000000 BIT_MASK 0xf00 FORMAT "%13.11" ECU_ADDRESS 0x382E32 /end MEASUREMENT
/begin MEASUREMENT TYP_mfa "" UWORD B_TRUE 1 100 0.00 1.00000000000 BIT_MASK 0xf00 FORMAT "%13.11" ECU_ADDRESS 0x382E36 /end MEASUREMENT
/begin MEASUREMENT TYP_nwkw "" UWORD B_TRUE 1 100 0.00 1.00000000000 BIT_MASK 0xf00 FORMAT "%13.11" ECU_ADDRESS 0x382E3A /end MEASUREMENT
/begin MEASUREMENT TYP_nwkw2 "" UWORD B_TRUE 1 100 0.00 1.00000000000 BIT_MASK 0xf00 FORMAT "%13.11" ECU_ADDRESS 0x382E3C /end MEASUREMENT
/begin MEASUREMENT TYP_nx "" UWORD B_TRUE 1 100 0.00 1.00000000000 BIT_MASK 0xf00 FORMAT "%13.11" ECU_ADDRESS 0x382E3E /end MEASUREMENT
/begin MEASUREMENT TYP_ph "" UWORD B_TRUE 1 100 0.00 1.00000000000 BIT_MASK 0xf00 FORMAT "%13.11" ECU_ADDRESS 0x382E40 /end MEASUREMENT
/begin MEASUREMENT TYP_ph2 "" UWORD B_TRUE 1 100 0.00 1.00000000000 BIT_MASK 0xf00 FORMAT "%13.11" ECU_ADDRESS 0x382E42 /end MEASUREMENT
/begin MEASUREMENT TYP_pllsu "" UWORD B_TRUE 1 100 0.00 1.00000000000 BIT_MASK 0xf00 FORMAT "%13.11" ECU_ADDRESS 0x382E44 /end MEASUREMENT
/begin MEASUREMENT TYP_pllsu2 "" UWORD B_TRUE 1 100 0.00 1.00000000000 BIT_MASK 0xf00 FORMAT "%13.11" ECU_ADDRESS 0x382E46 /end MEASUREMENT
/begin MEASUREMENT TYP_rkat "" UWORD B_TRUE 1 100 0.00 1.00000000000 BIT_MASK 0xf00 FORMAT "%13.11" ECU_ADDRESS 0x382E4A /end MEASUREMENT
/begin MEASUREMENT TYP_rkat2 "" UWORD B_TRUE 1 100 0.00 1.00000000000 BIT_MASK 0xf00 FORMAT "%13.11" ECU_ADDRESS 0x382E4C /end MEASUREMENT
/begin MEASUREMENT TYP_rkaz "" UWORD B_TRUE 1 100 0.00 1.00000000000 BIT_MASK 0xf00 FORMAT "%13.11" ECU_ADDRESS 0x382E4E /end MEASUREMENT
/begin MEASUREMENT TYP_rkaz2 "" UWORD B_TRUE 1 100 0.00 1.00000000000 BIT_MASK 0xf00 FORMAT "%13.11" ECU_ADDRESS 0x382E50 /end MEASUREMENT
/begin MEASUREMENT TYP_sgeep "" UWORD B_TRUE 1 100 0.00 1.00000000000 BIT_MASK 0xf00 FORMAT "%13.11" ECU_ADDRESS 0x382E54 /end MEASUREMENT
/begin MEASUREMENT TYP_sls "" UWORD B_TRUE 1 100 0.00 1.00000000000 BIT_MASK 0xf00 FORMAT "%13.11" ECU_ADDRESS 0x382E5A /end MEASUREMENT
/begin MEASUREMENT TYP_sls2 "" UWORD B_TRUE 1 100 0.00 1.00000000000 BIT_MASK 0xf00 FORMAT "%13.11" ECU_ADDRESS 0x382E5C /end MEASUREMENT
/begin MEASUREMENT TYP_slv "" UWORD B_TRUE 1 100 0.00 1.00000000000 BIT_MASK 0xf00 FORMAT "%13.11" ECU_ADDRESS 0x382E5E /end MEASUREMENT
/begin MEASUREMENT TYP_slv2 "" UWORD B_TRUE 1 100 0.00 1.00000000000 BIT_MASK 0xf00 FORMAT "%13.11" ECU_ADDRESS 0x382E60 /end MEASUREMENT
/begin MEASUREMENT TYP_tankl "" UWORD B_TRUE 1 100 0.00 1.00000000000 BIT_MASK 0xf00 FORMAT "%13.11" ECU_ADDRESS 0x382E6A /end MEASUREMENT
/begin MEASUREMENT TYP_tes "" UWORD B_TRUE 1 100 0.00 1.00000000000 BIT_MASK 0xf00 FORMAT "%13.11" ECU_ADDRESS 0x382E6C /end MEASUREMENT
/begin MEASUREMENT TYP_tesf "" UWORD B_TRUE 1 100 0.00 1.00000000000 BIT_MASK 0xf00 FORMAT "%13.11" ECU_ADDRESS 0x382E6E /end MEASUREMENT
/begin MEASUREMENT TYP_tesg "" UWORD B_TRUE 1 100 0.00 1.00000000000 BIT_MASK 0xf00 FORMAT "%13.11" ECU_ADDRESS 0x382E70 /end MEASUREMENT
/begin MEASUREMENT TYP_ufmv "" UWORD B_TRUE 1 100 0.00 1.00000000000 BIT_MASK 0xf00 FORMAT "%13.11" ECU_ADDRESS 0x382E84 /end MEASUREMENT
/begin MEASUREMENT TYP_ufnc "" UWORD B_TRUE 1 100 0.00 1.00000000000 BIT_MASK 0xf00 FORMAT "%13.11" ECU_ADDRESS 0x382E86 /end MEASUREMENT
/begin MEASUREMENT TYP_ufrlip "" UWORD B_TRUE 1 100 0.00 1.00000000000 BIT_MASK 0xf00 FORMAT "%13.11" ECU_ADDRESS 0x382E88 /end MEASUREMENT
/begin MEASUREMENT TYP_ufsga "" UWORD B_TRUE 1 100 0.00 1.00000000000 BIT_MASK 0xf00 FORMAT "%13.11" ECU_ADDRESS 0x382E8A /end MEASUREMENT
/begin MEASUREMENT TYP_ufsgb "" UWORD B_TRUE 1 100 0.00 1.00000000000 BIT_MASK 0xf00 FORMAT "%13.11" ECU_ADDRESS 0x382E8C /end MEASUREMENT
/begin MEASUREMENT TYP_ufska "" UWORD B_TRUE 1 100 0.00 1.00000000000 BIT_MASK 0xf00 FORMAT "%13.11" ECU_ADDRESS 0x382E8E /end MEASUREMENT
/begin MEASUREMENT TYP_ufspsc "" UWORD B_TRUE 1 100 0.00 1.00000000000 BIT_MASK 0xf00 FORMAT "%13.11" ECU_ADDRESS 0x382E90 /end MEASUREMENT
/begin MEASUREMENT TYP_ulsu "" UWORD B_TRUE 1 100 0.00 1.00000000000 BIT_MASK 0xf00 FORMAT "%13.11" ECU_ADDRESS 0x382E92 /end MEASUREMENT
/begin MEASUREMENT TYP_ulsu2 "" UWORD B_TRUE 1 100 0.00 1.00000000000 BIT_MASK 0xf00 FORMAT "%13.11" ECU_ADDRESS 0x382E94 /end MEASUREMENT
/begin MEASUREMENT TYP_urram "" UWORD B_TRUE 1 100 0.00 1.00000000000 BIT_MASK 0xf00 FORMAT "%13.11" ECU_ADDRESS 0x382E96 /end MEASUREMENT
/begin MEASUREMENT TYP_urrom "" UWORD B_TRUE 1 100 0.00 1.00000000000 BIT_MASK 0xf00 FORMAT "%13.11" ECU_ADDRESS 0x382E98 /end MEASUREMENT
/begin MEASUREMENT TYP_urrst "" UWORD B_TRUE 1 100 0.00 1.00000000000 BIT_MASK 0xf00 FORMAT "%13.11" ECU_ADDRESS 0x382E9A /end MEASUREMENT
/begin MEASUREMENT TYP_vfz "" UWORD B_TRUE 1 100 0.00 1.00000000000 BIT_MASK 0xf00 FORMAT "%13.11" ECU_ADDRESS 0x382E9C /end MEASUREMENT
/begin MEASUREMENT Z_cge "" UWORD B_TRUE 1 100 0.00 1.00000000000 BIT_MASK 0x2 FORMAT "%13.11" ECU_ADDRESS 0x382D54 /end MEASUREMENT
/begin MEASUREMENT Z_dpl "" UWORD B_TRUE 1 100 0.00 1.00000000000 BIT_MASK 0x2 FORMAT "%13.11" ECU_ADDRESS 0x382D6A /end MEASUREMENT
/begin MEASUREMENT Z_dsbkv "" UWORD B_TRUE 1 100 0.00 1.00000000000 BIT_MASK 0x2 FORMAT "%13.11" ECU_ADDRESS 0x382D6C /end MEASUREMENT
/begin MEASUREMENT Z_frao "" UWORD B_TRUE 1 100 0.00 1.00000000000 BIT_MASK 0x2 FORMAT "%13.11" ECU_ADDRESS 0x382DA6 /end MEASUREMENT
/begin MEASUREMENT Z_frao2 "" UWORD B_TRUE 1 100 0.00 1.00000000000 BIT_MASK 0x2 FORMAT "%13.11" ECU_ADDRESS 0x382DA8 /end MEASUREMENT
/begin MEASUREMENT Z_frau "" UWORD B_TRUE 1 100 0.00 1.00000000000 BIT_MASK 0x2 FORMAT "%13.11" ECU_ADDRESS 0x382DAA /end MEASUREMENT
/begin MEASUREMENT Z_frau2 "" UWORD B_TRUE 1 100 0.00 1.00000000000 BIT_MASK 0x2 FORMAT "%13.11" ECU_ADDRESS 0x382DAC /end MEASUREMENT
/begin MEASUREMENT Z_frst "" UWORD B_TRUE 1 100 0.00 1.00000000000 BIT_MASK 0x2 FORMAT "%13.11" ECU_ADDRESS 0x382DAE /end MEASUREMENT
/begin MEASUREMENT Z_frst2 "" UWORD B_TRUE 1 100 0.00 1.00000000000 BIT_MASK 0x2 FORMAT "%13.11" ECU_ADDRESS 0x382DB0 /end MEASUREMENT
/begin MEASUREMENT Z_gecod "" UWORD B_TRUE 1 100 0.00 1.00000000000 BIT_MASK 0x2 FORMAT "%13.11" ECU_ADDRESS 0x382DB2 /end MEASUREMENT
/begin MEASUREMENT Z_kat "" UWORD B_TRUE 1 100 0.00 1.00000000000 BIT_MASK 0x2 FORMAT "%13.11" ECU_ADDRESS 0x382DD0 /end MEASUREMENT
/begin MEASUREMENT Z_kat2 "" UWORD B_TRUE 1 100 0.00 1.00000000000 BIT_MASK 0x2 FORMAT "%13.11" ECU_ADDRESS 0x382DD2 /end MEASUREMENT
/begin MEASUREMENT Z_kra01 "" UWORD B_TRUE 1 100 0.00 1.00000000000 BIT_MASK 0x2 FORMAT "%13.11" ECU_ADDRESS 0x382DD6 /end MEASUREMENT
/begin MEASUREMENT Z_kra02 "" UWORD B_TRUE 1 100 0.00 1.00000000000 BIT_MASK 0x2 FORMAT "%13.11" ECU_ADDRESS 0x382DD8 /end MEASUREMENT
/begin MEASUREMENT Z_kra03 "" UWORD B_TRUE 1 100 0.00 1.00000000000 BIT_MASK 0x2 FORMAT "%13.11" ECU_ADDRESS 0x382DDA /end MEASUREMENT
/begin MEASUREMENT Z_kra04 "" UWORD B_TRUE 1 100 0.00 1.00000000000 BIT_MASK 0x2 FORMAT "%13.11" ECU_ADDRESS 0x382DDC /end MEASUREMENT
/begin MEASUREMENT Z_kra05 "" UWORD B_TRUE 1 100 0.00 1.00000000000 BIT_MASK 0x2 FORMAT "%13.11" ECU_ADDRESS 0x382DDE /end MEASUREMENT
/begin MEASUREMENT Z_kra06 "" UWORD B_TRUE 1 100 0.00 1.00000000000 BIT_MASK 0x2 FORMAT "%13.11" ECU_ADDRESS 0x382DE0 /end MEASUREMENT
/begin MEASUREMENT Z_krnt "" UWORD B_TRUE 1 100 0.00 1.00000000000 BIT_MASK 0x2 FORMAT "%13.11" ECU_ADDRESS 0x382DE2 /end MEASUREMENT
/begin MEASUREMENT Z_krof "" UWORD B_TRUE 1 100 0.00 1.00000000000 BIT_MASK 0x2 FORMAT "%13.11" ECU_ADDRESS 0x382DE4 /end MEASUREMENT
/begin MEASUREMENT Z_krtp "" UWORD B_TRUE 1 100 0.00 1.00000000000 BIT_MASK 0x2 FORMAT "%13.11" ECU_ADDRESS 0x382DE6 /end MEASUREMENT
/begin MEASUREMENT Z_ks1 "" UWORD B_TRUE 1 100 0.00 1.00000000000 BIT_MASK 0x2 FORMAT "%13.11" ECU_ADDRESS 0x382DE8 /end MEASUREMENT
/begin MEASUREMENT Z_ks2 "" UWORD B_TRUE 1 100 0.00 1.00000000000 BIT_MASK 0x2 FORMAT "%13.11" ECU_ADDRESS 0x382DEA /end MEASUREMENT
/begin MEASUREMENT Z_ks3 "" UWORD B_TRUE 1 100 0.00 1.00000000000 BIT_MASK 0x2 FORMAT "%13.11" ECU_ADDRESS 0x382DEC /end MEASUREMENT
/begin MEASUREMENT Z_ks4 "" UWORD B_TRUE 1 100 0.00 1.00000000000 BIT_MASK 0x2 FORMAT "%13.11" ECU_ADDRESS 0x382DEE /end MEASUREMENT
/begin MEASUREMENT Z_kuppl "" UWORD B_TRUE 1 100 0.00 1.00000000000 BIT_MASK 0x2 FORMAT "%13.11" ECU_ADDRESS 0x382DF0 /end MEASUREMENT
/begin MEASUREMENT Z_lash "" UWORD B_TRUE 1 100 0.00 1.00000000000 BIT_MASK 0x2 FORMAT "%13.11" ECU_ADDRESS 0x382DF2 /end MEASUREMENT
/begin MEASUREMENT Z_lash2 "" UWORD B_TRUE 1 100 0.00 1.00000000000 BIT_MASK 0x2 FORMAT "%13.11" ECU_ADDRESS 0x382DF4 /end MEASUREMENT
/begin MEASUREMENT Z_lavh "" UWORD B_TRUE 1 100 0.00 1.00000000000 BIT_MASK 0x2 FORMAT "%13.11" ECU_ADDRESS 0x382DF6 /end MEASUREMENT
/begin MEASUREMENT Z_lavh2 "" UWORD B_TRUE 1 100 0.00 1.00000000000 BIT_MASK 0x2 FORMAT "%13.11" ECU_ADDRESS 0x382DF8 /end MEASUREMENT
/begin MEASUREMENT Z_llr "" UWORD B_TRUE 1 100 0.00 1.00000000000 BIT_MASK 0x2 FORMAT "%13.11" ECU_ADDRESS 0x382DFC /end MEASUREMENT
/begin MEASUREMENT Z_lm "" UWORD B_TRUE 1 100 0.00 1.00000000000 BIT_MASK 0x2 FORMAT "%13.11" ECU_ADDRESS 0x382DFE /end MEASUREMENT
/begin MEASUREMENT Z_lsh "" UWORD B_TRUE 1 100 0.00 1.00000000000 BIT_MASK 0x2 FORMAT "%13.11" ECU_ADDRESS 0x382E00 /end MEASUREMENT
/begin MEASUREMENT Z_lsh2 "" UWORD B_TRUE 1 100 0.00 1.00000000000 BIT_MASK 0x2 FORMAT "%13.11" ECU_ADDRESS 0x382E02 /end MEASUREMENT
/begin MEASUREMENT Z_lsvv "" UWORD B_TRUE 1 100 0.00 1.00000000000 BIT_MASK 0x2 FORMAT "%13.11" ECU_ADDRESS 0x382E1E /end MEASUREMENT
/begin MEASUREMENT Z_lue1 "" UWORD B_TRUE 1 100 0.00 1.00000000000 BIT_MASK 0x2 FORMAT "%13.11" ECU_ADDRESS 0x382E20 /end MEASUREMENT
/begin MEASUREMENT Z_md "" UWORD B_TRUE 1 100 0.00 1.00000000000 BIT_MASK 0x2 FORMAT "%13.11" ECU_ADDRESS 0x382E26 /end MEASUREMENT
/begin MEASUREMENT Z_md00 "" UWORD B_TRUE 1 100 0.00 1.00000000000 BIT_MASK 0x2 FORMAT "%13.11" ECU_ADDRESS 0x382E28 /end MEASUREMENT
/begin MEASUREMENT Z_md01 "" UWORD B_TRUE 1 100 0.00 1.00000000000 BIT_MASK 0x2 FORMAT "%13.11" ECU_ADDRESS 0x382E2A /end MEASUREMENT
/begin MEASUREMENT Z_md02 "" UWORD B_TRUE 1 100 0.00 1.00000000000 BIT_MASK 0x2 FORMAT "%13.11" ECU_ADDRESS 0x382E2C /end MEASUREMENT
/begin MEASUREMENT Z_md03 "" UWORD B_TRUE 1 100 0.00 1.00000000000 BIT_MASK 0x2 FORMAT "%13.11" ECU_ADDRESS 0x382E2E /end MEASUREMENT
/begin MEASUREMENT Z_md04 "" UWORD B_TRUE 1 100 0.00 1.00000000000 BIT_MASK 0x2 FORMAT "%13.11" ECU_ADDRESS 0x382E30 /end MEASUREMENT
/begin MEASUREMENT Z_md05 "" UWORD B_TRUE 1 100 0.00 1.00000000000 BIT_MASK 0x2 FORMAT "%13.11" ECU_ADDRESS 0x382E32 /end MEASUREMENT
/begin MEASUREMENT Z_mfa "" UWORD B_TRUE 1 100 0.00 1.00000000000 BIT_MASK 0x2 FORMAT "%13.11" ECU_ADDRESS 0x382E36 /end MEASUREMENT
/begin MEASUREMENT Z_nwkw "" UWORD B_TRUE 1 100 0.00 1.00000000000 BIT_MASK 0x2 FORMAT "%13.11" ECU_ADDRESS 0x382E3A /end MEASUREMENT
/begin MEASUREMENT Z_nwkw2 "" UWORD B_TRUE 1 100 0.00 1.00000000000 BIT_MASK 0x2 FORMAT "%13.11" ECU_ADDRESS 0x382E3C /end MEASUREMENT
/begin MEASUREMENT Z_nx "" UWORD B_TRUE 1 100 0.00 1.00000000000 BIT_MASK 0x2 FORMAT "%13.11" ECU_ADDRESS 0x382E3E /end MEASUREMENT
/begin MEASUREMENT Z_ph "" UWORD B_TRUE 1 100 0.00 1.00000000000 BIT_MASK 0x2 FORMAT "%13.11" ECU_ADDRESS 0x382E40 /end MEASUREMENT
/begin MEASUREMENT Z_ph2 "" UWORD B_TRUE 1 100 0.00 1.00000000000 BIT_MASK 0x2 FORMAT "%13.11" ECU_ADDRESS 0x382E42 /end MEASUREMENT
/begin MEASUREMENT Z_pllsu "" UWORD B_TRUE 1 100 0.00 1.00000000000 BIT_MASK 0x2 FORMAT "%13.11" ECU_ADDRESS 0x382E44 /end MEASUREMENT
/begin MEASUREMENT Z_pllsu2 "" UWORD B_TRUE 1 100 0.00 1.00000000000 BIT_MASK 0x2 FORMAT "%13.11" ECU_ADDRESS 0x382E46 /end MEASUREMENT
/begin MEASUREMENT Z_rkat "" UWORD B_TRUE 1 100 0.00 1.00000000000 BIT_MASK 0x2 FORMAT "%13.11" ECU_ADDRESS 0x382E4A /end MEASUREMENT
/begin MEASUREMENT Z_rkat2 "" UWORD B_TRUE 1 100 0.00 1.00000000000 BIT_MASK 0x2 FORMAT "%13.11" ECU_ADDRESS 0x382E4C /end MEASUREMENT
/begin MEASUREMENT Z_rkaz "" UWORD B_TRUE 1 100 0.00 1.00000000000 BIT_MASK 0x2 FORMAT "%13.11" ECU_ADDRESS 0x382E4E /end MEASUREMENT
/begin MEASUREMENT Z_rkaz2 "" UWORD B_TRUE 1 100 0.00 1.00000000000 BIT_MASK 0x2 FORMAT "%13.11" ECU_ADDRESS 0x382E50 /end MEASUREMENT
/begin MEASUREMENT Z_sgeep "" UWORD B_TRUE 1 100 0.00 1.00000000000 BIT_MASK 0x2 FORMAT "%13.11" ECU_ADDRESS 0x382E54 /end MEASUREMENT
/begin MEASUREMENT Z_sls "" UWORD B_TRUE 1 100 0.00 1.00000000000 BIT_MASK 0x2 FORMAT "%13.11" ECU_ADDRESS 0x382E5A /end MEASUREMENT
/begin MEASUREMENT Z_sls2 "" UWORD B_TRUE 1 100 0.00 1.00000000000 BIT_MASK 0x2 FORMAT "%13.11" ECU_ADDRESS 0x382E5C /end MEASUREMENT
/begin MEASUREMENT Z_slv "" UWORD B_TRUE 1 100 0.00 1.00000000000 BIT_MASK 0x2 FORMAT "%13.11" ECU_ADDRESS 0x382E5E /end MEASUREMENT
/begin MEASUREMENT Z_slv2 "" UWORD B_TRUE 1 100 0.00 1.00000000000 BIT_MASK 0x2 FORMAT "%13.11" ECU_ADDRESS 0x382E60 /end MEASUREMENT
/begin MEASUREMENT Z_tankl "" UWORD B_TRUE 1 100 0.00 1.00000000000 BIT_MASK 0x2 FORMAT "%13.11" ECU_ADDRESS 0x382E6A /end MEASUREMENT
/begin MEASUREMENT Z_tes "" UWORD B_TRUE 1 100 0.00 1.00000000000 BIT_MASK 0x2 FORMAT "%13.11" ECU_ADDRESS 0x382E6C /end MEASUREMENT
/begin MEASUREMENT Z_tesf "" UWORD B_TRUE 1 100 0.00 1.00000000000 BIT_MASK 0x2 FORMAT "%13.11" ECU_ADDRESS 0x382E6E /end MEASUREMENT
/begin MEASUREMENT Z_tesg "" UWORD B_TRUE 1 100 0.00 1.00000000000 BIT_MASK 0x2 FORMAT "%13.11" ECU_ADDRESS 0x382E70 /end MEASUREMENT
/begin MEASUREMENT Z_teve2 "" UWORD B_TRUE 1 100 0.00 1.00000000000 BIT_MASK 0x2 FORMAT "%13.11" ECU_ADDRESS 0x382E74 /end MEASUREMENT
/begin MEASUREMENT Z_ufmv "" UWORD B_TRUE 1 100 0.00 1.00000000000 BIT_MASK 0x2 FORMAT "%13.11" ECU_ADDRESS 0x382E84 /end MEASUREMENT
/begin MEASUREMENT Z_ufnc "" UWORD B_TRUE 1 100 0.00 1.00000000000 BIT_MASK 0x2 FORMAT "%13.11" ECU_ADDRESS 0x382E86 /end MEASUREMENT
/begin MEASUREMENT Z_ufrlip "" UWORD B_TRUE 1 100 0.00 1.00000000000 BIT_MASK 0x2 FORMAT "%13.11" ECU_ADDRESS 0x382E88 /end MEASUREMENT
/begin MEASUREMENT Z_ufsga "" UWORD B_TRUE 1 100 0.00 1.00000000000 BIT_MASK 0x2 FORMAT "%13.11" ECU_ADDRESS 0x382E8A /end MEASUREMENT
/begin MEASUREMENT Z_ufsgb "" UWORD B_TRUE 1 100 0.00 1.00000000000 BIT_MASK 0x2 FORMAT "%13.11" ECU_ADDRESS 0x382E8C /end MEASUREMENT
/begin MEASUREMENT Z_ufska "" UWORD B_TRUE 1 100 0.00 1.00000000000 BIT_MASK 0x2 FORMAT "%13.11" ECU_ADDRESS 0x382E8E /end MEASUREMENT
/begin MEASUREMENT Z_ufspsc "" UWORD B_TRUE 1 100 0.00 1.00000000000 BIT_MASK 0x2 FORMAT "%13.11" ECU_ADDRESS 0x382E90 /end MEASUREMENT
/begin MEASUREMENT Z_ulsu "" UWORD B_TRUE 1 100 0.00 1.00000000000 BIT_MASK 0x2 FORMAT "%13.11" ECU_ADDRESS 0x382E92 /end MEASUREMENT
/begin MEASUREMENT Z_ulsu2 "" UWORD B_TRUE 1 100 0.00 1.00000000000 BIT_MASK 0x2 FORMAT "%13.11" ECU_ADDRESS 0x382E94 /end MEASUREMENT
/begin MEASUREMENT Z_urram "" UWORD B_TRUE 1 100 0.00 1.00000000000 BIT_MASK 0x2 FORMAT "%13.11" ECU_ADDRESS 0x382E96 /end MEASUREMENT
/begin MEASUREMENT Z_urrom "" UWORD B_TRUE 1 100 0.00 1.00000000000 BIT_MASK 0x2 FORMAT "%13.11" ECU_ADDRESS 0x382E98 /end MEASUREMENT
/begin MEASUREMENT Z_urrst "" UWORD B_TRUE 1 100 0.00 1.00000000000 BIT_MASK 0x2 FORMAT "%13.11" ECU_ADDRESS 0x382E9A /end MEASUREMENT
/begin MEASUREMENT Z_vfz "" UWORD B_TRUE 1 100 0.00 1.00000000000 BIT_MASK 0x2 FORMAT "%13.11" ECU_ADDRESS 0x382E9C /end MEASUREMENT
/begin FUNCTION DFPM_DKAT ""
 /begin DEF_CHARACTERISTIC CDCKAT CDCKAT2 CDKKAT CDKKAT2 CDTKAT CDTKAT2 CLAKAT CLAKAT2 FFTKAT FFTKAT2 TSFKAT TSFKAT2 /end DEF_CHARACTERISTIC
 /begin OUT_MEASUREMENT B_bekat B_bekat2 B_bkkat B_bkkat2 B_clkat B_clkat2 B_ftkat B_ftkat2 B_mnkat B_mnkat2 B_mxkat B_mxkat2 B_npkat B_npkat2 B_sikat B_sikat2 E_kat E_kat2 sfpkat sfpkat2 TYP_kat TYP_kat2 Z_kat Z_kat2 /end OUT_MEASUREMENT
/end FUNCTION
/begin FUNCTION DFPM_dkmtr "dkmtr." /begin DEF_CHARACTERISTIC CDCLUE1 CDKLUE1 CDTLUE1 CLALUE1 FFTLUE1 TSFLUE1 /end DEF_CHARACTERISTIC
 /begin OUT_MEASUREMENT B_belue1 B_bklue1 B_cllue1 B_ftlue1 B_mnlue1 B_mxlue1 B_nplue1 B_silue1 E_lue1 sfplue1 TYP_lue1 Z_lue1 /end OUT_MEASUREMENT
/end FUNCTION
/begin FUNCTION DFPM_DKRA ""
 /begin DEF_CHARACTERISTIC CDCKRA01 CDCKRA02 CDCKRA03 CDCKRA04 CDCKRA05 CDCKRA06 CDKKRA01 CDKKRA02 CDKKRA03 CDKKRA04 CDKKRA05 CDKKRA06 CDTKRA01 CDTKRA02 CDTKRA03 CDTKRA04 CDTKRA05 CDTKRA06 CLAKRA01 CLAKRA02 CLAKRA03 CLAKRA04 CLAKRA05 CLAKRA06 FFTKRA01 FFTKRA02 FFTKRA03 FFTKRA04 FFTKRA05 FFTKRA06 TSFKRA01 TSFKRA02 TSFKRA03 TSFKRA04 TSFKRA05 TSFKRA06 /end DEF_CHARACTERISTIC
 /begin OUT_MEASUREMENT B_clkra01 B_clkra02 B_clkra03 B_clkra04 B_clkra05 B_clkra06 B_mxkra01 B_mxkra02 B_mxkra03 B_mxkra04 B_mxkra05 B_mxkra06 E_kra01 E_kra02 E_kra03 E_kra04 E_kra05 E_kra06 sfpkra01 sfpkra02 sfpkra03 sfpkra04 sfpkra05 sfpkra06 TYPkra01 TYPkra02 TYPkra03 TYPkra04 TYPkra05 TYPkra06 Z_kra01 Z_kra02 Z_kra03 Z_kra04 Z_kra05 Z_kra06 /end OUT_MEASUREMENT
/end FUNCTION
/begin FUNCTION DFPM_DKRNT ""
 /begin DEF_CHARACTERISTIC CDCKRNT CDCKROF CDKKRNT CDKKROF CDTKRNT CDTKROF CLAKRNT CLAKROF FFTKRNT FFTKROF TSFKRNT TSFKROF /end DEF_CHARACTERISTIC
 /begin OUT_MEASUREMENT B_bekrnt B_bekrof B_bkkrnt B_bkkrof B_clkrnt B_clkrof B_ftkrnt B_ftkrof B_mnkrnt B_mnkrof B_mxkrnt B_mxkrof B_npkrnt B_npkrof B_sikrnt B_sikrof E_krnt E_krof sfpkrnt sfpkrof TYP_krnt TYP_krof Z_krnt Z_krof /end OUT_MEASUREMENT
/end FUNCTION
/begin FUNCTION DFPM_DKRS ""
 /begin DEF_CHARACTERISTIC CDCKS1 CDCKS2 CDCKS3 CDCKS4 CDKKS1 CDKKS2 CDKKS3 CDKKS4 CDTKS1 CDTKS2 CDTKS3 CDTKS4 CLAKS1 CLAKS2 CLAKS3 CLAKS4 FFTKS1 FFTKS2 FFTKS3 FFTKS4 TSFKS1 TSFKS2 TSFKS3 TSFKS4 /end DEF_CHARACTERISTIC
 /begin OUT_MEASUREMENT B_beks1 B_beks2 B_beks3 B_beks4 B_bkks1 B_bkks2 B_bkks3 B_bkks4 B_clks1 B_clks2 B_clks3 B_clks4 B_ftks1 B_ftks2 B_ftks3 B_ftks4 B_mnks1 B_mnks2 B_mnks3 B_mnks4 B_mxks1 B_mxks2 B_mxks3 B_mxks4 B_npks1 B_npks2 B_npks3 B_npks4 B_siks1 B_siks2 B_siks3 B_siks4 E_ks1 E_ks2 E_ks3 E_ks4 sfpks1 sfpks2 sfpks3 sfpks4 TYP_ks1 TYP_ks2 TYP_ks3 TYP_ks4 Z_ks1 Z_ks2 Z_ks3 Z_ks4 /end OUT_MEASUREMENT
/end FUNCTION
/begin FUNCTION DFPM_DKRTP "" /begin DEF_CHARACTERISTIC CDCKRTP CDKKRTP CDTKRTP CLAKRTP FFTKRTP TSFKRTP /end DEF_CHARACTERISTIC
 /begin OUT_MEASUREMENT B_bekrtp B_bkkrtp B_clkrtp B_ftkrtp B_mnkrtp B_mxkrtp B_npkrtp B_sikrtp E_krtp sfpkrtp TYP_krtp Z_krtp /end OUT_MEASUREMENT
/end FUNCTION
/begin FUNCTION DFPM_DKUPPL "" /begin DEF_CHARACTERISTIC CDCKUPPL CDKKUPPL CDTKUPPL CLAKUPPL FFTKUPPL TSFKUPPL /end DEF_CHARACTERISTIC
 /begin OUT_MEASUREMENT B_bekuppl B_bkkuppl B_clkuppl B_ftkuppl B_mnkuppl B_mxkuppl B_npkuppl B_sikuppl E_kuppl sfpkuppl TYP_kuppl Z_kuppl /end OUT_MEASUREMENT
/end FUNCTION
/begin FUNCTION DFPM_DKVS ""
 /begin DEF_CHARACTERISTIC CDCFRAO CDCFRAO2 CDCFRAU CDCFRAU2 CDCFRST CDCFRST2 CDCRKAT CDCRKAT2 CDCRKAZ CDCRKAZ2 CDKFRAO CDKFRAO2 CDKFRAU CDKFRAU2 CDKFRST CDKFRST2 CDKRKAT CDKRKAT2 CDKRKAZ CDKRKAZ2 CDTFRAO CDTFRAO2 CDTFRAU CDTFRAU2 CDTFRST CDTFRST2 CDTRKAT CDTRKAT2 CDTRKAZ CDTRKAZ2 CLAFRAO CLAFRAO2 CLAFRAU CLAFRAU2 CLAFRST CLAFRST2 CLARKAT CLARKAT2 CLARKAZ CLARKAZ2 FFTFRAO FFTFRAO2 FFTFRAU FFTFRAU2 FFTFRST FFTFRST2 FFTRKAT FFTRKAT2 FFTRKAZ FFTRKAZ2 TSFFRAO TSFFRAO2 TSFFRAU TSFFRAU2 TSFFRST TSFFRST2 TSFRKAT TSFRKAT2 TSFRKAZ TSFRKAZ2 /end DEF_CHARACTERISTIC
 /begin OUT_MEASUREMENT B_befrao B_befrao2 B_befrau B_befrau2 B_befrst B_befrst2 B_berkat B_berkat2 B_berkaz B_berkaz2 B_bkfrao B_bkfrao2 B_bkfrau B_bkfrau2 B_bkfrst B_bkfrst2 B_bkrkat B_bkrkat2 B_bkrkaz B_bkrkaz2 B_clfrao B_clfrao2 B_clfrau B_clfrau2 B_clfrst B_clfrst2 B_clrkat B_clrkat2 B_clrkaz B_clrkaz2 B_ftfrao B_ftfrao2 B_ftfrau B_ftfrau2 B_ftfrst B_ftfrst2 B_ftrkat B_ftrkat2 B_ftrkaz B_ftrkaz2 B_mnfrao B_mnfrao2 B_mnfrau B_mnfrau2 B_mnfrst B_mnfrst2 B_mnrkat B_mnrkat2 B_mnrkaz B_mnrkaz2 B_mxfrao B_mxfrao2 B_mxfrau B_mxfrau2 B_mxfrst B_mxfrst2 B_mxrkat B_mxrkat2 B_mxrkaz B_mxrkaz2 B_npfrao B_npfrao2 B_npfrau B_npfrau2 B_npfrst B_npfrst2 B_nprkat B_nprkat2 B_nprkaz B_nprkaz2 B_sifrao B_sifrao2 B_sifrau B_sifrau2 B_sifrst B_sifrst2 B_sirkat B_sirkat2 B_sirkaz B_sirkaz2 E_frao E_frao2 E_frau E_frau2 E_frst E_frst2 E_rkat E_rkat2 E_rkaz E_rkaz2 sfpfrao sfpfrao2 sfpfrau sfpfrau2 sfpfrst sfpfrst2 sfprkat sfprkat2 sfprkaz sfprkaz2 TYP_frao TYP_frao2 TYP_frau TYP_frau2 TYP_frst TYP_frst2 TYP_rkat TYP_rkat2 TYP_rkaz TYP_rkaz2 Z_frao Z_frao2 Z_frau Z_frau2 Z_frst Z_frst2 Z_rkat Z_rkat2 Z_rkaz Z_rkaz2 /end OUT_MEASUREMENT
/end FUNCTION
/begin FUNCTION DFPM_DLLR "" /begin DEF_CHARACTERISTIC CDCLLR CDKLLR CDTLLR CLALLR FFTLLR TSFLLR /end DEF_CHARACTERISTIC
 /begin OUT_MEASUREMENT B_bellr B_bkllr B_clllr B_ftllr B_mnllr B_mxllr B_npllr B_sillr E_llr sfpllr TYP_LLR Z_llr /end OUT_MEASUREMENT
/end FUNCTION
/begin FUNCTION DFPM_DLSAHK ""
 /begin DEF_CHARACTERISTIC CDCLASH CDCLASH2 CDCLAVH CDCLAVH2 CDKLASH CDKLASH2 CDKLAVH CDKLAVH2 CDTLASH CDTLASH2 CDTLAVH CDTLAVH2 CLALASH CLALASH2 CLALAVH CLALAVH2 FFTLASH FFTLASH2 FFTLAVH FFTLAVH2 TSFLASH TSFLASH2 TSFLAVH TSFLAVH2 /end DEF_CHARACTERISTIC
 /begin OUT_MEASUREMENT B_belash B_belash2 B_belavh B_belavh2 B_bklash B_bklash2 B_bklavh B_bklavh2 B_cllash B_cllash2 B_cllavh B_cllavh2 B_ftlash B_ftlash2 B_ftlavh B_ftlavh2 B_mnlash B_mnlash2 B_mnlavh B_mnlavh2 B_mxlash B_mxlash2 B_mxlavh B_mxlavh2 B_nplash B_nplash2 B_nplavh B_nplavh2 B_silash B_silash2 B_silavh B_silavh2 E_lash E_lash2 E_lavh E_lavh2 sfplash sfplash2 sfplavh sfplavh2 TYP_lash TYP_lash2 TYP_lavh TYP_lavh2 Z_lash Z_lash2 Z_lavh Z_lavh2 /end OUT_MEASUREMENT
/end FUNCTION
/begin FUNCTION DFPM_DLSH ""
 /begin DEF_CHARACTERISTIC CDCLSH CDCLSH2 CDKLSH CDKLSH2 CDTLSH CDTLSH2 CLALSH CLALSH2 FFTLSH FFTLSH2 TSFLSH TSFLSH2 /end DEF_CHARACTERISTIC
 /begin OUT_MEASUREMENT B_belsh B_belsh2 B_bklsh B_bklsh2 B_cllsh B_cllsh2 B_ftlsh B_ftlsh2 B_mnlsh B_mnlsh2 B_mxlsh B_mxlsh2 B_nplsh B_nplsh2 B_silsh B_silsh2 E_lsh E_lsh2 sfplsh sfplsh2 TYP_lsh TYP_lsh2 Z_lsh Z_lsh2 /end OUT_MEASUREMENT
/end FUNCTION
/begin FUNCTION DFPM_DLSUV "" /begin DEF_CHARACTERISTIC CDCLSVV CDKLSVV CDTLSVV CLALSVV FFTLSVV TSFLSVV /end DEF_CHARACTERISTIC
 /begin OUT_MEASUREMENT B_belsvv B_bklsvv B_cllsvv B_ftlsvv B_mnlsvv B_mxlsvv B_nplsvv B_silsvv E_lsvv sfplsvv TYP_lsvv Z_lsvv /end OUT_MEASUREMENT
/end FUNCTION
/begin FUNCTION DFPM_DMDMIL ""
 /begin DEF_CHARACTERISTIC CDCMD CDCMD00 CDCMD01 CDCMD02 CDCMD03 CDCMD04 CDCMD05 CDKMD CDKMD00 CDKMD01 CDKMD02 CDKMD03 CDKMD04 CDKMD05 CDTMD CDTMD00 CDTMD01 CDTMD02 CDTMD03 CDTMD04 CDTMD05 CLAMD CLAMD00 CLAMD01 CLAMD02 CLAMD03 CLAMD04 CLAMD05 FFTMD FFTMD00 FFTMD01 FFTMD02 FFTMD03 FFTMD04 FFTMD05 TSFMD TSFMD00 TSFMD01 TSFMD02 TSFMD03 TSFMD04 TSFMD05 /end DEF_CHARACTERISTIC
 /begin OUT_MEASUREMENT B_bemd B_bemd00 B_bemd01 B_bemd02 B_bemd03 B_bemd04 B_bemd05 B_bkmd B_bkmd00 B_bkmd01 B_bkmd02 B_bkmd03 B_bkmd04 B_bkmd05 B_clmd B_clmd00 B_clmd01 B_clmd02 B_clmd03 B_clmd04 B_clmd05 B_ftmd B_ftmd00 B_ftmd01 B_ftmd02 B_ftmd03 B_ftmd04 B_ftmd05 B_mnmd B_mnmd00 B_mnmd01 B_mnmd02 B_mnmd03 B_mnmd04 B_mnmd05 B_mxmd B_mxmd00 B_mxmd01 B_mxmd02 B_mxmd03 B_mxmd04 B_mxmd05 B_npmd B_npmd00 B_npmd01 B_npmd02 B_npmd03 B_npmd04 B_npmd05 B_simd B_simd00 B_simd01 B_simd02 B_simd03 B_simd04 B_simd05 E_md E_md00 E_md01 E_md02 E_md03 E_md04 E_md05 sfpmd sfpmd00 sfpmd01 sfpmd02 sfpmd03 sfpmd04 sfpmd05 TYP_md TYP_md00 TYP_md01 TYP_md02 TYP_md03 TYP_md04 TYP_md05 Z_md Z_md00 Z_md01 Z_md02 Z_md03 Z_md04 Z_md05 /end OUT_MEASUREMENT
/end FUNCTION
/begin FUNCTION DFPM_DMFB "" /begin DEF_CHARACTERISTIC CDCMFA CDKMFA CDTMFA CLAMFA FFTMFA TSFMFA /end DEF_CHARACTERISTIC
 /begin OUT_MEASUREMENT B_bemfa B_bkmfa B_clmfa B_famfa B_mnmfa B_mxmfa B_npmfa B_simfa E_mfa sfpmfa TYP_mfa Z_mfa /end OUT_MEASUREMENT
/end FUNCTION
/begin FUNCTION DFPM_DNMAX "" /begin DEF_CHARACTERISTIC CDCNX CDKNX CDTNX CLANX FFTNX TSFNX /end DEF_CHARACTERISTIC
 /begin OUT_MEASUREMENT B_benx B_bknx B_clnx B_ftnx B_mnnx B_mxnx B_npnx B_sinx E_nx sfpnx TYP_nx Z_nx /end OUT_MEASUREMENT
/end FUNCTION
/begin FUNCTION DFPM_DNWKW ""
 /begin DEF_CHARACTERISTIC CDCNWKW CDCNWKW2 CDKNWKW CDKNWKW2 CDTNWKW CDTNWKW2 CLANWKW CLANWKW2 FFTNWKW FFTNWKW2 TSFNWKW TSFNWKW2 /end DEF_CHARACTERISTIC
 /begin OUT_MEASUREMENT B_benwkw B_benwkw2 B_bknwkw B_bknwkw2 B_clnwkw B_clnwkw2 B_ftnwkw B_ftnwkw2 B_mnnwkw B_mnnwkw2 B_mxnwkw B_mxnwkw2 B_npnwkw B_npnwkw2 B_sinwkw B_sinwkw2 E_nwkw E_nwkw2 sfpnwkw sfpnwkw2 TYP_nwkw TYP_nwkw2 Z_nwkw Z_nwkw2 /end OUT_MEASUREMENT
/end FUNCTION
/begin FUNCTION DFPM_DPH ""
 /begin DEF_CHARACTERISTIC CDCPH CDCPH2 CDKPH CDKPH2 CDTPH CDTPH2 CLAPH CLAPH2 FFTPH FFTPH2 TSFPH TSFPH2 /end DEF_CHARACTERISTIC
 /begin OUT_MEASUREMENT B_beph B_beph2 B_bkph B_bkph2 B_clph B_clph2 B_ftph B_ftph2 B_mnph B_mnph2 B_mxph B_mxph2 B_npph B_npph2 B_siph B_siph2 E_ph E_ph2 sfpph sfpph2 TYP_ph TYP_ph2 Z_ph Z_ph2 /end OUT_MEASUREMENT
/end FUNCTION
/begin FUNCTION DFPM_DPL "" /begin DEF_CHARACTERISTIC CDCDPL CDKDPL CDTDPL CLADPL FFTDPL TSFDPL /end DEF_CHARACTERISTIC
 /begin OUT_MEASUREMENT B_bedpl B_bkdpl B_cldpl B_ftdpl B_mndpl B_mxdpl B_npddpl B_siddpl E_dpl sfpdpl TYP_dpl Z_dpl /end OUT_MEASUREMENT
/end FUNCTION
/begin FUNCTION DFPM_DPLLSU ""
 /begin DEF_CHARACTERISTIC CDCPLLSU CDCPLLSU2 CDKPLLSU CDKPLLSU2 CDTPLLSU CDTPLLSU2 CLAPLLSU CLAPLLSU2 FFTPLLSU FFTPLLSU2 TSFPLLSU TSFPLLSU2 /end DEF_CHARACTERISTIC
 /begin OUT_MEASUREMENT B_bepllsu B_bepllsu2 B_bkpllsu B_bkpllsu2 B_clpllsu B_clpllsu2 B_ftpllsu B_ftpllsu2 B_mnpllsu B_mnpllsu2 B_mxpllsu B_mxpllsu2 B_nppllsu B_nppllsu2 B_sipllsu B_sipllsu2 E_pllsu E_pllsu2 sfppllsu sfppllsu2 TYP_pllsu TYP_pllsu2 Z_pllsu Z_pllsu2 /end OUT_MEASUREMENT
/end FUNCTION
/begin FUNCTION DFPM_DSELHFS "" /begin DEF_CHARACTERISTIC CDCLM CDKLM CDTLM CLALM FFTLM TSFLM /end DEF_CHARACTERISTIC
 /begin OUT_MEASUREMENT B_belm B_bklm B_cllm B_falm B_mnlm B_mxlm B_nplm B_silm E_lm sfplm TYP_lm Z_lm /end OUT_MEASUREMENT
/end FUNCTION
/begin FUNCTION DFPM_DSGEEP "" /begin DEF_CHARACTERISTIC CDCSGEEP CDKSGEEP CDTSGEEP CLASGEEP FFTSGEEP TSFSGEEP /end DEF_CHARACTERISTIC
 /begin OUT_MEASUREMENT B_besgeep B_bksgeep B_clsgeep B_ftsgeep B_mnsgeep B_mxsgeep B_npsgeep B_sisgeep E_sgeep sfpsgeep TYP_sgeep Z_sgeep /end OUT_MEASUREMENT
/end FUNCTION
/begin FUNCTION DFPM_DSLSLRS ""
 /begin DEF_CHARACTERISTIC CDCSLS CDCSLS2 CDCSLV CDCSLV2 CDKSLS CDKSLS2 CDKSLV CDKSLV2 CDTSLS CDTSLS2 CDTSLV CDTSLV2 CLASLS CLASLS2 CLASLV CLASLV2 FFTSLS FFTSLS2 FFTSLV FFTSLV2 TSFSLS TSFSLS2 TSFSLV TSFSLV2 /end DEF_CHARACTERISTIC
 /begin OUT_MEASUREMENT B_besls B_besls2 B_beslv B_beslv2 B_bksls B_bksls2 B_bkslv B_bkslv2 B_clsls B_clsls2 B_clslv B_clslv2 B_ftsls B_ftsls2 B_ftslv B_ftslv2 B_mnsls B_mnsls2 B_mnslv B_mnslv2 B_mxsls B_mxsls2 B_mxslv B_mxslv2 B_npsls B_npsls2 B_npslv B_npslv2 B_sisls B_sisls2 B_sislv B_sislv2 E_sls E_sls2 E_slv E_slv2 sfpsls sfpsls2 sfpslv sfpslv2 TYP_sls TYP_sls2 TYP_slv TYP_slv2 Z_sls Z_sls2 Z_slv Z_slv2 /end OUT_MEASUREMENT
/end FUNCTION
/begin FUNCTION DFPM_DTANKL "" /begin DEF_CHARACTERISTIC CDCTANKL CDKTANKL CDTTANKL CLATANKL FFTTANKL TSFTANKL /end DEF_CHARACTERISTIC
 /begin OUT_MEASUREMENT B_betankl B_bktankl B_cltankl B_fttankl B_mntankl B_mxtankl B_nptankl B_sitankl E_tankl sfptankl TYP_tankl Z_tankl /end OUT_MEASUREMENT
/end FUNCTION
/begin FUNCTION DFPM_DTEV "" /begin DEF_CHARACTERISTIC CDCTES CDKTES CDTTES CLATES FFTTES TSFTES /end DEF_CHARACTERISTIC
 /begin OUT_MEASUREMENT B_avtes B_betes B_bktes B_cltes B_fttes B_mntes B_mxtes B_nptes B_pytes B_sctes B_sites E_tes sfptes TYP_tes Z_tes /end OUT_MEASUREMENT
/end FUNCTION
/begin FUNCTION DFPM_DUF ""
 /begin DEF_CHARACTERISTIC CDCUFMV CDCUFNC CDCUFRLIP CDCUFSGA CDCUFSGB CDCUFSKA CDCUFSPSC CDKUFMV CDKUFNC CDKUFRLIP CDKUFSGA CDKUFSGB CDKUFSKA CDKUFSPSC CDTUFMV CDTUFNC CDTUFRLIP CDTUFSGA CDTUFSGB CDTUFSKA CDTUFSPSC CLAUFMV CLAUFNC CLAUFRLIP CLAUFSGA CLAUFSGB CLAUFSKA CLAUFSPSC FFTUFMV FFTUFNC FFTUFRLIP FFTUFSGA FFTUFSGB FFTUFSKA FFTUFSPSC TSFUFMV TSFUFNC TSFUFRLIP TSFUFSGA TSFUFSGB TSFUFSKA TSFUFSPSC /end DEF_CHARACTERISTIC
 /begin OUT_MEASUREMENT B_beufmv B_beufnc B_beufrlip B_beufsga B_beufsgb B_beufska B_beufspsc B_bkufmv B_bkufnc B_bkufrlip B_bkufsga B_bkufsgb B_bkufska B_bkufspsc B_clufmv B_clufnc B_clufrlip B_clufsga B_clufsgb B_clufska B_clufspsc B_ftufmv B_ftufnc B_ftufrlip B_ftufsga B_ftufsgb B_ftufska B_ftufspsc B_mnufmv B_mnufnc B_mnufrlip B_mnufsga B_mnufsgb B_mnufska B_mnufspsc B_mxufmv B_mxufnc B_mxufrlip B_mxufsga B_mxufsgb B_mxufska B_mxufspsc B_npufmv B_npufnc B_npufrlip B_npufsga B_npufsgb B_npufska B_npufspsc B_siufmv B_siufnc B_siufrlip B_siufsga B_siufsgb B_siufska B_siufspsc E_ufmv E_ufnc E_ufrlip E_ufsga E_ufsgb E_ufska E_ufspsc sfpufmv sfpufnc sfpufrlip sfpufsga sfpufsgb sfpufska sfpufspsc TYP_ufmv TYP_ufnc TYP_ufrlip TYP_ufsga TYP_ufsgb TYP_ufska TYP_ufspsc Z_ufmv Z_ufnc Z_ufrlip Z_ufsga Z_ufsgb Z_ufska Z_ufspsc /end OUT_MEASUREMENT
/end FUNCTION
/begin FUNCTION DFPM_DULSU ""
 /begin DEF_CHARACTERISTIC CDCULSU CDCULSU2 CDKULSU CDKULSU2 CDTULSU CDTULSU2 CLAULSU CLAULSU2 FFTULSU FFTULSU2 TSFULSU TSFULSU2 /end DEF_CHARACTERISTIC
 /begin OUT_MEASUREMENT B_beulsu B_beulsu2 B_bkulsu B_bkulsu2 B_clulsu B_clulsu2 B_ftulsu B_ftulsu2 B_mnulsu B_mnulsu2 B_mxulsu B_mxulsu2 B_npulsu B_npulsu2 B_siulsu B_siulsu2 E_ulsu E_ulsu2 sfpulsu sfpulsu2 TYP_ulsu TYP_ulsu2 Z_ulsu Z_ulsu2 /end OUT_MEASUREMENT
/end FUNCTION
/begin FUNCTION DFPM_DUMMY_D ""
 /begin DEF_CHARACTERISTIC CDCDSBKV CDCTESF CDCTESG CDCTEVE2 CDKDSBKV CDKTESF CDKTESG CDKTEVE2 CDTDSBKV CDTTESF CDTTESG CDTTEVE2 CLADSBKV CLATESF CLATESG CLATEVE2 FFTDSBKV FFTTESF FFTTESG FFTTEVE2 TSFDSBKV TSFTESF TSFTESG TSFTEVE2 /end DEF_CHARACTERISTIC
 /begin OUT_MEASUREMENT B_bedsbkv B_betesf B_betesg B_bkdsbkv B_bktesf B_bktesg B_cldsbkv B_cltesf B_cltesg B_ftdsbkv B_fttesf B_fttesg B_mndsbkv B_mntesf B_mntesg B_mxdsbkv B_mxtesf B_mxtesg B_npdsbkv B_nptesf B_nptesg B_sidsbkv B_sitesf B_sitesg E_dsbkv E_tesf E_tesg E_teve2 sfpdsbkv sfptesf sfptesg sfpteve2 TYP_dsbkv TYP_tesf TYP_tesg Z_dsbkv Z_tesf Z_tesg Z_teve2 /end OUT_MEASUREMENT
/end FUNCTION
/begin FUNCTION DFPM_DUR ""
 /begin DEF_CHARACTERISTIC CDCURRAM CDCURROM CDCURRST CDKURRAM CDKURROM CDKURRST CDTURRAM CDTURROM CDTURRST CLAURRAM CLAURROM CLAURRST FFTURRAM FFTURROM FFTURRST TSFURRAM TSFURROM TSFURRST /end DEF_CHARACTERISTIC
 /begin OUT_MEASUREMENT B_beurram B_beurrom B_beurrst B_bkurram B_bkurrom B_bkurrst B_clurram B_clurrom B_clurrst B_fturram B_fturrom B_fturrst B_mnurram B_mnurrom B_mnurrst B_mxurram B_mxurrom B_mxurrst B_npurram B_npurrom B_npurrst B_siurram B_siurrom B_siurrst E_urram E_urrom E_urrst sfpurram sfpurrom sfpurrst TYP_urram TYP_urrom TYP_urrst Z_urram Z_urrom Z_urrst /end OUT_MEASUREMENT
/end FUNCTION
/begin FUNCTION DFPM_DVFZ "" /begin DEF_CHARACTERISTIC CDCVFZ CDKVFZ CDTVFZ CLAVFZ FFTVFZ TSFVFZ /end DEF_CHARACTERISTIC
 /begin OUT_MEASUREMENT B_bevfz B_bkvfz B_clvfz B_ftvfz B_mnvfz B_mxvfz B_npvfz B_sivfz E_vfz sfpvfz TYP_vfz Z_vfz /end OUT_MEASUREMENT
/end FUNCTION
/begin FUNCTION DFPM_GECOD "" /begin DEF_CHARACTERISTIC CDCGECOD CDKGECOD CDTGECOD CLAGECOD FFTGECOD TSFGECOD /end DEF_CHARACTERISTIC
 /begin OUT_MEASUREMENT B_avgecod B_begecod B_bkgecod B_clgecod B_ftgecod B_mngecod B_mxgecod B_npgecod B_pygecod B_scgecod B_sigecod E_gecod sfpgecod TYP_gecod Z_gecod /end OUT_MEASUREMENT
/end FUNCTION
/begin FUNCTION DFPM_GGCEGSPL "" /begin DEF_CHARACTERISTIC CDCCGE CDKCGE CDTCGE CLACGE FFTCGE TSFCGE /end DEF_CHARACTERISTIC
 /begin OUT_MEASUREMENT B_becge B_bkcge B_clcge B_ftcge B_mncge B_mxcge B_npcge B_sicge E_cge sfpcge TYP_cge Z_cge /end OUT_MEASUREMENT
/end FUNCTION
/begin COMPU_METHOD B_TRUE "" TAB_VERB "%6.3" "" COMPU_TAB_REF B_TRUE /end COMPU_METHOD
/begin COMPU_VTAB B_TRUE "" TAB_VERB 2 0 "----" 1 "TRUE" /end COMPU_VTAB
/begin COMPU_METHOD DEZ "" RAT_FUNC "%6.2" "" COEFFS 0 1 0 0 0 1 /end COMPU_METHOD
/begin COMPU_METHOD dez "" RAT_FUNC "%6.2" "" COEFFS 0 1 0 0 0 1 /end COMPU_METHOD
/begin COMPU_METHOD default "" RAT_FUNC "%6.2" "" COEFFS 0 1 0 0 0 1 /end COMPU_METHOD
/begin RECORD_LAYOUT KwbUb FNC_VALUES 1 UBYTE COLUMN_DIR DIRECT /end RECORD_LAYOUT
/begin RECORD_LAYOUT KwbUw FNC_VALUES 1 UWORD COLUMN_DIR DIRECT /end RECORD_LAYOUT
/begin RECORD_LAYOUT KwUb FNC_VALUES 1 UBYTE COLUMN_DIR DIRECT /end RECORD_LAYOUT
/begin RECORD_LAYOUT KwUw FNC_VALUES 1 UWORD COLUMN_DIR DIRECT /end RECORD_LAYOUT
/end MODULE
/end PROJECT
