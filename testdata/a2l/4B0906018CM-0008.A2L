ASAP2_VERSION 1 3
/begin PROJECT X505P_24HG_1 "X505P"
/begin HEADER "" VERSION "X505P_24HG_1" PROJECT_NO X505P_24HG_1 /end HEADER
/begin MODULE DIM ""
/begin MOD_COMMON "" BYTE_ORDER MSB_LAST ALIGNMENT_BYTE 1 ALIGNMENT_WORD 2 ALIGNMENT_LONG 2 /end MOD_COMMON
/begin CHARACTERISTIC CDCAGRF "Codewort CARB: Überwachung AGR-FLOW" VAL_BLK 0x81426C KwbUw 65535.00 dez 0.00 65535.00 FORMAT "%8.2" NUMBER 4 /end CHARACTERISTIC
/begin CHARACTERISTIC CDCBREMS "Codewort CARB: Bremspedalgeber" VAL_BLK 0x8142BC KwbUw 65535.00 dez 0.00 65535.00 FORMAT "%8.2" NUMBER 4 /end CHARACTERISTIC
/begin CHARACTERISTIC CDCBWF "Codewort CARB: PWG Bewegung" VAL_BLK 0x8142C4 KwbUw 65535.00 dez 0.00 65535.00 FORMAT "%8.2" NUMBER 4 /end CHARACTERISTIC
/begin CHARACTERISTIC CDCCAIRP "Codewort CARB: unpl. Airbag-Botschaft" VAL_BLK 0x8142D4 KwbUw 65535.00 dez 0.00 65535.00 FORMAT "%8.2" NUMBER 4 /end CHARACTERISTIC
/begin CHARACTERISTIC CDCDKVM "Codewort CARB: Drosselklappenverschmutzung" VAL_BLK 0x814334 KwbUw 65535.00 dez 0.00 65535.00 FORMAT "%8.2" NUMBER 4 /end CHARACTERISTIC
/begin CHARACTERISTIC CDCDPL "Codewort CARB: Dauerplus" VAL_BLK 0x81433C KwbUw 65535.00 dez 0.00 65535.00 FORMAT "%8.2" NUMBER 4 /end CHARACTERISTIC
/begin CHARACTERISTIC CDCDSBKV "Codewort CARB: BKV" VAL_BLK 0x814344 KwbUw 65535.00 dez 0.00 65535.00 FORMAT "%8.2" NUMBER 4 /end CHARACTERISTIC
/begin CHARACTERISTIC CDCDSL "Codewort CARB: Drucksensor Ladedruck" VAL_BLK 0x81434C KwbUw 65535.00 dez 0.00 65535.00 FORMAT "%8.2" NUMBER 4 /end CHARACTERISTIC
/begin CHARACTERISTIC CDCDSU "Codewort CARB: Drucksensor Umgebung" VAL_BLK 0x814354 KwbUw 65535.00 dez 0.00 65535.00 FORMAT "%8.2" NUMBER 4 /end CHARACTERISTIC
/begin CHARACTERISTIC CDCDSVLU "Codewort CARB: Drucksensorsignalvergleich (DS-L DS-U)" VAL_BLK 0x81435C KwbUw 65535.00 dez 0.00 65535.00 FORMAT "%8.2" NUMBER 4 /end CHARACTERISTIC
/begin CHARACTERISTIC CDCFP1P "Codewort CARB: Poti 1, Fahrpedal" VAL_BLK 0x814404 KwbUw 65535.00 dez 0.00 65535.00 FORMAT "%8.2" NUMBER 4 /end CHARACTERISTIC
/begin CHARACTERISTIC CDCFP2P "Codewort CARB: Poti 2, Fahrpedal" VAL_BLK 0x81440C KwbUw 65535.00 dez 0.00 65535.00 FORMAT "%8.2" NUMBER 4 /end CHARACTERISTIC
/begin CHARACTERISTIC CDCFPP "Codewort CARB: Fahrpedal" VAL_BLK 0x814414 KwbUw 65535.00 dez 0.00 65535.00 FORMAT "%8.2" NUMBER 4 /end CHARACTERISTIC
/begin CHARACTERISTIC CDCGECOD "Codewort CARB: Getriebecodierung CAN" VAL_BLK 0x814434 KwbUw 65535.00 dez 0.00 65535.00 FORMAT "%8.2" NUMBER 4 /end CHARACTERISTIC
/begin CHARACTERISTIC CDCGRBH "Codewort CARB: GRA Bedienhebelfehler" VAL_BLK 0x81443C KwbUw 65535.00 dez 0.00 65535.00 FORMAT "%8.2" NUMBER 4 /end CHARACTERISTIC
/begin CHARACTERISTIC CDCHLA "Codewort CARB: Heizleistungsanforderung" VAL_BLK 0x814444 KwbUw 65535.00 dez 0.00 65535.00 FORMAT "%8.2" NUMBER 4 /end CHARACTERISTIC
/begin CHARACTERISTIC CDCHRE "Codewort CARB: Hauptrelais Endstufe" VAL_BLK 0x81444C KwbUw 65535.00 dez 0.00 65535.00 FORMAT "%8.2" NUMBER 4 /end CHARACTERISTIC
/begin CHARACTERISTIC CDCLASH "Codewort CARB: Lambda-Sondenalterung hinter Kat." VAL_BLK 0x8144FC KwbUw 65535.00 dez 0.00 65535.00 FORMAT "%8.2" NUMBER 4 /end CHARACTERISTIC
/begin CHARACTERISTIC CDCLDO "Codewort CARB: Ladedruckkennlinie; oberer Wert überschritten" VAL_BLK 0x81450C KwbUw 65535.00 dez 0.00 65535.00 FORMAT "%8.2" NUMBER 4 /end CHARACTERISTIC
/begin CHARACTERISTIC CDCLDP "Codewort CARB: Leckdiagnosepumpe" VAL_BLK 0x814514 KwbUw 65535.00 dez 0.00 65535.00 FORMAT "%8.2" NUMBER 4 /end CHARACTERISTIC
/begin CHARACTERISTIC CDCLDRA "Codewort CARB: Ladedruckregelabweichung" VAL_BLK 0x814524 KwbUw 65535.00 dez 0.00 65535.00 FORMAT "%8.2" NUMBER 4 /end CHARACTERISTIC
/begin CHARACTERISTIC CDCLDUV "Codewort CARB: Schubumluftventil-Endstufe" VAL_BLK 0x81452C KwbUw 65535.00 dez 0.00 65535.00 FORMAT "%8.2" NUMBER 4 /end CHARACTERISTIC
/begin CHARACTERISTIC CDCLKVDK "Codewort CARB: Leck vor Drosselklappe" VAL_BLK 0x814534 KwbUw 65535.00 dez 0.00 65535.00 FORMAT "%8.2" NUMBER 4 /end CHARACTERISTIC
/begin CHARACTERISTIC CDCLLR "Codewort CARB: Leerlaufregelung am Anschlag" VAL_BLK 0x81453C KwbUw 65535.00 dez 0.00 65535.00 FORMAT "%8.2" NUMBER 4 /end CHARACTERISTIC
/begin CHARACTERISTIC CDCLM "Codewort CARB: LMM/HLM/HFM" VAL_BLK 0x814544 KwbUw 65535.00 dez 0.00 65535.00 FORMAT "%8.2" NUMBER 4 /end CHARACTERISTIC
/begin CHARACTERISTIC CDCLSH "Codewort CARB: Lambda-Sonde hinter Kat" VAL_BLK 0x81454C KwbUw 65535.00 dez 0.00 65535.00 FORMAT "%8.2" NUMBER 4 /end CHARACTERISTIC
/begin CHARACTERISTIC CDCLSV "Codewort CARB: Lambda-Sonde vor Kat" VAL_BLK 0x814554 KwbUw 65535.00 dez 0.00 65535.00 FORMAT "%8.2" NUMBER 4 /end CHARACTERISTIC
/begin CHARACTERISTIC CDCMD "Codewort CARB: Aussetzer, Summenfehler (multiple)" VAL_BLK 0x81456C KwbUw 65535.00 dez 0.00 65535.00 FORMAT "%8.2" NUMBER 4 /end CHARACTERISTIC
/begin CHARACTERISTIC CDCMD00 "Codewort CARB: Aussetzer Zyl. 0" VAL_BLK 0x814574 KwbUw 65535.00 dez 0.00 65535.00 FORMAT "%8.2" NUMBER 4 /end CHARACTERISTIC
/begin CHARACTERISTIC CDCMD01 "Codewort CARB: Aussetzer Zyl. 1" VAL_BLK 0x81457C KwbUw 65535.00 dez 0.00 65535.00 FORMAT "%8.2" NUMBER 4 /end CHARACTERISTIC
/begin CHARACTERISTIC CDCMD02 "Codewort CARB: Aussetzer Zylinder 2" VAL_BLK 0x814584 KwbUw 65535.00 dez 0.00 65535.00 FORMAT "%8.2" NUMBER 4 /end CHARACTERISTIC
/begin CHARACTERISTIC CDCMD03 "Codewort CARB: Aussetzer Zylinder 3" VAL_BLK 0x81458C KwbUw 65535.00 dez 0.00 65535.00 FORMAT "%8.2" NUMBER 4 /end CHARACTERISTIC
/begin CHARACTERISTIC CDCMFA "Codewort CARB: MIL-fremdbestimmt" VAL_BLK 0x81459C KwbUw 65535.00 dez 0.00 65535.00 FORMAT "%8.2" NUMBER 4 /end CHARACTERISTIC
/begin CHARACTERISTIC CDCNWKW "Codewort CARB: Zuordnung Nockenwelle zu Kurbelwelle" VAL_BLK 0x8145B4 KwbUw 65535.00 dez 0.00 65535.00 FORMAT "%8.2" NUMBER 4 /end CHARACTERISTIC
/begin CHARACTERISTIC CDCNX "Codewort CARB: NMAX - Überschreitung" VAL_BLK 0x8145C4 KwbUw 65535.00 dez 0.00 65535.00 FORMAT "%8.2" NUMBER 4 /end CHARACTERISTIC
/begin CHARACTERISTIC CDCPH "Codewort CARB: Phasensensor" VAL_BLK 0x8145CC KwbUw 65535.00 dez 0.00 65535.00 FORMAT "%8.2" NUMBER 4 /end CHARACTERISTIC
/begin CHARACTERISTIC CDCPWM "" VAL_BLK 0x8145D4 KwbUw 65535.00 dez 0.00 65535.00 FORMAT "%8.2" NUMBER 4 /end CHARACTERISTIC
/begin CHARACTERISTIC CDCSCR "Codewort CARB: Überwachung Crashsignal" VAL_BLK 0x8145EC KwbUw 65535.00 dez 0.00 65535.00 FORMAT "%8.2" NUMBER 4 /end CHARACTERISTIC
/begin CHARACTERISTIC CDCSGEEP "Codewort CARB: Steuergerät defekt (EEPROM)" VAL_BLK 0x8145F4 KwbUw 65535.00 dez 0.00 65535.00 FORMAT "%8.2" NUMBER 4 /end CHARACTERISTIC
/begin CHARACTERISTIC CDCSLS "Codewort CARB: Sekundärluft-System" VAL_BLK 0x81460C KwbUw 65535.00 dez 0.00 65535.00 FORMAT "%8.2" NUMBER 4 /end CHARACTERISTIC
/begin CHARACTERISTIC CDCSLV "Codewort CARB: Sekundärluftventil" VAL_BLK 0x814614 KwbUw 65535.00 dez 0.00 65535.00 FORMAT "%8.2" NUMBER 4 /end CHARACTERISTIC
/begin CHARACTERISTIC CDCSWE "Codewort CARB: Beschleunigungssensor der Schlechtwegeerkennung" VAL_BLK 0x814624 KwbUw 65535.00 dez 0.00 65535.00 FORMAT "%8.2" NUMBER 4 /end CHARACTERISTIC
/begin CHARACTERISTIC CDCT2STC "" VAL_BLK 0x81462C KwbUw 65535.00 dez 0.00 65535.00 FORMAT "%8.2" NUMBER 4 /end CHARACTERISTIC
/begin CHARACTERISTIC CDCTA "Codewort CARB: TANS" VAL_BLK 0x814634 KwbUw 65535.00 dez 0.00 65535.00 FORMAT "%8.2" NUMBER 4 /end CHARACTERISTIC
/begin CHARACTERISTIC CDCTANKL "Codewort CARB: OBDII Fehler auf Grund eines leeren Tanks" VAL_BLK 0x81463C KwbUw 65535.00 dez 0.00 65535.00 FORMAT "%8.2" NUMBER 4 /end CHARACTERISTIC
/begin CHARACTERISTIC CDCTES "Codewort CARB: Tankentlüftungssystem" VAL_BLK 0x814644 KwbUw 65535.00 dez 0.00 65535.00 FORMAT "%8.2" NUMBER 4 /end CHARACTERISTIC
/begin CHARACTERISTIC CDCTESF "Codewort CARB: Tankentlüftungssystem Feinleck" VAL_BLK 0x81464C KwbUw 65535.00 dez 0.00 65535.00 FORMAT "%8.2" NUMBER 4 /end CHARACTERISTIC
/begin CHARACTERISTIC CDCTESG "Codewort CARB: Tankentlüftungssystem Grobleck" VAL_BLK 0x814654 KwbUw 65535.00 dez 0.00 65535.00 FORMAT "%8.2" NUMBER 4 /end CHARACTERISTIC
/begin CHARACTERISTIC CDCTEVE2 "Codewort CARB: Tankentlüftungsventil Endstufe  Bank2" VAL_BLK 0x814664 KwbUw 65535.00 dez 0.00 65535.00 FORMAT "%8.2" NUMBER 4 /end CHARACTERISTIC
/begin CHARACTERISTIC CDCTHM "Codewort CARB: Thermostat-Diagnose THM" VAL_BLK 0x81466C KwbUw 65535.00 dez 0.00 65535.00 FORMAT "%8.2" NUMBER 4 /end CHARACTERISTIC
/begin CHARACTERISTIC CDCTKA "Codewort CARB: Temperatur Kühlerausgang" VAL_BLK 0x814674 KwbUw 65535.00 dez 0.00 65535.00 FORMAT "%8.2" NUMBER 4 /end CHARACTERISTIC
/begin CHARACTERISTIC CDCTM "Codewort CARB: Motortemperatur TMOT" VAL_BLK 0x81467C KwbUw 65535.00 dez 0.00 65535.00 FORMAT "%8.2" NUMBER 4 /end CHARACTERISTIC
/begin CHARACTERISTIC CDCTMKI "Codewort CARB: Motortemperatur aus Kombiinstrument TMKI" VAL_BLK 0x814684 KwbUw 65535.00 dez 0.00 65535.00 FORMAT "%8.2" NUMBER 4 /end CHARACTERISTIC
/begin CHARACTERISTIC CDCUB "Codewort CARB: Batteriespannung UB (Bordnetz)" VAL_BLK 0x81469C KwbUw 65535.00 dez 0.00 65535.00 FORMAT "%8.2" NUMBER 4 /end CHARACTERISTIC
/begin CHARACTERISTIC CDCUBR "Codewort CARB: UBR Bordnetzspannung über Hauptrelais" VAL_BLK 0x8146A4 KwbUw 65535.00 dez 0.00 65535.00 FORMAT "%8.2" NUMBER 4 /end CHARACTERISTIC
/begin CHARACTERISTIC CDCUFMV "Codewort CARB: Funktionsüberwachung: Momentenvergleich" VAL_BLK 0x8146AC KwbUw 65535.00 dez 0.00 65535.00 FORMAT "%8.2" NUMBER 4 /end CHARACTERISTIC
/begin CHARACTERISTIC CDCUFSKA "Codewort CARB: Funktionsüberwachung: Sicherheits-Kraftstoff-Abschaltung" VAL_BLK 0x8146B4 KwbUw 65535.00 dez 0.00 65535.00 FORMAT "%8.2" NUMBER 4 /end CHARACTERISTIC
/begin CHARACTERISTIC CDCURRAM "Codewort CARB: Rechnerüberwachung: RAM" VAL_BLK 0x8146BC KwbUw 65535.00 dez 0.00 65535.00 FORMAT "%8.2" NUMBER 4 /end CHARACTERISTIC
/begin CHARACTERISTIC CDCURROM "Codewort CARB: Rechnerüberwachung: ROM" VAL_BLK 0x8146C4 KwbUw 65535.00 dez 0.00 65535.00 FORMAT "%8.2" NUMBER 4 /end CHARACTERISTIC
/begin CHARACTERISTIC CDCURRST "Codewort CARB: Rechnerüberwachung: Reset" VAL_BLK 0x8146CC KwbUw 65535.00 dez 0.00 65535.00 FORMAT "%8.2" NUMBER 4 /end CHARACTERISTIC
/begin CHARACTERISTIC CDCVFZ "Codewort CARB: Fahrzeug-Geschwindigkeit" VAL_BLK 0x8146DC KwbUw 65535.00 dez 0.00 65535.00 FORMAT "%8.2" NUMBER 4 /end CHARACTERISTIC
/begin CHARACTERISTIC CDKAGRF "Codewort Kunde: Überwachung AGR-FLOW" VAL_BLK 0x814734 KwbUw 65535.00 dez 0.00 65535.00 FORMAT "%8.2" NUMBER 4 /end CHARACTERISTIC
/begin CHARACTERISTIC CDKBREMS "Codewort Kunde: BREMS (Bremsschalter)" VAL_BLK 0x814784 KwbUw 65535.00 dez 0.00 65535.00 FORMAT "%8.2" NUMBER 4 /end CHARACTERISTIC
/begin CHARACTERISTIC CDKBWF "Codewort Kunde: PWG Bewegung" VAL_BLK 0x81478C KwbUw 65535.00 dez 0.00 65535.00 FORMAT "%8.2" NUMBER 4 /end CHARACTERISTIC
/begin CHARACTERISTIC CDKCAIRP "Codewort Kunde: unpl. Airbag-Botschaft" VAL_BLK 0x81479C KwbUw 65535.00 dez 0.00 65535.00 FORMAT "%8.2" NUMBER 4 /end CHARACTERISTIC
/begin CHARACTERISTIC CDKDKVM "Codewort Kunde: Drosselklappenverschmutzung" VAL_BLK 0x8147FC KwbUw 65535.00 dez 0.00 65535.00 FORMAT "%8.2" NUMBER 4 /end CHARACTERISTIC
/begin CHARACTERISTIC CDKDPL "Codewort Kunde: Dauerplus" VAL_BLK 0x814804 KwbUw 65535.00 dez 0.00 65535.00 FORMAT "%8.2" NUMBER 4 /end CHARACTERISTIC
/begin CHARACTERISTIC CDKDSBKV "Codewort Kunde: Bremskraftverstärker" VAL_BLK 0x81480C KwbUw 65535.00 dez 0.00 65535.00 FORMAT "%8.2" NUMBER 4 /end CHARACTERISTIC
/begin CHARACTERISTIC CDKDSL "Codewort Kunde: Drucksensor Ladedruck" VAL_BLK 0x814814 KwbUw 65535.00 dez 0.00 65535.00 FORMAT "%8.2" NUMBER 4 /end CHARACTERISTIC
/begin CHARACTERISTIC CDKDSU "Codewort Kunde: Drucksensor Umgebung" VAL_BLK 0x81481C KwbUw 65535.00 dez 0.00 65535.00 FORMAT "%8.2" NUMBER 4 /end CHARACTERISTIC
/begin CHARACTERISTIC CDKDSVLU "Codewort Kunde: Drucksensorsignalvergleich (DS-L DS-U)" VAL_BLK 0x814824 KwbUw 65535.00 dez 0.00 65535.00 FORMAT "%8.2" NUMBER 4 /end CHARACTERISTIC
/begin CHARACTERISTIC CDKFP1P "Codewort Kunde: Poti 1, Fahrpedal" VAL_BLK 0x8148CC KwbUw 65535.00 dez 0.00 65535.00 FORMAT "%8.2" NUMBER 4 /end CHARACTERISTIC
/begin CHARACTERISTIC CDKFP2P "Codewort Kunde: Poti 2, Fahrpedal" VAL_BLK 0x8148D4 KwbUw 65535.00 dez 0.00 65535.00 FORMAT "%8.2" NUMBER 4 /end CHARACTERISTIC
/begin CHARACTERISTIC CDKFPP "Codewort Kunde: Poti Fahrpedal" VAL_BLK 0x8148DC KwbUw 65535.00 dez 0.00 65535.00 FORMAT "%8.2" NUMBER 4 /end CHARACTERISTIC
/begin CHARACTERISTIC CDKGECOD "Codewort Kunde: Getriebecodierung CAN" VAL_BLK 0x8148FC KwbUw 65535.00 dez 0.00 65535.00 FORMAT "%8.2" NUMBER 4 /end CHARACTERISTIC
/begin CHARACTERISTIC CDKGRBH "Codewort Kunde: GRA Bedienhebelfehler" VAL_BLK 0x814904 KwbUw 65535.00 dez 0.00 65535.00 FORMAT "%8.2" NUMBER 4 /end CHARACTERISTIC
/begin CHARACTERISTIC CDKHLA "Codeword Kunde: Heizleistungsanforderung" VAL_BLK 0x81490C KwbUw 65535.00 dez 0.00 65535.00 FORMAT "%8.2" NUMBER 4 /end CHARACTERISTIC
/begin CHARACTERISTIC CDKHRE "" VAL_BLK 0x814914 KwbUw 65535.00 dez 0.00 65535.00 FORMAT "%8.2" NUMBER 4 /end CHARACTERISTIC
/begin CHARACTERISTIC CDKLASH "Codewort Kunde: Lambda-Sondenalterung hinter Kat." VAL_BLK 0x8149C4 KwbUw 65535.00 dez 0.00 65535.00 FORMAT "%8.2" NUMBER 4 /end CHARACTERISTIC
/begin CHARACTERISTIC CDKLDO "Codewort Kunde: Ladedruckkennlinie; oberer Wert überschritten" VAL_BLK 0x8149D4 KwbUw 65535.00 dez 0.00 65535.00 FORMAT "%8.2" NUMBER 4 /end CHARACTERISTIC
/begin CHARACTERISTIC CDKLDP "Codewort Kunde: Leckdiagnosepumpe" VAL_BLK 0x8149DC KwbUw 65535.00 dez 0.00 65535.00 FORMAT "%8.2" NUMBER 4 /end CHARACTERISTIC
/begin CHARACTERISTIC CDKLDRA "Codewort Kunde: Ladedruckregelabweichung" VAL_BLK 0x8149EC KwbUw 65535.00 dez 0.00 65535.00 FORMAT "%8.2" NUMBER 4 /end CHARACTERISTIC
/begin CHARACTERISTIC CDKLDUV "Codewort Kunde: Schubumluftventil-Endstufe" VAL_BLK 0x8149F4 KwbUw 65535.00 dez 0.00 65535.00 FORMAT "%8.2" NUMBER 4 /end CHARACTERISTIC
/begin CHARACTERISTIC CDKLKVDK "Codewort Kunde: Leck vor Drosselklappe" VAL_BLK 0x8149FC KwbUw 65535.00 dez 0.00 65535.00 FORMAT "%8.2" NUMBER 4 /end CHARACTERISTIC
/begin CHARACTERISTIC CDKLLR "Codewort Kunde: Leerlaufregelung am Anschlag" VAL_BLK 0x814A04 KwbUw 65535.00 dez 0.00 65535.00 FORMAT "%8.2" NUMBER 4 /end CHARACTERISTIC
/begin CHARACTERISTIC CDKLM "Codewort Kunde: LMM/HLM/HFM" VAL_BLK 0x814A0C KwbUw 65535.00 dez 0.00 65535.00 FORMAT "%8.2" NUMBER 4 /end CHARACTERISTIC
/begin CHARACTERISTIC CDKLSH "Codewort Kunde: Lambda-Sonde hinter Kat" VAL_BLK 0x814A14 KwbUw 65535.00 dez 0.00 65535.00 FORMAT "%8.2" NUMBER 4 /end CHARACTERISTIC
/begin CHARACTERISTIC CDKLSV "Codewort Kunde: Lambda-Sonde vor Kat" VAL_BLK 0x814A1C KwbUw 65535.00 dez 0.00 65535.00 FORMAT "%8.2" NUMBER 4 /end CHARACTERISTIC
/begin CHARACTERISTIC CDKMD "Codewort Kunde: Aussetzer, Summenfehler (multiple)" VAL_BLK 0x814A34 KwbUw 65535.00 dez 0.00 65535.00 FORMAT "%8.2" NUMBER 4 /end CHARACTERISTIC
/begin CHARACTERISTIC CDKMD00 "Codewort Kunde: Aussetzer Zyl. 0" VAL_BLK 0x814A3C KwbUw 65535.00 dez 0.00 65535.00 FORMAT "%8.2" NUMBER 4 /end CHARACTERISTIC
/begin CHARACTERISTIC CDKMD01 "Codewort Kunde: Aussetzer Zyl. 1" VAL_BLK 0x814A44 KwbUw 65535.00 dez 0.00 65535.00 FORMAT "%8.2" NUMBER 4 /end CHARACTERISTIC
/begin CHARACTERISTIC CDKMD02 "Codewort Kunde: Aussetzer Zylinder 2" VAL_BLK 0x814A4C KwbUw 65535.00 dez 0.00 65535.00 FORMAT "%8.2" NUMBER 4 /end CHARACTERISTIC
/begin CHARACTERISTIC CDKMD03 "Codewort Kunde: Aussetzer Zylinder 3" VAL_BLK 0x814A54 KwbUw 65535.00 dez 0.00 65535.00 FORMAT "%8.2" NUMBER 4 /end CHARACTERISTIC
/begin CHARACTERISTIC CDKMFA "Codewort Kunde: MIL-fremdbestimmt" VAL_BLK 0x814A64 KwbUw 65535.00 dez 0.00 65535.00 FORMAT "%8.2" NUMBER 4 /end CHARACTERISTIC
/begin CHARACTERISTIC CDKNWKW "Codewort Kunde: Zuordnung Nockwelle zu Kurbelwelle" VAL_BLK 0x814A7C KwbUw 65535.00 dez 0.00 65535.00 FORMAT "%8.2" NUMBER 4 /end CHARACTERISTIC
/begin CHARACTERISTIC CDKNX "Codewort Kunde: NMAX - Überschreitung" VAL_BLK 0x814A8C KwbUw 65535.00 dez 0.00 65535.00 FORMAT "%8.2" NUMBER 4 /end CHARACTERISTIC
/begin CHARACTERISTIC CDKPH "Codewort Kunde: Phasensensor" VAL_BLK 0x814A94 KwbUw 65535.00 dez 0.00 65535.00 FORMAT "%8.2" NUMBER 4 /end CHARACTERISTIC
/begin CHARACTERISTIC CDKPWM "" VAL_BLK 0x814A9C KwbUw 65535.00 dez 0.00 65535.00 FORMAT "%8.2" NUMBER 4 /end CHARACTERISTIC
/begin CHARACTERISTIC CDKSCR "Codewort Kunde: CRAS-Signal" VAL_BLK 0x814AB4 KwbUw 65535.00 dez 0.00 65535.00 FORMAT "%8.2" NUMBER 4 /end CHARACTERISTIC
/begin CHARACTERISTIC CDKSGEEP "Codewort Kunde: Steuergerät defekt (EEPROM)" VAL_BLK 0x814ABC KwbUw 65535.00 dez 0.00 65535.00 FORMAT "%8.2" NUMBER 4 /end CHARACTERISTIC
/begin CHARACTERISTIC CDKSLS "Codewort Kunde: Sekundärluft-System" VAL_BLK 0x814AD4 KwbUw 65535.00 dez 0.00 65535.00 FORMAT "%8.2" NUMBER 4 /end CHARACTERISTIC
/begin CHARACTERISTIC CDKSLV "Codewort Kunde: Sekundärluftventil" VAL_BLK 0x814ADC KwbUw 65535.00 dez 0.00 65535.00 FORMAT "%8.2" NUMBER 4 /end CHARACTERISTIC
/begin CHARACTERISTIC CDKSWE "Codewort Kunde: Beschleunigungssensor der Schlechtwegeerkennung" VAL_BLK 0x814AEC KwbUw 65535.00 dez 0.00 65535.00 FORMAT "%8.2" NUMBER 4 /end CHARACTERISTIC
/begin CHARACTERISTIC CDKT2STC "" VAL_BLK 0x814AF4 KwbUw 65535.00 dez 0.00 65535.00 FORMAT "%8.2" NUMBER 4 /end CHARACTERISTIC
/begin CHARACTERISTIC CDKTA "Codewort Kunde: TANS" VAL_BLK 0x814AFC KwbUw 65535.00 dez 0.00 65535.00 FORMAT "%8.2" NUMBER 4 /end CHARACTERISTIC
/begin CHARACTERISTIC CDKTANKL "Codewort Kunde: OBDII Fehler auf Grund eines leeren Tanks" VAL_BLK 0x814B04 KwbUw 65535.00 dez 0.00 65535.00 FORMAT "%8.2" NUMBER 4 /end CHARACTERISTIC
/begin CHARACTERISTIC CDKTES "Codewort Kunde: Tankentlüftungssystem" VAL_BLK 0x814B0C KwbUw 65535.00 dez 0.00 65535.00 FORMAT "%8.2" NUMBER 4 /end CHARACTERISTIC
/begin CHARACTERISTIC CDKTESF "Codewort Kunde: Tankentlüftungssystem Feinleck" VAL_BLK 0x814B14 KwbUw 65535.00 dez 0.00 65535.00 FORMAT "%8.2" NUMBER 4 /end CHARACTERISTIC
/begin CHARACTERISTIC CDKTESG "Codewort Kunde: Tankentlüftungssystem Grobleck" VAL_BLK 0x814B1C KwbUw 65535.00 dez 0.00 65535.00 FORMAT "%8.2" NUMBER 4 /end CHARACTERISTIC
/begin CHARACTERISTIC CDKTEVE2 "Codewort Kunde: Tankentlüftungsventil Endstufe Bank 2" VAL_BLK 0x814B2C KwbUw 65535.00 dez 0.00 65535.00 FORMAT "%8.2" NUMBER 4 /end CHARACTERISTIC
/begin CHARACTERISTIC CDKTHM "Codewort Kunde: Thermostat-Diagnose THM" VAL_BLK 0x814B34 KwbUw 65535.00 dez 0.00 65535.00 FORMAT "%8.2" NUMBER 4 /end CHARACTERISTIC
/begin CHARACTERISTIC CDKTKA "Codewort Kunde: Temperatur am Kühlerausgang" VAL_BLK 0x814B3C KwbUw 65535.00 dez 0.00 65535.00 FORMAT "%8.2" NUMBER 4 /end CHARACTERISTIC
/begin CHARACTERISTIC CDKTM "Codewort Kunde: TMOT" VAL_BLK 0x814B44 KwbUw 65535.00 dez 0.00 65535.00 FORMAT "%8.2" NUMBER 4 /end CHARACTERISTIC
/begin CHARACTERISTIC CDKTMKI "Codewort Kunde: Motortemperatur aus Kombiinstrument TMKI" VAL_BLK 0x814B4C KwbUw 65535.00 dez 0.00 65535.00 FORMAT "%8.2" NUMBER 4 /end CHARACTERISTIC
/begin CHARACTERISTIC CDKUB "Codewort Kunde: UB" VAL_BLK 0x814B64 KwbUw 65535.00 dez 0.00 65535.00 FORMAT "%8.2" NUMBER 4 /end CHARACTERISTIC
/begin CHARACTERISTIC CDKUBR "" VAL_BLK 0x814B6C KwbUw 65535.00 dez 0.00 65535.00 FORMAT "%8.2" NUMBER 4 /end CHARACTERISTIC
/begin CHARACTERISTIC CDKUFMV "Codewort Kunde: Funktionsüberwachung: Momentenvergleich" VAL_BLK 0x814B74 KwbUw 65535.00 dez 0.00 65535.00 FORMAT "%8.2" NUMBER 4 /end CHARACTERISTIC
/begin CHARACTERISTIC CDKUFSKA "Codewort Kunde: Funktionsüberwachung: Sicherheits-Kraftstoff-Abschaltung" VAL_BLK 0x814B7C KwbUw 65535.00 dez 0.00 65535.00 FORMAT "%8.2" NUMBER 4 /end CHARACTERISTIC
/begin CHARACTERISTIC CDKURRAM "Codewort Kunde: Rechnerüberwachung: RAM" VAL_BLK 0x814B84 KwbUw 65535.00 dez 0.00 65535.00 FORMAT "%8.2" NUMBER 4 /end CHARACTERISTIC
/begin CHARACTERISTIC CDKURROM "Codewort Kunde: Rechnerüberwachung: ROM" VAL_BLK 0x814B8C KwbUw 65535.00 dez 0.00 65535.00 FORMAT "%8.2" NUMBER 4 /end CHARACTERISTIC
/begin CHARACTERISTIC CDKURRST "Codewort Kunde: Rechnerüberwachung: Reset" VAL_BLK 0x814B94 KwbUw 65535.00 dez 0.00 65535.00 FORMAT "%8.2" NUMBER 4 /end CHARACTERISTIC
/begin CHARACTERISTIC CDKVFZ "Codewort Kunde: Fahrzeug-Geschwindigkeit" VAL_BLK 0x814BA4 KwbUw 65535.00 dez 0.00 65535.00 FORMAT "%8.2" NUMBER 4 /end CHARACTERISTIC
/begin CHARACTERISTIC CDTAGRF "Codewort Tester: Überwachung AGR-FLOW" VALUE 0x814BEA KwUw 65535.00 dez 0.00 65535.00 FORMAT "%8.2" /end CHARACTERISTIC
/begin CHARACTERISTIC CDTBREMS "Fehlerpfadcode: BREMS (Bremsschalter)" VALUE 0x814BFE KwUw 65535.00 dez 0.00 65535.00 FORMAT "%8.2" /end CHARACTERISTIC
/begin CHARACTERISTIC CDTBWF "Codewort Tester: PWG Bewegung" VALUE 0x814C00 KwUw 65535.00 dez 0.00 65535.00 FORMAT "%8.2" /end CHARACTERISTIC
/begin CHARACTERISTIC CDTCAIRP "Codewort Tester: unpl. Airbag-Botschaft" VALUE 0x814C04 KwUw 65535.00 dez 0.00 65535.00 FORMAT "%8.2" /end CHARACTERISTIC
/begin CHARACTERISTIC CDTDKVM "Codewort Tester: Drosselklappenverschmutzung" VALUE 0x814C1C KwUw 65535.00 dez 0.00 65535.00 FORMAT "%8.2" /end CHARACTERISTIC
/begin CHARACTERISTIC CDTDPL "Codewort Tester: Dauerplus" VALUE 0x814C1E KwUw 65535.00 dez 0.00 65535.00 FORMAT "%8.2" /end CHARACTERISTIC
/begin CHARACTERISTIC CDTDSBKV "Codewort Tester: BKV" VALUE 0x814C20 KwUw 65535.00 dez 0.00 65535.00 FORMAT "%8.2" /end CHARACTERISTIC
/begin CHARACTERISTIC CDTDSL "Codewort Tester: Drucksensor Ladedruck" VALUE 0x814C22 KwUw 65535.00 dez 0.00 65535.00 FORMAT "%8.2" /end CHARACTERISTIC
/begin CHARACTERISTIC CDTDSU "Codewort Tester: Drucksensor Umgebung" VALUE 0x814C24 KwUw 65535.00 dez 0.00 65535.00 FORMAT "%8.2" /end CHARACTERISTIC
/begin CHARACTERISTIC CDTDSVLU "Codewort Tester: Drucksensorsignalvergleich (DS-L DS-U)" VALUE 0x814C26 KwUw 65535.00 dez 0.00 65535.00 FORMAT "%8.2" /end CHARACTERISTIC
/begin CHARACTERISTIC CDTFP1P "Codewort Tester: Poti 1, Fahrpedal" VALUE 0x814C50 KwUw 65535.00 dez 0.00 65535.00 FORMAT "%8.2" /end CHARACTERISTIC
/begin CHARACTERISTIC CDTFP2P "Codewort Tester: Poti 2, Fahrpedal" VALUE 0x814C52 KwUw 65535.00 dez 0.00 65535.00 FORMAT "%8.2" /end CHARACTERISTIC
/begin CHARACTERISTIC CDTFPP "Codewort Tester: Poti Fahrpedal" VALUE 0x814C54 KwUw 65535.00 dez 0.00 65535.00 FORMAT "%8.2" /end CHARACTERISTIC
/begin CHARACTERISTIC CDTGECOD "Codewort Tester: Getriebecodierung CAN" VALUE 0x814C5C KwUw 65535.00 dez 0.00 65535.00 FORMAT "%8.2" /end CHARACTERISTIC
/begin CHARACTERISTIC CDTGRBH "Codewort Tester: GRA Bedienhebel" VALUE 0x814C5E KwUw 65535.00 dez 0.00 65535.00 FORMAT "%8.2" /end CHARACTERISTIC
/begin CHARACTERISTIC CDTHLA "Codeword Tester: Heizleistungsanforderung" VALUE 0x814C60 KwUw 65535.00 dez 0.00 65535.00 FORMAT "%8.2" /end CHARACTERISTIC
/begin CHARACTERISTIC CDTHRE "" VALUE 0x814C62 KwUw 65535.00 dez 0.00 65535.00 FORMAT "%8.2" /end CHARACTERISTIC
/begin CHARACTERISTIC CDTLASH "Codewort Tester: Lambda-Sondenalterung hinter Kat" VALUE 0x814C8E KwUw 65535.00 dez 0.00 65535.00 FORMAT "%8.2" /end CHARACTERISTIC
/begin CHARACTERISTIC CDTLDO "Codewort Tester: Ladedruck; oberer Wert überschritten" VALUE 0x814C92 KwUw 65535.00 dez 0.00 65535.00 FORMAT "%8.2" /end CHARACTERISTIC
/begin CHARACTERISTIC CDTLDP "Codewort Tester: Tankentlüftung; Leckdiagnosepumpe" VALUE 0x814C94 KwUw 65535.00 dez 0.00 65535.00 FORMAT "%8.2" /end CHARACTERISTIC
/begin CHARACTERISTIC CDTLDRA "Codewort Tester: Ladedruckregelabweichung" VALUE 0x814C98 KwUw 65535.00 dez 0.00 65535.00 FORMAT "%8.2" /end CHARACTERISTIC
/begin CHARACTERISTIC CDTLDUV "Codewort Tester: Schubumluftventil-Endstufe" VALUE 0x814C9A KwUw 65535.00 dez 0.00 65535.00 FORMAT "%8.2" /end CHARACTERISTIC
/begin CHARACTERISTIC CDTLKVDK "Codewort Tester: Leck vor Drosselklappe" VALUE 0x814C9C KwUw 65535.00 dez 0.00 65535.00 FORMAT "%8.2" /end CHARACTERISTIC
/begin CHARACTERISTIC CDTLLR "Codewort Tester: Leerlaufregelung" VALUE 0x814C9E KwUw 65535.00 dez 0.00 65535.00 FORMAT "%8.2" /end CHARACTERISTIC
/begin CHARACTERISTIC CDTLM "Codewort Tester: LMM/HLM/HFM" VALUE 0x814CA0 KwUw 65535.00 dez 0.00 65535.00 FORMAT "%8.2" /end CHARACTERISTIC
/begin CHARACTERISTIC CDTLSH "Codewort Tester: Lambda-Sonde hinter Kat" VALUE 0x814CA2 KwUw 65535.00 dez 0.00 65535.00 FORMAT "%8.2" /end CHARACTERISTIC
/begin CHARACTERISTIC CDTLSV "Codewort Tester: Lambda-Sonde vor Kat" VALUE 0x814CA4 KwUw 65535.00 dez 0.00 65535.00 FORMAT "%8.2" /end CHARACTERISTIC
/begin CHARACTERISTIC CDTMD "Codewort Tester: Aussetzer, Summenfehler (multiple)" VALUE 0x814CAA KwUw 65535.00 dez 0.00 65535.00 FORMAT "%8.2" /end CHARACTERISTIC
/begin CHARACTERISTIC CDTMD00 "Codewort Tester: Aussetzer Zyl. 0" VALUE 0x814CAC KwUw 65535.00 dez 0.00 65535.00 FORMAT "%8.2" /end CHARACTERISTIC
/begin CHARACTERISTIC CDTMD01 "Codewort Tester: Aussetzer Zyl. 1" VALUE 0x814CAE KwUw 65535.00 dez 0.00 65535.00 FORMAT "%8.2" /end CHARACTERISTIC
/begin CHARACTERISTIC CDTMD02 "Codewort Tester: Aussetzer Zylinder 2" VALUE 0x814CB0 KwUw 65535.00 dez 0.00 65535.00 FORMAT "%8.2" /end CHARACTERISTIC
/begin CHARACTERISTIC CDTMD03 "Codewort Tester: Aussetzer Zylinder 3" VALUE 0x814CB2 KwUw 65535.00 dez 0.00 65535.00 FORMAT "%8.2" /end CHARACTERISTIC
/begin CHARACTERISTIC CDTMFA "Codewort Tester: MIL-fremdbestimmt" VALUE 0x814CB6 KwUw 65535.00 dez 0.00 65535.00 FORMAT "%8.2" /end CHARACTERISTIC
/begin CHARACTERISTIC CDTNWKW "Codewort Tester: Zuordnung Nockenwelle zu Kurbelwelle" VALUE 0x814CBC KwUw 65535.00 dez 0.00 65535.00 FORMAT "%8.2" /end CHARACTERISTIC
/begin CHARACTERISTIC CDTNX "Codewort Tester: NMAX - Überschreitung" VALUE 0x814CC0 KwUw 65535.00 dez 0.00 65535.00 FORMAT "%8.2" /end CHARACTERISTIC
/begin CHARACTERISTIC CDTPH "Codewort Tester: Phasensensor" VALUE 0x814CC2 KwUw 65535.00 dez 0.00 65535.00 FORMAT "%8.2" /end CHARACTERISTIC
/begin CHARACTERISTIC CDTPWM "" VALUE 0x814CC4 KwUw 65535.00 dez 0.00 65535.00 FORMAT "%8.2" /end CHARACTERISTIC
/begin CHARACTERISTIC CDTSCR "Codewort Tester: Überwachung Crashsignal" VALUE 0x814CCA KwUw 65535.00 dez 0.00 65535.00 FORMAT "%8.2" /end CHARACTERISTIC
/begin CHARACTERISTIC CDTSGEEP "Codewort Tester: Steuergerät defekt (EEPROM)" VALUE 0x814CCC KwUw 65535.00 dez 0.00 65535.00 FORMAT "%8.2" /end CHARACTERISTIC
/begin CHARACTERISTIC CDTSLS "Codewort Tester: Sekundärluft-System" VALUE 0x814CD2 KwUw 65535.00 dez 0.00 65535.00 FORMAT "%8.2" /end CHARACTERISTIC
/begin CHARACTERISTIC CDTSLV "Codewort Tester: Sekundärluftventil" VALUE 0x814CD4 KwUw 65535.00 dez 0.00 65535.00 FORMAT "%8.2" /end CHARACTERISTIC
/begin CHARACTERISTIC CDTSWE "Codewort Tester: Beschleunigungssensor Schlechtwegeerk." VALUE 0x814CD8 KwUw 65535.00 dez 0.00 65535.00 FORMAT "%8.2" /end CHARACTERISTIC
/begin CHARACTERISTIC CDTT2STC "Codewort Tester: Testerkommunikation, Start der Kommunikation" VALUE 0x814CDA KwUw 65535.00 dez 0.00 65535.00 FORMAT "%8.2" /end CHARACTERISTIC
/begin CHARACTERISTIC CDTTA "Codewort Tester: TANS" VALUE 0x814CDC KwUw 65535.00 dez 0.00 65535.00 FORMAT "%8.2" /end CHARACTERISTIC
/begin CHARACTERISTIC CDTTANKL "Codewort Tester: OBDII Fehler auf Grund eines leeren Tanks" VALUE 0x814CDE KwUw 65535.00 dez 0.00 65535.00 FORMAT "%8.2" /end CHARACTERISTIC
/begin CHARACTERISTIC CDTTES "Codewort Tester: Tankentlüftungssystem" VALUE 0x814CE0 KwUw 65535.00 dez 0.00 65535.00 FORMAT "%8.2" /end CHARACTERISTIC
/begin CHARACTERISTIC CDTTESF "Codewort Tester: Tankentlüftungssystem Feinleck" VALUE 0x814CE2 KwUw 65535.00 dez 0.00 65535.00 FORMAT "%8.2" /end CHARACTERISTIC
/begin CHARACTERISTIC CDTTESG "Codewort Tester: Tankentlüftungssystem Grobleck" VALUE 0x814CE4 KwUw 65535.00 dez 0.00 65535.00 FORMAT "%8.2" /end CHARACTERISTIC
/begin CHARACTERISTIC CDTTEVE2 "Codewort Tester: Tankentlüftungsventil Endstufe Bank 2" VALUE 0x814CE8 KwUw 65535.00 dez 0.00 65535.00 FORMAT "%8.2" /end CHARACTERISTIC
/begin CHARACTERISTIC CDTTHM "Codewort Tester: Thermostat-Diagnose THM" VALUE 0x814CEA KwUw 65535.00 dez 0.00 65535.00 FORMAT "%8.2" /end CHARACTERISTIC
/begin CHARACTERISTIC CDTTKA "Codewort Tester: Temperatur Kühlerausgang" VALUE 0x814CEC KwUw 65535.00 dez 0.00 65535.00 FORMAT "%8.2" /end CHARACTERISTIC
/begin CHARACTERISTIC CDTTM "Codewort Tester: TMOT" VALUE 0x814CEE KwUw 65535.00 dez 0.00 65535.00 FORMAT "%8.2" /end CHARACTERISTIC
/begin CHARACTERISTIC CDTTMKI "Codewort Tester: Motortemperatur aus Kombiinstrument TMKI" VALUE 0x814CF0 KwUw 65535.00 dez 0.00 65535.00 FORMAT "%8.2" /end CHARACTERISTIC
/begin CHARACTERISTIC CDTUB "Codewort Tester: UB" VALUE 0x814CF6 KwUw 65535.00 dez 0.00 65535.00 FORMAT "%8.2" /end CHARACTERISTIC
/begin CHARACTERISTIC CDTUBR "Codewort Tester: UBR Bordnetzspannung über Hauptrelais" VALUE 0x814CF8 KwUw 65535.00 dez 0.00 65535.00 FORMAT "%8.2" /end CHARACTERISTIC
/begin CHARACTERISTIC CDTUFMV "Codewort Tester: Funktionsüberwachung: Momentenvergleich" VALUE 0x814CFA KwUw 65535.00 dez 0.00 65535.00 FORMAT "%8.2" /end CHARACTERISTIC
/begin CHARACTERISTIC CDTUFSKA "Codewort Tester: Funktionsüberwachung: Sicherheits-Kraftstoff-Abschaltung" VALUE 0x814CFC KwUw 65535.00 dez 0.00 65535.00 FORMAT "%8.2" /end CHARACTERISTIC
/begin CHARACTERISTIC CDTURRAM "Codewort Tester: Rechnerüberwachung: RAM" VALUE 0x814CFE KwUw 65535.00 dez 0.00 65535.00 FORMAT "%8.2" /end CHARACTERISTIC
/begin CHARACTERISTIC CDTURROM "Codewort Tester: Rechnerüberwachung: ROM" VALUE 0x814D00 KwUw 65535.00 dez 0.00 65535.00 FORMAT "%8.2" /end CHARACTERISTIC
/begin CHARACTERISTIC CDTURRST "Codewort Tester: Rechnerüberwachung: Reset" VALUE 0x814D02 KwUw 65535.00 dez 0.00 65535.00 FORMAT "%8.2" /end CHARACTERISTIC
/begin CHARACTERISTIC CDTVFZ "Codewort Tester: Fahrzeug-Geschwindigkeit" VALUE 0x814D06 KwUw 65535.00 dez 0.00 65535.00 FORMAT "%8.2" /end CHARACTERISTIC
/begin CHARACTERISTIC CLAAGRF "Fehlerklasse: Überwachung AGR-Flow" VALUE 0x8108D3 KwUb 255.0 dez 0.00 255.0 FORMAT "%5.1" /end CHARACTERISTIC
/begin CHARACTERISTIC CLABREMS "Fehlerklasse: BREMS (Bremsschalter)" VALUE 0x8108DD KwUb 255.0 dez 0.00 255.0 FORMAT "%5.1" /end CHARACTERISTIC
/begin CHARACTERISTIC CLABWF "Fehlerklasse:  PWG Bewegung" VALUE 0x8108DE KwUb 255.0 dez 0.00 255.0 FORMAT "%5.1" /end CHARACTERISTIC
/begin CHARACTERISTIC CLACAIRP "Fehlerklasse: unpl. Airbag-Botschaft" VALUE 0x8108E0 KwUb 255.0 dez 0.00 255.0 FORMAT "%5.1" /end CHARACTERISTIC
/begin CHARACTERISTIC CLADKVM "Fehlerklasse: Drosselklappenverschmutzung" VALUE 0x8108EC KwUb 255.0 dez 0.00 255.0 FORMAT "%5.1" /end CHARACTERISTIC
/begin CHARACTERISTIC CLADPL "Fehlerklasse: Dauerplus" VALUE 0x8108ED KwUb 255.0 dez 0.00 255.0 FORMAT "%5.1" /end CHARACTERISTIC
/begin CHARACTERISTIC CLADSBKV "Fehlerklasse: BKV" VALUE 0x8108EE KwUb 255.0 dez 0.00 255.0 FORMAT "%5.1" /end CHARACTERISTIC
/begin CHARACTERISTIC CLADSL "Fehlerklasse: Druchsensor Ladedruck" VALUE 0x8108EF KwUb 255.0 dez 0.00 255.0 FORMAT "%5.1" /end CHARACTERISTIC
/begin CHARACTERISTIC CLADSU "Fehlerklasse: Umgebungsdrucksensor" VALUE 0x8108F0 KwUb 255.0 dez 0.00 255.0 FORMAT "%5.1" /end CHARACTERISTIC
/begin CHARACTERISTIC CLADSVLU "Fehlerklasse: Drucksensorsignalvergleich (DS-L DS-U)" VALUE 0x8108F1 KwUb 255.0 dez 0.00 255.0 FORMAT "%5.1" /end CHARACTERISTIC
/begin CHARACTERISTIC CLAFP1P "Fehlerklasse: Poti 1, Fahrpedal" VALUE 0x810906 KwUb 255.0 dez 0.00 255.0 FORMAT "%5.1" /end CHARACTERISTIC
/begin CHARACTERISTIC CLAFP2P "Fehlerklasse: Poti 2, Fahrpedal" VALUE 0x810907 KwUb 255.0 dez 0.00 255.0 FORMAT "%5.1" /end CHARACTERISTIC
/begin CHARACTERISTIC CLAFPP "Fehlerklasse: Poti Fahrpedal" VALUE 0x810908 KwUb 255.0 dez 0.00 255.0 FORMAT "%5.1" /end CHARACTERISTIC
/begin CHARACTERISTIC CLAGECOD "Fehlerklasse: Getriebecodierung CAN" VALUE 0x81090C KwUb 255.0 dez 0.00 255.0 FORMAT "%5.1" /end CHARACTERISTIC
/begin CHARACTERISTIC CLAGRBH "Fehlerklasse: GRA- Bedienhebel" VALUE 0x81090D KwUb 255.0 dez 0.00 255.0 FORMAT "%5.1" /end CHARACTERISTIC
/begin CHARACTERISTIC CLAHLA "Fehlerklasse: Heizleistungsanforderung" VALUE 0x81090E KwUb 255.0 dez 0.00 255.0 FORMAT "%5.1" /end CHARACTERISTIC
/begin CHARACTERISTIC CLAHRE "Fehlerklasse: Hauptrelais - Endstufe" VALUE 0x81090F KwUb 255.0 dez 0.00 255.0 FORMAT "%5.1" /end CHARACTERISTIC
/begin CHARACTERISTIC CLALASH "Fehlerklasse: Lambdasondenalterung hinter Kat" VALUE 0x810925 KwUb 255.0 dez 0.00 255.0 FORMAT "%5.1" /end CHARACTERISTIC
/begin CHARACTERISTIC CLALDO "Fehlerklasse: LDR Überladefehler" VALUE 0x810927 KwUb 255.0 dez 0.00 255.0 FORMAT "%5.1" /end CHARACTERISTIC
/begin CHARACTERISTIC CLALDP "Fehlerklasse: Leckdiagnosepumpe" VALUE 0x810928 KwUb 255.0 dez 0.00 255.0 FORMAT "%5.1" /end CHARACTERISTIC
/begin CHARACTERISTIC CLALDRA "Fehlerklasse: LDR Regelabweichungsfehler" VALUE 0x81092A KwUb 255.0 dez 0.00 255.0 FORMAT "%5.1" /end CHARACTERISTIC
/begin CHARACTERISTIC CLALDUV "Fehlerklasse: Schubumluftventil-Endstufe" VALUE 0x81092B KwUb 255.0 dez 0.00 255.0 FORMAT "%5.1" /end CHARACTERISTIC
/begin CHARACTERISTIC CLALKVDK "Fehlerklasse: Leck vor Drosselklappe" VALUE 0x81092C KwUb 255.0 dez 0.00 255.0 FORMAT "%5.1" /end CHARACTERISTIC
/begin CHARACTERISTIC CLALLR "Fehlerklasse: Leerlaufregelung" VALUE 0x81092D KwUb 255.0 dez 0.00 255.0 FORMAT "%5.1" /end CHARACTERISTIC
/begin CHARACTERISTIC CLALM "Fehlerklasse: Hauptfüllungssignal" VALUE 0x81092E KwUb 255.0 dez 0.00 255.0 FORMAT "%5.1" /end CHARACTERISTIC
/begin CHARACTERISTIC CLALSH "Fehlerklasse: Lambdasonde hinter Kat" VALUE 0x81092F KwUb 255.0 dez 0.00 255.0 FORMAT "%5.1" /end CHARACTERISTIC
/begin CHARACTERISTIC CLALSV "Fehlerklasse: Lambdasonde vor Kat" VALUE 0x810930 KwUb 255.0 dez 0.00 255.0 FORMAT "%5.1" /end CHARACTERISTIC
/begin CHARACTERISTIC CLAMD "Fehlerklasse:  Aussetzer, Summenfehler (multiple)" VALUE 0x810933 KwUb 255.0 dez 0.00 255.0 FORMAT "%5.1" /end CHARACTERISTIC
/begin CHARACTERISTIC CLAMD00 "Fehlerklasse:  Aussetzer Zyl. 0" VALUE 0x810934 KwUb 255.0 dez 0.00 255.0 FORMAT "%5.1" /end CHARACTERISTIC
/begin CHARACTERISTIC CLAMD01 "Fehlerklasse:  Aussetzer Zyl. 1" VALUE 0x810935 KwUb 255.0 dez 0.00 255.0 FORMAT "%5.1" /end CHARACTERISTIC
/begin CHARACTERISTIC CLAMD02 "Fehlerklasse:  Aussetzer Zylinder 2" VALUE 0x810936 KwUb 255.0 dez 0.00 255.0 FORMAT "%5.1" /end CHARACTERISTIC
/begin CHARACTERISTIC CLAMD03 "Fehlerklasse:  Aussetzer Zylinder 3" VALUE 0x810937 KwUb 255.0 dez 0.00 255.0 FORMAT "%5.1" /end CHARACTERISTIC
/begin CHARACTERISTIC CLAMFA "Fehlerklasse: MIL-fremdbestimmt" VALUE 0x810939 KwUb 255.0 dez 0.00 255.0 FORMAT "%5.1" /end CHARACTERISTIC
/begin CHARACTERISTIC CLANWKW "Fehlerklasse: Zuordnung Nockenwelle zu Kurbelwelle" VALUE 0x81093C KwUb 255.0 dez 0.00 255.0 FORMAT "%5.1" /end CHARACTERISTIC
/begin CHARACTERISTIC CLANX "Fehlerklasse: ^NMAX- Überschreitung" VALUE 0x81093E KwUb 255.0 dez 0.00 255.0 FORMAT "%5.1" /end CHARACTERISTIC
/begin CHARACTERISTIC CLAPH "Fehlerklasse: Phasengeber" VALUE 0x81093F KwUb 255.0 dez 0.00 255.0 FORMAT "%5.1" /end CHARACTERISTIC
/begin CHARACTERISTIC CLAPWM "" VALUE 0x810940 KwUb 255.0 dez 0.00 255.0 FORMAT "%5.1" /end CHARACTERISTIC
/begin CHARACTERISTIC CLASCR "Fehlerklasse: Überwachung Crashsignal" VALUE 0x810943 KwUb 255.0 dez 0.00 255.0 FORMAT "%5.1" /end CHARACTERISTIC
/begin CHARACTERISTIC CLASGEEP "Fehlerklasse: SG defekt (EEPROM)" VALUE 0x810944 KwUb 255.0 dez 0.00 255.0 FORMAT "%5.1" /end CHARACTERISTIC
/begin CHARACTERISTIC CLASLS "Fehlerklasse: Sekundärluftsystem" VALUE 0x810947 KwUb 255.0 dez 0.00 255.0 FORMAT "%5.1" /end CHARACTERISTIC
/begin CHARACTERISTIC CLASLV "Fehlerklasse: Dichtheit Sekundärluftventil" VALUE 0x810948 KwUb 255.0 dez 0.00 255.0 FORMAT "%5.1" /end CHARACTERISTIC
/begin CHARACTERISTIC CLASWE "Fehlerklasse: Beschleunigungssensor der Schlechtwegerkennung" VALUE 0x81094A KwUb 255.0 dez 0.00 255.0 FORMAT "%5.1" /end CHARACTERISTIC
/begin CHARACTERISTIC CLAT2STC "" VALUE 0x81094B KwUb 255.0 dez 0.00 255.0 FORMAT "%5.1" /end CHARACTERISTIC
/begin CHARACTERISTIC CLATA "Fehlerklasse: Ansauglufttemperatur TANS (/Ladeluft-)" VALUE 0x81094C KwUb 255.0 dez 0.00 255.0 FORMAT "%5.1" /end CHARACTERISTIC
/begin CHARACTERISTIC CLATANKL "Fehlerklasse : tankl (Tank leer)" VALUE 0x81094D KwUb 255.0 dez 0.00 255.0 FORMAT "%5.1" /end CHARACTERISTIC
/begin CHARACTERISTIC CLATES "Fehlerklasse: Tankdiagnose, TEV offen" VALUE 0x81094E KwUb 255.0 dez 0.00 255.0 FORMAT "%5.1" /end CHARACTERISTIC
/begin CHARACTERISTIC CLATESF "Fehlerklasse: Tankdiagnose, Feinleck" VALUE 0x81094F KwUb 255.0 dez 0.00 255.0 FORMAT "%5.1" /end CHARACTERISTIC
/begin CHARACTERISTIC CLATESG "Fehlerklasse: Tankdiagnose, Grobleck" VALUE 0x810950 KwUb 255.0 dez 0.00 255.0 FORMAT "%5.1" /end CHARACTERISTIC
/begin CHARACTERISTIC CLATEVE2 "Fehlerklasse: Tankentlüftungsventil Endstufe Bank 2" VALUE 0x810952 KwUb 255.0 dez 0.00 255.0 FORMAT "%5.1" /end CHARACTERISTIC
/begin CHARACTERISTIC CLATHM "Fehlerklasse: Thermostat-Diagnose THM" VALUE 0x810953 KwUb 255.0 dez 0.00 255.0 FORMAT "%5.1" /end CHARACTERISTIC
/begin CHARACTERISTIC CLATKA "Fehlerklasse: Temperatur Kühlerausgang" VALUE 0x810954 KwUb 255.0 dez 0.00 255.0 FORMAT "%5.1" /end CHARACTERISTIC
/begin CHARACTERISTIC CLATM "Fehlerklasse: Motortemperatur TMOT" VALUE 0x810955 KwUb 255.0 dez 0.00 255.0 FORMAT "%5.1" /end CHARACTERISTIC
/begin CHARACTERISTIC CLATMKI "Fehlerklasse: Motortemperatur aus Kombiinstrument TMKI" VALUE 0x810956 KwUb 255.0 dez 0.00 255.0 FORMAT "%5.1" /end CHARACTERISTIC
/begin CHARACTERISTIC CLAUB "Fehlerklasse: Batteriespannung UB (Bordnetz)" VALUE 0x810959 KwUb 255.0 dez 0.00 255.0 FORMAT "%5.1" /end CHARACTERISTIC
/begin CHARACTERISTIC CLAUBR "Fehlerklasse: UBR Bordnetzspannung über Hauptrelais" VALUE 0x81095A KwUb 255.0 dez 0.00 255.0 FORMAT "%5.1" /end CHARACTERISTIC
/begin CHARACTERISTIC CLAUFMV "Fehlerklasse: Funktionsüberwachung: Momentenvergleich" VALUE 0x81095B KwUb 255.0 dez 0.00 255.0 FORMAT "%5.1" /end CHARACTERISTIC
/begin CHARACTERISTIC CLAUFSKA "Fehlerklasse: Funktionsüberwachung: Sicherheits-Kraftstoff-Abschaltung" VALUE 0x81095C KwUb 255.0 dez 0.00 255.0 FORMAT "%5.1" /end CHARACTERISTIC
/begin CHARACTERISTIC CLAURRAM "Fehlerklasse: Rechnerüberwachung: RAM" VALUE 0x81095D KwUb 255.0 dez 0.00 255.0 FORMAT "%5.1" /end CHARACTERISTIC
/begin CHARACTERISTIC CLAURROM "Fehlerklasse: Rechnerüberwachung: ROM" VALUE 0x81095E KwUb 255.0 dez 0.00 255.0 FORMAT "%5.1" /end CHARACTERISTIC
/begin CHARACTERISTIC CLAURRST "Fehlerklasse: Rechnerüberwachung: Reset" VALUE 0x81095F KwUb 255.0 dez 0.00 255.0 FORMAT "%5.1" /end CHARACTERISTIC
/begin CHARACTERISTIC CLAVFZ "Fehlerklasse: Geschwindigkeitssignal" VALUE 0x810961 KwUb 255.0 dez 0.00 255.0 FORMAT "%5.1" /end CHARACTERISTIC
/begin CHARACTERISTIC FFTAGRF "Freeze Frame Tabelle: Überwachung AGR-Flow" VAL_BLK 0x81096F KwbUb 255.0 dez 0.00 255.0 FORMAT "%5.1" NUMBER 2 /end CHARACTERISTIC
/begin CHARACTERISTIC FFTBREMS "Freeze Frame Tabelle: Pedalwertgeber Bremse" VAL_BLK 0x810983 KwbUb 255.0 dez 0.00 255.0 FORMAT "%5.1" NUMBER 2 /end CHARACTERISTIC
/begin CHARACTERISTIC FFTBWF "Freeze Frame Tabelle: PWG Bewegung" VAL_BLK 0x810985 KwbUb 255.0 dez 0.00 255.0 FORMAT "%5.1" NUMBER 2 /end CHARACTERISTIC
/begin CHARACTERISTIC FFTCAIRP "Freeze Frame Tabelle: unpl. Airbag-Botschaft" VAL_BLK 0x810989 KwbUb 255.0 dez 0.00 255.0 FORMAT "%5.1" NUMBER 2 /end CHARACTERISTIC
/begin CHARACTERISTIC FFTDKVM "Freeze Frame Tabelle: Drosselklappenverschmutzung" VAL_BLK 0x8109A1 KwbUb 255.0 dez 0.00 255.0 FORMAT "%5.1" NUMBER 2 /end CHARACTERISTIC
/begin CHARACTERISTIC FFTDPL "Freeze Frame Tabelle: Dauerplus" VAL_BLK 0x8109A3 KwbUb 255.0 dez 0.00 255.0 FORMAT "%5.1" NUMBER 2 /end CHARACTERISTIC
/begin CHARACTERISTIC FFTDSBKV "Freeze Frame Tabelle: BKV" VAL_BLK 0x8109A5 KwbUb 255.0 dez 0.00 255.0 FORMAT "%5.1" NUMBER 2 /end CHARACTERISTIC
/begin CHARACTERISTIC FFTDSL "Freeze Frame Tabelle: Drucksensor Ladedruck" VAL_BLK 0x8109A7 KwbUb 255.0 dez 0.00 255.0 FORMAT "%5.1" NUMBER 2 /end CHARACTERISTIC
/begin CHARACTERISTIC FFTDSU "Freeze Frame Tabelle: Umgebungsdrucksensor" VAL_BLK 0x8109A9 KwbUb 255.0 dez 0.00 255.0 FORMAT "%5.1" NUMBER 2 /end CHARACTERISTIC
/begin CHARACTERISTIC FFTDSVLU "Freeze Frame Tabelle: Drucksensorsignalvergleich (DS-L DS-U)" VAL_BLK 0x8109AB KwbUb 255.0 dez 0.00 255.0 FORMAT "%5.1" NUMBER 2 /end CHARACTERISTIC
/begin CHARACTERISTIC FFTFP1P "Freeze Frame Tabelle: Poti 1, Fahrpedal" VAL_BLK 0x8109D5 KwbUb 255.0 dez 0.00 255.0 FORMAT "%5.1" NUMBER 2 /end CHARACTERISTIC
/begin CHARACTERISTIC FFTFP2P "Freeze Frame Tabelle: Poti 2, Fahrpedal" VAL_BLK 0x8109D7 KwbUb 255.0 dez 0.00 255.0 FORMAT "%5.1" NUMBER 2 /end CHARACTERISTIC
/begin CHARACTERISTIC FFTFPP "Freeze Frame Tabelle: Poti Fahrpedal" VAL_BLK 0x8109D9 KwbUb 255.0 dez 0.00 255.0 FORMAT "%5.1" NUMBER 2 /end CHARACTERISTIC
/begin CHARACTERISTIC FFTGECOD "Freeze Frame Tabelle: Getriebecodierung CAN" VAL_BLK 0x8109E1 KwbUb 255.0 dez 0.00 255.0 FORMAT "%5.1" NUMBER 2 /end CHARACTERISTIC
/begin CHARACTERISTIC FFTGRBH "Freeze Frame Tabelle: GRA- Bedienhebel" VAL_BLK 0x8109E3 KwbUb 255.0 dez 0.00 255.0 FORMAT "%5.1" NUMBER 2 /end CHARACTERISTIC
/begin CHARACTERISTIC FFTHLA "Freeze Frame Tabelle: Heizleistungsanforderung" VAL_BLK 0x8109E5 KwbUb 255.0 dez 0.00 255.0 FORMAT "%5.1" NUMBER 2 /end CHARACTERISTIC
/begin CHARACTERISTIC FFTHRE "" VAL_BLK 0x8109E7 KwbUb 255.0 dez 0.00 255.0 FORMAT "%5.1" NUMBER 2 /end CHARACTERISTIC
/begin CHARACTERISTIC FFTLASH "Tabelle Umweltbedingungen Lambdasonde hinter Kat" VAL_BLK 0x810A13 KwbUb 255.0 dez 0.00 255.0 FORMAT "%5.1" NUMBER 2 /end CHARACTERISTIC
/begin CHARACTERISTIC FFTLDO "Freeze Frame Tabelle: LDR Überladefehler" VAL_BLK 0x810A17 KwbUb 255.0 dez 0.00 255.0 FORMAT "%5.1" NUMBER 2 /end CHARACTERISTIC
/begin CHARACTERISTIC FFTLDP "Freeze Frame Tabelle: Leckdiagnosepumpe" VAL_BLK 0x810A19 KwbUb 255.0 dez 0.00 255.0 FORMAT "%5.1" NUMBER 2 /end CHARACTERISTIC
/begin CHARACTERISTIC FFTLDRA "Freeze Frame Tabelle: LDR Regelabweichungsfehler" VAL_BLK 0x810A1D KwbUb 255.0 dez 0.00 255.0 FORMAT "%5.1" NUMBER 2 /end CHARACTERISTIC
/begin CHARACTERISTIC FFTLDUV "Freeze Frame Tabelle: Schubumluftventil-Endstufe" VAL_BLK 0x810A1F KwbUb 255.0 dez 0.00 255.0 FORMAT "%5.1" NUMBER 2 /end CHARACTERISTIC
/begin CHARACTERISTIC FFTLKVDK "Freeze Frame Tabelle: Leck vor Drosselklappe" VAL_BLK 0x810A21 KwbUb 255.0 dez 0.00 255.0 FORMAT "%5.1" NUMBER 2 /end CHARACTERISTIC
/begin CHARACTERISTIC FFTLLR "Freeze Frame Tabelle: Leerlaufregelung" VAL_BLK 0x810A23 KwbUb 255.0 dez 0.00 255.0 FORMAT "%5.1" NUMBER 2 /end CHARACTERISTIC
/begin CHARACTERISTIC FFTLM "Freeze Frame Tabelle: Hauptfüllungssensor" VAL_BLK 0x810A25 KwbUb 255.0 dez 0.00 255.0 FORMAT "%5.1" NUMBER 2 /end CHARACTERISTIC
/begin CHARACTERISTIC FFTLSH "Tabelle Umweltbedingungen Lambdasonde hinter Kat" VAL_BLK 0x810A27 KwbUb 255.0 dez 0.00 255.0 FORMAT "%5.1" NUMBER 2 /end CHARACTERISTIC
/begin CHARACTERISTIC FFTLSV "Tabelle Umweltbedingungen: Lambdasonde vor Kat" VAL_BLK 0x810A29 KwbUb 255.0 dez 0.00 255.0 FORMAT "%5.1" NUMBER 2 /end CHARACTERISTIC
/begin CHARACTERISTIC FFTMD "Freeze Frame Tabelle: Aussetzer, Summenfehler (multiple)" VAL_BLK 0x810A2F KwbUb 255.0 dez 0.00 255.0 FORMAT "%5.1" NUMBER 2 /end CHARACTERISTIC
/begin CHARACTERISTIC FFTMD00 "Freeze Frame Tabelle: Aussetzer Zyl. 0" VAL_BLK 0x810A31 KwbUb 255.0 dez 0.00 255.0 FORMAT "%5.1" NUMBER 2 /end CHARACTERISTIC
/begin CHARACTERISTIC FFTMD01 "Freeze Frame Tabelle: Aussetzer Zyl. 1" VAL_BLK 0x810A33 KwbUb 255.0 dez 0.00 255.0 FORMAT "%5.1" NUMBER 2 /end CHARACTERISTIC
/begin CHARACTERISTIC FFTMD02 "Freeze Frame Tabelle: Aussetzer Zylinder 2" VAL_BLK 0x810A35 KwbUb 255.0 dez 0.00 255.0 FORMAT "%5.1" NUMBER 2 /end CHARACTERISTIC
/begin CHARACTERISTIC FFTMD03 "Freeze Frame Tabelle: Aussetzer Zylinder 3" VAL_BLK 0x810A37 KwbUb 255.0 dez 0.00 255.0 FORMAT "%5.1" NUMBER 2 /end CHARACTERISTIC
/begin CHARACTERISTIC FFTMFA "Freeze Frame Tabelle: MIL-fremdbestimmt" VAL_BLK 0x810A3B KwbUb 255.0 dez 0.00 255.0 FORMAT "%5.1" NUMBER 2 /end CHARACTERISTIC
/begin CHARACTERISTIC FFTNWKW "Freeze Frame Tabelle: Zuordnung Nockenwelle zu Kurbelwelle" VAL_BLK 0x810A41 KwbUb 255.0 dez 0.00 255.0 FORMAT "%5.1" NUMBER 2 /end CHARACTERISTIC
/begin CHARACTERISTIC FFTNX "Freeze Frame Tabelle: ^NMAX- Überschreitung" VAL_BLK 0x810A45 KwbUb 255.0 dez 0.00 255.0 FORMAT "%5.1" NUMBER 2 /end CHARACTERISTIC
/begin CHARACTERISTIC FFTPH "Freeze Frame Tabelle: Phasensensor" VAL_BLK 0x810A47 KwbUb 255.0 dez 0.00 255.0 FORMAT "%5.1" NUMBER 2 /end CHARACTERISTIC
/begin CHARACTERISTIC FFTPWM "" VAL_BLK 0x810A49 KwbUb 255.0 dez 0.00 255.0 FORMAT "%5.1" NUMBER 2 /end CHARACTERISTIC
/begin CHARACTERISTIC FFTSCR "Freeze Frame Tabelle: CRAS-Signal" VAL_BLK 0x810A4F KwbUb 255.0 dez 0.00 255.0 FORMAT "%5.1" NUMBER 2 /end CHARACTERISTIC
/begin CHARACTERISTIC FFTSGEEP "Freeze Frame Tabelle: SG defekt (EEPROM)" VAL_BLK 0x810A51 KwbUb 255.0 dez 0.00 255.0 FORMAT "%5.1" NUMBER 2 /end CHARACTERISTIC
/begin CHARACTERISTIC FFTSLS "Freeze Frame Tabelle: Sekundärluftsystem" VAL_BLK 0x810A57 KwbUb 255.0 dez 0.00 255.0 FORMAT "%5.1" NUMBER 2 /end CHARACTERISTIC
/begin CHARACTERISTIC FFTSLV "Freeze Frame Tabelle: Dichtheit Sekundärluftventil" VAL_BLK 0x810A59 KwbUb 255.0 dez 0.00 255.0 FORMAT "%5.1" NUMBER 2 /end CHARACTERISTIC
/begin CHARACTERISTIC FFTSWE "Freeze Frame Tabelle: Beschleunigungssensor Schlechtwegeerk." VAL_BLK 0x810A5D KwbUb 255.0 dez 0.00 255.0 FORMAT "%5.1" NUMBER 2 /end CHARACTERISTIC
/begin CHARACTERISTIC FFTT2STC "" VAL_BLK 0x810A5F KwbUb 255.0 dez 0.00 255.0 FORMAT "%5.1" NUMBER 2 /end CHARACTERISTIC
/begin CHARACTERISTIC FFTTA "Freeze Frame Tabelle: Ansauglufttemperatur TANS (/Ladeluft-)" VAL_BLK 0x810A61 KwbUb 255.0 dez 0.00 255.0 FORMAT "%5.1" NUMBER 2 /end CHARACTERISTIC
/begin CHARACTERISTIC FFTTANKL "Freeze Frame Tabelle : tankl (Tank leer)" VAL_BLK 0x810A63 KwbUb 255.0 dez 0.00 255.0 FORMAT "%5.1" NUMBER 2 /end CHARACTERISTIC
/begin CHARACTERISTIC FFTTES "Freeze Frame Tabelle: Tankentlüftungsventil" VAL_BLK 0x810A65 KwbUb 255.0 dez 0.00 255.0 FORMAT "%5.1" NUMBER 2 /end CHARACTERISTIC
/begin CHARACTERISTIC FFTTESF "Freeze Frame Tabelle: Tankdiagnose, Feinleck" VAL_BLK 0x810A67 KwbUb 255.0 dez 0.00 255.0 FORMAT "%5.1" NUMBER 2 /end CHARACTERISTIC
/begin CHARACTERISTIC FFTTESG "Freeze Frame Tabelle: Tankdiagnose, Grobleck" VAL_BLK 0x810A69 KwbUb 255.0 dez 0.00 255.0 FORMAT "%5.1" NUMBER 2 /end CHARACTERISTIC
/begin CHARACTERISTIC FFTTEVE2 "Freeze Frame Tabelle: Tankentlüftungsventil" VAL_BLK 0x810A6D KwbUb 255.0 dez 0.00 255.0 FORMAT "%5.1" NUMBER 2 /end CHARACTERISTIC
/begin CHARACTERISTIC FFTTHM "Freeze Frame Tabelle: Thermostat-Diagnose THM" VAL_BLK 0x810A6F KwbUb 255.0 dez 0.00 255.0 FORMAT "%5.1" NUMBER 2 /end CHARACTERISTIC
/begin CHARACTERISTIC FFTTKA "Freeze Frame Tabelle: Temperatur Kühlerausgang" VAL_BLK 0x810A71 KwbUb 255.0 dez 0.00 255.0 FORMAT "%5.1" NUMBER 2 /end CHARACTERISTIC
/begin CHARACTERISTIC FFTTM "Freeze Frame Tabelle: Motortemperatur TMOT" VAL_BLK 0x810A73 KwbUb 255.0 dez 0.00 255.0 FORMAT "%5.1" NUMBER 2 /end CHARACTERISTIC
/begin CHARACTERISTIC FFTTMKI "Freeze Frame Tabelle: Motortemperatur aus Kombiinstrument TMKI" VAL_BLK 0x810A75 KwbUb 255.0 dez 0.00 255.0 FORMAT "%5.1" NUMBER 2 /end CHARACTERISTIC
/begin CHARACTERISTIC FFTUB "Freeze Frame Tabelle: Batteriespannung UB (Bordnetz)" VAL_BLK 0x810A7B KwbUb 255.0 dez 0.00 255.0 FORMAT "%5.1" NUMBER 2 /end CHARACTERISTIC
/begin CHARACTERISTIC FFTUBR "Freeze Frame Tabelle: Bordnetzspannung über Hauptrelais UBR" VAL_BLK 0x810A7D KwbUb 255.0 dez 0.00 255.0 FORMAT "%5.1" NUMBER 2 /end CHARACTERISTIC
/begin CHARACTERISTIC FFTUFMV "Freeze Frame Tabelle: Funktionsüberwachung: Momentenvergleich" VAL_BLK 0x810A7F KwbUb 255.0 dez 0.00 255.0 FORMAT "%5.1" NUMBER 2 /end CHARACTERISTIC
/begin CHARACTERISTIC FFTUFSKA "Freeze Frame Tabelle: Funktionsüberwachung: Sicherheits-Kraftstoff-Abschaltung" VAL_BLK 0x810A81 KwbUb 255.0 dez 0.00 255.0 FORMAT "%5.1" NUMBER 2 /end CHARACTERISTIC
/begin CHARACTERISTIC FFTURRAM "Freeze Frame Tabelle: Rechnerüberwachung: RAM" VAL_BLK 0x810A83 KwbUb 255.0 dez 0.00 255.0 FORMAT "%5.1" NUMBER 2 /end CHARACTERISTIC
/begin CHARACTERISTIC FFTURROM "Freeze Frame Tabelle: Rechnerüberwachung: ROM" VAL_BLK 0x810A85 KwbUb 255.0 dez 0.00 255.0 FORMAT "%5.1" NUMBER 2 /end CHARACTERISTIC
/begin CHARACTERISTIC FFTURRST "Freeze Frame Tabelle: Rechnerüberwachung: Reset" VAL_BLK 0x810A87 KwbUb 255.0 dez 0.00 255.0 FORMAT "%5.1" NUMBER 2 /end CHARACTERISTIC
/begin CHARACTERISTIC FFTVFZ "Freeze Frame Tabelle: Geschwindigkeitssignal" VAL_BLK 0x810A8B KwbUb 255.0 dez 0.00 255.0 FORMAT "%5.1" NUMBER 2 /end CHARACTERISTIC
/begin CHARACTERISTIC TSFAGRF "Fehlersummenzeit: Überwachung AGR-FLOW" VALUE 0x810A9E KwUb 255.0 dez 0.00 255.0 FORMAT "%5.1" /end CHARACTERISTIC
/begin CHARACTERISTIC TSFBREMS "Fehlersummenzeit: BREMS (Bremsschalter)" VALUE 0x810AA8 KwUb 255.0 dez 0.00 255.0 FORMAT "%5.1" /end CHARACTERISTIC
/begin CHARACTERISTIC TSFBWF "Fehlersummenzeit: PWG Bewegung" VALUE 0x810AA9 KwUb 255.0 dez 0.00 255.0 FORMAT "%5.1" /end CHARACTERISTIC
/begin CHARACTERISTIC TSFCAIRP "Fehlersummenzeit: unpl. Airbag-Botschaft" VALUE 0x810AAB KwUb 255.0 dez 0.00 255.0 FORMAT "%5.1" /end CHARACTERISTIC
/begin CHARACTERISTIC TSFDKVM "Fehlersummenzeit: Drosselklappenverschmutzung" VALUE 0x810AB7 KwUb 255.0 dez 0.00 255.0 FORMAT "%5.1" /end CHARACTERISTIC
/begin CHARACTERISTIC TSFDPL "Fehlersummenzeit: Dauerplus" VALUE 0x810AB8 KwUb 255.0 dez 0.00 255.0 FORMAT "%5.1" /end CHARACTERISTIC
/begin CHARACTERISTIC TSFDSBKV "Fehlersummenzeit: BKV" VALUE 0x810AB9 KwUb 255.0 dez 0.00 255.0 FORMAT "%5.1" /end CHARACTERISTIC
/begin CHARACTERISTIC TSFDSL "Fehlersummenzeit: Drucksensor Ladedruck" VALUE 0x810ABA KwUb 255.0 dez 0.00 255.0 FORMAT "%5.1" /end CHARACTERISTIC
/begin CHARACTERISTIC TSFDSU "Fehlersummenzeit: Drucksensor Umgebung" VALUE 0x810ABB KwUb 255.0 dez 0.00 255.0 FORMAT "%5.1" /end CHARACTERISTIC
/begin CHARACTERISTIC TSFDSVLU "Fehlersummenzeit: Drucksensorsignalvergleich (DS-L DS-U)" VALUE 0x810ABC KwUb 255.0 dez 0.00 255.0 FORMAT "%5.1" /end CHARACTERISTIC
/begin CHARACTERISTIC TSFFP1P "Fehlersummenzeit: Poti 1, Fahrpedal" VALUE 0x810AD1 KwUb 255.0 dez 0.00 255.0 FORMAT "%5.1" /end CHARACTERISTIC
/begin CHARACTERISTIC TSFFP2P "Fehlersummenzeit: Poti 2, Fahrpedal" VALUE 0x810AD2 KwUb 255.0 dez 0.00 255.0 FORMAT "%5.1" /end CHARACTERISTIC
/begin CHARACTERISTIC TSFFPP "Fehlersummenzeit: Poti Fahrpedal" VALUE 0x810AD3 KwUb 255.0 dez 0.00 255.0 FORMAT "%5.1" /end CHARACTERISTIC
/begin CHARACTERISTIC TSFGECOD "Fehlersummenzeit: Getriebecodierung CAN" VALUE 0x810AD7 KwUb 255.0 dez 0.00 255.0 FORMAT "%5.1" /end CHARACTERISTIC
/begin CHARACTERISTIC TSFGRBH "Fehlersummenzeit: GRA Bedienhebel" VALUE 0x810AD8 KwUb 255.0 dez 0.00 255.0 FORMAT "%5.1" /end CHARACTERISTIC
/begin CHARACTERISTIC TSFHLA "Fehlersummenzeit: Heizleistungsanforderung" VALUE 0x810AD9 KwUb 255.0 dez 0.00 255.0 FORMAT "%5.1" /end CHARACTERISTIC
/begin CHARACTERISTIC TSFHRE "" VALUE 0x810ADA KwUb 255.0 dez 0.00 255.0 FORMAT "%5.1" /end CHARACTERISTIC
/begin CHARACTERISTIC TSFLASH "Fehlersummenzeit: Lambda-Sondenalterung hinter Kat." VALUE 0x810AF0 KwUb 255.0 dez 0.00 255.0 FORMAT "%5.1" /end CHARACTERISTIC
/begin CHARACTERISTIC TSFLDO "Fehlersummenzeit: Ladedruckkennlinie; oberer Wert überschritten" VALUE 0x810AF2 KwUb 255.0 dez 0.00 255.0 FORMAT "%5.1" /end CHARACTERISTIC
/begin CHARACTERISTIC TSFLDP "Fehlersummenzeit: Leckdiagnosepumpe" VALUE 0x810AF3 KwUb 255.0 dez 0.00 255.0 FORMAT "%5.1" /end CHARACTERISTIC
/begin CHARACTERISTIC TSFLDRA "Fehlersummenzeit: Ladedruckregelabweichung" VALUE 0x810AF5 KwUb 255.0 dez 0.00 255.0 FORMAT "%5.1" /end CHARACTERISTIC
/begin CHARACTERISTIC TSFLDUV "Fehlersummenzeit: Schubumluftventil-Endstufe" VALUE 0x810AF6 KwUb 255.0 dez 0.00 255.0 FORMAT "%5.1" /end CHARACTERISTIC
/begin CHARACTERISTIC TSFLKVDK "Fehlersummenzeit: Leck vor Drosselklappe" VALUE 0x810AF7 KwUb 255.0 dez 0.00 255.0 FORMAT "%5.1" /end CHARACTERISTIC
/begin CHARACTERISTIC TSFLLR "Fehlersummenzeit: Leerlaufregelung" VALUE 0x810AF8 KwUb 255.0 dez 0.00 255.0 FORMAT "%5.1" /end CHARACTERISTIC
/begin CHARACTERISTIC TSFLM "Fehlersummenzeit: LMM/HLM/HFM" VALUE 0x810AF9 KwUb 255.0 dez 0.00 255.0 FORMAT "%5.1" /end CHARACTERISTIC
/begin CHARACTERISTIC TSFLSH "Fehlersummenzeit: Lambda-Sonde hinter Kat" VALUE 0x810AFA KwUb 255.0 dez 0.00 255.0 FORMAT "%5.1" /end CHARACTERISTIC
/begin CHARACTERISTIC TSFLSV "Fehlersummenzeit: Lambda-Sonde vor Kat" VALUE 0x810AFB KwUb 255.0 dez 0.00 255.0 FORMAT "%5.1" /end CHARACTERISTIC
/begin CHARACTERISTIC TSFMD "Fehlersummenzeit: Aussetzer, Summenfehler (multiple)" VALUE 0x810AFE KwUb 255.0 dez 0.00 255.0 FORMAT "%5.1" /end CHARACTERISTIC
/begin CHARACTERISTIC TSFMD00 "Fehlersummenzeit: Aussetzer Zyl. 0" VALUE 0x810AFF KwUb 255.0 dez 0.00 255.0 FORMAT "%5.1" /end CHARACTERISTIC
/begin CHARACTERISTIC TSFMD01 "Fehlersummenzeit: Aussetzer Zyl. 1" VALUE 0x810B00 KwUb 255.0 dez 0.00 255.0 FORMAT "%5.1" /end CHARACTERISTIC
/begin CHARACTERISTIC TSFMD02 "Fehlersummenzeit: Aussetzer Zylinder 2" VALUE 0x810B01 KwUb 255.0 dez 0.00 255.0 FORMAT "%5.1" /end CHARACTERISTIC
/begin CHARACTERISTIC TSFMD03 "Fehlersummenzeit: Aussetzer Zylinder 3" VALUE 0x810B02 KwUb 255.0 dez 0.00 255.0 FORMAT "%5.1" /end CHARACTERISTIC
/begin CHARACTERISTIC TSFMFA "Fehlersummenzeit: MIL-fremdbestimmt" VALUE 0x810B04 KwUb 255.0 dez 0.00 255.0 FORMAT "%5.1" /end CHARACTERISTIC
/begin CHARACTERISTIC TSFNWKW "Fehlersummenzeit: Zuordnung Nockenwelle zu Kurbelwelle" VALUE 0x810B07 KwUb 255.0 dez 0.00 255.0 FORMAT "%5.1" /end CHARACTERISTIC
/begin CHARACTERISTIC TSFNX "Fehlersummenzeit: NMAX - Überschreitung" VALUE 0x810B09 KwUb 255.0 dez 0.00 255.0 FORMAT "%5.1" /end CHARACTERISTIC
/begin CHARACTERISTIC TSFPH "Fehlersummenzeit: Phasensensor" VALUE 0x810B0A KwUb 255.0 dez 0.00 255.0 FORMAT "%5.1" /end CHARACTERISTIC
/begin CHARACTERISTIC TSFPWM "" VALUE 0x810B0B KwUb 255.0 dez 0.00 255.0 FORMAT "%5.1" /end CHARACTERISTIC
/begin CHARACTERISTIC TSFSCR "Fehlersummenzeit: CRAS-Signal" VALUE 0x810B0E KwUb 255.0 dez 0.00 255.0 FORMAT "%5.1" /end CHARACTERISTIC
/begin CHARACTERISTIC TSFSGEEP "Fehlersummenzeit: Steuergerät defekt (EEPROM)" VALUE 0x810B0F KwUb 255.0 dez 0.00 255.0 FORMAT "%5.1" /end CHARACTERISTIC
/begin CHARACTERISTIC TSFSLS "Fehlersummenzeit: Sekundärluft-System" VALUE 0x810B12 KwUb 255.0 dez 0.00 255.0 FORMAT "%5.1" /end CHARACTERISTIC
/begin CHARACTERISTIC TSFSLV "Fehlersummenzeit: Sekundärluftventil" VALUE 0x810B13 KwUb 255.0 dez 0.00 255.0 FORMAT "%5.1" /end CHARACTERISTIC
/begin CHARACTERISTIC TSFSWE "Fehlersummenzeit: Beschleunigungssensor der Schlechtwegeerkennung" VALUE 0x810B15 KwUb 255.0 dez 0.00 255.0 FORMAT "%5.1" /end CHARACTERISTIC
/begin CHARACTERISTIC TSFT2STC "" VALUE 0x810B16 KwUb 255.0 dez 0.00 255.0 FORMAT "%5.1" /end CHARACTERISTIC
/begin CHARACTERISTIC TSFTA "Fehlersummenzeit: Ansauglufttemperatur TANS" VALUE 0x810B17 KwUb 255.0 dez 0.00 255.0 FORMAT "%5.1" /end CHARACTERISTIC
/begin CHARACTERISTIC TSFTANKL "Fehlersummenzeit: OBDII Fehler auf Grund eines leeren Tanks" VALUE 0x810B18 KwUb 255.0 dez 0.00 255.0 FORMAT "%5.1" /end CHARACTERISTIC
/begin CHARACTERISTIC TSFTES "Fehlersummenzeit: Tankentlüftungssystem" VALUE 0x810B19 KwUb 255.0 dez 0.00 255.0 FORMAT "%5.1" /end CHARACTERISTIC
/begin CHARACTERISTIC TSFTESF "Fehlersummenzeit: Tankentlüftungssystem Feinleck" VALUE 0x810B1A KwUb 255.0 dez 0.00 255.0 FORMAT "%5.1" /end CHARACTERISTIC
/begin CHARACTERISTIC TSFTESG "Fehlersummenzeit: Tankentlüftungssystem Grobleck" VALUE 0x810B1B KwUb 255.0 dez 0.00 255.0 FORMAT "%5.1" /end CHARACTERISTIC
/begin CHARACTERISTIC TSFTEVE2 "Fehlersummenzeit: Tankentlüftungsventil Endstufe  Bank2" VALUE 0x810B1D KwUb 255.0 dez 0.00 255.0 FORMAT "%5.1" /end CHARACTERISTIC
/begin CHARACTERISTIC TSFTHM "Fehlersummenzeit: Thermostat-Diagnose THM" VALUE 0x810B1E KwUb 255.0 dez 0.00 255.0 FORMAT "%5.1" /end CHARACTERISTIC
/begin CHARACTERISTIC TSFTKA "Fehlersummenzeit: Temperatur Kühlerausgang" VALUE 0x810B1F KwUb 255.0 dez 0.00 255.0 FORMAT "%5.1" /end CHARACTERISTIC
/begin CHARACTERISTIC TSFTM "Fehlersummenzeit: Motortemperatur TMOT" VALUE 0x810B20 KwUb 255.0 dez 0.00 255.0 FORMAT "%5.1" /end CHARACTERISTIC
/begin CHARACTERISTIC TSFTMKI "Fehlersummenzeit: Motortemperatur aus Kombiinstrument TMKI" VALUE 0x810B21 KwUb 255.0 dez 0.00 255.0 FORMAT "%5.1" /end CHARACTERISTIC
/begin CHARACTERISTIC TSFUB "Fehlersummenzeit: Batteriespannung UB (Bordnetz)" VALUE 0x810B24 KwUb 255.0 dez 0.00 255.0 FORMAT "%5.1" /end CHARACTERISTIC
/begin CHARACTERISTIC TSFUBR "Fehlersummenzeit: Bordnetzspannung über Hauptrelais UBR" VALUE 0x810B25 KwUb 255.0 dez 0.00 255.0 FORMAT "%5.1" /end CHARACTERISTIC
/begin CHARACTERISTIC TSFUFMV "Fehlersummenzeit: Funktionsüberwachung: Momentenvergleich" VALUE 0x810B26 KwUb 255.0 dez 0.00 255.0 FORMAT "%5.1" /end CHARACTERISTIC
/begin CHARACTERISTIC TSFUFSKA "Fehlersummenzeit: Funktionsüberwachung: Sicherheits-Kraftstoff-Abschaltung" VALUE 0x810B27 KwUb 255.0 dez 0.00 255.0 FORMAT "%5.1" /end CHARACTERISTIC
/begin CHARACTERISTIC TSFURRAM "Fehlersummenzeit: Rechnerüberwachung: RAM" VALUE 0x810B28 KwUb 255.0 dez 0.00 255.0 FORMAT "%5.1" /end CHARACTERISTIC
/begin CHARACTERISTIC TSFURROM "Fehlersummenzeit: Rechnerüberwachung: ROM" VALUE 0x810B29 KwUb 255.0 dez 0.00 255.0 FORMAT "%5.1" /end CHARACTERISTIC
/begin CHARACTERISTIC TSFURRST "Fehlersummenzeit: Rechnerüberwachung: Reset" VALUE 0x810B2A KwUb 255.0 dez 0.00 255.0 FORMAT "%5.1" /end CHARACTERISTIC
/begin CHARACTERISTIC TSFVFZ "Fehlersummenzeit: Fahrzeug-Geschwindigkeit" VALUE 0x810B2C KwUb 255.0 dez 0.00 255.0 FORMAT "%5.1" /end CHARACTERISTIC
/begin MEASUREMENT B_avgecod "" UWORD B_TRUE 1 100 0 1 BIT_MASK 0x1000 FORMAT "%13.11" ECU_ADDRESS 0x383B7E /end MEASUREMENT
/begin MEASUREMENT B_avtes "Leckdiagnose ist aktiv" UWORD B_TRUE 1 100 0 1 BIT_MASK 0x1000 FORMAT "%13.11" ECU_ADDRESS 0x383C02 /end MEASUREMENT
/begin MEASUREMENT B_avtmki "" UWORD B_TRUE 1 100 0 1 BIT_MASK 0x1000 FORMAT "%13.11" ECU_ADDRESS 0x383C12 /end MEASUREMENT
/begin MEASUREMENT B_bebrems "Bedingung Bandende-Funktionsanforderung Bremsschalter" UWORD B_TRUE 1 100 0 1 BIT_MASK 0x20 FORMAT "%13.11" ECU_ADDRESS 0x383B20 /end MEASUREMENT
/begin MEASUREMENT B_bebwf "Bedingung Bandendeanford. für Bewegungsfehler FPM" UWORD B_TRUE 1 100 0 1 BIT_MASK 0x20 FORMAT "%13.11" ECU_ADDRESS 0x383B22 /end MEASUREMENT
/begin MEASUREMENT B_becairp "Bedingung Bandende Funktionsanforderung : unpl. Airbag-Botschaft" UWORD B_TRUE 1 100 0 1 BIT_MASK 0x20 FORMAT "%13.11" ECU_ADDRESS 0x383B26 /end MEASUREMENT
/begin MEASUREMENT B_bedpl "Bedingung Bandende-Funktionsanforderung für Dauerplus Diagnose" UWORD B_TRUE 1 100 0 1 BIT_MASK 0x20 FORMAT "%13.11" ECU_ADDRESS 0x383B40 /end MEASUREMENT
/begin MEASUREMENT B_bedsbkv "Bedingung Bandende-Funktionsanforderung BKV" UWORD B_TRUE 1 100 0 1 BIT_MASK 0x20 FORMAT "%13.11" ECU_ADDRESS 0x383B42 /end MEASUREMENT
/begin MEASUREMENT B_bedsl "Bedingung: Bandende-Funktionsanforderung DSL" UWORD B_TRUE 1 100 0 1 BIT_MASK 0x20 FORMAT "%13.11" ECU_ADDRESS 0x383B44 /end MEASUREMENT
/begin MEASUREMENT B_bedsu "Bedingung: Bandende-Funktionsanforderung DSU" UWORD B_TRUE 1 100 0 1 BIT_MASK 0x20 FORMAT "%13.11" ECU_ADDRESS 0x383B46 /end MEASUREMENT
/begin MEASUREMENT B_bedsvlu "Bedingung: Bandende-Funktionsanforderung DSVLU" UWORD B_TRUE 1 100 0 1 BIT_MASK 0x20 FORMAT "%13.11" ECU_ADDRESS 0x383B48 /end MEASUREMENT
/begin MEASUREMENT B_befp1p "Bedingung Bandendeanford. für Fehler Poti1 FPM" UWORD B_TRUE 1 100 0 1 BIT_MASK 0x20 FORMAT "%13.11" ECU_ADDRESS 0x383B72 /end MEASUREMENT
/begin MEASUREMENT B_befp2p "Bedingung Bandendeanford. für Fehler Poti2 FPM" UWORD B_TRUE 1 100 0 1 BIT_MASK 0x20 FORMAT "%13.11" ECU_ADDRESS 0x383B74 /end MEASUREMENT
/begin MEASUREMENT B_befpp "Bedingung Bandendeanford. für Fehler FPM" UWORD B_TRUE 1 100 0 1 BIT_MASK 0x20 FORMAT "%13.11" ECU_ADDRESS 0x383B76 /end MEASUREMENT
/begin MEASUREMENT B_begecod "Bedingung Bandende Funktionsanforderung : Getriebecodierung CAN" UWORD B_TRUE 1 100 0 1 BIT_MASK 0x20 FORMAT "%13.11" ECU_ADDRESS 0x383B7E /end MEASUREMENT
/begin MEASUREMENT B_begrbh "Bedingung Bandende-Funktionsanforderung für GRA-Bedienteil" UWORD B_TRUE 1 100 0 1 BIT_MASK 0x20 FORMAT "%13.11" ECU_ADDRESS 0x383B80 /end MEASUREMENT
/begin MEASUREMENT B_behla "Bedingung: Bandende Funktionsanforderung Gebergröße Heizleistungsanforderung" UWORD B_TRUE 1 100 0 1 BIT_MASK 0x20 FORMAT "%13.11" ECU_ADDRESS 0x383B82 /end MEASUREMENT
/begin MEASUREMENT B_behre "Bedingung Bandende-Funktionsanforderung: Hauptrelais" UWORD B_TRUE 1 100 0 1 BIT_MASK 0x20 FORMAT "%13.11" ECU_ADDRESS 0x383B84 /end MEASUREMENT
/begin MEASUREMENT B_belash "Bedingung Bandende-Funktionsanforderung Schwingungsprüfung hinter KAT" UWORD B_TRUE 1 100 0 1 BIT_MASK 0x20 FORMAT "%13.11" ECU_ADDRESS 0x383BB0 /end MEASUREMENT
/begin MEASUREMENT B_beldo "Bedingung Bandende-Funktionsanforderung LDO" UWORD B_TRUE 1 100 0 1 BIT_MASK 0x20 FORMAT "%13.11" ECU_ADDRESS 0x383BB4 /end MEASUREMENT
/begin MEASUREMENT B_beldp "Bedingung Bandende-Funktionsanforderung LDP" UWORD B_TRUE 1 100 0 1 BIT_MASK 0x20 FORMAT "%13.11" ECU_ADDRESS 0x383BB6 /end MEASUREMENT
/begin MEASUREMENT B_beldra "Bedingung Bandende-Funktionsanforderung LDRA" UWORD B_TRUE 1 100 0 1 BIT_MASK 0x20 FORMAT "%13.11" ECU_ADDRESS 0x383BBA /end MEASUREMENT
/begin MEASUREMENT B_belduv "Bedingung Bandende-Funktionsanforderung Schubumluftventil Turbo" UWORD B_TRUE 1 100 0 1 BIT_MASK 0x20 FORMAT "%13.11" ECU_ADDRESS 0x383BBC /end MEASUREMENT
/begin MEASUREMENT B_belkvdk "Bedingung: Fehlereintrag durch Leck vor Drosselklappe (Bandende)" UWORD B_TRUE 1 100 0 1 BIT_MASK 0x20 FORMAT "%13.11" ECU_ADDRESS 0x383BBE /end MEASUREMENT
/begin MEASUREMENT B_bellr "Bedingung: Bandende-Funktionsanford. für Leerlaufregelung" UWORD B_TRUE 1 100 0 1 BIT_MASK 0x20 FORMAT "%13.11" ECU_ADDRESS 0x383BC0 /end MEASUREMENT
/begin MEASUREMENT B_belm "Bedingung Bandende-Funktionsanforderung Luftmassensensor (HFM/DSS)" UWORD B_TRUE 1 100 0 1 BIT_MASK 0x20 FORMAT "%13.11" ECU_ADDRESS 0x383BC2 /end MEASUREMENT
/begin MEASUREMENT B_belsh "Bedingung Bandende-Funktionsanforderung elktr. Diag. Lambda-Sonde hinter KAT" UWORD B_TRUE 1 100 0 1 BIT_MASK 0x20 FORMAT "%13.11" ECU_ADDRESS 0x383BC4 /end MEASUREMENT
/begin MEASUREMENT B_belsv "Bedingung Bandende-Funktionsanforderung elktr. Diag. Lambda-Sonde vor KAT" UWORD B_TRUE 1 100 0 1 BIT_MASK 0x20 FORMAT "%13.11" ECU_ADDRESS 0x383BC6 /end MEASUREMENT
/begin MEASUREMENT B_bemd "Bedingung Bandende-Funktionsanforderung Erkennung mehrfacher Aussetzer" UWORD B_TRUE 1 100 0 1 BIT_MASK 0x20 FORMAT "%13.11" ECU_ADDRESS 0x383BCC /end MEASUREMENT
/begin MEASUREMENT B_bemd00 "Bedingung Bandende-Funktionsanforderung" UWORD B_TRUE 1 100 0 1 BIT_MASK 0x20 FORMAT "%13.11" ECU_ADDRESS 0x383BCE /end MEASUREMENT
/begin MEASUREMENT B_bemd01 "Bedingung Bandende-Funktionsanforderung" UWORD B_TRUE 1 100 0 1 BIT_MASK 0x20 FORMAT "%13.11" ECU_ADDRESS 0x383BD0 /end MEASUREMENT
/begin MEASUREMENT B_bemd02 "Bedingung Bandende-Funktionsanforderung" UWORD B_TRUE 1 100 0 1 BIT_MASK 0x20 FORMAT "%13.11" ECU_ADDRESS 0x383BD2 /end MEASUREMENT
/begin MEASUREMENT B_bemd03 "Bedingung Bandende-Funktionsanforderung" UWORD B_TRUE 1 100 0 1 BIT_MASK 0x20 FORMAT "%13.11" ECU_ADDRESS 0x383BD4 /end MEASUREMENT
/begin MEASUREMENT B_bemfa "Bedingung Bandende-Funktionsanforderung: MIL-Fremdanforderung" UWORD B_TRUE 1 100 0 1 BIT_MASK 0x20 FORMAT "%13.11" ECU_ADDRESS 0x383BD8 /end MEASUREMENT
/begin MEASUREMENT B_benwkw "Bedingung Bandende-Funktionsanforderung Zuordnung Nockenwelle zu Kurbelwelle" UWORD B_TRUE 1 100 0 1 BIT_MASK 0x20 FORMAT "%13.11" ECU_ADDRESS 0x383BDE /end MEASUREMENT
/begin MEASUREMENT B_benx "Bedingung: Bandendefunktionanford. für DNMAX" UWORD B_TRUE 1 100 0 1 BIT_MASK 0x20 FORMAT "%13.11" ECU_ADDRESS 0x383BE2 /end MEASUREMENT
/begin MEASUREMENT B_beph "Bedingung: Bandendefunktionanford. für Phasengeber" UWORD B_TRUE 1 100 0 1 BIT_MASK 0x20 FORMAT "%13.11" ECU_ADDRESS 0x383BE4 /end MEASUREMENT
/begin MEASUREMENT B_bepwm "" UWORD B_TRUE 1 100 0 1 BIT_MASK 0x20 FORMAT "%13.11" ECU_ADDRESS 0x383BE6 /end MEASUREMENT
/begin MEASUREMENT B_bescr "Bedingung Bandende Funktionsanforderung : Crashabschaltung" UWORD B_TRUE 1 100 0 1 BIT_MASK 0x20 FORMAT "%13.11" ECU_ADDRESS 0x383BEC /end MEASUREMENT
/begin MEASUREMENT B_besgeep "Bedingung Bandende-Funktionsanforderung" UWORD B_TRUE 1 100 0 1 BIT_MASK 0x20 FORMAT "%13.11" ECU_ADDRESS 0x383BEE /end MEASUREMENT
/begin MEASUREMENT B_besls "Bedingung Bandende-Funktionsanforderung Sekundärluftsystem" UWORD B_TRUE 1 100 0 1 BIT_MASK 0x20 FORMAT "%13.11" ECU_ADDRESS 0x383BF4 /end MEASUREMENT
/begin MEASUREMENT B_beslv "Bedingung Bandende-Funktionsanforderung SLS" UWORD B_TRUE 1 100 0 1 BIT_MASK 0x20 FORMAT "%13.11" ECU_ADDRESS 0x383BF6 /end MEASUREMENT
/begin MEASUREMENT B_beswe "Bedingung Bandende-Funktionsanforderung Beschleunigungss. f Schlechtwegerkennung" UWORD B_TRUE 1 100 0 1 BIT_MASK 0x20 FORMAT "%13.11" ECU_ADDRESS 0x383BFA /end MEASUREMENT
/begin MEASUREMENT B_bet2stc "" UWORD B_TRUE 1 100 0 1 BIT_MASK 0x20 FORMAT "%13.11" ECU_ADDRESS 0x383BFC /end MEASUREMENT
/begin MEASUREMENT B_beta "Bedingung Bandende-Funktionsanforderung Ansauglufttemperaturfühler" UWORD B_TRUE 1 100 0 1 BIT_MASK 0x20 FORMAT "%13.11" ECU_ADDRESS 0x383BFE /end MEASUREMENT
/begin MEASUREMENT B_betankl "Bedingung Bandende-Funktionsanforderung TANKL" UWORD B_TRUE 1 100 0 1 BIT_MASK 0x20 FORMAT "%13.11" ECU_ADDRESS 0x383C00 /end MEASUREMENT
/begin MEASUREMENT B_betes "Bedingung Bandende-Funktionsanforderung Tankentlüftungssystem" UWORD B_TRUE 1 100 0 1 BIT_MASK 0x20 FORMAT "%13.11" ECU_ADDRESS 0x383C02 /end MEASUREMENT
/begin MEASUREMENT B_betesf "Bedingung Bandende-Funktionsanforderung TESF" UWORD B_TRUE 1 100 0 1 BIT_MASK 0x20 FORMAT "%13.11" ECU_ADDRESS 0x383C04 /end MEASUREMENT
/begin MEASUREMENT B_betesg "Bedingung: Bandendetest für Groblecktest" UWORD B_TRUE 1 100 0 1 BIT_MASK 0x20 FORMAT "%13.11" ECU_ADDRESS 0x383C06 /end MEASUREMENT
/begin MEASUREMENT B_bethm "Bedingung Bandendeanforderung für Thermostatdiagnose" UWORD B_TRUE 1 100 0 1 BIT_MASK 0x20 FORMAT "%13.11" ECU_ADDRESS 0x383C0C /end MEASUREMENT
/begin MEASUREMENT B_betka "Bedingung Bandende-Funktionsanforderung: TKA-Sensor" UWORD B_TRUE 1 100 0 1 BIT_MASK 0x20 FORMAT "%13.11" ECU_ADDRESS 0x383C0E /end MEASUREMENT
/begin MEASUREMENT B_betm "Bedingung Bandende-Funktionsanforderung Motortemperaturfühler" UWORD B_TRUE 1 100 0 1 BIT_MASK 0x20 FORMAT "%13.11" ECU_ADDRESS 0x383C10 /end MEASUREMENT
/begin MEASUREMENT B_betmki "Bedingung Bandende-Funktionsanforderung Motortemperatur üb. Kombiinstrument tmki" UWORD B_TRUE 1 100 0 1 BIT_MASK 0x20 FORMAT "%13.11" ECU_ADDRESS 0x383C12 /end MEASUREMENT
/begin MEASUREMENT B_beub "Bedingung: Bandendefunktionanford. für Batteriespannung (Bordnetz)" UWORD B_TRUE 1 100 0 1 BIT_MASK 0x20 FORMAT "%13.11" ECU_ADDRESS 0x383C18 /end MEASUREMENT
/begin MEASUREMENT B_beubr "Bedingung: Bandendefunktionanford. für Batteriespannung (Bordnetz)" UWORD B_TRUE 1 100 0 1 BIT_MASK 0x20 FORMAT "%13.11" ECU_ADDRESS 0x383C1A /end MEASUREMENT
/begin MEASUREMENT B_beufmv "Bedingung Bandende:Fktüberwachung-Anforderung" UWORD B_TRUE 1 100 0 1 BIT_MASK 0x20 FORMAT "%13.11" ECU_ADDRESS 0x383C1C /end MEASUREMENT
/begin MEASUREMENT B_beufska "Bedingung Bandende:Fktüberwachung-Anforderung" UWORD B_TRUE 1 100 0 1 BIT_MASK 0x20 FORMAT "%13.11" ECU_ADDRESS 0x383C1E /end MEASUREMENT
/begin MEASUREMENT B_beurram "" UWORD B_TRUE 1 100 0 1 BIT_MASK 0x20 FORMAT "%13.11" ECU_ADDRESS 0x383C20 /end MEASUREMENT
/begin MEASUREMENT B_beurrom "" UWORD B_TRUE 1 100 0 1 BIT_MASK 0x20 FORMAT "%13.11" ECU_ADDRESS 0x383C22 /end MEASUREMENT
/begin MEASUREMENT B_beurrst "" UWORD B_TRUE 1 100 0 1 BIT_MASK 0x20 FORMAT "%13.11" ECU_ADDRESS 0x383C24 /end MEASUREMENT
/begin MEASUREMENT B_bevfz "Bedingung Bandende-Funktionsanforderung für Fehlerpfad Fahrzeuggeschwindigkeit" UWORD B_TRUE 1 100 0 1 BIT_MASK 0x20 FORMAT "%13.11" ECU_ADDRESS 0x383C28 /end MEASUREMENT
/begin MEASUREMENT B_bkbrems "Bedingung Ersatzwert aktiv: BREMS (Bremsschalter)" UWORD B_TRUE 1 100 0 1 BIT_MASK 0x40 FORMAT "%13.11" ECU_ADDRESS 0x383B20 /end MEASUREMENT
/begin MEASUREMENT B_bkbwf "Flag für Ersatzwert: PWG Bewegung" UWORD B_TRUE 1 100 0 1 BIT_MASK 0x40 FORMAT "%13.11" ECU_ADDRESS 0x383B22 /end MEASUREMENT
/begin MEASUREMENT B_bkcairp "Bedingung : unpl. Airbag-Botschaft" UWORD B_TRUE 1 100 0 1 BIT_MASK 0x40 FORMAT "%13.11" ECU_ADDRESS 0x383B26 /end MEASUREMENT
/begin MEASUREMENT B_bkdpl "Bedingung: Dauerplus" UWORD B_TRUE 1 100 0 1 BIT_MASK 0x40 FORMAT "%13.11" ECU_ADDRESS 0x383B40 /end MEASUREMENT
/begin MEASUREMENT B_bkdsbkv "Bedingung Ersatzwert aktiv: BKV" UWORD B_TRUE 1 100 0 1 BIT_MASK 0x40 FORMAT "%13.11" ECU_ADDRESS 0x383B42 /end MEASUREMENT
/begin MEASUREMENT B_bkdsl "Bedingung: DSL aktiv" UWORD B_TRUE 1 100 0 1 BIT_MASK 0x40 FORMAT "%13.11" ECU_ADDRESS 0x383B44 /end MEASUREMENT
/begin MEASUREMENT B_bkdsu "Bedingung: Umgebungsdrucksensor" UWORD B_TRUE 1 100 0 1 BIT_MASK 0x40 FORMAT "%13.11" ECU_ADDRESS 0x383B46 /end MEASUREMENT
/begin MEASUREMENT B_bkdsvlu "Bedingung: Drucksensorsignalvergleich (DS-L DS-U)" UWORD B_TRUE 1 100 0 1 BIT_MASK 0x40 FORMAT "%13.11" ECU_ADDRESS 0x383B48 /end MEASUREMENT
/begin MEASUREMENT B_bkfp1p "Bedingung: Fahrpedal 1.Potentiometer aktiv" UWORD B_TRUE 1 100 0 1 BIT_MASK 0x40 FORMAT "%13.11" ECU_ADDRESS 0x383B72 /end MEASUREMENT
/begin MEASUREMENT B_bkfp2p "Bedingung: Fahrpedal 2.Potentiometer aktiv" UWORD B_TRUE 1 100 0 1 BIT_MASK 0x40 FORMAT "%13.11" ECU_ADDRESS 0x383B74 /end MEASUREMENT
/begin MEASUREMENT B_bkfpp "Bedingung: Fahrpedal Potentiometer aktiv" UWORD B_TRUE 1 100 0 1 BIT_MASK 0x40 FORMAT "%13.11" ECU_ADDRESS 0x383B76 /end MEASUREMENT
/begin MEASUREMENT B_bkgecod "Bedingung : Getriebecodierung CAN" UWORD B_TRUE 1 100 0 1 BIT_MASK 0x40 FORMAT "%13.11" ECU_ADDRESS 0x383B7E /end MEASUREMENT
/begin MEASUREMENT B_bkgrbh "Bedingung ersatzwert aktiv für GRA-Bedienteil" UWORD B_TRUE 1 100 0 1 BIT_MASK 0x40 FORMAT "%13.11" ECU_ADDRESS 0x383B80 /end MEASUREMENT
/begin MEASUREMENT B_bkhla "Bedingung: Ersatzwert aktiv: Gebergröße Heizleistungsanforderung" UWORD B_TRUE 1 100 0 1 BIT_MASK 0x40 FORMAT "%13.11" ECU_ADDRESS 0x383B82 /end MEASUREMENT
/begin MEASUREMENT B_bkhre "Bedingung Ersatzwert aktiv: Hauptrelais" UWORD B_TRUE 1 100 0 1 BIT_MASK 0x40 FORMAT "%13.11" ECU_ADDRESS 0x383B84 /end MEASUREMENT
/begin MEASUREMENT B_bklash "Bedingung: Lambdasondenalterung hinter Kat. aktive" UWORD B_TRUE 1 100 0 1 BIT_MASK 0x40 FORMAT "%13.11" ECU_ADDRESS 0x383BB0 /end MEASUREMENT
/begin MEASUREMENT B_bkldo "Bedingung Ersatzwert aktiv: LDO" UWORD B_TRUE 1 100 0 1 BIT_MASK 0x40 FORMAT "%13.11" ECU_ADDRESS 0x383BB4 /end MEASUREMENT
/begin MEASUREMENT B_bkldp "Bedingung: Leckdiagnosemodul aktiv" UWORD B_TRUE 1 100 0 1 BIT_MASK 0x40 FORMAT "%13.11" ECU_ADDRESS 0x383BB6 /end MEASUREMENT
/begin MEASUREMENT B_bkldra "Bedingung Ersatzwert aktiv: LDRA" UWORD B_TRUE 1 100 0 1 BIT_MASK 0x40 FORMAT "%13.11" ECU_ADDRESS 0x383BBA /end MEASUREMENT
/begin MEASUREMENT B_bklduv "Bedingung: Schubumluftventil-Endstufe aktiv" UWORD B_TRUE 1 100 0 1 BIT_MASK 0x40 FORMAT "%13.11" ECU_ADDRESS 0x383BBC /end MEASUREMENT
/begin MEASUREMENT B_bklkvdk "Bedingung: Leck vor Drosselklappe verwendet Ersatzwert" UWORD B_TRUE 1 100 0 1 BIT_MASK 0x40 FORMAT "%13.11" ECU_ADDRESS 0x383BBE /end MEASUREMENT
/begin MEASUREMENT B_bkllr "Bedingung: Leerlaufregelung" UWORD B_TRUE 1 100 0 1 BIT_MASK 0x40 FORMAT "%13.11" ECU_ADDRESS 0x383BC0 /end MEASUREMENT
/begin MEASUREMENT B_bklm "Bedingung: Hauptlastsensor aktiv" UWORD B_TRUE 1 100 0 1 BIT_MASK 0x40 FORMAT "%13.11" ECU_ADDRESS 0x383BC2 /end MEASUREMENT
/begin MEASUREMENT B_bklsh "Bedingung: Lambdasonde hinter Kat. aktiv" UWORD B_TRUE 1 100 0 1 BIT_MASK 0x40 FORMAT "%13.11" ECU_ADDRESS 0x383BC4 /end MEASUREMENT
/begin MEASUREMENT B_bklsv "Bedingung: Lambdasonde vor Kat. aktiv" UWORD B_TRUE 1 100 0 1 BIT_MASK 0x40 FORMAT "%13.11" ECU_ADDRESS 0x383BC6 /end MEASUREMENT
/begin MEASUREMENT B_bkmd "Flag für Ersatzwert: Aussetzer, Summenfehler (multiple)" UWORD B_TRUE 1 100 0 1 BIT_MASK 0x40 FORMAT "%13.11" ECU_ADDRESS 0x383BCC /end MEASUREMENT
/begin MEASUREMENT B_bkmd00 "Flag für Ersatzwert: Aussetzer Zündung 0" UWORD B_TRUE 1 100 0 1 BIT_MASK 0x40 FORMAT "%13.11" ECU_ADDRESS 0x383BCE /end MEASUREMENT
/begin MEASUREMENT B_bkmd01 "Flag für Ersatzwert: Aussetzer Zündung 1" UWORD B_TRUE 1 100 0 1 BIT_MASK 0x40 FORMAT "%13.11" ECU_ADDRESS 0x383BD0 /end MEASUREMENT
/begin MEASUREMENT B_bkmd02 "Flag für Ersatzwert: Aussetzer Zündung 2" UWORD B_TRUE 1 100 0 1 BIT_MASK 0x40 FORMAT "%13.11" ECU_ADDRESS 0x383BD2 /end MEASUREMENT
/begin MEASUREMENT B_bkmd03 "Flag für Ersatzwert: Aussetzer Zündung 3" UWORD B_TRUE 1 100 0 1 BIT_MASK 0x40 FORMAT "%13.11" ECU_ADDRESS 0x383BD4 /end MEASUREMENT
/begin MEASUREMENT B_bkmfa "Bedingung: Ersatzwert aktiv MIL-Fremdanforderung" UWORD B_TRUE 1 100 0 1 BIT_MASK 0x40 FORMAT "%13.11" ECU_ADDRESS 0x383BD8 /end MEASUREMENT
/begin MEASUREMENT B_bknwkw "Bedingung: Zuordnung Nockenwelle zu Kurbelwelle aktiv" UWORD B_TRUE 1 100 0 1 BIT_MASK 0x40 FORMAT "%13.11" ECU_ADDRESS 0x383BDE /end MEASUREMENT
/begin MEASUREMENT B_bknx "Flag für Ersatzwert: Überdrehzahl" UWORD B_TRUE 1 100 0 1 BIT_MASK 0x40 FORMAT "%13.11" ECU_ADDRESS 0x383BE2 /end MEASUREMENT
/begin MEASUREMENT B_bkph "Bedingung: Phasengeber aktiv" UWORD B_TRUE 1 100 0 1 BIT_MASK 0x40 FORMAT "%13.11" ECU_ADDRESS 0x383BE4 /end MEASUREMENT
/begin MEASUREMENT B_bkpwm "" UWORD B_TRUE 1 100 0 1 BIT_MASK 0x40 FORMAT "%13.11" ECU_ADDRESS 0x383BE6 /end MEASUREMENT
/begin MEASUREMENT B_bkscr "Bedingung: CRAS-Signal" UWORD B_TRUE 1 100 0 1 BIT_MASK 0x40 FORMAT "%13.11" ECU_ADDRESS 0x383BEC /end MEASUREMENT
/begin MEASUREMENT B_bksgeep "Bedingung Ersatzwert aktiv: EEPROM-Diagnose" UWORD B_TRUE 1 100 0 1 BIT_MASK 0x40 FORMAT "%13.11" ECU_ADDRESS 0x383BEE /end MEASUREMENT
/begin MEASUREMENT B_bksls "Bedingung: Sekundärluftsystem aktiv" UWORD B_TRUE 1 100 0 1 BIT_MASK 0x40 FORMAT "%13.11" ECU_ADDRESS 0x383BF4 /end MEASUREMENT
/begin MEASUREMENT B_bkslv "Bedingung: Sekundärluftventil aktiv" UWORD B_TRUE 1 100 0 1 BIT_MASK 0x40 FORMAT "%13.11" ECU_ADDRESS 0x383BF6 /end MEASUREMENT
/begin MEASUREMENT B_bkswe "Bedingung Ersatzwert aktiv: Schlechtwegerkennung" UWORD B_TRUE 1 100 0 1 BIT_MASK 0x40 FORMAT "%13.11" ECU_ADDRESS 0x383BFA /end MEASUREMENT
/begin MEASUREMENT B_bkt2stc "" UWORD B_TRUE 1 100 0 1 BIT_MASK 0x40 FORMAT "%13.11" ECU_ADDRESS 0x383BFC /end MEASUREMENT
/begin MEASUREMENT B_bkta "Bedingung Ersatzwert für Ansauglufttemperatur (/Ladelufttemp.)" UWORD B_TRUE 1 100 0 1 BIT_MASK 0x40 FORMAT "%13.11" ECU_ADDRESS 0x383BFE /end MEASUREMENT
/begin MEASUREMENT B_bktankl "Bedingung: Tank leer" UWORD B_TRUE 1 100 0 1 BIT_MASK 0x40 FORMAT "%13.11" ECU_ADDRESS 0x383C00 /end MEASUREMENT
/begin MEASUREMENT B_bktes "Bedingung Ersatzwert aktiv Tankdiagnose Tankentlüftungsventil offen" UWORD B_TRUE 1 100 0 1 BIT_MASK 0x40 FORMAT "%13.11" ECU_ADDRESS 0x383C02 /end MEASUREMENT
/begin MEASUREMENT B_bktesf "Bedingung Ersatzwert aktiv Tankdiagnose Feinleck" UWORD B_TRUE 1 100 0 1 BIT_MASK 0x40 FORMAT "%13.11" ECU_ADDRESS 0x383C04 /end MEASUREMENT
/begin MEASUREMENT B_bktesg "Bedingung Ersatzwert aktiv Tankdiagnose Grobleck" UWORD B_TRUE 1 100 0 1 BIT_MASK 0x40 FORMAT "%13.11" ECU_ADDRESS 0x383C06 /end MEASUREMENT
/begin MEASUREMENT B_bkthm "Bedingung Ersatzwert für Thermostatfehler" UWORD B_TRUE 1 100 0 1 BIT_MASK 0x40 FORMAT "%13.11" ECU_ADDRESS 0x383C0C /end MEASUREMENT
/begin MEASUREMENT B_bktka "Bedingung Ersatzwert für Temperatur Kühlerausgang" UWORD B_TRUE 1 100 0 1 BIT_MASK 0x40 FORMAT "%13.11" ECU_ADDRESS 0x383C0E /end MEASUREMENT
/begin MEASUREMENT B_bktm "Bedingung Ersatzwert für Motortemperatur" UWORD B_TRUE 1 100 0 1 BIT_MASK 0x40 FORMAT "%13.11" ECU_ADDRESS 0x383C10 /end MEASUREMENT
/begin MEASUREMENT B_bktmki "Bedingung Ersatzwert für Motortemperatur aus Kombiinstrument" UWORD B_TRUE 1 100 0 1 BIT_MASK 0x40 FORMAT "%13.11" ECU_ADDRESS 0x383C12 /end MEASUREMENT
/begin MEASUREMENT B_bkub "Bedingung Ersatzwert für Batteriespannung (Bordnetz)" UWORD B_TRUE 1 100 0 1 BIT_MASK 0x40 FORMAT "%13.11" ECU_ADDRESS 0x383C18 /end MEASUREMENT
/begin MEASUREMENT B_bkubr "Bedingung Ersatzwert für Batteriespannung (Bordnetz)" UWORD B_TRUE 1 100 0 1 BIT_MASK 0x40 FORMAT "%13.11" ECU_ADDRESS 0x383C1A /end MEASUREMENT
/begin MEASUREMENT B_bkufmv "Bedingung: Funktionsüberwachung Momentanvergleich aktiv" UWORD B_TRUE 1 100 0 1 BIT_MASK 0x40 FORMAT "%13.11" ECU_ADDRESS 0x383C1C /end MEASUREMENT
/begin MEASUREMENT B_bkufska "Bedingung: Funktionsüberwachung: Sicherheits-Kraftstoff-Abschaltung aktiv" UWORD B_TRUE 1 100 0 1 BIT_MASK 0x40 FORMAT "%13.11" ECU_ADDRESS 0x383C1E /end MEASUREMENT
/begin MEASUREMENT B_bkurram "Bedingung: Rechnerüberwachung: RAM" UWORD B_TRUE 1 100 0 1 BIT_MASK 0x40 FORMAT "%13.11" ECU_ADDRESS 0x383C20 /end MEASUREMENT
/begin MEASUREMENT B_bkurrom "Bedingung: Rechnerüberwachung: ROM" UWORD B_TRUE 1 100 0 1 BIT_MASK 0x40 FORMAT "%13.11" ECU_ADDRESS 0x383C22 /end MEASUREMENT
/begin MEASUREMENT B_bkurrst "Bedingung: Rechnerüberwachung: RESET" UWORD B_TRUE 1 100 0 1 BIT_MASK 0x40 FORMAT "%13.11" ECU_ADDRESS 0x383C24 /end MEASUREMENT
/begin MEASUREMENT B_bkvfz "Bedingung Ersatzwert aktiv: Fahrzeuggeschwindigkeitssignal" UWORD B_TRUE 1 100 0 1 BIT_MASK 0x40 FORMAT "%13.11" ECU_ADDRESS 0x383C28 /end MEASUREMENT
/begin MEASUREMENT B_clbrems "Bedingung Fehlerpfad BREMS (Bremsschalter) löschen" UWORD B_TRUE 1 100 0 1 BIT_MASK 0x80 FORMAT "%13.11" ECU_ADDRESS 0x383B20 /end MEASUREMENT
/begin MEASUREMENT B_clbwf "Flag für Löschung: PWG Bewegung" UWORD B_TRUE 1 100 0 1 BIT_MASK 0x80 FORMAT "%13.11" ECU_ADDRESS 0x383B22 /end MEASUREMENT
/begin MEASUREMENT B_clcairp "Bedingung Fehlerpfad  cairp löschen" UWORD B_TRUE 1 100 0 1 BIT_MASK 0x80 FORMAT "%13.11" ECU_ADDRESS 0x383B26 /end MEASUREMENT
/begin MEASUREMENT B_cldpl "Bedingung Fehler Dauerplus löschen" UWORD B_TRUE 1 100 0 1 BIT_MASK 0x80 FORMAT "%13.11" ECU_ADDRESS 0x383B40 /end MEASUREMENT
/begin MEASUREMENT B_cldsbkv "Bedingung: Fehlerpfad Bremskraftverstärkerdrucksensor löschen" UWORD B_TRUE 1 100 0 1 BIT_MASK 0x80 FORMAT "%13.11" ECU_ADDRESS 0x383B42 /end MEASUREMENT
/begin MEASUREMENT B_cldsl "Bedingung: Fehlerpfad Ladedrucksensor löschen" UWORD B_TRUE 1 100 0 1 BIT_MASK 0x80 FORMAT "%13.11" ECU_ADDRESS 0x383B44 /end MEASUREMENT
/begin MEASUREMENT B_cldsu "Bedingung: Fehlerpfad Umgebungsdrucksensor löschen" UWORD B_TRUE 1 100 0 1 BIT_MASK 0x80 FORMAT "%13.11" ECU_ADDRESS 0x383B46 /end MEASUREMENT
/begin MEASUREMENT B_cldsvlu "Bedingung: Fehlerpfad Drucksensorvergleich DS-L DS-U" UWORD B_TRUE 1 100 0 1 BIT_MASK 0x80 FORMAT "%13.11" ECU_ADDRESS 0x383B48 /end MEASUREMENT
/begin MEASUREMENT B_clfp1p "Flag für Löschmaßnahmen: Fahrpedal 1. Poti" UWORD B_TRUE 1 100 0 1 BIT_MASK 0x80 FORMAT "%13.11" ECU_ADDRESS 0x383B72 /end MEASUREMENT
/begin MEASUREMENT B_clfp2p "Flag für Löschmaßnahmen: Fahrpedal 2. Poti" UWORD B_TRUE 1 100 0 1 BIT_MASK 0x80 FORMAT "%13.11" ECU_ADDRESS 0x383B74 /end MEASUREMENT
/begin MEASUREMENT B_clfpp "Bedingung Fehlerpfad FPP (Fahrpedal-Poti) löschen" UWORD B_TRUE 1 100 0 1 BIT_MASK 0x80 FORMAT "%13.11" ECU_ADDRESS 0x383B76 /end MEASUREMENT
/begin MEASUREMENT B_clgecod "Bedingung Fehlerpfad  gecod löschen" UWORD B_TRUE 1 100 0 1 BIT_MASK 0x80 FORMAT "%13.11" ECU_ADDRESS 0x383B7E /end MEASUREMENT
/begin MEASUREMENT B_clgrbh "Flag für Löschmaßnahmen: GRA-Bedienhebel" UWORD B_TRUE 1 100 0 1 BIT_MASK 0x80 FORMAT "%13.11" ECU_ADDRESS 0x383B80 /end MEASUREMENT
/begin MEASUREMENT B_clhla "" UWORD B_TRUE 1 100 0 1 BIT_MASK 0x80 FORMAT "%13.11" ECU_ADDRESS 0x383B82 /end MEASUREMENT
/begin MEASUREMENT B_clhre "Bedingung Fehlerpfad Hauptrelaisendstufe löschen" UWORD B_TRUE 1 100 0 1 BIT_MASK 0x80 FORMAT "%13.11" ECU_ADDRESS 0x383B84 /end MEASUREMENT
/begin MEASUREMENT B_cllash "Fehlerpfad in DLSAHK löschen." UWORD B_TRUE 1 100 0 1 BIT_MASK 0x80 FORMAT "%13.11" ECU_ADDRESS 0x383BB0 /end MEASUREMENT
/begin MEASUREMENT B_clldo "Bedingung: Fehlereintrag Überladefehler löschen" UWORD B_TRUE 1 100 0 1 BIT_MASK 0x80 FORMAT "%13.11" ECU_ADDRESS 0x383BB4 /end MEASUREMENT
/begin MEASUREMENT B_clldp "Bedingung: Fehlerpfad LDP löschen" UWORD B_TRUE 1 100 0 1 BIT_MASK 0x80 FORMAT "%13.11" ECU_ADDRESS 0x383BB6 /end MEASUREMENT
/begin MEASUREMENT B_clldra "Bedingung: Fehlereintrag LDR Regelabweichungsfehler löschen" UWORD B_TRUE 1 100 0 1 BIT_MASK 0x80 FORMAT "%13.11" ECU_ADDRESS 0x383BBA /end MEASUREMENT
/begin MEASUREMENT B_cllduv "Bedingung Fehlerpfad Schubumluftventil-Endstufe löschen" UWORD B_TRUE 1 100 0 1 BIT_MASK 0x80 FORMAT "%13.11" ECU_ADDRESS 0x383BBC /end MEASUREMENT
/begin MEASUREMENT B_cllkvdk "Bedingung Fehler Leck vor Drosselklappe  löschen" UWORD B_TRUE 1 100 0 1 BIT_MASK 0x80 FORMAT "%13.11" ECU_ADDRESS 0x383BBE /end MEASUREMENT
/begin MEASUREMENT B_clllr "Bedingung: Fehlerpfad Leerlaufregelung löschen" UWORD B_TRUE 1 100 0 1 BIT_MASK 0x80 FORMAT "%13.11" ECU_ADDRESS 0x383BC0 /end MEASUREMENT
/begin MEASUREMENT B_cllm "Bedingung: Fehlerpfad Hauptfüllungssensor löschen" UWORD B_TRUE 1 100 0 1 BIT_MASK 0x80 FORMAT "%13.11" ECU_ADDRESS 0x383BC2 /end MEASUREMENT
/begin MEASUREMENT B_cllsh "Fehlerpfad in DLSH löschen" UWORD B_TRUE 1 100 0 1 BIT_MASK 0x80 FORMAT "%13.11" ECU_ADDRESS 0x383BC4 /end MEASUREMENT
/begin MEASUREMENT B_cllsv "Fehlerpfad in DLSV löschen." UWORD B_TRUE 1 100 0 1 BIT_MASK 0x80 FORMAT "%13.11" ECU_ADDRESS 0x383BC6 /end MEASUREMENT
/begin MEASUREMENT B_clmd "Flag für Löschung: Aussetzer, Summenfehler (multiple)" UWORD B_TRUE 1 100 0 1 BIT_MASK 0x80 FORMAT "%13.11" ECU_ADDRESS 0x383BCC /end MEASUREMENT
/begin MEASUREMENT B_clmd00 "Flag für Löschung: Aussetzer Zündung 0" UWORD B_TRUE 1 100 0 1 BIT_MASK 0x80 FORMAT "%13.11" ECU_ADDRESS 0x383BCE /end MEASUREMENT
/begin MEASUREMENT B_clmd01 "Flag für Löschung: Aussetzer Zündung 1" UWORD B_TRUE 1 100 0 1 BIT_MASK 0x80 FORMAT "%13.11" ECU_ADDRESS 0x383BD0 /end MEASUREMENT
/begin MEASUREMENT B_clmd02 "Flag für Löschung: Aussetzer Zündung 2" UWORD B_TRUE 1 100 0 1 BIT_MASK 0x80 FORMAT "%13.11" ECU_ADDRESS 0x383BD2 /end MEASUREMENT
/begin MEASUREMENT B_clmd03 "Flag für Löschung: Aussetzer Zündung 3" UWORD B_TRUE 1 100 0 1 BIT_MASK 0x80 FORMAT "%13.11" ECU_ADDRESS 0x383BD4 /end MEASUREMENT
/begin MEASUREMENT B_clmfa "Bedingung Fehlerflag ""MIL-Fremdanforderung"" löschen" UWORD B_TRUE 1 100 0 1 BIT_MASK 0x80 FORMAT "%13.11" ECU_ADDRESS 0x383BD8 /end MEASUREMENT
/begin MEASUREMENT B_clnwkw "Bedingung Fehlerpfad Zuordnung Nockenwelle zu Kurbelwelle löschen" UWORD B_TRUE 1 100 0 1 BIT_MASK 0x80 FORMAT "%13.11" ECU_ADDRESS 0x383BDE /end MEASUREMENT
/begin MEASUREMENT B_clnx "Flag für Löschung: Überdrehzahl" UWORD B_TRUE 1 100 0 1 BIT_MASK 0x80 FORMAT "%13.11" ECU_ADDRESS 0x383BE2 /end MEASUREMENT
/begin MEASUREMENT B_clph "Bedingung Fehlerpfad PH löschen" UWORD B_TRUE 1 100 0 1 BIT_MASK 0x80 FORMAT "%13.11" ECU_ADDRESS 0x383BE4 /end MEASUREMENT
/begin MEASUREMENT B_clpwm "Bedingung Fehlerpfad PWM- Signal löschen" UWORD B_TRUE 1 100 0 1 BIT_MASK 0x80 FORMAT "%13.11" ECU_ADDRESS 0x383BE6 /end MEASUREMENT
/begin MEASUREMENT B_clscr "Bedingung CRAS-Signal löschen" UWORD B_TRUE 1 100 0 1 BIT_MASK 0x80 FORMAT "%13.11" ECU_ADDRESS 0x383BEC /end MEASUREMENT
/begin MEASUREMENT B_clsgeep "Bedingung Fehlerpfad DSGEEP löschen" UWORD B_TRUE 1 100 0 1 BIT_MASK 0x80 FORMAT "%13.11" ECU_ADDRESS 0x383BEE /end MEASUREMENT
/begin MEASUREMENT B_clsls "Bedingung: Fehler Sekundärluftsystem löschen" UWORD B_TRUE 1 100 0 1 BIT_MASK 0x80 FORMAT "%13.11" ECU_ADDRESS 0x383BF4 /end MEASUREMENT
/begin MEASUREMENT B_clslv "Bedingung: Fehler Sekundärluftventil löschen" UWORD B_TRUE 1 100 0 1 BIT_MASK 0x80 FORMAT "%13.11" ECU_ADDRESS 0x383BF6 /end MEASUREMENT
/begin MEASUREMENT B_clswe "Flag : Fehlerpfad Diagnose Beschleunigungssensor löschen" UWORD B_TRUE 1 100 0 1 BIT_MASK 0x80 FORMAT "%13.11" ECU_ADDRESS 0x383BFA /end MEASUREMENT
/begin MEASUREMENT B_clt2stc "" UWORD B_TRUE 1 100 0 1 BIT_MASK 0x80 FORMAT "%13.11" ECU_ADDRESS 0x383BFC /end MEASUREMENT
/begin MEASUREMENT B_clta "Bedingung Fehlerpfad Ansauglufttemperatur (/Ladeluft-) TANS löschen" UWORD B_TRUE 1 100 0 1 BIT_MASK 0x80 FORMAT "%13.11" ECU_ADDRESS 0x383BFE /end MEASUREMENT
/begin MEASUREMENT B_cltankl "Flag : Fehlerpfad DTANKL soll gelöscht werden" UWORD B_TRUE 1 100 0 1 BIT_MASK 0x80 FORMAT "%13.11" ECU_ADDRESS 0x383C00 /end MEASUREMENT
/begin MEASUREMENT B_cltes "Bedingung Fehlerflag ""Tankentlüftungssystem offen"" löschen" UWORD B_TRUE 1 100 0 1 BIT_MASK 0x80 FORMAT "%13.11" ECU_ADDRESS 0x383C02 /end MEASUREMENT
/begin MEASUREMENT B_cltesf "Bedingung Fehlerflag ""Feinleck"" löschen" UWORD B_TRUE 1 100 0 1 BIT_MASK 0x80 FORMAT "%13.11" ECU_ADDRESS 0x383C04 /end MEASUREMENT
/begin MEASUREMENT B_cltesg "Bedingung Fehlerflag ""Grobleckfehler"" löschen" UWORD B_TRUE 1 100 0 1 BIT_MASK 0x80 FORMAT "%13.11" ECU_ADDRESS 0x383C06 /end MEASUREMENT
/begin MEASUREMENT B_clthm "Bedingung Fehlerpfad Kühlwasserthermostat löschen" UWORD B_TRUE 1 100 0 1 BIT_MASK 0x80 FORMAT "%13.11" ECU_ADDRESS 0x383C0C /end MEASUREMENT
/begin MEASUREMENT B_cltka "Bedingung Fehlerpfad Temperatur Kühlerausgang TKA löschen" UWORD B_TRUE 1 100 0 1 BIT_MASK 0x80 FORMAT "%13.11" ECU_ADDRESS 0x383C0E /end MEASUREMENT
/begin MEASUREMENT B_cltm "Bedingung Fehlerpfad Motortemperatur TMOT löschen" UWORD B_TRUE 1 100 0 1 BIT_MASK 0x80 FORMAT "%13.11" ECU_ADDRESS 0x383C10 /end MEASUREMENT
/begin MEASUREMENT B_cltmki "Bedingung: Fehler Motortemperatur aus Kombiinstrument löschen" UWORD B_TRUE 1 100 0 1 BIT_MASK 0x80 FORMAT "%13.11" ECU_ADDRESS 0x383C12 /end MEASUREMENT
/begin MEASUREMENT B_club "Bedingung Fehlerpfad Batteriespannung (Bordnetz) löschen" UWORD B_TRUE 1 100 0 1 BIT_MASK 0x80 FORMAT "%13.11" ECU_ADDRESS 0x383C18 /end MEASUREMENT
/begin MEASUREMENT B_clubr "Bedingung Fehlerpfad Bordspannung über Hauptrelais löschen" UWORD B_TRUE 1 100 0 1 BIT_MASK 0x80 FORMAT "%13.11" ECU_ADDRESS 0x383C1A /end MEASUREMENT
/begin MEASUREMENT B_clufmv "Flag für Löschung: Funktionsüberwachung: Momentenvergleich" UWORD B_TRUE 1 100 0 1 BIT_MASK 0x80 FORMAT "%13.11" ECU_ADDRESS 0x383C1C /end MEASUREMENT
/begin MEASUREMENT B_clufska "Flag für Löschung: Funktionsüberwachung: Sicherheits-Kraftstoff-Abschaltung" UWORD B_TRUE 1 100 0 1 BIT_MASK 0x80 FORMAT "%13.11" ECU_ADDRESS 0x383C1E /end MEASUREMENT
/begin MEASUREMENT B_clurram "Flag für Löschung: Rechnerüberwachung: RAM" UWORD B_TRUE 1 100 0 1 BIT_MASK 0x80 FORMAT "%13.11" ECU_ADDRESS 0x383C20 /end MEASUREMENT
/begin MEASUREMENT B_clurrom "Flag für Löschung: Rechnerüberwachung: ROM" UWORD B_TRUE 1 100 0 1 BIT_MASK 0x80 FORMAT "%13.11" ECU_ADDRESS 0x383C22 /end MEASUREMENT
/begin MEASUREMENT B_clurrst "Flag für Löschung: Rechnerüberwachung: Reset" UWORD B_TRUE 1 100 0 1 BIT_MASK 0x80 FORMAT "%13.11" ECU_ADDRESS 0x383C24 /end MEASUREMENT
/begin MEASUREMENT B_clvfz "Bedingung Fehlerpfad VFZ (Fahrzeuggeschwindigkeit) löschen" UWORD B_TRUE 1 100 0 1 BIT_MASK 0x80 FORMAT "%13.11" ECU_ADDRESS 0x383C28 /end MEASUREMENT
/begin MEASUREMENT B_falash "" UWORD B_TRUE 1 100 0 1 BIT_MASK 0x10 FORMAT "%13.11" ECU_ADDRESS 0x383BB0 /end MEASUREMENT
/begin MEASUREMENT B_falm "" UWORD B_TRUE 1 100 0 1 BIT_MASK 0x10 FORMAT "%13.11" ECU_ADDRESS 0x383BC2 /end MEASUREMENT
/begin MEASUREMENT B_famfa "" UWORD B_TRUE 1 100 0 1 BIT_MASK 0x10 FORMAT "%13.11" ECU_ADDRESS 0x383BD8 /end MEASUREMENT
/begin MEASUREMENT B_ftbrems "Bedingung: Fehlereintrag durch Tester für Bremsschalter" UWORD B_TRUE 1 100 0 1 BIT_MASK 0x10 FORMAT "%13.11" ECU_ADDRESS 0x383B20 /end MEASUREMENT
/begin MEASUREMENT B_ftbwf "Bedingung Fehlereintrag durch Tester für Bewegungsfehler FPM" UWORD B_TRUE 1 100 0 1 BIT_MASK 0x10 FORMAT "%13.11" ECU_ADDRESS 0x383B22 /end MEASUREMENT
/begin MEASUREMENT B_ftcairp "Bedingung Fehlereintrag durch Tester : unpl. Airbag-Botschaft" UWORD B_TRUE 1 100 0 1 BIT_MASK 0x10 FORMAT "%13.11" ECU_ADDRESS 0x383B26 /end MEASUREMENT
/begin MEASUREMENT B_ftdpl "Bedingung Fehlereintrag durch Tester für Dauerplus Diagnose" UWORD B_TRUE 1 100 0 1 BIT_MASK 0x10 FORMAT "%13.11" ECU_ADDRESS 0x383B40 /end MEASUREMENT
/begin MEASUREMENT B_ftdsbkv "Bedingung: Fehlereintrag durch Tester für BKV" UWORD B_TRUE 1 100 0 1 BIT_MASK 0x10 FORMAT "%13.11" ECU_ADDRESS 0x383B42 /end MEASUREMENT
/begin MEASUREMENT B_ftdsl "Bedingung: Fehlereintrag durch Tester für DSL" UWORD B_TRUE 1 100 0 1 BIT_MASK 0x10 FORMAT "%13.11" ECU_ADDRESS 0x383B44 /end MEASUREMENT
/begin MEASUREMENT B_ftdsu "Bedingung: Fehlereintrag durch Tester für DSU" UWORD B_TRUE 1 100 0 1 BIT_MASK 0x10 FORMAT "%13.11" ECU_ADDRESS 0x383B46 /end MEASUREMENT
/begin MEASUREMENT B_ftdsvlu "Bedingung: Fehlereintrag durch Tester für DSVLU" UWORD B_TRUE 1 100 0 1 BIT_MASK 0x10 FORMAT "%13.11" ECU_ADDRESS 0x383B48 /end MEASUREMENT
/begin MEASUREMENT B_ftfp1p "Bedingung Fehlereintrag durch Tester für Poti1 FPM" UWORD B_TRUE 1 100 0 1 BIT_MASK 0x10 FORMAT "%13.11" ECU_ADDRESS 0x383B72 /end MEASUREMENT
/begin MEASUREMENT B_ftfp2p "Bedingung Fehlereintrag durch Tester für Poti2 FPM" UWORD B_TRUE 1 100 0 1 BIT_MASK 0x10 FORMAT "%13.11" ECU_ADDRESS 0x383B74 /end MEASUREMENT
/begin MEASUREMENT B_ftfpp "Bedingung Fehlereintrag durch Tester für FPM" UWORD B_TRUE 1 100 0 1 BIT_MASK 0x10 FORMAT "%13.11" ECU_ADDRESS 0x383B76 /end MEASUREMENT
/begin MEASUREMENT B_ftgecod "Bedingung Fehlereintrag durch Tester : Getriebecodierung CAN" UWORD B_TRUE 1 100 0 1 BIT_MASK 0x10 FORMAT "%13.11" ECU_ADDRESS 0x383B7E /end MEASUREMENT
/begin MEASUREMENT B_ftgrbh "Bedingung Fehlereintrag durch Tester für GRA-Bedienteil" UWORD B_TRUE 1 100 0 1 BIT_MASK 0x10 FORMAT "%13.11" ECU_ADDRESS 0x383B80 /end MEASUREMENT
/begin MEASUREMENT B_fthla "Bedingung: Fehlereintrag Gebergröße Heizleistungsanforderung" UWORD B_TRUE 1 100 0 1 BIT_MASK 0x10 FORMAT "%13.11" ECU_ADDRESS 0x383B82 /end MEASUREMENT
/begin MEASUREMENT B_fthre "Bedingung: Fehlereintrag durch Tester für Hauptrelais" UWORD B_TRUE 1 100 0 1 BIT_MASK 0x10 FORMAT "%13.11" ECU_ADDRESS 0x383B84 /end MEASUREMENT
/begin MEASUREMENT B_ftldo "Bedingung: Fehlereintrag durch Tester für LDO" UWORD B_TRUE 1 100 0 1 BIT_MASK 0x10 FORMAT "%13.11" ECU_ADDRESS 0x383BB4 /end MEASUREMENT
/begin MEASUREMENT B_ftldp "Bedingung Fehlereintrag durch Tester LDP" UWORD B_TRUE 1 100 0 1 BIT_MASK 0x10 FORMAT "%13.11" ECU_ADDRESS 0x383BB6 /end MEASUREMENT
/begin MEASUREMENT B_ftldra "Bedingung: Fehlereintrag durch Tester für LDRA" UWORD B_TRUE 1 100 0 1 BIT_MASK 0x10 FORMAT "%13.11" ECU_ADDRESS 0x383BBA /end MEASUREMENT
/begin MEASUREMENT B_ftlduv "Bedingung: Fehlereintrag durch Tester für DLDUV" UWORD B_TRUE 1 100 0 1 BIT_MASK 0x10 FORMAT "%13.11" ECU_ADDRESS 0x383BBC /end MEASUREMENT
/begin MEASUREMENT B_ftlkvdk "Bedingung: Fehlereintrag durch Leck vor Drosselklappe (Tester)" UWORD B_TRUE 1 100 0 1 BIT_MASK 0x10 FORMAT "%13.11" ECU_ADDRESS 0x383BBE /end MEASUREMENT
/begin MEASUREMENT B_ftllr "Bedingung: Fehlereintrag durch Tester für Leerlaufregelung" UWORD B_TRUE 1 100 0 1 BIT_MASK 0x10 FORMAT "%13.11" ECU_ADDRESS 0x383BC0 /end MEASUREMENT
/begin MEASUREMENT B_ftlsh "Bedingung Fehlereintrag durch Tester Lambda Sonde hinter KAT" UWORD B_TRUE 1 100 0 1 BIT_MASK 0x10 FORMAT "%13.11" ECU_ADDRESS 0x383BC4 /end MEASUREMENT
/begin MEASUREMENT B_ftlsv "Bedingung Fehlereintrag durch Tester Lambda Sonde vor KAT" UWORD B_TRUE 1 100 0 1 BIT_MASK 0x10 FORMAT "%13.11" ECU_ADDRESS 0x383BC6 /end MEASUREMENT
/begin MEASUREMENT B_ftmd "Bedingung: Fehlereintrag durch Tester für MD" UWORD B_TRUE 1 100 0 1 BIT_MASK 0x10 FORMAT "%13.11" ECU_ADDRESS 0x383BCC /end MEASUREMENT
/begin MEASUREMENT B_ftmd00 "Bedingung Fehlereintrag durch Tester" UWORD B_TRUE 1 100 0 1 BIT_MASK 0x10 FORMAT "%13.11" ECU_ADDRESS 0x383BCE /end MEASUREMENT
/begin MEASUREMENT B_ftmd01 "Bedingung Fehlereintrag durch Tester" UWORD B_TRUE 1 100 0 1 BIT_MASK 0x10 FORMAT "%13.11" ECU_ADDRESS 0x383BD0 /end MEASUREMENT
/begin MEASUREMENT B_ftmd02 "Bedingung Fehlereintrag durch Tester" UWORD B_TRUE 1 100 0 1 BIT_MASK 0x10 FORMAT "%13.11" ECU_ADDRESS 0x383BD2 /end MEASUREMENT
/begin MEASUREMENT B_ftmd03 "Bedingung Fehlereintrag durch Tester" UWORD B_TRUE 1 100 0 1 BIT_MASK 0x10 FORMAT "%13.11" ECU_ADDRESS 0x383BD4 /end MEASUREMENT
/begin MEASUREMENT B_ftnwkw "Bedingung Fehlereintrag durch Tester für Zuordnung Nockenwelle zu Kurbelwelle" UWORD B_TRUE 1 100 0 1 BIT_MASK 0x10 FORMAT "%13.11" ECU_ADDRESS 0x383BDE /end MEASUREMENT
/begin MEASUREMENT B_ftnx "Bedingung Fehlereintrag durch Tester für NMAX" UWORD B_TRUE 1 100 0 1 BIT_MASK 0x10 FORMAT "%13.11" ECU_ADDRESS 0x383BE2 /end MEASUREMENT
/begin MEASUREMENT B_ftph "Bedingung Fehlereintrag durch Tester für Phasensensor" UWORD B_TRUE 1 100 0 1 BIT_MASK 0x10 FORMAT "%13.11" ECU_ADDRESS 0x383BE4 /end MEASUREMENT
/begin MEASUREMENT B_ftpwm "" UWORD B_TRUE 1 100 0 1 BIT_MASK 0x10 FORMAT "%13.11" ECU_ADDRESS 0x383BE6 /end MEASUREMENT
/begin MEASUREMENT B_ftscr "Bedingung Fehlereintrag durch Tester : Crashabschaltung" UWORD B_TRUE 1 100 0 1 BIT_MASK 0x10 FORMAT "%13.11" ECU_ADDRESS 0x383BEC /end MEASUREMENT
/begin MEASUREMENT B_ftsgeep "Bedingung: Fehlereintrag durch Tester" UWORD B_TRUE 1 100 0 1 BIT_MASK 0x10 FORMAT "%13.11" ECU_ADDRESS 0x383BEE /end MEASUREMENT
/begin MEASUREMENT B_ftsls "Bedingung: Fehlereintrag durch Tester für Katheizen" UWORD B_TRUE 1 100 0 1 BIT_MASK 0x10 FORMAT "%13.11" ECU_ADDRESS 0x383BF4 /end MEASUREMENT
/begin MEASUREMENT B_ftslv "Bedingung: Fehlereintrag durch Tester für SLV" UWORD B_TRUE 1 100 0 1 BIT_MASK 0x10 FORMAT "%13.11" ECU_ADDRESS 0x383BF6 /end MEASUREMENT
/begin MEASUREMENT B_ftswe "Bedingung Fehlereintrag durch Tester:  Schlechtwegerkennung" UWORD B_TRUE 1 100 0 1 BIT_MASK 0x10 FORMAT "%13.11" ECU_ADDRESS 0x383BFA /end MEASUREMENT
/begin MEASUREMENT B_ftt2stc "" UWORD B_TRUE 1 100 0 1 BIT_MASK 0x10 FORMAT "%13.11" ECU_ADDRESS 0x383BFC /end MEASUREMENT
/begin MEASUREMENT B_ftta "Bedingung Fehlereintrag durch Tester Ansauglufttemperatur" UWORD B_TRUE 1 100 0 1 BIT_MASK 0x10 FORMAT "%13.11" ECU_ADDRESS 0x383BFE /end MEASUREMENT
/begin MEASUREMENT B_fttankl "Bedingung: Fehlereintrag TANKL durch Tester" UWORD B_TRUE 1 100 0 1 BIT_MASK 0x10 FORMAT "%13.11" ECU_ADDRESS 0x383C00 /end MEASUREMENT
/begin MEASUREMENT B_fttes "Bedingung Fehlereintrag durch Tester für TEV" UWORD B_TRUE 1 100 0 1 BIT_MASK 0x10 FORMAT "%13.11" ECU_ADDRESS 0x383C02 /end MEASUREMENT
/begin MEASUREMENT B_fttesf "Bedingung Fehlereintrag durch Tester TESF" UWORD B_TRUE 1 100 0 1 BIT_MASK 0x10 FORMAT "%13.11" ECU_ADDRESS 0x383C04 /end MEASUREMENT
/begin MEASUREMENT B_fttesg "Bedingung: Fehlereintrag durch Tester für Grobleck" UWORD B_TRUE 1 100 0 1 BIT_MASK 0x10 FORMAT "%13.11" ECU_ADDRESS 0x383C06 /end MEASUREMENT
/begin MEASUREMENT B_ftthm "Bedingung Fehlereintrag durch Tester Thermostat monitoring" UWORD B_TRUE 1 100 0 1 BIT_MASK 0x10 FORMAT "%13.11" ECU_ADDRESS 0x383C0C /end MEASUREMENT
/begin MEASUREMENT B_fttka "Bedingung Fehlereintrag durch Tester: TKA-Sensor" UWORD B_TRUE 1 100 0 1 BIT_MASK 0x10 FORMAT "%13.11" ECU_ADDRESS 0x383C0E /end MEASUREMENT
/begin MEASUREMENT B_fttm "Bedingung Fehlereintrag durch Tester für Motor-/Kühlmittel-Temperatur" UWORD B_TRUE 1 100 0 1 BIT_MASK 0x10 FORMAT "%13.11" ECU_ADDRESS 0x383C10 /end MEASUREMENT
/begin MEASUREMENT B_fttmki "Bedingung Fehlereintrag durch Tester Motortemperatur aus Kombiinstrument tmki" UWORD B_TRUE 1 100 0 1 BIT_MASK 0x10 FORMAT "%13.11" ECU_ADDRESS 0x383C12 /end MEASUREMENT
/begin MEASUREMENT B_ftub "Bedingung Fehlereintrag durch Tester für Batteriespannung (Bordnetz)" UWORD B_TRUE 1 100 0 1 BIT_MASK 0x10 FORMAT "%13.11" ECU_ADDRESS 0x383C18 /end MEASUREMENT
/begin MEASUREMENT B_ftubr "Bedingung Fehlereintrag durch Tester für Batteriespannung (Bordnetz)" UWORD B_TRUE 1 100 0 1 BIT_MASK 0x10 FORMAT "%13.11" ECU_ADDRESS 0x383C1A /end MEASUREMENT
/begin MEASUREMENT B_ftufmv "Bedingung: Fehlereintrag durch Tester: Momentvergleich" UWORD B_TRUE 1 100 0 1 BIT_MASK 0x10 FORMAT "%13.11" ECU_ADDRESS 0x383C1C /end MEASUREMENT
/begin MEASUREMENT B_ftufska "Bedingung: Fehlereintrag durch Tester:Sicherheits-Kraftstoff-Abschaltung" UWORD B_TRUE 1 100 0 1 BIT_MASK 0x10 FORMAT "%13.11" ECU_ADDRESS 0x383C1E /end MEASUREMENT
/begin MEASUREMENT B_fturram "" UWORD B_TRUE 1 100 0 1 BIT_MASK 0x10 FORMAT "%13.11" ECU_ADDRESS 0x383C20 /end MEASUREMENT
/begin MEASUREMENT B_fturrom "" UWORD B_TRUE 1 100 0 1 BIT_MASK 0x10 FORMAT "%13.11" ECU_ADDRESS 0x383C22 /end MEASUREMENT
/begin MEASUREMENT B_fturrst "" UWORD B_TRUE 1 100 0 1 BIT_MASK 0x10 FORMAT "%13.11" ECU_ADDRESS 0x383C24 /end MEASUREMENT
/begin MEASUREMENT B_ftvfz "Bedingung Fehlereintrag durch Tester für Fehlerpfad VFZ" UWORD B_TRUE 1 100 0 1 BIT_MASK 0x10 FORMAT "%13.11" ECU_ADDRESS 0x383C28 /end MEASUREMENT
/begin MEASUREMENT B_mnbrems "Fehlertyp BREMS (Bremssschalter): Minimalwert unterschritten" UWORD B_TRUE 1 100 0 1 BIT_MASK 0x200 FORMAT "%13.11" ECU_ADDRESS 0x383B20 /end MEASUREMENT
/begin MEASUREMENT B_mnbwf "Fehlertyp min.: PWG Bewegung" UWORD B_TRUE 1 100 0 1 BIT_MASK 0x200 FORMAT "%13.11" ECU_ADDRESS 0x383B22 /end MEASUREMENT
/begin MEASUREMENT B_mncairp "Fehlertyp min. : unpl. Airbag-Botschaft" UWORD B_TRUE 1 100 0 1 BIT_MASK 0x200 FORMAT "%13.11" ECU_ADDRESS 0x383B26 /end MEASUREMENT
/begin MEASUREMENT B_mndpl "Fehlertyp 'Dauerplus' erkannt" UWORD B_TRUE 1 100 0 1 BIT_MASK 0x200 FORMAT "%13.11" ECU_ADDRESS 0x383B40 /end MEASUREMENT
/begin MEASUREMENT B_mndsbkv "Bedingung: min. Fehler BKV-Drucksensor" UWORD B_TRUE 1 100 0 1 BIT_MASK 0x200 FORMAT "%13.11" ECU_ADDRESS 0x383B42 /end MEASUREMENT
/begin MEASUREMENT B_mndsl "Bedingung min. Fehler Ladedrucksensor" UWORD B_TRUE 1 100 0 1 BIT_MASK 0x200 FORMAT "%13.11" ECU_ADDRESS 0x383B44 /end MEASUREMENT
/begin MEASUREMENT B_mndsu "Bedingung: min-Fehler Umgebungsdrucksensor" UWORD B_TRUE 1 100 0 1 BIT_MASK 0x200 FORMAT "%13.11" ECU_ADDRESS 0x383B46 /end MEASUREMENT
/begin MEASUREMENT B_mndsvlu "Bedingung: min. Fehler Drucksensorsignalvergleich (DS-L DS-U)" UWORD B_TRUE 1 100 0 1 BIT_MASK 0x200 FORMAT "%13.11" ECU_ADDRESS 0x383B48 /end MEASUREMENT
/begin MEASUREMENT B_mnfp1p "Fehlertyp min.: Fahrpedal 1. Poti" UWORD B_TRUE 1 100 0 1 BIT_MASK 0x200 FORMAT "%13.11" ECU_ADDRESS 0x383B72 /end MEASUREMENT
/begin MEASUREMENT B_mnfp2p "Fehlertyp min.: Fahrpedal 2. Poti" UWORD B_TRUE 1 100 0 1 BIT_MASK 0x200 FORMAT "%13.11" ECU_ADDRESS 0x383B74 /end MEASUREMENT
/begin MEASUREMENT B_mnfpp "Fehlertyp min.: Fahrpedal Potentiometer" UWORD B_TRUE 1 100 0 1 BIT_MASK 0x200 FORMAT "%13.11" ECU_ADDRESS 0x383B76 /end MEASUREMENT
/begin MEASUREMENT B_mngecod "Fehlertyp: CVT-Getriebe falsch codiert" UWORD B_TRUE 1 100 0 1 BIT_MASK 0x200 FORMAT "%13.11" ECU_ADDRESS 0x383B7E /end MEASUREMENT
/begin MEASUREMENT B_mngrbh "Fehlertyp min.: GRA-Bedienhebel" UWORD B_TRUE 1 100 0 1 BIT_MASK 0x200 FORMAT "%13.11" ECU_ADDRESS 0x383B80 /end MEASUREMENT
/begin MEASUREMENT B_mnhla "Bedingung: Min-Fehler Gebergröße Heizleistungsanforderung" UWORD B_TRUE 1 100 0 1 BIT_MASK 0x200 FORMAT "%13.11" ECU_ADDRESS 0x383B82 /end MEASUREMENT
/begin MEASUREMENT B_mnhre "Bedingung für Fehlertyp 'Minimalwert' Hauptrelaisentstufe erkannt" UWORD B_TRUE 1 100 0 1 BIT_MASK 0x200 FORMAT "%13.11" ECU_ADDRESS 0x383B84 /end MEASUREMENT
/begin MEASUREMENT B_mnlash "Fehlertyp 'Minimalwert' für Schwingungsprüfung hinter KAT erkannt" UWORD B_TRUE 1 100 0 1 BIT_MASK 0x200 FORMAT "%13.11" ECU_ADDRESS 0x383BB0 /end MEASUREMENT
/begin MEASUREMENT B_mnldo "Bedingung MIN-Fehler Fehlerpfad ldo" UWORD B_TRUE 1 100 0 1 BIT_MASK 0x200 FORMAT "%13.11" ECU_ADDRESS 0x383BB4 /end MEASUREMENT
/begin MEASUREMENT B_mnldp "Fehlertyp 'Minimalwert' erkannt (Reed-Switch öffnet nicht)" UWORD B_TRUE 1 100 0 1 BIT_MASK 0x200 FORMAT "%13.11" ECU_ADDRESS 0x383BB6 /end MEASUREMENT
/begin MEASUREMENT B_mnldra "Bedingung MIN-Fehler Fehlerpfad ldra" UWORD B_TRUE 1 100 0 1 BIT_MASK 0x200 FORMAT "%13.11" ECU_ADDRESS 0x383BBA /end MEASUREMENT
/begin MEASUREMENT B_mnlduv "Fehlerart: Kurzschluß Masse an Schubumluftventil Endstufe" UWORD B_TRUE 1 100 0 1 BIT_MASK 0x200 FORMAT "%13.11" ECU_ADDRESS 0x383BBC /end MEASUREMENT
/begin MEASUREMENT B_mnlkvdk "Fehlerart: Leck vor Drosselklappe zu klein" UWORD B_TRUE 1 100 0 1 BIT_MASK 0x200 FORMAT "%13.11" ECU_ADDRESS 0x383BBE /end MEASUREMENT
/begin MEASUREMENT B_mnllr "Bedingung untere Plausibilitätsschwelle unterschritten Leerlaufregelung" UWORD B_TRUE 1 100 0 1 BIT_MASK 0x200 FORMAT "%13.11" ECU_ADDRESS 0x383BC0 /end MEASUREMENT
/begin MEASUREMENT B_mnlm "Bedingung: min-Fehler Hauptfüllungssensor" UWORD B_TRUE 1 100 0 1 BIT_MASK 0x200 FORMAT "%13.11" ECU_ADDRESS 0x383BC2 /end MEASUREMENT
/begin MEASUREMENT B_mnlsh "Fehlertyp 'Minimalwert' hinter KAT erkannt" UWORD B_TRUE 1 100 0 1 BIT_MASK 0x200 FORMAT "%13.11" ECU_ADDRESS 0x383BC4 /end MEASUREMENT
/begin MEASUREMENT B_mnlsv "Fehlertyp 'Minimalwert' vor KAT erkannt" UWORD B_TRUE 1 100 0 1 BIT_MASK 0x200 FORMAT "%13.11" ECU_ADDRESS 0x383BC6 /end MEASUREMENT
/begin MEASUREMENT B_mnmd "Fehlertyp min.: Aussetzer, Summenfehler (multiple)" UWORD B_TRUE 1 100 0 1 BIT_MASK 0x200 FORMAT "%13.11" ECU_ADDRESS 0x383BCC /end MEASUREMENT
/begin MEASUREMENT B_mnmd00 "Fehlertyp min.: Aussetzer Zündung 0" UWORD B_TRUE 1 100 0 1 BIT_MASK 0x200 FORMAT "%13.11" ECU_ADDRESS 0x383BCE /end MEASUREMENT
/begin MEASUREMENT B_mnmd01 "Fehlertyp min.: Aussetzer Zündung 1" UWORD B_TRUE 1 100 0 1 BIT_MASK 0x200 FORMAT "%13.11" ECU_ADDRESS 0x383BD0 /end MEASUREMENT
/begin MEASUREMENT B_mnmd02 "Fehlertyp min.: Aussetzer Zündung 2" UWORD B_TRUE 1 100 0 1 BIT_MASK 0x200 FORMAT "%13.11" ECU_ADDRESS 0x383BD2 /end MEASUREMENT
/begin MEASUREMENT B_mnmd03 "Fehlertyp min.: Aussetzer Zündung 3" UWORD B_TRUE 1 100 0 1 BIT_MASK 0x200 FORMAT "%13.11" ECU_ADDRESS 0x383BD4 /end MEASUREMENT
/begin MEASUREMENT B_mnmfa "Fehlertyp min.: MIL-fremdbestimmt" UWORD B_TRUE 1 100 0 1 BIT_MASK 0x200 FORMAT "%13.11" ECU_ADDRESS 0x383BD8 /end MEASUREMENT
/begin MEASUREMENT B_mnnwkw "Fehlerart: Nockenwelle spätverstellt" UWORD B_TRUE 1 100 0 1 BIT_MASK 0x200 FORMAT "%13.11" ECU_ADDRESS 0x383BDE /end MEASUREMENT
/begin MEASUREMENT B_mnnx "Fehlertyp min.: Überdrehzahl" UWORD B_TRUE 1 100 0 1 BIT_MASK 0x200 FORMAT "%13.11" ECU_ADDRESS 0x383BE2 /end MEASUREMENT
/begin MEASUREMENT B_mnph "Fehlerart: Kurzschluß Masse Phasengeber" UWORD B_TRUE 1 100 0 1 BIT_MASK 0x200 FORMAT "%13.11" ECU_ADDRESS 0x383BE4 /end MEASUREMENT
/begin MEASUREMENT B_mnpwm "PWM-Signal kleiner als Plausibilitätsschwelle" UWORD B_TRUE 1 100 0 1 BIT_MASK 0x200 FORMAT "%13.11" ECU_ADDRESS 0x383BE6 /end MEASUREMENT
/begin MEASUREMENT B_mnscr "Fehlertyp min.: CRAS-Signal" UWORD B_TRUE 1 100 0 1 BIT_MASK 0x200 FORMAT "%13.11" ECU_ADDRESS 0x383BEC /end MEASUREMENT
/begin MEASUREMENT B_mnsgeep "Bedingung: min-Fehler EEPROM-Diagnose" UWORD B_TRUE 1 100 0 1 BIT_MASK 0x200 FORMAT "%13.11" ECU_ADDRESS 0x383BEE /end MEASUREMENT
/begin MEASUREMENT B_mnsls "Fehlerart: Sekundärluftmasse zu gering" UWORD B_TRUE 1 100 0 1 BIT_MASK 0x200 FORMAT "%13.11" ECU_ADDRESS 0x383BF4 /end MEASUREMENT
/begin MEASUREMENT B_mnslv "Fehlerart:" UWORD B_TRUE 1 100 0 1 BIT_MASK 0x200 FORMAT "%13.11" ECU_ADDRESS 0x383BF6 /end MEASUREMENT
/begin MEASUREMENT B_mnswe "Beschleunigungssensorsignal kleiner als Plausibilitätsschwelle" UWORD B_TRUE 1 100 0 1 BIT_MASK 0x200 FORMAT "%13.11" ECU_ADDRESS 0x383BFA /end MEASUREMENT
/begin MEASUREMENT B_mnt2stc "" UWORD B_TRUE 1 100 0 1 BIT_MASK 0x200 FORMAT "%13.11" ECU_ADDRESS 0x383BFC /end MEASUREMENT
/begin MEASUREMENT B_mnta "Fehlertyp: Minimalwertunterschreitung Ansauglufttemperatur TANS" UWORD B_TRUE 1 100 0 1 BIT_MASK 0x200 FORMAT "%13.11" ECU_ADDRESS 0x383BFE /end MEASUREMENT
/begin MEASUREMENT B_mntankl "Fehlertyp min.: Tank leer" UWORD B_TRUE 1 100 0 1 BIT_MASK 0x200 FORMAT "%13.11" ECU_ADDRESS 0x383C00 /end MEASUREMENT
/begin MEASUREMENT B_mntes "Fehlertyp 'Minimalwert' erkannt" UWORD B_TRUE 1 100 0 1 BIT_MASK 0x200 FORMAT "%13.11" ECU_ADDRESS 0x383C02 /end MEASUREMENT
/begin MEASUREMENT B_mntesf "Fehlertyp 'Minimalwert' erkannt (Feinleck)" UWORD B_TRUE 1 100 0 1 BIT_MASK 0x200 FORMAT "%13.11" ECU_ADDRESS 0x383C04 /end MEASUREMENT
/begin MEASUREMENT B_mntesg "Fehlertyp 'Minimalwert' erkannt (Grobleck)" UWORD B_TRUE 1 100 0 1 BIT_MASK 0x200 FORMAT "%13.11" ECU_ADDRESS 0x383C06 /end MEASUREMENT
/begin MEASUREMENT B_mnthm "Fehlerart: MIN-Fehler Thermostatdiagnose" UWORD B_TRUE 1 100 0 1 BIT_MASK 0x200 FORMAT "%13.11" ECU_ADDRESS 0x383C0C /end MEASUREMENT
/begin MEASUREMENT B_mntka "Fehlertyp: Minimalwertunterschreitung Temperatur Kühlerausgang" UWORD B_TRUE 1 100 0 1 BIT_MASK 0x200 FORMAT "%13.11" ECU_ADDRESS 0x383C0E /end MEASUREMENT
/begin MEASUREMENT B_mntm "Fehlertyp: Minimalwertunterschreitung Motortemperatur" UWORD B_TRUE 1 100 0 1 BIT_MASK 0x200 FORMAT "%13.11" ECU_ADDRESS 0x383C10 /end MEASUREMENT
/begin MEASUREMENT B_mntmki "Bedingung: Min-Fehler Motortemperatur aus Kombiinstrument" UWORD B_TRUE 1 100 0 1 BIT_MASK 0x200 FORMAT "%13.11" ECU_ADDRESS 0x383C12 /end MEASUREMENT
/begin MEASUREMENT B_mnub "Fehlertyp: Minimalwertunterschreitung Batteriespannung (Bordnetz)" UWORD B_TRUE 1 100 0 1 BIT_MASK 0x200 FORMAT "%13.11" ECU_ADDRESS 0x383C18 /end MEASUREMENT
/begin MEASUREMENT B_mnubr "Fehlertyp: Minimalwertunterschreitung Bordnetzspannung über Hauptrelais" UWORD B_TRUE 1 100 0 1 BIT_MASK 0x200 FORMAT "%13.11" ECU_ADDRESS 0x383C1A /end MEASUREMENT
/begin MEASUREMENT B_mnufmv "Fehlertyp min.: Funktionsüberwachung: Momentenvergleich" UWORD B_TRUE 1 100 0 1 BIT_MASK 0x200 FORMAT "%13.11" ECU_ADDRESS 0x383C1C /end MEASUREMENT
/begin MEASUREMENT B_mnufska "Fehlertyp min.: Funktionsüberwachung: Sicherheits-Kraftstoff-Abschaltung" UWORD B_TRUE 1 100 0 1 BIT_MASK 0x200 FORMAT "%13.11" ECU_ADDRESS 0x383C1E /end MEASUREMENT
/begin MEASUREMENT B_mnurram "Fehlertyp min.: Rechnerüberwachung: RAM" UWORD B_TRUE 1 100 0 1 BIT_MASK 0x200 FORMAT "%13.11" ECU_ADDRESS 0x383C20 /end MEASUREMENT
/begin MEASUREMENT B_mnurrom "Fehlertyp min.: Rechnerüberwachung: ROM" UWORD B_TRUE 1 100 0 1 BIT_MASK 0x200 FORMAT "%13.11" ECU_ADDRESS 0x383C22 /end MEASUREMENT
/begin MEASUREMENT B_mnurrst "Fehlertyp min.: Rechnerüberwachung: Reset" UWORD B_TRUE 1 100 0 1 BIT_MASK 0x200 FORMAT "%13.11" ECU_ADDRESS 0x383C24 /end MEASUREMENT
/begin MEASUREMENT B_mnvfz "Fehlertyp min,: Fahrzeuggeschwindigkeit" UWORD B_TRUE 1 100 0 1 BIT_MASK 0x200 FORMAT "%13.11" ECU_ADDRESS 0x383C28 /end MEASUREMENT
/begin MEASUREMENT B_mxbrems "Fehlertyp BREMS (Bremsschalter): Maximalwert überschritten" UWORD B_TRUE 1 100 0 1 BIT_MASK 0x100 FORMAT "%13.11" ECU_ADDRESS 0x383B20 /end MEASUREMENT
/begin MEASUREMENT B_mxbwf "Fehlertyp max.: PWG Bewegung" UWORD B_TRUE 1 100 0 1 BIT_MASK 0x100 FORMAT "%13.11" ECU_ADDRESS 0x383B22 /end MEASUREMENT
/begin MEASUREMENT B_mxcairp "Fehlertyp max. : unpl. Airbag-Botschaft" UWORD B_TRUE 1 100 0 1 BIT_MASK 0x100 FORMAT "%13.11" ECU_ADDRESS 0x383B26 /end MEASUREMENT
/begin MEASUREMENT B_mxdpl "Fehlertyp 'Dauerplus' erkannt" UWORD B_TRUE 1 100 0 1 BIT_MASK 0x100 FORMAT "%13.11" ECU_ADDRESS 0x383B40 /end MEASUREMENT
/begin MEASUREMENT B_mxdsbkv "Bedingung: max. Fehler BKV-Drucksensor" UWORD B_TRUE 1 100 0 1 BIT_MASK 0x100 FORMAT "%13.11" ECU_ADDRESS 0x383B42 /end MEASUREMENT
/begin MEASUREMENT B_mxdsl "Bedingung max. Fehler Ladedrucksensor" UWORD B_TRUE 1 100 0 1 BIT_MASK 0x100 FORMAT "%13.11" ECU_ADDRESS 0x383B44 /end MEASUREMENT
/begin MEASUREMENT B_mxdsu "Bedingung: max-Fehler Umgebungsdrucksensor" UWORD B_TRUE 1 100 0 1 BIT_MASK 0x100 FORMAT "%13.11" ECU_ADDRESS 0x383B46 /end MEASUREMENT
/begin MEASUREMENT B_mxdsvlu "Fehlertyp 'Maximalwert' erkannt: Drucksensorsignalvergleich (DS-L DS-U)" UWORD B_TRUE 1 100 0 1 BIT_MASK 0x100 FORMAT "%13.11" ECU_ADDRESS 0x383B48 /end MEASUREMENT
/begin MEASUREMENT B_mxfp1p "Fehlertyp max.: Fahrpedal 1. Poti" UWORD B_TRUE 1 100 0 1 BIT_MASK 0x100 FORMAT "%13.11" ECU_ADDRESS 0x383B72 /end MEASUREMENT
/begin MEASUREMENT B_mxfp2p "Fehlertyp max.: Fahrpedal 2. Poti" UWORD B_TRUE 1 100 0 1 BIT_MASK 0x100 FORMAT "%13.11" ECU_ADDRESS 0x383B74 /end MEASUREMENT
/begin MEASUREMENT B_mxfpp "Fehlertyp max.: Fahrpedal Potentiometer" UWORD B_TRUE 1 100 0 1 BIT_MASK 0x100 FORMAT "%13.11" ECU_ADDRESS 0x383B76 /end MEASUREMENT
/begin MEASUREMENT B_mxgecod "Fehlertyp: AT-Getriebe falsch codiert" UWORD B_TRUE 1 100 0 1 BIT_MASK 0x100 FORMAT "%13.11" ECU_ADDRESS 0x383B7E /end MEASUREMENT
/begin MEASUREMENT B_mxgrbh "Fehlertyp max.: GRA-Bedienhebel" UWORD B_TRUE 1 100 0 1 BIT_MASK 0x100 FORMAT "%13.11" ECU_ADDRESS 0x383B80 /end MEASUREMENT
/begin MEASUREMENT B_mxhla "Bedingung: Max-Fehler Gebergröße Heizleistungsanforderung" UWORD B_TRUE 1 100 0 1 BIT_MASK 0x100 FORMAT "%13.11" ECU_ADDRESS 0x383B82 /end MEASUREMENT
/begin MEASUREMENT B_mxhre "Bedingung für Fehlertyp 'Maximalwert' Hauptrelaisentstufe erkannt" UWORD B_TRUE 1 100 0 1 BIT_MASK 0x100 FORMAT "%13.11" ECU_ADDRESS 0x383B84 /end MEASUREMENT
/begin MEASUREMENT B_mxlash "Fehlertyp 'Maximalwert' für Schwingungs-Prüfung hinter KAT erkannt" UWORD B_TRUE 1 100 0 1 BIT_MASK 0x100 FORMAT "%13.11" ECU_ADDRESS 0x383BB0 /end MEASUREMENT
/begin MEASUREMENT B_mxldo "Bedingung MAX-Fehler Fehlerpfad ldo" UWORD B_TRUE 1 100 0 1 BIT_MASK 0x100 FORMAT "%13.11" ECU_ADDRESS 0x383BB4 /end MEASUREMENT
/begin MEASUREMENT B_mxldp "Fehlertyp 'Maximalwert' erkannt (Reed-Switch nicht geschlossen)" UWORD B_TRUE 1 100 0 1 BIT_MASK 0x100 FORMAT "%13.11" ECU_ADDRESS 0x383BB6 /end MEASUREMENT
/begin MEASUREMENT B_mxldra "Bedingung Max-Fehler Fehlerpfad ldra" UWORD B_TRUE 1 100 0 1 BIT_MASK 0x100 FORMAT "%13.11" ECU_ADDRESS 0x383BBA /end MEASUREMENT
/begin MEASUREMENT B_mxlduv "Fehlerart: Kurzschluß Ubat an Schubumluftventil Endstufe" UWORD B_TRUE 1 100 0 1 BIT_MASK 0x100 FORMAT "%13.11" ECU_ADDRESS 0x383BBC /end MEASUREMENT
/begin MEASUREMENT B_mxlkvdk "Fehlerart: Leck vor Drosselklappe zu groß" UWORD B_TRUE 1 100 0 1 BIT_MASK 0x100 FORMAT "%13.11" ECU_ADDRESS 0x383BBE /end MEASUREMENT
/begin MEASUREMENT B_mxllr "Bedingung obere Plausibilitätsschwelle unterschritten Leerlaufregelung" UWORD B_TRUE 1 100 0 1 BIT_MASK 0x100 FORMAT "%13.11" ECU_ADDRESS 0x383BC0 /end MEASUREMENT
/begin MEASUREMENT B_mxlm "Bedingung: max-Fehler Hauptfüllungssensor" UWORD B_TRUE 1 100 0 1 BIT_MASK 0x100 FORMAT "%13.11" ECU_ADDRESS 0x383BC2 /end MEASUREMENT
/begin MEASUREMENT B_mxlsh "Fehlertyp 'Maximalwert' hinter KAT erkannt" UWORD B_TRUE 1 100 0 1 BIT_MASK 0x100 FORMAT "%13.11" ECU_ADDRESS 0x383BC4 /end MEASUREMENT
/begin MEASUREMENT B_mxlsv "Fehlertyp 'Maximalwert' vor KAT erkannt" UWORD B_TRUE 1 100 0 1 BIT_MASK 0x100 FORMAT "%13.11" ECU_ADDRESS 0x383BC6 /end MEASUREMENT
/begin MEASUREMENT B_mxmd "Fehlertyp max.: Aussetzer, Summenfehler (multiple)" UWORD B_TRUE 1 100 0 1 BIT_MASK 0x100 FORMAT "%13.11" ECU_ADDRESS 0x383BCC /end MEASUREMENT
/begin MEASUREMENT B_mxmd00 "Fehlertyp max.: Aussetzer Zündung 0" UWORD B_TRUE 1 100 0 1 BIT_MASK 0x100 FORMAT "%13.11" ECU_ADDRESS 0x383BCE /end MEASUREMENT
/begin MEASUREMENT B_mxmd01 "Fehlertyp max.: Aussetzer Zündung 1" UWORD B_TRUE 1 100 0 1 BIT_MASK 0x100 FORMAT "%13.11" ECU_ADDRESS 0x383BD0 /end MEASUREMENT
/begin MEASUREMENT B_mxmd02 "Fehlertyp max.: Aussetzer Zündung 2" UWORD B_TRUE 1 100 0 1 BIT_MASK 0x100 FORMAT "%13.11" ECU_ADDRESS 0x383BD2 /end MEASUREMENT
/begin MEASUREMENT B_mxmd03 "Fehlertyp max.: Aussetzer Zündung 3" UWORD B_TRUE 1 100 0 1 BIT_MASK 0x100 FORMAT "%13.11" ECU_ADDRESS 0x383BD4 /end MEASUREMENT
/begin MEASUREMENT B_mxmfa "Fehlertyp max.: MIL-fremdbestimmt" UWORD B_TRUE 1 100 0 1 BIT_MASK 0x100 FORMAT "%13.11" ECU_ADDRESS 0x383BD8 /end MEASUREMENT
/begin MEASUREMENT B_mxnwkw "Fehlerart: Nockenwelle frühverstellt" UWORD B_TRUE 1 100 0 1 BIT_MASK 0x100 FORMAT "%13.11" ECU_ADDRESS 0x383BDE /end MEASUREMENT
/begin MEASUREMENT B_mxnx "Fehlertyp max.: Überdrehzahl" UWORD B_TRUE 1 100 0 1 BIT_MASK 0x100 FORMAT "%13.11" ECU_ADDRESS 0x383BE2 /end MEASUREMENT
/begin MEASUREMENT B_mxph "Fehlerart: Kurzschluß Ubat Phasengeber" UWORD B_TRUE 1 100 0 1 BIT_MASK 0x100 FORMAT "%13.11" ECU_ADDRESS 0x383BE4 /end MEASUREMENT
/begin MEASUREMENT B_mxpwm "PWM-Signal größer als Plausibilitätsschwelle" UWORD B_TRUE 1 100 0 1 BIT_MASK 0x100 FORMAT "%13.11" ECU_ADDRESS 0x383BE6 /end MEASUREMENT
/begin MEASUREMENT B_mxscr "Bedingung max. Fehler Crash- Signal" UWORD B_TRUE 1 100 0 1 BIT_MASK 0x100 FORMAT "%13.11" ECU_ADDRESS 0x383BEC /end MEASUREMENT
/begin MEASUREMENT B_mxsgeep "Bedingung: max-Fehler EEPROM-Diagnose" UWORD B_TRUE 1 100 0 1 BIT_MASK 0x100 FORMAT "%13.11" ECU_ADDRESS 0x383BEE /end MEASUREMENT
/begin MEASUREMENT B_mxsls "Fehlerart:Sekundärluftsystem" UWORD B_TRUE 1 100 0 1 BIT_MASK 0x100 FORMAT "%13.11" ECU_ADDRESS 0x383BF4 /end MEASUREMENT
/begin MEASUREMENT B_mxslv "Fehlerart: Sekundärluftmasse bei Ventildichtheitsprüfung zu groß" UWORD B_TRUE 1 100 0 1 BIT_MASK 0x100 FORMAT "%13.11" ECU_ADDRESS 0x383BF6 /end MEASUREMENT
/begin MEASUREMENT B_mxswe "Beschleunigungssensorsignal größer als Plausibilitätsschwelle" UWORD B_TRUE 1 100 0 1 BIT_MASK 0x100 FORMAT "%13.11" ECU_ADDRESS 0x383BFA /end MEASUREMENT
/begin MEASUREMENT B_mxt2stc "" UWORD B_TRUE 1 100 0 1 BIT_MASK 0x100 FORMAT "%13.11" ECU_ADDRESS 0x383BFC /end MEASUREMENT
/begin MEASUREMENT B_mxta "Fehlertyp: Maximalwertüberschreitung Ansauglufttemperatur TANS" UWORD B_TRUE 1 100 0 1 BIT_MASK 0x100 FORMAT "%13.11" ECU_ADDRESS 0x383BFE /end MEASUREMENT
/begin MEASUREMENT B_mxtankl "Fehlertyp max.: Tank leer" UWORD B_TRUE 1 100 0 1 BIT_MASK 0x100 FORMAT "%13.11" ECU_ADDRESS 0x383C00 /end MEASUREMENT
/begin MEASUREMENT B_mxtes "Fehlertyp 'Maximalwert' erkannt (Tankentlüftungsventil)" UWORD B_TRUE 1 100 0 1 BIT_MASK 0x100 FORMAT "%13.11" ECU_ADDRESS 0x383C02 /end MEASUREMENT
/begin MEASUREMENT B_mxtesf "Fehlertyp 'Maximalwert' erkannt (Feinleck)" UWORD B_TRUE 1 100 0 1 BIT_MASK 0x100 FORMAT "%13.11" ECU_ADDRESS 0x383C04 /end MEASUREMENT
/begin MEASUREMENT B_mxtesg "Fehlertyp 'Maximalwert' erkannt (Grobleck)" UWORD B_TRUE 1 100 0 1 BIT_MASK 0x100 FORMAT "%13.11" ECU_ADDRESS 0x383C06 /end MEASUREMENT
/begin MEASUREMENT B_mxthm "Fehlerart: MAX-Fehler Thermostatdiagnose" UWORD B_TRUE 1 100 0 1 BIT_MASK 0x100 FORMAT "%13.11" ECU_ADDRESS 0x383C0C /end MEASUREMENT
/begin MEASUREMENT B_mxtka "Fehlertyp: Maximalwertüberschreitung Temperatur Kühlerausgang" UWORD B_TRUE 1 100 0 1 BIT_MASK 0x100 FORMAT "%13.11" ECU_ADDRESS 0x383C0E /end MEASUREMENT
/begin MEASUREMENT B_mxtm "Fehlertyp: Maximalwertüberschreitung Motortemperatur" UWORD B_TRUE 1 100 0 1 BIT_MASK 0x100 FORMAT "%13.11" ECU_ADDRESS 0x383C10 /end MEASUREMENT
/begin MEASUREMENT B_mxtmki "Bedingung: Max-Fehler Motortemperatur aus Kombiinstrument" UWORD B_TRUE 1 100 0 1 BIT_MASK 0x100 FORMAT "%13.11" ECU_ADDRESS 0x383C12 /end MEASUREMENT
/begin MEASUREMENT B_mxub "Fehlertyp: Maximalwertüberschreitung Batteriespannung (Bordnetz)" UWORD B_TRUE 1 100 0 1 BIT_MASK 0x100 FORMAT "%13.11" ECU_ADDRESS 0x383C18 /end MEASUREMENT
/begin MEASUREMENT B_mxubr "Fehlertyp: Maximalwertüberschreitung Bordnetzspannung über Hauptrelais" UWORD B_TRUE 1 100 0 1 BIT_MASK 0x100 FORMAT "%13.11" ECU_ADDRESS 0x383C1A /end MEASUREMENT
/begin MEASUREMENT B_mxufmv "Fehlertyp max.: Funktionsüberwachung: Momentenvergleich" UWORD B_TRUE 1 100 0 1 BIT_MASK 0x100 FORMAT "%13.11" ECU_ADDRESS 0x383C1C /end MEASUREMENT
/begin MEASUREMENT B_mxufska "Fehlertyp max.: Funktionsüberwachung: Sicherheits-Kraftstoff-Abschaltung" UWORD B_TRUE 1 100 0 1 BIT_MASK 0x100 FORMAT "%13.11" ECU_ADDRESS 0x383C1E /end MEASUREMENT
/begin MEASUREMENT B_mxurram "Fehlertyp max.: Rechnerüberwachung: RAM" UWORD B_TRUE 1 100 0 1 BIT_MASK 0x100 FORMAT "%13.11" ECU_ADDRESS 0x383C20 /end MEASUREMENT
/begin MEASUREMENT B_mxurrom "Fehlertyp max.: Rechnerüberwachung: ROM" UWORD B_TRUE 1 100 0 1 BIT_MASK 0x100 FORMAT "%13.11" ECU_ADDRESS 0x383C22 /end MEASUREMENT
/begin MEASUREMENT B_mxurrst "Fehlertyp max.: Rechnerüberwachung: Reset" UWORD B_TRUE 1 100 0 1 BIT_MASK 0x100 FORMAT "%13.11" ECU_ADDRESS 0x383C24 /end MEASUREMENT
/begin MEASUREMENT B_mxvfz "Fehlertyp max.: Fahrzeuggeschwindigkeit" UWORD B_TRUE 1 100 0 1 BIT_MASK 0x100 FORMAT "%13.11" ECU_ADDRESS 0x383C28 /end MEASUREMENT
/begin MEASUREMENT B_npbrems "Fehlertyp BREMS (Bremsschalter): Prüfresultat nicht plausibel" UWORD B_TRUE 1 100 0 1 BIT_MASK 0x800 FORMAT "%13.11" ECU_ADDRESS 0x383B20 /end MEASUREMENT
/begin MEASUREMENT B_npbwf "Fehlertyp unplaus.: PWG Bewegung" UWORD B_TRUE 1 100 0 1 BIT_MASK 0x800 FORMAT "%13.11" ECU_ADDRESS 0x383B22 /end MEASUREMENT
/begin MEASUREMENT B_npcairp "Fehlertyp : Airbag-Botschaft unplausibel" UWORD B_TRUE 1 100 0 1 BIT_MASK 0x800 FORMAT "%13.11" ECU_ADDRESS 0x383B26 /end MEASUREMENT
/begin MEASUREMENT B_npddpl "" UWORD B_TRUE 1 100 0 1 BIT_MASK 0x800 FORMAT "%13.11" ECU_ADDRESS 0x383B40 /end MEASUREMENT
/begin MEASUREMENT B_npdsbkv "Fehlertyp unplaus.: Bremskraftverstärler-Drucksensor" UWORD B_TRUE 1 100 0 1 BIT_MASK 0x800 FORMAT "%13.11" ECU_ADDRESS 0x383B42 /end MEASUREMENT
/begin MEASUREMENT B_npdsl "Bedingung: Ladedrucksensor nicht plausibel" UWORD B_TRUE 1 100 0 1 BIT_MASK 0x800 FORMAT "%13.11" ECU_ADDRESS 0x383B44 /end MEASUREMENT
/begin MEASUREMENT B_npdsu "Bedingung: Umgebungsdrucksensor nicht plausibel" UWORD B_TRUE 1 100 0 1 BIT_MASK 0x800 FORMAT "%13.11" ECU_ADDRESS 0x383B46 /end MEASUREMENT
/begin MEASUREMENT B_npdsvlu "Bedingung: Drucksensorsignalvergleich nicht plausibel (DS-L DS-U)" UWORD B_TRUE 1 100 0 1 BIT_MASK 0x800 FORMAT "%13.11" ECU_ADDRESS 0x383B48 /end MEASUREMENT
/begin MEASUREMENT B_npfp1p "Fehlertyp unplaus.: Fahrpedal 1. Poti" UWORD B_TRUE 1 100 0 1 BIT_MASK 0x800 FORMAT "%13.11" ECU_ADDRESS 0x383B72 /end MEASUREMENT
/begin MEASUREMENT B_npfp2p "Fehlertyp unplaus.: Fahrpedal 2. Poti" UWORD B_TRUE 1 100 0 1 BIT_MASK 0x800 FORMAT "%13.11" ECU_ADDRESS 0x383B74 /end MEASUREMENT
/begin MEASUREMENT B_npfpp "Bedingung unplausible Potisignale vom Fahrpedal" UWORD B_TRUE 1 100 0 1 BIT_MASK 0x800 FORMAT "%13.11" ECU_ADDRESS 0x383B76 /end MEASUREMENT
/begin MEASUREMENT B_npgecod "Fehlertyp: unplausible Getriebecodierung" UWORD B_TRUE 1 100 0 1 BIT_MASK 0x800 FORMAT "%13.11" ECU_ADDRESS 0x383B7E /end MEASUREMENT
/begin MEASUREMENT B_npgrbh "Fehlertyp unplaus.: GRA-Bedienhebel" UWORD B_TRUE 1 100 0 1 BIT_MASK 0x800 FORMAT "%13.11" ECU_ADDRESS 0x383B80 /end MEASUREMENT
/begin MEASUREMENT B_nphla "Bedingung: Unplausible Gebergröße Heizleistungsanforderung" UWORD B_TRUE 1 100 0 1 BIT_MASK 0x800 FORMAT "%13.11" ECU_ADDRESS 0x383B82 /end MEASUREMENT
/begin MEASUREMENT B_nphre "Fehler Hauptrelais NP" UWORD B_TRUE 1 100 0 1 BIT_MASK 0x800 FORMAT "%13.11" ECU_ADDRESS 0x383B84 /end MEASUREMENT
/begin MEASUREMENT B_nplash "Fehlertyp 'Wert unplausibel' für Schwingungs-Prüfung hinter KAT erkannt" UWORD B_TRUE 1 100 0 1 BIT_MASK 0x800 FORMAT "%13.11" ECU_ADDRESS 0x383BB0 /end MEASUREMENT
/begin MEASUREMENT B_npldo "Bedingung Plausfehler ldo" UWORD B_TRUE 1 100 0 1 BIT_MASK 0x800 FORMAT "%13.11" ECU_ADDRESS 0x383BB4 /end MEASUREMENT
/begin MEASUREMENT B_npldp "Fehlertyp 'unplausibles Prüfresultat' Reed Switch schliesst nicht" UWORD B_TRUE 1 100 0 1 BIT_MASK 0x800 FORMAT "%13.11" ECU_ADDRESS 0x383BB6 /end MEASUREMENT
/begin MEASUREMENT B_npldra "Bedingung Plausfehler LDRA" UWORD B_TRUE 1 100 0 1 BIT_MASK 0x800 FORMAT "%13.11" ECU_ADDRESS 0x383BBA /end MEASUREMENT
/begin MEASUREMENT B_nplduv "Fehlerart: Zustand nicht plausibel an Schubumluftventil-Endstufe" UWORD B_TRUE 1 100 0 1 BIT_MASK 0x800 FORMAT "%13.11" ECU_ADDRESS 0x383BBC /end MEASUREMENT
/begin MEASUREMENT B_nplkvdk "Fehlertyp: unplausible Leck vor Drosselklappe" UWORD B_TRUE 1 100 0 1 BIT_MASK 0x800 FORMAT "%13.11" ECU_ADDRESS 0x383BBE /end MEASUREMENT
/begin MEASUREMENT B_npllr "Fehlertyp 'unplausibles Prüfresultat erkannt Leerlaufregelung" UWORD B_TRUE 1 100 0 1 BIT_MASK 0x800 FORMAT "%13.11" ECU_ADDRESS 0x383BC0 /end MEASUREMENT
/begin MEASUREMENT B_nplm "Bedingung Plausfehler Hauptfüllungssensor" UWORD B_TRUE 1 100 0 1 BIT_MASK 0x800 FORMAT "%13.11" ECU_ADDRESS 0x383BC2 /end MEASUREMENT
/begin MEASUREMENT B_nplsh "Fehlertyp 'Wert unplausibel' hinter KAT erkannt" UWORD B_TRUE 1 100 0 1 BIT_MASK 0x800 FORMAT "%13.11" ECU_ADDRESS 0x383BC4 /end MEASUREMENT
/begin MEASUREMENT B_nplsv "Fehlertyp 'Wert unplausibel' erkannt" UWORD B_TRUE 1 100 0 1 BIT_MASK 0x800 FORMAT "%13.11" ECU_ADDRESS 0x383BC6 /end MEASUREMENT
/begin MEASUREMENT B_npmd "Fehlertyp unplaus.: Aussetzer, Summenfehler (multiple)" UWORD B_TRUE 1 100 0 1 BIT_MASK 0x800 FORMAT "%13.11" ECU_ADDRESS 0x383BCC /end MEASUREMENT
/begin MEASUREMENT B_npmd00 "Fehlertyp unplaus.: Aussetzer Zündung 0" UWORD B_TRUE 1 100 0 1 BIT_MASK 0x800 FORMAT "%13.11" ECU_ADDRESS 0x383BCE /end MEASUREMENT
/begin MEASUREMENT B_npmd01 "Fehlertyp unplaus.: Aussetzer Zündung 1" UWORD B_TRUE 1 100 0 1 BIT_MASK 0x800 FORMAT "%13.11" ECU_ADDRESS 0x383BD0 /end MEASUREMENT
/begin MEASUREMENT B_npmd02 "Fehlertyp unplaus.: Aussetzer Zündung 2" UWORD B_TRUE 1 100 0 1 BIT_MASK 0x800 FORMAT "%13.11" ECU_ADDRESS 0x383BD2 /end MEASUREMENT
/begin MEASUREMENT B_npmd03 "Fehlertyp unplaus.: Aussetzer Zündung 3" UWORD B_TRUE 1 100 0 1 BIT_MASK 0x800 FORMAT "%13.11" ECU_ADDRESS 0x383BD4 /end MEASUREMENT
/begin MEASUREMENT B_npmfa "Fehlerart: MIL angesteuert von anderem SG" UWORD B_TRUE 1 100 0 1 BIT_MASK 0x800 FORMAT "%13.11" ECU_ADDRESS 0x383BD8 /end MEASUREMENT
/begin MEASUREMENT B_npnwkw "Nicht plausibler Fehler: Zuordnung Nockenwelle zu Kurbelwelle" UWORD B_TRUE 1 100 0 1 BIT_MASK 0x800 FORMAT "%13.11" ECU_ADDRESS 0x383BDE /end MEASUREMENT
/begin MEASUREMENT B_npnx "Fehlertyp unplaus.: Überdrehzahl" UWORD B_TRUE 1 100 0 1 BIT_MASK 0x800 FORMAT "%13.11" ECU_ADDRESS 0x383BE2 /end MEASUREMENT
/begin MEASUREMENT B_npph "Bedingung Phasengebersignal ist unplausibel (ph)" UWORD B_TRUE 1 100 0 1 BIT_MASK 0x800 FORMAT "%13.11" ECU_ADDRESS 0x383BE4 /end MEASUREMENT
/begin MEASUREMENT B_nppwm "PWM-Signal ist nicht plausibel" UWORD B_TRUE 1 100 0 1 BIT_MASK 0x800 FORMAT "%13.11" ECU_ADDRESS 0x383BE6 /end MEASUREMENT
/begin MEASUREMENT B_npscr "Bedingung Crashsignal unplausibel" UWORD B_TRUE 1 100 0 1 BIT_MASK 0x800 FORMAT "%13.11" ECU_ADDRESS 0x383BEC /end MEASUREMENT
/begin MEASUREMENT B_npsgeep "Bedingung: npl-Fehler EEPROM-Diagnose" UWORD B_TRUE 1 100 0 1 BIT_MASK 0x800 FORMAT "%13.11" ECU_ADDRESS 0x383BEE /end MEASUREMENT
/begin MEASUREMENT B_npsls "Fehlerart: Offsetwert Sekundärluftmasse zu groß" UWORD B_TRUE 1 100 0 1 BIT_MASK 0x800 FORMAT "%13.11" ECU_ADDRESS 0x383BF4 /end MEASUREMENT
/begin MEASUREMENT B_npslv "Fehlerart: Offsetwert Sekundärluftmasse zu groß" UWORD B_TRUE 1 100 0 1 BIT_MASK 0x800 FORMAT "%13.11" ECU_ADDRESS 0x383BF6 /end MEASUREMENT
/begin MEASUREMENT B_npswe "Beschleunigungssensorsignal ist nicht plausibel" UWORD B_TRUE 1 100 0 1 BIT_MASK 0x800 FORMAT "%13.11" ECU_ADDRESS 0x383BFA /end MEASUREMENT
/begin MEASUREMENT B_npt2stc "" UWORD B_TRUE 1 100 0 1 BIT_MASK 0x800 FORMAT "%13.11" ECU_ADDRESS 0x383BFC /end MEASUREMENT
/begin MEASUREMENT B_npta "Fehlertyp unplaus.: Ansauglufttemperatur TANS (-Ladeluft)" UWORD B_TRUE 1 100 0 1 BIT_MASK 0x800 FORMAT "%13.11" ECU_ADDRESS 0x383BFE /end MEASUREMENT
/begin MEASUREMENT B_nptankl "Flag : nicht plausibles Prüfresultat bei DTANKL" UWORD B_TRUE 1 100 0 1 BIT_MASK 0x800 FORMAT "%13.11" ECU_ADDRESS 0x383C00 /end MEASUREMENT
/begin MEASUREMENT B_nptes "Fehlertyp 'unplausibles Prüfresultat' erkannt (TEV offen)" UWORD B_TRUE 1 100 0 1 BIT_MASK 0x800 FORMAT "%13.11" ECU_ADDRESS 0x383C02 /end MEASUREMENT
/begin MEASUREMENT B_nptesf "Fehlertyp 'unplausibles Prüfresultat' erkannt (Feinleck)" UWORD B_TRUE 1 100 0 1 BIT_MASK 0x800 FORMAT "%13.11" ECU_ADDRESS 0x383C04 /end MEASUREMENT
/begin MEASUREMENT B_nptesg "Fehlertyp 'unplausibles Prüfresultat' erkannt (Grobleck)" UWORD B_TRUE 1 100 0 1 BIT_MASK 0x800 FORMAT "%13.11" ECU_ADDRESS 0x383C06 /end MEASUREMENT
/begin MEASUREMENT B_npthm "Fehlerart: Motortemperatursignal nicht plausibel ggü. Thermostat-Modellierung" UWORD B_TRUE 1 100 0 1 BIT_MASK 0x800 FORMAT "%13.11" ECU_ADDRESS 0x383C0C /end MEASUREMENT
/begin MEASUREMENT B_nptka "Plausfehler TKA-Sensor" UWORD B_TRUE 1 100 0 1 BIT_MASK 0x800 FORMAT "%13.11" ECU_ADDRESS 0x383C0E /end MEASUREMENT
/begin MEASUREMENT B_nptm "Fehlerart: Motortemperatursignal nicht plausibel ggü. Modell" UWORD B_TRUE 1 100 0 1 BIT_MASK 0x800 FORMAT "%13.11" ECU_ADDRESS 0x383C10 /end MEASUREMENT
/begin MEASUREMENT B_nptmki "Bedingung: Unplausible Motortemperatur aus Kombiinstrument" UWORD B_TRUE 1 100 0 1 BIT_MASK 0x800 FORMAT "%13.11" ECU_ADDRESS 0x383C12 /end MEASUREMENT
/begin MEASUREMENT B_npub "Fehlerart: Batteriespannungssignal nicht plausibel" UWORD B_TRUE 1 100 0 1 BIT_MASK 0x800 FORMAT "%13.11" ECU_ADDRESS 0x383C18 /end MEASUREMENT
/begin MEASUREMENT B_npubr "Fehlerart: Signal von Bordspannung über Hauptrelais nicht plausibel" UWORD B_TRUE 1 100 0 1 BIT_MASK 0x800 FORMAT "%13.11" ECU_ADDRESS 0x383C1A /end MEASUREMENT
/begin MEASUREMENT B_npufmv "Fehlertyp unplaus.: Funktionsüberwachung: Momentenvergleich" UWORD B_TRUE 1 100 0 1 BIT_MASK 0x800 FORMAT "%13.11" ECU_ADDRESS 0x383C1C /end MEASUREMENT
/begin MEASUREMENT B_npufska "Fehlertyp unplaus.: Funktionsüberwachung: Sicherheits-Kraftstoff-Abschaltung" UWORD B_TRUE 1 100 0 1 BIT_MASK 0x800 FORMAT "%13.11" ECU_ADDRESS 0x383C1E /end MEASUREMENT
/begin MEASUREMENT B_npurram "Fehlertyp unplaus: Rechnerüberwachung: RAM" UWORD B_TRUE 1 100 0 1 BIT_MASK 0x800 FORMAT "%13.11" ECU_ADDRESS 0x383C20 /end MEASUREMENT
/begin MEASUREMENT B_npurrom "Fehlertyp unplaus.: Rechnerüberwachung: ROM" UWORD B_TRUE 1 100 0 1 BIT_MASK 0x800 FORMAT "%13.11" ECU_ADDRESS 0x383C22 /end MEASUREMENT
/begin MEASUREMENT B_npurrst "Fehlertyp unplaus: Rechnerüberwachung: Reset" UWORD B_TRUE 1 100 0 1 BIT_MASK 0x800 FORMAT "%13.11" ECU_ADDRESS 0x383C24 /end MEASUREMENT
/begin MEASUREMENT B_npvfz "Fehlerart: Fahrzeuggeschwindigkeit nicht plausibel" UWORD B_TRUE 1 100 0 1 BIT_MASK 0x800 FORMAT "%13.11" ECU_ADDRESS 0x383C28 /end MEASUREMENT
/begin MEASUREMENT B_pygecod "" UWORD B_TRUE 1 100 0 1 BIT_MASK 0x2000 FORMAT "%13.11" ECU_ADDRESS 0x383B7E /end MEASUREMENT
/begin MEASUREMENT B_pytes "Leckdiagnose ist physikalisch freigegeben" UWORD B_TRUE 1 100 0 1 BIT_MASK 0x2000 FORMAT "%13.11" ECU_ADDRESS 0x383C02 /end MEASUREMENT
/begin MEASUREMENT B_pytmki "" UWORD B_TRUE 1 100 0 1 BIT_MASK 0x2000 FORMAT "%13.11" ECU_ADDRESS 0x383C12 /end MEASUREMENT
/begin MEASUREMENT B_scgecod "" UWORD B_TRUE 1 100 0 1 BIT_MASK 0x4000 FORMAT "%13.11" ECU_ADDRESS 0x383B7E /end MEASUREMENT
/begin MEASUREMENT B_sctes "Leckdiagnose ist vom Scheduler freigegeben" UWORD B_TRUE 1 100 0 1 BIT_MASK 0x4000 FORMAT "%13.11" ECU_ADDRESS 0x383C02 /end MEASUREMENT
/begin MEASUREMENT B_sctmki "" UWORD B_TRUE 1 100 0 1 BIT_MASK 0x4000 FORMAT "%13.11" ECU_ADDRESS 0x383C12 /end MEASUREMENT
/begin MEASUREMENT B_sibrems "Fehlertyp BREMS (Bremsschalter): Signal inaktiv" UWORD B_TRUE 1 100 0 1 BIT_MASK 0x400 FORMAT "%13.11" ECU_ADDRESS 0x383B20 /end MEASUREMENT
/begin MEASUREMENT B_sibwf "Fehlertyp sig.: PWG Bewegung" UWORD B_TRUE 1 100 0 1 BIT_MASK 0x400 FORMAT "%13.11" ECU_ADDRESS 0x383B22 /end MEASUREMENT
/begin MEASUREMENT B_sicairp "Fehlertyp: Airbag-Botschaft unplausibel" UWORD B_TRUE 1 100 0 1 BIT_MASK 0x400 FORMAT "%13.11" ECU_ADDRESS 0x383B26 /end MEASUREMENT
/begin MEASUREMENT B_siddpl "" UWORD B_TRUE 1 100 0 1 BIT_MASK 0x400 FORMAT "%13.11" ECU_ADDRESS 0x383B40 /end MEASUREMENT
/begin MEASUREMENT B_sidsbkv "Fehlerart: Bremskraftverstärkersensor" UWORD B_TRUE 1 100 0 1 BIT_MASK 0x400 FORMAT "%13.11" ECU_ADDRESS 0x383B42 /end MEASUREMENT
/begin MEASUREMENT B_sidsl "Bedingung Signalfehler Ladedrucksensor" UWORD B_TRUE 1 100 0 1 BIT_MASK 0x400 FORMAT "%13.11" ECU_ADDRESS 0x383B44 /end MEASUREMENT
/begin MEASUREMENT B_sidsu "Fehlerart: Umgebungsdrucksensor" UWORD B_TRUE 1 100 0 1 BIT_MASK 0x400 FORMAT "%13.11" ECU_ADDRESS 0x383B46 /end MEASUREMENT
/begin MEASUREMENT B_sidsvlu "Fehlerart: Drucksensorsignalvergleich (DS-L DS-U)" UWORD B_TRUE 1 100 0 1 BIT_MASK 0x400 FORMAT "%13.11" ECU_ADDRESS 0x383B48 /end MEASUREMENT
/begin MEASUREMENT B_sifp1p "Fehlerart: Fahrpedal 1.Potentiometer" UWORD B_TRUE 1 100 0 1 BIT_MASK 0x400 FORMAT "%13.11" ECU_ADDRESS 0x383B72 /end MEASUREMENT
/begin MEASUREMENT B_sifp2p "Fehlerart: Fahrpedal 2.Potentiometer" UWORD B_TRUE 1 100 0 1 BIT_MASK 0x400 FORMAT "%13.11" ECU_ADDRESS 0x383B74 /end MEASUREMENT
/begin MEASUREMENT B_sifpp "Fehlerart: Fahrpedal Potentiometer" UWORD B_TRUE 1 100 0 1 BIT_MASK 0x400 FORMAT "%13.11" ECU_ADDRESS 0x383B76 /end MEASUREMENT
/begin MEASUREMENT B_sigecod "Fehlertyp sig. : Getriebecodierung CAN" UWORD B_TRUE 1 100 0 1 BIT_MASK 0x400 FORMAT "%13.11" ECU_ADDRESS 0x383B7E /end MEASUREMENT
/begin MEASUREMENT B_sigrbh "Fehlerart: GRA-Bedienhebel" UWORD B_TRUE 1 100 0 1 BIT_MASK 0x400 FORMAT "%13.11" ECU_ADDRESS 0x383B80 /end MEASUREMENT
/begin MEASUREMENT B_sihla "Bedingung: Signalfehler Gebergröße Heizleistungsanforderung" UWORD B_TRUE 1 100 0 1 BIT_MASK 0x400 FORMAT "%13.11" ECU_ADDRESS 0x383B82 /end MEASUREMENT
/begin MEASUREMENT B_sihre "Bedingung für Fehlertyp 'Signal fehlt' Hauptrelaisentstufe erkannt" UWORD B_TRUE 1 100 0 1 BIT_MASK 0x400 FORMAT "%13.11" ECU_ADDRESS 0x383B84 /end MEASUREMENT
/begin MEASUREMENT B_silash "Fehlertyp: Lambdasondenalterung hinter Kat." UWORD B_TRUE 1 100 0 1 BIT_MASK 0x400 FORMAT "%13.11" ECU_ADDRESS 0x383BB0 /end MEASUREMENT
/begin MEASUREMENT B_sildo "Bedingung Signal-Fehler Fehlerpfad ldo" UWORD B_TRUE 1 100 0 1 BIT_MASK 0x400 FORMAT "%13.11" ECU_ADDRESS 0x383BB4 /end MEASUREMENT
/begin MEASUREMENT B_sildp "Fehlertyp: Leckdiagnosemodul" UWORD B_TRUE 1 100 0 1 BIT_MASK 0x400 FORMAT "%13.11" ECU_ADDRESS 0x383BB6 /end MEASUREMENT
/begin MEASUREMENT B_sildra "Bedingung Signal-Fehler Fehlerpfad LDRA" UWORD B_TRUE 1 100 0 1 BIT_MASK 0x400 FORMAT "%13.11" ECU_ADDRESS 0x383BBA /end MEASUREMENT
/begin MEASUREMENT B_silduv "Fehlerart: Unterbrechung an Schubumluftventil-Endstufe" UWORD B_TRUE 1 100 0 1 BIT_MASK 0x400 FORMAT "%13.11" ECU_ADDRESS 0x383BBC /end MEASUREMENT
/begin MEASUREMENT B_silkvdk "Bedingung Signalfehler Leck vor Drosselklappe" UWORD B_TRUE 1 100 0 1 BIT_MASK 0x400 FORMAT "%13.11" ECU_ADDRESS 0x383BBE /end MEASUREMENT
/begin MEASUREMENT B_sillr "Fehlerart: Leerlaufregelung" UWORD B_TRUE 1 100 0 1 BIT_MASK 0x400 FORMAT "%13.11" ECU_ADDRESS 0x383BC0 /end MEASUREMENT
/begin MEASUREMENT B_silm "Bedingung Signalfehler Hauptfüllungssensor" UWORD B_TRUE 1 100 0 1 BIT_MASK 0x400 FORMAT "%13.11" ECU_ADDRESS 0x383BC2 /end MEASUREMENT
/begin MEASUREMENT B_silsh "Fehlertyp 'Signal fehlt' hinter KAT erkannt" UWORD B_TRUE 1 100 0 1 BIT_MASK 0x400 FORMAT "%13.11" ECU_ADDRESS 0x383BC4 /end MEASUREMENT
/begin MEASUREMENT B_silsv "Fehlertyp 'Signal fehlt' vor KAT erkannt" UWORD B_TRUE 1 100 0 1 BIT_MASK 0x400 FORMAT "%13.11" ECU_ADDRESS 0x383BC6 /end MEASUREMENT
/begin MEASUREMENT B_simd "Fehlertyp sig.: Aussetzer, Summenfehler (multiple)" UWORD B_TRUE 1 100 0 1 BIT_MASK 0x400 FORMAT "%13.11" ECU_ADDRESS 0x383BCC /end MEASUREMENT
/begin MEASUREMENT B_simd00 "Fehlertyp sig.: Aussetzer Zündung 0" UWORD B_TRUE 1 100 0 1 BIT_MASK 0x400 FORMAT "%13.11" ECU_ADDRESS 0x383BCE /end MEASUREMENT
/begin MEASUREMENT B_simd01 "Fehlertyp sig.: Aussetzer Zündung 1" UWORD B_TRUE 1 100 0 1 BIT_MASK 0x400 FORMAT "%13.11" ECU_ADDRESS 0x383BD0 /end MEASUREMENT
/begin MEASUREMENT B_simd02 "Fehlertyp sig.: Aussetzer Zündung 2" UWORD B_TRUE 1 100 0 1 BIT_MASK 0x400 FORMAT "%13.11" ECU_ADDRESS 0x383BD2 /end MEASUREMENT
/begin MEASUREMENT B_simd03 "Fehlertyp sig.: Aussetzer Zündung 3" UWORD B_TRUE 1 100 0 1 BIT_MASK 0x400 FORMAT "%13.11" ECU_ADDRESS 0x383BD4 /end MEASUREMENT
/begin MEASUREMENT B_simfa "Fehlertyp sig.: MIL-fremdbestimmt" UWORD B_TRUE 1 100 0 1 BIT_MASK 0x400 FORMAT "%13.11" ECU_ADDRESS 0x383BD8 /end MEASUREMENT
/begin MEASUREMENT B_sinwkw "Fehlertyp: Zuordnung Nockenwelle zu Kurbelwelle" UWORD B_TRUE 1 100 0 1 BIT_MASK 0x400 FORMAT "%13.11" ECU_ADDRESS 0x383BDE /end MEASUREMENT
/begin MEASUREMENT B_sinx "Fehlertyp sig.: Überdrehzahl" UWORD B_TRUE 1 100 0 1 BIT_MASK 0x400 FORMAT "%13.11" ECU_ADDRESS 0x383BE2 /end MEASUREMENT
/begin MEASUREMENT B_siph "Bedingung keine alternierende Phasenpegel PG in den Bezugsmarken" UWORD B_TRUE 1 100 0 1 BIT_MASK 0x400 FORMAT "%13.11" ECU_ADDRESS 0x383BE4 /end MEASUREMENT
/begin MEASUREMENT B_sipwm "" UWORD B_TRUE 1 100 0 1 BIT_MASK 0x400 FORMAT "%13.11" ECU_ADDRESS 0x383BE6 /end MEASUREMENT
/begin MEASUREMENT B_siscr "Fehlerart:CRAS-Signal" UWORD B_TRUE 1 100 0 1 BIT_MASK 0x400 FORMAT "%13.11" ECU_ADDRESS 0x383BEC /end MEASUREMENT
/begin MEASUREMENT B_sisgeep "Bedingung: sig-Fehler EEPROM-Diagnose" UWORD B_TRUE 1 100 0 1 BIT_MASK 0x400 FORMAT "%13.11" ECU_ADDRESS 0x383BEE /end MEASUREMENT
/begin MEASUREMENT B_sisls "Fehlertype: Sekundärluftsystem" UWORD B_TRUE 1 100 0 1 BIT_MASK 0x400 FORMAT "%13.11" ECU_ADDRESS 0x383BF4 /end MEASUREMENT
/begin MEASUREMENT B_sislv "Fehlertyp: Sekundärluftventil" UWORD B_TRUE 1 100 0 1 BIT_MASK 0x400 FORMAT "%13.11" ECU_ADDRESS 0x383BF6 /end MEASUREMENT
/begin MEASUREMENT B_siswe "Fehlertyp: Geschwindigkeitssignal nicht vorhanden" UWORD B_TRUE 1 100 0 1 BIT_MASK 0x400 FORMAT "%13.11" ECU_ADDRESS 0x383BFA /end MEASUREMENT
/begin MEASUREMENT B_sit2stc "" UWORD B_TRUE 1 100 0 1 BIT_MASK 0x400 FORMAT "%13.11" ECU_ADDRESS 0x383BFC /end MEASUREMENT
/begin MEASUREMENT B_sita "Fehlertyp: Ansauglufttemperatur TANS (-Ladeluft)" UWORD B_TRUE 1 100 0 1 BIT_MASK 0x400 FORMAT "%13.11" ECU_ADDRESS 0x383BFE /end MEASUREMENT
/begin MEASUREMENT B_sitankl "Fehlertyp: Tank leer" UWORD B_TRUE 1 100 0 1 BIT_MASK 0x400 FORMAT "%13.11" ECU_ADDRESS 0x383C00 /end MEASUREMENT
/begin MEASUREMENT B_sites "Fehlerart: TEV offen" UWORD B_TRUE 1 100 0 1 BIT_MASK 0x400 FORMAT "%13.11" ECU_ADDRESS 0x383C02 /end MEASUREMENT
/begin MEASUREMENT B_sitesf "Fehlerart: Feinleck" UWORD B_TRUE 1 100 0 1 BIT_MASK 0x400 FORMAT "%13.11" ECU_ADDRESS 0x383C04 /end MEASUREMENT
/begin MEASUREMENT B_sitesg "Fehlerart: Grobleck" UWORD B_TRUE 1 100 0 1 BIT_MASK 0x400 FORMAT "%13.11" ECU_ADDRESS 0x383C06 /end MEASUREMENT
/begin MEASUREMENT B_sithm "Fehlerart: Signalfehler Thermostatdiagnose" UWORD B_TRUE 1 100 0 1 BIT_MASK 0x400 FORMAT "%13.11" ECU_ADDRESS 0x383C0C /end MEASUREMENT
/begin MEASUREMENT B_sitka "Signalfehler TKA-Sensor" UWORD B_TRUE 1 100 0 1 BIT_MASK 0x400 FORMAT "%13.11" ECU_ADDRESS 0x383C0E /end MEASUREMENT
/begin MEASUREMENT B_sitm "Fehlerart: Motortemperaturschwelle für Lambdaregelungsfreigabe nicht erreicht" UWORD B_TRUE 1 100 0 1 BIT_MASK 0x400 FORMAT "%13.11" ECU_ADDRESS 0x383C10 /end MEASUREMENT
/begin MEASUREMENT B_sitmki "Signalfehler Kühlmitteltemperatur vom Kombiinstrument" UWORD B_TRUE 1 100 0 1 BIT_MASK 0x400 FORMAT "%13.11" ECU_ADDRESS 0x383C12 /end MEASUREMENT
/begin MEASUREMENT B_siub "Fehlertyp: Umweltbedingungen" UWORD B_TRUE 1 100 0 1 BIT_MASK 0x400 FORMAT "%13.11" ECU_ADDRESS 0x383C18 /end MEASUREMENT
/begin MEASUREMENT B_siubr "Fehlerart: Signalfehler Leitungsabfall Bordnetzspannung über Hauptrelais" UWORD B_TRUE 1 100 0 1 BIT_MASK 0x400 FORMAT "%13.11" ECU_ADDRESS 0x383C1A /end MEASUREMENT
/begin MEASUREMENT B_siufmv "Fehlertyp sig.: Funktionsüberwachung: Momentenvergleich" UWORD B_TRUE 1 100 0 1 BIT_MASK 0x400 FORMAT "%13.11" ECU_ADDRESS 0x383C1C /end MEASUREMENT
/begin MEASUREMENT B_siufska "Fehlertyp sig.: Funktionsüberwachung: Sicherheits-Kraftstoff-Abschaltung" UWORD B_TRUE 1 100 0 1 BIT_MASK 0x400 FORMAT "%13.11" ECU_ADDRESS 0x383C1E /end MEASUREMENT
/begin MEASUREMENT B_siurram "Fehlertyp sig.: Rechnerüberwachung: RAM" UWORD B_TRUE 1 100 0 1 BIT_MASK 0x400 FORMAT "%13.11" ECU_ADDRESS 0x383C20 /end MEASUREMENT
/begin MEASUREMENT B_siurrom "Fehlertyp sig.: Rechnerüberwachung: ROM" UWORD B_TRUE 1 100 0 1 BIT_MASK 0x400 FORMAT "%13.11" ECU_ADDRESS 0x383C22 /end MEASUREMENT
/begin MEASUREMENT B_siurrst "Fehlertyp sig.: Rechnerüberwachung: Reset" UWORD B_TRUE 1 100 0 1 BIT_MASK 0x400 FORMAT "%13.11" ECU_ADDRESS 0x383C24 /end MEASUREMENT
/begin MEASUREMENT B_sivfz "Bedingung fehlendes Signal Fahrzeuggeschwindigkeit" UWORD B_TRUE 1 100 0 1 BIT_MASK 0x400 FORMAT "%13.11" ECU_ADDRESS 0x383C28 /end MEASUREMENT
/begin MEASUREMENT E_agrf "Errorflag: Überwachung AGR-FLOW" UWORD B_TRUE 1 100 0 1 BIT_MASK 0x1 FORMAT "%13.11" ECU_ADDRESS 0x383B0C /end MEASUREMENT
/begin MEASUREMENT E_brems "Fehlerflag: BREMS (Bremsschalter)" UWORD B_TRUE 1 100 0 1 BIT_MASK 0x1 FORMAT "%13.11" ECU_ADDRESS 0x383B20 /end MEASUREMENT
/begin MEASUREMENT E_bwf "Errorflag: PWG Bewegung" UWORD B_TRUE 1 100 0 1 BIT_MASK 0x1 FORMAT "%13.11" ECU_ADDRESS 0x383B22 /end MEASUREMENT
/begin MEASUREMENT E_cairp "Fehlerflag : Airbag-Botschaft unplausibel" UWORD B_TRUE 1 100 0 1 BIT_MASK 0x1 FORMAT "%13.11" ECU_ADDRESS 0x383B26 /end MEASUREMENT
/begin MEASUREMENT E_dkvm "Errorflag: Drosselklappenverschmutzung" UWORD B_TRUE 1 100 0 1 BIT_MASK 0x1 FORMAT "%13.11" ECU_ADDRESS 0x383B3E /end MEASUREMENT
/begin MEASUREMENT E_dpl "Errorflag: Dauerplus" UWORD B_TRUE 1 100 0 1 BIT_MASK 0x1 FORMAT "%13.11" ECU_ADDRESS 0x383B40 /end MEASUREMENT
/begin MEASUREMENT E_dsbkv "Errorflag: Bremskraftverstärker-Drucksensor" UWORD B_TRUE 1 100 0 1 BIT_MASK 0x1 FORMAT "%13.11" ECU_ADDRESS 0x383B42 /end MEASUREMENT
/begin MEASUREMENT E_dsl "Errorflag: Drucksensor Ladedruck" UWORD B_TRUE 1 100 0 1 BIT_MASK 0x1 FORMAT "%13.11" ECU_ADDRESS 0x383B44 /end MEASUREMENT
/begin MEASUREMENT E_dsu "Errorflag: Umgebungsdrucksensor" UWORD B_TRUE 1 100 0 1 BIT_MASK 0x1 FORMAT "%13.11" ECU_ADDRESS 0x383B46 /end MEASUREMENT
/begin MEASUREMENT E_dsvlu "Errorflag: Drucksensorsignalvergleich (DS-L DS-U)" UWORD B_TRUE 1 100 0 1 BIT_MASK 0x1 FORMAT "%13.11" ECU_ADDRESS 0x383B48 /end MEASUREMENT
/begin MEASUREMENT E_fp1p "Errorflag: Fahrpedal 1. Poti" UWORD B_TRUE 1 100 0 1 BIT_MASK 0x1 FORMAT "%13.11" ECU_ADDRESS 0x383B72 /end MEASUREMENT
/begin MEASUREMENT E_fp2p "Errorflag: Fahrpedal 2. Poti" UWORD B_TRUE 1 100 0 1 BIT_MASK 0x1 FORMAT "%13.11" ECU_ADDRESS 0x383B74 /end MEASUREMENT
/begin MEASUREMENT E_fpp "Errorflag Fahrpedal-Poti" UWORD B_TRUE 1 100 0 1 BIT_MASK 0x1 FORMAT "%13.11" ECU_ADDRESS 0x383B76 /end MEASUREMENT
/begin MEASUREMENT E_gecod "Errorflag: Getriebe-Codierung" UWORD B_TRUE 1 100 0 1 BIT_MASK 0x1 FORMAT "%13.11" ECU_ADDRESS 0x383B7E /end MEASUREMENT
/begin MEASUREMENT E_grbh "Errorflag: GRA Bedienhebel" UWORD B_TRUE 1 100 0 1 BIT_MASK 0x1 FORMAT "%13.11" ECU_ADDRESS 0x383B80 /end MEASUREMENT
/begin MEASUREMENT E_hla "Errorflag: Heizleistungsanforderung" UWORD B_TRUE 1 100 0 1 BIT_MASK 0x1 FORMAT "%13.11" ECU_ADDRESS 0x383B82 /end MEASUREMENT
/begin MEASUREMENT E_hre "Errorflag: Hauptrelaisentstufe" UWORD B_TRUE 1 100 0 1 BIT_MASK 0x1 FORMAT "%13.11" ECU_ADDRESS 0x383B84 /end MEASUREMENT
/begin MEASUREMENT E_lash "Errorflag: Lambda-Sondenalterung hinter Katalysator" UWORD B_TRUE 1 100 0 1 BIT_MASK 0x1 FORMAT "%13.11" ECU_ADDRESS 0x383BB0 /end MEASUREMENT
/begin MEASUREMENT E_ldo "Errorflag: Ladedruckkennlinie; oberer Wert überschritten" UWORD B_TRUE 1 100 0 1 BIT_MASK 0x1 FORMAT "%13.11" ECU_ADDRESS 0x383BB4 /end MEASUREMENT
/begin MEASUREMENT E_ldp "Errorflag: Leckdiagnosemodul" UWORD B_TRUE 1 100 0 1 BIT_MASK 0x1 FORMAT "%13.11" ECU_ADDRESS 0x383BB6 /end MEASUREMENT
/begin MEASUREMENT E_ldra "Errorflag: Ladedruckregelabweichung" UWORD B_TRUE 1 100 0 1 BIT_MASK 0x1 FORMAT "%13.11" ECU_ADDRESS 0x383BBA /end MEASUREMENT
/begin MEASUREMENT E_lduv "Fehlerflag: Schubumluftventil beim Turbo" UWORD B_TRUE 1 100 0 1 BIT_MASK 0x1 FORMAT "%13.11" ECU_ADDRESS 0x383BBC /end MEASUREMENT
/begin MEASUREMENT E_lkvdk "Errorflag: Diagnose Leck vor Drosselklappe" UWORD B_TRUE 1 100 0 1 BIT_MASK 0x1 FORMAT "%13.11" ECU_ADDRESS 0x383BBE /end MEASUREMENT
/begin MEASUREMENT E_llr "Errorflag: Leerlaufregelung" UWORD B_TRUE 1 100 0 1 BIT_MASK 0x1 FORMAT "%13.11" ECU_ADDRESS 0x383BC0 /end MEASUREMENT
/begin MEASUREMENT E_lm "Errorflag: Hauptlastsensor" UWORD B_TRUE 1 100 0 1 BIT_MASK 0x1 FORMAT "%13.11" ECU_ADDRESS 0x383BC2 /end MEASUREMENT
/begin MEASUREMENT E_lsh "Errorflag: Lambda-Sonde hinter Kat" UWORD B_TRUE 1 100 0 1 BIT_MASK 0x1 FORMAT "%13.11" ECU_ADDRESS 0x383BC4 /end MEASUREMENT
/begin MEASUREMENT E_lsv "Errorflag: Lambda-Sonde vor Kat" UWORD B_TRUE 1 100 0 1 BIT_MASK 0x1 FORMAT "%13.11" ECU_ADDRESS 0x383BC6 /end MEASUREMENT
/begin MEASUREMENT E_md "Errorflag: Aussetzer, Summenfehler (multiple)" UWORD B_TRUE 1 100 0 1 BIT_MASK 0x1 FORMAT "%13.11" ECU_ADDRESS 0x383BCC /end MEASUREMENT
/begin MEASUREMENT E_md00 "Errorflag: Aussetzer Zündung 0" UWORD B_TRUE 1 100 0 1 BIT_MASK 0x1 FORMAT "%13.11" ECU_ADDRESS 0x383BCE /end MEASUREMENT
/begin MEASUREMENT E_md01 "Errorflag: Aussetzer Zündung 1" UWORD B_TRUE 1 100 0 1 BIT_MASK 0x1 FORMAT "%13.11" ECU_ADDRESS 0x383BD0 /end MEASUREMENT
/begin MEASUREMENT E_md02 "Errorflag: Aussetzer Zündung 2" UWORD B_TRUE 1 100 0 1 BIT_MASK 0x1 FORMAT "%13.11" ECU_ADDRESS 0x383BD2 /end MEASUREMENT
/begin MEASUREMENT E_md03 "Errorflag: Aussetzer Zündung 3" UWORD B_TRUE 1 100 0 1 BIT_MASK 0x1 FORMAT "%13.11" ECU_ADDRESS 0x383BD4 /end MEASUREMENT
/begin MEASUREMENT E_mfa "Errorflag: MIL-fremdbestimmt" UWORD B_TRUE 1 100 0 1 BIT_MASK 0x1 FORMAT "%13.11" ECU_ADDRESS 0x383BD8 /end MEASUREMENT
/begin MEASUREMENT E_nwkw "Errorflag: Zuordnung Nockenwelle zu Kurbelwelle" UWORD B_TRUE 1 100 0 1 BIT_MASK 0x1 FORMAT "%13.11" ECU_ADDRESS 0x383BDE /end MEASUREMENT
/begin MEASUREMENT E_nx "Errorflag: NMAX - Überschreitung" UWORD B_TRUE 1 100 0 1 BIT_MASK 0x1 FORMAT "%13.11" ECU_ADDRESS 0x383BE2 /end MEASUREMENT
/begin MEASUREMENT E_ph "Errorflag: Phasensensor" UWORD B_TRUE 1 100 0 1 BIT_MASK 0x1 FORMAT "%13.11" ECU_ADDRESS 0x383BE4 /end MEASUREMENT
/begin MEASUREMENT E_pwm "Fehler PWM-Signal" UWORD B_TRUE 1 100 0 1 BIT_MASK 0x1 FORMAT "%13.11" ECU_ADDRESS 0x383BE6 /end MEASUREMENT
/begin MEASUREMENT E_scr "Errorflag: CRAS-Signal" UWORD B_TRUE 1 100 0 1 BIT_MASK 0x1 FORMAT "%13.11" ECU_ADDRESS 0x383BEC /end MEASUREMENT
/begin MEASUREMENT E_sgeep "Errorflag: Steuergerät defekt (EEPROM)" UWORD B_TRUE 1 100 0 1 BIT_MASK 0x1 FORMAT "%13.11" ECU_ADDRESS 0x383BEE /end MEASUREMENT
/begin MEASUREMENT E_sls "Errorflag: Sekundärluft-System" UWORD B_TRUE 1 100 0 1 BIT_MASK 0x1 FORMAT "%13.11" ECU_ADDRESS 0x383BF4 /end MEASUREMENT
/begin MEASUREMENT E_slv "Errorflag: Sekundärluftventil" UWORD B_TRUE 1 100 0 1 BIT_MASK 0x1 FORMAT "%13.11" ECU_ADDRESS 0x383BF6 /end MEASUREMENT
/begin MEASUREMENT E_swe "Errorflag: Beschleunigungssensor der Schlechtwegeerkennung" UWORD B_TRUE 1 100 0 1 BIT_MASK 0x1 FORMAT "%13.11" ECU_ADDRESS 0x383BFA /end MEASUREMENT
/begin MEASUREMENT E_t2stc "Errorflag: Testerkommunikation, Start der Kommunikation" UWORD B_TRUE 1 100 0 1 BIT_MASK 0x1 FORMAT "%13.11" ECU_ADDRESS 0x383BFC /end MEASUREMENT
/begin MEASUREMENT E_ta "Errorflag: Ansauglufttemperatur" UWORD B_TRUE 1 100 0 1 BIT_MASK 0x1 FORMAT "%13.11" ECU_ADDRESS 0x383BFE /end MEASUREMENT
/begin MEASUREMENT E_tankl "Errorflag: OBDII-Fehler auf Grund eines leeren Tanks" UWORD B_TRUE 1 100 0 1 BIT_MASK 0x1 FORMAT "%13.11" ECU_ADDRESS 0x383C00 /end MEASUREMENT
/begin MEASUREMENT E_tes "Errorflag: Tankentlüftungssystem" UWORD B_TRUE 1 100 0 1 BIT_MASK 0x1 FORMAT "%13.11" ECU_ADDRESS 0x383C02 /end MEASUREMENT
/begin MEASUREMENT E_tesf "Errorflag: Tankentlüftungssystem Feinleck" UWORD B_TRUE 1 100 0 1 BIT_MASK 0x1 FORMAT "%13.11" ECU_ADDRESS 0x383C04 /end MEASUREMENT
/begin MEASUREMENT E_tesg "Errorflag: Tankentlüftungssystem Grobleck" UWORD B_TRUE 1 100 0 1 BIT_MASK 0x1 FORMAT "%13.11" ECU_ADDRESS 0x383C06 /end MEASUREMENT
/begin MEASUREMENT E_teve2 "Errorflag: Tankentlüftungsventil Endstufe, Bank 2" UWORD B_TRUE 1 100 0 1 BIT_MASK 0x1 FORMAT "%13.11" ECU_ADDRESS 0x383C0A /end MEASUREMENT
/begin MEASUREMENT E_thm "Error_flag: Kühlwasser-Thermostat" UWORD B_TRUE 1 100 0 1 BIT_MASK 0x1 FORMAT "%13.11" ECU_ADDRESS 0x383C0C /end MEASUREMENT
/begin MEASUREMENT E_TKA "Errorflag: Temperatur Kühlerausgang" UWORD B_TRUE 1 100 0 1 BIT_MASK 0x1 FORMAT "%13.11" ECU_ADDRESS 0x383C0E /end MEASUREMENT
/begin MEASUREMENT E_tm "Errorflag: Motor-Temperatur" UWORD B_TRUE 1 100 0 1 BIT_MASK 0x1 FORMAT "%13.11" ECU_ADDRESS 0x383C10 /end MEASUREMENT
/begin MEASUREMENT E_tmki "Errorflag: Motortemperatur aus Kombiinstrument" UWORD B_TRUE 1 100 0 1 BIT_MASK 0x1 FORMAT "%13.11" ECU_ADDRESS 0x383C12 /end MEASUREMENT
/begin MEASUREMENT E_ub "Errorflag: UB" UWORD B_TRUE 1 100 0 1 BIT_MASK 0x1 FORMAT "%13.11" ECU_ADDRESS 0x383C18 /end MEASUREMENT
/begin MEASUREMENT E_ubr "Errorflag: Bordnetzspannung über Hauptrelais UBR" UWORD B_TRUE 1 100 0 1 BIT_MASK 0x1 FORMAT "%13.11" ECU_ADDRESS 0x383C1A /end MEASUREMENT
/begin MEASUREMENT E_ufmv "Errorflag: Funktionsüberwachung: Momentenvergleich" UWORD B_TRUE 1 100 0 1 BIT_MASK 0x1 FORMAT "%13.11" ECU_ADDRESS 0x383C1C /end MEASUREMENT
/begin MEASUREMENT E_ufska "Errorflag: Funktionsüberwachung: Sicherheits-Kraftstoff-Abschaltung" UWORD B_TRUE 1 100 0 1 BIT_MASK 0x1 FORMAT "%13.11" ECU_ADDRESS 0x383C1E /end MEASUREMENT
/begin MEASUREMENT E_urram "Errorflag: Rechnerüberwachung: RAM" UWORD B_TRUE 1 100 0 1 BIT_MASK 0x1 FORMAT "%13.11" ECU_ADDRESS 0x383C20 /end MEASUREMENT
/begin MEASUREMENT E_urrom "Errorflag: Rechnerüberwachung: ROM" UWORD B_TRUE 1 100 0 1 BIT_MASK 0x1 FORMAT "%13.11" ECU_ADDRESS 0x383C22 /end MEASUREMENT
/begin MEASUREMENT E_urrst "Errorflag: Rechnerüberwachung: Reset" UWORD B_TRUE 1 100 0 1 BIT_MASK 0x1 FORMAT "%13.11" ECU_ADDRESS 0x383C24 /end MEASUREMENT
/begin MEASUREMENT E_vfz "Errorflag: Fahrzeug-Geschwindigkeit" UWORD B_TRUE 1 100 0 1 BIT_MASK 0x1 FORMAT "%13.11" ECU_ADDRESS 0x383C28 /end MEASUREMENT
/begin MEASUREMENT sfpagrf "Status Fehlerpfad: Überwachung AGR-Flow" UWORD dez 1 100 0 65535 FORMAT "%8.2" ECU_ADDRESS 0x383B0C /end MEASUREMENT
/begin MEASUREMENT sfpbrems "Status Fehlerpfad BREMS: Bremsschalter" UWORD dez 1 100 0 65535 FORMAT "%8.2" ECU_ADDRESS 0x383B20 /end MEASUREMENT
/begin MEASUREMENT sfpbwf "Statuswort:  PWG Bewegung" UWORD dez 1 100 0 65535 FORMAT "%8.2" ECU_ADDRESS 0x383B22 /end MEASUREMENT
/begin MEASUREMENT sfpcairp "Status Fehlerpfad : unpl. Airbag-Botschaft" UWORD default 1 100 0 65535 FORMAT "%8.2" ECU_ADDRESS 0x383B26 /end MEASUREMENT
/begin MEASUREMENT sfpdkvm "Status Fehlerpfad: Drosselklappenverschmutzung" UWORD dez 1 100 0 65535 FORMAT "%8.2" ECU_ADDRESS 0x383B3E /end MEASUREMENT
/begin MEASUREMENT sfpdpl "Status Fehlerpfad: Dauerplus" UWORD dez 1 100 0 65535 FORMAT "%8.2" ECU_ADDRESS 0x383B40 /end MEASUREMENT
/begin MEASUREMENT sfpdsbkv "Status Fehlerpfad: Drucksensor Bremskraftverstärker" UWORD default 1 100 0 65535 FORMAT "%8.2" ECU_ADDRESS 0x383B42 /end MEASUREMENT
/begin MEASUREMENT sfpdsl "Status Fehlerpfad: Drucksensor Ladedruck" UWORD dez 1 100 0 65535 FORMAT "%8.2" ECU_ADDRESS 0x383B44 /end MEASUREMENT
/begin MEASUREMENT sfpdsu "Status Fehlerpfad: Umgebungsdrucksensor" UWORD dez 1 100 0 65535 FORMAT "%8.2" ECU_ADDRESS 0x383B46 /end MEASUREMENT
/begin MEASUREMENT sfpdsvlu "Status Fehlerpfad:Drucksensorsignalvergleich (DS-L DS-U)" UWORD dez 1 100 0 65535 FORMAT "%8.2" ECU_ADDRESS 0x383B48 /end MEASUREMENT
/begin MEASUREMENT sfpfp1p "Status Fehlerpfad: Fahrpedal 1.Potentiometer" UWORD dez 1 100 0 65535 FORMAT "%8.2" ECU_ADDRESS 0x383B72 /end MEASUREMENT
/begin MEASUREMENT sfpfp2p "Status Fehlerpfad: Fahrpedal 2.Potentiometer" UWORD dez 1 100 0 65535 FORMAT "%8.2" ECU_ADDRESS 0x383B74 /end MEASUREMENT
/begin MEASUREMENT sfpfpp "Status Fehlerpfad: Fahrpedal Potentiometer" UWORD dez 1 100 0 65535 FORMAT "%8.2" ECU_ADDRESS 0x383B76 /end MEASUREMENT
/begin MEASUREMENT sfpgecod "Status Fehlerpfad : Getriebecodierung CAN" UWORD dez 1 100 0 65535 FORMAT "%8.2" ECU_ADDRESS 0x383B7E /end MEASUREMENT
/begin MEASUREMENT sfpgrbh "Status Fehlerpfad: GRA-Bedienhebel" UWORD default 1 100 0 65535 FORMAT "%8.2" ECU_ADDRESS 0x383B80 /end MEASUREMENT
/begin MEASUREMENT sfphla "Status Fehlerpfad: Gebergröße Heizleistungsanforderung" UWORD default 1 100 0 65535 FORMAT "%8.2" ECU_ADDRESS 0x383B82 /end MEASUREMENT
/begin MEASUREMENT sfphre "Status Fehlerpfad: Hauptrelais Endstufe" UWORD default 1 100 0 65535 FORMAT "%8.2" ECU_ADDRESS 0x383B84 /end MEASUREMENT
/begin MEASUREMENT sfplash "Status Fehlerpfad: Lambdasondenalterung hinter Kat" UWORD dez 1 100 0 65535 FORMAT "%8.2" ECU_ADDRESS 0x383BB0 /end MEASUREMENT
/begin MEASUREMENT sfpldo "Status Fehlerpfad: Überladefehler LDR" UWORD dez 1 100 0 65535 FORMAT "%8.2" ECU_ADDRESS 0x383BB4 /end MEASUREMENT
/begin MEASUREMENT sfpldp "Status Fehlerpfad: Leckdiagnosemodul" UWORD default 1 100 0 65535 FORMAT "%8.2" ECU_ADDRESS 0x383BB6 /end MEASUREMENT
/begin MEASUREMENT sfpldra "Status Fehlerpfad: Regelabweichung LDR" UWORD dez 1 100 0 65535 FORMAT "%8.2" ECU_ADDRESS 0x383BBA /end MEASUREMENT
/begin MEASUREMENT sfplduv "Status Fehlerpfad: Schubumluftventil Turbo" UWORD dez 1 100 0 65535 FORMAT "%8.2" ECU_ADDRESS 0x383BBC /end MEASUREMENT
/begin MEASUREMENT sfplkvdk "Status Fehlerpfad: Leck vor Drosselklappe" UWORD dez 1 100 0 65535 FORMAT "%8.2" ECU_ADDRESS 0x383BBE /end MEASUREMENT
/begin MEASUREMENT sfpllr "Status Fehlerpfad: Leerlaufregelung" UWORD dez 1 100 0 65535 FORMAT "%8.2" ECU_ADDRESS 0x383BC0 /end MEASUREMENT
/begin MEASUREMENT sfplm "Status Fehlerpfad: Hauptfüllungssensor" UWORD dez 1 100 0 65535 FORMAT "%8.2" ECU_ADDRESS 0x383BC2 /end MEASUREMENT
/begin MEASUREMENT sfplsh "Status Fehlerpfad: Diagnose Lambdasonde hinter Kat" UWORD dez 1 100 0 65535 FORMAT "%8.2" ECU_ADDRESS 0x383BC4 /end MEASUREMENT
/begin MEASUREMENT sfplsv "Status Fehlerpfad: Diagnose Lambdasonde vor Kat" UWORD dez 1 100 0 65535 FORMAT "%8.2" ECU_ADDRESS 0x383BC6 /end MEASUREMENT
/begin MEASUREMENT sfpmd "Statuswort:  Aussetzer, Summenfehler (multiple)" UWORD dez 1 100 0 65535 FORMAT "%8.2" ECU_ADDRESS 0x383BCC /end MEASUREMENT
/begin MEASUREMENT sfpmd00 "Statuswort:  Aussetzer Zündung 0" UWORD dez 1 100 0 65535 FORMAT "%8.2" ECU_ADDRESS 0x383BCE /end MEASUREMENT
/begin MEASUREMENT sfpmd01 "Statuswort:  Aussetzer Zündung 1" UWORD dez 1 100 0 65535 FORMAT "%8.2" ECU_ADDRESS 0x383BD0 /end MEASUREMENT
/begin MEASUREMENT sfpmd02 "Statuswort:  Aussetzer Zündung 2" UWORD dez 1 100 0 65535 FORMAT "%8.2" ECU_ADDRESS 0x383BD2 /end MEASUREMENT
/begin MEASUREMENT sfpmd03 "Statuswort:  Aussetzer Zündung 3" UWORD dez 1 100 0 65535 FORMAT "%8.2" ECU_ADDRESS 0x383BD4 /end MEASUREMENT
/begin MEASUREMENT sfpmfa "Status Fehlerpfad: MIL-Fremdanforderung" UWORD dez 1 100 0 65535 FORMAT "%8.2" ECU_ADDRESS 0x383BD8 /end MEASUREMENT
/begin MEASUREMENT sfpnwkw "Status Fehlerpfad: Zuordnung Nockenwelle zu Kurbelwelle" UWORD default 1 100 0 65535 FORMAT "%8.2" ECU_ADDRESS 0x383BDE /end MEASUREMENT
/begin MEASUREMENT sfpnx "Statuswort: Überdrehzahl" UWORD dez 1 100 0 65535 FORMAT "%8.2" ECU_ADDRESS 0x383BE2 /end MEASUREMENT
/begin MEASUREMENT sfpph "Status Fehlerpfad: Phasengeber" UWORD dez 1 100 0 65535 FORMAT "%8.2" ECU_ADDRESS 0x383BE4 /end MEASUREMENT
/begin MEASUREMENT sfppwm "" UWORD dez 1 100 0 65535 FORMAT "%8.2" ECU_ADDRESS 0x383BE6 /end MEASUREMENT
/begin MEASUREMENT sfpscr "Status Fehlerpfad: CRAS-Signal" UWORD default 1 100 0 65535 FORMAT "%8.2" ECU_ADDRESS 0x383BEC /end MEASUREMENT
/begin MEASUREMENT sfpsgeep "Status Fehlerpfad: Steuergerät defekt (EEPROM)" UWORD default 1 100 0 65535 FORMAT "%8.2" ECU_ADDRESS 0x383BEE /end MEASUREMENT
/begin MEASUREMENT sfpsls "Status Fehlerpfad: Diagnose Sekundärluftsystem" UWORD dez 1 100 0 65535 FORMAT "%8.2" ECU_ADDRESS 0x383BF4 /end MEASUREMENT
/begin MEASUREMENT sfpslv "Status Fehlerpfad: Diagnose Sekundärluftventil" UWORD dez 1 100 0 65535 FORMAT "%8.2" ECU_ADDRESS 0x383BF6 /end MEASUREMENT
/begin MEASUREMENT sfpswe "Status Fehlerpfad: Schlechtwegerkennung" UWORD dez 1 100 0 65535 FORMAT "%8.2" ECU_ADDRESS 0x383BFA /end MEASUREMENT
/begin MEASUREMENT sfpt2stc "" UWORD default 1 100 0 65535 FORMAT "%8.2" ECU_ADDRESS 0x383BFC /end MEASUREMENT
/begin MEASUREMENT sfpta "Status Fehlerpfad: Ansauglufttemperatur (Ladeluft-) TANS" UWORD dez 1 100 0 65535 FORMAT "%8.2" ECU_ADDRESS 0x383BFE /end MEASUREMENT
/begin MEASUREMENT sfptankl "Statuswort : tankl <Tank leer>" UWORD default 1 100 0 65535 FORMAT "%8.2" ECU_ADDRESS 0x383C00 /end MEASUREMENT
/begin MEASUREMENT sfptes "Status Fehlerpfad: Tankdiagnose, TEV defekt offen" UWORD default 1 100 0 65535 FORMAT "%8.2" ECU_ADDRESS 0x383C02 /end MEASUREMENT
/begin MEASUREMENT sfptesf "Status Fehlerpfad: Tankdiagnose, Feinleck" UWORD default 1 100 0 65535 FORMAT "%8.2" ECU_ADDRESS 0x383C04 /end MEASUREMENT
/begin MEASUREMENT sfptesg "Status Fehlerpfad: Tankdiagnose, Grobleck" UWORD default 1 100 0 65535 FORMAT "%8.2" ECU_ADDRESS 0x383C06 /end MEASUREMENT
/begin MEASUREMENT sfpteve2 "Status Fehlerpfad: Tanklüftungsventil Endstufe Bank 2" UWORD dez 1 100 0 65535 FORMAT "%8.2" ECU_ADDRESS 0x383C0A /end MEASUREMENT
/begin MEASUREMENT sfpthm "Status Fehlerpfad: Thermostat Motor(-Kühlung) THM" UWORD default 1 100 0 65535 FORMAT "%8.2" ECU_ADDRESS 0x383C0C /end MEASUREMENT
/begin MEASUREMENT sfptka "Status Fehlerpfad: Temperatur Kühlerausgang" UWORD dez 1 100 0 65535 FORMAT "%8.2" ECU_ADDRESS 0x383C0E /end MEASUREMENT
/begin MEASUREMENT sfptm "Status Fehlerpfad: Motortemperatur TMOT" UWORD dez 1 100 0 65535 FORMAT "%8.2" ECU_ADDRESS 0x383C10 /end MEASUREMENT
/begin MEASUREMENT sfptmki "Status Fehlerpfad: Motortemperatur aus Kombiinstrument TMKI" UWORD dez 1 100 0 65535 FORMAT "%8.2" ECU_ADDRESS 0x383C12 /end MEASUREMENT
/begin MEASUREMENT sfpub "Status Fehlerpfad: Batteriespannung UB (Bordnetz)" UWORD dez 1 100 0 65535 FORMAT "%8.2" ECU_ADDRESS 0x383C18 /end MEASUREMENT
/begin MEASUREMENT sfpubr "Status Fehlerpfad: Bordnetzspannung über Hauptrelais UBR" UWORD dez 1 100 0 65535 FORMAT "%8.2" ECU_ADDRESS 0x383C1A /end MEASUREMENT
/begin MEASUREMENT sfpufmv "Statuswort: Funktionsüberwachung: Momentenvergleich" UWORD dez 1 100 0 65535 FORMAT "%8.2" ECU_ADDRESS 0x383C1C /end MEASUREMENT
/begin MEASUREMENT sfpufska "Statuswort: Funktionsüberwachung: Sicherheits-Kraftstoff-Abschaltung" UWORD dez 1 100 0 65535 FORMAT "%8.2" ECU_ADDRESS 0x383C1E /end MEASUREMENT
/begin MEASUREMENT sfpurram "Statuswort: Rechnerüberwachung: RAM" UWORD dez 1 100 0 65535 FORMAT "%8.2" ECU_ADDRESS 0x383C20 /end MEASUREMENT
/begin MEASUREMENT sfpurrom "Statuswort: Rechnerüberwachung: ROM" UWORD dez 1 100 0 65535 FORMAT "%8.2" ECU_ADDRESS 0x383C22 /end MEASUREMENT
/begin MEASUREMENT sfpurrst "Statuswort: Rechnerüberwachung: Reset" UWORD dez 1 100 0 65535 FORMAT "%8.2" ECU_ADDRESS 0x383C24 /end MEASUREMENT
/begin MEASUREMENT sfpvfz "Status Fehlerpfad: Fahrzeuggeschwindigkeit" UWORD dez 1 100 0 65535 FORMAT "%8.2" ECU_ADDRESS 0x383C28 /end MEASUREMENT
/begin MEASUREMENT TYP_brems "Fehlertyp: Gebergröße Bremsschalter" UWORD B_TRUE 1 100 0 1 BIT_MASK 0xf00 FORMAT "%13.11" ECU_ADDRESS 0x383B20 /end MEASUREMENT
/begin MEASUREMENT TYP_bwf "Fehlertyp:  PWG Bewegung" UWORD B_TRUE 1 100 0 1 BIT_MASK 0xf00 FORMAT "%13.11" ECU_ADDRESS 0x383B22 /end MEASUREMENT
/begin MEASUREMENT TYP_cairp "" UWORD B_TRUE 1 100 0 1 BIT_MASK 0xf00 FORMAT "%13.11" ECU_ADDRESS 0x383B26 /end MEASUREMENT
/begin MEASUREMENT TYP_dpl "" UWORD B_TRUE 1 100 0 1 BIT_MASK 0xf00 FORMAT "%13.11" ECU_ADDRESS 0x383B40 /end MEASUREMENT
/begin MEASUREMENT TYP_dsbkv "" UWORD B_TRUE 1 100 0 1 BIT_MASK 0xf00 FORMAT "%13.11" ECU_ADDRESS 0x383B42 /end MEASUREMENT
/begin MEASUREMENT TYP_dsl "" UWORD B_TRUE 1 100 0 1 BIT_MASK 0xf00 FORMAT "%13.11" ECU_ADDRESS 0x383B44 /end MEASUREMENT
/begin MEASUREMENT TYP_dsu "" UWORD B_TRUE 1 100 0 1 BIT_MASK 0xf00 FORMAT "%13.11" ECU_ADDRESS 0x383B46 /end MEASUREMENT
/begin MEASUREMENT TYP_dsvlu "" UWORD B_TRUE 1 100 0 1 BIT_MASK 0xf00 FORMAT "%13.11" ECU_ADDRESS 0x383B48 /end MEASUREMENT
/begin MEASUREMENT TYP_fp1p "" UWORD B_TRUE 1 100 0 1 BIT_MASK 0xf00 FORMAT "%13.11" ECU_ADDRESS 0x383B72 /end MEASUREMENT
/begin MEASUREMENT TYP_fp2p "" UWORD B_TRUE 1 100 0 1 BIT_MASK 0xf00 FORMAT "%13.11" ECU_ADDRESS 0x383B74 /end MEASUREMENT
/begin MEASUREMENT TYP_fpp "" UWORD B_TRUE 1 100 0 1 BIT_MASK 0xf00 FORMAT "%13.11" ECU_ADDRESS 0x383B76 /end MEASUREMENT
/begin MEASUREMENT TYP_gecod "" UWORD B_TRUE 1 100 0 1 BIT_MASK 0xf00 FORMAT "%13.11" ECU_ADDRESS 0x383B7E /end MEASUREMENT
/begin MEASUREMENT TYP_grbh "" UWORD B_TRUE 1 100 0 1 BIT_MASK 0xf00 FORMAT "%13.11" ECU_ADDRESS 0x383B80 /end MEASUREMENT
/begin MEASUREMENT TYP_hla "" UWORD B_TRUE 1 100 0 1 BIT_MASK 0xf00 FORMAT "%13.11" ECU_ADDRESS 0x383B82 /end MEASUREMENT
/begin MEASUREMENT TYP_hre "" UWORD B_TRUE 1 100 0 1 BIT_MASK 0xf00 FORMAT "%13.11" ECU_ADDRESS 0x383B84 /end MEASUREMENT
/begin MEASUREMENT TYP_lash "Fehlertyp: Lambda- Sondenalterung hinter Kat" UWORD B_TRUE 1 100 0 1 BIT_MASK 0xf00 FORMAT "%13.11" ECU_ADDRESS 0x383BB0 /end MEASUREMENT
/begin MEASUREMENT TYP_ldo "" UWORD B_TRUE 1 100 0 1 BIT_MASK 0xf00 FORMAT "%13.11" ECU_ADDRESS 0x383BB4 /end MEASUREMENT
/begin MEASUREMENT TYP_ldp "" UWORD B_TRUE 1 100 0 1 BIT_MASK 0xf00 FORMAT "%13.11" ECU_ADDRESS 0x383BB6 /end MEASUREMENT
/begin MEASUREMENT TYP_ldra "" UWORD B_TRUE 1 100 0 1 BIT_MASK 0xf00 FORMAT "%13.11" ECU_ADDRESS 0x383BBA /end MEASUREMENT
/begin MEASUREMENT TYP_lduv "" UWORD B_TRUE 1 100 0 1 BIT_MASK 0xf00 FORMAT "%13.11" ECU_ADDRESS 0x383BBC /end MEASUREMENT
/begin MEASUREMENT TYP_lkvdk "" UWORD B_TRUE 1 100 0 1 BIT_MASK 0xf00 FORMAT "%13.11" ECU_ADDRESS 0x383BBE /end MEASUREMENT
/begin MEASUREMENT TYP_LLR "" UWORD B_TRUE 1 100 0 1 BIT_MASK 0xf00 FORMAT "%13.11" ECU_ADDRESS 0x383BC0 /end MEASUREMENT
/begin MEASUREMENT TYP_lm "" UWORD B_TRUE 1 100 0 1 BIT_MASK 0xf00 FORMAT "%13.11" ECU_ADDRESS 0x383BC2 /end MEASUREMENT
/begin MEASUREMENT TYP_lsh "Fehlertyp: Lambdasonde 1 hinter Kat" UWORD B_TRUE 1 100 0 1 BIT_MASK 0xf00 FORMAT "%13.11" ECU_ADDRESS 0x383BC4 /end MEASUREMENT
/begin MEASUREMENT TYP_lsv "Fehlertyp: Lambdasonde 1 vor Kat" UWORD B_TRUE 1 100 0 1 BIT_MASK 0xf00 FORMAT "%13.11" ECU_ADDRESS 0x383BC6 /end MEASUREMENT
/begin MEASUREMENT TYP_md "Fehlertyp:  Aussetzer, Summenfehler (multiple)" UWORD B_TRUE 1 100 0 1 BIT_MASK 0xf00 FORMAT "%13.11" ECU_ADDRESS 0x383BCC /end MEASUREMENT
/begin MEASUREMENT TYP_md00 "Fehlertyp:  Aussetzer Zündung 0" UWORD B_TRUE 1 100 0 1 BIT_MASK 0xf00 FORMAT "%13.11" ECU_ADDRESS 0x383BCE /end MEASUREMENT
/begin MEASUREMENT TYP_md01 "Fehlertyp:  Aussetzer Zündung 1" UWORD B_TRUE 1 100 0 1 BIT_MASK 0xf00 FORMAT "%13.11" ECU_ADDRESS 0x383BD0 /end MEASUREMENT
/begin MEASUREMENT TYP_md02 "Fehlertyp:  Aussetzer Zündung 2" UWORD B_TRUE 1 100 0 1 BIT_MASK 0xf00 FORMAT "%13.11" ECU_ADDRESS 0x383BD2 /end MEASUREMENT
/begin MEASUREMENT TYP_md03 "Fehlertyp:  Aussetzer Zündung 3" UWORD B_TRUE 1 100 0 1 BIT_MASK 0xf00 FORMAT "%13.11" ECU_ADDRESS 0x383BD4 /end MEASUREMENT
/begin MEASUREMENT TYP_mfa "Fehlertyp: MIL-fremdbestimmt" UWORD B_TRUE 1 100 0 1 BIT_MASK 0xf00 FORMAT "%13.11" ECU_ADDRESS 0x383BD8 /end MEASUREMENT
/begin MEASUREMENT TYP_nwkw "" UWORD B_TRUE 1 100 0 1 BIT_MASK 0xf00 FORMAT "%13.11" ECU_ADDRESS 0x383BDE /end MEASUREMENT
/begin MEASUREMENT TYP_nx "Fehlertyp: Überdrehzahl" UWORD B_TRUE 1 100 0 1 BIT_MASK 0xf00 FORMAT "%13.11" ECU_ADDRESS 0x383BE2 /end MEASUREMENT
/begin MEASUREMENT TYP_ph "" UWORD B_TRUE 1 100 0 1 BIT_MASK 0xf00 FORMAT "%13.11" ECU_ADDRESS 0x383BE4 /end MEASUREMENT
/begin MEASUREMENT TYP_pwm "" UWORD B_TRUE 1 100 0 1 BIT_MASK 0xf00 FORMAT "%13.11" ECU_ADDRESS 0x383BE6 /end MEASUREMENT
/begin MEASUREMENT TYP_scr "" UWORD B_TRUE 1 100 0 1 BIT_MASK 0xf00 FORMAT "%13.11" ECU_ADDRESS 0x383BEC /end MEASUREMENT
/begin MEASUREMENT TYP_sgeep "" UWORD B_TRUE 1 100 0 1 BIT_MASK 0xf00 FORMAT "%13.11" ECU_ADDRESS 0x383BEE /end MEASUREMENT
/begin MEASUREMENT TYP_sls "Fehlertyp: Sekundärluftsystem" UWORD B_TRUE 1 100 0 1 BIT_MASK 0xf00 FORMAT "%13.11" ECU_ADDRESS 0x383BF4 /end MEASUREMENT
/begin MEASUREMENT TYP_slv "Fehlertyp: Dichtheit Sekundärluftventil" UWORD B_TRUE 1 100 0 1 BIT_MASK 0xf00 FORMAT "%13.11" ECU_ADDRESS 0x383BF6 /end MEASUREMENT
/begin MEASUREMENT TYP_swe "" UWORD B_TRUE 1 100 0 1 BIT_MASK 0xf00 FORMAT "%13.11" ECU_ADDRESS 0x383BFA /end MEASUREMENT
/begin MEASUREMENT TYP_t2stc "" UWORD B_TRUE 1 100 0 1 BIT_MASK 0xf00 FORMAT "%13.11" ECU_ADDRESS 0x383BFC /end MEASUREMENT
/begin MEASUREMENT TYP_ta "" UWORD B_TRUE 1 100 0 1 BIT_MASK 0xf00 FORMAT "%13.11" ECU_ADDRESS 0x383BFE /end MEASUREMENT
/begin MEASUREMENT TYP_tankl "Fehlertyp : Tank leer" UWORD B_TRUE 1 100 0 1 BIT_MASK 0xf00 FORMAT "%13.11" ECU_ADDRESS 0x383C00 /end MEASUREMENT
/begin MEASUREMENT TYP_tes "Fehlertyp: Tankdiagnose, TEV offen" UWORD B_TRUE 1 100 0 1 BIT_MASK 0xf00 FORMAT "%13.11" ECU_ADDRESS 0x383C02 /end MEASUREMENT
/begin MEASUREMENT TYP_tesf "Fehlertyp: Tankdiagnose, Feinleck" UWORD B_TRUE 1 100 0 1 BIT_MASK 0xf00 FORMAT "%13.11" ECU_ADDRESS 0x383C04 /end MEASUREMENT
/begin MEASUREMENT TYP_tesg "Fehlertyp: Tankdiagnose, Grobleck" UWORD B_TRUE 1 100 0 1 BIT_MASK 0xf00 FORMAT "%13.11" ECU_ADDRESS 0x383C06 /end MEASUREMENT
/begin MEASUREMENT TYP_thm "" UWORD B_TRUE 1 100 0 1 BIT_MASK 0xf00 FORMAT "%13.11" ECU_ADDRESS 0x383C0C /end MEASUREMENT
/begin MEASUREMENT TYP_tka "" UWORD B_TRUE 1 100 0 1 BIT_MASK 0xf00 FORMAT "%13.11" ECU_ADDRESS 0x383C0E /end MEASUREMENT
/begin MEASUREMENT TYP_tm "" UWORD B_TRUE 1 100 0 1 BIT_MASK 0xf00 FORMAT "%13.11" ECU_ADDRESS 0x383C10 /end MEASUREMENT
/begin MEASUREMENT TYP_tmki "" UWORD B_TRUE 1 100 0 1 BIT_MASK 0xf00 FORMAT "%13.11" ECU_ADDRESS 0x383C12 /end MEASUREMENT
/begin MEASUREMENT TYP_ub "" UWORD B_TRUE 1 100 0 1 BIT_MASK 0xf00 FORMAT "%13.11" ECU_ADDRESS 0x383C18 /end MEASUREMENT
/begin MEASUREMENT TYP_ubr "" UWORD B_TRUE 1 100 0 1 BIT_MASK 0xf00 FORMAT "%13.11" ECU_ADDRESS 0x383C1A /end MEASUREMENT
/begin MEASUREMENT TYP_ufmv "Fehlertyp: Funktionsüberwachung: Momentenvergleich" UWORD B_TRUE 1 100 0 1 BIT_MASK 0xf00 FORMAT "%13.11" ECU_ADDRESS 0x383C1C /end MEASUREMENT
/begin MEASUREMENT TYP_ufska "Fehlertyp: Funktionsüberwachung: Sicherheits-Kraftstoff-Abschaltung" UWORD B_TRUE 1 100 0 1 BIT_MASK 0xf00 FORMAT "%13.11" ECU_ADDRESS 0x383C1E /end MEASUREMENT
/begin MEASUREMENT TYP_urram "Fehlertyp: Rechnerüberwachung: RAM" UWORD B_TRUE 1 100 0 1 BIT_MASK 0xf00 FORMAT "%13.11" ECU_ADDRESS 0x383C20 /end MEASUREMENT
/begin MEASUREMENT TYP_urrom "Fehlertyp: Rechnerüberwachung: ROM" UWORD B_TRUE 1 100 0 1 BIT_MASK 0xf00 FORMAT "%13.11" ECU_ADDRESS 0x383C22 /end MEASUREMENT
/begin MEASUREMENT TYP_urrst "Fehlertyp: Rechnerüberwachung: Reset" UWORD B_TRUE 1 100 0 1 BIT_MASK 0xf00 FORMAT "%13.11" ECU_ADDRESS 0x383C24 /end MEASUREMENT
/begin MEASUREMENT TYP_vfz "" UWORD B_TRUE 1 100 0 1 BIT_MASK 0xf00 FORMAT "%13.11" ECU_ADDRESS 0x383C28 /end MEASUREMENT
/begin MEASUREMENT Z_agrf "Zyklusflag: Überwachung AGR-FLOW" UWORD B_TRUE 1 100 0 1 BIT_MASK 0x2 FORMAT "%13.11" ECU_ADDRESS 0x383B0C /end MEASUREMENT
/begin MEASUREMENT Z_brems "Zyklusflag: BREMS (Bremsschalter)" UWORD B_TRUE 1 100 0 1 BIT_MASK 0x2 FORMAT "%13.11" ECU_ADDRESS 0x383B20 /end MEASUREMENT
/begin MEASUREMENT Z_bwf "Zyklusflag: PWG Bewegung" UWORD B_TRUE 1 100 0 1 BIT_MASK 0x2 FORMAT "%13.11" ECU_ADDRESS 0x383B22 /end MEASUREMENT
/begin MEASUREMENT Z_cairp "Zyklusflag : Airbag-Botschaft unplausibel" UWORD B_TRUE 1 100 0 1 BIT_MASK 0x2 FORMAT "%13.11" ECU_ADDRESS 0x383B26 /end MEASUREMENT
/begin MEASUREMENT Z_dkvm "Zyklusflag: Drosselklappenverschmutzung" UWORD B_TRUE 1 100 0 1 BIT_MASK 0x2 FORMAT "%13.11" ECU_ADDRESS 0x383B3E /end MEASUREMENT
/begin MEASUREMENT Z_dpl "Zyklusflag: Dauerplus" UWORD B_TRUE 1 100 0 1 BIT_MASK 0x2 FORMAT "%13.11" ECU_ADDRESS 0x383B40 /end MEASUREMENT
/begin MEASUREMENT Z_dsbkv "Zyklusflag: Bremskraftverstärker-Drucksensor" UWORD B_TRUE 1 100 0 1 BIT_MASK 0x2 FORMAT "%13.11" ECU_ADDRESS 0x383B42 /end MEASUREMENT
/begin MEASUREMENT Z_dsl "Zyklusflag: Drucksensor Ladedruck" UWORD B_TRUE 1 100 0 1 BIT_MASK 0x2 FORMAT "%13.11" ECU_ADDRESS 0x383B44 /end MEASUREMENT
/begin MEASUREMENT Z_dsu "Zyklusflag: Umgebungsdrucksensor" UWORD B_TRUE 1 100 0 1 BIT_MASK 0x2 FORMAT "%13.11" ECU_ADDRESS 0x383B46 /end MEASUREMENT
/begin MEASUREMENT Z_dsvlu "Zyklusflag: Drucksensorsignalvergleich (DS-L DS-U)" UWORD B_TRUE 1 100 0 1 BIT_MASK 0x2 FORMAT "%13.11" ECU_ADDRESS 0x383B48 /end MEASUREMENT
/begin MEASUREMENT Z_fp1p "Zyklusflag: Fahrpedal 1. Poti" UWORD B_TRUE 1 100 0 1 BIT_MASK 0x2 FORMAT "%13.11" ECU_ADDRESS 0x383B72 /end MEASUREMENT
/begin MEASUREMENT Z_fp2p "Zyklusflag: Fahrpedal 2. Poti" UWORD B_TRUE 1 100 0 1 BIT_MASK 0x2 FORMAT "%13.11" ECU_ADDRESS 0x383B74 /end MEASUREMENT
/begin MEASUREMENT Z_fpp "Zyklusflag Fahrpedal-Poti" UWORD B_TRUE 1 100 0 1 BIT_MASK 0x2 FORMAT "%13.11" ECU_ADDRESS 0x383B76 /end MEASUREMENT
/begin MEASUREMENT Z_gecod "Zyklusflag Getriebe-Codierung" UWORD B_TRUE 1 100 0 1 BIT_MASK 0x2 FORMAT "%13.11" ECU_ADDRESS 0x383B7E /end MEASUREMENT
/begin MEASUREMENT Z_grbh "Zyklusflag: GRA Bedienhebel" UWORD B_TRUE 1 100 0 1 BIT_MASK 0x2 FORMAT "%13.11" ECU_ADDRESS 0x383B80 /end MEASUREMENT
/begin MEASUREMENT Z_hla "Zyklusflag: Gebergröße Heizleistungsanforderung" UWORD B_TRUE 1 100 0 1 BIT_MASK 0x2 FORMAT "%13.11" ECU_ADDRESS 0x383B82 /end MEASUREMENT
/begin MEASUREMENT Z_hre "Zyklusflag: Hauptrelaisentstufe" UWORD B_TRUE 1 100 0 1 BIT_MASK 0x2 FORMAT "%13.11" ECU_ADDRESS 0x383B84 /end MEASUREMENT
/begin MEASUREMENT Z_lash "Zyklusflag: Lambda-Sondenalterung hinter Kat" UWORD B_TRUE 1 100 0 1 BIT_MASK 0x2 FORMAT "%13.11" ECU_ADDRESS 0x383BB0 /end MEASUREMENT
/begin MEASUREMENT Z_ldo "Zyklusflag: Ladedruckkennlinie; oberer Wert überschritten" UWORD B_TRUE 1 100 0 1 BIT_MASK 0x2 FORMAT "%13.11" ECU_ADDRESS 0x383BB4 /end MEASUREMENT
/begin MEASUREMENT Z_ldp "Zyklusflag: Leckdiagnosemodul" UWORD B_TRUE 1 100 0 1 BIT_MASK 0x2 FORMAT "%13.11" ECU_ADDRESS 0x383BB6 /end MEASUREMENT
/begin MEASUREMENT Z_ldra "Zyklusflag: Ladedruckregelabweichung" UWORD B_TRUE 1 100 0 1 BIT_MASK 0x2 FORMAT "%13.11" ECU_ADDRESS 0x383BBA /end MEASUREMENT
/begin MEASUREMENT Z_lduv "Zyklusflag: Schubumluftventil Turbo" UWORD B_TRUE 1 100 0 1 BIT_MASK 0x2 FORMAT "%13.11" ECU_ADDRESS 0x383BBC /end MEASUREMENT
/begin MEASUREMENT Z_lkvdk "Zyklusflag: Diagnose Leck vor Drosselklappe" UWORD B_TRUE 1 100 0 1 BIT_MASK 0x2 FORMAT "%13.11" ECU_ADDRESS 0x383BBE /end MEASUREMENT
/begin MEASUREMENT Z_llr "Zyklusflag: Leerlaufregelung" UWORD B_TRUE 1 100 0 1 BIT_MASK 0x2 FORMAT "%13.11" ECU_ADDRESS 0x383BC0 /end MEASUREMENT
/begin MEASUREMENT Z_lm "Zyklusflag: LMM/HLM/HFM" UWORD B_TRUE 1 100 0 1 BIT_MASK 0x2 FORMAT "%13.11" ECU_ADDRESS 0x383BC2 /end MEASUREMENT
/begin MEASUREMENT Z_lsh "Zyklusflag: Lambda-Sonde hinter Kat" UWORD B_TRUE 1 100 0 1 BIT_MASK 0x2 FORMAT "%13.11" ECU_ADDRESS 0x383BC4 /end MEASUREMENT
/begin MEASUREMENT Z_lsv "Zyklusflag: Lambda-Sonde vor Kat" UWORD B_TRUE 1 100 0 1 BIT_MASK 0x2 FORMAT "%13.11" ECU_ADDRESS 0x383BC6 /end MEASUREMENT
/begin MEASUREMENT Z_md "Zyklusflag: Aussetzer, Summenfehler (multiple)" UWORD B_TRUE 1 100 0 1 BIT_MASK 0x2 FORMAT "%13.11" ECU_ADDRESS 0x383BCC /end MEASUREMENT
/begin MEASUREMENT Z_md00 "Zyklusflag: Aussetzer Zündung 0" UWORD B_TRUE 1 100 0 1 BIT_MASK 0x2 FORMAT "%13.11" ECU_ADDRESS 0x383BCE /end MEASUREMENT
/begin MEASUREMENT Z_md01 "Zyklusflag: Aussetzer Zündung 1" UWORD B_TRUE 1 100 0 1 BIT_MASK 0x2 FORMAT "%13.11" ECU_ADDRESS 0x383BD0 /end MEASUREMENT
/begin MEASUREMENT Z_md02 "Zyklusflag: Aussetzer Zündung 2" UWORD B_TRUE 1 100 0 1 BIT_MASK 0x2 FORMAT "%13.11" ECU_ADDRESS 0x383BD2 /end MEASUREMENT
/begin MEASUREMENT Z_md03 "Zyklusflag: Aussetzer Zündung 3" UWORD B_TRUE 1 100 0 1 BIT_MASK 0x2 FORMAT "%13.11" ECU_ADDRESS 0x383BD4 /end MEASUREMENT
/begin MEASUREMENT Z_mfa "Zyklusflag: MIL-fremdbestimmt" UWORD B_TRUE 1 100 0 1 BIT_MASK 0x2 FORMAT "%13.11" ECU_ADDRESS 0x383BD8 /end MEASUREMENT
/begin MEASUREMENT Z_nwkw "Zyklusflag: Zuordnung Nockenwelle zu Kurbelwelle" UWORD B_TRUE 1 100 0 1 BIT_MASK 0x2 FORMAT "%13.11" ECU_ADDRESS 0x383BDE /end MEASUREMENT
/begin MEASUREMENT Z_nx "Zyklusflag: NMAX - Überschreitung" UWORD B_TRUE 1 100 0 1 BIT_MASK 0x2 FORMAT "%13.11" ECU_ADDRESS 0x383BE2 /end MEASUREMENT
/begin MEASUREMENT Z_ph "Zyklusflag: Phasensensor" UWORD B_TRUE 1 100 0 1 BIT_MASK 0x2 FORMAT "%13.11" ECU_ADDRESS 0x383BE4 /end MEASUREMENT
/begin MEASUREMENT Z_pwm "Zyklusflag: PWM-Signal" UWORD B_TRUE 1 100 0 1 BIT_MASK 0x2 FORMAT "%13.11" ECU_ADDRESS 0x383BE6 /end MEASUREMENT
/begin MEASUREMENT Z_scr "Zyklusflag: CRAS-Signal" UWORD B_TRUE 1 100 0 1 BIT_MASK 0x2 FORMAT "%13.11" ECU_ADDRESS 0x383BEC /end MEASUREMENT
/begin MEASUREMENT Z_sgeep "Zyklusflag: Steuergerät defekt (EEPROM)" UWORD B_TRUE 1 100 0 1 BIT_MASK 0x2 FORMAT "%13.11" ECU_ADDRESS 0x383BEE /end MEASUREMENT
/begin MEASUREMENT Z_sls "Zyklusflag: Sekundärluft-System" UWORD B_TRUE 1 100 0 1 BIT_MASK 0x2 FORMAT "%13.11" ECU_ADDRESS 0x383BF4 /end MEASUREMENT
/begin MEASUREMENT Z_slv "Zyklusflag: Sekundärluftventil" UWORD B_TRUE 1 100 0 1 BIT_MASK 0x2 FORMAT "%13.11" ECU_ADDRESS 0x383BF6 /end MEASUREMENT
/begin MEASUREMENT Z_swe "Zyklusflag: Beschleunigungssensor der Schlechtwegeerkennung" UWORD B_TRUE 1 100 0 1 BIT_MASK 0x2 FORMAT "%13.11" ECU_ADDRESS 0x383BFA /end MEASUREMENT
/begin MEASUREMENT Z_t2stc "" UWORD B_TRUE 1 100 0 1 BIT_MASK 0x2 FORMAT "%13.11" ECU_ADDRESS 0x383BFC /end MEASUREMENT
/begin MEASUREMENT Z_ta "Zyklusflag: Ansauglufttemperatur" UWORD B_TRUE 1 100 0 1 BIT_MASK 0x2 FORMAT "%13.11" ECU_ADDRESS 0x383BFE /end MEASUREMENT
/begin MEASUREMENT Z_tankl "Zyklusflag: OBDII Fehler auf Grund eines leeren Tanks" UWORD B_TRUE 1 100 0 1 BIT_MASK 0x2 FORMAT "%13.11" ECU_ADDRESS 0x383C00 /end MEASUREMENT
/begin MEASUREMENT Z_tes "Zyklusflag: Tankentlüftungssystem" UWORD B_TRUE 1 100 0 1 BIT_MASK 0x2 FORMAT "%13.11" ECU_ADDRESS 0x383C02 /end MEASUREMENT
/begin MEASUREMENT Z_tesf "Zyklusflag: Tankentlüftungssystem Feinleck" UWORD B_TRUE 1 100 0 1 BIT_MASK 0x2 FORMAT "%13.11" ECU_ADDRESS 0x383C04 /end MEASUREMENT
/begin MEASUREMENT Z_tesg "Zyklusflag: Tankentlüftungssystem Grobleck" UWORD B_TRUE 1 100 0 1 BIT_MASK 0x2 FORMAT "%13.11" ECU_ADDRESS 0x383C06 /end MEASUREMENT
/begin MEASUREMENT Z_teve2 "Zyklusflag: Tankentlüftungsventil Endstufe 2" UWORD B_TRUE 1 100 0 1 BIT_MASK 0x2 FORMAT "%13.11" ECU_ADDRESS 0x383C0A /end MEASUREMENT
/begin MEASUREMENT Z_thm "Zyklusflg Kühlwasser-Thermostat" UWORD B_TRUE 1 100 0 1 BIT_MASK 0x2 FORMAT "%13.11" ECU_ADDRESS 0x383C0C /end MEASUREMENT
/begin MEASUREMENT Z_TKA "Zyklusflag Temperatur Kühlerausgang" UWORD B_TRUE 1 100 0 1 BIT_MASK 0x2 FORMAT "%13.11" ECU_ADDRESS 0x383C0E /end MEASUREMENT
/begin MEASUREMENT Z_tm "Zyklusflag: Motor-Temperatur" UWORD B_TRUE 1 100 0 1 BIT_MASK 0x2 FORMAT "%13.11" ECU_ADDRESS 0x383C10 /end MEASUREMENT
/begin MEASUREMENT Z_tmki "Zyklusflag: Motortemperatur aus Kombiinstrument" UWORD B_TRUE 1 100 0 1 BIT_MASK 0x2 FORMAT "%13.11" ECU_ADDRESS 0x383C12 /end MEASUREMENT
/begin MEASUREMENT Z_ub "Zyklusflag: UB" UWORD B_TRUE 1 100 0 1 BIT_MASK 0x2 FORMAT "%13.11" ECU_ADDRESS 0x383C18 /end MEASUREMENT
/begin MEASUREMENT Z_ubr "Zyklusflag: Bordnetzspannung über Hauptrelais UBR" UWORD B_TRUE 1 100 0 1 BIT_MASK 0x2 FORMAT "%13.11" ECU_ADDRESS 0x383C1A /end MEASUREMENT
/begin MEASUREMENT Z_ufmv "Zyklusflag: Funktionsüberwachung: Momentenvergleich" UWORD B_TRUE 1 100 0 1 BIT_MASK 0x2 FORMAT "%13.11" ECU_ADDRESS 0x383C1C /end MEASUREMENT
/begin MEASUREMENT Z_ufska "Zyklusflag: Funktionsüberwachung: Sicherheits-Kraftstoff-Abschaltung" UWORD B_TRUE 1 100 0 1 BIT_MASK 0x2 FORMAT "%13.11" ECU_ADDRESS 0x383C1E /end MEASUREMENT
/begin MEASUREMENT Z_urram "Zyklusflag: Rechnerüberwachung: RAM" UWORD B_TRUE 1 100 0 1 BIT_MASK 0x2 FORMAT "%13.11" ECU_ADDRESS 0x383C20 /end MEASUREMENT
/begin MEASUREMENT Z_urrom "Zyklusflag: Rechnerüberwachung: ROM" UWORD B_TRUE 1 100 0 1 BIT_MASK 0x2 FORMAT "%13.11" ECU_ADDRESS 0x383C22 /end MEASUREMENT
/begin MEASUREMENT Z_urrst "Zyklusflag: Rechnerüberwachung: Reset" UWORD B_TRUE 1 100 0 1 BIT_MASK 0x2 FORMAT "%13.11" ECU_ADDRESS 0x383C24 /end MEASUREMENT
/begin MEASUREMENT Z_vfz "Zyklusflag: Fahrzeug-Geschwindigkeit" UWORD B_TRUE 1 100 0 1 BIT_MASK 0x2 FORMAT "%13.11" ECU_ADDRESS 0x383C28 /end MEASUREMENT
/begin FUNCTION DFPM_DLDP ""
 /begin DEF_CHARACTERISTIC CDCLDP CDCTESF CDCTESG CDKLDP CDKTESF CDKTESG CDTLDP CDTTESF CDTTESG CLALDP CLATESF CLATESG FFTLDP FFTTESF FFTTESG TSFLDP TSFTESF TSFTESG /end DEF_CHARACTERISTIC
 /begin REF_CHARACTERISTIC /end REF_CHARACTERISTIC
 /begin IN_MEASUREMENT /end IN_MEASUREMENT
 /begin OUT_MEASUREMENT B_beldp B_betesf B_betesg B_bkldp B_bktesf B_bktesg B_clldp B_cltesf B_cltesg B_ftldp B_fttesf B_fttesg B_mnldp B_mntesf B_mntesg B_mxldp B_mxtesf B_mxtesg B_npldp B_nptesf B_nptesg B_sildp B_sitesf B_sitesg E_ldp E_tesf E_tesg sfpldp sfptesf sfptesg TYP_ldp TYP_tesf TYP_tesg Z_ldp Z_tesf Z_tesg /end OUT_MEASUREMENT
 /begin LOC_MEASUREMENT /end LOC_MEASUREMENT
 /begin SUB_FUNCTION /end SUB_FUNCTION
/end FUNCTION
/begin FUNCTION DFPM_DLDR "DLDR."
 /begin DEF_CHARACTERISTIC CDCLDO CDCLDRA CDCLKVDK CDKLDO CDKLDRA CDKLKVDK CDTLDO CDTLDRA CDTLKVDK CLALDO CLALDRA CLALKVDK FFTLDO FFTLDRA FFTLKVDK TSFLDO TSFLDRA TSFLKVDK /end DEF_CHARACTERISTIC
 /begin REF_CHARACTERISTIC /end REF_CHARACTERISTIC
 /begin IN_MEASUREMENT /end IN_MEASUREMENT
 /begin OUT_MEASUREMENT B_beldo B_beldra B_belkvdk B_bkldo B_bkldra B_bklkvdk B_clldo B_clldra B_cllkvdk B_ftldo B_ftldra B_ftlkvdk B_mnldo B_mnldra B_mnlkvdk B_mxldo B_mxldra B_mxlkvdk B_npldo B_npldra B_nplkvdk B_sildo B_sildra B_silkvdk E_ldo E_ldra E_lkvdk sfpldo sfpldra sfplkvdk TYP_ldo TYP_ldra TYP_lkvdk Z_ldo Z_ldra Z_lkvdk /end OUT_MEASUREMENT
 /begin LOC_MEASUREMENT /end LOC_MEASUREMENT
 /begin SUB_FUNCTION /end SUB_FUNCTION
/end FUNCTION
/begin FUNCTION DFPM_DLDUV "1.40" /begin DEF_CHARACTERISTIC CDCLDUV CDKLDUV CDTLDUV CLALDUV FFTLDUV TSFLDUV /end DEF_CHARACTERISTIC /begin REF_CHARACTERISTIC /end REF_CHARACTERISTIC /begin IN_MEASUREMENT /end IN_MEASUREMENT
 /begin OUT_MEASUREMENT B_belduv B_bklduv B_cllduv B_ftlduv B_mnlduv B_mxlduv B_nplduv B_silduv E_lduv sfplduv TYP_lduv Z_lduv /end OUT_MEASUREMENT
 /begin LOC_MEASUREMENT /end LOC_MEASUREMENT
 /begin SUB_FUNCTION /end SUB_FUNCTION
/end FUNCTION
/begin FUNCTION DFPM_DLLR "" /begin DEF_CHARACTERISTIC CDCLLR CDKLLR CDTLLR CLALLR FFTLLR TSFLLR /end DEF_CHARACTERISTIC /begin REF_CHARACTERISTIC /end REF_CHARACTERISTIC /begin IN_MEASUREMENT /end IN_MEASUREMENT
 /begin OUT_MEASUREMENT B_bellr B_bkllr B_clllr B_ftllr B_mnllr B_mxllr B_npllr B_sillr E_llr sfpllr TYP_LLR Z_llr /end OUT_MEASUREMENT
 /begin LOC_MEASUREMENT /end LOC_MEASUREMENT
 /begin SUB_FUNCTION /end SUB_FUNCTION
/end FUNCTION
/begin FUNCTION DFPM_DLSAHK "" /begin DEF_CHARACTERISTIC CDCLASH CDKLASH CDTLASH CLALASH FFTLASH TSFLASH /end DEF_CHARACTERISTIC /begin REF_CHARACTERISTIC /end REF_CHARACTERISTIC /begin IN_MEASUREMENT /end IN_MEASUREMENT
 /begin OUT_MEASUREMENT B_belash B_bklash B_cllash B_falash B_mnlash B_mxlash B_nplash B_silash E_lash sfplash TYP_lash Z_lash /end OUT_MEASUREMENT
 /begin LOC_MEASUREMENT /end LOC_MEASUREMENT
 /begin SUB_FUNCTION /end SUB_FUNCTION
/end FUNCTION
/begin FUNCTION DFPM_DLSH "" /begin DEF_CHARACTERISTIC CDCLSH CDKLSH CDTLSH CLALSH FFTLSH TSFLSH /end DEF_CHARACTERISTIC /begin REF_CHARACTERISTIC /end REF_CHARACTERISTIC /begin IN_MEASUREMENT /end IN_MEASUREMENT
 /begin OUT_MEASUREMENT B_belsh B_bklsh B_cllsh B_ftlsh B_mnlsh B_mxlsh B_nplsh B_silsh E_lsh sfplsh TYP_lsh Z_lsh /end OUT_MEASUREMENT
 /begin LOC_MEASUREMENT /end LOC_MEASUREMENT
 /begin SUB_FUNCTION /end SUB_FUNCTION
/end FUNCTION
/begin FUNCTION DFPM_DLSU "" /begin DEF_CHARACTERISTIC CDCLSV CDKLSV CDTLSV CLALSV FFTLSV TSFLSV /end DEF_CHARACTERISTIC /begin REF_CHARACTERISTIC /end REF_CHARACTERISTIC /begin IN_MEASUREMENT /end IN_MEASUREMENT
 /begin OUT_MEASUREMENT B_belsv B_bklsv B_cllsv B_ftlsv B_mnlsv B_mxlsv B_nplsv B_silsv E_lsv sfplsv TYP_lsv Z_lsv /end OUT_MEASUREMENT
 /begin LOC_MEASUREMENT /end LOC_MEASUREMENT
 /begin SUB_FUNCTION /end SUB_FUNCTION
/end FUNCTION
/begin FUNCTION DFPM_DMDMIL ""
 /begin DEF_CHARACTERISTIC CDCMD CDCMD00 CDCMD01 CDCMD02 CDCMD03 CDKMD CDKMD00 CDKMD01 CDKMD02 CDKMD03 CDTMD CDTMD00 CDTMD01 CDTMD02 CDTMD03 CLAMD CLAMD00 CLAMD01 CLAMD02 CLAMD03 FFTMD FFTMD00 FFTMD01 FFTMD02 FFTMD03 TSFMD TSFMD00 TSFMD01 TSFMD02 TSFMD03 /end DEF_CHARACTERISTIC
 /begin REF_CHARACTERISTIC /end REF_CHARACTERISTIC
 /begin IN_MEASUREMENT /end IN_MEASUREMENT
 /begin OUT_MEASUREMENT B_bemd B_bemd00 B_bemd01 B_bemd02 B_bemd03 B_bkmd B_bkmd00 B_bkmd01 B_bkmd02 B_bkmd03 B_clmd B_clmd00 B_clmd01 B_clmd02 B_clmd03 B_ftmd B_ftmd00 B_ftmd01 B_ftmd02 B_ftmd03 B_mnmd B_mnmd00 B_mnmd01 B_mnmd02 B_mnmd03 B_mxmd B_mxmd00 B_mxmd01 B_mxmd02 B_mxmd03 B_npmd B_npmd00 B_npmd01 B_npmd02 B_npmd03 B_simd B_simd00 B_simd01 B_simd02 B_simd03 E_md E_md00 E_md01 E_md02 E_md03 sfpmd sfpmd00 sfpmd01 sfpmd02 sfpmd03 TYP_md TYP_md00 TYP_md01 TYP_md02 TYP_md03 Z_md Z_md00 Z_md01 Z_md02 Z_md03 /end OUT_MEASUREMENT
 /begin LOC_MEASUREMENT /end LOC_MEASUREMENT
 /begin SUB_FUNCTION /end SUB_FUNCTION
/end FUNCTION
/begin FUNCTION DFPM_DMFB "" /begin DEF_CHARACTERISTIC CDCMFA CDKMFA CDTMFA CLAMFA FFTMFA TSFMFA /end DEF_CHARACTERISTIC /begin REF_CHARACTERISTIC /end REF_CHARACTERISTIC /begin IN_MEASUREMENT /end IN_MEASUREMENT
 /begin OUT_MEASUREMENT B_bemfa B_bkmfa B_clmfa B_famfa B_mnmfa B_mxmfa B_npmfa B_simfa E_mfa sfpmfa TYP_mfa Z_mfa /end OUT_MEASUREMENT
 /begin LOC_MEASUREMENT /end LOC_MEASUREMENT
 /begin SUB_FUNCTION /end SUB_FUNCTION
/end FUNCTION
/begin FUNCTION DFPM_DNMAX "" /begin DEF_CHARACTERISTIC CDCNX CDKNX CDTNX CLANX FFTNX TSFNX /end DEF_CHARACTERISTIC /begin REF_CHARACTERISTIC /end REF_CHARACTERISTIC /begin IN_MEASUREMENT /end IN_MEASUREMENT
 /begin OUT_MEASUREMENT B_benx B_bknx B_clnx B_ftnx B_mnnx B_mxnx B_npnx B_sinx E_nx sfpnx TYP_nx Z_nx /end OUT_MEASUREMENT
 /begin LOC_MEASUREMENT /end LOC_MEASUREMENT
 /begin SUB_FUNCTION /end SUB_FUNCTION
/end FUNCTION
/begin FUNCTION DFPM_DNWKW "" /begin DEF_CHARACTERISTIC CDCNWKW CDKNWKW CDTNWKW CLANWKW FFTNWKW TSFNWKW /end DEF_CHARACTERISTIC /begin REF_CHARACTERISTIC /end REF_CHARACTERISTIC /begin IN_MEASUREMENT /end IN_MEASUREMENT
 /begin OUT_MEASUREMENT B_benwkw B_bknwkw B_clnwkw B_ftnwkw B_mnnwkw B_mxnwkw B_npnwkw B_sinwkw E_nwkw sfpnwkw TYP_nwkw Z_nwkw /end OUT_MEASUREMENT
 /begin LOC_MEASUREMENT /end LOC_MEASUREMENT
 /begin SUB_FUNCTION /end SUB_FUNCTION
/end FUNCTION
/begin FUNCTION DFPM_DPH "" /begin DEF_CHARACTERISTIC CDCPH CDKPH CDTPH CLAPH FFTPH TSFPH /end DEF_CHARACTERISTIC /begin REF_CHARACTERISTIC /end REF_CHARACTERISTIC /begin IN_MEASUREMENT /end IN_MEASUREMENT
 /begin OUT_MEASUREMENT B_beph B_bkph B_clph B_ftph B_mnph B_mxph B_npph B_siph E_ph sfpph TYP_ph Z_ph /end OUT_MEASUREMENT
 /begin LOC_MEASUREMENT /end LOC_MEASUREMENT
 /begin SUB_FUNCTION /end SUB_FUNCTION
/end FUNCTION
/begin FUNCTION DFPM_DPL "" /begin DEF_CHARACTERISTIC CDCDPL CDKDPL CDTDPL CLADPL FFTDPL TSFDPL /end DEF_CHARACTERISTIC /begin REF_CHARACTERISTIC /end REF_CHARACTERISTIC /begin IN_MEASUREMENT /end IN_MEASUREMENT
 /begin OUT_MEASUREMENT B_bedpl B_bkdpl B_cldpl B_ftdpl B_mndpl B_mxdpl B_npddpl B_siddpl E_dpl sfpdpl TYP_dpl Z_dpl /end OUT_MEASUREMENT
 /begin LOC_MEASUREMENT /end LOC_MEASUREMENT
 /begin SUB_FUNCTION /end SUB_FUNCTION
/end FUNCTION
/begin FUNCTION DFPM_DSBKV "" /begin DEF_CHARACTERISTIC CDCDSBKV CDKDSBKV CDTDSBKV CLADSBKV FFTDSBKV TSFDSBKV /end DEF_CHARACTERISTIC /begin REF_CHARACTERISTIC /end REF_CHARACTERISTIC /begin IN_MEASUREMENT /end IN_MEASUREMENT
 /begin OUT_MEASUREMENT B_bedsbkv B_bkdsbkv B_cldsbkv B_ftdsbkv B_mndsbkv B_mxdsbkv B_npdsbkv B_sidsbkv E_dsbkv sfpdsbkv TYP_dsbkv Z_dsbkv /end OUT_MEASUREMENT
 /begin LOC_MEASUREMENT /end LOC_MEASUREMENT
 /begin SUB_FUNCTION /end SUB_FUNCTION
/end FUNCTION
/begin FUNCTION DFPM_DSELHFS "" /begin DEF_CHARACTERISTIC CDCLM CDKLM CDTLM CLALM FFTLM TSFLM /end DEF_CHARACTERISTIC /begin REF_CHARACTERISTIC /end REF_CHARACTERISTIC /begin IN_MEASUREMENT /end IN_MEASUREMENT
 /begin OUT_MEASUREMENT B_belm B_bklm B_cllm B_falm B_mnlm B_mxlm B_nplm B_silm E_lm sfplm TYP_lm Z_lm /end OUT_MEASUREMENT
 /begin LOC_MEASUREMENT /end LOC_MEASUREMENT
 /begin SUB_FUNCTION /end SUB_FUNCTION
/end FUNCTION
/begin FUNCTION DFPM_DSGEEP "" /begin DEF_CHARACTERISTIC CDCSGEEP CDKSGEEP CDTSGEEP CLASGEEP FFTSGEEP TSFSGEEP /end DEF_CHARACTERISTIC /begin REF_CHARACTERISTIC /end REF_CHARACTERISTIC /begin IN_MEASUREMENT /end IN_MEASUREMENT
 /begin OUT_MEASUREMENT B_besgeep B_bksgeep B_clsgeep B_ftsgeep B_mnsgeep B_mxsgeep B_npsgeep B_sisgeep E_sgeep sfpsgeep TYP_sgeep Z_sgeep /end OUT_MEASUREMENT
 /begin LOC_MEASUREMENT /end LOC_MEASUREMENT
 /begin SUB_FUNCTION /end SUB_FUNCTION
/end FUNCTION
/begin FUNCTION DFPM_DSLSLRS ""
 /begin DEF_CHARACTERISTIC CDCSLS CDCSLV CDKSLS CDKSLV CDTSLS CDTSLV CLASLS CLASLV FFTSLS FFTSLV TSFSLS TSFSLV /end DEF_CHARACTERISTIC
 /begin REF_CHARACTERISTIC /end REF_CHARACTERISTIC
 /begin IN_MEASUREMENT /end IN_MEASUREMENT
 /begin OUT_MEASUREMENT B_besls B_beslv B_bksls B_bkslv B_clsls B_clslv B_ftsls B_ftslv B_mnsls B_mnslv B_mxsls B_mxslv B_npsls B_npslv B_sisls B_sislv E_sls E_slv sfpsls sfpslv TYP_sls TYP_slv Z_sls Z_slv /end OUT_MEASUREMENT
 /begin LOC_MEASUREMENT /end LOC_MEASUREMENT
 /begin SUB_FUNCTION /end SUB_FUNCTION
/end FUNCTION
/begin FUNCTION DFPM_DSWEA ""
 /begin DEF_CHARACTERISTIC CDCPWM CDCSWE CDKPWM CDKSWE CDTPWM CDTSWE CLAPWM CLASWE FFTPWM FFTSWE TSFPWM TSFSWE /end DEF_CHARACTERISTIC
 /begin REF_CHARACTERISTIC /end REF_CHARACTERISTIC
 /begin IN_MEASUREMENT /end IN_MEASUREMENT
 /begin OUT_MEASUREMENT B_bepwm B_beswe B_bkpwm B_bkswe B_clpwm B_clswe B_ftpwm B_ftswe B_mnpwm B_mnswe B_mxpwm B_mxswe B_nppwm B_npswe B_sipwm B_siswe E_pwm E_swe sfppwm sfpswe TYP_pwm TYP_swe Z_pwm Z_swe /end OUT_MEASUREMENT
 /begin LOC_MEASUREMENT /end LOC_MEASUREMENT
 /begin SUB_FUNCTION /end SUB_FUNCTION
/end FUNCTION
/begin FUNCTION DFPM_DT2STC "" /begin DEF_CHARACTERISTIC CDCT2STC CDKT2STC CDTT2STC CLAT2STC FFTT2STC TSFT2STC /end DEF_CHARACTERISTIC /begin REF_CHARACTERISTIC /end REF_CHARACTERISTIC /begin IN_MEASUREMENT /end IN_MEASUREMENT
 /begin OUT_MEASUREMENT B_bet2stc B_bkt2stc B_clt2stc B_ftt2stc B_mnt2stc B_mxt2stc B_npt2stc B_sit2stc E_t2stc sfpt2stc TYP_t2stc Z_t2stc /end OUT_MEASUREMENT
 /begin LOC_MEASUREMENT /end LOC_MEASUREMENT
 /begin SUB_FUNCTION /end SUB_FUNCTION
/end FUNCTION
/begin FUNCTION DFPM_DTANKL "" /begin DEF_CHARACTERISTIC CDCTANKL CDKTANKL CDTTANKL CLATANKL FFTTANKL TSFTANKL /end DEF_CHARACTERISTIC /begin REF_CHARACTERISTIC /end REF_CHARACTERISTIC /begin IN_MEASUREMENT /end IN_MEASUREMENT
 /begin OUT_MEASUREMENT B_betankl B_bktankl B_cltankl B_fttankl B_mntankl B_mxtankl B_nptankl B_sitankl E_tankl sfptankl TYP_tankl Z_tankl /end OUT_MEASUREMENT
 /begin LOC_MEASUREMENT /end LOC_MEASUREMENT
 /begin SUB_FUNCTION /end SUB_FUNCTION
/end FUNCTION
/begin FUNCTION DFPM_DTEV "" /begin DEF_CHARACTERISTIC CDCTES CDKTES CDTTES CLATES FFTTES TSFTES /end DEF_CHARACTERISTIC /begin REF_CHARACTERISTIC /end REF_CHARACTERISTIC /begin IN_MEASUREMENT /end IN_MEASUREMENT
 /begin OUT_MEASUREMENT B_avtes B_betes B_bktes B_cltes B_fttes B_mntes B_mxtes B_nptes B_pytes B_sctes B_sites E_tes sfptes TYP_tes Z_tes /end OUT_MEASUREMENT
 /begin LOC_MEASUREMENT /end LOC_MEASUREMENT
 /begin SUB_FUNCTION /end SUB_FUNCTION
/end FUNCTION
/begin FUNCTION DFPM_DTHM "" /begin DEF_CHARACTERISTIC CDCTHM CDKTHM CDTTHM CLATHM FFTTHM TSFTHM /end DEF_CHARACTERISTIC /begin REF_CHARACTERISTIC /end REF_CHARACTERISTIC /begin IN_MEASUREMENT /end IN_MEASUREMENT
 /begin OUT_MEASUREMENT B_bethm B_bkthm B_clthm B_ftthm B_mnthm B_mxthm B_npthm B_sithm E_thm sfpthm TYP_thm Z_thm /end OUT_MEASUREMENT
 /begin LOC_MEASUREMENT /end LOC_MEASUREMENT
 /begin SUB_FUNCTION /end SUB_FUNCTION
/end FUNCTION
/begin FUNCTION DFPM_DUF ""
 /begin DEF_CHARACTERISTIC CDCUFMV CDCUFSKA CDKUFMV CDKUFSKA CDTUFMV CDTUFSKA CLAUFMV CLAUFSKA FFTUFMV FFTUFSKA TSFUFMV TSFUFSKA /end DEF_CHARACTERISTIC
 /begin REF_CHARACTERISTIC /end REF_CHARACTERISTIC
 /begin IN_MEASUREMENT /end IN_MEASUREMENT
 /begin OUT_MEASUREMENT B_beufmv B_beufska B_bkufmv B_bkufska B_clufmv B_clufska B_ftufmv B_ftufska B_mnufmv B_mnufska B_mxufmv B_mxufska B_npufmv B_npufska B_siufmv B_siufska E_ufmv E_ufska sfpufmv sfpufska TYP_ufmv TYP_ufska Z_ufmv Z_ufska /end OUT_MEASUREMENT
 /begin LOC_MEASUREMENT /end LOC_MEASUREMENT
 /begin SUB_FUNCTION /end SUB_FUNCTION
/end FUNCTION
/begin FUNCTION DFPM_DUMMY_D ""
 /begin DEF_CHARACTERISTIC CDCAGRF CDCDKVM CDCTEVE2 CDKAGRF CDKDKVM CDKTEVE2 CDTAGRF CDTDKVM CDTTEVE2 CLAAGRF CLADKVM CLATEVE2 FFTAGRF FFTDKVM FFTTEVE2 TSFAGRF TSFDKVM TSFTEVE2 /end DEF_CHARACTERISTIC
 /begin REF_CHARACTERISTIC /end REF_CHARACTERISTIC
 /begin IN_MEASUREMENT /end IN_MEASUREMENT
 /begin OUT_MEASUREMENT E_agrf E_dkvm E_teve2 sfpagrf sfpdkvm sfpteve2 Z_agrf Z_dkvm Z_teve2 /end OUT_MEASUREMENT
 /begin LOC_MEASUREMENT /end LOC_MEASUREMENT
 /begin SUB_FUNCTION /end SUB_FUNCTION
/end FUNCTION
/begin FUNCTION DFPM_DUR ""
 /begin DEF_CHARACTERISTIC CDCURRAM CDCURROM CDCURRST CDKURRAM CDKURROM CDKURRST CDTURRAM CDTURROM CDTURRST CLAURRAM CLAURROM CLAURRST FFTURRAM FFTURROM FFTURRST TSFURRAM TSFURROM TSFURRST /end DEF_CHARACTERISTIC
 /begin REF_CHARACTERISTIC /end REF_CHARACTERISTIC
 /begin IN_MEASUREMENT /end IN_MEASUREMENT
 /begin OUT_MEASUREMENT B_beurram B_beurrom B_beurrst B_bkurram B_bkurrom B_bkurrst B_clurram B_clurrom B_clurrst B_fturram B_fturrom B_fturrst B_mnurram B_mnurrom B_mnurrst B_mxurram B_mxurrom B_mxurrst B_npurram B_npurrom B_npurrst B_siurram B_siurrom B_siurrst E_urram E_urrom E_urrst sfpurram sfpurrom sfpurrst TYP_urram TYP_urrom TYP_urrst Z_urram Z_urrom Z_urrst /end OUT_MEASUREMENT
 /begin LOC_MEASUREMENT /end LOC_MEASUREMENT
 /begin SUB_FUNCTION /end SUB_FUNCTION
/end FUNCTION
/begin FUNCTION DFPM_DVFZ "" /begin DEF_CHARACTERISTIC CDCVFZ CDKVFZ CDTVFZ CLAVFZ FFTVFZ TSFVFZ /end DEF_CHARACTERISTIC /begin REF_CHARACTERISTIC /end REF_CHARACTERISTIC /begin IN_MEASUREMENT /end IN_MEASUREMENT
 /begin OUT_MEASUREMENT B_bevfz B_bkvfz B_clvfz B_ftvfz B_mnvfz B_mxvfz B_npvfz B_sivfz E_vfz sfpvfz TYP_vfz Z_vfz /end OUT_MEASUREMENT
 /begin LOC_MEASUREMENT /end LOC_MEASUREMENT
 /begin SUB_FUNCTION /end SUB_FUNCTION
/end FUNCTION
/begin FUNCTION DFPM_GECOD "" /begin DEF_CHARACTERISTIC CDCGECOD CDKGECOD CDTGECOD CLAGECOD FFTGECOD TSFGECOD /end DEF_CHARACTERISTIC /begin REF_CHARACTERISTIC /end REF_CHARACTERISTIC /begin IN_MEASUREMENT /end IN_MEASUREMENT
 /begin OUT_MEASUREMENT B_avgecod B_begecod B_bkgecod B_clgecod B_ftgecod B_mngecod B_mxgecod B_npgecod B_pygecod B_scgecod B_sigecod E_gecod sfpgecod TYP_gecod Z_gecod /end OUT_MEASUREMENT
 /begin LOC_MEASUREMENT /end LOC_MEASUREMENT
 /begin SUB_FUNCTION /end SUB_FUNCTION
/end FUNCTION
/begin FUNCTION DFPM_GGCS ""
 /begin DEF_CHARACTERISTIC CDCCAIRP CDCSCR CDKCAIRP CDKSCR CDTCAIRP CDTSCR CLACAIRP CLASCR FFTCAIRP FFTSCR TSFCAIRP TSFSCR /end DEF_CHARACTERISTIC
 /begin REF_CHARACTERISTIC /end REF_CHARACTERISTIC
 /begin IN_MEASUREMENT /end IN_MEASUREMENT
 /begin OUT_MEASUREMENT B_becairp B_bescr B_bkcairp B_bkscr B_clcairp B_clscr B_ftcairp B_ftscr B_mncairp B_mnscr B_mxcairp B_mxscr B_npcairp B_npscr B_sicairp B_siscr E_cairp E_scr sfpcairp sfpscr TYP_cairp TYP_scr Z_cairp Z_scr /end OUT_MEASUREMENT
 /begin LOC_MEASUREMENT /end LOC_MEASUREMENT
 /begin SUB_FUNCTION /end SUB_FUNCTION
/end FUNCTION
/begin FUNCTION DFPM_GGDSAS ""
 /begin DEF_CHARACTERISTIC CDCDSL CDCDSU CDCDSVLU CDKDSL CDKDSU CDKDSVLU CDTDSL CDTDSU CDTDSVLU CLADSL CLADSU CLADSVLU FFTDSL FFTDSU FFTDSVLU TSFDSL TSFDSU TSFDSVLU /end DEF_CHARACTERISTIC
 /begin REF_CHARACTERISTIC /end REF_CHARACTERISTIC
 /begin IN_MEASUREMENT /end IN_MEASUREMENT
 /begin OUT_MEASUREMENT B_bedsl B_bedsu B_bedsvlu B_bkdsl B_bkdsu B_bkdsvlu B_cldsl B_cldsu B_cldsvlu B_ftdsl B_ftdsu B_ftdsvlu B_mndsl B_mndsu B_mndsvlu B_mxdsl B_mxdsu B_mxdsvlu B_npdsl B_npdsu B_npdsvlu B_sidsl B_sidsu B_sidsvlu E_dsl E_dsu E_dsvlu sfpdsl sfpdsu sfpdsvlu TYP_dsl TYP_dsu TYP_dsvlu Z_dsl Z_dsu Z_dsvlu /end OUT_MEASUREMENT
 /begin LOC_MEASUREMENT /end LOC_MEASUREMENT
 /begin SUB_FUNCTION /end SUB_FUNCTION
/end FUNCTION
/begin FUNCTION DFPM_GGEGAS "" /begin DEF_CHARACTERISTIC CDCBREMS CDKBREMS CDTBREMS CLABREMS FFTBREMS TSFBREMS /end DEF_CHARACTERISTIC /begin REF_CHARACTERISTIC /end REF_CHARACTERISTIC /begin IN_MEASUREMENT /end IN_MEASUREMENT
 /begin OUT_MEASUREMENT B_bebrems B_bkbrems B_clbrems B_ftbrems B_mnbrems B_mxbrems B_npbrems B_sibrems E_brems sfpbrems TYP_brems Z_brems /end OUT_MEASUREMENT
 /begin LOC_MEASUREMENT /end LOC_MEASUREMENT
 /begin SUB_FUNCTION /end SUB_FUNCTION
/end FUNCTION
/begin FUNCTION DFPM_GGFGRH "" /begin DEF_CHARACTERISTIC CDCGRBH CDKGRBH CDTGRBH CLAGRBH FFTGRBH TSFGRBH /end DEF_CHARACTERISTIC /begin REF_CHARACTERISTIC /end REF_CHARACTERISTIC /begin IN_MEASUREMENT /end IN_MEASUREMENT
 /begin OUT_MEASUREMENT B_begrbh B_bkgrbh B_clgrbh B_ftgrbh B_mngrbh B_mxgrbh B_npgrbh B_sigrbh E_grbh sfpgrbh TYP_grbh Z_grbh /end OUT_MEASUREMENT
 /begin LOC_MEASUREMENT /end LOC_MEASUREMENT
 /begin SUB_FUNCTION /end SUB_FUNCTION
/end FUNCTION
/begin FUNCTION DFPM_GGGTS "" /begin DEF_CHARACTERISTIC CDCTMKI CDKTMKI CDTTMKI CLATMKI FFTTMKI TSFTMKI /end DEF_CHARACTERISTIC /begin REF_CHARACTERISTIC /end REF_CHARACTERISTIC /begin IN_MEASUREMENT /end IN_MEASUREMENT
 /begin OUT_MEASUREMENT B_avtmki B_betmki B_bktmki B_cltmki B_fttmki B_mntmki B_mxtmki B_nptmki B_pytmki B_sctmki B_sitmki E_tmki sfptmki TYP_tmki Z_tmki /end OUT_MEASUREMENT
 /begin LOC_MEASUREMENT /end LOC_MEASUREMENT
 /begin SUB_FUNCTION /end SUB_FUNCTION
/end FUNCTION
/begin FUNCTION DFPM_GGHLA "" /begin DEF_CHARACTERISTIC CDCHLA CDKHLA CDTHLA CLAHLA FFTHLA TSFHLA /end DEF_CHARACTERISTIC /begin REF_CHARACTERISTIC /end REF_CHARACTERISTIC /begin IN_MEASUREMENT /end IN_MEASUREMENT
 /begin OUT_MEASUREMENT B_behla B_bkhla B_clhla B_fthla B_mnhla B_mxhla B_nphla B_sihla E_hla sfphla TYP_hla Z_hla /end OUT_MEASUREMENT
 /begin LOC_MEASUREMENT /end LOC_MEASUREMENT
 /begin SUB_FUNCTION /end SUB_FUNCTION
/end FUNCTION
/begin FUNCTION DFPM_GGPED ""
 /begin DEF_CHARACTERISTIC CDCBWF CDCFP1P CDCFP2P CDCFPP CDKBWF CDKFP1P CDKFP2P CDKFPP CDTBWF CDTFP1P CDTFP2P CDTFPP CLABWF CLAFP1P CLAFP2P CLAFPP FFTBWF FFTFP1P FFTFP2P FFTFPP TSFBWF TSFFP1P TSFFP2P TSFFPP /end DEF_CHARACTERISTIC
 /begin REF_CHARACTERISTIC /end REF_CHARACTERISTIC
 /begin IN_MEASUREMENT /end IN_MEASUREMENT
 /begin OUT_MEASUREMENT B_bebwf B_befp1p B_befp2p B_befpp B_bkbwf B_bkfp1p B_bkfp2p B_bkfpp B_clbwf B_clfp1p B_clfp2p B_clfpp B_ftbwf B_ftfp1p B_ftfp2p B_ftfpp B_mnbwf B_mnfp1p B_mnfp2p B_mnfpp B_mxbwf B_mxfp1p B_mxfp2p B_mxfpp B_npbwf B_npfp1p B_npfp2p B_npfpp B_sibwf B_sifp1p B_sifp2p B_sifpp E_bwf E_fp1p E_fp2p E_fpp sfpbwf sfpfp1p sfpfp2p sfpfpp TYP_bwf TYP_fp1p TYP_fp2p TYP_fpp Z_bwf Z_fp1p Z_fp2p Z_fpp /end OUT_MEASUREMENT
 /begin LOC_MEASUREMENT /end LOC_MEASUREMENT
 /begin SUB_FUNCTION /end SUB_FUNCTION
/end FUNCTION
/begin FUNCTION DFPM_GGTFA "" /begin DEF_CHARACTERISTIC CDCTA CDKTA CDTTA CLATA FFTTA TSFTA /end DEF_CHARACTERISTIC /begin REF_CHARACTERISTIC /end REF_CHARACTERISTIC /begin IN_MEASUREMENT /end IN_MEASUREMENT
 /begin OUT_MEASUREMENT B_beta B_bkta B_clta B_ftta B_mnta B_mxta B_npta B_sita E_ta sfpta TYP_ta Z_ta /end OUT_MEASUREMENT
 /begin LOC_MEASUREMENT /end LOC_MEASUREMENT
 /begin SUB_FUNCTION /end SUB_FUNCTION
/end FUNCTION
/begin FUNCTION DFPM_GGTFM "" /begin DEF_CHARACTERISTIC CDCTM CDKTM CDTTM CLATM FFTTM TSFTM /end DEF_CHARACTERISTIC /begin REF_CHARACTERISTIC /end REF_CHARACTERISTIC /begin IN_MEASUREMENT /end IN_MEASUREMENT
 /begin OUT_MEASUREMENT B_betm B_bktm B_cltm B_fttm B_mntm B_mxtm B_nptm B_sitm E_tm sfptm TYP_tm Z_tm /end OUT_MEASUREMENT
 /begin LOC_MEASUREMENT /end LOC_MEASUREMENT
 /begin SUB_FUNCTION /end SUB_FUNCTION
/end FUNCTION
/begin FUNCTION DFPM_GGTKA "" /begin DEF_CHARACTERISTIC CDCTKA CDKTKA CDTTKA CLATKA FFTTKA TSFTKA /end DEF_CHARACTERISTIC /begin REF_CHARACTERISTIC /end REF_CHARACTERISTIC /begin IN_MEASUREMENT /end IN_MEASUREMENT
 /begin OUT_MEASUREMENT B_betka B_bktka B_cltka B_fttka B_mntka B_mxtka B_nptka B_sitka E_TKA sfptka TYP_tka Z_TKA /end OUT_MEASUREMENT
 /begin LOC_MEASUREMENT /end LOC_MEASUREMENT
 /begin SUB_FUNCTION /end SUB_FUNCTION
/end FUNCTION
/begin FUNCTION DFPM_GGUB "" /begin DEF_CHARACTERISTIC CDCUB CDKUB CDTUB CLAUB FFTUB TSFUB /end DEF_CHARACTERISTIC /begin REF_CHARACTERISTIC /end REF_CHARACTERISTIC /begin IN_MEASUREMENT /end IN_MEASUREMENT
 /begin OUT_MEASUREMENT B_beub B_bkub B_club B_ftub B_mnub B_mxub B_npub B_siub E_ub sfpub TYP_ub Z_ub /end OUT_MEASUREMENT
 /begin LOC_MEASUREMENT /end LOC_MEASUREMENT
 /begin SUB_FUNCTION /end SUB_FUNCTION
/end FUNCTION
/begin FUNCTION DFPM_GGUBR "" /begin DEF_CHARACTERISTIC CDCUBR CDKUBR CDTUBR CLAUBR FFTUBR TSFUBR /end DEF_CHARACTERISTIC /begin REF_CHARACTERISTIC /end REF_CHARACTERISTIC /begin IN_MEASUREMENT /end IN_MEASUREMENT
 /begin OUT_MEASUREMENT B_beubr B_bkubr B_clubr B_ftubr B_mnubr B_mxubr B_npubr B_siubr E_ubr sfpubr TYP_ubr Z_ubr /end OUT_MEASUREMENT
 /begin LOC_MEASUREMENT /end LOC_MEASUREMENT
 /begin SUB_FUNCTION /end SUB_FUNCTION
/end FUNCTION
/begin FUNCTION DFPM_HRE "" /begin DEF_CHARACTERISTIC CDCHRE CDKHRE CDTHRE CLAHRE FFTHRE TSFHRE /end DEF_CHARACTERISTIC /begin REF_CHARACTERISTIC /end REF_CHARACTERISTIC /begin IN_MEASUREMENT /end IN_MEASUREMENT
 /begin OUT_MEASUREMENT B_behre B_bkhre B_clhre B_fthre B_mnhre B_mxhre B_nphre B_sihre E_hre sfphre TYP_hre Z_hre /end OUT_MEASUREMENT
 /begin LOC_MEASUREMENT /end LOC_MEASUREMENT
 /begin SUB_FUNCTION /end SUB_FUNCTION
/end FUNCTION
/begin COMPU_METHOD B_TRUE "boolsche Zustände, positive Logik" TAB_VERB "%6.3" "" COMPU_TAB_REF B_TRUE /end COMPU_METHOD
/begin COMPU_VTAB B_TRUE "boolsche Zustände, positive Logik" TAB_VERB 2 0 "----" 1 "TRUE" /end COMPU_VTAB
/begin COMPU_METHOD dez "1 : 1 Umrechnug (dez/hex)" RAT_FUNC "%6.2" "" COEFFS 0 1 0 0 0 1 /end COMPU_METHOD
/begin COMPU_METHOD default "" RAT_FUNC "%6.2" "" COEFFS 0 1 0 0 0 1 /end COMPU_METHOD
/begin RECORD_LAYOUT KwbUb FNC_VALUES 1 UBYTE COLUMN_DIR DIRECT /end RECORD_LAYOUT
/begin RECORD_LAYOUT KwbUw FNC_VALUES 1 UWORD COLUMN_DIR DIRECT /end RECORD_LAYOUT
/begin RECORD_LAYOUT KwUb FNC_VALUES 1 UBYTE COLUMN_DIR DIRECT /end RECORD_LAYOUT
/begin RECORD_LAYOUT KwUw FNC_VALUES 1 UWORD COLUMN_DIR DIRECT /end RECORD_LAYOUT
/end MODULE
/end PROJECT
