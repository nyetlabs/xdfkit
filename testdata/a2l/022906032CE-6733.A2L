ASAP2_VERSION 1 3
/begin PROJECT S1103A_25G5_0 "S1103A"
/begin HEADER "" VERSION "S1103A_25G5_0" PROJECT_NO S1103A_25G5_0 /end HEADER
/begin MODULE DIM ""
/begin MOD_COMMON "" BYTE_ORDER MSB_LAST ALIGNMENT_BYTE 1 ALIGNMENT_WORD 2 ALIGNMENT_LONG 2 /end MOD_COMMON
/begin CHARACTERISTIC AFZBKLH "" VALUE 0x8E23AC KwUb 255.0 dez 0.00 255.0 FORMAT "%5.1" /end CHARACTERISTIC
/begin CHARACTERISTIC AFZBKLN "" VALUE 0x8E23AD KwUb 255.0 dez 0.00 255.0 FORMAT "%5.1" /end CHARACTERISTIC
/begin CHARACTERISTIC AFZPTAFX "" VALUE 0x8E2367 KwUb 255.0 dez 0.00 255.0 FORMAT "%5.1" /end CHARACTERISTIC
/begin CHARACTERISTIC AIMVM "" VALUE 0x8FDC4E KwUw 9.999000 fak_uw_q0p001 0.001000000 10.00000 FORMAT "%8.5" /end CHARACTERISTIC
/begin CHARACTERISTIC ALLPTAFX "" VALUE 0x8E2368 KwUb 255.0 dez 0.00 255.0 FORMAT "%5.1" /end CHARACTERISTIC
/begin CHARACTERISTIC ANUDLMN "" VALUE 0x8FCFCC KwUb 255.0 dez 0.00 255.0 FORMAT "%5.1" /end CHARACTERISTIC
/begin CHARACTERISTIC ANZRIBEH "" VALUE 0x8E0C8E KwUb 255.0 dez 0.00 255.0 FORMAT "%5.1" /end CHARACTERISTIC
/begin CHARACTERISTIC ANZRIWZGH "" VALUE 0x8E0C8F KwUb 255.0 dez 0.00 255.0 FORMAT "%5.1" /end CHARACTERISTIC
/begin CHARACTERISTIC CWBWEEN "" VALUE 0x8FCE81 KwUb 255.0 dez 0.00 255.0 FORMAT "%5.1" /end CHARACTERISTIC
/begin CHARACTERISTIC CWGGEGAS "" VALUE 0x8FCF73 KwUb 255.0 dez 0.00 255.0 FORMAT "%5.1" /end CHARACTERISTIC
/begin CHARACTERISTIC CWGGFGRH "" VALUE 0x8FCE80 KwUb 255.0 dez 0.00 255.0 FORMAT "%5.1" /end CHARACTERISTIC
/begin CHARACTERISTIC CWGGLSH "" VALUE 0x8FCE72 KwUb 255.0 dez 0.00 255.0 FORMAT "%5.1" /end CHARACTERISTIC
/begin CHARACTERISTIC CWGGLSU "" VALUE 0x8FD261 KwUb 255.0 dez 0.00 255.0 FORMAT "%5.1" /end CHARACTERISTIC
/begin CHARACTERISTIC CWGGNW "" VALUE 0x8FCE06 KwUb 255.0 dez 0.00 255.0 FORMAT "%5.1" /end CHARACTERISTIC
/begin CHARACTERISTIC CWGGPBKV "" VALUE 0x8FD393 KwUb 255.0 dez 0.00 255.0 FORMAT "%5.1" /end CHARACTERISTIC
/begin CHARACTERISTIC CWGGVFZG "" VALUE 0x8FCE78 KwUb 255.0 dez 0.00 255.0 FORMAT "%5.1" /end CHARACTERISTIC
/begin CHARACTERISTIC CWHFMPUKL1 "" VALUE 0x8FCFC1 KwUb 255.0 dez 0.00 255.0 FORMAT "%5.1" /end CHARACTERISTIC
/begin CHARACTERISTIC CWHFMPUKL2 "" VALUE 0x8FCFC2 KwUb 255.0 dez 0.00 255.0 FORMAT "%5.1" /end CHARACTERISTIC
/begin CHARACTERISTIC CWKHMD "" VALUE 0x8E2484 KwUb 255.0 dez 0.00 255.0 FORMAT "%5.1" /end CHARACTERISTIC
/begin CHARACTERISTIC CWKLDF "" VALUE 0x8E0087 KwUb 255.0 dez 0.00 255.0 FORMAT "%5.1" /end CHARACTERISTIC
/begin CHARACTERISTIC CWKONDTFA "" VALUE 0x8E2369 KwUb 255.0 dez 0.00 255.0 FORMAT "%5.1" /end CHARACTERISTIC
/begin CHARACTERISTIC CWKONGTM "" VALUE 0x8E23AE KwUb 255.0 dez 0.00 255.0 FORMAT "%5.1" /end CHARACTERISTIC
/begin CHARACTERISTIC CWKVHR "" VALUE 0x8E8272 KwUw 65535.00 dez 0.00 65535.00 FORMAT "%8.2" /end CHARACTERISTIC
/begin CHARACTERISTIC CWNWREF "" VALUE 0x8FCE1B KwUb 255.0 dez 0.00 255.0 FORMAT "%5.1" /end CHARACTERISTIC
/begin CHARACTERISTIC CW_TABST "" VALUE 0x8E23AF KwUb 255.0 dez 0.00 255.0 FORMAT "%5.1" /end CHARACTERISTIC
/begin CHARACTERISTIC DFMPERIOMX "" VALUE 0x8E596E KwUw 5.200000 tinjection_sy 6.800000 12.00000 FORMAT "%8.5" /end CHARACTERISTIC
/begin CHARACTERISTIC DKROKD "" VALUE 0x8E24AE KwUb 10200. nmot_ub_q40 0.00 10200. FORMAT "%5.0" /end CHARACTERISTIC
/begin CHARACTERISTIC DKROKMX "" VALUE 0x8FD084 KwUb 4.980 spg_ub_b5 0.00 4.980 FORMAT "%5.3" /end CHARACTERISTIC
/begin CHARACTERISTIC DKROKO "" VALUE 0x8E24AF KwUb 10200. nmot_ub_q40 0.00 10200. FORMAT "%5.0" /end CHARACTERISTIC
/begin CHARACTERISTIC DPBKVBBG "" VALUE 0x8F140A KwUw 7.999878 fak_uw_b8 0.00 7.999878 FORMAT "%8.6" /end CHARACTERISTIC
/begin CHARACTERISTIC DPBKVBSGV0 "" VALUE 0x8F140C KwUw 7.999878 fak_uw_b8 0.00 7.999878 FORMAT "%8.6" /end CHARACTERISTIC
/begin CHARACTERISTIC DPBKVBSGVS "" VALUE 0x8F140E KwUw 7.999878 fak_uw_b8 0.00 7.999878 FORMAT "%8.6" /end CHARACTERISTIC
/begin CHARACTERISTIC DPBKVEBG "" VALUE 0x8F1410 KwUw 7.999878 fak_uw_b8 0.00 7.999878 FORMAT "%8.6" /end CHARACTERISTIC
/begin CHARACTERISTIC DPBKVEBGVS "" VALUE 0x8F1412 KwUw 7.999878 fak_uw_b8 0.00 7.999878 FORMAT "%8.6" /end CHARACTERISTIC
/begin CHARACTERISTIC DPBKVEVK "" VALUE 0x8F1414 KwUw 15.99976 fak_uw_b16 0.00 15.99976 FORMAT "%8.5" /end CHARACTERISTIC
/begin CHARACTERISTIC DPBKVEVKEP "" VALUE 0x8F1416 KwUw 15.99976 fak_uw_b16 0.00 15.99976 FORMAT "%8.5" /end CHARACTERISTIC
/begin CHARACTERISTIC DPBKVEVKSP "" VALUE 0x8F1418 KwUw 15.99976 fak_uw_b16 0.00 15.99976 FORMAT "%8.5" /end CHARACTERISTIC
/begin CHARACTERISTIC DPBKVSTG "" VALUE 0x8F141A KwUw 7.999878 fak_uw_b8 0.00 7.999878 FORMAT "%8.6" /end CHARACTERISTIC
/begin CHARACTERISTIC DPDSVLU "" VALUE 0x8E9B0C KwUw 2559.961 p_uw_q0p039 0.00 2559.961 FORMAT "%8.3" /end CHARACTERISTIC
/begin CHARACTERISTIC DPRHLSU "" VALUE 0x8EDB34 KwSw 100.0000 rel_q0p0061 0.00 100.0000 FORMAT "%8.4" /end CHARACTERISTIC
/begin CHARACTERISTIC DPUPVDK "" CURVE 0x8E9B0E KlAUwSstUwWUw 2559.961 p_uw_q0p039 0.00 2559.961 FORMAT "%8.3"
 /begin AXIS_DESCR STD_AXIS ml_w m_uw_b6553p5 8 0.00 6553.500 FORMAT "%8.3" DEPOSIT ABSOLUTE /end AXIS_DESCR
/end CHARACTERISTIC
/begin CHARACTERISTIC DSUGRAD "" VALUE 0x8E9B30 KwUw 1023.984 dgrad_uw_q0p015 0.00 1023.984 FORMAT "%8.3" /end CHARACTERISTIC
/begin CHARACTERISTIC DSUOFS "" VALUE 0x8E9B32 KwSw 2559.961 p_sw_q0p039 -1280.000 1279.961 FORMAT "%8.3" /end CHARACTERISTIC
/begin CHARACTERISTIC DTAFIX "" VALUE 0x8E236A KwUb 191.3 temp_ub_b191p25 0.00 191.3 FORMAT "%5.1" /end CHARACTERISTIC
/begin CHARACTERISTIC DTKLSUSTA "" VALUE 0x8EDB36 KwUw 1535.977 temp_q0p0234 0.00 1535.977 FORMAT "%8.3" /end CHARACTERISTIC
/begin CHARACTERISTIC DTKLSUSTB "" VALUE 0x8EDB38 KwUw 1535.977 temp_q0p0234 0.00 1535.977 FORMAT "%8.3" /end CHARACTERISTIC
/begin CHARACTERISTIC DTMABDTMN "" VALUE 0x8E23B0 KwUb 191.3 temp_ub_b191p25 0.00 191.3 FORMAT "%5.1" /end CHARACTERISTIC
/begin CHARACTERISTIC DTMDMA "" VALUE 0x8E23B1 KwUb 191.3 temp_ub_b191p25 0.00 191.3 FORMAT "%5.1" /end CHARACTERISTIC
/begin CHARACTERISTIC DTMDNPO "" VALUE 0x8E23B2 KwUb 191.3 temp_ub_b191p25 0.00 191.3 FORMAT "%5.1" /end CHARACTERISTIC
/begin CHARACTERISTIC DTMDZG "" VALUE 0x8E23B3 KwUb 191.3 temp_ub_b191p25 0.00 191.3 FORMAT "%5.1" /end CHARACTERISTIC
/begin CHARACTERISTIC DTMKI "" VALUE 0x8E2434 KwUb 191.3 temp_ub_b191p25 0.00 191.3 FORMAT "%5.1" /end CHARACTERISTIC
/begin CHARACTERISTIC DTMRESDZG "" VALUE 0x8E23B4 KwUb 191.3 temp_ub_b191p25 0.00 191.3 FORMAT "%5.1" /end CHARACTERISTIC
/begin CHARACTERISTIC DTMSRT "" VALUE 0x8E23B5 KwUb 191.3 temp_ub_b191p25 0.00 191.3 FORMAT "%5.1" /end CHARACTERISTIC
/begin CHARACTERISTIC DUDKP1HY "" VALUE 0x8FDC90 KwUw 79.99878 spg_uw_q0p001222 0.00 79.99878 FORMAT "%8.5" /end CHARACTERISTIC
/begin CHARACTERISTIC DUPWGHY "" VALUE 0x8FDC6E KwUw 4.995117 spg_q0p00488 0.00 4.995117 FORMAT "%8.6" /end CHARACTERISTIC
/begin CHARACTERISTIC DUPWGVPE "" VALUE 0x8FDC70 KwUw 319.9951 spg_q0p00488 0.00 319.9951 FORMAT "%8.4" /end CHARACTERISTIC
/begin CHARACTERISTIC DURINLSU "" VALUE 0x8FECD4 KwUw 319.9951 spg_q0p00488 0.00 319.9951 FORMAT "%8.4" /end CHARACTERISTIC
/begin CHARACTERISTIC DUSRIH "" VALUE 0x8FDC2E KwSw 319.9951 spg_sw_q0p00488 -160.0000 159.9951 FORMAT "%8.4" /end CHARACTERISTIC
/begin CHARACTERISTIC DUSSPH "" VALUE 0x8FDC30 KwSw 319.9951 spg_sw_q0p00488 -160.0000 159.9951 FORMAT "%8.4" /end CHARACTERISTIC
/begin CHARACTERISTIC DVFZBEG "" VALUE 0x8FDC50 KwUw 511.9922 vfzg_uw_b512 0.00 511.9922 FORMAT "%8.4" /end CHARACTERISTIC
/begin CHARACTERISTIC DWDK12O "" VALUE 0x8FCE98 KwUb 100.0 relDK_ub_b100 0.00 100.0 FORMAT "%5.1" /end CHARACTERISTIC
/begin CHARACTERISTIC DWDK13O "" VALUE 0x8FCE99 KwUb 100.0 relDK_ub_b100 0.00 100.0 FORMAT "%5.1" /end CHARACTERISTIC
/begin CHARACTERISTIC DWDK23O "" VALUE 0x8FCE9A KwUb 100.0 relDK_ub_b100 0.00 100.0 FORMAT "%5.1" /end CHARACTERISTIC
/begin CHARACTERISTIC DWPMXNB "" VALUE 0x8FDC72 KwUw 100.0000 relPED_q0p00153 0.00 100.0000 FORMAT "%8.4" /end CHARACTERISTIC
/begin CHARACTERISTIC DWPMXNOT "" VALUE 0x8FDC74 KwUw 100.0000 relPED_q0p00153 0.00 100.0000 FORMAT "%8.4" /end CHARACTERISTIC
/begin CHARACTERISTIC DWPOPBP "" VALUE 0x8FDC76 KwUw 100.0000 relPED_q0p00153 0.00 100.0000 FORMAT "%8.4" /end CHARACTERISTIC
/begin CHARACTERISTIC DWPPBP "" VALUE 0x8FDC78 KwUw 100.0000 relPED_q0p00153 0.00 100.0000 FORMAT "%8.4" /end CHARACTERISTIC
/begin CHARACTERISTIC DZZST "" VALUE 0x8FCE1C KwUb 254.0 dez 0.00 254.0 FORMAT "%5.1" /end CHARACTERISTIC
/begin CHARACTERISTIC DZZST2 "" VALUE 0x8FCE1D KwUb 254.0 dez 0.00 254.0 FORMAT "%5.1" /end CHARACTERISTIC
/begin CHARACTERISTIC DZZSTNLP "" VALUE 0x8FCE1E KwUb 254.0 dez 0.00 254.0 FORMAT "%5.1" /end CHARACTERISTIC
/begin CHARACTERISTIC F10SAMP "" VALUE 0x8FD262 KwUb 10.00 grd_q1_ms 0.00 10.00 FORMAT "%5.2" /end CHARACTERISTIC
/begin CHARACTERISTIC F5SAMP "" VALUE 0x8FD263 KwUb 10.00 grd_q1_ms 0.00 10.00 FORMAT "%5.2" /end CHARACTERISTIC
/begin CHARACTERISTIC FABSTT "" CURVE 0x8EAE3E KlAUwSstUwWUw 1.999969 fak_uw_b2 0.00 1.999969 FORMAT "%8.6"
 /begin AXIS_DESCR STD_AXIS tabst_w t1sxs_uw_q1 5 0.00 65535.00 FORMAT "%8.2" DEPOSIT ABSOLUTE /end AXIS_DESCR
/end CHARACTERISTIC
/begin CHARACTERISTIC FARIN "" VALUE 0x8FECD6 KwUw 1023.984 rpspg_q0p0156 0.00 1023.984 FORMAT "%8.3" /end CHARACTERISTIC
/begin CHARACTERISTIC FBKVP "" VALUE 0x8F141C KwUw 1.999969 fak_uw_b2 0.00 1.999969 FORMAT "%8.6" /end CHARACTERISTIC
/begin CHARACTERISTIC FHOE "" VALUE 0x8E138A KwUb 3.984 fak_ub_b4 0.00 3.984 FORMAT "%5.3" /end CHARACTERISTIC
/begin CHARACTERISTIC FIPLSU "" VALUE 0x8FECC4 KwUw 16383.75 ispg_q0p25 0.00 16383.75 FORMAT "%8.2" /end CHARACTERISTIC
/begin CHARACTERISTIC FIPREFLSU "" VALUE 0x8FD264 KwUb 31.88 i_q0p125_uA 0.00 31.88 FORMAT "%5.2" /end CHARACTERISTIC
/begin CHARACTERISTIC FLAMPFT "" CURVE 0x8EDB5A KlAUbSstUwWUw 1.999969 fak_uw_b2 0.00 1.999969 FORMAT "%8.6"
 /begin AXIS_DESCR STD_AXIS palsu_w p_uw_q0p039 10 0.00 2559.961 FORMAT "%8.3" DEPOSIT ABSOLUTE /end AXIS_DESCR
/end CHARACTERISTIC
/begin CHARACTERISTIC FLAMPMR "" CURVE 0x8EDB84 KlAUbSstUwWUw 1.999969 fak_uw_b2 0.00 1.999969 FORMAT "%8.6"
 /begin AXIS_DESCR STD_AXIS palsu_w p_uw_q0p039 10 0.00 2559.961 FORMAT "%8.3" DEPOSIT ABSOLUTE /end AXIS_DESCR
/end CHARACTERISTIC
/begin CHARACTERISTIC FLSUFTKL "" VALUE 0x8FECC6 KwUw 3.999939 fak_uw_b4 0.00 3.999939 FORMAT "%8.6" /end CHARACTERISTIC
/begin CHARACTERISTIC FMDKHFH "" CURVE 0x8EB1A2 KlAUwSstUwWUw 1.999969 fak_uw_b2 0.00 1.999969 FORMAT "%8.6"
 /begin AXIS_DESCR STD_AXIS fho_w fak_uw_b4 4 0.00 3.999939 FORMAT "%8.6" DEPOSIT ABSOLUTE /end AXIS_DESCR
/end CHARACTERISTIC
/begin CHARACTERISTIC FMDKHTMST "" CURVE 0x8E2485 KlAUbSstUbWUb 1.992 fak_ub_b2 0.00 1.992 FORMAT "%5.3"
 /begin AXIS_DESCR STD_AXIS tmst temp_ub_q0p75_o48 8 -48.00 143.3 FORMAT "%5.1" DEPOSIT ABSOLUTE /end AXIS_DESCR
/end CHARACTERISTIC
/begin CHARACTERISTIC FMDPUBKV "" CURVE 0x8EB1B4 KlAUwSstUwWUb 0.9961 fak_ub_b1 0.00 0.9961
 /begin AXIS_DESCR STD_AXIS pubkv_w p_uw_q0p039 6 0.00 2559.961 FORMAT "%8.3" DEPOSIT ABSOLUTE /end AXIS_DESCR
/end CHARACTERISTIC
/begin CHARACTERISTIC FMFKRB0 "" VALUE 0x8E24B0 KwUb 255.0 fmfkr_dez 0.00 255.0 FORMAT "%5.1" /end CHARACTERISTIC
/begin CHARACTERISTIC FMFKRB1 "" VALUE 0x8E24B1 KwUb 255.0 fmfkr_dez 0.00 255.0 FORMAT "%5.1" /end CHARACTERISTIC
/begin CHARACTERISTIC FMFKRB2 "" VALUE 0x8E24B2 KwUb 255.0 fmfkr_dez 0.00 255.0 FORMAT "%5.1" /end CHARACTERISTIC
/begin CHARACTERISTIC FMFKRB3 "" VALUE 0x8E24B3 KwUb 255.0 fmfkr_dez 0.00 255.0 FORMAT "%5.1" /end CHARACTERISTIC
/begin CHARACTERISTIC FNWUEPUHFM "" VALUE 0x8FCFC3 KwUb 0.9961 fak_ub_b1 0.00 0.9961 /end CHARACTERISTIC
/begin CHARACTERISTIC FRINOFH "" VALUE 0x8E0C90 KwUb 15.94 fak_ub_b16 0.00 15.94 FORMAT "%5.2" /end CHARACTERISTIC
/begin CHARACTERISTIC KAFPBKVPU "" CURVE 0x8F141E KlAUwSstUwWUw 1.999969 fak_uw_b2 0.00 1.999969 FORMAT "%8.6"
 /begin AXIS_DESCR STD_AXIS pbkvmpu_w fak_uw_b2 4 0.00 1.999969 FORMAT "%8.6" DEPOSIT ABSOLUTE /end AXIS_DESCR
/end CHARACTERISTIC
/begin CHARACTERISTIC KDHRLSU "" VALUE 0x8EDB3A KwUw 33.33282 reltemp_q5p086Em4 0.00 33.33282 FORMAT "%8.5" /end CHARACTERISTIC
/begin CHARACTERISTIC KEMLN "" CURVE 0x8E24B4 GklWUb 191.3 zw_ub_q0p75 0.00 191.3 FORMAT "%5.1"
 /begin AXIS_DESCR COM_AXIS nmot nmot_ub_q40 16 0.00 10200. FORMAT "%5.0" AXIS_PTS_REF SNM16KRUB /end AXIS_DESCR
/end CHARACTERISTIC
/begin CHARACTERISTIC KFBS "" MAP 0x8EA43C KfAxUbAyUbSstxUbSstyUbWSb 0.4980 fak_sb_b0p25 -0.2500 0.2480
 /begin AXIS_DESCR STD_AXIS nmot nmot_ub_q40 8 0.00 10200. FORMAT "%5.0" DEPOSIT ABSOLUTE /end AXIS_DESCR
 /begin AXIS_DESCR STD_AXIS rl rel_ub_q0p75 8 0.00 191.3 FORMAT "%5.1" DEPOSIT ABSOLUTE /end AXIS_DESCR
/end CHARACTERISTIC
/begin CHARACTERISTIC KFDTMRS "" MAP 0x8EAE54 KfAxUbAyUbSstxUbSstyUbWSb 0.1868 temp_sb_b0p093 -0.09375 0.09302 FORMAT "%7.5"
 /begin AXIS_DESCR STD_AXIS mll1 m_ub_b1020 5 0.00 1020. FORMAT "%5.0" DEPOSIT ABSOLUTE /end AXIS_DESCR
 /begin AXIS_DESCR STD_AXIS tmrw temp_ub_q0p75_o48 4 -48.00 143.3 FORMAT "%5.1" DEPOSIT ABSOLUTE /end AXIS_DESCR
/end CHARACTERISTIC
/begin CHARACTERISTIC KFDTMTE "" MAP 0x8EAE74 KfAxUbAyUbSstxUbSstyUbWSb 0.1868 temp_sb_b0p093 -0.09375 0.09302 FORMAT "%7.5"
 /begin AXIS_DESCR STD_AXIS mll1 m_ub_b1020 5 0.00 1020. FORMAT "%5.0" DEPOSIT ABSOLUTE /end AXIS_DESCR
 /begin AXIS_DESCR STD_AXIS tmew temp_ub_q0p75_o48 4 -48.00 143.3 FORMAT "%5.1" DEPOSIT ABSOLUTE /end AXIS_DESCR
/end CHARACTERISTIC
/begin CHARACTERISTIC KFDTMTR "" MAP 0x8EAE94 KfAxUbAyUbSstxUbSstyUbWSb 0.1868 temp_sb_b0p093 -0.09375 0.09302 FORMAT "%7.5"
 /begin AXIS_DESCR STD_AXIS mll1 m_ub_b1020 5 0.00 1020. FORMAT "%5.0" DEPOSIT ABSOLUTE /end AXIS_DESCR
 /begin AXIS_DESCR STD_AXIS tmrw temp_ub_q0p75_o48 4 -48.00 143.3 FORMAT "%5.1" DEPOSIT ABSOLUTE /end AXIS_DESCR
/end CHARACTERISTIC
/begin CHARACTERISTIC KFDTMTU "" MAP 0x8EAEB4 KfAxUbAyUbSstxUbSstyUbWSb 0.1868 temp_sb_b0p093 -0.09375 0.09302 FORMAT "%7.5"
 /begin AXIS_DESCR STD_AXIS mll1 m_ub_b1020 5 0.00 1020. FORMAT "%5.0" DEPOSIT ABSOLUTE /end AXIS_DESCR
 /begin AXIS_DESCR STD_AXIS tumginp temp_ub_q0p75_o48 4 -48.00 143.3 FORMAT "%5.1" DEPOSIT ABSOLUTE /end AXIS_DESCR
/end CHARACTERISTIC
/begin CHARACTERISTIC KFKHFM "" MAP 0x8E0F17 KfAxUbAyUbSstxUbSstyUbWUb 1.992 fak_ub_b2 0.00 1.992 FORMAT "%5.3"
 /begin AXIS_DESCR STD_AXIS nmot nmot_ub_q40 14 0.00 10200. FORMAT "%5.0" DEPOSIT ABSOLUTE /end AXIS_DESCR
 /begin AXIS_DESCR STD_AXIS rl rel_ub_q0p75 14 0.00 191.3 FORMAT "%5.1" DEPOSIT ABSOLUTE /end AXIS_DESCR
/end CHARACTERISTIC
/begin CHARACTERISTIC KFKWTMP "" MAP 0x8EB1C8 KfAxUwAyUwSstxUwSstyUwWUw 99.99847 rel_uw_b100 0.00 99.99847 FORMAT "%8.5"
 /begin AXIS_DESCR STD_AXIS nmot_w nmot_uw_q0p25 4 0.00 16383.75 FORMAT "%8.2" DEPOSIT ABSOLUTE /end AXIS_DESCR
 /begin AXIS_DESCR STD_AXIS mifakh_w rel_uw_b100 4 0.00 99.99847 FORMAT "%8.5" DEPOSIT ABSOLUTE /end AXIS_DESCR
/end CHARACTERISTIC
/begin CHARACTERISTIC KFMAKR "" MAP 0x8E24C4 GkfWUb 191.3 zw_ub_q0p75 0.00 191.3 FORMAT "%5.1"
 /begin AXIS_DESCR COM_AXIS nmot nmot_ub_q40 16 0.00 10200. FORMAT "%5.0" AXIS_PTS_REF SNM16KRUB /end AXIS_DESCR
 /begin AXIS_DESCR COM_AXIS rl rel_ub_q0p75 4 0.00 191.3 FORMAT "%5.1" AXIS_PTS_REF SRL04KRUB /end AXIS_DESCR
/end CHARACTERISTIC
/begin CHARACTERISTIC KFMDDSLAD "" MAP 0x8EB1FC KfAxUwAyUwSstxUwSstyUwWUw 99.99847 rel_uw_b100 0.00 99.99847 FORMAT "%8.5"
 /begin AXIS_DESCR STD_AXIS mifakh_w rel_uw_b100 4 0.00 99.99847 FORMAT "%8.5" DEPOSIT ABSOLUTE /end AXIS_DESCR
 /begin AXIS_DESCR STD_AXIS nmot_w nmot_uw_q0p25 4 0.00 16383.75 FORMAT "%8.2" DEPOSIT ABSOLUTE /end AXIS_DESCR
/end CHARACTERISTIC
/begin CHARACTERISTIC KFMDDSLFA "" MAP 0x8EB230 KfAxUwAyUwSstxUwSstyUwWUw 99.99847 rel_uw_b100 0.00 99.99847 FORMAT "%8.5"
 /begin AXIS_DESCR STD_AXIS nmot_w nmot_uw_q0p25 4 0.00 16383.75 FORMAT "%8.2" DEPOSIT ABSOLUTE /end AXIS_DESCR
 /begin AXIS_DESCR STD_AXIS mifakh_w rel_uw_b100 4 0.00 99.99847 FORMAT "%8.5" DEPOSIT ABSOLUTE /end AXIS_DESCR
/end CHARACTERISTIC
/begin CHARACTERISTIC KFMDKH "" MAP 0x8EB264 KfAxUwAyUwSstxUwSstyUwWUw 99.99847 rel_uw_b100 0.00 99.99847 FORMAT "%8.5"
 /begin AXIS_DESCR STD_AXIS nmot_w nmot_uw_q0p25 8 0.00 16383.75 FORMAT "%8.2" DEPOSIT ABSOLUTE /end AXIS_DESCR
 /begin AXIS_DESCR STD_AXIS mifakh_w rel_uw_b100 8 0.00 99.99847 FORMAT "%8.5" DEPOSIT ABSOLUTE /end AXIS_DESCR
/end CHARACTERISTIC
/begin CHARACTERISTIC KFMDKHLL "" MAP 0x8EB308 KfAxUwAyUwSstxUwSstyUwWUw 99.99847 rel_uw_b100 0.00 99.99847 FORMAT "%8.5"
 /begin AXIS_DESCR STD_AXIS nmot_w nmot_uw_q0p25 8 0.00 16383.75 FORMAT "%8.2" DEPOSIT ABSOLUTE /end AXIS_DESCR
 /begin AXIS_DESCR STD_AXIS mifakh_w rel_uw_b100 8 0.00 99.99847 FORMAT "%8.5" DEPOSIT ABSOLUTE /end AXIS_DESCR
/end CHARACTERISTIC
/begin CHARACTERISTIC KFPU "" MAP 0x8E0FF9 KfAxUbAyUbSstxUbSstyUbWUb 1.992 fak_ub_b2 0.00 1.992 FORMAT "%5.3"
 /begin AXIS_DESCR STD_AXIS nmotkor nmot_ub_q40 14 0.00 10200. FORMAT "%5.0" DEPOSIT ABSOLUTE /end AXIS_DESCR
 /begin AXIS_DESCR STD_AXIS wdkba relDK_ub_b100 14 0.00 100.0 FORMAT "%5.1" DEPOSIT ABSOLUTE /end AXIS_DESCR
/end CHARACTERISTIC
/begin CHARACTERISTIC KFPUKLP1 "" MAP 0x8E10DB KfAxUbAyUbSstxUbSstyUbWUb 1.992 fak_ub_b2 0.00 1.992 FORMAT "%5.3"
 /begin AXIS_DESCR STD_AXIS nmotkor nmot_ub_q40 14 0.00 10200. FORMAT "%5.0" DEPOSIT ABSOLUTE /end AXIS_DESCR
 /begin AXIS_DESCR STD_AXIS wdkba relDK_ub_b100 14 0.00 100.0 FORMAT "%5.1" DEPOSIT ABSOLUTE /end AXIS_DESCR
/end CHARACTERISTIC
/begin CHARACTERISTIC KFPUKLP12 "" MAP 0x8E11BD KfAxUbAyUbSstxUbSstyUbWUb 1.992 fak_ub_b2 0.00 1.992 FORMAT "%5.3"
 /begin AXIS_DESCR STD_AXIS nmotkor nmot_ub_q40 14 0.00 10200. FORMAT "%5.0" DEPOSIT ABSOLUTE /end AXIS_DESCR
 /begin AXIS_DESCR STD_AXIS wdkba relDK_ub_b100 14 0.00 100.0 FORMAT "%5.1" DEPOSIT ABSOLUTE /end AXIS_DESCR
/end CHARACTERISTIC
/begin CHARACTERISTIC KFPUKLP2 "" MAP 0x8E129F KfAxUbAyUbSstxUbSstyUbWUb 1.992 fak_ub_b2 0.00 1.992 FORMAT "%5.3"
 /begin AXIS_DESCR STD_AXIS nmotkor nmot_ub_q40 14 0.00 10200. FORMAT "%5.0" DEPOSIT ABSOLUTE /end AXIS_DESCR
 /begin AXIS_DESCR STD_AXIS wdkba relDK_ub_b100 14 0.00 100.0 FORMAT "%5.1" DEPOSIT ABSOLUTE /end AXIS_DESCR
/end CHARACTERISTIC
/begin CHARACTERISTIC KFTVKUP "" MAP 0x8E82C2 KfAxUwAyUwSstxUwSstyUwWUw 1310.700 t20msxs_ub_b5p1 0.00 1310.700 FORMAT "%8.3"
 /begin AXIS_DESCR STD_AXIS nmot_w nmot_uw_q0p25 8 0.00 16383.75 FORMAT "%8.2" DEPOSIT ABSOLUTE /end AXIS_DESCR
 /begin AXIS_DESCR STD_AXIS gangi dez 8 0.00 255.0 FORMAT "%5.1" DEPOSIT ABSOLUTE /end AXIS_DESCR
/end CHARACTERISTIC
/begin CHARACTERISTIC KFWDKPP "" MAP 0x8E0DC5 KfAxUbAyUbSstxUbSstyUbWUb 100.0 relDK_ub_b100 0.00 100.0 FORMAT "%5.1"
 /begin AXIS_DESCR STD_AXIS nmot nmot_ub_q40 12 0.00 10200. FORMAT "%5.0" DEPOSIT ABSOLUTE /end AXIS_DESCR
 /begin AXIS_DESCR STD_AXIS rlvppl rel_ub_q0p75 12 0.00 191.3 FORMAT "%5.1" DEPOSIT ABSOLUTE /end AXIS_DESCR
/end CHARACTERISTIC
/begin CHARACTERISTIC KIHRLSU "" VALUE 0x8EDB3C KwUw 16.66641 reltemp_q2p543Em4 0.00 16.66641 FORMAT "%8.5" /end CHARACTERISTIC
/begin CHARACTERISTIC KLDFPWMDEF "" VALUE 0x8FCD1E KwUb 99.61 rel_ub_b99p6 0.00 99.61 FORMAT "%5.2" /end CHARACTERISTIC
/begin CHARACTERISTIC KLDFPWMST "" VALUE 0x8FCD1F KwUb 99.61 rel_ub_b99p6 0.00 99.61 FORMAT "%5.2" /end CHARACTERISTIC
/begin CHARACTERISTIC KLDTMFXTM "" CURVE 0x8E23B6 KlAUbSstUbWUb 191.3 temp_ub_b191p25 0.00 191.3 FORMAT "%5.1"
 /begin AXIS_DESCR STD_AXIS tmotlinlp temp_ub_q0p75_o48 8 -48.00 143.3 FORMAT "%5.1" DEPOSIT ABSOLUTE /end AXIS_DESCR
/end CHARACTERISTIC
/begin CHARACTERISTIC KLDUPW12 "" CURVE 0x8E0DBA KlAUbSstUbWUb 4.980 spg_ub_b5 0.00 4.980 FORMAT "%5.3"
 /begin AXIS_DESCR STD_AXIS upwgmin spg_ub_b5 5 0.00 4.980 FORMAT "%5.3" DEPOSIT ABSOLUTE /end AXIS_DESCR
/end CHARACTERISTIC
/begin CHARACTERISTIC KLITHMS "" CURVE 0x8E23C7 KlAUbSstUbWUb 23.21 m_ub_b23p3 0.00 23.21 FORMAT "%5.2"
 /begin AXIS_DESCR STD_AXIS tmotlinst temp_ub_q0p75_o48 4 -48.00 143.3 FORMAT "%5.1" DEPOSIT ABSOLUTE /end AXIS_DESCR
/end CHARACTERISTIC
/begin CHARACTERISTIC KLKTKVK "" CURVE 0x8EDC4E KlAUbSstSwWUw 1.999969 fak_uw_b2 0.00 1.999969 FORMAT "%8.6"
 /begin AXIS_DESCR STD_AXIS rdtklsu_w temp_q0p0234 11 -768.0000 767.9766 FORMAT "%8.4" DEPOSIT ABSOLUTE /end AXIS_DESCR
/end CHARACTERISTIC
/begin CHARACTERISTIC KLPRHLSU "" CURVE 0x8EDB3E KlAUbSstUwWSw 100.0000 rel_q0p0061 0.00 100.0000 FORMAT "%8.4"
 /begin AXIS_DESCR STD_AXIS tatuk_w temp_q0p0234_o273 4 -273.1500 1262.827 FORMAT "%8.3" DEPOSIT ABSOLUTE /end AXIS_DESCR
/end CHARACTERISTIC
/begin CHARACTERISTIC KLRTLSU "" CURVE 0x8EDBF0 KlAUbSstUwWUw 1535.977 temp_q0p0234_o273 -273.1500 1262.827 FORMAT "%8.3"
 /begin AXIS_DESCR STD_AXIS rinlsu_w r_q0p0391 22 0.00 2559.961 FORMAT "%8.3" DEPOSIT ABSOLUTE /end AXIS_DESCR
/end CHARACTERISTIC
/begin CHARACTERISTIC KLTHMDTMS "" CURVE 0x8E23D0 KlAUbSstUbWUb 191.3 temp_ub_b191p25 0.00 191.3 FORMAT "%5.1"
 /begin AXIS_DESCR STD_AXIS tmotlinst temp_ub_q0p75_o48 5 -48.00 143.3 FORMAT "%5.1" DEPOSIT ABSOLUTE /end AXIS_DESCR
/end CHARACTERISTIC
/begin CHARACTERISTIC KPHRLSU "" VALUE 0x8EDB50 KwUw 33.33282 reltemp_q5p086Em4 0.00 33.33282 FORMAT "%8.5" /end CHARACTERISTIC
/begin CHARACTERISTIC MIFAMXNOT "" CURVE 0x8E0D9E KlAUbSstUbWUb 99.61 rel_ub_b100 0.00 99.61 FORMAT "%5.2"
 /begin AXIS_DESCR STD_AXIS nmot nmot_ub_q40 8 0.00 10200. FORMAT "%5.0" DEPOSIT ABSOLUTE /end AXIS_DESCR
/end CHARACTERISTIC
/begin CHARACTERISTIC MLDTAMN "" VALUE 0x8E236B KwUb 1020. m_ub_b1020 0.00 1020. FORMAT "%5.0" /end CHARACTERISTIC
/begin CHARACTERISTIC MLDTAMX "" VALUE 0x8E236C KwUb 1020. m_ub_b1020 0.00 1020. FORMAT "%5.0" /end CHARACTERISTIC
/begin CHARACTERISTIC MLHFM "" CURVE 0x8FDD7A FklWUw 6553.500 m_uw_b6553p5 0.00 6553.500 FORMAT "%8.3"
 /begin AXIS_DESCR FIX_AXIS uhfm_w spg_uw_q0p00488 512 0.00 4.990234 FORMAT "%8.6" FIX_AXIS_PAR 0 1 512 /end AXIS_DESCR
/end CHARACTERISTIC
/begin CHARACTERISTIC MLMIN "" VALUE 0x8FE17A KwSw 6553.500 m_sw_b3276p8 -3276.800 3276.700 FORMAT "%8.3" /end CHARACTERISTIC
/begin CHARACTERISTIC MLOBKLHV "" CURVE 0x8E23DB KlAUbSstUbWUb 1020. m_ub_b1020 0.00 1020. FORMAT "%5.0"
 /begin AXIS_DESCR STD_AXIS vfzg vfzg_ub_q1p25 5 0.00 318.8 FORMAT "%5.1" DEPOSIT ABSOLUTE /end AXIS_DESCR
/end CHARACTERISTIC
/begin CHARACTERISTIC MLOBKLNV "" CURVE 0x8E23E6 KlAUbSstUbWUb 1020. m_ub_b1020 0.00 1020. FORMAT "%5.0"
 /begin AXIS_DESCR STD_AXIS vfzg vfzg_ub_q1p25 5 0.00 318.8 FORMAT "%5.1" DEPOSIT ABSOLUTE /end AXIS_DESCR
/end CHARACTERISTIC
/begin CHARACTERISTIC MLOFS "" VALUE 0x8FE17C KwUw 6553.500 m_uw_b6553p5 0.00 6553.500 FORMAT "%8.3" /end CHARACTERISTIC
/begin CHARACTERISTIC MLPTAFXO "" VALUE 0x8E236D KwUb 1020. m_ub_b1020 0.00 1020. FORMAT "%5.0" /end CHARACTERISTIC
/begin CHARACTERISTIC MLPTAFXU "" VALUE 0x8E236E KwUb 1020. m_ub_b1020 0.00 1020. FORMAT "%5.0" /end CHARACTERISTIC
/begin CHARACTERISTIC MLUBKLHV "" CURVE 0x8E23F1 KlAUbSstUbWUb 1020. m_ub_b1020 0.00 1020. FORMAT "%5.0"
 /begin AXIS_DESCR STD_AXIS vfzg vfzg_ub_q1p25 5 0.00 318.8 FORMAT "%5.1" DEPOSIT ABSOLUTE /end AXIS_DESCR
/end CHARACTERISTIC
/begin CHARACTERISTIC MLUBKLNV "" CURVE 0x8E23FC KlAUbSstUbWUb 1020. m_ub_b1020 0.00 1020. FORMAT "%5.0"
 /begin AXIS_DESCR STD_AXIS vfzg vfzg_ub_q1p25 5 0.00 318.8 FORMAT "%5.1" DEPOSIT ABSOLUTE /end AXIS_DESCR
/end CHARACTERISTIC
/begin CHARACTERISTIC NDKPPU "" VALUE 0x8FCE9B KwUb 10000. nmot_ub_q40 200.0 10200. FORMAT "%5.0" /end CHARACTERISTIC
/begin CHARACTERISTIC NDSVLO "" VALUE 0x8E138B KwUb 10200. nmot_ub_q40 0.00 10200. FORMAT "%5.0" /end CHARACTERISTIC
/begin CHARACTERISTIC NDSVLU "" VALUE 0x8E138C KwUb 10200. nmot_ub_q40 0.00 10200. FORMAT "%5.0" /end CHARACTERISTIC
/begin CHARACTERISTIC NKRFM1 "" VALUE 0x8E2504 KwUb 10200. nmot_ub_q40 0.00 10200. FORMAT "%5.0" /end CHARACTERISTIC
/begin CHARACTERISTIC NKRFM2 "" VALUE 0x8E2505 KwUb 10200. nmot_ub_q40 0.00 10200. FORMAT "%5.0" /end CHARACTERISTIC
/begin CHARACTERISTIC NKRFM3 "" VALUE 0x8E2506 KwUb 10200. nmot_ub_q40 0.00 10200. FORMAT "%5.0" /end CHARACTERISTIC
/begin CHARACTERISTIC NMIN "" VALUE 0x8FDBF2 KwUw 16383.75 nmot_uw_q0p25 0.00 16383.75 FORMAT "%8.2" /end CHARACTERISTIC
/begin CHARACTERISTIC NMINMBVH "" VALUE 0x8E0DAF KwUb 10200. nmot_ub_q40 0.00 10200. FORMAT "%5.0" /end CHARACTERISTIC
/begin CHARACTERISTIC NMOTQSYN "" VALUE 0x8FDBF4 KwUw 700.0000 nmot_uw_q0p25 0.00 700.0000 FORMAT "%8.4" /end CHARACTERISTIC
/begin CHARACTERISTIC NSPWGBRPL "" VALUE 0x8E0DB0 KwUb 10200. nmot_ub_q40 0.00 10200. FORMAT "%5.0" /end CHARACTERISTIC
/begin CHARACTERISTIC NSPWGNOT1 "" VALUE 0x8E0DB1 KwUb 10200. nmot_ub_q40 0.00 10200. FORMAT "%5.0" /end CHARACTERISTIC
/begin CHARACTERISTIC NSPWGNOT2 "" VALUE 0x8E0DB2 KwUb 10200. nmot_ub_q40 0.00 10200. FORMAT "%5.0" /end CHARACTERISTIC
/begin CHARACTERISTIC NSPWGNOT3 "" VALUE 0x8E0DB3 KwUb 10200. nmot_ub_q40 0.00 10200. FORMAT "%5.0" /end CHARACTERISTIC
/begin CHARACTERISTIC NTHRESHOLD "" VALUE 0x8FCD20 KwUb 7600. nmot_ub_q40 400.0 8000. FORMAT "%5.0" /end CHARACTERISTIC
/begin CHARACTERISTIC NVGDSLL "" VALUE 0x8E138D KwUb 10200. nmot_ub_q40 0.00 10200. FORMAT "%5.0" /end CHARACTERISTIC
/begin CHARACTERISTIC NWDK3 "" VALUE 0x8FCE9C KwUb 10000. nmot_ub_q40 200.0 10200. FORMAT "%5.0" /end CHARACTERISTIC
/begin CHARACTERISTIC NWPMBBR "" VALUE 0x8FCE82 KwUb 10200. nmot_ub_q40 0.00 10200. FORMAT "%5.0" /end CHARACTERISTIC
/begin CHARACTERISTIC O2VK "" CURVE 0x8EDBAE KlAUbSstSwWSw 63.99902 relO2_q9p765Em4 -32.00000 31.99902 FORMAT "%8.5"
 /begin AXIS_DESCR STD_AXIS ipktk_w i_q1_uA 16 -32768.00 32767.00 FORMAT "%8.2" DEPOSIT ABSOLUTE /end AXIS_DESCR
/end CHARACTERISTIC
/begin CHARACTERISTIC OFQSYNADAP "" VALUE 0x8FDBF6 KwSw 72.00000 kw_q0p0156 -36.00000 36.00000 FORMAT "%8.5" /end CHARACTERISTIC
/begin CHARACTERISTIC PBKVVSTGPV "" CURVE 0x8F1430 KlAUwSstUwWUw 2559.961 p_uw_q0p039 0.00 2559.961 FORMAT "%8.3"
 /begin AXIS_DESCR STD_AXIS dpspvdkd_w p_uw_q0p039 6 0.00 2559.961 FORMAT "%8.3" DEPOSIT ABSOLUTE /end AXIS_DESCR
/end CHARACTERISTIC
/begin CHARACTERISTIC PHLSNHMN "" VALUE 0x8E0D6C KwUb 2.550 fak_ub_q0p01 0.00 2.550 FORMAT "%5.3" /end CHARACTERISTIC
/begin CHARACTERISTIC PHNMO "" VALUE 0x8E090A KwUb 10200. nmot_ub_q40 0.00 10200. FORMAT "%5.0" /end CHARACTERISTIC
/begin CHARACTERISTIC PHNMU "" VALUE 0x8E090B KwUb 10200. nmot_ub_q40 0.00 10200. FORMAT "%5.0" /end CHARACTERISTIC
/begin CHARACTERISTIC PH_MINSEG "" VALUE 0x8FCE1F KwUb 90.00 kw_tooth_sy 0.00 90.00 FORMAT "%5.2" /end CHARACTERISTIC
/begin CHARACTERISTIC PRHLSUL "" VALUE 0x8EDB52 KwUw 199.9969 rel_uw_b200 0.00 199.9969 FORMAT "%8.4" /end CHARACTERISTIC
/begin CHARACTERISTIC PUE "" VALUE 0x8E9B34 KwUw 2559.961 p_uw_q0p039 0.00 2559.961 FORMAT "%8.3" /end CHARACTERISTIC
/begin CHARACTERISTIC PUEBKV "" VALUE 0x8F144A KwUw 1279.961 p_uw_q0p039 0.00 1279.961 FORMAT "%8.3" /end CHARACTERISTIC
/begin CHARACTERISTIC PUKANS "" CURVE 0x8E0F06 KlAUbSstUbWUb 1.992 fak_ub_b2 0.00 1.992 FORMAT "%5.3"
 /begin AXIS_DESCR STD_AXIS tans temp_ub_q0p75_o48 8 -48.00 143.3 FORMAT "%5.1" DEPOSIT ABSOLUTE /end AXIS_DESCR
/end CHARACTERISTIC
/begin CHARACTERISTIC PUMN "" VALUE 0x8E9B36 KwUw 2559.961 p_uw_q0p039 0.00 2559.961 FORMAT "%8.3" /end CHARACTERISTIC
/begin CHARACTERISTIC PUMX "" VALUE 0x8E9B38 KwUw 2559.961 p_uw_q0p039 0.00 2559.961 FORMAT "%8.3" /end CHARACTERISTIC
/begin CHARACTERISTIC PUSPSMX "" VALUE 0x8E9B3A KwUw 2559.961 p_uw_q0p039 0.00 2559.961 FORMAT "%8.3" /end CHARACTERISTIC
/begin CHARACTERISTIC PVDKPUD "" VALUE 0x8E138E KwUb 2550. p_ub_q10 0.00 2550. FORMAT "%5.0" /end CHARACTERISTIC
/begin CHARACTERISTIC PWGDEMX "" VALUE 0x8E0DB4 KwUb 255.0 dez 0.00 255.0 FORMAT "%5.1" /end CHARACTERISTIC
/begin CHARACTERISTIC PWMRAMPINC "" VALUE 0x8FCD21 KwUb 49.61 rel_ub_b99p6 0.3906 50.00 FORMAT "%5.2" /end CHARACTERISTIC
/begin CHARACTERISTIC RBELH "" VALUE 0x8E801C KwUw 131070.0 r_uw_q2 0.00 131070.0 FORMAT "%8.1" /end CHARACTERISTIC
/begin CHARACTERISTIC RINCAL "" VALUE 0x8FECD8 KwUw 2559.961 r_q0p0391 0.00 2559.961 FORMAT "%8.3" /end CHARACTERISTIC
/begin CHARACTERISTIC RINHMX "" VALUE 0x8E801E KwUw 131070.0 r_uw_q2 0.00 131070.0 FORMAT "%8.1" /end CHARACTERISTIC
/begin CHARACTERISTIC RININI "" VALUE 0x8FECDA KwUw 2559.961 r_q0p0391 0.00 2559.961 FORMAT "%8.3" /end CHARACTERISTIC
/begin CHARACTERISTIC RKSPH "" VALUE 0x8E8020 KwUw 131070.0 r_uw_q2 0.00 131070.0 FORMAT "%8.1" /end CHARACTERISTIC
/begin CHARACTERISTIC SEGMANSW "" VALUE 0x8FD265 KwUb 20.00 t1msxms_q1 0.00 20.00 FORMAT "%5.2" /end CHARACTERISTIC
/begin CHARACTERISTIC SENZZYL "" VAL_BLK 0x8E2507 KwbUb 3.000 dezsub1 1.000 4.000 FORMAT "%5.3" NUMBER 8 /end CHARACTERISTIC
/begin CHARACTERISTIC SGIDB4 "" ASCII 0x8E0055 KtxC 255.0 defaultAscii 0.00 255.0 NUMBER 10 /end CHARACTERISTIC
/begin CHARACTERISTIC SGIDB5 "" ASCII 0x8E0060 KtxC 255.0 defaultAscii 0.00 255.0 NUMBER 10 /end CHARACTERISTIC
/begin CHARACTERISTIC SGIDB6 "" ASCII 0x8E006B KtxC 255.0 defaultAscii 0.00 255.0 NUMBER 7 /end CHARACTERISTIC
/begin CHARACTERISTIC SGIDB7 "" ASCII 0x8E0073 KtxC 255.0 defaultAscii 0.00 255.0 NUMBER 11 /end CHARACTERISTIC
/begin CHARACTERISTIC SGIDK1_DAT "" ASCII 0x8E007F KtxC 255.0 defaultAscii 0.00 255.0 NUMBER 5 /end CHARACTERISTIC
/begin AXIS_PTS SNM16KRUB "" 0x8E011B nmot SstAUbSstUb 10200. nmot_ub_q40 16 0.00 10200. FORMAT "%5.0" DEPOSIT ABSOLUTE /end AXIS_PTS
/begin AXIS_PTS SRL04KRUB "" 0x8E0130 rl SstAUbSstUb 191.3 rel_ub_q0p75 4 0.00 191.3 FORMAT "%5.1" DEPOSIT ABSOLUTE /end AXIS_PTS
/begin AXIS_PTS STM05EPMSB "" 0x8E090C tmot SstAUbSstUb 191.3 temp_ub_q0p75_o48 5 -48.00 143.3 FORMAT "%5.1" DEPOSIT ABSOLUTE /end AXIS_PTS
/begin CHARACTERISTIC TABGL "" VALUE 0x8FECC8 KwUw 655.3500 t10msxs_uw_b655p35 0.00 655.3500 FORMAT "%8.4" /end CHARACTERISTIC
/begin CHARACTERISTIC TABGS "" VALUE 0x8FECCA KwUw 655.3500 t10msxs_uw_b655p35 0.00 655.3500 FORMAT "%8.4" /end CHARACTERISTIC
/begin CHARACTERISTIC TABSMADTM "" VALUE 0x8EAED4 KwUw 65535.00 t1sxs_uw_q1 0.00 65535.00 FORMAT "%8.2" /end CHARACTERISTIC
/begin CHARACTERISTIC TABSTRILSU "" VALUE 0x8EDB54 KwUw 65535.00 t1sxs_uw_q1 0.00 65535.00 FORMAT "%8.2" /end CHARACTERISTIC
/begin CHARACTERISTIC TADE "" VALUE 0x8E236F KwUb 191.3 temp_ub_q0p75_o48 -48.00 143.3 FORMAT "%5.1" /end CHARACTERISTIC
/begin CHARACTERISTIC TADMM "" VALUE 0x8EAED6 KwUw 6553.500 t100msxs_uw_b6553p5 0.00 6553.500 FORMAT "%8.3" /end CHARACTERISTIC
/begin CHARACTERISTIC TADMN "" VALUE 0x8E2370 KwUb 191.3 temp_ub_q0p75_o48 -48.00 143.3 FORMAT "%5.1" /end CHARACTERISTIC
/begin CHARACTERISTIC TADMX "" VALUE 0x8E2371 KwUb 191.3 temp_ub_q0p75_o48 -48.00 143.3 FORMAT "%5.1" /end CHARACTERISTIC
/begin CHARACTERISTIC TADPLMX "" VALUE 0x8E2372 KwUb 191.3 temp_ub_q0p75_o48 -48.00 143.3 FORMAT "%5.1" /end CHARACTERISTIC
/begin CHARACTERISTIC TANDT1 "" CURVE 0x8E2407 KlAUbSstUbWUb 191.3 temp_ub_b191p25 0.00 191.3 FORMAT "%5.1"
 /begin AXIS_DESCR STD_AXIS tansab temp_ub_q0p75_o48 8 -48.00 143.3 FORMAT "%5.1" DEPOSIT ABSOLUTE /end AXIS_DESCR
/end CHARACTERISTIC
/begin CHARACTERISTIC TANH1 "" VALUE 0x8E2418 KwUb 191.3 temp_ub_q0p75_o48 -48.00 143.3 FORMAT "%5.1" /end CHARACTERISTIC
/begin CHARACTERISTIC TANHKMMN "" VALUE 0x8E8180 KwUw 1535.977 temp_q0p0234_o273 -273.1500 1262.827 FORMAT "%8.3" /end CHARACTERISTIC
/begin CHARACTERISTIC TANSELI "" CURVE 0x8E2373 KlAUbSstUbWUb 191.3 temp_ub_q0p75_o48 -48.00 143.3 FORMAT "%5.1"
 /begin AXIS_DESCR STD_AXIS wtans spg_ub_b5 20 0.00 4.980 FORMAT "%5.3" DEPOSIT ABSOLUTE /end AXIS_DESCR
/end CHARACTERISTIC
/begin CHARACTERISTIC TBKVP "" VALUE 0x8E3FE8 KwUb 12.7498 zk50msxs_ub_b12p8 0.0501961 12.8000 FORMAT "%7.4" /end CHARACTERISTIC
/begin CHARACTERISTIC TDAPTUBR "" VALUE 0x8E0D7F KwUb 25.50 t100msxs_ub_b25p5 0.00 25.50 FORMAT "%5.2" /end CHARACTERISTIC
/begin CHARACTERISTIC TDBKLOFF "" VALUE 0x8E2419 KwUb 25.40 t100msxs_ub_b25p5 0.1000 25.50 FORMAT "%5.2" /end CHARACTERISTIC
/begin CHARACTERISTIC TDDFU "" VALUE 0x8E138F KwUb 25.50 t100msxs_ub_b25p5 0.00 25.50 FORMAT "%5.2" /end CHARACTERISTIC
/begin CHARACTERISTIC TDDFUUGD "" VALUE 0x8E1390 KwUb 25.50 t100msxs_ub_b25p5 0.00 25.50 FORMAT "%5.2" /end CHARACTERISTIC
/begin CHARACTERISTIC TDFZTAFX "" VALUE 0x8E239C KwUb 255.0 t1sxs_ub_b255 0.00 255.0 FORMAT "%5.1" /end CHARACTERISTIC
/begin CHARACTERISTIC TDHREVAB "" VALUE 0x8E0D80 KwUb 25.50 t100msxs_ub_b25p5 0.00 25.50 FORMAT "%5.2" /end CHARACTERISTIC
/begin CHARACTERISTIC TDKPAW "" VALUE 0x8FCE9D KwUb 2.540 t10msxs_ub_b2p55 0.01000 2.550 FORMAT "%5.3" /end CHARACTERISTIC
/begin CHARACTERISTIC TDLLTAFX "" VALUE 0x8E239D KwUb 255.0 t1sxs_ub_b255 0.00 255.0 FORMAT "%5.1" /end CHARACTERISTIC
/begin CHARACTERISTIC TDNSTA "" VALUE 0x8E239E KwUb 255.0 t1sxs_ub_b255 0.00 255.0 FORMAT "%5.1" /end CHARACTERISTIC
/begin CHARACTERISTIC TDNSUB "" VALUE 0x8FDC66 KwUw 6553.500 t100msxs_uw_b6553p5 0.00 6553.500 FORMAT "%8.3" /end CHARACTERISTIC
/begin CHARACTERISTIC TDPLTAO "" VALUE 0x8E239F KwUb 255.0 t1sxs_ub_b255 0.00 255.0 FORMAT "%5.1" /end CHARACTERISTIC
/begin CHARACTERISTIC TDRFZTAFX "" VALUE 0x8E23A0 KwUb 255.0 t1sxs_ub_b255 0.00 255.0 FORMAT "%5.1" /end CHARACTERISTIC
/begin CHARACTERISTIC TDRNLUBR "" VALUE 0x8E0D81 KwUb 25.50 t100msxs_ub_b25p5 0.00 25.50 FORMAT "%5.2" /end CHARACTERISTIC
/begin CHARACTERISTIC TDRPLTAO "" VALUE 0x8E23A1 KwUb 255.0 t1sxs_ub_b255 0.00 255.0 FORMAT "%5.1" /end CHARACTERISTIC
/begin CHARACTERISTIC TDTA "" VALUE 0x8E23A2 KwUb 25.50 t100msxs_ub_b25p5 0.00 25.50 FORMAT "%5.2" /end CHARACTERISTIC
/begin CHARACTERISTIC TDTAL "" VALUE 0x8E23A3 KwUb 255.0 t1sxs_ub_b255 0.00 255.0 FORMAT "%5.1" /end CHARACTERISTIC
/begin CHARACTERISTIC TDTKAUS "" VALUE 0x8E4D74 KwUb 25.50 t100msxs_ub_b25p5 0.00 25.50 FORMAT "%5.2" /end CHARACTERISTIC
/begin CHARACTERISTIC TDTM "" VALUE 0x8EAED8 KwUw 6553.500 t100msxs_uw_b6553p5 0.00 6553.500 FORMAT "%8.3" /end CHARACTERISTIC
/begin CHARACTERISTIC TDTMMA "" VALUE 0x8EAEDA KwUw 6553.500 t100msxs_uw_b6553p5 0.00 6553.500 FORMAT "%8.3" /end CHARACTERISTIC
/begin CHARACTERISTIC TDTMNP "" VALUE 0x8EAEDC KwUw 6553.500 t100msxs_uw_b6553p5 0.00 6553.500 FORMAT "%8.3" /end CHARACTERISTIC
/begin CHARACTERISTIC TDTMNPO "" VALUE 0x8E241A KwUb 25.50 t100msxs_ub_b25p5 0.00 25.50 FORMAT "%5.2" /end CHARACTERISTIC
/begin CHARACTERISTIC TDTMPOG "" VALUE 0x8E241B KwUb 25.50 t100msxs_ub_b25p5 0.00 25.50 FORMAT "%5.2" /end CHARACTERISTIC
/begin CHARACTERISTIC TDUB "" VALUE 0x8FCE7A KwUb 25.50 t100msxs_ub_b25p5 0.00 25.50 FORMAT "%5.2" /end CHARACTERISTIC
/begin CHARACTERISTIC TDUBR "" VALUE 0x8E0D82 KwUb 25.50 t100msxs_ub_b25p5 0.00 25.50 FORMAT "%5.2" /end CHARACTERISTIC
/begin CHARACTERISTIC TDUBRNL "" VALUE 0x8E0D83 KwUb 25.40 t100msxs_ub_b25p5 0.1000 25.50 FORMAT "%5.2" /end CHARACTERISTIC
/begin CHARACTERISTIC TDVGDSLL "" VALUE 0x8E1391 KwUb 25.50 t100msxs_ub_b25p5 0.00 25.50 FORMAT "%5.2" /end CHARACTERISTIC
/begin CHARACTERISTIC TDWPOPBP "" VALUE 0x8FCE83 KwUb 2.550 t_q0p01 0.00 2.550 FORMAT "%5.3" /end CHARACTERISTIC
/begin CHARACTERISTIC TEBBREMS "" VALUE 0x8E3FE9 KwUb 0.5000 t50msxs_q0p05 0.00 0.5000 /end CHARACTERISTIC
/begin CHARACTERISTIC TEPBRKUP "" VALUE 0x8FCF74 KwUb 5.100 t20msxs_ub_b5p1 0.00 5.100 FORMAT "%5.3" /end CHARACTERISTIC
/begin CHARACTERISTIC TEPFGRH "" VALUE 0x8E0D96 KwUb 5.100 t20msxs_ub_b5p1 0.00 5.100 FORMAT "%5.3" /end CHARACTERISTIC
/begin CHARACTERISTIC TFGRABTE "" VALUE 0x8E0D97 KwUb 5.100 t20msxs_ub_b5p1 0.00 5.100 FORMAT "%5.3" /end CHARACTERISTIC
/begin CHARACTERISTIC TFGRHE "" VALUE 0x8E0D98 KwUb 5.100 t20msxs_ub_b5p1 0.00 5.100 FORMAT "%5.3" /end CHARACTERISTIC
/begin CHARACTERISTIC TFGRHSNP "" VALUE 0x8E0D99 KwUb 5.100 t20msxs_ub_b5p1 0.00 5.100 FORMAT "%5.3" /end CHARACTERISTIC
/begin CHARACTERISTIC TFGRTIP "" VALUE 0x8E0D9A KwUb 5.100 t20msxs_ub_b5p1 0.00 5.100 FORMAT "%5.3" /end CHARACTERISTIC
/begin CHARACTERISTIC TFGRVRAB "" VALUE 0x8FCE79 KwUb 5.100 t20msxs_ub_b5p1 0.00 5.100 FORMAT "%5.3" /end CHARACTERISTIC
/begin CHARACTERISTIC TFWDKPN "" CURVE 0x8E0E6F KlAUbSstUbWUb 2.54000 zk10msxs_ub_b2p55 0.0100000 2.55000 FORMAT "%7.5"
 /begin AXIS_DESCR STD_AXIS nmot nmot_ub_q40 6 0.00 10200. FORMAT "%5.0" DEPOSIT ABSOLUTE /end AXIS_DESCR
/end CHARACTERISTIC
/begin CHARACTERISTIC THHA "" VALUE 0x8E0D6D KwUb 2.550 t10msxs_q0p01_o0p05 -0.05000 2.500 FORMAT "%5.3" /end CHARACTERISTIC
/begin CHARACTERISTIC THHA2 "" VALUE 0x8E0D6E KwUb 2.550 t10msxs_q0p01_o0p05 -0.05000 2.500 FORMAT "%5.3" /end CHARACTERISTIC
/begin CHARACTERISTIC THHAWU "" VALUE 0x8E0D6F KwUb 2.550 t10msxs_ub_b2p55 0.00 2.550 FORMAT "%5.3" /end CHARACTERISTIC
/begin CHARACTERISTIC THLSUHR "" VALUE 0x8E3506 KwUb 25.50 t100msxs_ub_b25p5 0.00 25.50 FORMAT "%5.2" /end CHARACTERISTIC
/begin CHARACTERISTIC THLSUHRST "" VALUE 0x8E3507 KwUb 25.50 t100msxs_ub_b25p5 0.00 25.50 FORMAT "%5.2" /end CHARACTERISTIC
/begin CHARACTERISTIC THPHADR "" VALUE 0x8FDBDE KwUw 255.0000 kw_q0p0039 0.00 255.0000 FORMAT "%8.4" /end CHARACTERISTIC
/begin CHARACTERISTIC THPHADS "" VALUE 0x8FDBE0 KwUw 255.0000 kw_q0p0039 0.00 255.0000 FORMAT "%8.4" /end CHARACTERISTIC
/begin CHARACTERISTIC THSHA "" VALUE 0x8E0D70 KwUb 25.50 t100msxs_ub_b25p5 0.00 25.50 FORMAT "%5.2" /end CHARACTERISTIC
/begin CHARACTERISTIC THSHKTK "" CURVE 0x8E8182 KlAUbSstUwWUb 2.550 t10msxs_q0p01_o0p05 -0.05000 2.500 FORMAT "%5.3"
 /begin AXIS_DESCR STD_AXIS tanhkm_w temp_q0p0234_o273 8 -273.1500 1262.827 FORMAT "%8.3" DEPOSIT ABSOLUTE /end AXIS_DESCR
/end CHARACTERISTIC
/begin CHARACTERISTIC THSHKTK2 "" CURVE 0x8E819C KlAUbSstUwWUb 2.550 t10msxs_q0p01_o0p05 -0.05000 2.500 FORMAT "%5.3"
 /begin AXIS_DESCR STD_AXIS tanhkm2_w temp_q0p0234_o273 8 -273.1500 1262.827 FORMAT "%8.3" DEPOSIT ABSOLUTE /end AXIS_DESCR
/end CHARACTERISTIC
/begin CHARACTERISTIC THSRIH "" VALUE 0x8FDC32 KwUw 655.3500 t10msxs_uw_b655p35 0.00 655.3500 FORMAT "%8.4" /end CHARACTERISTIC
/begin CHARACTERISTIC TIDLEMAX "" VALUE 0x8E27D5 KwUb 0.00 t100msxs_ub_b25p5 10.00 10.00 FORMAT "%5.2" /end CHARACTERISTIC
/begin CHARACTERISTIC TIDLEMIN "" VALUE 0x8E27D6 KwUb 0.00 t100msxs_ub_b25p5 2.300 2.300 FORMAT "%5.3" /end CHARACTERISTIC
/begin CHARACTERISTIC TKAELI "" CURVE 0x8E4D75 KlAUbSstUbWUb 191.3 temp_ub_q0p75_o48 -48.00 143.3 FORMAT "%5.1"
 /begin AXIS_DESCR STD_AXIS wtka spg_ub_b5 20 0.00 4.980 FORMAT "%5.3" DEPOSIT ABSOLUTE /end AXIS_DESCR
/end CHARACTERISTIC
/begin CHARACTERISTIC TKAUSDE "" VALUE 0x8E4D9E KwUb 191.3 temp_ub_q0p75_o48 -48.00 143.3 FORMAT "%5.1" /end CHARACTERISTIC
/begin CHARACTERISTIC TKAUSDMN "" VALUE 0x8E4D9F KwUb 191.3 temp_ub_q0p75_o48 -48.00 143.3 FORMAT "%5.1" /end CHARACTERISTIC
/begin CHARACTERISTIC TKAUSDMX "" VALUE 0x8E4DA0 KwUb 191.3 temp_ub_q0p75_o48 -48.00 143.3 FORMAT "%5.1" /end CHARACTERISTIC
/begin CHARACTERISTIC TKERENSCUN "" VALUE 0x8EDC4A KwUw 1535.977 temp_q0p0234_o273 -273.1500 1262.827 FORMAT "%8.3" /end CHARACTERISTIC
/begin CHARACTERISTIC TKERLSPSF "" VALUE 0x8EDC4C KwUw 1535.977 temp_q0p0234_o273 -273.1500 1262.827 FORMAT "%8.3" /end CHARACTERISTIC
/begin CHARACTERISTIC TKERLSUS "" VALUE 0x8EDB56 KwUw 1535.977 temp_q0p0234_o273 -273.1500 1262.827 FORMAT "%8.3" /end CHARACTERISTIC
/begin CHARACTERISTIC TKERLSUST "" VALUE 0x8EDB58 KwUw 1535.977 temp_q0p0234_o273 -273.1500 1262.827 FORMAT "%8.3" /end CHARACTERISTIC
/begin CHARACTERISTIC TKLDFINI "" VALUE 0x8E0088 KwUb 5.100 t20msxs_ub_b5p1 0.00 5.100 FORMAT "%5.3" /end CHARACTERISTIC
/begin CHARACTERISTIC TKLDFPWMDF "" VALUE 0x8E5970 KwUw 1310.700 t20msxs_uw_b1310 0.00 1310.700 FORMAT "%8.3" /end CHARACTERISTIC
/begin CHARACTERISTIC TMABDTA1MN "" VALUE 0x8E23A4 KwUb 191.3 temp_ub_q0p75_o48 -48.00 143.3 FORMAT "%5.1" /end CHARACTERISTIC
/begin CHARACTERISTIC TMABDTMN "" VALUE 0x8E241C KwUb 103.5 temp_ub_q0p75_o48 39.75 143.3 FORMAT "%5.1" /end CHARACTERISTIC
/begin CHARACTERISTIC TMBVH "" VALUE 0x8E8298 KwUw 6553.500 t_q0p1 0.00 6553.500 FORMAT "%8.3" /end CHARACTERISTIC
/begin CHARACTERISTIC TMCC650 "" VALUE 0x8E250F KwUb 255.0 dez 0.00 255.0 FORMAT "%5.1" /end CHARACTERISTIC
/begin CHARACTERISTIC TMDMMA "" VALUE 0x8E241D KwUb 191.3 temp_ub_q0p75_o48 -48.00 143.3 FORMAT "%5.1" /end CHARACTERISTIC
/begin CHARACTERISTIC TMDMMAT "" CURVE 0x8EAEDE KlAUwSstUwWUw 191.2500 temp_ub_q0p75_o48 -48.00000 143.2500 FORMAT "%8.4"
 /begin AXIS_DESCR STD_AXIS tabst_w t1sxs_uw_q1 3 0.00 65535.00 FORMAT "%8.2" DEPOSIT ABSOLUTE /end AXIS_DESCR
/end CHARACTERISTIC
/begin CHARACTERISTIC TMDMMAU "" VALUE 0x8E241E KwUb 191.3 temp_ub_q0p75_o48 -48.00 143.3 FORMAT "%5.1" /end CHARACTERISTIC
/begin CHARACTERISTIC TMDMMEE "" VALUE 0x8E241F KwUb 191.3 temp_ub_q0p75_o48 -48.00 143.3 FORMAT "%5.1" /end CHARACTERISTIC
/begin CHARACTERISTIC TMDMMER "" VALUE 0x8E2420 KwUb 191.3 temp_ub_q0p75_o48 -48.00 143.3 FORMAT "%5.1" /end CHARACTERISTIC
/begin CHARACTERISTIC TMDMN "" VALUE 0x8E2421 KwUb 191.3 temp_ub_q0p75_o48 -48.00 143.3 FORMAT "%5.1" /end CHARACTERISTIC
/begin CHARACTERISTIC TMDMX "" VALUE 0x8E2422 KwUb 191.3 temp_ub_q0p75_o48 -48.00 143.3 FORMAT "%5.1" /end CHARACTERISTIC
/begin CHARACTERISTIC TMDZGMN "" VALUE 0x8E2423 KwUb 191.3 temp_ub_q0p75_o48 -48.00 143.3 FORMAT "%5.1" /end CHARACTERISTIC
/begin CHARACTERISTIC TMELIPU1 "" CURVE 0x8EAEEC KlAUwSstUwWUw 191.9971 temp_uw_q0p0029_o48 -48.00000 143.9971 FORMAT "%8.4"
 /begin AXIS_DESCR STD_AXIS wtmot_w spg_uw_q0p00488 20 0.00 319.9951 FORMAT "%8.4" DEPOSIT ABSOLUTE /end AXIS_DESCR
/end CHARACTERISTIC
/begin CHARACTERISTIC TMESSCMN "" VALUE 0x8E2424 KwUb 191.3 temp_ub_q0p75_o48 -48.00 143.3 FORMAT "%5.1" /end CHARACTERISTIC
/begin CHARACTERISTIC TMKIMN "" VALUE 0x8E2435 KwUb 191.3 temp_ub_q0p75_o48 -48.00 143.3 FORMAT "%5.1" /end CHARACTERISTIC
/begin CHARACTERISTIC TMMXRT "" VALUE 0x8E2425 KwUb 191.3 temp_ub_q0p75_o48 -48.00 143.3 FORMAT "%5.1" /end CHARACTERISTIC
/begin CHARACTERISTIC TMOTELI "" CURVE 0x8EAF3E KlAUwSstUwWUw 191.9971 temp_uw_q0p0029_o48 -48.00000 143.9971 FORMAT "%8.4"
 /begin AXIS_DESCR STD_AXIS wtmot_w spg_uw_q0p00488 20 0.00 319.9951 FORMAT "%8.4" DEPOSIT ABSOLUTE /end AXIS_DESCR
/end CHARACTERISTIC
/begin CHARACTERISTIC TMPTAFXMN "" VALUE 0x8E23A5 KwUb 191.3 temp_ub_q0p75_o48 -48.00 143.3 FORMAT "%5.1" /end CHARACTERISTIC
/begin CHARACTERISTIC TMPTAFXU "" VALUE 0x8E23A6 KwUb 191.3 temp_ub_q0p75_o48 -48.00 143.3 FORMAT "%5.1" /end CHARACTERISTIC
/begin CHARACTERISTIC TMPUPOFF "" VALUE 0x8E2426 KwUb 191.3 temp_ub_q0p75_o48 -48.00 143.3 FORMAT "%5.1" /end CHARACTERISTIC
/begin CHARACTERISTIC TMPUPON "" VALUE 0x8E2427 KwUb 191.3 temp_ub_q0p75_o48 -48.00 143.3 FORMAT "%5.1" /end CHARACTERISTIC
/begin CHARACTERISTIC TMQSYN "" VALUE 0x8FCE20 KwUb 191.3 temp_ub_q0p75_o48 -48.00 143.3 FORMAT "%5.1" /end CHARACTERISTIC
/begin CHARACTERISTIC TMSPTAFX "" VALUE 0x8E23A7 KwUb 191.3 temp_ub_q0p75_o48 -48.00 143.3 FORMAT "%5.1" /end CHARACTERISTIC
/begin CHARACTERISTIC TMSSSCO "" VALUE 0x8E2428 KwUb 191.3 temp_ub_q0p75_o48 -48.00 143.3 FORMAT "%5.1" /end CHARACTERISTIC
/begin CHARACTERISTIC TMSSSCU "" VALUE 0x8E2429 KwUb 191.3 temp_ub_q0p75_o48 -48.00 143.3 FORMAT "%5.1" /end CHARACTERISTIC
/begin CHARACTERISTIC TMSUPTAFX "" VALUE 0x8E23A8 KwUb 191.3 temp_ub_q0p75_o48 -48.00 143.3 FORMAT "%5.1" /end CHARACTERISTIC
/begin CHARACTERISTIC TNLETM "" VALUE 0x8EAF90 KwUw 65535.00 t1sxs_uw_q1 0.00 65535.00 FORMAT "%8.2" /end CHARACTERISTIC
/begin CHARACTERISTIC TNSRT "" VALUE 0x8E242A KwUb 255.0 t1sxs_ub_b255 0.00 255.0 FORMAT "%5.1" /end CHARACTERISTIC
/begin CHARACTERISTIC TOOTAUS "" VALUE 0x8E0D9B KwUb 5.100 t20msxs_ub_b5p1 0.00 5.100 FORMAT "%5.3" /end CHARACTERISTIC
/begin CHARACTERISTIC TOOTEIN "" VALUE 0x8E0D9C KwUb 5.100 t20msxs_ub_b5p1 0.00 5.100 FORMAT "%5.3" /end CHARACTERISTIC
/begin CHARACTERISTIC TOOTULB "" VALUE 0x8E8296 KwUw 1310.700 t20msxs_uw_b1310 0.00 1310.700 FORMAT "%8.3" /end CHARACTERISTIC
/begin CHARACTERISTIC TPNSE1 "" VALUE 0x8E0DB5 KwUb 12.70 t50msxs_ub_b12p75 0.05000 12.75 FORMAT "%5.2" /end CHARACTERISTIC
/begin CHARACTERISTIC TPREL "" VALUE 0x8FCE21 KwUb 0.1000 t10msxs_ub_b2p55 0.00 0.1000 /end CHARACTERISTIC
/begin CHARACTERISTIC TPWGDEE "" VALUE 0x8E0DB6 KwUb 2.550 t_q0p01 0.00 2.550 FORMAT "%5.3" /end CHARACTERISTIC
/begin CHARACTERISTIC TPWGDEOK "" VALUE 0x8E0DB7 KwUb 2.550 t_q0p01 0.00 2.550 FORMAT "%5.3" /end CHARACTERISTIC
/begin CHARACTERISTIC TRIAKTH "" VALUE 0x8E8022 KwUw 6553.400 t100msxs_uw_b6553p5 0.1000000 6553.500 FORMAT "%8.3" /end CHARACTERISTIC
/begin CHARACTERISTIC TRIIMPH "" VALUE 0x8FDC34 KwUw 655.3500 t10msxs_uw_b655p35 0.00 655.3500 FORMAT "%8.4" /end CHARACTERISTIC
/begin CHARACTERISTIC TRINSTART "" VALUE 0x8FD266 KwUb 2.550 t10msxs_uw_b655p35 0.00 2.550 FORMAT "%5.3" /end CHARACTERISTIC
/begin CHARACTERISTIC TUBKL15 "" VALUE 0x8E3503 KwUb 2.550 t10msxs_ub_b2p55 0.00 2.550 FORMAT "%5.3" /end CHARACTERISTIC
/begin CHARACTERISTIC TUMDETM "" VALUE 0x8E242B KwUb 191.3 temp_ub_q0p75_o48 -48.00 143.3 FORMAT "%5.1" /end CHARACTERISTIC
/begin CHARACTERISTIC TUMTO "" VALUE 0x8FECDC KwUw 655.2500 t10msxs_uw_b655p35 0.1000000 655.3500 FORMAT "%8.4" /end CHARACTERISTIC
/begin CHARACTERISTIC TUMTOE "" VALUE 0x8FECCC KwUw 655.3500 t10msxs_uw_b655p35 0.00 655.3500 FORMAT "%8.4" /end CHARACTERISTIC
/begin CHARACTERISTIC TUPWG12 "" VALUE 0x8FCE84 KwUb 2.550 t_q0p01 0.00 2.550 FORMAT "%5.3" /end CHARACTERISTIC
/begin CHARACTERISTIC TUPWG1O "" VALUE 0x8FCE85 KwUb 2.550 t_q0p01 0.00 2.550 FORMAT "%5.3" /end CHARACTERISTIC
/begin CHARACTERISTIC TUPWG1U "" VALUE 0x8FCE86 KwUb 2.550 t_q0p01 0.00 2.550 FORMAT "%5.3" /end CHARACTERISTIC
/begin CHARACTERISTIC TUPWG2O "" VALUE 0x8FCE87 KwUb 2.550 t_q0p01 0.00 2.550 FORMAT "%5.3" /end CHARACTERISTIC
/begin CHARACTERISTIC TUPWG2U "" VALUE 0x8FCE88 KwUb 2.550 t_q0p01 0.00 2.550 FORMAT "%5.3" /end CHARACTERISTIC
/begin CHARACTERISTIC TUSBELH "" VALUE 0x8FCE73 KwUb 2.550 t10msxs_ub_b2p55 0.00 2.550 FORMAT "%5.3" /end CHARACTERISTIC
/begin CHARACTERISTIC TUSRIBERH "" VALUE 0x8FDC36 KwUw 655.3500 t10msxs_uw_b655p35 0.00 655.3500 FORMAT "%8.4" /end CHARACTERISTIC
/begin CHARACTERISTIC TVABGL "" VALUE 0x8FECCE KwUw 655.3500 t10msxs_uw_b655p35 0.00 655.3500 FORMAT "%8.4" /end CHARACTERISTIC
/begin CHARACTERISTIC TVERBR "" VALUE 0x8E0E9D KwUb 25.50 t100msxs_ub_b25p5 0.00 25.50 FORMAT "%5.2" /end CHARACTERISTIC
/begin CHARACTERISTIC TVHSH "" VALUE 0x8E0D71 KwUb 25.50 t100msxs_ub_b25p5 0.00 25.50 FORMAT "%5.2" /end CHARACTERISTIC
/begin CHARACTERISTIC TVKUPV "" VALUE 0x8FDD1A KwUw 1310.700 t20msxs_uw_q0p02 0.00 1310.700 FORMAT "%8.3" /end CHARACTERISTIC
/begin CHARACTERISTIC TVPDKP1 "" VALUE 0x8FCE9E KwUb 2.540 t10msxs_ub_b2p55 0.01000 2.550 FORMAT "%5.3" /end CHARACTERISTIC
/begin CHARACTERISTIC TVPDKP2 "" VALUE 0x8FCE9F KwUb 2.540 t10msxs_ub_b2p55 0.01000 2.550 FORMAT "%5.3" /end CHARACTERISTIC
/begin CHARACTERISTIC TVPWDK12 "" VALUE 0x8FCEA0 KwUb 2.540 t10msxs_ub_b2p55 0.01000 2.550 FORMAT "%5.3" /end CHARACTERISTIC
/begin CHARACTERISTIC TVPWDK13 "" VALUE 0x8FCEA1 KwUb 2.540 t10msxs_ub_b2p55 0.01000 2.550 FORMAT "%5.3" /end CHARACTERISTIC
/begin CHARACTERISTIC TVPWDK23 "" VALUE 0x8FCEA2 KwUb 2.540 t10msxs_ub_b2p55 0.01000 2.550 FORMAT "%5.3" /end CHARACTERISTIC
/begin CHARACTERISTIC TVSABGL "" VALUE 0x8FECDE KwUw 655.3500 t10msxs_uw_b655p35 0.00 655.3500 FORMAT "%8.4" /end CHARACTERISTIC
/begin CHARACTERISTIC TVTMKIC "" VALUE 0x8EAF9C KwUw 6553.400 t100msxs_uw_b6553p5 0.1000000 6553.500 FORMAT "%8.3" /end CHARACTERISTIC
/begin CHARACTERISTIC TVTMKIE "" VALUE 0x8EAF9E KwUw 6553.400 t100msxs_uw_b6553p5 0.1000000 6553.500 FORMAT "%8.3" /end CHARACTERISTIC
/begin CHARACTERISTIC TWBKLHOF "" VALUE 0x8EAF92 KwUw 6553.400 t100msxs_uw_b6553p5 0.1000000 6553.500 FORMAT "%8.3" /end CHARACTERISTIC
/begin CHARACTERISTIC TWBKLHON "" VALUE 0x8EAF94 KwUw 6553.400 t100msxs_uw_b6553p5 0.1000000 6553.500 FORMAT "%8.3" /end CHARACTERISTIC
/begin CHARACTERISTIC TWBKLNOF "" VALUE 0x8EAF96 KwUw 6553.400 t100msxs_uw_b6553p5 0.1000000 6553.500 FORMAT "%8.3" /end CHARACTERISTIC
/begin CHARACTERISTIC TWBKLNON "" VALUE 0x8EAF98 KwUw 6553.400 t100msxs_uw_b6553p5 0.1000000 6553.500 FORMAT "%8.3" /end CHARACTERISTIC
/begin CHARACTERISTIC TWDUBRNL "" VALUE 0x8E0D84 KwUb 25.40 t100msxs_ub_b25p5 0.1000 25.50 FORMAT "%5.2" /end CHARACTERISTIC
/begin CHARACTERISTIC TWNLPTAMN "" VALUE 0x8EAE36 KwUw 6553.500 t100msxs_uw_b6553p5 0.00 6553.500 FORMAT "%8.3" /end CHARACTERISTIC
/begin CHARACTERISTIC TWNSEZDTAN "" VALUE 0x8EAE38 KwUw 6553.500 t100msxs_uw_b6553p5 0.00 6553.500 FORMAT "%8.3" /end CHARACTERISTIC
/begin CHARACTERISTIC TWNSTA "" VALUE 0x8E8278 KwUw 655.3500 t10msxs_uw_b655p35 0.00 655.3500 FORMAT "%8.4" /end CHARACTERISTIC
/begin CHARACTERISTIC TWNTAL "" VALUE 0x8E827A KwUw 13107.00 t200msxs_uw_q0p2 0.00 13107.00 FORMAT "%8.2" /end CHARACTERISTIC
/begin CHARACTERISTIC TWPLK "" VALUE 0x8E0DB8 KwUb 25.50 t_q0p1 0.00 25.50 FORMAT "%5.2" /end CHARACTERISTIC
/begin CHARACTERISTIC TWPMBBR "" VALUE 0x8FCE89 KwUb 2.550 t_q0p01 0.00 2.550 FORMAT "%5.3" /end CHARACTERISTIC
/begin CHARACTERISTIC TWRDZGMX "" VALUE 0x8E242C KwUb 25.40 t100msxs_ub_b25p5 0.1000 25.50 FORMAT "%5.2" /end CHARACTERISTIC
/begin CHARACTERISTIC TWSSCTM "" VALUE 0x8E242D KwUb 25.50 t100msxs_ub_b25p5 0.00 25.50 FORMAT "%5.2" /end CHARACTERISTIC
/begin CHARACTERISTIC TWTMNHST "" VALUE 0x8E242E KwUb 255.0 t1sxs_ub_b255 0.00 255.0 FORMAT "%5.1" /end CHARACTERISTIC
/begin CHARACTERISTIC TWTMNTAFX "" VALUE 0x8EAE3A KwUw 6553.500 t100msxs_uw_b6553p5 0.00 6553.500 FORMAT "%8.3" /end CHARACTERISTIC
/begin CHARACTERISTIC UADPUMN "" VALUE 0x8E1392 KwUb 4.980 spg_ub_q0p019 0.00 4.980 FORMAT "%5.3" /end CHARACTERISTIC
/begin CHARACTERISTIC UADPUMX "" VALUE 0x8E1393 KwUb 4.980 spg_ub_q0p019 0.00 4.980 FORMAT "%5.3" /end CHARACTERISTIC
/begin CHARACTERISTIC UBDE "" VALUE 0x8FDC68 KwUw 17.98242 spg_ubatt_w_sy 0.00 17.98242 FORMAT "%8.5" /end CHARACTERISTIC
/begin CHARACTERISTIC UBDMN1 "" VALUE 0x8FCE7B KwUb 17.93 spg_ubatt_sy 0.00 17.93 FORMAT "%5.2" /end CHARACTERISTIC
/begin CHARACTERISTIC UBDMN2 "" VALUE 0x8FCE7C KwUb 17.93 spg_ubatt_sy 0.00 17.93 FORMAT "%5.2" /end CHARACTERISTIC
/begin CHARACTERISTIC UBDMN3 "" VALUE 0x8FCE7D KwUb 17.93 spg_ubatt_sy 0.00 17.93 FORMAT "%5.2" /end CHARACTERISTIC
/begin CHARACTERISTIC UBDMX "" VALUE 0x8FCE7E KwUb 17.93 spg_ubatt_sy 0.00 17.93 FORMAT "%5.2" /end CHARACTERISTIC
/begin CHARACTERISTIC UBHS "" VALUE 0x8E0D72 KwUb 17.95 spg_ubatt 0.00 17.95 FORMAT "%5.2" /end CHARACTERISTIC
/begin CHARACTERISTIC UBKL15 "" VALUE 0x8E3504 KwUb 4.998 spg_ubatt 0.00 4.998 FORMAT "%5.3" /end CHARACTERISTIC
/begin CHARACTERISTIC UBMNPUP "" VALUE 0x8E242F KwUb 25.50 spg_q0p1 0.00 25.50 FORMAT "%5.2" /end CHARACTERISTIC
/begin CHARACTERISTIC UBNACHL "" VALUE 0x8FDC6A KwUw 17.98242 spg_ubatt_w_sy 0.00 17.98242 FORMAT "%8.5" /end CHARACTERISTIC
/begin CHARACTERISTIC UBRDMN1 "" VALUE 0x8E0D85 KwUb 25.50 spg_q0p1 0.00 25.50 FORMAT "%5.2" /end CHARACTERISTIC
/begin CHARACTERISTIC UBRDMN2 "" VALUE 0x8E0D86 KwUb 25.50 spg_q0p1 0.00 25.50 FORMAT "%5.2" /end CHARACTERISTIC
/begin CHARACTERISTIC UBRDMX "" VALUE 0x8E8274 KwUw 1823.511 spg_ub_b28p5_w 0.00 1823.511 FORMAT "%8.3" /end CHARACTERISTIC
/begin CHARACTERISTIC UBRDUNL "" VALUE 0x8E0D87 KwUb 25.50 spg_q0p1 0.00 25.50 FORMAT "%5.2" /end CHARACTERISTIC
/begin CHARACTERISTIC UBVDKPO "" VALUE 0x8FCEA3 KwUb 17.95 spg_ubatt 0.00 17.95 FORMAT "%5.2" /end CHARACTERISTIC
/begin CHARACTERISTIC UBVDKPU "" VALUE 0x8FCEA4 KwUb 17.95 spg_ubatt 0.00 17.95 FORMAT "%5.2" /end CHARACTERISTIC
/begin CHARACTERISTIC UDKP1O "" VALUE 0x8FCEA5 KwUb 4.980 spg_ub_b5 0.00 4.980 FORMAT "%5.3" /end CHARACTERISTIC
/begin CHARACTERISTIC UDKP1U "" VALUE 0x8FCEA6 KwUb 4.980 spg_ub_b5 0.00 4.980 FORMAT "%5.3" /end CHARACTERISTIC
/begin CHARACTERISTIC UDKP2O "" VALUE 0x8FCEA7 KwUb 4.980 spg_ub_b5 0.00 4.980 FORMAT "%5.3" /end CHARACTERISTIC
/begin CHARACTERISTIC UDKP2U "" VALUE 0x8FCEA8 KwUb 4.980 spg_ub_b5 0.00 4.980 FORMAT "%5.3" /end CHARACTERISTIC
/begin CHARACTERISTIC UHSN "" VALUE 0x8E0D73 KwUb 17.95 spg_ubatt 0.00 17.95 FORMAT "%5.2" /end CHARACTERISTIC
/begin CHARACTERISTIC UPWG12U "" VALUE 0x8FCE8A KwUb 4.980 spg_ub_b5 0.00 4.980 FORMAT "%5.3" /end CHARACTERISTIC
/begin CHARACTERISTIC UPWG1LLDE "" VALUE 0x8E829A KwUw 319.9951 spg_q0p00488 0.00 319.9951 FORMAT "%8.4" /end CHARACTERISTIC
/begin CHARACTERISTIC UPWG1O "" VALUE 0x8FCE8B KwUb 4.980 spg_ub_b5 0.00 4.980 FORMAT "%5.3" /end CHARACTERISTIC
/begin CHARACTERISTIC UPWG1OGDE "" VALUE 0x8E829C KwUw 319.9951 spg_q0p00488 0.00 319.9951 FORMAT "%8.4" /end CHARACTERISTIC
/begin CHARACTERISTIC UPWG1U "" VALUE 0x8FCE8C KwUb 4.980 spg_ub_b5 0.00 4.980 FORMAT "%5.3" /end CHARACTERISTIC
/begin CHARACTERISTIC UPWG2DOFF "" VALUE 0x8FDC7A KwUw 0.04882813 spg_q0p00488 0.00 0.04882813 FORMAT "%10.8" /end CHARACTERISTIC
/begin CHARACTERISTIC UPWG2LLDE "" VALUE 0x8E829E KwUw 319.9951 spg_q0p00488 0.00 319.9951 FORMAT "%8.4" /end CHARACTERISTIC
/begin CHARACTERISTIC UPWG2O "" VALUE 0x8FCE8D KwUb 4.980 spg_ub_b5 0.00 4.980 FORMAT "%5.3" /end CHARACTERISTIC
/begin CHARACTERISTIC UPWG2OGDE "" VALUE 0x8E82A0 KwUw 319.9951 spg_q0p00488 0.00 319.9951 FORMAT "%8.4" /end CHARACTERISTIC
/begin CHARACTERISTIC UPWG2U "" VALUE 0x8FCE8E KwUb 4.980 spg_ub_b5 0.00 4.980 FORMAT "%5.3" /end CHARACTERISTIC
/begin CHARACTERISTIC UPWGO "" VALUE 0x8FCE8F KwUb 4.980 spg_ub_b5 0.00 4.980 FORMAT "%5.3" /end CHARACTERISTIC
/begin CHARACTERISTIC UPWGU "" VALUE 0x8FCE90 KwUb 4.980 spg_ub_b5 0.00 4.980 FORMAT "%5.3" /end CHARACTERISTIC
/begin CHARACTERISTIC URINOFF "" VALUE 0x8FECE0 KwUw 5.000000 spg_q0p00488 0.00 5.000000 FORMAT "%8.6" /end CHARACTERISTIC
/begin CHARACTERISTIC USABGL "" VALUE 0x8FECD0 KwUw 31.99951 spg_q4p88Em4 0.00 31.99951 FORMAT "%8.5" /end CHARACTERISTIC
/begin CHARACTERISTIC USRIMINH "" VALUE 0x8FDC38 KwUw 319.9951 spg_uw_q0p00488_o1 -1.000000 318.9951 FORMAT "%8.4" /end CHARACTERISTIC
/begin CHARACTERISTIC USRIOH "" VALUE 0x8FDC3A KwUw 319.9951 spg_uw_q0p00488_o1 -1.000000 318.9951 FORMAT "%8.4" /end CHARACTERISTIC
/begin CHARACTERISTIC USRIUH "" VALUE 0x8FDC3C KwUw 319.9951 spg_uw_q0p00488_o1 -1.000000 318.9951 FORMAT "%8.4" /end CHARACTERISTIC
/begin CHARACTERISTIC VBKLHO "" VALUE 0x8E2430 KwUb 318.8 vfzg_ub_q1p25 0.00 318.8 FORMAT "%5.1" /end CHARACTERISTIC
/begin CHARACTERISTIC VBKLHU "" VALUE 0x8E2431 KwUb 318.8 vfzg_ub_q1p25 0.00 318.8 FORMAT "%5.1" /end CHARACTERISTIC
/begin CHARACTERISTIC VBKLNO "" VALUE 0x8E2432 KwUb 318.8 vfzg_ub_q1p25 0.00 318.8 FORMAT "%5.1" /end CHARACTERISTIC
/begin CHARACTERISTIC VBKLNU "" VALUE 0x8E2433 KwUb 318.8 vfzg_ub_q1p25 0.00 318.8 FORMAT "%5.1" /end CHARACTERISTIC
/begin CHARACTERISTIC VFZGSCH "" VALUE 0x8F144C KwUw 511.9922 vfzg_uw_q0p00781 0.00 511.9922 FORMAT "%8.4" /end CHARACTERISTIC
/begin CHARACTERISTIC VFZMN "" VALUE 0x8FDC52 KwUw 511.9922 vfzg_uw_b512 0.00 511.9922 FORMAT "%8.4" /end CHARACTERISTIC
/begin CHARACTERISTIC VFZR1O "" VALUE 0x8FDC54 KwUw 511.9922 vfzg_uw_b512 0.00 511.9922 FORMAT "%8.4" /end CHARACTERISTIC
/begin CHARACTERISTIC VFZR1U "" VALUE 0x8FDC56 KwUw 511.9922 vfzg_uw_b512 0.00 511.9922 FORMAT "%8.4" /end CHARACTERISTIC
/begin CHARACTERISTIC VFZR2O "" VALUE 0x8FDC58 KwUw 511.9922 vfzg_uw_b512 0.00 511.9922 FORMAT "%8.4" /end CHARACTERISTIC
/begin CHARACTERISTIC VFZR2U "" VALUE 0x8FDC5A KwUw 511.9922 vfzg_uw_b512 0.00 511.9922 FORMAT "%8.4" /end CHARACTERISTIC
/begin CHARACTERISTIC VMDUB "" VALUE 0x8FCE7F KwUb 318.8 vfzg_ub_q1p25 0.00 318.8 FORMAT "%5.1" /end CHARACTERISTIC
/begin CHARACTERISTIC VNSPWGNOT3 "" VALUE 0x8E0DB9 KwUb 318.8 vfzg_ub_q1p25 0.00 318.8 FORMAT "%5.1" /end CHARACTERISTIC
/begin CHARACTERISTIC VPTAFXO "" VALUE 0x8E23A9 KwUb 318.8 vfzg_ub_q1p25 0.00 318.8 FORMAT "%5.1" /end CHARACTERISTIC
/begin CHARACTERISTIC VPTAFXU "" VALUE 0x8E23AA KwUb 318.8 vfzg_ub_q1p25 0.00 318.8 FORMAT "%5.1" /end CHARACTERISTIC
/begin CHARACTERISTIC VRFGRMN "" VALUE 0x8FDC5C KwUw 511.9922 vfzg_uw_b512 0.00 511.9922 FORMAT "%8.4" /end CHARACTERISTIC
/begin CHARACTERISTIC VTAPLC "" VALUE 0x8E23AB KwUb 318.8 vfzg_ub_q1p25 0.00 318.8 FORMAT "%5.1" /end CHARACTERISTIC
/begin CHARACTERISTIC VWPMBBR "" VALUE 0x8FCE91 KwUb 318.8 vfzg_ub_q1p25 0.00 318.8 FORMAT "%5.1" /end CHARACTERISTIC
/begin CHARACTERISTIC WDKDSVLU "" CURVE 0x8E1394 KlAUbSstUbWUb 100.0 relDK_ub_b100 0.00 100.0 FORMAT "%5.1"
 /begin AXIS_DESCR STD_AXIS nmot nmot_ub_q40 6 0.00 10200. FORMAT "%5.0" DEPOSIT ABSOLUTE /end AXIS_DESCR
/end CHARACTERISTIC
/begin CHARACTERISTIC WDKPMXN "" CURVE 0x8E0E7C KlAUbSstUbWUb 100.0 relDK_ub_b100 0.00 100.0 FORMAT "%5.1"
 /begin AXIS_DESCR STD_AXIS nmot nmot_ub_q40 12 0.00 10200. FORMAT "%5.0" DEPOSIT ABSOLUTE /end AXIS_DESCR
/end CHARACTERISTIC
/begin CHARACTERISTIC WNWAFMX "" VALUE 0x8FCE07 KwSb 128.0 kw_q1 -128.0 0.00 FORMAT "%5.1" /end CHARACTERISTIC
/begin CHARACTERISTIC WNWASMX "" VALUE 0x8FCE08 KwSb 127.0 kw_q1 0.00 127.0 FORMAT "%5.1" /end CHARACTERISTIC
/begin CHARACTERISTIC WNWKM "" CURVE 0x8E7D4C GklWSb 15.94 kw_q0p0625 -8.000 7.938 FORMAT "%5.3"
 /begin AXIS_DESCR COM_AXIS tmot temp_ub_q0p75_o48 5 -48.00 143.3 FORMAT "%5.1" AXIS_PTS_REF STM05EPMSB /end AXIS_DESCR
/end CHARACTERISTIC
/begin CHARACTERISTIC WNWKM2 "" CURVE 0x8E7D51 GklWSb 15.94 kw_q0p0625 -8.000 7.938 FORMAT "%5.3"
 /begin AXIS_DESCR COM_AXIS tmot temp_ub_q0p75_o48 5 -48.00 143.3 FORMAT "%5.1" AXIS_PTS_REF STM05EPMSB /end AXIS_DESCR
/end CHARACTERISTIC
/begin CHARACTERISTIC WNWKN "" CURVE 0x8E7D56 KlAUbSstUbWSb 15.94 kw_q0p0625 -8.000 7.938 FORMAT "%5.3"
 /begin AXIS_DESCR STD_AXIS nmot nmot_ub_q40 6 0.00 10200. FORMAT "%5.0" DEPOSIT ABSOLUTE /end AXIS_DESCR
/end CHARACTERISTIC
/begin CHARACTERISTIC WNWRPS "" VAL_BLK 0x8FDBE2 KwbUw 1023.984 kw_q0p0156 0.00 1023.984 FORMAT "%8.3" NUMBER 4 /end CHARACTERISTIC
/begin CHARACTERISTIC WNWRPS2 "" VAL_BLK 0x8FDBEA KwbUw 1023.984 kw_q0p0156 0.00 1023.984 FORMAT "%8.3" NUMBER 4 /end CHARACTERISTIC
/begin CHARACTERISTIC WPMXBR "" VALUE 0x8FCE92 KwUb 100.0 relPED_ub_b100 0.00 100.0 FORMAT "%5.1" /end CHARACTERISTIC
/begin CHARACTERISTIC WPMXNOT "" VALUE 0x8FCE93 KwUb 100.0 relPED_ub_b100 0.00 100.0 FORMAT "%5.1" /end CHARACTERISTIC
/begin CHARACTERISTIC WPRMBVH "" VALUE 0x8FCE94 KwUb 100.0 relPED_ub_b100 0.00 100.0 FORMAT "%5.1" /end CHARACTERISTIC
/begin CHARACTERISTIC ZDELBMSRCH "" VALUE 0x8FCE22 KwUb 6.000 dez 0.00 6.000 FORMAT "%5.3" /end CHARACTERISTIC
/begin CHARACTERISTIC ZDSU "" VALUE 0x8E13A1 KwUb 25.4996 zk100msxs_ub_b25p5 0.100392 25.6000 FORMAT "%7.4" /end CHARACTERISTIC
/begin CHARACTERISTIC ZERBR "" VALUE 0x8E0E9E KwUb 255.0 dez 0.00 255.0 FORMAT "%5.1" /end CHARACTERISTIC
/begin CHARACTERISTIC ZFBFZGL "" VALUE 0x8FDC5E KwUw 1310.6999997 zk20msxs_uw_b1310 0.020000305180 1310.7200000 FORMAT "%12.7" /end CHARACTERISTIC
/begin CHARACTERISTIC ZFCNT1 "" VALUE 0x8FDC60 KwUw 65535.00 dez 0.00 65535.00 FORMAT "%8.2" /end CHARACTERISTIC
/begin CHARACTERISTIC ZFCNT2 "" VALUE 0x8FDC62 KwUw 65535.00 dez 0.00 65535.00 FORMAT "%8.2" /end CHARACTERISTIC
/begin CHARACTERISTIC ZFDUSVK "" VALUE 0x8FECD2 KwUw 655.34999985 zk10msxs_uw_b655 0.010000152590 655.36000000 FORMAT "%12.8" /end CHARACTERISTIC
/begin CHARACTERISTIC ZFGRSDET "" VALUE 0x8E0D9D KwUb 255.0 dez 0.00 255.0 FORMAT "%5.1" /end CHARACTERISTIC
/begin CHARACTERISTIC ZFRIH "" VALUE 0x8E8024 KwUw 0.9999847 fak_uw_b1 0.00 0.9999847 FORMAT "%9.7" /end CHARACTERISTIC
/begin CHARACTERISTIC ZFRIN "" VALUE 0x8FECE2 KwUw 655.34999985 zk10msxs_uw_b655 0.010000152590 655.36000000 FORMAT "%12.8" /end CHARACTERISTIC
/begin CHARACTERISTIC ZFRINCAL "" VALUE 0x8FECE4 KwUw 655.34999985 zk10msxs_uw_b655 0.010000152590 655.36000000 FORMAT "%12.8" /end CHARACTERISTIC
/begin CHARACTERISTIC ZFRINSTART "" VALUE 0x8FECE6 KwUw 655.34999985 zk10msxs_uw_b655 0.010000152590 655.36000000 FORMAT "%12.8" /end CHARACTERISTIC
/begin CHARACTERISTIC ZFTANS "" VALUE 0x8EAE3C KwUw 6553.4999985 zk100msxs_uw_b6553 0.10000152590 6553.6000000 FORMAT "%12.7" /end CHARACTERISTIC
/begin CHARACTERISTIC ZFV "" VALUE 0x8FDC64 KwUw 1310.6999997 zk20msxs_uw_b1310 0.020000305180 1310.7200000 FORMAT "%12.7" /end CHARACTERISTIC
/begin CHARACTERISTIC ZKBKVAB "" VALUE 0x8E2496 KwUb 25.4996 zk100msxs_ub_b25p5 0.100392 25.6000 FORMAT "%7.4" /end CHARACTERISTIC
/begin CHARACTERISTIC ZKLDFPWMF "" VALUE 0x8E5972 KwUw 1310.6999997 zk20msxs_uw_b1310 0.020000305180 1310.7200000 FORMAT "%12.7" /end CHARACTERISTIC
/begin CHARACTERISTIC ZKMDKH "" VALUE 0x8E2497 KwUb 25.4996 zk100msxs_ub_b25p5 0.100392 25.6000 FORMAT "%7.4" /end CHARACTERISTIC
/begin CHARACTERISTIC ZKTMLINSS "" VALUE 0x8EAF9A KwUw 6553.4999985 zk100msxs_uw_b6553 0.10000152590 6553.6000000 FORMAT "%12.7" /end CHARACTERISTIC
/begin CHARACTERISTIC ZKUBSQF01 "" VALUE 0x8E8276 KwUw 6553.4999985 zk100msxs_uw_b6553 0.10000152590 6553.6000000 FORMAT "%12.7" /end CHARACTERISTIC
/begin CHARACTERISTIC ZKUBSQF10 "" VALUE 0x8FDC6C KwUw 655.34999985 zk10msxs_uw_b655 0.010000152590 655.36000000 FORMAT "%12.8" /end CHARACTERISTIC
/begin CHARACTERISTIC ZNWSP "" VALUE 0x8FCE09 KwUb 99.61 rel_ub_b99p6 0.00 99.61 FORMAT "%5.2" /end CHARACTERISTIC
/begin CHARACTERISTIC ZPHFLBM1 "" VALUE 0x8FCE0A KwSb 255.0 dez -128.0 127.0 FORMAT "%5.1" /end CHARACTERISTIC
/begin CHARACTERISTIC ZTPREL "" VALUE 0x8FCE23 KwUb 255.0 dez 0.00 255.0 FORMAT "%5.1" /end CHARACTERISTIC
/begin MEASUREMENT anzhfma_w "" UWORD dez 1 100 0.00 65535.00 FORMAT "%8.2" ECU_ADDRESS 0xE15E /end MEASUREMENT
/begin MEASUREMENT bfzgl_b "" SBYTE bfzg_sb_q0p217 1 100 -27.78 27.56 FORMAT "%5.2" ECU_ADDRESS 0xF07EC /end MEASUREMENT
/begin MEASUREMENT bfzgl_w "" SWORD bfzg_sw_q4p239Em4 1 100 -13.8903552 13.8899313 ECU_ADDRESS 0xF1A70 /end MEASUREMENT
/begin MEASUREMENT bmLosCtr_w "" UWORD dez 1 100 0.00 65535.00 FORMAT "%8.2" ECU_ADDRESS 0x382ED0 /end MEASUREMENT
/begin MEASUREMENT bmzzyl "" UBYTE dez 1 100 0.00 255.0 FORMAT "%5.1" ECU_ADDRESS 0xF0707 /end MEASUREMENT
/begin MEASUREMENT B_0101_ack "" UBYTE B_TRUE 1 100 0.00 1.00000000000 BIT_MASK 0x2 FORMAT "%13.11" ECU_ADDRESS 0xF0AC9 /end MEASUREMENT
/begin MEASUREMENT B_0101_ident "" UBYTE B_TRUE 1 100 0.00 1.00000000000 BIT_MASK 0x1 FORMAT "%13.11" ECU_ADDRESS 0xF0AC9 /end MEASUREMENT
/begin MEASUREMENT B_0101_notadr "" UBYTE B_TRUE 1 100 0.00 1.00000000000 BIT_MASK 0x8 FORMAT "%13.11" ECU_ADDRESS 0xF0AC9 /end MEASUREMENT
/begin MEASUREMENT B_0101_switch "" UBYTE B_TRUE 1 100 0.00 1.00000000000 BIT_MASK 0x4 FORMAT "%13.11" ECU_ADDRESS 0xF0AC9 /end MEASUREMENT
/begin MEASUREMENT B_afgrbs "" UBYTE B_TRUE 1 100 0.00 1.00000000000 BIT_MASK 0x1 FORMAT "%13.11" ECU_ADDRESS 0xF0816 /end MEASUREMENT
/begin MEASUREMENT B_anschlag "" UWORD B_TRUE 1 100 0.00 1.00000000000 BIT_MASK 0x8 FORMAT "%13.11" ECU_ADDRESS 0xFD8E /end MEASUREMENT
/begin MEASUREMENT B_bl "" UWORD B_TRUE 1 100 0.00 1.00000000000 BIT_MASK 0x10 FORMAT "%13.11" ECU_ADDRESS 0xFD62 /end MEASUREMENT
/begin MEASUREMENT B_bm "" UWORD B_TRUE 1 100 0.00 1.00000000000 BIT_MASK 0x1000 FORMAT "%13.11" ECU_ADDRESS 0xFD42 /end MEASUREMENT
/begin MEASUREMENT B_br "" UWORD B_TRUE 1 100 0.00 1.00000000000 BIT_MASK 0x20 FORMAT "%13.11" ECU_ADDRESS 0xFD62 /end MEASUREMENT
/begin MEASUREMENT B_br2k "" UWORD B_TRUE 1 100 0.00 1.00000000000 BIT_MASK 0x40 FORMAT "%13.11" ECU_ADDRESS 0xFD62 /end MEASUREMENT
/begin MEASUREMENT B_brems "" UWORD B_TRUE 1 100 0.00 1.00000000000 BIT_MASK 0x80 FORMAT "%13.11" ECU_ADDRESS 0xFD62 /end MEASUREMENT
/begin MEASUREMENT B_bztafx "" UBYTE B_TRUE 1 100 0.00 1.00000000000 BIT_MASK 0x1 FORMAT "%13.11" ECU_ADDRESS 0xF0921 /end MEASUREMENT
/begin MEASUREMENT B_c95bf0 "" UWORD B_TRUE 1 100 0.00 1.00000000000 BIT_MASK 0x10 FORMAT "%13.11" ECU_ADDRESS 0xFD8E /end MEASUREMENT
/begin MEASUREMENT B_c95bf1 "" UWORD B_TRUE 1 100 0.00 1.00000000000 BIT_MASK 0x20 FORMAT "%13.11" ECU_ADDRESS 0xFD8E /end MEASUREMENT
/begin MEASUREMENT B_c95bf2 "" UWORD B_TRUE 1 100 0.00 1.00000000000 BIT_MASK 0x40 FORMAT "%13.11" ECU_ADDRESS 0xFD8E /end MEASUREMENT
/begin MEASUREMENT B_c95bf3 "" UWORD B_TRUE 1 100 0.00 1.00000000000 BIT_MASK 0x80 FORMAT "%13.11" ECU_ADDRESS 0xFD8E /end MEASUREMENT
/begin MEASUREMENT B_c95ks3 "" UWORD B_TRUE 1 100 0.00 1.00000000000 BIT_MASK 0x100 FORMAT "%13.11" ECU_ADDRESS 0xFD8E /end MEASUREMENT
/begin MEASUREMENT B_ci2cjx "" UWORD B_TRUE 1 100 0.00 1.00000000000 BIT_MASK 0x100 FORMAT "%13.11" ECU_ADDRESS 0xFD86 /end MEASUREMENT
/begin MEASUREMENT B_ci2cjx2 "" UWORD B_TRUE 1 100 0.00 1.00000000000 BIT_MASK 0x200 FORMAT "%13.11" ECU_ADDRESS 0xFD86 /end MEASUREMENT
/begin MEASUREMENT B_cicjx "" UWORD B_TRUE 1 100 0.00 1.00000000000 BIT_MASK 0x400 FORMAT "%13.11" ECU_ADDRESS 0xFD86 /end MEASUREMENT
/begin MEASUREMENT B_cicjx2 "" UWORD B_TRUE 1 100 0.00 1.00000000000 BIT_MASK 0x800 FORMAT "%13.11" ECU_ADDRESS 0xFD86 /end MEASUREMENT
/begin MEASUREMENT B_ckrivk "" UBYTE B_TRUE 1 100 0.00 1.00000000000 BIT_MASK 0x1 FORMAT "%13.11" ECU_ADDRESS 0xE28D /end MEASUREMENT
/begin MEASUREMENT B_ckrivk2 "" UBYTE B_TRUE 1 100 0.00 1.00000000000 BIT_MASK 0x2 FORMAT "%13.11" ECU_ADDRESS 0xE28D /end MEASUREMENT
/begin MEASUREMENT B_dcff "" UWORD B_TRUE 1 100 0.00 1.00000000000 BIT_MASK 0x4 FORMAT "%13.11" ECU_ADDRESS 0xFD84 /end MEASUREMENT
/begin MEASUREMENT B_dkp1e "" UWORD B_TRUE 1 100 0.00 1.00000000000 BIT_MASK 0x1 FORMAT "%13.11" ECU_ADDRESS 0xFD58 /end MEASUREMENT
/begin MEASUREMENT B_dkp1ev "" UWORD B_TRUE 1 100 0.00 1.00000000000 BIT_MASK 0x2 FORMAT "%13.11" ECU_ADDRESS 0xFD58 /end MEASUREMENT
/begin MEASUREMENT B_dkp1mn "" UWORD B_TRUE 1 100 0.00 1.00000000000 BIT_MASK 0x4 FORMAT "%13.11" ECU_ADDRESS 0xFD58 /end MEASUREMENT
/begin MEASUREMENT B_dkp1mx "" UWORD B_TRUE 1 100 0.00 1.00000000000 BIT_MASK 0x8 FORMAT "%13.11" ECU_ADDRESS 0xFD58 /end MEASUREMENT
/begin MEASUREMENT B_dkp1np "" UWORD B_TRUE 1 100 0.00 1.00000000000 BIT_MASK 0x10 FORMAT "%13.11" ECU_ADDRESS 0xFD58 /end MEASUREMENT
/begin MEASUREMENT B_dkp2e "" UWORD B_TRUE 1 100 0.00 1.00000000000 BIT_MASK 0x20 FORMAT "%13.11" ECU_ADDRESS 0xFD58 /end MEASUREMENT
/begin MEASUREMENT B_dkp2ev "" UWORD B_TRUE 1 100 0.00 1.00000000000 BIT_MASK 0x40 FORMAT "%13.11" ECU_ADDRESS 0xFD58 /end MEASUREMENT
/begin MEASUREMENT B_dkp2mn "" UWORD B_TRUE 1 100 0.00 1.00000000000 BIT_MASK 0x80 FORMAT "%13.11" ECU_ADDRESS 0xFD58 /end MEASUREMENT
/begin MEASUREMENT B_dkp2mx "" UWORD B_TRUE 1 100 0.00 1.00000000000 BIT_MASK 0x100 FORMAT "%13.11" ECU_ADDRESS 0xFD58 /end MEASUREMENT
/begin MEASUREMENT B_dkp2np "" UWORD B_TRUE 1 100 0.00 1.00000000000 BIT_MASK 0x200 FORMAT "%13.11" ECU_ADDRESS 0xFD58 /end MEASUREMENT
/begin MEASUREMENT B_dkpaw "" UWORD B_TRUE 1 100 0.00 1.00000000000 BIT_MASK 0x400 FORMAT "%13.11" ECU_ADDRESS 0xFD58 /end MEASUREMENT
/begin MEASUREMENT B_dksbeg "" UWORD B_TRUE 1 100 0.00 1.00000000000 BIT_MASK 0x800 FORMAT "%13.11" ECU_ADDRESS 0xFD58 /end MEASUREMENT
/begin MEASUREMENT B_dnlubr "" UBYTE B_TRUE 1 100 0.00 1.00000000000 BIT_MASK 0x8 FORMAT "%13.11" ECU_ADDRESS 0xF07EE /end MEASUREMENT
/begin MEASUREMENT B_dnt "" UWORD B_TRUE 1 100 0.00 1.00000000000 BIT_MASK 0x200 FORMAT "%13.11" ECU_ADDRESS 0xFD8E /end MEASUREMENT
/begin MEASUREMENT B_dntb "" UWORD B_TRUE 1 100 0.00 1.00000000000 BIT_MASK 0x400 FORMAT "%13.11" ECU_ADDRESS 0xFD8E /end MEASUREMENT
/begin MEASUREMENT B_dtp "" UWORD B_TRUE 1 100 0.00 1.00000000000 BIT_MASK 0x800 FORMAT "%13.11" ECU_ADDRESS 0xFD8E /end MEASUREMENT
/begin MEASUREMENT B_dtpb "" UWORD B_TRUE 1 100 0.00 1.00000000000 BIT_MASK 0x1000 FORMAT "%13.11" ECU_ADDRESS 0xFD8E /end MEASUREMENT
/begin MEASUREMENT B_dubre "" UBYTE B_TRUE 1 100 0.00 1.00000000000 BIT_MASK 0x1 FORMAT "%13.11" ECU_ADDRESS 0xF07EE /end MEASUREMENT
/begin MEASUREMENT B_dupw12 "" UWORD B_TRUE 1 100 0.00 1.00000000000 BIT_MASK 0x4000 FORMAT "%13.11" ECU_ADDRESS 0xFD54 /end MEASUREMENT
/begin MEASUREMENT B_dupwgvpe "" UWORD B_TRUE 1 100 0.00 1.00000000000 BIT_MASK 0x8000 FORMAT "%13.11" ECU_ADDRESS 0xFD54 /end MEASUREMENT
/begin MEASUREMENT B_dveeson "" UWORD B_TRUE 1 100 0.00 1.00000000000 BIT_MASK 0x8 FORMAT "%13.11" ECU_ADDRESS 0xFD84 /end MEASUREMENT
/begin MEASUREMENT B_edks "" UWORD B_TRUE 1 100 0.00 1.00000000000 BIT_MASK 0x1000 FORMAT "%13.11" ECU_ADDRESS 0xFD58 /end MEASUREMENT
/begin MEASUREMENT B_edsl "" UWORD B_TRUE 1 100 0.00 1.00000000000 BIT_MASK 0x8000 FORMAT "%13.11" ECU_ADDRESS 0xFD6C /end MEASUREMENT
/begin MEASUREMENT B_edsuu "" UBYTE B_TRUE 1 100 0.00 1.00000000000 BIT_MASK 0x1 FORMAT "%13.11" ECU_ADDRESS 0x382060 /end MEASUREMENT
/begin MEASUREMENT B_enhlshk "" UWORD B_TRUE 1 100 0.00 1.00000000000 BIT_MASK 0x2 FORMAT "%13.11" ECU_ADDRESS 0xFD52 /end MEASUREMENT
/begin MEASUREMENT B_enqsyn "" UWORD B_TRUE 1 100 0.00 1.00000000000 BIT_MASK 0x2000 FORMAT "%13.11" ECU_ADDRESS 0xFD42 /end MEASUREMENT
/begin MEASUREMENT B_enrinh "" UBYTE B_TRUE 1 100 0.00 1.00000000000 BIT_MASK 0x1 FORMAT "%13.11" ECU_ADDRESS 0xF0747 /end MEASUREMENT
/begin MEASUREMENT B_enrinh2 "" UBYTE B_TRUE 1 100 0.00 1.00000000000 BIT_MASK 0x4 FORMAT "%13.11" ECU_ADDRESS 0xF0747 /end MEASUREMENT
/begin MEASUREMENT B_enscun "" UBYTE B_TRUE 1 100 0.00 1.00000000000 BIT_MASK 0x1 FORMAT "%13.11" ECU_ADDRESS 0xF0B6E /end MEASUREMENT
/begin MEASUREMENT B_enscun2 "" UBYTE B_TRUE 1 100 0.00 1.00000000000 BIT_MASK 0x2 FORMAT "%13.11" ECU_ADDRESS 0xF0B6E /end MEASUREMENT
/begin MEASUREMENT B_erbr "" UWORD B_TRUE 1 100 0.00 1.00000000000 BIT_MASK 0x2 FORMAT "%13.11" ECU_ADDRESS 0xFD62 /end MEASUREMENT
/begin MEASUREMENT B_erinofh "" UBYTE B_TRUE 1 100 0.00 1.00000000000 BIT_MASK 0x2 FORMAT "%13.11" ECU_ADDRESS 0xF0747 /end MEASUREMENT
/begin MEASUREMENT B_erinofh2 "" UBYTE B_TRUE 1 100 0.00 1.00000000000 BIT_MASK 0x8 FORMAT "%13.11" ECU_ADDRESS 0xF0747 /end MEASUREMENT
/begin MEASUREMENT B_erlsuwi "" UBYTE B_TRUE 1 100 0.00 1.00000000000 BIT_MASK 0x4 FORMAT "%13.11" ECU_ADDRESS 0xE28D /end MEASUREMENT
/begin MEASUREMENT B_erlsuwi2 "" UBYTE B_TRUE 1 100 0.00 1.00000000000 BIT_MASK 0x8 FORMAT "%13.11" ECU_ADDRESS 0xE28D /end MEASUREMENT
/begin MEASUREMENT B_eshlsu "" UBYTE B_TRUE 1 100 0.00 1.00000000000 BIT_MASK 0x1 FORMAT "%13.11" ECU_ADDRESS 0xF0B5F /end MEASUREMENT
/begin MEASUREMENT B_eshlsu2 "" UBYTE B_TRUE 1 100 0.00 1.00000000000 BIT_MASK 0x1 FORMAT "%13.11" ECU_ADDRESS 0xF0B60 /end MEASUREMENT
/begin MEASUREMENT B_etafix "" UBYTE B_TRUE 1 100 0.00 1.00000000000 BIT_MASK 0x8 FORMAT "%13.11" ECU_ADDRESS 0xF0921 /end MEASUREMENT
/begin MEASUREMENT B_fbm "" UWORD B_TRUE 1 100 0.00 1.00000000000 BIT_MASK 0x4000 FORMAT "%13.11" ECU_ADDRESS 0xFD42 /end MEASUREMENT
/begin MEASUREMENT B_ffhsc "" UBYTE B_TRUE 1 100 0.00 1.00000000000 BIT_MASK 0x2 FORMAT "%13.11" ECU_ADDRESS 0xF0816 /end MEASUREMENT
/begin MEASUREMENT B_fgootein "" UBYTE B_TRUE 1 100 0.00 1.00000000000 BIT_MASK 0x4 FORMAT "%13.11" ECU_ADDRESS 0xF0816 /end MEASUREMENT
/begin MEASUREMENT B_fgr6p "" UWORD B_TRUE 1 100 0.00 1.00000000000 BIT_MASK 0x8 FORMAT "%13.11" ECU_ADDRESS 0xFD54 /end MEASUREMENT
/begin MEASUREMENT B_fgrat "" UWORD B_TRUE 1 100 0.00 1.00000000000 BIT_MASK 0x10 FORMAT "%13.11" ECU_ADDRESS 0xFD54 /end MEASUREMENT
/begin MEASUREMENT B_fgrbtl "" UBYTE B_TRUE 1 100 0.00 1.00000000000 BIT_MASK 0x1 FORMAT "%13.11" ECU_ADDRESS 0xF0817 /end MEASUREMENT
/begin MEASUREMENT B_fgrhe "" UWORD B_TRUE 1 100 0.00 1.00000000000 BIT_MASK 0x20 FORMAT "%13.11" ECU_ADDRESS 0xFD54 /end MEASUREMENT
/begin MEASUREMENT B_fgrhev "" UBYTE B_TRUE 1 100 0.00 1.00000000000 BIT_MASK 0x8 FORMAT "%13.11" ECU_ADDRESS 0xF0816 /end MEASUREMENT
/begin MEASUREMENT B_fgrhs "" UBYTE B_TRUE 1 100 0.00 1.00000000000 BIT_MASK 0x10 FORMAT "%13.11" ECU_ADDRESS 0xF0816 /end MEASUREMENT
/begin MEASUREMENT B_fgrhsa "" UWORD B_TRUE 1 100 0.00 1.00000000000 BIT_MASK 0x40 FORMAT "%13.11" ECU_ADDRESS 0xFD54 /end MEASUREMENT
/begin MEASUREMENT B_fgrtbe "" UWORD B_TRUE 1 100 0.00 1.00000000000 BIT_MASK 0x80 FORMAT "%13.11" ECU_ADDRESS 0xFD54 /end MEASUREMENT
/begin MEASUREMENT B_fgrtbh "" UWORD B_TRUE 1 100 0.00 1.00000000000 BIT_MASK 0x100 FORMAT "%13.11" ECU_ADDRESS 0xFD54 /end MEASUREMENT
/begin MEASUREMENT B_fgrths "" UBYTE B_TRUE 1 100 0.00 1.00000000000 BIT_MASK 0x2 FORMAT "%13.11" ECU_ADDRESS 0xF0817 /end MEASUREMENT
/begin MEASUREMENT B_fgrthse "" UBYTE B_TRUE 1 100 0.00 1.00000000000 BIT_MASK 0x4 FORMAT "%13.11" ECU_ADDRESS 0xF0817 /end MEASUREMENT
/begin MEASUREMENT B_fgrtse "" UWORD B_TRUE 1 100 0.00 1.00000000000 BIT_MASK 0x200 FORMAT "%13.11" ECU_ADDRESS 0xFD54 /end MEASUREMENT
/begin MEASUREMENT B_fgrtve "" UWORD B_TRUE 1 100 0.00 1.00000000000 BIT_MASK 0x400 FORMAT "%13.11" ECU_ADDRESS 0xFD54 /end MEASUREMENT
/begin MEASUREMENT B_fgrtvh "" UWORD B_TRUE 1 100 0.00 1.00000000000 BIT_MASK 0x800 FORMAT "%13.11" ECU_ADDRESS 0xFD54 /end MEASUREMENT
/begin MEASUREMENT B_fgrtwa "" UWORD B_TRUE 1 100 0.00 1.00000000000 BIT_MASK 0x1000 FORMAT "%13.11" ECU_ADDRESS 0xFD54 /end MEASUREMENT
/begin MEASUREMENT B_fklanf "" UWORD B_TRUE 1 100 0.00 1.00000000000 BIT_MASK 0x800 FORMAT "%13.11" ECU_ADDRESS 0xFDB0 /end MEASUREMENT
/begin MEASUREMENT B_fklanf2 "" UWORD B_TRUE 1 100 0.00 1.00000000000 BIT_MASK 0x1000 FORMAT "%13.11" ECU_ADDRESS 0xFDB0 /end MEASUREMENT
/begin MEASUREMENT B_fklanfs "" UWORD B_TRUE 1 100 0.00 1.00000000000 BIT_MASK 0x2000 FORMAT "%13.11" ECU_ADDRESS 0xFDB0 /end MEASUREMENT
/begin MEASUREMENT B_fmfkrc "" UWORD B_TRUE 1 100 0.00 1.00000000000 BIT_MASK 0x2000 FORMAT "%13.11" ECU_ADDRESS 0xFD8E /end MEASUREMENT
/begin MEASUREMENT B_fmfkrhs "" UWORD B_TRUE 1 100 0.00 1.00000000000 BIT_MASK 0x4000 FORMAT "%13.11" ECU_ADDRESS 0xFD8E /end MEASUREMENT
/begin MEASUREMENT B_fpwld "" UWORD B_TRUE 1 100 0.00 1.00000000000 BIT_MASK 0x8 FORMAT "%13.11" ECU_ADDRESS 0xFD0E /end MEASUREMENT
/begin MEASUREMENT B_fztafx "" UBYTE B_TRUE 1 100 0.00 1.00000000000 BIT_MASK 0x10 FORMAT "%13.11" ECU_ADDRESS 0xF0921 /end MEASUREMENT
/begin MEASUREMENT B_glf "" UWORD B_TRUE 1 100 0.00 1.00000000000 BIT_MASK 0x1 FORMAT "%13.11" ECU_ADDRESS 0xFD56 /end MEASUREMENT
/begin MEASUREMENT B_gra6pe "" UBYTE B_TRUE 1 100 0.00 1.00000000000 BIT_MASK 0x8 FORMAT "%13.11" ECU_ADDRESS 0xF0817 /end MEASUREMENT
/begin MEASUREMENT B_hag "" UWORD B_TRUE 1 100 0.00 1.00000000000 BIT_MASK 0x1 FORMAT "%13.11" ECU_ADDRESS 0xFD6E /end MEASUREMENT
/begin MEASUREMENT B_henrin "" UBYTE B_TRUE 1 100 0.00 1.00000000000 BIT_MASK 0x2 FORMAT "%13.11" ECU_ADDRESS 0xF0B5F /end MEASUREMENT
/begin MEASUREMENT B_henrin2 "" UBYTE B_TRUE 1 100 0.00 1.00000000000 BIT_MASK 0x2 FORMAT "%13.11" ECU_ADDRESS 0xF0B60 /end MEASUREMENT
/begin MEASUREMENT B_hlsuaru "" UBYTE B_TRUE 1 100 0.00 1.00000000000 BIT_MASK 0x2 FORMAT "%13.11" ECU_ADDRESS 0xE1E8 /end MEASUREMENT
/begin MEASUREMENT B_hlsuaru2 "" UBYTE B_TRUE 1 100 0.00 1.00000000000 BIT_MASK 0x2 FORMAT "%13.11" ECU_ADDRESS 0xE1E9 /end MEASUREMENT
/begin MEASUREMENT B_hlsumx "" UBYTE B_TRUE 1 100 0.00 1.00000000000 BIT_MASK 0x20 FORMAT "%13.11" ECU_ADDRESS 0xF0B5F /end MEASUREMENT
/begin MEASUREMENT B_hlsumx2 "" UBYTE B_TRUE 1 100 0.00 1.00000000000 BIT_MASK 0x20 FORMAT "%13.11" ECU_ADDRESS 0xF0B60 /end MEASUREMENT
/begin MEASUREMENT B_hrevab "" UBYTE B_TRUE 1 100 0.00 1.00000000000 BIT_MASK 0x4 FORMAT "%13.11" ECU_ADDRESS 0xF07EE /end MEASUREMENT
/begin MEASUREMENT B_hrkng "" UBYTE B_TRUE 1 100 0.00 1.00000000000 BIT_MASK 0x10 FORMAT "%13.11" ECU_ADDRESS 0xF07EE /end MEASUREMENT
/begin MEASUREMENT B_hrkzlg "" UBYTE B_TRUE 1 100 0.00 1.00000000000 BIT_MASK 0x20 FORMAT "%13.11" ECU_ADDRESS 0xF07EE /end MEASUREMENT
/begin MEASUREMENT B_hsha "" UWORD B_TRUE 1 100 0.00 1.00000000000 BIT_MASK 0x4 FORMAT "%13.11" ECU_ADDRESS 0xFD52 /end MEASUREMENT
/begin MEASUREMENT B_hsha2 "" UWORD B_TRUE 1 100 0.00 1.00000000000 BIT_MASK 0x8 FORMAT "%13.11" ECU_ADDRESS 0xFD52 /end MEASUREMENT
/begin MEASUREMENT B_hshe "" UWORD B_TRUE 1 100 0.00 1.00000000000 BIT_MASK 0x10 FORMAT "%13.11" ECU_ADDRESS 0xFD52 /end MEASUREMENT
/begin MEASUREMENT B_hshe2 "" UWORD B_TRUE 1 100 0.00 1.00000000000 BIT_MASK 0x20 FORMAT "%13.11" ECU_ADDRESS 0xFD52 /end MEASUREMENT
/begin MEASUREMENT B_hstlsua "" UBYTE B_TRUE 1 100 0.00 1.00000000000 BIT_MASK 0x4 FORMAT "%13.11" ECU_ADDRESS 0xF0B5F /end MEASUREMENT
/begin MEASUREMENT B_hstlsua2 "" UBYTE B_TRUE 1 100 0.00 1.00000000000 BIT_MASK 0x4 FORMAT "%13.11" ECU_ADDRESS 0xF0B60 /end MEASUREMENT
/begin MEASUREMENT B_hstlsub "" UBYTE B_TRUE 1 100 0.00 1.00000000000 BIT_MASK 0x8 FORMAT "%13.11" ECU_ADDRESS 0xF0B5F /end MEASUREMENT
/begin MEASUREMENT B_hstlsub2 "" UBYTE B_TRUE 1 100 0.00 1.00000000000 BIT_MASK 0x8 FORMAT "%13.11" ECU_ADDRESS 0xF0B60 /end MEASUREMENT
/begin MEASUREMENT B_hsttwt "" UBYTE B_TRUE 1 100 0.00 1.00000000000 BIT_MASK 0x1 FORMAT "%13.11" ECU_ADDRESS 0xF0935 /end MEASUREMENT
/begin MEASUREMENT B_hsv "" UBYTE B_TRUE 1 100 0.00 1.00000000000 BIT_MASK 0x10 FORMAT "%13.11" ECU_ADDRESS 0xF0B5F /end MEASUREMENT
/begin MEASUREMENT B_hsv2 "" UBYTE B_TRUE 1 100 0.00 1.00000000000 BIT_MASK 0x10 FORMAT "%13.11" ECU_ADDRESS 0xF0B60 /end MEASUREMENT
/begin MEASUREMENT B_hsvemn "" UWORD B_TRUE 1 100 0.00 1.00000000000 BIT_MASK 0x1000 FORMAT "%13.11" ECU_ADDRESS 0xFD86 /end MEASUREMENT
/begin MEASUREMENT B_hsvemn2 "" UWORD B_TRUE 1 100 0.00 1.00000000000 BIT_MASK 0x2000 FORMAT "%13.11" ECU_ADDRESS 0xFD86 /end MEASUREMENT
/begin MEASUREMENT B_hsvemx "" UWORD B_TRUE 1 100 0.00 1.00000000000 BIT_MASK 0x4000 FORMAT "%13.11" ECU_ADDRESS 0xFD86 /end MEASUREMENT
/begin MEASUREMENT B_hsvemx2 "" UWORD B_TRUE 1 100 0.00 1.00000000000 BIT_MASK 0x8000 FORMAT "%13.11" ECU_ADDRESS 0xFD86 /end MEASUREMENT
/begin MEASUREMENT B_hsvesi "" UWORD B_TRUE 1 100 0.00 1.00000000000 BIT_MASK 0x1 FORMAT "%13.11" ECU_ADDRESS 0xFD88 /end MEASUREMENT
/begin MEASUREMENT B_hsvesi2 "" UWORD B_TRUE 1 100 0.00 1.00000000000 BIT_MASK 0x2 FORMAT "%13.11" ECU_ADDRESS 0xFD88 /end MEASUREMENT
/begin MEASUREMENT B_hztanl "" UBYTE B_TRUE 1 100 0.00 1.00000000000 BIT_MASK 0x2 FORMAT "%13.11" ECU_ADDRESS 0xF0921 /end MEASUREMENT
/begin MEASUREMENT B_iclsabg "" UWORD B_TRUE 1 100 0.00 1.00000000000 BIT_MASK 0x4000 FORMAT "%13.11" ECU_ADDRESS 0xFDB0 /end MEASUREMENT
/begin MEASUREMENT B_iclsabg2 "" UWORD B_TRUE 1 100 0.00 1.00000000000 BIT_MASK 0x8000 FORMAT "%13.11" ECU_ADDRESS 0xFDB0 /end MEASUREMENT
/begin MEASUREMENT B_JumpRamOK "" UWORD B_TRUE 1 100 0.00 1.00000000000 BIT_MASK 0x10 FORMAT "%13.11" ECU_ADDRESS 0xFD0E /end MEASUREMENT
/begin MEASUREMENT B_kdhre "" UBYTE B_TRUE 1 100 0.00 1.00000000000 BIT_MASK 0x2 FORMAT "%13.11" ECU_ADDRESS 0xF07EE /end MEASUREMENT
/begin MEASUREMENT B_kl15 "" UWORD B_TRUE 1 100 0.00 1.00000000000 BIT_MASK 0x100 FORMAT "%13.11" ECU_ADDRESS 0xFDAE /end MEASUREMENT
/begin MEASUREMENT B_kldfact "" UWORD B_TRUE 1 100 0.00 1.00000000000 BIT_MASK 0x8000 FORMAT "%13.11" ECU_ADDRESS 0xFD0E /end MEASUREMENT
/begin MEASUREMENT B_klh "" UBYTE B_TRUE 1 100 0.00 1.00000000000 BIT_MASK 0x10 FORMAT "%13.11" ECU_ADDRESS 0xF0934 /end MEASUREMENT
/begin MEASUREMENT B_kln "" UBYTE B_TRUE 1 100 0.00 1.00000000000 BIT_MASK 0x20 FORMAT "%13.11" ECU_ADDRESS 0xF0934 /end MEASUREMENT
/begin MEASUREMENT B_kpl "" UBYTE B_TRUE 1 100 0.00 1.00000000000 BIT_MASK 0x10 FORMAT "%13.11" ECU_ADDRESS 0xF0922 /end MEASUREMENT
/begin MEASUREMENT B_kuppl "" UWORD B_TRUE 1 100 0.00 1.00000000000 BIT_MASK 0x100 FORMAT "%13.11" ECU_ADDRESS 0xFD62 /end MEASUREMENT
/begin MEASUREMENT B_kupplv "" UWORD B_TRUE 1 100 0.00 1.00000000000 BIT_MASK 0x200 FORMAT "%13.11" ECU_ADDRESS 0xFD62 /end MEASUREMENT
/begin MEASUREMENT B_ldpi "" UWORD B_TRUE 1 100 0.00 1.00000000000 BIT_MASK 0x40 FORMAT "%13.11" ECU_ADDRESS 0xFD84 /end MEASUREMENT
/begin MEASUREMENT B_llhzta "" UBYTE B_TRUE 1 100 0.00 1.00000000000 BIT_MASK 0x4 FORMAT "%13.11" ECU_ADDRESS 0xF0921 /end MEASUREMENT
/begin MEASUREMENT B_lltafx "" UBYTE B_TRUE 1 100 0.00 1.00000000000 BIT_MASK 0x20 FORMAT "%13.11" ECU_ADDRESS 0xF0921 /end MEASUREMENT
/begin MEASUREMENT B_lsuiamn "" UWORD B_TRUE 1 100 0.00 1.00000000000 BIT_MASK 0x4 FORMAT "%13.11" ECU_ADDRESS 0xFD88 /end MEASUREMENT
/begin MEASUREMENT B_lsuiamn2 "" UWORD B_TRUE 1 100 0.00 1.00000000000 BIT_MASK 0x8 FORMAT "%13.11" ECU_ADDRESS 0xFD88 /end MEASUREMENT
/begin MEASUREMENT B_lsuiamx "" UWORD B_TRUE 1 100 0.00 1.00000000000 BIT_MASK 0x10 FORMAT "%13.11" ECU_ADDRESS 0xFD88 /end MEASUREMENT
/begin MEASUREMENT B_lsuiamx2 "" UWORD B_TRUE 1 100 0.00 1.00000000000 BIT_MASK 0x20 FORMAT "%13.11" ECU_ADDRESS 0xFD88 /end MEASUREMENT
/begin MEASUREMENT B_lsuicif "" UWORD B_TRUE 1 100 0.00 1.00000000000 BIT_MASK 0x40 FORMAT "%13.11" ECU_ADDRESS 0xFD88 /end MEASUREMENT
/begin MEASUREMENT B_lsuicif2 "" UWORD B_TRUE 1 100 0.00 1.00000000000 BIT_MASK 0x80 FORMAT "%13.11" ECU_ADDRESS 0xFD88 /end MEASUREMENT
/begin MEASUREMENT B_lsuickf "" UWORD B_TRUE 1 100 0.00 1.00000000000 BIT_MASK 0x100 FORMAT "%13.11" ECU_ADDRESS 0xFD88 /end MEASUREMENT
/begin MEASUREMENT B_lsuickf2 "" UWORD B_TRUE 1 100 0.00 1.00000000000 BIT_MASK 0x200 FORMAT "%13.11" ECU_ADDRESS 0xFD88 /end MEASUREMENT
/begin MEASUREMENT B_lsuube "" UWORD B_TRUE 1 100 0.00 1.00000000000 BIT_MASK 0x400 FORMAT "%13.11" ECU_ADDRESS 0xFD88 /end MEASUREMENT
/begin MEASUREMENT B_lsuube2 "" UWORD B_TRUE 1 100 0.00 1.00000000000 BIT_MASK 0x800 FORMAT "%13.11" ECU_ADDRESS 0xFD88 /end MEASUREMENT
/begin MEASUREMENT B_lsuunmn "" UWORD B_TRUE 1 100 0.00 1.00000000000 BIT_MASK 0x1000 FORMAT "%13.11" ECU_ADDRESS 0xFD88 /end MEASUREMENT
/begin MEASUREMENT B_lsuunmn2 "" UWORD B_TRUE 1 100 0.00 1.00000000000 BIT_MASK 0x2000 FORMAT "%13.11" ECU_ADDRESS 0xFD88 /end MEASUREMENT
/begin MEASUREMENT B_lsuunmx "" UWORD B_TRUE 1 100 0.00 1.00000000000 BIT_MASK 0x4000 FORMAT "%13.11" ECU_ADDRESS 0xFD88 /end MEASUREMENT
/begin MEASUREMENT B_lsuunmx2 "" UWORD B_TRUE 1 100 0.00 1.00000000000 BIT_MASK 0x8000 FORMAT "%13.11" ECU_ADDRESS 0xFD88 /end MEASUREMENT
/begin MEASUREMENT B_lsuvmmn "" UWORD B_TRUE 1 100 0.00 1.00000000000 BIT_MASK 0x1 FORMAT "%13.11" ECU_ADDRESS 0xFD8A /end MEASUREMENT
/begin MEASUREMENT B_lsuvmmn2 "" UWORD B_TRUE 1 100 0.00 1.00000000000 BIT_MASK 0x2 FORMAT "%13.11" ECU_ADDRESS 0xFD8A /end MEASUREMENT
/begin MEASUREMENT B_lsuvmmx "" UWORD B_TRUE 1 100 0.00 1.00000000000 BIT_MASK 0x4 FORMAT "%13.11" ECU_ADDRESS 0xFD8A /end MEASUREMENT
/begin MEASUREMENT B_lsuvmmx2 "" UWORD B_TRUE 1 100 0.00 1.00000000000 BIT_MASK 0x8 FORMAT "%13.11" ECU_ADDRESS 0xFD8A /end MEASUREMENT
/begin MEASUREMENT B_luecke "" UWORD B_TRUE 1 100 0.00 1.00000000000 BIT_MASK 0x8000 FORMAT "%13.11" ECU_ADDRESS 0xFD42 /end MEASUREMENT
/begin MEASUREMENT B_mbvh "" UWORD B_TRUE 1 100 0.00 1.00000000000 BIT_MASK 0x2 FORMAT "%13.11" ECU_ADDRESS 0xFD56 /end MEASUREMENT
/begin MEASUREMENT B_measure "" UWORD B_TRUE 1 100 0.00 1.00000000000 BIT_MASK 0x10 FORMAT "%13.11" ECU_ADDRESS 0xFD50 /end MEASUREMENT
/begin MEASUREMENT B_mluecke "" UWORD B_TRUE 1 100 0.00 1.00000000000 BIT_MASK 0x1 FORMAT "%13.11" ECU_ADDRESS 0xFD44 /end MEASUREMENT
/begin MEASUREMENT B_mn_hsve "" UWORD B_TRUE 1 100 0.00 1.00000000000 BIT_MASK 0x10 FORMAT "%13.11" ECU_ADDRESS 0xFD8A /end MEASUREMENT
/begin MEASUREMENT B_mn_hsve2 "" UWORD B_TRUE 1 100 0.00 1.00000000000 BIT_MASK 0x20 FORMAT "%13.11" ECU_ADDRESS 0xFD8A /end MEASUREMENT
/begin MEASUREMENT B_mn_ia "" UWORD B_TRUE 1 100 0.00 1.00000000000 BIT_MASK 0x40 FORMAT "%13.11" ECU_ADDRESS 0xFD8A /end MEASUREMENT
/begin MEASUREMENT B_mn_ia2 "" UWORD B_TRUE 1 100 0.00 1.00000000000 BIT_MASK 0x80 FORMAT "%13.11" ECU_ADDRESS 0xFD8A /end MEASUREMENT
/begin MEASUREMENT B_mn_un "" UWORD B_TRUE 1 100 0.00 1.00000000000 BIT_MASK 0x100 FORMAT "%13.11" ECU_ADDRESS 0xFD8A /end MEASUREMENT
/begin MEASUREMENT B_mn_un2 "" UWORD B_TRUE 1 100 0.00 1.00000000000 BIT_MASK 0x200 FORMAT "%13.11" ECU_ADDRESS 0xFD8A /end MEASUREMENT
/begin MEASUREMENT B_mn_vm "" UWORD B_TRUE 1 100 0.00 1.00000000000 BIT_MASK 0x400 FORMAT "%13.11" ECU_ADDRESS 0xFD8A /end MEASUREMENT
/begin MEASUREMENT B_mn_vm2 "" UWORD B_TRUE 1 100 0.00 1.00000000000 BIT_MASK 0x800 FORMAT "%13.11" ECU_ADDRESS 0xFD8A /end MEASUREMENT
/begin MEASUREMENT B_mx_hsve "" UWORD B_TRUE 1 100 0.00 1.00000000000 BIT_MASK 0x1000 FORMAT "%13.11" ECU_ADDRESS 0xFD8A /end MEASUREMENT
/begin MEASUREMENT B_mx_hsve2 "" UWORD B_TRUE 1 100 0.00 1.00000000000 BIT_MASK 0x2000 FORMAT "%13.11" ECU_ADDRESS 0xFD8A /end MEASUREMENT
/begin MEASUREMENT B_mx_ia "" UWORD B_TRUE 1 100 0.00 1.00000000000 BIT_MASK 0x4000 FORMAT "%13.11" ECU_ADDRESS 0xFD8A /end MEASUREMENT
/begin MEASUREMENT B_mx_ia2 "" UWORD B_TRUE 1 100 0.00 1.00000000000 BIT_MASK 0x8000 FORMAT "%13.11" ECU_ADDRESS 0xFD8A /end MEASUREMENT
/begin MEASUREMENT B_mx_un "" UWORD B_TRUE 1 100 0.00 1.00000000000 BIT_MASK 0x1 FORMAT "%13.11" ECU_ADDRESS 0xFD8C /end MEASUREMENT
/begin MEASUREMENT B_mx_un2 "" UWORD B_TRUE 1 100 0.00 1.00000000000 BIT_MASK 0x2 FORMAT "%13.11" ECU_ADDRESS 0xFD8C /end MEASUREMENT
/begin MEASUREMENT B_mx_vm "" UWORD B_TRUE 1 100 0.00 1.00000000000 BIT_MASK 0x4 FORMAT "%13.11" ECU_ADDRESS 0xFD8C /end MEASUREMENT
/begin MEASUREMENT B_mx_vm2 "" UWORD B_TRUE 1 100 0.00 1.00000000000 BIT_MASK 0x8 FORMAT "%13.11" ECU_ADDRESS 0xFD8C /end MEASUREMENT
/begin MEASUREMENT B_neucode "" UWORD B_TRUE 1 100 0.00 1.00000000000 BIT_MASK 0x40 FORMAT "%13.11" ECU_ADDRESS 0xFD0E /end MEASUREMENT
/begin MEASUREMENT B_nmin "" UWORD B_TRUE 1 100 0.00 1.00000000000 BIT_MASK 0x2 FORMAT "%13.11" ECU_ADDRESS 0xFD44 /end MEASUREMENT
/begin MEASUREMENT B_nmot "" UWORD B_TRUE 1 100 0.00 1.00000000000 BIT_MASK 0x4 FORMAT "%13.11" ECU_ADDRESS 0xFD44 /end MEASUREMENT
/begin MEASUREMENT B_nobm "" UWORD B_TRUE 1 100 0.00 1.00000000000 BIT_MASK 0x8 FORMAT "%13.11" ECU_ADDRESS 0xFD44 /end MEASUREMENT
/begin MEASUREMENT B_nobm1 "" UBYTE B_TRUE 1 100 0.00 1.00000000000 BIT_MASK 0x1 FORMAT "%13.11" ECU_ADDRESS 0x382040 /end MEASUREMENT
/begin MEASUREMENT B_noph "" UWORD B_TRUE 1 100 0.00 1.00000000000 BIT_MASK 0x10 FORMAT "%13.11" ECU_ADDRESS 0xFD44 /end MEASUREMENT
/begin MEASUREMENT B_noph2 "" UWORD B_TRUE 1 100 0.00 1.00000000000 BIT_MASK 0x20 FORMAT "%13.11" ECU_ADDRESS 0xFD44 /end MEASUREMENT
/begin MEASUREMENT B_no_pl_err "" UBYTE B_TRUE 1 100 0.00 1.00000000000 BIT_MASK 0x4 FORMAT "%13.11" ECU_ADDRESS 0xF0922 /end MEASUREMENT
/begin MEASUREMENT B_no_si_err "" UBYTE B_TRUE 1 100 0.00 1.00000000000 BIT_MASK 0x8 FORMAT "%13.11" ECU_ADDRESS 0xF0922 /end MEASUREMENT
/begin MEASUREMENT B_nputm "" UBYTE B_TRUE 1 100 0.00 1.00000000000 BIT_MASK 0x2 FORMAT "%13.11" ECU_ADDRESS 0xF0934 /end MEASUREMENT
/begin MEASUREMENT B_ntini "" UWORD B_TRUE 1 100 0.00 1.00000000000 BIT_MASK 0x8000 FORMAT "%13.11" ECU_ADDRESS 0xFD8E /end MEASUREMENT
/begin MEASUREMENT B_nwflad "" UBYTE B_TRUE 1 100 0.00 1.00000000000 BIT_MASK 0x1 FORMAT "%13.11" ECU_ADDRESS 0xF06F3 /end MEASUREMENT
/begin MEASUREMENT B_nwflad2 "" UBYTE B_TRUE 1 100 0.00 1.00000000000 BIT_MASK 0x2 FORMAT "%13.11" ECU_ADDRESS 0xF06F3 /end MEASUREMENT
/begin MEASUREMENT B_nwia "" UBYTE B_TRUE 1 100 0.00 1.00000000000 BIT_MASK 0x4 FORMAT "%13.11" ECU_ADDRESS 0x38203C /end MEASUREMENT
/begin MEASUREMENT B_nwie "" UBYTE B_TRUE 1 100 0.00 1.00000000000 BIT_MASK 0x8 FORMAT "%13.11" ECU_ADDRESS 0x38203C /end MEASUREMENT
/begin MEASUREMENT B_pbpabr "" UWORD B_TRUE 1 100 0.00 1.00000000000 BIT_MASK 0x4 FORMAT "%13.11" ECU_ADDRESS 0xFD56 /end MEASUREMENT
/begin MEASUREMENT B_pgxqsyn "" UWORD B_TRUE 1 100 0.00 1.00000000000 BIT_MASK 0x40 FORMAT "%13.11" ECU_ADDRESS 0xFD44 /end MEASUREMENT
/begin MEASUREMENT B_pha2act "" UWORD B_TRUE 1 100 0.00 1.00000000000 BIT_MASK 0x80 FORMAT "%13.11" ECU_ADDRESS 0xFD44 /end MEASUREMENT
/begin MEASUREMENT B_phaact "" UWORD B_TRUE 1 100 0.00 1.00000000000 BIT_MASK 0x100 FORMAT "%13.11" ECU_ADDRESS 0xFD44 /end MEASUREMENT
/begin MEASUREMENT B_phad "" UBYTE B_TRUE 1 100 0.00 1.00000000000 BIT_MASK 0x10 FORMAT "%13.11" ECU_ADDRESS 0x38203C /end MEASUREMENT
/begin MEASUREMENT B_phad2 "" UBYTE B_TRUE 1 100 0.00 1.00000000000 BIT_MASK 0x20 FORMAT "%13.11" ECU_ADDRESS 0x38203C /end MEASUREMENT
/begin MEASUREMENT B_phada "" UBYTE B_TRUE 1 100 0.00 1.00000000000 BIT_MASK 0x40 FORMAT "%13.11" ECU_ADDRESS 0x38203C /end MEASUREMENT
/begin MEASUREMENT B_phade "" UBYTE B_TRUE 1 100 0.00 1.00000000000 BIT_MASK 0x80 FORMAT "%13.11" ECU_ADDRESS 0x38203C /end MEASUREMENT
/begin MEASUREMENT B_phas2 "" UWORD B_TRUE 1 100 0.00 1.00000000000 BIT_MASK 0x200 FORMAT "%13.11" ECU_ADDRESS 0xFD44 /end MEASUREMENT
/begin MEASUREMENT B_phase "" UWORD B_TRUE 1 100 0.00 1.00000000000 BIT_MASK 0x400 FORMAT "%13.11" ECU_ADDRESS 0xFD44 /end MEASUREMENT
/begin MEASUREMENT B_phgefl "" UBYTE B_TRUE 1 100 0.00 1.00000000000 BIT_MASK 0x10 FORMAT "%13.11" ECU_ADDRESS 0xF06F3 /end MEASUREMENT
/begin MEASUREMENT B_phgefl2 "" UBYTE B_TRUE 1 100 0.00 1.00000000000 BIT_MASK 0x20 FORMAT "%13.11" ECU_ADDRESS 0xF06F3 /end MEASUREMENT
/begin MEASUREMENT B_phnmo "" UBYTE B_TRUE 1 100 0.00 1.00000000000 BIT_MASK 0x1 FORMAT "%13.11" ECU_ADDRESS 0xF06F1 /end MEASUREMENT
/begin MEASUREMENT B_phnmu "" UBYTE B_TRUE 1 100 0.00 1.00000000000 BIT_MASK 0x2 FORMAT "%13.11" ECU_ADDRESS 0xF06F1 /end MEASUREMENT
/begin MEASUREMENT B_phw "" UWORD B_TRUE 1 100 0.00 1.00000000000 BIT_MASK 0x800 FORMAT "%13.11" ECU_ADDRESS 0xFD44 /end MEASUREMENT
/begin MEASUREMENT B_phw2 "" UWORD B_TRUE 1 100 0.00 1.00000000000 BIT_MASK 0x1000 FORMAT "%13.11" ECU_ADDRESS 0xFD44 /end MEASUREMENT
/begin MEASUREMENT B_phwneg "" UWORD B_TRUE 1 100 0.00 1.00000000000 BIT_MASK 0x2000 FORMAT "%13.11" ECU_ADDRESS 0xFD44 /end MEASUREMENT
/begin MEASUREMENT B_phwok "" UWORD B_TRUE 1 100 0.00 1.00000000000 BIT_MASK 0x4000 FORMAT "%13.11" ECU_ADDRESS 0xFD44 /end MEASUREMENT
/begin MEASUREMENT B_phwok2 "" UWORD B_TRUE 1 100 0.00 1.00000000000 BIT_MASK 0x8000 FORMAT "%13.11" ECU_ADDRESS 0xFD44 /end MEASUREMENT
/begin MEASUREMENT B_phwpos "" UWORD B_TRUE 1 100 0.00 1.00000000000 BIT_MASK 0x1 FORMAT "%13.11" ECU_ADDRESS 0xFD46 /end MEASUREMENT
/begin MEASUREMENT B_plaus "" UBYTE B_TRUE 1 100 0.00 1.00000000000 BIT_MASK 0x20 FORMAT "%13.11" ECU_ADDRESS 0xF0922 /end MEASUREMENT
/begin MEASUREMENT B_pl_err "" UBYTE B_TRUE 1 100 0.00 1.00000000000 BIT_MASK 0x1 FORMAT "%13.11" ECU_ADDRESS 0xF0922 /end MEASUREMENT
/begin MEASUREMENT B_priph "" UWORD B_TRUE 1 100 0.00 1.00000000000 BIT_MASK 0x2000 FORMAT "%13.11" ECU_ADDRESS 0xFD4C /end MEASUREMENT
/begin MEASUREMENT B_priph2 "" UWORD B_TRUE 1 100 0.00 1.00000000000 BIT_MASK 0x4000 FORMAT "%13.11" ECU_ADDRESS 0xFD4C /end MEASUREMENT
/begin MEASUREMENT B_puklp1 "" UWORD B_TRUE 1 100 0.00 1.00000000000 BIT_MASK 0x200 FORMAT "%13.11" ECU_ADDRESS 0xFD6A /end MEASUREMENT
/begin MEASUREMENT B_puklp2 "" UWORD B_TRUE 1 100 0.00 1.00000000000 BIT_MASK 0x400 FORMAT "%13.11" ECU_ADDRESS 0xFD6A /end MEASUREMENT
/begin MEASUREMENT B_pullup "" UBYTE B_TRUE 1 100 0.00 1.00000000000 BIT_MASK 0x1 FORMAT "%13.11" ECU_ADDRESS 0xF0934 /end MEASUREMENT
/begin MEASUREMENT B_pullupsw "" UBYTE B_TRUE 1 100 0.00 1.00000000000 BIT_MASK 0x80 FORMAT "%13.11" ECU_ADDRESS 0xF0934 /end MEASUREMENT
/begin MEASUREMENT B_pump "" UWORD B_TRUE 1 100 0.00 1.00000000000 BIT_MASK 0x20 FORMAT "%13.11" ECU_ADDRESS 0xFD50 /end MEASUREMENT
/begin MEASUREMENT B_pusab "" UBYTE B_TRUE 1 100 0.00 1.00000000000 BIT_MASK 0x4 FORMAT "%13.11" ECU_ADDRESS 0xF0B6E /end MEASUREMENT
/begin MEASUREMENT B_pusab2 "" UBYTE B_TRUE 1 100 0.00 1.00000000000 BIT_MASK 0x8 FORMAT "%13.11" ECU_ADDRESS 0xF0B6E /end MEASUREMENT
/begin MEASUREMENT B_pwgde "" UBYTE B_TRUE 1 100 0.00 1.00000000000 BIT_MASK 0x1 FORMAT "%13.11" ECU_ADDRESS 0x38205B /end MEASUREMENT
/begin MEASUREMENT B_pwgdee "" UBYTE B_TRUE 1 100 0.00 1.00000000000 BIT_MASK 0x40 FORMAT "%13.11" ECU_ADDRESS 0xF0820 /end MEASUREMENT
/begin MEASUREMENT B_pwgdeok "" UBYTE B_TRUE 1 100 0.00 1.00000000000 BIT_MASK 0x20 FORMAT "%13.11" ECU_ADDRESS 0xF0820 /end MEASUREMENT
/begin MEASUREMENT B_pwglk "" UWORD B_TRUE 1 100 0.00 1.00000000000 BIT_MASK 0x8 FORMAT "%13.11" ECU_ADDRESS 0xFD56 /end MEASUREMENT
/begin MEASUREMENT B_pwgnoten "" UWORD B_TRUE 1 100 0.00 1.00000000000 BIT_MASK 0x10 FORMAT "%13.11" ECU_ADDRESS 0xFD56 /end MEASUREMENT
/begin MEASUREMENT B_pwgnotfr "" UWORD B_TRUE 1 100 0.00 1.00000000000 BIT_MASK 0x20 FORMAT "%13.11" ECU_ADDRESS 0xFD56 /end MEASUREMENT
/begin MEASUREMENT B_pwmramp "" UWORD B_TRUE 1 100 0.00 1.00000000000 BIT_MASK 0x1 FORMAT "%13.11" ECU_ADDRESS 0xFD10 /end MEASUREMENT
/begin MEASUREMENT B_qsyn "" UWORD B_TRUE 1 100 0.00 1.00000000000 BIT_MASK 0x2 FORMAT "%13.11" ECU_ADDRESS 0xFD46 /end MEASUREMENT
/begin MEASUREMENT B_rcjx "" UWORD B_TRUE 1 100 0.00 1.00000000000 BIT_MASK 0x10 FORMAT "%13.11" ECU_ADDRESS 0xFD8C /end MEASUREMENT
/begin MEASUREMENT B_rcjx2 "" UWORD B_TRUE 1 100 0.00 1.00000000000 BIT_MASK 0x20 FORMAT "%13.11" ECU_ADDRESS 0xFD8C /end MEASUREMENT
/begin MEASUREMENT B_rehs "" UWORD B_TRUE 1 100 0.00 1.00000000000 BIT_MASK 0x40 FORMAT "%13.11" ECU_ADDRESS 0xFD52 /end MEASUREMENT
/begin MEASUREMENT B_resabg "" UWORD B_TRUE 1 100 0.00 1.00000000000 BIT_MASK 0x1 FORMAT "%13.11" ECU_ADDRESS 0xFDB2 /end MEASUREMENT
/begin MEASUREMENT B_resabg2 "" UWORD B_TRUE 1 100 0.00 1.00000000000 BIT_MASK 0x2 FORMAT "%13.11" ECU_ADDRESS 0xFDB2 /end MEASUREMENT
/begin MEASUREMENT B_rfgoot "" UWORD B_TRUE 1 100 0.00 1.00000000000 BIT_MASK 0x2000 FORMAT "%13.11" ECU_ADDRESS 0xFD54 /end MEASUREMENT
/begin MEASUREMENT B_riakh "" UWORD B_TRUE 1 100 0.00 1.00000000000 BIT_MASK 0x8000 FORMAT "%13.11" ECU_ADDRESS 0xFD4C /end MEASUREMENT
/begin MEASUREMENT B_riakh2 "" UWORD B_TRUE 1 100 0.00 1.00000000000 BIT_MASK 0x1 FORMAT "%13.11" ECU_ADDRESS 0xFD4E /end MEASUREMENT
/begin MEASUREMENT B_ribeh "" UWORD B_TRUE 1 100 0.00 1.00000000000 BIT_MASK 0x2 FORMAT "%13.11" ECU_ADDRESS 0xFD4E /end MEASUREMENT
/begin MEASUREMENT B_ribeh2 "" UWORD B_TRUE 1 100 0.00 1.00000000000 BIT_MASK 0x4 FORMAT "%13.11" ECU_ADDRESS 0xFD4E /end MEASUREMENT
/begin MEASUREMENT B_ribehv "" UWORD B_TRUE 1 100 0.00 1.00000000000 BIT_MASK 0x8 FORMAT "%13.11" ECU_ADDRESS 0xFD4E /end MEASUREMENT
/begin MEASUREMENT B_ribehv2 "" UWORD B_TRUE 1 100 0.00 1.00000000000 BIT_MASK 0x10 FORMAT "%13.11" ECU_ADDRESS 0xFD4E /end MEASUREMENT
/begin MEASUREMENT B_riibh "" UWORD B_TRUE 1 100 0.00 1.00000000000 BIT_MASK 0x20 FORMAT "%13.11" ECU_ADDRESS 0xFD4E /end MEASUREMENT
/begin MEASUREMENT B_riibh2 "" UWORD B_TRUE 1 100 0.00 1.00000000000 BIT_MASK 0x40 FORMAT "%13.11" ECU_ADDRESS 0xFD4E /end MEASUREMENT
/begin MEASUREMENT B_riimph "" UWORD B_TRUE 1 100 0.00 1.00000000000 BIT_MASK 0x80 FORMAT "%13.11" ECU_ADDRESS 0xFD4E /end MEASUREMENT
/begin MEASUREMENT B_rimh "" UWORD B_TRUE 1 100 0.00 1.00000000000 BIT_MASK 0x100 FORMAT "%13.11" ECU_ADDRESS 0xFD4E /end MEASUREMENT
/begin MEASUREMENT B_rimh2 "" UWORD B_TRUE 1 100 0.00 1.00000000000 BIT_MASK 0x200 FORMAT "%13.11" ECU_ADDRESS 0xFD4E /end MEASUREMENT
/begin MEASUREMENT B_rinabg "" UBYTE B_TRUE 1 100 0.00 1.00000000000 BIT_MASK 0x1 FORMAT "%13.11" ECU_ADDRESS 0xE28C /end MEASUREMENT
/begin MEASUREMENT B_rinabg2 "" UBYTE B_TRUE 1 100 0.00 1.00000000000 BIT_MASK 0x2 FORMAT "%13.11" ECU_ADDRESS 0xE28C /end MEASUREMENT
/begin MEASUREMENT B_rinh "" UBYTE B_TRUE 1 100 0.00 1.00000000000 BIT_MASK 0x1 FORMAT "%13.11" ECU_ADDRESS 0xF0746 /end MEASUREMENT
/begin MEASUREMENT B_rinh2 "" UBYTE B_TRUE 1 100 0.00 1.00000000000 BIT_MASK 0x2 FORMAT "%13.11" ECU_ADDRESS 0xF0746 /end MEASUREMENT
/begin MEASUREMENT B_ripuh "" UWORD B_TRUE 1 100 0.00 1.00000000000 BIT_MASK 0x400 FORMAT "%13.11" ECU_ADDRESS 0xFD4E /end MEASUREMENT
/begin MEASUREMENT B_ripuh2 "" UWORD B_TRUE 1 100 0.00 1.00000000000 BIT_MASK 0x800 FORMAT "%13.11" ECU_ADDRESS 0xFD4E /end MEASUREMENT
/begin MEASUREMENT B_rireh "" UWORD B_TRUE 1 100 0.00 1.00000000000 BIT_MASK 0x1000 FORMAT "%13.11" ECU_ADDRESS 0xFD4E /end MEASUREMENT
/begin MEASUREMENT B_rireh2 "" UWORD B_TRUE 1 100 0.00 1.00000000000 BIT_MASK 0x2000 FORMAT "%13.11" ECU_ADDRESS 0xFD4E /end MEASUREMENT
/begin MEASUREMENT B_risph "" UWORD B_TRUE 1 100 0.00 1.00000000000 BIT_MASK 0x4000 FORMAT "%13.11" ECU_ADDRESS 0xFD4E /end MEASUREMENT
/begin MEASUREMENT B_risph2 "" UWORD B_TRUE 1 100 0.00 1.00000000000 BIT_MASK 0x8000 FORMAT "%13.11" ECU_ADDRESS 0xFD4E /end MEASUREMENT
/begin MEASUREMENT B_SeedSent "" UWORD B_TRUE 1 100 0.00 1.00000000000 BIT_MASK 0x20 FORMAT "%13.11" ECU_ADDRESS 0xFD0E /end MEASUREMENT
/begin MEASUREMENT B_shres "" UWORD B_TRUE 1 100 0.00 1.00000000000 BIT_MASK 0x40 FORMAT "%13.11" ECU_ADDRESS 0xFD50 /end MEASUREMENT
/begin MEASUREMENT B_shres2 "" UWORD B_TRUE 1 100 0.00 1.00000000000 BIT_MASK 0x80 FORMAT "%13.11" ECU_ADDRESS 0xFD50 /end MEASUREMENT
/begin MEASUREMENT B_shuerf "" UWORD B_TRUE 1 100 0.00 1.00000000000 BIT_MASK 0x1 FORMAT "%13.11" ECU_ADDRESS 0xFD50 /end MEASUREMENT
/begin MEASUREMENT B_shuerf2 "" UWORD B_TRUE 1 100 0.00 1.00000000000 BIT_MASK 0x2 FORMAT "%13.11" ECU_ADDRESS 0xFD50 /end MEASUREMENT
/begin MEASUREMENT B_si_err "" UBYTE B_TRUE 1 100 0.00 1.00000000000 BIT_MASK 0x2 FORMAT "%13.11" ECU_ADDRESS 0xF0922 /end MEASUREMENT
/begin MEASUREMENT B_si_hsve "" UWORD B_TRUE 1 100 0.00 1.00000000000 BIT_MASK 0x40 FORMAT "%13.11" ECU_ADDRESS 0xFD8C /end MEASUREMENT
/begin MEASUREMENT B_si_hsve2 "" UWORD B_TRUE 1 100 0.00 1.00000000000 BIT_MASK 0x80 FORMAT "%13.11" ECU_ADDRESS 0xFD8C /end MEASUREMENT
/begin MEASUREMENT B_sp1s "" UWORD B_TRUE 1 100 0.00 1.00000000000 BIT_MASK 0x40 FORMAT "%13.11" ECU_ADDRESS 0xFD56 /end MEASUREMENT
/begin MEASUREMENT B_sp2s "" UWORD B_TRUE 1 100 0.00 1.00000000000 BIT_MASK 0x80 FORMAT "%13.11" ECU_ADDRESS 0xFD56 /end MEASUREMENT
/begin MEASUREMENT B_sphrlsu "" UBYTE B_TRUE 1 100 0.00 1.00000000000 BIT_MASK 0x4 FORMAT "%13.11" ECU_ADDRESS 0xE1E8 /end MEASUREMENT
/begin MEASUREMENT B_sphrlsu2 "" UBYTE B_TRUE 1 100 0.00 1.00000000000 BIT_MASK 0x4 FORMAT "%13.11" ECU_ADDRESS 0xE1E9 /end MEASUREMENT
/begin MEASUREMENT B_spsa "" UBYTE B_TRUE 1 100 0.00 1.00000000000 BIT_MASK 0x1 FORMAT "%13.11" ECU_ADDRESS 0xF06F2 /end MEASUREMENT
/begin MEASUREMENT B_spsa2 "" UBYTE B_TRUE 1 100 0.00 1.00000000000 BIT_MASK 0x2 FORMAT "%13.11" ECU_ADDRESS 0xF06F2 /end MEASUREMENT
/begin MEASUREMENT B_spsmin "" UWORD B_TRUE 1 100 0.00 1.00000000000 BIT_MASK 0x100 FORMAT "%13.11" ECU_ADDRESS 0xFD56 /end MEASUREMENT
/begin MEASUREMENT B_startini "" UWORD B_TRUE 1 100 0.00 1.00000000000 BIT_MASK 0x4 FORMAT "%13.11" ECU_ADDRESS 0xFD46 /end MEASUREMENT
/begin MEASUREMENT B_stprel "" UBYTE B_TRUE 1 100 0.00 1.00000000000 BIT_MASK 0x1 FORMAT "%13.11" ECU_ADDRESS 0xF0708 /end MEASUREMENT
/begin MEASUREMENT B_syn "" UWORD B_TRUE 1 100 0.00 1.00000000000 BIT_MASK 0x8 FORMAT "%13.11" ECU_ADDRESS 0xFD46 /end MEASUREMENT
/begin MEASUREMENT B_synbmale "" UWORD B_TRUE 1 100 0.00 1.00000000000 BIT_MASK 0x10 FORMAT "%13.11" ECU_ADDRESS 0xFD46 /end MEASUREMENT
/begin MEASUREMENT B_synph "" UWORD B_TRUE 1 100 0.00 1.00000000000 BIT_MASK 0x20 FORMAT "%13.11" ECU_ADDRESS 0xFD46 /end MEASUREMENT
/begin MEASUREMENT B_tabgs "" UWORD B_TRUE 1 100 0.00 1.00000000000 BIT_MASK 0x4 FORMAT "%13.11" ECU_ADDRESS 0xFDB2 /end MEASUREMENT
/begin MEASUREMENT B_tablsugr "" UBYTE B_TRUE 1 100 0.00 1.00000000000 BIT_MASK 0x10 FORMAT "%13.11" ECU_ADDRESS 0xE1E8 /end MEASUREMENT
/begin MEASUREMENT B_tal "" UBYTE B_TRUE 1 100 0.00 1.00000000000 BIT_MASK 0x1 FORMAT "%13.11" ECU_ADDRESS 0x38205A /end MEASUREMENT
/begin MEASUREMENT B_talval "" UWORD B_TRUE 1 100 0.00 1.00000000000 BIT_MASK 0x8000 FORMAT "%13.11" ECU_ADDRESS 0xFD52 /end MEASUREMENT
/begin MEASUREMENT B_tevtini "" UWORD B_TRUE 1 100 0.00 1.00000000000 BIT_MASK 0x400 FORMAT "%13.11" ECU_ADDRESS 0xFDBA /end MEASUREMENT
/begin MEASUREMENT B_tmdzg "" UBYTE B_TRUE 1 100 0.00 1.00000000000 BIT_MASK 0x40 FORMAT "%13.11" ECU_ADDRESS 0xF0934 /end MEASUREMENT
/begin MEASUREMENT B_tmmn "" UWORD B_TRUE 1 100 0.00 1.00000000000 BIT_MASK 0x1 FORMAT "%13.11" ECU_ADDRESS 0xFD84 /end MEASUREMENT
/begin MEASUREMENT B_tmsrt "" UWORD B_TRUE 1 100 0.00 1.00000000000 BIT_MASK 0x2 FORMAT "%13.11" ECU_ADDRESS 0xFD84 /end MEASUREMENT
/begin MEASUREMENT B_tootaus "" UBYTE B_TRUE 1 100 0.00 1.00000000000 BIT_MASK 0x20 FORMAT "%13.11" ECU_ADDRESS 0xF0816 /end MEASUREMENT
/begin MEASUREMENT B_tootein "" UBYTE B_TRUE 1 100 0.00 1.00000000000 BIT_MASK 0x40 FORMAT "%13.11" ECU_ADDRESS 0xF0816 /end MEASUREMENT
/begin MEASUREMENT B_tootulb "" UBYTE B_TRUE 1 100 0.00 1.00000000000 BIT_MASK 0x80 FORMAT "%13.11" ECU_ADDRESS 0xF0816 /end MEASUREMENT
/begin MEASUREMENT B_tpnt_aw "" UWORD B_TRUE 1 100 0.00 1.00000000000 BIT_MASK 0x1 FORMAT "%13.11" ECU_ADDRESS 0xFD90 /end MEASUREMENT
/begin MEASUREMENT B_tpnt_e "" UWORD B_TRUE 1 100 0.00 1.00000000000 BIT_MASK 0x2 FORMAT "%13.11" ECU_ADDRESS 0xFD90 /end MEASUREMENT
/begin MEASUREMENT B_ubrdmn1 "" UWORD B_TRUE 1 100 0.00 1.00000000000 BIT_MASK 0x800 FORMAT "%13.11" ECU_ADDRESS 0xFD52 /end MEASUREMENT
/begin MEASUREMENT B_ubrdmn2 "" UWORD B_TRUE 1 100 0.00 1.00000000000 BIT_MASK 0x1000 FORMAT "%13.11" ECU_ADDRESS 0xFD52 /end MEASUREMENT
/begin MEASUREMENT B_ubrk "" UWORD B_TRUE 1 100 0.00 1.00000000000 BIT_MASK 0x2000 FORMAT "%13.11" ECU_ADDRESS 0xFD52 /end MEASUREMENT
/begin MEASUREMENT B_ubrmax "" UWORD B_TRUE 1 100 0.00 1.00000000000 BIT_MASK 0x4000 FORMAT "%13.11" ECU_ADDRESS 0xFD52 /end MEASUREMENT
/begin MEASUREMENT B_ubru "" UBYTE B_TRUE 1 100 0.00 1.00000000000 BIT_MASK 0x40 FORMAT "%13.11" ECU_ADDRESS 0xF07EE /end MEASUREMENT
/begin MEASUREMENT B_ubvdkp "" UWORD B_TRUE 1 100 0.00 1.00000000000 BIT_MASK 0x2000 FORMAT "%13.11" ECU_ADDRESS 0xFD58 /end MEASUREMENT
/begin MEASUREMENT B_udk1nv "" UWORD B_TRUE 1 100 0.00 1.00000000000 BIT_MASK 0x4000 FORMAT "%13.11" ECU_ADDRESS 0xFD58 /end MEASUREMENT
/begin MEASUREMENT B_upw12e "" UBYTE B_TRUE 1 100 0.00 1.00000000000 BIT_MASK 0x1 FORMAT "%13.11" ECU_ADDRESS 0xF0820 /end MEASUREMENT
/begin MEASUREMENT B_upw1mn "" UBYTE B_TRUE 1 100 0.00 1.00000000000 BIT_MASK 0x2 FORMAT "%13.11" ECU_ADDRESS 0xF0820 /end MEASUREMENT
/begin MEASUREMENT B_upw1mx "" UBYTE B_TRUE 1 100 0.00 1.00000000000 BIT_MASK 0x4 FORMAT "%13.11" ECU_ADDRESS 0xF0820 /end MEASUREMENT
/begin MEASUREMENT B_upw2mn "" UBYTE B_TRUE 1 100 0.00 1.00000000000 BIT_MASK 0x8 FORMAT "%13.11" ECU_ADDRESS 0xF0820 /end MEASUREMENT
/begin MEASUREMENT B_upw2mx "" UBYTE B_TRUE 1 100 0.00 1.00000000000 BIT_MASK 0x10 FORMAT "%13.11" ECU_ADDRESS 0xF0820 /end MEASUREMENT
/begin MEASUREMENT B_upwg1o "" UWORD B_TRUE 1 100 0.00 1.00000000000 BIT_MASK 0x200 FORMAT "%13.11" ECU_ADDRESS 0xFD56 /end MEASUREMENT
/begin MEASUREMENT B_upwg1u "" UWORD B_TRUE 1 100 0.00 1.00000000000 BIT_MASK 0x400 FORMAT "%13.11" ECU_ADDRESS 0xFD56 /end MEASUREMENT
/begin MEASUREMENT B_upwg2o "" UWORD B_TRUE 1 100 0.00 1.00000000000 BIT_MASK 0x800 FORMAT "%13.11" ECU_ADDRESS 0xFD56 /end MEASUREMENT
/begin MEASUREMENT B_upwg2u "" UWORD B_TRUE 1 100 0.00 1.00000000000 BIT_MASK 0x1000 FORMAT "%13.11" ECU_ADDRESS 0xFD56 /end MEASUREMENT
/begin MEASUREMENT B_usbeh "" UWORD B_TRUE 1 100 0.00 1.00000000000 BIT_MASK 0x4 FORMAT "%13.11" ECU_ADDRESS 0xFD50 /end MEASUREMENT
/begin MEASUREMENT B_usbeh2 "" UWORD B_TRUE 1 100 0.00 1.00000000000 BIT_MASK 0x8 FORMAT "%13.11" ECU_ADDRESS 0xFD50 /end MEASUREMENT
/begin MEASUREMENT B_vnull "" UWORD B_TRUE 1 100 0.00 1.00000000000 BIT_MASK 0x200 FORMAT "%13.11" ECU_ADDRESS 0xFD52 /end MEASUREMENT
/begin MEASUREMENT B_vpwgerr "" UWORD B_TRUE 1 100 0.00 1.00000000000 BIT_MASK 0x2000 FORMAT "%13.11" ECU_ADDRESS 0xFD56 /end MEASUREMENT
/begin MEASUREMENT B_wdk12ev "" UWORD B_TRUE 1 100 0.00 1.00000000000 BIT_MASK 0x8000 FORMAT "%13.11" ECU_ADDRESS 0xFD58 /end MEASUREMENT
/begin MEASUREMENT B_wdk13ev "" UWORD B_TRUE 1 100 0.00 1.00000000000 BIT_MASK 0x1 FORMAT "%13.11" ECU_ADDRESS 0xFD5A /end MEASUREMENT
/begin MEASUREMENT B_wdk1v "" UWORD B_TRUE 1 100 0.00 1.00000000000 BIT_MASK 0x2 FORMAT "%13.11" ECU_ADDRESS 0xFD5A /end MEASUREMENT
/begin MEASUREMENT B_wdk23ev "" UWORD B_TRUE 1 100 0.00 1.00000000000 BIT_MASK 0x4 FORMAT "%13.11" ECU_ADDRESS 0xFD5A /end MEASUREMENT
/begin MEASUREMENT B_wdk2sel "" UWORD B_TRUE 1 100 0.00 1.00000000000 BIT_MASK 0x8 FORMAT "%13.11" ECU_ADDRESS 0xFD5A /end MEASUREMENT
/begin MEASUREMENT B_wdk2st "" UWORD B_TRUE 1 100 0.00 1.00000000000 BIT_MASK 0x10 FORMAT "%13.11" ECU_ADDRESS 0xFD5A /end MEASUREMENT
/begin MEASUREMENT B_wnwi2out "" UBYTE B_TRUE 1 100 0.00 1.00000000000 BIT_MASK 0x20 FORMAT "%13.11" ECU_ADDRESS 0xF06F2 /end MEASUREMENT
/begin MEASUREMENT B_wnwiout "" UBYTE B_TRUE 1 100 0.00 1.00000000000 BIT_MASK 0x10 FORMAT "%13.11" ECU_ADDRESS 0xF06F2 /end MEASUREMENT
/begin MEASUREMENT B_wpabnb "" UWORD B_TRUE 1 100 0.00 1.00000000000 BIT_MASK 0x4000 FORMAT "%13.11" ECU_ADDRESS 0xFD56 /end MEASUREMENT
/begin MEASUREMENT B_wpmbbr "" UWORD B_TRUE 1 100 0.00 1.00000000000 BIT_MASK 0x8000 FORMAT "%13.11" ECU_ADDRESS 0xFD56 /end MEASUREMENT
/begin MEASUREMENT B_znptm "" UBYTE B_TRUE 1 100 0.00 1.00000000000 BIT_MASK 0x4 FORMAT "%13.11" ECU_ADDRESS 0xF0934 /end MEASUREMENT
/begin MEASUREMENT B_zprel "" UWORD B_TRUE 1 100 0.00 1.00000000000 BIT_MASK 0x40 FORMAT "%13.11" ECU_ADDRESS 0xFD46 /end MEASUREMENT
/begin MEASUREMENT B_zsitm "" UBYTE B_TRUE 1 100 0.00 1.00000000000 BIT_MASK 0x8 FORMAT "%13.11" ECU_ADDRESS 0xF0934 /end MEASUREMENT
/begin MEASUREMENT B_ztafix "" UBYTE B_TRUE 1 100 0.00 1.00000000000 BIT_MASK 0x40 FORMAT "%13.11" ECU_ADDRESS 0xF0921 /end MEASUREMENT
/begin MEASUREMENT B_zztab "" UWORD B_TRUE 1 100 0.00 1.00000000000 BIT_MASK 0x80 FORMAT "%13.11" ECU_ADDRESS 0xFD46 /end MEASUREMENT
/begin MEASUREMENT cpaw1 "" UBYTE dez 1 100 0.00 255.0 FORMAT "%5.1" ECU_ADDRESS 0xF0833 /end MEASUREMENT
/begin MEASUREMENT cpaw2 "" UBYTE dez 1 100 0.00 255.0 FORMAT "%5.1" ECU_ADDRESS 0xF0834 /end MEASUREMENT
/begin MEASUREMENT ctbetip "" UBYTE t20msxs_ub_b5p1 1 100 0.00 5.100 FORMAT "%5.3" ECU_ADDRESS 0xF080E /end MEASUREMENT
/begin MEASUREMENT ctdkp1 "" UBYTE t10msxs_ub_b2p55 1 100 0.00 2.550 FORMAT "%5.3" ECU_ADDRESS 0xF0835 /end MEASUREMENT
/begin MEASUREMENT ctdkp2 "" UBYTE t10msxs_ub_b2p55 1 100 0.00 2.550 FORMAT "%5.3" ECU_ADDRESS 0xF0836 /end MEASUREMENT
/begin MEASUREMENT ctdkpaw "" UBYTE t10msxs_ub_b2p55 1 100 0.00 2.550 FORMAT "%5.3" ECU_ADDRESS 0xF0837 /end MEASUREMENT
/begin MEASUREMENT ctepfgrh "" UBYTE t20msxs_ub_b5p1 1 100 0.00 5.100 FORMAT "%5.3" ECU_ADDRESS 0xF080F /end MEASUREMENT
/begin MEASUREMENT ctfgrhe "" UBYTE t20msxs_ub_b5p1 1 100 0.00 5.100 FORMAT "%5.3" ECU_ADDRESS 0xF0810 /end MEASUREMENT
/begin MEASUREMENT cthsnp "" UBYTE t20msxs_ub_b5p1 1 100 0.00 5.100 FORMAT "%5.3" ECU_ADDRESS 0xF0811 /end MEASUREMENT
/begin MEASUREMENT ctootaus "" UBYTE t20msxs_ub_b5p1 1 100 0.00 5.100 FORMAT "%5.3" ECU_ADDRESS 0xF0812 /end MEASUREMENT
/begin MEASUREMENT ctootein "" UBYTE t20msxs_ub_b5p1 1 100 0.00 5.100 FORMAT "%5.3" ECU_ADDRESS 0xF0813 /end MEASUREMENT
/begin MEASUREMENT ctootulb_w "" UWORD t20msxs_uw_b1310 1 100 0.00 1310.700 FORMAT "%8.3" ECU_ADDRESS 0xF1AC6 /end MEASUREMENT
/begin MEASUREMENT ctrerbr "" UBYTE dez 1 100 0.00 255.0 FORMAT "%5.1" ECU_ADDRESS 0x38205F /end MEASUREMENT
/begin MEASUREMENT ctr_MD5Block "" UWORD dez 1 100 0.00 65535.00 FORMAT "%8.2" ECU_ADDRESS 0xF2672 /end MEASUREMENT
/begin MEASUREMENT ctvetip "" UBYTE t20msxs_ub_b5p1 1 100 0.00 5.100 FORMAT "%5.3" ECU_ADDRESS 0xF0814 /end MEASUREMENT
/begin MEASUREMENT ctwdk12 "" UBYTE t10msxs_ub_b2p55 1 100 0.00 2.550 FORMAT "%5.3" ECU_ADDRESS 0xF0838 /end MEASUREMENT
/begin MEASUREMENT ctwdk13 "" UBYTE t10msxs_ub_b2p55 1 100 0.00 2.550 FORMAT "%5.3" ECU_ADDRESS 0xF0839 /end MEASUREMENT
/begin MEASUREMENT ctwdk23 "" UBYTE t10msxs_ub_b2p55 1 100 0.00 2.550 FORMAT "%5.3" ECU_ADDRESS 0xF083A /end MEASUREMENT
/begin MEASUREMENT dfmlow_w "" UWORD tinjection_sy 1 100 0.00 209.7120 FORMAT "%8.4" ECU_ADDRESS 0xF12C0 /end MEASUREMENT
/begin MEASUREMENT dfmperio_w "" UWORD tinjection_sy 1 100 0.00 209.7120 FORMAT "%8.4" ECU_ADDRESS 0xF12C2 /end MEASUREMENT
/begin MEASUREMENT diacjx "" UBYTE dez 1 100 0.00 255.0 FORMAT "%5.1" ECU_ADDRESS 0xF0937 /end MEASUREMENT
/begin MEASUREMENT diacjx2 "" UBYTE dez 1 100 0.00 255.0 FORMAT "%5.1" ECU_ADDRESS 0xF0938 /end MEASUREMENT
/begin MEASUREMENT dist_w "" UWORD dist_uw_q0p1 1 100 0.00 6553.500 FORMAT "%8.3" ECU_ADDRESS 0xF1A72 /end MEASUREMENT
/begin MEASUREMENT dmnpbkv_w "" SWORD pgrad_q0p15625 1 100 -5120.000 5119.844 FORMAT "%8.3" ECU_ADDRESS 0xF4FC6 /end MEASUREMENT
/begin MEASUREMENT dmrdsls_w "" UWORD rel_uw_b100 1 100 0.00 99.99847 FORMAT "%8.5" ECU_ADDRESS 0xF46FC /end MEASUREMENT
/begin MEASUREMENT dmrkh "" UBYTE rel_ub_b99p6 1 100 0.00 99.61 FORMAT "%5.2" ECU_ADDRESS 0xF411F /end MEASUREMENT
/begin MEASUREMENT dmrkhz_w "" UWORD rel_uw_b100 1 100 0.00 99.99847 FORMAT "%8.5" ECU_ADDRESS 0xF46FE /end MEASUREMENT
/begin MEASUREMENT dmrkh_w "" UWORD rel_uw_b100 1 100 0.00 99.99847 FORMAT "%8.5" ECU_ADDRESS 0xF4700 /end MEASUREMENT
/begin MEASUREMENT dmxpbkv_w "" UWORD pgrad_q0p15625 1 100 0.00 10239.84 FORMAT "%8.2" ECU_ADDRESS 0xF4FC8 /end MEASUREMENT
/begin MEASUREMENT dpbkvep_w "" SWORD pgrad_q0p039 1 100 -1280.000 1279.961 FORMAT "%8.3" ECU_ADDRESS 0xF4FCA /end MEASUREMENT
/begin MEASUREMENT dpbkvmx_w "" UWORD fak_uw_b8 1 100 0.00 7.999878 FORMAT "%8.6" ECU_ADDRESS 0xF4FCC /end MEASUREMENT
/begin MEASUREMENT dpbkvps_w "" SWORD pgrad_q0p039 1 100 -1280.000 1279.961 FORMAT "%8.3" ECU_ADDRESS 0xF4FCE /end MEASUREMENT
/begin MEASUREMENT dpbkvsp_w "" SWORD pgrad_q0p039 1 100 -1280.000 1279.961 FORMAT "%8.3" ECU_ADDRESS 0xF4FD0 /end MEASUREMENT
/begin MEASUREMENT dpbkvu_w "" UWORD p_uw_q0p039 1 100 0.00 2559.961 FORMAT "%8.3" ECU_ADDRESS 0xF4FD2 /end MEASUREMENT
/begin MEASUREMENT dpgNvBits "" UBYTE dez 1 100 0.00 255.0 FORMAT "%5.1" ECU_ADDRESS 0x382040 /end MEASUREMENT
/begin MEASUREMENT dpspvdkd_w "" UWORD p_uw_q0p039 1 100 0.00 2559.961 FORMAT "%8.3" ECU_ADDRESS 0xF4FD4 /end MEASUREMENT
/begin MEASUREMENT dpvdkspu_w "" UWORD p_uw_q0p039 1 100 0.00 2559.961 FORMAT "%8.3" ECU_ADDRESS 0xF45EA /end MEASUREMENT
/begin MEASUREMENT drinlsu2_w "" SWORD r_q0p0391 1 100 -1280.000 1279.961 FORMAT "%8.3" ECU_ADDRESS 0xF27B8 /end MEASUREMENT
/begin MEASUREMENT drinlsu_w "" SWORD r_q0p0391 1 100 -1280.000 1279.961 FORMAT "%8.3" ECU_ADDRESS 0xF27BA /end MEASUREMENT
/begin MEASUREMENT drkwtmp_w "" UWORD rel_uw_b100 1 100 0.00 99.99847 FORMAT "%8.5" ECU_ADDRESS 0xF4702 /end MEASUREMENT
/begin MEASUREMENT dua10g2_w "" SWORD spg_q4p88Em4 1 100 -16.00000 15.99951 FORMAT "%8.5" ECU_ADDRESS 0xF26B0 /end MEASUREMENT
/begin MEASUREMENT dua10g_w "" SWORD spg_q4p88Em4 1 100 -16.00000 15.99951 FORMAT "%8.5" ECU_ADDRESS 0xF26B2 /end MEASUREMENT
/begin MEASUREMENT dwdkba_w "" SWORD relDK_q0p02441 1 100 -800.0000 799.9756 FORMAT "%8.4" ECU_ADDRESS 0xF1AEE /end MEASUREMENT
/begin MEASUREMENT dwped "" SBYTE rel_q0p39 1 100 -50.00 49.61 FORMAT "%5.2" ECU_ADDRESS 0xF081F /end MEASUREMENT
/begin MEASUREMENT dwped_w "" SWORD rel_sw_b50 1 100 -50.00000 49.99847 FORMAT "%8.5" ECU_ADDRESS 0xF1AC8 /end MEASUREMENT
/begin MEASUREMENT edge_ctr "" SBYTE dez 1 100 -128.0 127.0 FORMAT "%5.1" ECU_ADDRESS 0xE088 /end MEASUREMENT
/begin MEASUREMENT esst_stm05epmsb "" UWORD dez 1 100 0.00 65535.00 FORMAT "%8.2" ECU_ADDRESS 0xF440E /end MEASUREMENT
/begin MEASUREMENT fgrscod "" UBYTE dez 1 100 0.00 255.0 FORMAT "%5.1" ECU_ADDRESS 0xF0815 /end MEASUREMENT
/begin MEASUREMENT fho "" UBYTE fak_ub_b4 1 100 0.00 3.984 FORMAT "%5.3" ECU_ADDRESS 0xF40C5 /end MEASUREMENT
/begin MEASUREMENT fho_w "" UWORD fak_uw_b4 1 100 0.00 3.999939 FORMAT "%8.6" ECU_ADDRESS 0xF45EC /end MEASUREMENT
/begin MEASUREMENT fkhfm "" UBYTE fak_ub_b2 1 100 0.00 1.992 FORMAT "%5.3" ECU_ADDRESS 0xF08B5 /end MEASUREMENT
/begin MEASUREMENT fmfkrakt "" UBYTE fmfkr_dez 1 100 0.00 255.0 FORMAT "%5.1" ECU_ADDRESS 0xF0A59 /end MEASUREMENT
/begin MEASUREMENT fmfkraktol "" UBYTE fmfkr_dez 1 100 0.00 255.0 FORMAT "%5.1" ECU_ADDRESS 0xF0A5A /end MEASUREMENT
/begin MEASUREMENT fmfw "" UBYTE dez 1 100 0.00 255.0 FORMAT "%5.1" ECU_ADDRESS 0xF0A5B /end MEASUREMENT
/begin MEASUREMENT fmkhfho_w "" UWORD fak_uw_b2 1 100 0.00 1.999969 FORMAT "%8.6" ECU_ADDRESS 0xF4704 /end MEASUREMENT
/begin MEASUREMENT fmkhtmst "" UBYTE fak_ub_b2 1 100 0.00 1.992 FORMAT "%5.3" ECU_ADDRESS 0xF4120 /end MEASUREMENT
/begin MEASUREMENT fpuk "" UBYTE fak_ub_b2 1 100 0.00 1.992 FORMAT "%5.3" ECU_ADDRESS 0xF08B6 /end MEASUREMENT
/begin MEASUREMENT fpvdkds "" UBYTE fak_ub_b4 1 100 0.00 3.984 FORMAT "%5.3" ECU_ADDRESS 0xF08BE /end MEASUREMENT
/begin MEASUREMENT fpvdkdsl_w "" UWORD fak_uw_b4 1 100 0.00 3.999939 FORMAT "%8.6" ECU_ADDRESS 0xF1CFA /end MEASUREMENT
/begin MEASUREMENT fpvdkdsu_w "" UWORD fak_uw_b4 1 100 0.00 3.999939 FORMAT "%8.6" ECU_ADDRESS 0xF45EE /end MEASUREMENT
/begin MEASUREMENT fpvdkds_w "" UWORD fak_uw_b4 1 100 0.00 3.999939 FORMAT "%8.6" ECU_ADDRESS 0xF1CFC /end MEASUREMENT
/begin MEASUREMENT frhol_w "" UWORD fak_uw_b2 1 100 0.00 1.999969 FORMAT "%8.6" ECU_ADDRESS 0xF45F0 /end MEASUREMENT
/begin MEASUREMENT fstt "" UBYTE vol_q1_l 1 100 0.00 255.0 FORMAT "%5.1" ECU_ADDRESS 0xF0808 /end MEASUREMENT
/begin MEASUREMENT fvst_w "" UWORD fak_uw_b64 1 100 0.00 63.99902 FORMAT "%8.5" ECU_ADDRESS 0xF1E3E /end MEASUREMENT
/begin MEASUREMENT gaptooth "" UBYTE dez 1 100 0.00 255.0 FORMAT "%5.1" ECU_ADDRESS 0xE089 /end MEASUREMENT
/begin MEASUREMENT ggdpgBitsKgs "" UBYTE dez 1 100 0.00 255.0 FORMAT "%5.1" ECU_ADDRESS 0xF0708 /end MEASUREMENT
/begin MEASUREMENT GgdsasNvBits "" UBYTE dez 1 100 0.00 255.0 FORMAT "%5.1" ECU_ADDRESS 0x382060 /end MEASUREMENT
/begin MEASUREMENT GGFGRHlokbits0 "" UBYTE dez 1 100 0.00 255.0 FORMAT "%5.1" ECU_ADDRESS 0xF0816 /end MEASUREMENT
/begin MEASUREMENT GGFGRHlokbits1 "" UBYTE dez 1 100 0.00 255.0 FORMAT "%5.1" ECU_ADDRESS 0xF0817 /end MEASUREMENT
/begin MEASUREMENT GGFGRHlokbits2 "" UBYTE dez 1 100 0.00 255.0 FORMAT "%5.1" ECU_ADDRESS 0xF0818 /end MEASUREMENT
/begin MEASUREMENT GGFSTbits "" UBYTE dez 1 100 0.00 255.0 FORMAT "%5.1" ECU_ADDRESS 0x38205A /end MEASUREMENT
/begin MEASUREMENT ggrtlsuAusBits10ms "" UBYTE dez 1 100 0.00 255.0 FORMAT "%5.1" ECU_ADDRESS 0xE28C /end MEASUREMENT
/begin MEASUREMENT ggrtlsuAusBitsKoop "" UBYTE dez 1 100 0.00 255.0 FORMAT "%5.1" ECU_ADDRESS 0xF0B6E /end MEASUREMENT
/begin MEASUREMENT ggrtlsuLokBits10ms "" UBYTE dez 1 100 0.00 255.0 FORMAT "%5.1" ECU_ADDRESS 0xE28D /end MEASUREMENT
/begin MEASUREMENT ggrtlsuLokBitsKoop "" UBYTE dez 1 100 0.00 255.0 FORMAT "%5.1" ECU_ADDRESS 0xF0B6F /end MEASUREMENT
/begin MEASUREMENT GGUBRausbits "" UBYTE dez 1 100 0.00 255.0 FORMAT "%5.1" ECU_ADDRESS 0xF07EE /end MEASUREMENT
/begin MEASUREMENT hrlsuAusBits "" UBYTE dez 1 100 0.00 255.0 FORMAT "%5.1" ECU_ADDRESS 0xF0B5F /end MEASUREMENT
/begin MEASUREMENT hrlsuAusBits_2 "" UBYTE dez 1 100 0.00 255.0 FORMAT "%5.1" ECU_ADDRESS 0xF0B60 /end MEASUREMENT
/begin MEASUREMENT hrlsuLokBits "" UBYTE dez 1 100 0.00 255.0 FORMAT "%5.1" ECU_ADDRESS 0xE1E8 /end MEASUREMENT
/begin MEASUREMENT hrlsuLokBits_2 "" UBYTE dez 1 100 0.00 255.0 FORMAT "%5.1" ECU_ADDRESS 0xE1E9 /end MEASUREMENT
/begin MEASUREMENT igod_w "" SWORD tknockintgrad_sy 1 100 -3051.520 3051.427 FORMAT "%8.3" ECU_ADDRESS 0xF22C4 /end MEASUREMENT
/begin MEASUREMENT igokr_w "" SWORD tknockintgrad_sy 1 100 -3051.520 3051.427 FORMAT "%8.3" ECU_ADDRESS 0xF22C6 /end MEASUREMENT
/begin MEASUREMENT iintpid2_w "" UWORD rel_uw_b200 1 100 0.00 99.99695 FORMAT "%8.5" ECU_ADDRESS 0xF4E6A /end MEASUREMENT
/begin MEASUREMENT iintpid_w "" UWORD rel_uw_b200 1 100 0.00 99.99695 FORMAT "%8.5" ECU_ADDRESS 0xF4E6C /end MEASUREMENT
/begin MEASUREMENT ikr "" UBYTE spg_ub_b5 1 100 0.00 4.980 FORMAT "%5.3" ARRAY_SIZE 8 ECU_ADDRESS 0xE29C /end MEASUREMENT
/begin MEASUREMENT ikrma "" UBYTE spg_ub_b5 1 100 0.00 4.980 FORMAT "%5.3" ECU_ADDRESS 0xF0A5C /end MEASUREMENT
/begin MEASUREMENT ikrme "" UBYTE spg_ub_b5 1 100 0.00 4.980 FORMAT "%5.3" ARRAY_SIZE 8 ECU_ADDRESS 0xE2A4 /end MEASUREMENT
/begin MEASUREMENT ikrmen "" UBYTE spg_ub_b5 1 100 0.00 4.980 FORMAT "%5.3" ECU_ADDRESS 0xF0A5D /end MEASUREMENT
/begin MEASUREMENT ikrmet "" UBYTE spg_ub_b5 1 100 0.00 4.980 FORMAT "%5.3" ECU_ADDRESS 0xF0A5E /end MEASUREMENT
/begin MEASUREMENT ikr_tst "" UBYTE spg_ub_b5 1 100 0.00 4.980 FORMAT "%5.3" ECU_ADDRESS 0xF0A5F /end MEASUREMENT
/begin MEASUREMENT ini2cjx "" UBYTE dez 1 100 0.00 255.0 FORMAT "%5.1" ECU_ADDRESS 0xF0939 /end MEASUREMENT
/begin MEASUREMENT ini2cjx2 "" UBYTE dez 1 100 0.00 255.0 FORMAT "%5.1" ECU_ADDRESS 0xF093A /end MEASUREMENT
/begin MEASUREMENT inicjx "" UBYTE dez 1 100 0.00 255.0 FORMAT "%5.1" ECU_ADDRESS 0xF093B /end MEASUREMENT
/begin MEASUREMENT inicjx2 "" UBYTE dez 1 100 0.00 255.0 FORMAT "%5.1" ECU_ADDRESS 0xF093C /end MEASUREMENT
/begin MEASUREMENT iokkr "" UBYTE spg_ub_b5 1 100 0.00 4.980 FORMAT "%5.3" ECU_ADDRESS 0xF0A60 /end MEASUREMENT
/begin MEASUREMENT ipiprk2_w "" SWORD i_q1_uA 1 100 -32768.00 32767.00 FORMAT "%8.2" ECU_ADDRESS 0xF26BA /end MEASUREMENT
/begin MEASUREMENT ipiprk_w "" SWORD i_q1_uA 1 100 -32768.00 32767.00 FORMAT "%8.2" ECU_ADDRESS 0xF26BC /end MEASUREMENT
/begin MEASUREMENT ipkorp2_w "" SWORD i_q1_uA 1 100 -32768.00 32767.00 FORMAT "%8.2" ECU_ADDRESS 0xF26BE /end MEASUREMENT
/begin MEASUREMENT ipkorp_w "" SWORD i_q1_uA 1 100 -32768.00 32767.00 FORMAT "%8.2" ECU_ADDRESS 0xF26C0 /end MEASUREMENT
/begin MEASUREMENT ipktk2_w "" SWORD i_q1_uA 1 100 -32768.00 32767.00 FORMAT "%8.2" ECU_ADDRESS 0xF26C2 /end MEASUREMENT
/begin MEASUREMENT ipktk_w "" SWORD i_q1_uA 1 100 -32768.00 32767.00 FORMAT "%8.2" ECU_ADDRESS 0xF26C4 /end MEASUREMENT
/begin MEASUREMENT iplsuvj2_w "" UWORD dez 1 100 0.00 65535.00 FORMAT "%8.2" ECU_ADDRESS 0xF4E90 /end MEASUREMENT
/begin MEASUREMENT iplsuvj_w "" UWORD dez 1 100 0.00 65535.00 FORMAT "%8.2" ECU_ADDRESS 0xF4E92 /end MEASUREMENT
/begin MEASUREMENT iproh2_w "" SWORD i_q1_uA 1 100 -32768.00 32767.00 FORMAT "%8.2" ECU_ADDRESS 0xF26C6 /end MEASUREMENT
/begin MEASUREMENT iproh_w "" SWORD i_q1_uA 1 100 -32768.00 32767.00 FORMAT "%8.2" ECU_ADDRESS 0xF26C8 /end MEASUREMENT
/begin MEASUREMENT iUipoti1_w "" UWORD DEZ 1 100 0.00 65535.00 FORMAT "%8.2" ECU_ADDRESS 0xE454 /end MEASUREMENT
/begin MEASUREMENT iUipoti2_w "" UWORD DEZ 1 100 0.00 65535.00 FORMAT "%8.2" ECU_ADDRESS 0xE450 /end MEASUREMENT
/begin MEASUREMENT iUspoti1_w "" UWORD DEZ 1 100 0.00 65535.00 FORMAT "%8.2" ECU_ADDRESS 0xE446 /end MEASUREMENT
/begin MEASUREMENT iUspoti2_w "" UWORD DEZ 1 100 0.00 65535.00 FORMAT "%8.2" ECU_ADDRESS 0xE444 /end MEASUREMENT
/begin MEASUREMENT kldfpwm "" UBYTE rel_ub_b99p6 1 100 0.00 99.61 FORMAT "%5.2" ECU_ADDRESS 0xE00C /end MEASUREMENT
/begin MEASUREMENT kldfpwmf "" UBYTE rel_ub_b99p6 1 100 0.00 99.61 FORMAT "%5.2" ECU_ADDRESS 0xF05C6 /end MEASUREMENT
/begin MEASUREMENT korrfak "" UBYTE fak_ub_b2 1 100 0.00 1.992 FORMAT "%5.3" ECU_ADDRESS 0xF410A /end MEASUREMENT
/begin MEASUREMENT krivk2_w "" SWORD r_q0p0391 1 100 -1280.000 1279.961 FORMAT "%8.3" ECU_ADDRESS 0x382F4A /end MEASUREMENT
/begin MEASUREMENT krivk_w "" SWORD r_q0p0391 1 100 -1280.000 1279.961 FORMAT "%8.3" ECU_ADDRESS 0x382F4C /end MEASUREMENT
/begin MEASUREMENT ks_sym "" UBYTE dez 1 100 0.00 255.0 FORMAT "%5.1" ARRAY_SIZE 4 ECU_ADDRESS 0xE2AC /end MEASUREMENT
/begin MEASUREMENT ktkvk2_w "" UWORD fak_uw_b2 1 100 0.00 1.999969 FORMAT "%8.6" ECU_ADDRESS 0xF27C0 /end MEASUREMENT
/begin MEASUREMENT ktkvk_w "" UWORD fak_uw_b2 1 100 0.00 1.999969 FORMAT "%8.6" ECU_ADDRESS 0xF27C2 /end MEASUREMENT
/begin MEASUREMENT kusvk2_w "" SWORD spg_q4p88Em4 1 100 -16.00000 15.99951 FORMAT "%8.5" ECU_ADDRESS 0x382F42 /end MEASUREMENT
/begin MEASUREMENT kusvkft2_w "" SWORD spg_q4p88Em4 1 100 -16.00000 15.99951 FORMAT "%8.5" ECU_ADDRESS 0x382F44 /end MEASUREMENT
/begin MEASUREMENT kusvkft_w "" SWORD spg_q4p88Em4 1 100 -16.00000 15.99951 FORMAT "%8.5" ECU_ADDRESS 0x382F46 /end MEASUREMENT
/begin MEASUREMENT kusvk_w "" SWORD spg_q4p88Em4 1 100 -16.00000 15.99951 FORMAT "%8.5" ECU_ADDRESS 0x382F48 /end MEASUREMENT
/begin MEASUREMENT kwp71_bits "" UBYTE dez 1 100 0.00 255.0 FORMAT "%5.1" ECU_ADDRESS 0xF0AC9 /end MEASUREMENT
/begin MEASUREMENT ldfki_w "" UWORD zk10msxs_uw_b655 1 100 0.010000152590 655.36000000 FORMAT "%12.8" ECU_ADDRESS 0xF1CFE /end MEASUREMENT
/begin MEASUREMENT len_hiseg "" UBYTE dez 1 100 0.00 255.0 FORMAT "%5.1" ECU_ADDRESS 0xE08A /end MEASUREMENT
/begin MEASUREMENT len_loseg "" UBYTE dez 1 100 0.00 255.0 FORMAT "%5.1" ECU_ADDRESS 0xE08B /end MEASUREMENT
/begin MEASUREMENT lsukorp2_w "" UWORD fak_uw_b2 1 100 0.00 1.999969 FORMAT "%8.6" ECU_ADDRESS 0xF4E94 /end MEASUREMENT
/begin MEASUREMENT lsukorp_w "" UWORD fak_uw_b2 1 100 0.00 1.999969 FORMAT "%8.6" ECU_ADDRESS 0xF4E96 /end MEASUREMENT
/begin MEASUREMENT mifakh_w "" UWORD rel_uw_b100 1 100 0.00 99.99847 FORMAT "%8.5" ECU_ADDRESS 0xF4706 /end MEASUREMENT
/begin MEASUREMENT mifamx_w "" UWORD rel_uw_b100 1 100 0.00 99.99847 FORMAT "%8.5" ECU_ADDRESS 0xF458E /end MEASUREMENT
/begin MEASUREMENT mkfamx_w "" UWORD rel_uw_b100 1 100 0.00 99.99847 FORMAT "%8.5" ECU_ADDRESS 0xF4590 /end MEASUREMENT
/begin MEASUREMENT mlhfma_w "" UWORD m_uw_b6553p5 1 100 0.00 6553.500 FORMAT "%8.3" ECU_ADDRESS 0xE160 /end MEASUREMENT
/begin MEASUREMENT mlhfmm_w "" UWORD m_uw_b6553p5 1 100 0.00 6553.500 FORMAT "%8.3" ECU_ADDRESS 0xE162 /end MEASUREMENT
/begin MEASUREMENT mll1 "" UBYTE m_ub_b1020 1 100 0.00 1020. FORMAT "%5.0" ECU_ADDRESS 0xF410B /end MEASUREMENT
/begin MEASUREMENT mshfm1_w "" SWORD m_sw_b3276p8 1 100 -3276.800 3276.700 FORMAT "%8.3" ECU_ADDRESS 0xE164 /end MEASUREMENT
/begin MEASUREMENT mshfms_w "" SWORD m_sw_b3276p8 1 100 -3276.800 3276.700 FORMAT "%8.3" ECU_ADDRESS 0xE166 /end MEASUREMENT
/begin MEASUREMENT mshfm_w "" UWORD m_uw_b6553p5 1 100 0.00 6553.500 FORMAT "%8.3" ECU_ADDRESS 0xE168 /end MEASUREMENT
/begin MEASUREMENT mulres_w "" UWORD fak_uw_b4 1 100 0.00 3.999939 FORMAT "%8.6" ECU_ADDRESS 0xF4708 /end MEASUREMENT
/begin MEASUREMENT nmotkor "" UBYTE nmot_ub_q40 1 100 0.00 10200. FORMAT "%5.0" ECU_ADDRESS 0xF08B7 /end MEASUREMENT
/begin MEASUREMENT nspwgnot "" UBYTE nmot_ub_q40 1 100 0.00 10200. FORMAT "%5.0" ECU_ADDRESS 0xF40AA /end MEASUREMENT
/begin MEASUREMENT nsynggdpg "" UBYTE dez 1 100 0.00 255.0 FORMAT "%5.1" ECU_ADDRESS 0xF0709 /end MEASUREMENT
/begin MEASUREMENT o2vk2_w "" SWORD relO2_q9p765Em4 1 100 -32.00000 31.99902 FORMAT "%8.5" ECU_ADDRESS 0xF26CA /end MEASUREMENT
/begin MEASUREMENT o2vk_w "" SWORD relO2_q9p765Em4 1 100 -32.00000 31.99902 FORMAT "%8.5" ECU_ADDRESS 0xF26CC /end MEASUREMENT
/begin MEASUREMENT palsu2_w "" UWORD p_uw_q0p039 1 100 0.00 2559.961 FORMAT "%8.3" ECU_ADDRESS 0xF4E98 /end MEASUREMENT
/begin MEASUREMENT palsu_w "" UWORD p_uw_q0p039 1 100 0.00 2559.961 FORMAT "%8.3" ECU_ADDRESS 0xF4E9A /end MEASUREMENT
/begin MEASUREMENT pbkvmod_w "" UWORD p_uw_q0p039 1 100 0.00 2559.961 FORMAT "%8.3" ECU_ADDRESS 0xF4FD6 /end MEASUREMENT
/begin MEASUREMENT pbkvmpu_w "" UWORD fak_uw_b2 1 100 0.00 1.999969 FORMAT "%8.6" ECU_ADDRESS 0xF4FD8 /end MEASUREMENT
/begin MEASUREMENT pbkvpmn_w "" UWORD p_uw_q0p039 1 100 0.00 2559.961 FORMAT "%8.3" ECU_ADDRESS 0xF4FDA /end MEASUREMENT
/begin MEASUREMENT perioval_w "" UWORD tinjection_sy 1 100 0.00 209.7120 FORMAT "%8.4" ECU_ADDRESS 0xF12C8 /end MEASUREMENT
/begin MEASUREMENT phlsnh "" UBYTE fak_ub_q0p01 1 100 0.00 2.550 FORMAT "%5.3" ECU_ADDRESS 0xF409D /end MEASUREMENT
/begin MEASUREMENT phlsnh2 "" UBYTE fak_ub_q0p01 1 100 0.00 2.550 FORMAT "%5.3" ECU_ADDRESS 0xF409E /end MEASUREMENT
/begin MEASUREMENT phlsuri2_w "" UWORD rel_uw_b200 1 100 0.00 199.9969 FORMAT "%8.4" ECU_ADDRESS 0xF4E6E /end MEASUREMENT
/begin MEASUREMENT phlsuri_w "" UWORD rel_uw_b200 1 100 0.00 199.9969 FORMAT "%8.4" ECU_ADDRESS 0xF4E70 /end MEASUREMENT
/begin MEASUREMENT plauf "" UBYTE dez 1 100 0.00 255.0 FORMAT "%5.1" ECU_ADDRESS 0xF0B63 /end MEASUREMENT
/begin MEASUREMENT plauf2 "" UBYTE dez 1 100 0.00 255.0 FORMAT "%5.1" ECU_ADDRESS 0xF0B64 /end MEASUREMENT
/begin MEASUREMENT plooplsu "" SBYTE dez 1 100 -128.0 127.0 FORMAT "%5.1" ECU_ADDRESS 0xF0B65 /end MEASUREMENT
/begin MEASUREMENT plooplsu2 "" SBYTE dez 1 100 -128.0 127.0 FORMAT "%5.1" ECU_ADDRESS 0xF0B66 /end MEASUREMENT
/begin MEASUREMENT prhlsub2_w "" UWORD rel_uw_b200 1 100 0.00 199.9969 FORMAT "%8.4" ECU_ADDRESS 0xF4E72 /end MEASUREMENT
/begin MEASUREMENT prhlsub_w "" UWORD rel_uw_b200 1 100 0.00 199.9969 FORMAT "%8.4" ECU_ADDRESS 0xF4E74 /end MEASUREMENT
/begin MEASUREMENT prhlsud2_w "" SWORD rel_sw_b100 1 100 -100.0000 99.99695 FORMAT "%8.4" ECU_ADDRESS 0xF4E76 /end MEASUREMENT
/begin MEASUREMENT prhlsud_w "" SWORD rel_sw_b100 1 100 -100.0000 99.99695 FORMAT "%8.4" ECU_ADDRESS 0xF4E78 /end MEASUREMENT
/begin MEASUREMENT prhlsui2_w "" SWORD rel_sw_b100 1 100 -100.0000 99.99695 FORMAT "%8.4" ECU_ADDRESS 0xF4E7A /end MEASUREMENT
/begin MEASUREMENT prhlsuin_w "" SWORD rel_q0p0061 1 100 0.00 100.0000 FORMAT "%8.4" ECU_ADDRESS 0xF4E7C /end MEASUREMENT
/begin MEASUREMENT prhlsui_w "" SWORD rel_sw_b100 1 100 -100.0000 99.99695 FORMAT "%8.4" ECU_ADDRESS 0xF4E7E /end MEASUREMENT
/begin MEASUREMENT prhlsup2_w "" SWORD rel_sw_b100 1 100 -100.0000 99.99695 FORMAT "%8.4" ECU_ADDRESS 0xF4E80 /end MEASUREMENT
/begin MEASUREMENT prhlsup_w "" SWORD rel_sw_b100 1 100 -100.0000 99.99695 FORMAT "%8.4" ECU_ADDRESS 0xF4E82 /end MEASUREMENT
/begin MEASUREMENT prhlsur2_w "" UWORD rel_uw_b200 1 100 0.00 199.9969 FORMAT "%8.4" ECU_ADDRESS 0xF4E84 /end MEASUREMENT
/begin MEASUREMENT prhlsur_w "" UWORD rel_uw_b200 1 100 0.00 199.9969 FORMAT "%8.4" ECU_ADDRESS 0xF4E86 /end MEASUREMENT
/begin MEASUREMENT prhrlsu2_w "" UWORD rel_uw_b200 1 100 0.00 199.9969 FORMAT "%8.4" ECU_ADDRESS 0xF4E88 /end MEASUREMENT
/begin MEASUREMENT prhrlsu_w "" UWORD rel_uw_b200 1 100 0.00 199.9969 FORMAT "%8.4" ECU_ADDRESS 0xF4E8A /end MEASUREMENT
/begin MEASUREMENT pringlsu "" UBYTE dez 1 100 0.00 255.0 FORMAT "%5.1" ECU_ADDRESS 0xE1EA /end MEASUREMENT
/begin MEASUREMENT pringlsu2 "" UBYTE dez 1 100 0.00 255.0 FORMAT "%5.1" ECU_ADDRESS 0xE1EB /end MEASUREMENT
/begin MEASUREMENT prlsust "" UBYTE dez 1 100 0.00 255.0 FORMAT "%5.1" ECU_ADDRESS 0xF0B67 /end MEASUREMENT
/begin MEASUREMENT prlsust2 "" UBYTE dez 1 100 0.00 255.0 FORMAT "%5.1" ECU_ADDRESS 0xF0B68 /end MEASUREMENT
/begin MEASUREMENT psspbkv_w "" UWORD p_uw_q0p039 1 100 0.00 2559.961 FORMAT "%8.3" ECU_ADDRESS 0xF4FDC /end MEASUREMENT
/begin MEASUREMENT psspvdkd_w "" UWORD fak_uw_b4 1 100 0.00 3.999939 FORMAT "%8.6" ECU_ADDRESS 0xF1D00 /end MEASUREMENT
/begin MEASUREMENT pu "" UBYTE p_ub_q5 1 100 0.00 1275. FORMAT "%5.0" ECU_ADDRESS 0xF40C6 /end MEASUREMENT
/begin MEASUREMENT puans "" UBYTE fak_ub_b2 1 100 0.00 1.992 FORMAT "%5.3" ECU_ADDRESS 0xF40BF /end MEASUREMENT
/begin MEASUREMENT pubkv_w "" UWORD p_uw_q0p039 1 100 0.00 2559.961 FORMAT "%8.3" ECU_ADDRESS 0xF4FDE /end MEASUREMENT
/begin MEASUREMENT pus_w "" UWORD p_uw_q0p039 1 100 0.00 2559.961 FORMAT "%8.3" ECU_ADDRESS 0xF45F2 /end MEASUREMENT
/begin MEASUREMENT pu_w "" UWORD p_uw_q0p039 1 100 0.00 2559.961 FORMAT "%8.3" ECU_ADDRESS 0xF45F4 /end MEASUREMENT
/begin MEASUREMENT pvdkds "" UBYTE p_ub_q10 1 100 0.00 2550. FORMAT "%5.0" ECU_ADDRESS 0xF08BF /end MEASUREMENT
/begin MEASUREMENT pvdkdsl_w "" UWORD p_uw_q0p039 1 100 0.00 2559.961 FORMAT "%8.3" ECU_ADDRESS 0xF1D02 /end MEASUREMENT
/begin MEASUREMENT pvdkdsu_w "" UWORD p_uw_q0p039 1 100 0.00 2559.961 FORMAT "%8.3" ECU_ADDRESS 0xF45F6 /end MEASUREMENT
/begin MEASUREMENT pvdkds_w "" UWORD p_uw_q0p039 1 100 0.00 2559.961 FORMAT "%8.3" ECU_ADDRESS 0xF1D04 /end MEASUREMENT
/begin MEASUREMENT pvdkmx_w "" UWORD p_uw_q0p039 1 100 0.00 2559.961 FORMAT "%8.3" ECU_ADDRESS 0xF1D06 /end MEASUREMENT
/begin MEASUREMENT pvdksf_w "" UWORD p_uw_q0p039 1 100 0.00 2559.961 FORMAT "%8.3" ECU_ADDRESS 0xF1D08 /end MEASUREMENT
/begin MEASUREMENT pvdkspud "" UBYTE p_ub_q10 1 100 0.00 2550. FORMAT "%5.0" ECU_ADDRESS 0xF40C7 /end MEASUREMENT
/begin MEASUREMENT pvdks_w "" UWORD p_uw_q0p039 1 100 0.00 2559.961 FORMAT "%8.3" ECU_ADDRESS 0xF1D0A /end MEASUREMENT
/begin MEASUREMENT pwgdectr "" UBYTE dez 1 100 0.00 255.0 FORMAT "%5.1" ECU_ADDRESS 0x38205C /end MEASUREMENT
/begin MEASUREMENT pwmstate "" UBYTE dez 1 100 0.00 255.0 FORMAT "%5.1" ECU_ADDRESS 0xF05C5 /end MEASUREMENT
/begin MEASUREMENT P_ats "" UWORD B_TRUE 1 100 0.00 1.00000000000 BIT_MASK 0x80 FORMAT "%13.11" ECU_ADDRESS 0xFD84 /end MEASUREMENT
/begin MEASUREMENT P_ats2 "" UWORD B_TRUE 1 100 0.00 1.00000000000 BIT_MASK 0x100 FORMAT "%13.11" ECU_ADDRESS 0xFD84 /end MEASUREMENT
/begin MEASUREMENT P_crsh "" UWORD B_TRUE 1 100 0.00 1.00000000000 BIT_MASK 0x200 FORMAT "%13.11" ECU_ADDRESS 0xFD84 /end MEASUREMENT
/begin MEASUREMENT P_KLDF "" UWORD B_TRUE 1 100 0.00 1.00000000000 BIT_MASK 0x400 FORMAT "%13.11" ECU_ADDRESS 0xFD84 /end MEASUREMENT
/begin MEASUREMENT P_swe "" UWORD B_TRUE 1 100 0.00 1.00000000000 BIT_MASK 0x800 FORMAT "%13.11" ECU_ADDRESS 0xFD84 /end MEASUREMENT
/begin MEASUREMENT qzzyl "" UBYTE dez 1 100 0.00 255.0 FORMAT "%5.1" ECU_ADDRESS 0xF070A /end MEASUREMENT
/begin MEASUREMENT rdtklsu2_w "" SWORD temp_q0p0234 1 100 -768.0000 767.9766 FORMAT "%8.4" ECU_ADDRESS 0xF4E8C /end MEASUREMENT
/begin MEASUREMENT rdtklsu_w "" SWORD temp_q0p0234 1 100 -768.0000 767.9766 FORMAT "%8.4" ECU_ADDRESS 0xF4E8E /end MEASUREMENT
/begin MEASUREMENT rinh2_w "" UWORD r_uw_q2 1 100 0.00 131070.0 FORMAT "%8.1" ECU_ADDRESS 0xF1832 /end MEASUREMENT
/begin MEASUREMENT rinh_w "" UWORD r_uw_q2 1 100 0.00 131070.0 FORMAT "%8.1" ECU_ADDRESS 0xF1834 /end MEASUREMENT
/begin MEASUREMENT rinlsu2_w "" UWORD r_q0p0391 1 100 0.00 2559.961 FORMAT "%8.3" ECU_ADDRESS 0xF4E9C /end MEASUREMENT
/begin MEASUREMENT rinlsuk2_w "" UWORD r_q0p0391 1 100 0.00 2559.961 FORMAT "%8.3" ECU_ADDRESS 0xF27C4 /end MEASUREMENT
/begin MEASUREMENT rinlsuk_w "" UWORD r_q0p0391 1 100 0.00 2559.961 FORMAT "%8.3" ECU_ADDRESS 0xF27C6 /end MEASUREMENT
/begin MEASUREMENT rinlsu_w "" UWORD r_q0p0391 1 100 0.00 2559.961 FORMAT "%8.3" ECU_ADDRESS 0xF4E9E /end MEASUREMENT
/begin MEASUREMENT rinofh2_w "" UWORD r_uw_q2 1 100 0.00 131070.0 FORMAT "%8.1" ECU_ADDRESS 0xF444C /end MEASUREMENT
/begin MEASUREMENT rinofha2_w "" UWORD r_uw_q2 1 100 0.00 131070.0 FORMAT "%8.1" ECU_ADDRESS 0xF444E /end MEASUREMENT
/begin MEASUREMENT rinofha_w "" UWORD r_uw_q2 1 100 0.00 131070.0 FORMAT "%8.1" ECU_ADDRESS 0xF4450 /end MEASUREMENT
/begin MEASUREMENT rinofh_w "" UWORD r_uw_q2 1 100 0.00 131070.0 FORMAT "%8.1" ECU_ADDRESS 0xF4452 /end MEASUREMENT
/begin MEASUREMENT rk2_w "" UWORD rel_uw_b3072 1 100 0.00 3071.953 FORMAT "%8.3" ECU_ADDRESS 0xF1E40 /end MEASUREMENT
/begin MEASUREMENT rkg2_w "" UWORD rel_uw_b3072 1 100 0.00 3071.953 FORMAT "%8.3" ECU_ADDRESS 0xF1E42 /end MEASUREMENT
/begin MEASUREMENT rkg_w "" UWORD rel_uw_b3072 1 100 0.00 3071.953 FORMAT "%8.3" ECU_ADDRESS 0xF1E44 /end MEASUREMENT
/begin MEASUREMENT rk_w "" UWORD rel_uw_b3072 1 100 0.00 3071.953 FORMAT "%8.3" ECU_ADDRESS 0xF1E46 /end MEASUREMENT
/begin MEASUREMENT rllaso2_w "" UWORD rel_uw_q0p0234 1 100 0.00 1535.977 FORMAT "%8.3" ECU_ADDRESS 0xF1E48 /end MEASUREMENT
/begin MEASUREMENT rllaso_w "" UWORD rel_uw_q0p0234 1 100 0.00 1535.977 FORMAT "%8.3" ECU_ADDRESS 0xF1E4A /end MEASUREMENT
/begin MEASUREMENT rlvppl "" UBYTE rel_ub_q0p75 1 100 0.00 191.3 FORMAT "%5.1" ECU_ADDRESS 0xF083B /end MEASUREMENT
/begin MEASUREMENT rrinlsu2_w "" UWORD r_q0p0391 1 100 0.00 2559.961 FORMAT "%8.3" ECU_ADDRESS 0xF27C8 /end MEASUREMENT
/begin MEASUREMENT rrinlsu_w "" UWORD r_q0p0391 1 100 0.00 2559.961 FORMAT "%8.3" ECU_ADDRESS 0xF27CA /end MEASUREMENT
/begin MEASUREMENT sen_c95 "" UBYTE dezsub1 1 100 1.000 256.0 FORMAT "%5.1" ARRAY_SIZE 8 ECU_ADDRESS 0xF0A61 /end MEASUREMENT
/begin MEASUREMENT statcjx "" UBYTE dez 1 100 0.00 255.0 FORMAT "%5.1" ECU_ADDRESS 0xF093D /end MEASUREMENT
/begin MEASUREMENT statcjx2 "" UBYTE dez 1 100 0.00 255.0 FORMAT "%5.1" ECU_ADDRESS 0xF093E /end MEASUREMENT
/begin MEASUREMENT stateQsyn "" UBYTE dez 1 100 0.00 255.0 FORMAT "%5.1" ECU_ADDRESS 0xE08C /end MEASUREMENT
/begin MEASUREMENT sumulsu2_l "" ULONG spg_q0p00488 1 100 0.00 81920.0000000 FORMAT "%13.7" ECU_ADDRESS 0xF26A8 /end MEASUREMENT
/begin MEASUREMENT sumulsu_l "" ULONG spg_q0p00488 1 100 0.00 81920.0000000 FORMAT "%13.7" ECU_ADDRESS 0xF26AC /end MEASUREMENT
/begin MEASUREMENT S_ac "" UWORD B_TRUE 1 100 0.00 1.00000000000 BIT_MASK 0x1000 FORMAT "%13.11" ECU_ADDRESS 0xFD84 /end MEASUREMENT
/begin MEASUREMENT S_bls "" UWORD B_TRUE 1 100 0.00 1.00000000000 BIT_MASK 0x2000 FORMAT "%13.11" ECU_ADDRESS 0xFD84 /end MEASUREMENT
/begin MEASUREMENT S_brs "" UWORD B_TRUE 1 100 0.00 1.00000000000 BIT_MASK 0x4000 FORMAT "%13.11" ECU_ADDRESS 0xFD84 /end MEASUREMENT
/begin MEASUREMENT S_fgrat "" UWORD B_TRUE 1 100 0.00 1.00000000000 BIT_MASK 0x8000 FORMAT "%13.11" ECU_ADDRESS 0xFD84 /end MEASUREMENT
/begin MEASUREMENT S_fgrhs "" UWORD B_TRUE 1 100 0.00 1.00000000000 BIT_MASK 0x1 FORMAT "%13.11" ECU_ADDRESS 0xFD86 /end MEASUREMENT
/begin MEASUREMENT S_fgrsv "" UWORD B_TRUE 1 100 0.00 1.00000000000 BIT_MASK 0x2 FORMAT "%13.11" ECU_ADDRESS 0xFD86 /end MEASUREMENT
/begin MEASUREMENT S_fgrwb "" UWORD B_TRUE 1 100 0.00 1.00000000000 BIT_MASK 0x4 FORMAT "%13.11" ECU_ADDRESS 0xFD86 /end MEASUREMENT
/begin MEASUREMENT S_kl15 "" UWORD B_TRUE 1 100 0.00 1.00000000000 BIT_MASK 0x10 FORMAT "%13.11" ECU_ADDRESS 0xFD84 /end MEASUREMENT
/begin MEASUREMENT S_ko "" UWORD B_TRUE 1 100 0.00 1.00000000000 BIT_MASK 0x8 FORMAT "%13.11" ECU_ADDRESS 0xFD86 /end MEASUREMENT
/begin MEASUREMENT S_kupp "" UWORD B_TRUE 1 100 0.00 1.00000000000 BIT_MASK 0x10 FORMAT "%13.11" ECU_ADDRESS 0xFD86 /end MEASUREMENT
/begin MEASUREMENT S_tal "" UWORD B_TRUE 1 100 0.00 1.00000000000 BIT_MASK 0x20 FORMAT "%13.11" ECU_ADDRESS 0xFD86 /end MEASUREMENT
/begin MEASUREMENT tamax "" UBYTE temp_ub_q0p75_o48 1 100 -48.00 143.3 FORMAT "%5.1" ECU_ADDRESS 0xF4105 /end MEASUREMENT
/begin MEASUREMENT tamin "" UBYTE temp_ub_q0p75_o48 1 100 -48.00 143.3 FORMAT "%5.1" ECU_ADDRESS 0xF4106 /end MEASUREMENT
/begin MEASUREMENT tans "" UBYTE temp_ub_q0p75_o48 1 100 -48.00 143.3 FORMAT "%5.1" ECU_ADDRESS 0xF0923 /end MEASUREMENT
/begin MEASUREMENT tansab "" UBYTE temp_ub_q0p75_o48 1 100 -48.00 143.3 FORMAT "%5.1" ECU_ADDRESS 0x382068 /end MEASUREMENT
/begin MEASUREMENT tansabk_w "" UWORD temp_q0p0234_o273 1 100 -273.1500 1262.827 FORMAT "%8.3" ECU_ADDRESS 0x382F22 /end MEASUREMENT
/begin MEASUREMENT tansk_w "" UWORD temp_q0p0234_o273 1 100 -273.1500 1262.827 FORMAT "%8.3" ECU_ADDRESS 0xF46E2 /end MEASUREMENT
/begin MEASUREMENT tanslin "" UBYTE temp_ub_q0p75_o48 1 100 -48.00 143.3 FORMAT "%5.1" ECU_ADDRESS 0xF4107 /end MEASUREMENT
/begin MEASUREMENT TB_eieo18 "" UBYTE B_TRUE 1 100 0.00 1.00000000000 BIT_MASK 0x20 FORMAT "%13.11" ECU_ADDRESS 0xF0817 /end MEASUREMENT
/begin MEASUREMENT TB_eieo19a "" UBYTE B_TRUE 1 100 0.00 1.00000000000 BIT_MASK 0x40 FORMAT "%13.11" ECU_ADDRESS 0xF0817 /end MEASUREMENT
/begin MEASUREMENT TB_eieo19b "" UBYTE B_TRUE 1 100 0.00 1.00000000000 BIT_MASK 0x80 FORMAT "%13.11" ECU_ADDRESS 0xF0817 /end MEASUREMENT
/begin MEASUREMENT TB_eieo19c "" UBYTE B_TRUE 1 100 0.00 1.00000000000 BIT_MASK 0x1 FORMAT "%13.11" ECU_ADDRESS 0xF0818 /end MEASUREMENT
/begin MEASUREMENT thhaist "" UBYTE t10msxs_ub_b2p55 1 100 0.00 2.550 FORMAT "%5.3" ECU_ADDRESS 0xF409F /end MEASUREMENT
/begin MEASUREMENT thhaist2 "" UBYTE t10msxs_ub_b2p55 1 100 0.00 2.550 FORMAT "%5.3" ECU_ADDRESS 0xF40A0 /end MEASUREMENT
/begin MEASUREMENT thhat "" UBYTE t10msxs_q0p01_o0p05 1 100 -0.05000 2.500 FORMAT "%5.3" ECU_ADDRESS 0xF40A1 /end MEASUREMENT
/begin MEASUREMENT thhat2 "" UBYTE t10msxs_q0p01_o0p05 1 100 -0.05000 2.500 FORMAT "%5.3" ECU_ADDRESS 0xF40A2 /end MEASUREMENT
/begin MEASUREMENT timtalr_w "" UWORD t200msxs_uw_q0p2 1 100 0.00 13107.00 FORMAT "%8.2" ECU_ADDRESS 0xF458A /end MEASUREMENT
/begin MEASUREMENT timtals_w "" UWORD t200msxs_uw_q0p2 1 100 0.00 13107.00 FORMAT "%8.2" ECU_ADDRESS 0xF458C /end MEASUREMENT
/begin MEASUREMENT tka "" UBYTE temp_ub_q0p75_o48 1 100 -48.00 143.3 FORMAT "%5.1" ECU_ADDRESS 0xF0C99 /end MEASUREMENT
/begin MEASUREMENT tkalin "" UBYTE temp_ub_q0p75_o48 1 100 -48.00 143.3 FORMAT "%5.1" ECU_ADDRESS 0xF0C9A /end MEASUREMENT
/begin MEASUREMENT tkerlsu2_w "" UWORD temp_q0p0234_o273 1 100 -273.1500 1262.827 FORMAT "%8.3" ECU_ADDRESS 0xF4EA0 /end MEASUREMENT
/begin MEASUREMENT tkerlsu_w "" UWORD temp_q0p0234_o273 1 100 -273.1500 1262.827 FORMAT "%8.3" ECU_ADDRESS 0xF4EA2 /end MEASUREMENT
/begin MEASUREMENT tkldflock "" UBYTE t20msxs_ub_b5p1 1 100 0.00 5.100 FORMAT "%5.3" ECU_ADDRESS 0xF05C7 /end MEASUREMENT
/begin MEASUREMENT tmCorCtr_w "" UWORD dez 1 100 0.00 65535.00 FORMAT "%8.2" ECU_ADDRESS 0xF1768 /end MEASUREMENT
/begin MEASUREMENT tmew "" UBYTE temp_ub_q0p75_o48 1 100 -48.00 143.3 FORMAT "%5.1" ECU_ADDRESS 0xF410C /end MEASUREMENT
/begin MEASUREMENT tmewab "" UBYTE temp_ub_q0p75_o48 1 100 -48.00 143.3 FORMAT "%5.1" ECU_ADDRESS 0x382069 /end MEASUREMENT
/begin MEASUREMENT tmfa_w "" UWORD tknockcon_sy 1 100 0.00 0.2097120 FORMAT "%9.7" ECU_ADDRESS 0xF22C8 /end MEASUREMENT
/begin MEASUREMENT tmfln_w "" UWORD tknockcon_sy 1 100 0.00 0.2097120 FORMAT "%9.7" ECU_ADDRESS 0xF22CA /end MEASUREMENT
/begin MEASUREMENT tmfl_w "" UWORD tknockcon_sy 1 100 0.00 0.2097120 FORMAT "%9.7" ECU_ADDRESS 0xF22CC /end MEASUREMENT
/begin MEASUREMENT tmki "" UBYTE temp_ub_q0p75_o48 1 100 -48.00 143.3 FORMAT "%5.1" ECU_ADDRESS 0xF4118 /end MEASUREMENT
/begin MEASUREMENT tmlinmax "" UBYTE temp_ub_q0p75_o48 1 100 -48.00 143.3 FORMAT "%5.1" ECU_ADDRESS 0xF410D /end MEASUREMENT
/begin MEASUREMENT tmlinmin "" UBYTE temp_ub_q0p75_o48 1 100 -48.00 143.3 FORMAT "%5.1" ECU_ADDRESS 0xF410E /end MEASUREMENT
/begin MEASUREMENT tmlinvdzg "" UBYTE temp_ub_q0p75_o48 1 100 -48.00 143.3 FORMAT "%5.1" ECU_ADDRESS 0xF410F /end MEASUREMENT
/begin MEASUREMENT tmot "" UBYTE temp_ub_q0p75_o48 1 100 -48.00 143.3 FORMAT "%5.1" ECU_ADDRESS 0xF0936 /end MEASUREMENT
/begin MEASUREMENT tmotab "" UBYTE temp_ub_q0p75_o48 1 100 -48.00 143.3 FORMAT "%5.1" ECU_ADDRESS 0x38206A /end MEASUREMENT
/begin MEASUREMENT tmotlin "" UBYTE temp_ub_q0p75_o48 1 100 -48.00 143.3 FORMAT "%5.1" ECU_ADDRESS 0xF4110 /end MEASUREMENT
/begin MEASUREMENT tmotlinab "" UBYTE temp_ub_q0p75_o48 1 100 -48.00 143.3 FORMAT "%5.1" ECU_ADDRESS 0x38401E /end MEASUREMENT
/begin MEASUREMENT tmotlinlp "" UBYTE temp_ub_q0p75_o48 1 100 -48.00 143.3 FORMAT "%5.1" ECU_ADDRESS 0xF4111 /end MEASUREMENT
/begin MEASUREMENT tmotlinst "" UBYTE temp_ub_q0p75_o48 1 100 -48.00 143.3 FORMAT "%5.1" ECU_ADDRESS 0xF4112 /end MEASUREMENT
/begin MEASUREMENT tmotlin_w "" UWORD temp_uw_q0p0029_o48 1 100 -48.00000 143.9971 FORMAT "%8.4" ECU_ADDRESS 0xF46E4 /end MEASUREMENT
/begin MEASUREMENT tmotvt "" UBYTE temp_ub_q0p75_o48 1 100 -48.00 143.3 FORMAT "%5.1" ECU_ADDRESS 0xF4113 /end MEASUREMENT
/begin MEASUREMENT tmrw "" UBYTE temp_ub_q0p75_o48 1 100 -48.00 143.3 FORMAT "%5.1" ECU_ADDRESS 0xF4114 /end MEASUREMENT
/begin MEASUREMENT tmrwend "" UBYTE temp_ub_q0p75_o48 1 100 -48.00 143.3 FORMAT "%5.1" ECU_ADDRESS 0xF4115 /end MEASUREMENT
/begin MEASUREMENT tmsnp "" UBYTE temp_ub_q0p75_o48 1 100 -48.00 143.3 FORMAT "%5.1" ECU_ADDRESS 0x38401F /end MEASUREMENT
/begin MEASUREMENT tmst "" UBYTE temp_ub_q0p75_o48 1 100 -48.00 143.3 FORMAT "%5.1" ECU_ADDRESS 0xF4116 /end MEASUREMENT
/begin MEASUREMENT tnbm1_w "" UWORD dez 1 100 0.00 65535.00 FORMAT "%8.2" ECU_ADDRESS 0xF176A /end MEASUREMENT
/begin MEASUREMENT tnbm2_w "" UWORD dez 1 100 0.00 65535.00 FORMAT "%8.2" ECU_ADDRESS 0xF176C /end MEASUREMENT
/begin MEASUREMENT tnbm_w "" UWORD dez 1 100 0.00 65535.00 FORMAT "%8.2" ECU_ADDRESS 0xF176E /end MEASUREMENT
/begin MEASUREMENT tnwia_w "" UWORD t_q16us 1 100 0.00 1048560. FORMAT "%8.0" ECU_ADDRESS 0xF172C /end MEASUREMENT
/begin MEASUREMENT tnwie_w "" UWORD t_q16us 1 100 0.00 1048560. FORMAT "%8.0" ECU_ADDRESS 0xF172E /end MEASUREMENT
/begin MEASUREMENT tpCorCtr_w "" UWORD dez 1 100 0.00 65535.00 FORMAT "%8.2" ECU_ADDRESS 0xF1770 /end MEASUREMENT
/begin MEASUREMENT tpnt_aktiv "" UBYTE dez 1 100 0.00 255.0 FORMAT "%5.1" ECU_ADDRESS 0xF0A69 /end MEASUREMENT
/begin MEASUREMENT ttooth10ms "" UBYTE dez 1 100 0.00 255.0 FORMAT "%5.1" ECU_ADDRESS 0xF070B /end MEASUREMENT
/begin MEASUREMENT tumginp "" UBYTE temp_ub_q0p75_o48 1 100 -48.00 143.3 FORMAT "%5.1" ECU_ADDRESS 0xF4117 /end MEASUREMENT
/begin MEASUREMENT t_idle_ctr "" UBYTE dez 1 100 0.00 255.0 FORMAT "%5.1" ECU_ADDRESS 0xF4140 /end MEASUREMENT
/begin MEASUREMENT ua10mo2_w "" UWORD spg_q4p88Em4 1 100 0.00 31.99951 FORMAT "%8.5" ECU_ADDRESS 0xF26CE /end MEASUREMENT
/begin MEASUREMENT ua10mo_w "" UWORD spg_q4p88Em4 1 100 0.00 31.99951 FORMAT "%8.5" ECU_ADDRESS 0xF26D0 /end MEASUREMENT
/begin MEASUREMENT ua10ms2_w "" UWORD spg_q4p88Em4 1 100 0.00 31.99951 FORMAT "%8.5" ECU_ADDRESS 0xF26D2 /end MEASUREMENT
/begin MEASUREMENT ua10ms_w "" UWORD spg_q4p88Em4 1 100 0.00 31.99951 FORMAT "%8.5" ECU_ADDRESS 0xF26D4 /end MEASUREMENT
/begin MEASUREMENT UADKI "" UWORD dez 1 100 0.00 65535.00 FORMAT "%8.2" ECU_ADDRESS 0xE1A2 /end MEASUREMENT
/begin MEASUREMENT UADMFA "" UWORD dez 1 100 0.00 65535.00 FORMAT "%8.2" ECU_ADDRESS 0xE1A4 /end MEASUREMENT
/begin MEASUREMENT uagrvh_w "" UWORD spg_uw_q0p00488 1 100 0.00 319.9951 FORMAT "%8.4" ECU_ADDRESS 0xF0CB4 /end MEASUREMENT
/begin MEASUREMENT ub "" UBYTE spg_ubatt_sy 1 100 0.00 17.93 FORMAT "%5.2" ECU_ADDRESS 0xF07FF /end MEASUREMENT
/begin MEASUREMENT ubrsq "" UBYTE spg_q0p1 1 100 0.00 25.50 FORMAT "%5.2" ECU_ADDRESS 0xF07EF /end MEASUREMENT
/begin MEASUREMENT ubrsqf "" UBYTE spg_q0p1 1 100 0.00 25.50 FORMAT "%5.2" ECU_ADDRESS 0xF07F0 /end MEASUREMENT
/begin MEASUREMENT ubrsqf_w "" UWORD spg_q0p00039 1 100 0.00 25.59961 FORMAT "%8.5" ECU_ADDRESS 0xF1A9A /end MEASUREMENT
/begin MEASUREMENT ubrsqka "" UBYTE spg_q0p1 1 100 0.00 25.50 FORMAT "%5.2" ECU_ADDRESS 0xF07F1 /end MEASUREMENT
/begin MEASUREMENT ubrsqke "" UBYTE spg_q0p1 1 100 0.00 25.50 FORMAT "%5.2" ECU_ADDRESS 0xF07F2 /end MEASUREMENT
/begin MEASUREMENT ubrsq_w "" UWORD spg_q0p00039 1 100 0.00 25.59961 FORMAT "%8.5" ECU_ADDRESS 0xF1A9C /end MEASUREMENT
/begin MEASUREMENT ubsq "" UBYTE spg_q0p1 1 100 0.00 25.50 FORMAT "%5.2" ECU_ADDRESS 0xF0800 /end MEASUREMENT
/begin MEASUREMENT ubsqf "" UBYTE spg_q0p1 1 100 0.00 25.50 FORMAT "%5.2" ECU_ADDRESS 0xF0801 /end MEASUREMENT
/begin MEASUREMENT ubsqf_w "" UWORD spg_q0p00039 1 100 0.00 25.59961 FORMAT "%8.5" ECU_ADDRESS 0xF1AA2 /end MEASUREMENT
/begin MEASUREMENT ubsq_w "" UWORD spg_q0p00039 1 100 0.00 25.59961 FORMAT "%8.5" ECU_ADDRESS 0xF1AA4 /end MEASUREMENT
/begin MEASUREMENT udbuk_w "" UWORD spg_uw_q0p00488 1 100 0.00 319.9951 FORMAT "%8.4" ECU_ADDRESS 0xF0CB6 /end MEASUREMENT
/begin MEASUREMENT udkp1v_w "" UWORD spg_uw_q0p00488 1 100 0.00 319.9951 FORMAT "%8.4" ECU_ADDRESS 0xF0CB8 /end MEASUREMENT
/begin MEASUREMENT udkp1_w "" UWORD spg_uw_q0p001222 1 100 0.00 79.99878 FORMAT "%8.5" ECU_ADDRESS 0xF0CBA /end MEASUREMENT
/begin MEASUREMENT udkp2_w "" UWORD spg_uw_q0p001222 1 100 0.00 79.99878 FORMAT "%8.5" ECU_ADDRESS 0xF0CBC /end MEASUREMENT
/begin MEASUREMENT udsu_w "" UWORD spg_uw_q0p00488 1 100 0.00 319.9951 FORMAT "%8.4" ECU_ADDRESS 0xF0CBE /end MEASUREMENT
/begin MEASUREMENT uhfm2_w "" UWORD spg_uw_q0p00488 1 100 0.00 319.9951 FORMAT "%8.4" ECU_ADDRESS 0xF0CC0 /end MEASUREMENT
/begin MEASUREMENT uhfm_w "" UWORD spg_uw_q0p00488 1 100 0.00 319.9951 FORMAT "%8.4" ECU_ADDRESS 0xF0CC2 /end MEASUREMENT
/begin MEASUREMENT ulbkist_w "" UWORD spg_uw_q0p00488 1 100 0.00 319.9951 FORMAT "%8.4" ECU_ADDRESS 0xF0CC4 /end MEASUREMENT
/begin MEASUREMENT ulsurbu2_w "" UWORD spg_uw_b5 1 100 0.00 319.9951 FORMAT "%8.4" ARRAY_SIZE 80 ECU_ADDRESS 0xF26D6 /end MEASUREMENT
/begin MEASUREMENT ulsurbu_w "" UWORD spg_uw_b5 1 100 0.00 319.9951 FORMAT "%8.4" ARRAY_SIZE 80 ECU_ADDRESS 0xE1EC /end MEASUREMENT
/begin MEASUREMENT upwg1h_w "" UWORD spg_q0p00488 1 100 0.00 319.9951 FORMAT "%8.4" ECU_ADDRESS 0xF1ACA /end MEASUREMENT
/begin MEASUREMENT upwg1_w "" UWORD spg_uw_q0p00488 1 100 0.00 319.9951 FORMAT "%8.4" ECU_ADDRESS 0xF0CC6 /end MEASUREMENT
/begin MEASUREMENT upwg2d_w "" UWORD spg_q0p00488 1 100 0.00 319.9951 FORMAT "%8.4" ECU_ADDRESS 0xF1ACC /end MEASUREMENT
/begin MEASUREMENT upwg2_w "" UWORD spg_uw_q0p00488 1 100 0.00 319.9951 FORMAT "%8.4" ECU_ADDRESS 0xF0CC8 /end MEASUREMENT
/begin MEASUREMENT upwgej_w "" UWORD spg_q0p00488 1 100 0.00 319.9951 FORMAT "%8.4" ECU_ADDRESS 0xF1ACE /end MEASUREMENT
/begin MEASUREMENT upwgmin "" UBYTE spg_ub_b5 1 100 0.00 4.980 FORMAT "%5.3" ECU_ADDRESS 0xF0821 /end MEASUREMENT
/begin MEASUREMENT upwg_w "" UWORD spg_q0p00488 1 100 0.00 319.9951 FORMAT "%8.4" ECU_ADDRESS 0xF1AD0 /end MEASUREMENT
/begin MEASUREMENT urinlsu2_w "" UWORD spg_q0p00488 1 100 0.00 319.9951 FORMAT "%8.4" ECU_ADDRESS 0xF0CCA /end MEASUREMENT
/begin MEASUREMENT urinlsu_w "" UWORD spg_q0p00488 1 100 0.00 319.9951 FORMAT "%8.4" ECU_ADDRESS 0xF0CCC /end MEASUREMENT
/begin MEASUREMENT usbeh2_w "" UWORD spg_uw_q0p00488_o1 1 100 -1.000000 318.9951 FORMAT "%8.4" ECU_ADDRESS 0xF4454 /end MEASUREMENT
/begin MEASUREMENT usbeh_w "" UWORD spg_uw_q0p00488_o1 1 100 -1.000000 318.9951 FORMAT "%8.4" ECU_ADDRESS 0xF4456 /end MEASUREMENT
/begin MEASUREMENT ushk "" UBYTE spg_ub_q0p0052_o0p2 1 100 -0.2000 1.130 FORMAT "%5.3" ECU_ADDRESS 0xF0748 /end MEASUREMENT
/begin MEASUREMENT ushk2 "" UBYTE spg_ub_q0p0052_o0p2 1 100 -0.2000 1.130 FORMAT "%5.3" ECU_ADDRESS 0xF0749 /end MEASUREMENT
/begin MEASUREMENT ushk2_w "" UWORD spg_uw_q0p00488_o1 1 100 -1.000000 318.9951 FORMAT "%8.4" ECU_ADDRESS 0xF1836 /end MEASUREMENT
/begin MEASUREMENT ushkr2_w "" UWORD spg_uw_q0p00488_o1 1 100 -1.000000 318.9951 FORMAT "%8.4" ECU_ADDRESS 0xF1838 /end MEASUREMENT
/begin MEASUREMENT ushkr_w "" UWORD spg_uw_q0p00488_o1 1 100 -1.000000 318.9951 FORMAT "%8.4" ECU_ADDRESS 0xF183A /end MEASUREMENT
/begin MEASUREMENT ushk_w "" UWORD spg_uw_q0p00488_o1 1 100 -1.000000 318.9951 FORMAT "%8.4" ECU_ADDRESS 0xF183C /end MEASUREMENT
/begin MEASUREMENT ushmb2_w "" UWORD spg_uw_q0p00488_o1 1 100 -1.000000 318.9951 FORMAT "%8.4" ECU_ADDRESS 0xF183E /end MEASUREMENT
/begin MEASUREMENT ushmb_w "" UWORD spg_uw_q0p00488_o1 1 100 -1.000000 318.9951 FORMAT "%8.4" ECU_ADDRESS 0xF1840 /end MEASUREMENT
/begin MEASUREMENT ushob2_w "" UWORD spg_uw_q0p00488_o1 1 100 -1.000000 318.9951 FORMAT "%8.4" ECU_ADDRESS 0xF1842 /end MEASUREMENT
/begin MEASUREMENT ushob_w "" UWORD spg_uw_q0p00488_o1 1 100 -1.000000 318.9951 FORMAT "%8.4" ECU_ADDRESS 0xF1844 /end MEASUREMENT
/begin MEASUREMENT usobh2_w "" UWORD spg_uw_q0p00488_o1 1 100 -1.000000 318.9951 FORMAT "%8.4" ECU_ADDRESS 0xF4458 /end MEASUREMENT
/begin MEASUREMENT usobh_w "" UWORD spg_uw_q0p00488_o1 1 100 -1.000000 318.9951 FORMAT "%8.4" ECU_ADDRESS 0xF445A /end MEASUREMENT
/begin MEASUREMENT usvkvj2_w "" UWORD spg_q1p22Em4 1 100 0.00 7.999878 FORMAT "%8.6" ECU_ADDRESS 0xF2776 /end MEASUREMENT
/begin MEASUREMENT usvkvj_w "" UWORD spg_q1p22Em4 1 100 0.00 7.999878 FORMAT "%8.6" ECU_ADDRESS 0xF2778 /end MEASUREMENT
/begin MEASUREMENT uulsuv2_w "" UWORD spg_uw_b5 1 100 0.00 319.9951 FORMAT "%8.4" ECU_ADDRESS 0xF0CCE /end MEASUREMENT
/begin MEASUREMENT uulsuv_w "" UWORD spg_uw_b5 1 100 0.00 319.9951 FORMAT "%8.4" ECU_ADDRESS 0xF0CD0 /end MEASUREMENT
/begin MEASUREMENT uushk2_w "" UWORD spg_uw_q0p00488 1 100 0.00 319.9951 FORMAT "%8.4" ECU_ADDRESS 0xF0CD2 /end MEASUREMENT
/begin MEASUREMENT uushk_w "" UWORD spg_uw_q0p00488 1 100 0.00 319.9951 FORMAT "%8.4" ECU_ADDRESS 0xF0CD4 /end MEASUREMENT
/begin MEASUREMENT uushmb2_w "" UWORD spg_uw_q0p00488 1 100 0.00 319.9951 FORMAT "%8.4" ECU_ADDRESS 0xE0D6 /end MEASUREMENT
/begin MEASUREMENT uushmb_w "" UWORD spg_uw_q0p00488 1 100 0.00 319.9951 FORMAT "%8.4" ECU_ADDRESS 0xE0D8 /end MEASUREMENT
/begin MEASUREMENT uushob2_w "" UWORD spg_uw_q0p00488 1 100 0.00 319.9951 FORMAT "%8.4" ECU_ADDRESS 0xE0DA /end MEASUREMENT
/begin MEASUREMENT uushob_w "" UWORD spg_uw_q0p00488 1 100 0.00 319.9951 FORMAT "%8.4" ECU_ADDRESS 0xE0DC /end MEASUREMENT
/begin MEASUREMENT uzkw_w "" UWORD dez 1 100 0.00 65535.00 FORMAT "%8.2" ECU_ADDRESS 0xF1772 /end MEASUREMENT
/begin MEASUREMENT u_immo "" UBYTE spg_ub_b5 1 100 0.00 4.980 FORMAT "%5.3" ECU_ADDRESS 0xF0504 /end MEASUREMENT
/begin MEASUREMENT vfgr_w "" UWORD vfzg_uw_b512 1 100 0.00 511.9922 FORMAT "%8.4" ECU_ADDRESS 0xF1A74 /end MEASUREMENT
/begin MEASUREMENT vfil_w "" UWORD vfzg_uw_b512 1 100 0.00 511.9922 FORMAT "%8.4" ECU_ADDRESS 0xF1A76 /end MEASUREMENT
/begin MEASUREMENT vfzg "" UBYTE vfzg_ub_q1p25 1 100 0.00 318.8 FORMAT "%5.1" ECU_ADDRESS 0xF40A8 /end MEASUREMENT
/begin MEASUREMENT vfzg_w "" UWORD vfzg_uw_b512 1 100 0.00 511.9922 FORMAT "%8.4" ECU_ADDRESS 0xF1A78 /end MEASUREMENT
/begin MEASUREMENT vfzroh_w "" UWORD vfzg_uw_b512 1 100 0.00 511.9922 FORMAT "%8.4" ECU_ADDRESS 0xF1A7A /end MEASUREMENT
/begin MEASUREMENT vpvdkpu_w "" UWORD fak_q0p000122 1 100 0.00 7.999878 FORMAT "%8.6" ECU_ADDRESS 0xF45F8 /end MEASUREMENT
/begin MEASUREMENT vroh_w "" UWORD vfzg_uw_b512 1 100 0.00 511.9922 FORMAT "%8.4" ECU_ADDRESS 0xF1A7C /end MEASUREMENT
/begin MEASUREMENT wdk1 "" UBYTE relDK_ub_b100 1 100 0.00 100.0 FORMAT "%5.1" ECU_ADDRESS 0xF083C /end MEASUREMENT
/begin MEASUREMENT wdk1g "" UBYTE relDK_ub_b100 1 100 0.00 100.0 FORMAT "%5.1" ECU_ADDRESS 0xF083D /end MEASUREMENT
/begin MEASUREMENT wdk1_w "" SWORD relDK_q0p02441 1 100 -800.0000 799.9756 FORMAT "%8.4" ECU_ADDRESS 0xF1AF0 /end MEASUREMENT
/begin MEASUREMENT wdk2 "" UBYTE relDK_ub_b100 1 100 0.00 100.0 FORMAT "%5.1" ECU_ADDRESS 0xF083E /end MEASUREMENT
/begin MEASUREMENT wdk2g "" UBYTE relDK_ub_b100 1 100 0.00 100.0 FORMAT "%5.1" ECU_ADDRESS 0xF083F /end MEASUREMENT
/begin MEASUREMENT wdk2_w "" SWORD relDK_q0p02441 1 100 -800.0000 799.9756 FORMAT "%8.4" ECU_ADDRESS 0xF1AF2 /end MEASUREMENT
/begin MEASUREMENT wdk3 "" UBYTE relDK_ub_b100 1 100 0.00 100.0 FORMAT "%5.1" ECU_ADDRESS 0xF0840 /end MEASUREMENT
/begin MEASUREMENT wdkba "" UBYTE relDK_ub_b100 1 100 0.00 100.0 FORMAT "%5.1" ECU_ADDRESS 0xF0841 /end MEASUREMENT
/begin MEASUREMENT wdkba_w "" SWORD relDK_q0p02441 1 100 -800.0000 799.9756 FORMAT "%8.4" ECU_ADDRESS 0xE0E0 /end MEASUREMENT
/begin MEASUREMENT wdkpmx "" UBYTE relDK_ub_b100 1 100 0.00 100.0 FORMAT "%5.1" ECU_ADDRESS 0xF0842 /end MEASUREMENT
/begin MEASUREMENT wkwbzm0_w "" UWORD kw_tooth_sy 1 100 0.00 393210.0 FORMAT "%8.1" ECU_ADDRESS 0xE092 /end MEASUREMENT
/begin MEASUREMENT wkwneg_w "" UWORD kw_tooth_sy 1 100 0.00 393210.0 FORMAT "%8.1" ECU_ADDRESS 0xE094 /end MEASUREMENT
/begin MEASUREMENT wkwpos_w "" UWORD kw_tooth_sy 1 100 0.00 393210.0 FORMAT "%8.1" ECU_ADDRESS 0xE096 /end MEASUREMENT
/begin MEASUREMENT wkwstart_w "" UWORD kw_tooth_sy 1 100 0.00 393210.0 FORMAT "%8.1" ECU_ADDRESS 0xE098 /end MEASUREMENT
/begin MEASUREMENT wkwsyn_w "" UWORD kw_tooth_sy 1 100 0.00 393210.0 FORMAT "%8.1" ECU_ADDRESS 0xE002 /end MEASUREMENT
/begin MEASUREMENT wkw_w "" UWORD kw_tooth_sy 1 100 0.00 393210.0 FORMAT "%8.1" ECU_ADDRESS 0xFE50 /end MEASUREMENT
/begin MEASUREMENT wmfa "" UBYTE zw_ub_q0p75 1 100 0.00 191.3 FORMAT "%5.1" ECU_ADDRESS 0xF0A6A /end MEASUREMENT
/begin MEASUREMENT wmfl "" UBYTE zw_ub_q0p75 1 100 0.00 191.3 FORMAT "%5.1" ECU_ADDRESS 0xF0A6B /end MEASUREMENT
/begin MEASUREMENT wnwadmn2_w "" SWORD kw_q0p0156 1 100 -512.0000 511.9844 FORMAT "%8.4" ECU_ADDRESS 0xF4410 /end MEASUREMENT
/begin MEASUREMENT wnwadmna_w "" SWORD kw_q0p0078 1 100 -256.0000 255.9922 FORMAT "%8.4" ECU_ADDRESS 0xF1730 /end MEASUREMENT
/begin MEASUREMENT wnwadmne_w "" SWORD kw_q0p0078 1 100 -256.0000 255.9922 FORMAT "%8.4" ECU_ADDRESS 0xF4412 /end MEASUREMENT
/begin MEASUREMENT wnwadmn_w "" SWORD kw_q0p0156 1 100 -512.0000 511.9844 FORMAT "%8.4" ECU_ADDRESS 0xF4414 /end MEASUREMENT
/begin MEASUREMENT wnwadmx2_w "" SWORD kw_q0p0156 1 100 -512.0000 511.9844 FORMAT "%8.4" ECU_ADDRESS 0xF1732 /end MEASUREMENT
/begin MEASUREMENT wnwadmxa_w "" SWORD kw_q0p0078 1 100 -256.0000 255.9922 FORMAT "%8.4" ECU_ADDRESS 0xF1734 /end MEASUREMENT
/begin MEASUREMENT wnwadmxe_w "" SWORD kw_q0p0078 1 100 -256.0000 255.9922 FORMAT "%8.4" ECU_ADDRESS 0xF1736 /end MEASUREMENT
/begin MEASUREMENT wnwadmx_w "" SWORD kw_q0p0156 1 100 -512.0000 511.9844 FORMAT "%8.4" ECU_ADDRESS 0xF1738 /end MEASUREMENT
/begin MEASUREMENT wnwa_w "" SWORD kw_q0p0078 1 100 -256.0000 255.9922 FORMAT "%8.4" ECU_ADDRESS 0xF173A /end MEASUREMENT
/begin MEASUREMENT wnweoas2_w "" SWORD kw_q0p0078 1 100 -256.0000 255.9922 FORMAT "%8.4" ECU_ADDRESS 0xF173C /end MEASUREMENT
/begin MEASUREMENT wnweoas_w "" SWORD kw_q0p0078 1 100 -256.0000 255.9922 FORMAT "%8.4" ECU_ADDRESS 0xF173E /end MEASUREMENT
/begin MEASUREMENT wnwe_w "" SWORD kw_q0p0078 1 100 -256.0000 255.9922 FORMAT "%8.4" ECU_ADDRESS 0xF1740 /end MEASUREMENT
/begin MEASUREMENT wnwi2_ad_w "" SWORD kw_q0p0039 1 100 -128.0000 127.9961 FORMAT "%8.4" ECU_ADDRESS 0xF1742 /end MEASUREMENT
/begin MEASUREMENT wnwim2_w "" UWORD kw_q0p0039 1 100 0.00 255.9961 FORMAT "%8.4" ECU_ADDRESS 0x382EBA /end MEASUREMENT
/begin MEASUREMENT wnwim_w "" UWORD kw_q0p0039 1 100 0.00 255.9961 FORMAT "%8.4" ECU_ADDRESS 0x382EBC /end MEASUREMENT
/begin MEASUREMENT wnwi_ad_w "" SWORD kw_q0p0039 1 100 -128.0000 127.9961 FORMAT "%8.4" ECU_ADDRESS 0xF1744 /end MEASUREMENT
/begin MEASUREMENT wnwkor2_w "" SWORD kw_q0p0156 1 100 -512.0000 511.9844 FORMAT "%8.4" ECU_ADDRESS 0xF4416 /end MEASUREMENT
/begin MEASUREMENT wnwkor_w "" SWORD kw_q0p0156 1 100 -512.0000 511.9844 FORMAT "%8.4" ECU_ADDRESS 0xF4418 /end MEASUREMENT
/begin MEASUREMENT wnwkwas2_w "" UWORD kw_q0p0156 1 100 0.00 1023.984 FORMAT "%8.3" ECU_ADDRESS 0xF1746 /end MEASUREMENT
/begin MEASUREMENT wnwkwas_w "" UWORD kw_q0p0156 1 100 0.00 1023.984 FORMAT "%8.3" ECU_ADDRESS 0xF1748 /end MEASUREMENT
/begin MEASUREMENT wnwsp2_w "" UWORD kw_q0p0156 1 100 0.00 1023.984 FORMAT "%8.3" ARRAY_SIZE 4 ECU_ADDRESS 0x382EBE /end MEASUREMENT
/begin MEASUREMENT wnwspas2_w "" UWORD kw_q0p0156 1 100 0.00 1023.984 FORMAT "%8.3" ECU_ADDRESS 0xF174A /end MEASUREMENT
/begin MEASUREMENT wnwspas_w "" UWORD kw_q0p0156 1 100 0.00 1023.984 FORMAT "%8.3" ECU_ADDRESS 0xF174C /end MEASUREMENT
/begin MEASUREMENT wnwsp_w "" UWORD kw_q0p0156 1 100 0.00 1023.984 FORMAT "%8.3" ARRAY_SIZE 4 ECU_ADDRESS 0x382EC6 /end MEASUREMENT
/begin MEASUREMENT wped "" UBYTE relPED_ub_b100 1 100 0.00 100.0 FORMAT "%5.1" ECU_ADDRESS 0xF0822 /end MEASUREMENT
/begin MEASUREMENT wpedt_w "" UWORD relPED_q0p00153 1 100 0.00 100.0000 FORMAT "%8.4" ECU_ADDRESS 0xF1AD2 /end MEASUREMENT
/begin MEASUREMENT wpedv_w "" UWORD relPED_q0p00153 1 100 0.00 100.0000 FORMAT "%8.4" ECU_ADDRESS 0xF1AD4 /end MEASUREMENT
/begin MEASUREMENT wped_w "" UWORD relPED_q0p00153 1 100 0.00 100.0000 FORMAT "%8.4" ECU_ADDRESS 0xF1AD6 /end MEASUREMENT
/begin MEASUREMENT wtans "" UBYTE spg_ub_b5 1 100 0.00 4.980 FORMAT "%5.3" ECU_ADDRESS 0xF0505 /end MEASUREMENT
/begin MEASUREMENT wtka "" UBYTE spg_ub_b5 1 100 0.00 4.980 FORMAT "%5.3" ECU_ADDRESS 0xF0506 /end MEASUREMENT
/begin MEASUREMENT wtmot_w "" UWORD spg_uw_q0p00488 1 100 0.00 319.9951 FORMAT "%8.4" ECU_ADDRESS 0xF0CD6 /end MEASUREMENT
/begin MEASUREMENT wub "" UBYTE spg_ubatt 1 100 0.00 17.95 FORMAT "%5.2" ECU_ADDRESS 0xF0507 /end MEASUREMENT
/begin MEASUREMENT wubiso_w "" UWORD spg_q0p001 1 100 0.00 65.53500 FORMAT "%8.5" ECU_ADDRESS 0xF1AA6 /end MEASUREMENT
/begin MEASUREMENT wubr "" UBYTE spg_ub_b28p5 1 100 0.00 28.38 FORMAT "%5.2" ECU_ADDRESS 0xF0508 /end MEASUREMENT
/begin MEASUREMENT wubr_w "" UWORD spg_ub_b28p5_w 1 100 0.00 1823.511 FORMAT "%8.3" ECU_ADDRESS 0xF0CD8 /end MEASUREMENT
/begin MEASUREMENT wub_w "" UWORD spg_ubatt_w 1 100 0.00 1153.416 FORMAT "%8.3" ECU_ADDRESS 0xF0CDA /end MEASUREMENT
/begin MEASUREMENT wuhr "" UBYTE spg_ub_b5 1 100 0.00 4.980 FORMAT "%5.3" ECU_ADDRESS 0xF0509 /end MEASUREMENT
/begin MEASUREMENT zbeztafix "" UBYTE dez 1 100 0.00 255.0 FORMAT "%5.1" ECU_ADDRESS 0x38401D /end MEASUREMENT
/begin MEASUREMENT zdelay "" UBYTE dez 1 100 0.00 255.0 FORMAT "%5.1" ECU_ADDRESS 0xE08D /end MEASUREMENT
/begin MEASUREMENT zfcnt "" UBYTE dez 1 100 0.00 255.0 FORMAT "%5.1" ECU_ADDRESS 0xF07ED /end MEASUREMENT
/begin MEASUREMENT zfzptafx "" UBYTE dez 1 100 0.00 255.0 FORMAT "%5.1" ECU_ADDRESS 0xF4108 /end MEASUREMENT
/begin MEASUREMENT zkrfmu "" UBYTE dez 1 100 0.00 255.0 FORMAT "%5.1" ECU_ADDRESS 0xF0A6C /end MEASUREMENT
/begin MEASUREMENT zllptafx "" UBYTE dez 1 100 0.00 255.0 FORMAT "%5.1" ECU_ADDRESS 0xF4109 /end MEASUREMENT
/begin MEASUREMENT zlooplsu "" UBYTE dez 1 100 0.00 255.0 FORMAT "%5.1" ECU_ADDRESS 0xF0B69 /end MEASUREMENT
/begin MEASUREMENT zlooplsu2 "" UBYTE dez 1 100 0.00 255.0 FORMAT "%5.1" ECU_ADDRESS 0xF0B6A /end MEASUREMENT
/begin MEASUREMENT znbm_w "" UWORD dez 1 100 0.00 65535.00 FORMAT "%8.2" ECU_ADDRESS 0xFE50 /end MEASUREMENT
/begin MEASUREMENT znldtafx_w "" UWORD dez 1 100 0.00 65535.00 FORMAT "%8.2" ECU_ADDRESS 0x38407C /end MEASUREMENT
/begin MEASUREMENT zphfl "" UBYTE dez 1 100 0.00 255.0 FORMAT "%5.1" ECU_ADDRESS 0xF06F5 /end MEASUREMENT
/begin MEASUREMENT zphfl2 "" UBYTE dez 1 100 0.00 255.0 FORMAT "%5.1" ECU_ADDRESS 0xF06F6 /end MEASUREMENT
/begin MEASUREMENT zriberh "" UBYTE dez 1 100 0.00 255.0 FORMAT "%5.1" ECU_ADDRESS 0xF4080 /end MEASUREMENT
/begin MEASUREMENT zriberh2 "" UBYTE dez 1 100 0.00 255.0 FORMAT "%5.1" ECU_ADDRESS 0xF4081 /end MEASUREMENT
/begin MEASUREMENT zrinh2_w "" UWORD t100msxs_uw_b6553p5 1 100 0.00 6553.500 FORMAT "%8.3" ECU_ADDRESS 0xF445C /end MEASUREMENT
/begin MEASUREMENT zrinh_w "" UWORD t100msxs_uw_b6553p5 1 100 0.00 6553.500 FORMAT "%8.3" ECU_ADDRESS 0xF445E /end MEASUREMENT
/begin MEASUREMENT zriwzgh "" UBYTE dez 1 100 0.00 255.0 FORMAT "%5.1" ECU_ADDRESS 0xF4082 /end MEASUREMENT
/begin MEASUREMENT zriwzgh2 "" UBYTE dez 1 100 0.00 255.0 FORMAT "%5.1" ECU_ADDRESS 0xF4083 /end MEASUREMENT
/begin MEASUREMENT zrph "" UBYTE dez 1 100 0.00 255.0 FORMAT "%5.1" ECU_ADDRESS 0xF070C /end MEASUREMENT
/begin MEASUREMENT zrph2 "" UBYTE dez 1 100 0.00 255.0 FORMAT "%5.1" ECU_ADDRESS 0xF070D /end MEASUREMENT
/begin MEASUREMENT zrphgefl "" UBYTE dez 1 100 0.00 255.0 FORMAT "%5.1" ECU_ADDRESS 0xF06F7 /end MEASUREMENT
/begin MEASUREMENT zrphgefl2 "" UBYTE dez 1 100 0.00 255.0 FORMAT "%5.1" ECU_ADDRESS 0xF06F8 /end MEASUREMENT
/begin MEASUREMENT zseglsu "" UBYTE t1msxms_q1 1 100 0.00 255.0 FORMAT "%5.1" ECU_ADDRESS 0xF0B6B /end MEASUREMENT
/begin MEASUREMENT zseglsum "" UBYTE dez 1 100 0.00 255.0 FORMAT "%5.1" ECU_ADDRESS 0xF0B6C /end MEASUREMENT
/begin MEASUREMENT zseglsumt "" UBYTE t_q0p001 1 100 0.00 0.2550 FORMAT "%6.4" ECU_ADDRESS 0xF0B6D /end MEASUREMENT
/begin MEASUREMENT ztpnt_a "" UBYTE dez 1 100 0.00 255.0 FORMAT "%5.1" ECU_ADDRESS 0xF0A6D /end MEASUREMENT
/begin MEASUREMENT zylvirt "" UBYTE dez 1 100 0.00 255.0 FORMAT "%5.1" ECU_ADDRESS 0xF070E /end MEASUREMENT
/begin MEASUREMENT zzale_ini "" UBYTE dez 1 100 0.00 255.0 FORMAT "%5.1" ECU_ADDRESS 0xF070F /end MEASUREMENT
/begin MEASUREMENT zzseg "" UBYTE dez 1 100 0.00 255.0 FORMAT "%5.1" ECU_ADDRESS 0xFEC4 /end MEASUREMENT
/begin MEASUREMENT zztab "" UWORD dez 1 100 0.00 65535.00 FORMAT "%8.2" ARRAY_SIZE 24 ECU_ADDRESS 0xE09A /end MEASUREMENT
/begin MEASUREMENT zzvirt "" UBYTE dez 1 100 0.00 255.0 FORMAT "%5.1" ECU_ADDRESS 0xF0710 /end MEASUREMENT
/begin MEASUREMENT zzyl "" UBYTE dez 1 100 0.00 255.0 FORMAT "%5.1" ECU_ADDRESS 0xE08E /end MEASUREMENT
/begin MEASUREMENT zzylkr "" UBYTE dez 1 100 0.00 255.0 FORMAT "%5.1" ECU_ADDRESS 0xF0A6E /end MEASUREMENT
/begin MEASUREMENT zzylkr_neu "" UBYTE dez 1 100 0.00 255.0 FORMAT "%5.1" ECU_ADDRESS 0xF0A6F /end MEASUREMENT
/begin MEASUREMENT zzyl_virt "" UBYTE dez 1 100 0.00 255.0 FORMAT "%5.1" ECU_ADDRESS 0xF0711 /end MEASUREMENT
/begin FUNCTION GGDPG "14.60"
 /begin DEF_CHARACTERISTIC CWNWREF DZZST DZZST2 DZZSTNLP NMIN NMOTQSYN OFQSYNADAP PH_MINSEG TMQSYN TPREL ZDELBMSRCH ZTPREL /end DEF_CHARACTERISTIC
 /begin IN_MEASUREMENT B_ale B_nldg B_nlph B_nosynph B_phad B_phad2 B_phnldg B_phsok B_phsok2 B_pwf B_st B_synnldg nmot nmot_w tmot wkwstop wnwsp2_w wnwsp_w /end IN_MEASUREMENT
 /begin OUT_MEASUREMENT bmLosCtr_w B_bm B_fbm B_luecke B_mluecke B_nmin B_nmot B_nobm B_nobm1 B_noph B_noph2 B_pha2act B_phaact B_phas2 B_phase B_qsyn B_startini B_stprel B_syn B_synph B_zprel B_zztab dpgNvBits gaptooth ggdpgBitsKgs nsynggdpg tmCorCtr_w tnbm1_w tnbm2_w tnbm_w tpCorCtr_w ttooth10ms uzkw_w wkwbzm0_w wkwsyn_w wkw_w znbm_w zrph zrph2 zylvirt zzseg zztab zzvirt zzyl /end OUT_MEASUREMENT
 /begin LOC_MEASUREMENT bmzzyl B_enqsyn B_pgxqsyn B_phw B_phw2 B_phwneg B_phwok B_phwok2 B_phwpos B_synbmale edge_ctr len_hiseg len_loseg qzzyl stateQsyn wkwneg_w wkwpos_w wkwstart_w zdelay zzale_ini zzyl_virt /end LOC_MEASUREMENT
/end FUNCTION
/begin FUNCTION GGDSAS "4.130"
 /begin DEF_CHARACTERISTIC ANUDLMN DPDSVLU DPUPVDK DSUGRAD DSUOFS FHOE NDSVLO NDSVLU NVGDSLL PUE PUMN PUMX PUSPSMX PVDKPUD TDDFU TDDFUUGD TDVGDSLL UADPUMN UADPUMX WDKDSVLU ZDSU /end DEF_CHARACTERISTIC
 /begin IN_MEASUREMENT B_nmot B_wdksive ftu ml_w nmot pspvdk_w pssol_w ps_w udsl_w udsu_w wdkba /end IN_MEASUREMENT
 /begin OUT_MEASUREMENT B_edsl B_edsuu B_hag fho fho_w fpvdkds fpvdkds_w frhol_w GgdsasNvBits pu pus_w pu_w pvdkds pvdkds_w pvdkmx_w pvdksf_w pvdkspud pvdks_w vpvdkpu_w /end OUT_MEASUREMENT
 /begin LOC_MEASUREMENT dpvdkspu_w fpvdkdsl_w fpvdkdsu_w ldfki_w psspvdkd_w pvdkdsl_w pvdkdsu_w /end LOC_MEASUREMENT
/end FUNCTION
/begin FUNCTION GGDVE "2.50"
 /begin DEF_CHARACTERISTIC DUDKP1HY DWDK12O DWDK13O DWDK23O KFWDKPP NDKPPU NWDK3 TDKPAW TFWDKPN TVPDKP1 TVPDKP2 TVPWDK12 TVPWDK13 TVPWDK23 UBVDKPO UBVDKPU UDKP1O UDKP1U UDKP2O UDKP2U WDKPMXN /end DEF_CHARACTERISTIC
 /begin IN_MEASUREMENT B_dkpu B_ehfm B_st B_ubpvg dkpstg_w fpvdkds ftvdk nmot rl ub udkp1a_w udkp1sv udkp1vo_w udkp1vv_w udkp1v_w udkp1_w udkp2a_w udkp2_w /end IN_MEASUREMENT
 /begin OUT_MEASUREMENT B_dkp1e B_dkp1mn B_dkp1mx B_dkp1np B_dkp2e B_dkp2mn B_dkp2mx B_dkp2np B_dkpaw B_dksbeg B_edks B_wdk1v B_wdk2sel dwdkba_w wdk1_w wdk2_w wdkba wdkba_w /end OUT_MEASUREMENT
 /begin LOC_MEASUREMENT B_dkp1ev B_dkp2ev B_ubvdkp B_udk1nv B_wdk12ev B_wdk13ev B_wdk23ev B_wdk2st cpaw1 cpaw2 ctdkp1 ctdkp2 ctdkpaw ctwdk12 ctwdk13 ctwdk23 rlvppl wdk1 wdk1g wdk2 wdk2g wdk3 wdkpmx /end LOC_MEASUREMENT
/end FUNCTION
/begin FUNCTION GGEGAS "9.61" /begin DEF_CHARACTERISTIC CWGGEGAS KFTVKUP TEPBRKUP TVERBR TVKUPV ZERBR /end DEF_CHARACTERISTIC
 /begin IN_MEASUREMENT B_autget B_bkva B_bkvv B_fabr B_pwf B_vnull gangi nmot_w S_bls S_brs S_kupp /end IN_MEASUREMENT
 /begin OUT_MEASUREMENT B_bl B_br B_br2k B_brems B_kuppl B_kupplv ctrerbr /end OUT_MEASUREMENT
 /begin LOC_MEASUREMENT B_erbr /end LOC_MEASUREMENT
/end FUNCTION
/begin FUNCTION GGFGRH "1.200"
 /begin DEF_CHARACTERISTIC CWGGFGRH TEPFGRH TFGRABTE TFGRHE TFGRHSNP TFGRTIP TOOTAUS TOOTEIN TOOTULB ZFGRSDET /end DEF_CHARACTERISTIC
 /begin IN_MEASUREMENT B_acc B_cfgra B_ctout B_fgrabz B_fgratc B_fgrbec B_fgrhec B_fgrhsc B_fgrsec B_fgrtdc B_fgrte B_fgrthsc B_fgrtuc B_fgrvec B_fgrwac B_gra6p B_grabot B_gracan fgrscodc S_fgrat S_fgrhs S_fgrsv S_fgrwb /end IN_MEASUREMENT
 /begin OUT_MEASUREMENT B_fgr6p B_fgrat B_fgrhe B_fgrhsa B_fgrtbe B_fgrtbh B_fgrtse B_fgrtve B_fgrtvh B_fgrtwa B_rfgoot /end OUT_MEASUREMENT
 /begin LOC_MEASUREMENT B_afgrbs B_ffhsc B_fgootein B_fgrbtl B_fgrhev B_fgrhs B_fgrths B_fgrthse B_gra6pe B_tootaus B_tootein B_tootulb ctbetip ctepfgrh ctfgrhe cthsnp ctootaus ctootein ctootulb_w ctvetip fgrscod GGFGRHlokbits0 GGFGRHlokbits1 GGFGRHlokbits2 TB_eieo18 TB_eieo19a TB_eieo19b TB_eieo19c /end LOC_MEASUREMENT
/end FUNCTION
/begin FUNCTION GGFST "11.40" /begin DEF_CHARACTERISTIC TWNSTA TWNTAL /end DEF_CHARACTERISTIC /begin IN_MEASUREMENT B_pwf B_talcan tfst tnst_w /end IN_MEASUREMENT /begin OUT_MEASUREMENT B_tal B_talval fstt GGFSTbits /end OUT_MEASUREMENT /begin LOC_MEASUREMENT timtalr_w timtals_w /end LOC_MEASUREMENT /end FUNCTION
/begin FUNCTION GGGTS "2.30" /begin DEF_CHARACTERISTIC DTMKI TMKIMN TVTMKIC TVTMKIE /end DEF_CHARACTERISTIC /begin IN_MEASUREMENT B_cdgts B_ckien B_ctout B_tmkicb tmew tmkic tmot /end IN_MEASUREMENT /begin OUT_MEASUREMENT tmki /end OUT_MEASUREMENT /end FUNCTION
/begin FUNCTION GGHFM "65.20"
 /begin DEF_CHARACTERISTIC CWHFMPUKL1 CWHFMPUKL2 FNWUEPUHFM KFKHFM KFPU KFPUKLP1 KFPUKLP12 KFPUKLP2 MLHFM MLMIN MLOFS PUKANS /end DEF_CHARACTERISTIC
 /begin IN_MEASUREMENT B_su fnwue nmot rl tans uhfm_w wdkba /end IN_MEASUREMENT
 /begin OUT_MEASUREMENT mlhfmm_w mshfm1_w mshfms_w mshfm_w /end OUT_MEASUREMENT
 /begin LOC_MEASUREMENT anzhfma_w B_puklp1 B_puklp2 fkhfm fpuk mlhfma_w nmotkor puans /end LOC_MEASUREMENT
/end FUNCTION
/begin FUNCTION GGKLDF "2.40"
 /begin DEF_CHARACTERISTIC CWKLDF DFMPERIOMX KLDFPWMDEF KLDFPWMST NTHRESHOLD PWMRAMPINC TKLDFINI TKLDFPWMDF ZKLDFPWMF /end DEF_CHARACTERISTIC
 /begin IN_MEASUREMENT B_stend dfmlow_w dfmperio_w nmot pwmstate /end IN_MEASUREMENT
 /begin OUT_MEASUREMENT B_kldfact B_pwmramp kldfpwm kldfpwmf perioval_w tkldflock /end OUT_MEASUREMENT
/end FUNCTION
/begin FUNCTION GGKS "4.50"
 /begin DEF_CHARACTERISTIC DKROKD DKROKMX DKROKO FMFKRB0 FMFKRB1 FMFKRB2 FMFKRB3 KEMLN KFMAKR NKRFM1 NKRFM2 NKRFM3 SENZZYL TMCC650 /end DEF_CHARACTERISTIC
 /begin REF_CHARACTERISTIC CWDKRTP KRANH KRFHT KRFTP1 SNM16KRUB SRL04KRUB TMKR /end REF_CHARACTERISTIC
 /begin IN_MEASUREMENT B_kr B_krldy B_krndy B_st B_stend B_tmkr esst_snm16krub esst_srl04krub krftpakt nmot rl tmot tn2 xzskrnt xzskrof xzskrtp zzyl /end IN_MEASUREMENT
 /begin OUT_MEASUREMENT B_anschlag B_c95bf0 B_c95bf1 B_c95bf2 B_c95bf3 B_c95ks3 B_dnt B_dntb B_dtp B_dtpb B_fmfkrc B_fmfkrhs B_ntini B_tpnt_aw B_tpnt_e fmfw igod_w igokr_w ikr ikrma ikrme ikrmen ikrmet ikr_tst iokkr ks_sym sen_c95 tmfa_w tmfln_w tmfl_w tpnt_aktiv UADKI UADMFA wmfa wmfl zkrfmu ztpnt_a zzylkr zzylkr_neu /end OUT_MEASUREMENT
 /begin LOC_MEASUREMENT fmfkrakt fmfkraktol /end LOC_MEASUREMENT
/end FUNCTION
/begin FUNCTION GGLSH "7.30"
 /begin DEF_CHARACTERISTIC ANZRIBEH ANZRIWZGH CWGGLSH DUSRIH DUSSPH FRINOFH RBELH RINHMX RKSPH THSRIH TRIAKTH TRIIMPH TUSBELH TUSRIBERH USRIMINH USRIOH USRIUH ZFRIH /end DEF_CHARACTERISTIC
 /begin IN_MEASUREMENT B_lsh B_lsh2 B_shres B_shres2 B_ttbmhh B_ttbmhh2 uushk2_w uushk_w uushmb2_w uushmb_w uushob2_w uushob_w /end IN_MEASUREMENT
 /begin OUT_MEASUREMENT B_priph B_priph2 B_rinh B_rinh2 B_shuerf B_shuerf2 rinh2_w rinh_w ushk ushk2 ushk2_w ushk_w /end OUT_MEASUREMENT
 /begin LOC_MEASUREMENT B_enrinh B_enrinh2 B_erinofh B_erinofh2 B_riakh B_riakh2 B_ribeh B_ribeh2 B_ribehv B_ribehv2 B_riibh B_riibh2 B_riimph B_rimh B_rimh2 B_ripuh B_ripuh2 B_rireh B_rireh2 B_risph B_risph2 B_usbeh B_usbeh2 rinofh2_w rinofha2_w rinofha_w rinofh_w usbeh2_w usbeh_w ushkr2_w ushkr_w ushmb2_w ushmb_w ushob2_w ushob_w usobh2_w usobh_w zriberh zriberh2 zrinh2_w zrinh_w zriwzgh zriwzgh2 /end LOC_MEASUREMENT
/end FUNCTION
/begin FUNCTION GGLSVFH "1.30"
 /begin IN_MEASUREMENT B_lsh B_lsh2 B_ripuh B_ripuh2 B_shuerf B_shuerf2 uushk2_w uushk_w valutggls /end IN_MEASUREMENT
 /begin OUT_MEASUREMENT B_pump B_shres B_shres2 uushmb2_w uushmb_w uushob2_w uushob_w /end OUT_MEASUREMENT
 /begin LOC_MEASUREMENT B_measure /end LOC_MEASUREMENT
/end FUNCTION
/begin FUNCTION GGNW "1.80"
 /begin DEF_CHARACTERISTIC CWGGNW PHNMO PHNMU STM05EPMSB THPHADR THPHADS WNWAFMX WNWASMX WNWKM WNWKM2 WNWKN WNWRPS WNWRPS2 ZNWSP ZPHFLBM1 /end DEF_CHARACTERISTIC
 /begin REF_CHARACTERISTIC WNWRAS WNWREO /end REF_CHARACTERISTIC
 /begin IN_MEASUREMENT B_bm B_luecke B_nldg B_nwflada B_nwflade B_p1refpos B_p2refpos B_pwf B_syn B_synnldg B_zztab gaptooth nmot synstate tmot wkwsyn_w wkw_w zphflsyn zzseg zztab zzyl /end IN_MEASUREMENT
 /begin OUT_MEASUREMENT B_nwia B_nwie B_phad B_phad2 B_phada B_phade B_phnmo B_phnmu B_spsa B_spsa2 B_wnwi2out B_wnwiout tnwia_w tnwie_w wnwadmn2_w wnwadmna_w wnwadmne_w wnwadmn_w wnwadmx2_w wnwadmxa_w wnwadmxe_w wnwadmx_w wnwa_w wnwe_w wnwi2_ad_w wnwi_ad_w wnwkwas2_w wnwkwas_w wnwspas2_w wnwspas_w zphfl zphfl2 zrphgefl zrphgefl2 /end OUT_MEASUREMENT
 /begin LOC_MEASUREMENT B_nwflad B_nwflad2 B_phgefl B_phgefl2 esst_stm05epmsb wnweoas2_w wnweoas_w wnwim2_w wnwim_w wnwkor2_w wnwkor_w wnwsp2_w wnwsp_w /end LOC_MEASUREMENT
/end FUNCTION
/begin FUNCTION GGO2LSU "2.40"
 /begin DEF_CHARACTERISTIC CWGGLSU F10SAMP F5SAMP FIPLSU FIPREFLSU FLAMPFT FLAMPMR FLSUFTKL O2VK SEGMANSW TABGL TABGS TUMTOE TVABGL USABGL ZFDUSVK /end DEF_CHARACTERISTIC
 /begin IN_MEASUREMENT B_eiclsu B_eiclsu2 B_elsuwi B_elsuwi2 B_fklsol B_fklsol2 B_llr B_st B_stend iprefanf iprefanf2 ktkvk2_w ktkvk_w nmot_w pabnav2_w pabnav_w pabvvk2_w pabvvk_w tnst_w uulsuv2_w uulsuv_w /end IN_MEASUREMENT
 /begin OUT_MEASUREMENT B_fklanf B_fklanf2 B_iclsabg B_iclsabg2 dua10g2_w dua10g_w iplsuvj2_w iplsuvj_w kusvk2_w kusvkft2_w kusvkft_w kusvk_w lsukorp2_w lsukorp_w o2vk2_w o2vk_w palsu2_w palsu_w ua10mo2_w ua10mo_w ua10ms2_w ua10ms_w usvkvj2_w usvkvj_w zseglsumt /end OUT_MEASUREMENT
 /begin LOC_MEASUREMENT B_fklanfs B_resabg B_resabg2 B_tabgs ipiprk2_w ipiprk_w ipkorp2_w ipkorp_w ipktk2_w ipktk_w iproh2_w iproh_w plauf plauf2 plooplsu plooplsu2 pringlsu pringlsu2 prlsust prlsust2 sumulsu2_l sumulsu_l ulsurbu2_w ulsurbu_w zlooplsu zlooplsu2 zseglsu zseglsum /end LOC_MEASUREMENT
/end FUNCTION
/begin FUNCTION GGPBKV "2.50"
 /begin DEF_CHARACTERISTIC CWGGPBKV DPBKVBBG DPBKVBSGV0 DPBKVBSGVS DPBKVEBG DPBKVEBGVS DPBKVEVK DPBKVEVKEP DPBKVEVKSP DPBKVSTG FBKVP KAFPBKVPU PBKVVSTGPV PUEBKV TBKVP TEBBREMS VFZGSCH /end DEF_CHARACTERISTIC
 /begin IN_MEASUREMENT B_bkvp B_brems B_cddsbkv ps_w pu_w pvdkds_w vfzg_w /end IN_MEASUREMENT
 /begin OUT_MEASUREMENT dpbkvu_w pbkvpmn_w psspbkv_w pubkv_w /end OUT_MEASUREMENT
 /begin LOC_MEASUREMENT dmnpbkv_w dmxpbkv_w dpbkvep_w dpbkvmx_w dpbkvps_w dpbkvsp_w dpspvdkd_w pbkvmod_w pbkvmpu_w /end LOC_MEASUREMENT
/end FUNCTION
/begin FUNCTION GGPED "22.40"
 /begin DEF_CHARACTERISTIC CWBWEEN DUPWGHY DUPWGVPE DWPMXNB DWPMXNOT DWPOPBP DWPPBP KLDUPW12 MIFAMXNOT NMINMBVH NSPWGBRPL NSPWGNOT1 NSPWGNOT2 NSPWGNOT3 NWPMBBR PWGDEMX TDWPOPBP TMBVH TPNSE1 TPWGDEE TPWGDEOK TUPWG12 TUPWG1O TUPWG1U TUPWG2O TUPWG2U TWPLK TWPMBBR UPWG12U UPWG1LLDE UPWG1O UPWG1OGDE UPWG1U UPWG2DOFF UPWG2LLDE UPWG2O UPWG2OGDE UPWG2U UPWGO UPWGU VNSPWGNOT3 VWPMBBR WPMXBR WPMXNOT WPRMBVH /end DEF_CHARACTERISTIC
 /begin IN_MEASUREMENT B_bkva B_bkvv B_bl B_br B_br2k B_brems B_dksbeg B_fabr B_fs B_nmax B_pwgnotum B_stend B_ubpvg nmot upwg1_w upwg2_w vfzg /end IN_MEASUREMENT
 /begin OUT_MEASUREMENT B_pwgnotfr B_sp1s B_sp2s B_spsmin dwped dwped_w mifamx_w mkfamx_w nspwgnot upwg1h_w upwg2d_w wped wped_w /end OUT_MEASUREMENT
 /begin LOC_MEASUREMENT B_dupw12 B_dupwgvpe B_glf B_mbvh B_pbpabr B_pwgde B_pwgdee B_pwgdeok B_pwglk B_pwgnoten B_upw12e B_upw1mn B_upw1mx B_upw2mn B_upw2mx B_upwg1o B_upwg1u B_upwg2o B_upwg2u B_vpwgerr B_wpabnb B_wpmbbr pwgdectr upwgej_w upwgmin upwg_w wpedt_w wpedv_w /end LOC_MEASUREMENT
/end FUNCTION
/begin FUNCTION GGRTLSU "1.140"
 /begin DEF_CHARACTERISTIC DURINLSU FARIN KLKTKVK KLRTLSU RINCAL RININI TKERENSCUN TKERLSPSF TRINSTART TUMTO TVSABGL URINOFF ZFRIN ZFRINCAL ZFRINSTART /end DEF_CHARACTERISTIC
 /begin REF_CHARACTERISTIC TVSERSL /end REF_CHARACTERISTIC
 /begin IN_MEASUREMENT B_ehlsu B_ehlsu2 B_ehsve B_ehsve2 B_eiclsu B_eiclsu2 B_elsuwi B_elsuwi2 B_elsv B_elsv2 B_eshlsu B_eshlsu2 B_henrin B_henrin2 B_hsv B_hsv2 B_iclsabg B_iclsabg2 B_lsuiamn B_lsuiamn2 B_lsuiamx B_lsuiamx2 B_lsuunmn B_lsuunmn2 B_lsuunmx B_lsuunmx2 B_lsuvmmn B_lsuvmmn2 B_lsuvmmx B_lsuvmmx2 B_nmot B_pwf B_spf3k B_spf3k2 B_stend B_zlsv B_zlsv2 rdtklsu2_w rdtklsu_w ubsq_w urinlsu2_w urinlsu_w /end IN_MEASUREMENT
 /begin OUT_MEASUREMENT B_enscun B_enscun2 B_pusab B_pusab2 B_rinabg B_rinabg2 ggrtlsuAusBits10ms ggrtlsuAusBitsKoop krivk2_w krivk_w ktkvk2_w ktkvk_w rinlsu2_w rinlsu_w tkerlsu2_w tkerlsu_w /end OUT_MEASUREMENT
 /begin LOC_MEASUREMENT B_ckrivk B_ckrivk2 B_erlsuwi B_erlsuwi2 drinlsu2_w drinlsu_w ggrtlsuLokBits10ms ggrtlsuLokBitsKoop rinlsuk2_w rinlsuk_w rrinlsu2_w rrinlsu_w /end LOC_MEASUREMENT
/end FUNCTION
/begin FUNCTION GGTFA "18.91"
 /begin DEF_CHARACTERISTIC AFZPTAFX ALLPTAFX CWKONDTFA DTAFIX MLDTAMN MLDTAMX MLPTAFXO MLPTAFXU TADE TADMN TADMX TADPLMX TANSELI TDFZTAFX TDLLTAFX TDNSTA TDPLTAO TDRFZTAFX TDRPLTAO TDTA TDTAL TMABDTA1MN TMPTAFXMN TMPTAFXU TMSPTAFX TMSUPTAFX TWNLPTAMN TWNSEZDTAN TWTMNTAFX VPTAFXO VPTAFXU VTAPLC ZFTANS /end DEF_CHARACTERISTIC
 /begin IN_MEASUREMENT B_ll B_nldtafx B_nmot B_pwf B_sa B_stend ml tmot tmotab tmst tnachl_w tnse_w vfzg wtans /end IN_MEASUREMENT
 /begin OUT_MEASUREMENT tans tansab tansabk_w tansk_w tanslin zbeztafix znldtafx_w /end OUT_MEASUREMENT
 /begin LOC_MEASUREMENT B_bztafx B_etafix B_fztafx B_hztanl B_kpl B_llhzta B_lltafx B_no_pl_err B_no_si_err B_plaus B_pl_err B_si_err B_ztafix tamax tamin zfzptafx zllptafx /end LOC_MEASUREMENT
/end FUNCTION
/begin FUNCTION GGTFM "46.61"
 /begin DEF_CHARACTERISTIC AFZBKLH AFZBKLN CWKONGTM CW_TABST DTMABDTMN DTMDMA DTMDNPO DTMDZG DTMRESDZG DTMSRT FABSTT KFDTMRS KFDTMTE KFDTMTR KFDTMTU KLDTMFXTM KLITHMS KLTHMDTMS MLOBKLHV MLOBKLNV MLUBKLHV MLUBKLNV TABSMADTM TADMM TANDT1 TANH1 TDBKLOFF TDTM TDTMMA TDTMNP TDTMNPO TDTMPOG TMABDTMN TMDMMA TMDMMAT TMDMMAU TMDMMEE TMDMMER TMDMN TMDMX TMDZGMN TMELIPU1 TMESSCMN TMMXRT TMOTELI TMPUPOFF TMPUPON TMSSSCO TMSSSCU TNLETM TNSRT TUMDETM TWBKLHOF TWBKLHON TWBKLNOF TWBKLNON TWRDZGMX TWSSCTM TWTMNHST UBMNPUP VBKLHO VBKLHU VBKLNO VBKLNU ZKTMLINSS /end DEF_CHARACTERISTIC
 /begin IN_MEASUREMENT B_abstgp B_abstnlgp B_auakt B_hst B_kl15 B_nletm B_nmin B_nmot B_pwf B_sa B_st B_stend imlatm ml tabst_w tans tansab tmki ubsq vfzg wtmot_w /end IN_MEASUREMENT
 /begin OUT_MEASUREMENT B_tmmn B_tmsrt korrfak tmew tmewab tmlinmax tmlinmin tmlinvdzg tmot tmotab tmotlin tmotlinab tmotlinlp tmotlinst tmotlin_w tmotvt tmrw tmrwend tmsnp tmst tumginp /end OUT_MEASUREMENT
 /begin LOC_MEASUREMENT B_hsttwt B_klh B_kln B_nputm B_pullup B_pullupsw B_tmdzg B_znptm B_zsitm mll1 /end LOC_MEASUREMENT
/end FUNCTION
/begin FUNCTION GGTKA "5.10" /begin DEF_CHARACTERISTIC TDTKAUS TKAELI TKAUSDE TKAUSDMN TKAUSDMX /end DEF_CHARACTERISTIC /begin IN_MEASUREMENT wtka /end IN_MEASUREMENT /begin OUT_MEASUREMENT tka tkalin /end OUT_MEASUREMENT /end FUNCTION
/begin FUNCTION GGUB "11.60"
 /begin DEF_CHARACTERISTIC TDNSUB TDUB UBDE UBDMN1 UBDMN2 UBDMN3 UBDMX UBNACHL VMDUB ZKUBSQF01 ZKUBSQF10 /end DEF_CHARACTERISTIC
 /begin IN_MEASUREMENT B_stend B_ubrk ubrsq_w vfzg wub_w /end IN_MEASUREMENT
 /begin OUT_MEASUREMENT ub ubsq ubsqf ubsqf_w ubsq_w wubiso_w /end OUT_MEASUREMENT
/end FUNCTION
/begin FUNCTION GGUBR "1.110"
 /begin DEF_CHARACTERISTIC CWKVHR TDAPTUBR TDHREVAB TDRNLUBR TDUBR TDUBRNL TWDUBRNL UBRDMN1 UBRDMN2 UBRDMX UBRDUNL /end DEF_CHARACTERISTIC
 /begin IN_MEASUREMENT B_nldve B_nlsgls B_nlubr B_nmin ei_ubr_um wubr_w /end IN_MEASUREMENT
 /begin OUT_MEASUREMENT B_dnlubr B_dubre B_hrevab B_hrkng B_hrkzlg B_kdhre B_ubrdmn1 B_ubrdmn2 B_ubrk B_ubrmax B_ubru GGUBRausbits ubrsq ubrsqf ubrsqf_w ubrsqka ubrsqke ubrsq_w /end OUT_MEASUREMENT
/end FUNCTION
/begin FUNCTION GGVFZG "14.70"
 /begin DEF_CHARACTERISTIC AIMVM CWGGVFZG DVFZBEG TFGRVRAB VFZMN VFZR1O VFZR1U VFZR2O VFZR2U VRFGRMN ZFBFZGL ZFCNT1 ZFCNT2 ZFV /end DEF_CHARACTERISTIC
 /begin IN_MEASUREMENT B_cankbi vamsr_w vfzgkb_w /end IN_MEASUREMENT
 /begin OUT_MEASUREMENT bfzgl_b bfzgl_w B_vnull dist_w vfgr_w vfzg vfzg_w vfzroh_w zfcnt /end OUT_MEASUREMENT
 /begin LOC_MEASUREMENT vfil_w vroh_w /end LOC_MEASUREMENT
/end FUNCTION
/begin FUNCTION GGZDGON "1.30" /begin DEF_CHARACTERISTIC TUBKL15 UBKL15 /end DEF_CHARACTERISTIC /begin IN_MEASUREMENT S_kl15 wub /end IN_MEASUREMENT /begin OUT_MEASUREMENT B_kl15 /end OUT_MEASUREMENT /end FUNCTION
/begin FUNCTION GK "13.50" /begin DEF_CHARACTERISTIC KFBS /end DEF_CHARACTERISTIC /begin REF_CHARACTERISTIC CWWL /end REF_CHARACTERISTIC
 /begin IN_MEASUREMENT B_stendes fgru fnswl_w fr2_w fra2_w fra_w fr_w fst_w fwe lamns_w lamsbg2_w lamsbg_w nmot rka2_w rka_w rkte_w rkukg_w rl rlp_w /end IN_MEASUREMENT
 /begin OUT_MEASUREMENT rk2_w rkg2_w rkg_w rk_w rllaso2_w rllaso_w /end OUT_MEASUREMENT
 /begin LOC_MEASUREMENT fvst_w /end LOC_MEASUREMENT
/end FUNCTION
/begin FUNCTION GKLDFHW "" /begin REF_CHARACTERISTIC DFMPERIOMX /end REF_CHARACTERISTIC /begin IN_MEASUREMENT B_kldfact P_KLDF tcclkldf_w tccpkldf_w /end IN_MEASUREMENT /begin OUT_MEASUREMENT dfmlow_w dfmperio_w pwmstate /end OUT_MEASUREMENT /end FUNCTION
/begin FUNCTION Hash "" /begin LOC_MEASUREMENT ctr_MD5Block /end LOC_MEASUREMENT /end FUNCTION
/begin FUNCTION HLSHK "3.30"
 /begin DEF_CHARACTERISTIC PHLSNHMN TANHKMMN THHA THHA2 THHAWU THSHA THSHKTK THSHKTK2 TVHSH UBHS UHSN /end DEF_CHARACTERISTIC
 /begin IN_MEASUREMENT B_atmtpk B_atmtpk2 B_atmtpl B_atmtpl2 B_stend tanhkm2_w tanhkm_w ub /end IN_MEASUREMENT
 /begin OUT_MEASUREMENT B_hsha B_hsha2 B_hshe B_hshe2 phlsnh phlsnh2 /end OUT_MEASUREMENT
 /begin LOC_MEASUREMENT B_enhlshk B_rehs thhaist thhaist2 thhat thhat2 /end LOC_MEASUREMENT
/end FUNCTION
/begin FUNCTION HRLSU "4.140"
 /begin DEF_CHARACTERISTIC DPRHLSU DTKLSUSTA DTKLSUSTB KDHRLSU KIHRLSU KLPRHLSU KPHRLSU PRHLSUL TABSTRILSU THLSUHR THLSUHRST TKERLSUS TKERLSUST /end DEF_CHARACTERISTIC
 /begin IN_MEASUREMENT B_atmtpa B_atmtpa2 B_ehlsu B_ehlsu2 B_eiclsu B_eiclsu2 B_elsuwi B_elsuwi2 B_hrlsaus B_nmot B_rinabg B_rinabg2 B_spf3k B_spf3k2 B_stend tabst_w tatuk_w tkerlsu2_w tkerlsu_w /end IN_MEASUREMENT
 /begin OUT_MEASUREMENT B_eshlsu B_eshlsu2 B_henrin B_henrin2 B_hlsumx B_hlsumx2 B_hstlsua B_hstlsua2 B_hstlsub B_hstlsub2 B_hsv B_hsv2 hrlsuAusBits hrlsuAusBits_2 prhlsub2_w prhlsub_w prhrlsu2_w prhrlsu_w rdtklsu2_w rdtklsu_w /end OUT_MEASUREMENT
 /begin LOC_MEASUREMENT B_hlsuaru B_hlsuaru2 B_sphrlsu B_sphrlsu2 B_tablsugr hrlsuLokBits hrlsuLokBits_2 iintpid2_w iintpid_w phlsuri2_w phlsuri_w prhlsud2_w prhlsud_w prhlsui2_w prhlsuin_w prhlsui_w prhlsup2_w prhlsup_w prhlsur2_w prhlsur_w /end LOC_MEASUREMENT
/end FUNCTION
/begin FUNCTION HT2KTLSU "1.20"
 /begin IN_MEASUREMENT B_diagia B_diagia2 B_enscun B_enscun2 B_fklanf B_fklanf2 B_hrlsaus B_iclsabg B_iclsabg2 B_nmot B_pusab B_pusab2 B_rinabg B_rinabg2 B_spf3k B_spf3k2 B_stend iprefanf iprefanf2 /end IN_MEASUREMENT
 /begin OUT_MEASUREMENT B_ci2cjx B_ci2cjx2 B_cicjx B_cicjx2 B_hsvemn B_hsvemn2 B_hsvemx B_hsvemx2 B_hsvesi B_hsvesi2 B_lsuiamn B_lsuiamn2 B_lsuiamx B_lsuiamx2 B_lsuicif B_lsuicif2 B_lsuickf B_lsuickf2 B_lsuube B_lsuube2 B_lsuunmn B_lsuunmn2 B_lsuunmx B_lsuunmx2 B_lsuvmmn B_lsuvmmn2 B_lsuvmmx B_lsuvmmx2 B_rcjx B_rcjx2 /end OUT_MEASUREMENT
 /begin LOC_MEASUREMENT B_mn_hsve B_mn_hsve2 B_mn_ia B_mn_ia2 B_mn_un B_mn_un2 B_mn_vm B_mn_vm2 B_mx_hsve B_mx_hsve2 B_mx_ia B_mx_ia2 B_mx_un B_mx_un2 B_mx_vm B_mx_vm2 B_si_hsve B_si_hsve2 diacjx diacjx2 ini2cjx ini2cjx2 inicjx inicjx2 statcjx statcjx2 /end LOC_MEASUREMENT
/end FUNCTION
/begin FUNCTION HWADC ""
 /begin OUT_MEASUREMENT iUipoti1_w iUipoti2_w iUspoti1_w iUspoti2_w uagrvh_w udbuk_w udkp1v_w udkp1_w udkp2_w udsu_w uhfm2_w uhfm_w ulbkist_w upwg1_w upwg2_w urinlsu2_w urinlsu_w uulsuv2_w uulsuv_w uushk2_w uushk_w u_immo wtans wtka wtmot_w wub wubr wubr_w wub_w wuhr /end OUT_MEASUREMENT
/end FUNCTION
/begin FUNCTION HWDIG_AS "" /begin REF_CHARACTERISTIC TTVLU1MX TTVLU2MX TVLU1MN TVLU2MN /end REF_CHARACTERISTIC
 /begin IN_MEASUREMENT B_abkl B_bkvp B_hlon B_hshe B_hshe2 B_iclsabg B_iclsabg2 B_kov B_mil B_nlel B_priph B_priph2 B_pripv B_pripv2 B_pullup B_slp B_slv B_su B_su2 B_zwp S_hds tahrlsu2_w tahrlsu_w tphrlsu_w tvkmtr tvlues1 tvlues2 /end IN_MEASUREMENT
 /begin OUT_MEASUREMENT B_ldpi P_ats P_ats2 P_crsh P_KLDF P_swe S_ac S_bls S_brs S_fgrat S_fgrhs S_fgrsv S_fgrwb S_ko S_kupp S_tal /end OUT_MEASUREMENT
/end FUNCTION
/begin FUNCTION HWDIG_FR "" /begin REF_CHARACTERISTIC CWSTAKD2 /end REF_CHARACTERISTIC /begin IN_MEASUREMENT B_abkl B_ekp S_hds tanwra tanwraa tanwre tanwrea tvkmtr /end IN_MEASUREMENT /begin OUT_MEASUREMENT B_dcff B_dveeson S_kl15 /end OUT_MEASUREMENT /end FUNCTION
/begin FUNCTION HWSNWS "" /end FUNCTION
/begin FUNCTION HWTEV "" /begin IN_MEASUREMENT B_tevtstp tateout tevper /end IN_MEASUREMENT /begin OUT_MEASUREMENT B_tevtini /end OUT_MEASUREMENT /end FUNCTION
/begin FUNCTION K71EXT "" /begin IN_MEASUREMENT fcmEnd /end IN_MEASUREMENT /end FUNCTION
/begin FUNCTION K71MN "" /begin DEF_CHARACTERISTIC TIDLEMAX TIDLEMIN /end DEF_CHARACTERISTIC
 /begin IN_MEASUREMENT B_fa B_fgrte B_grdst B_kstebf B_lrndia B_nachl B_stend nmot_w /end IN_MEASUREMENT
 /begin OUT_MEASUREMENT B_0101_ack B_0101_ident B_0101_notadr B_0101_switch kwp71_bits /end OUT_MEASUREMENT
 /begin LOC_MEASUREMENT t_idle_ctr /end LOC_MEASUREMENT
/end FUNCTION
/begin FUNCTION K71SR ""
 /begin REF_CHARACTERISTIC AAGOFLOGIN AAGONLOGIN ADRONLOGIN GRAOFLOGIN GRAONLOGIN HLOFFLOGIN HLONLOGIN KLOGIN LFWOFLOGIN LFWONLOGIN LUEN1LOGIN LUEN2LOGIN LUEN3LOGIN SGIDB1 SGIDB2 SGIDB3 SLOGIN VARDEF /end REF_CHARACTERISTIC
 /begin IN_MEASUREMENT B_0101_ack B_0101_ident B_0101_switch B_acc B_accen B_fgrte B_hlon B_luef1 B_luef2 B_luef3 kwp71_bits nmot_w /end IN_MEASUREMENT
/end FUNCTION
/begin FUNCTION KDATR ""
 /begin REF_CHARACTERISTIC AAGOFLOGIN AAGONLOGIN ADRONLOGIN GRAOFLOGIN GRAONLOGIN HLOFFLOGIN HLONLOGIN KLOGIN LFWOFLOGIN LFWONLOGIN LUEN1LOGIN LUEN2LOGIN LUEN3LOGIN SLOGIN /end REF_CHARACTERISTIC
 /begin IN_MEASUREMENT B_acc B_accen B_fgrte B_grdst B_hlon B_kl15 B_luef1 B_luef2 B_luef3 nmot_w /end IN_MEASUREMENT
 /begin OUT_MEASUREMENT B_neucode /end OUT_MEASUREMENT
/end FUNCTION
/begin FUNCTION KDIAG "" /begin DEF_CHARACTERISTIC SGIDB4 SGIDB5 SGIDB6 SGIDB7 SGIDK1_DAT /end DEF_CHARACTERISTIC
 /begin REF_CHARACTERISTIC ADRONLOGIN GRAOFLOGIN GRAONLOGIN KLOGIN SGIDB1 SGIDB2 SGIDB3 SLOGIN VARDEF /end REF_CHARACTERISTIC
 /begin IN_MEASUREMENT B_acc B_accen B_fgrte B_fpwld_ok B_kl15 B_nachl B_pwf nmot_w /end IN_MEASUREMENT
 /begin OUT_MEASUREMENT B_fpwld B_JumpRamOK B_SeedSent /end OUT_MEASUREMENT
/end FUNCTION
/begin FUNCTION keycheck "" /end FUNCTION
/begin FUNCTION KHMD "1.100"
 /begin DEF_CHARACTERISTIC CWKHMD FMDKHFH FMDKHTMST FMDPUBKV KFKWTMP KFMDDSLAD KFMDDSLFA KFMDKH KFMDKHLL ZKBKVAB ZKMDKH /end DEF_CHARACTERISTIC
 /begin IN_MEASUREMENT B_bkvleer B_dsl4 B_fasla B_kh B_kw B_ll dmllri_w fho_w fmdkh mifa_w nmot_w pubkv_w tmst /end IN_MEASUREMENT
 /begin OUT_MEASUREMENT dmrdsls_w dmrkh dmrkh_w /end OUT_MEASUREMENT
 /begin LOC_MEASUREMENT dmrkhz_w drkwtmp_w fmkhfho_w fmkhtmst mifakh_w mulres_w /end LOC_MEASUREMENT
/end FUNCTION
/begin COMPU_METHOD bfzg_sb_q0p217 "" RAT_FUNC "%6.3" "m/s^2" COEFFS 0 1 0 0 0 0.217 /end COMPU_METHOD
/begin COMPU_METHOD bfzg_sw_q4p239Em4 "" RAT_FUNC "%10.7" "m/s^2" COEFFS 0 1 0 0 0 0.0004239 /end COMPU_METHOD
/begin COMPU_METHOD B_TRUE "" TAB_VERB "%6.3" "" COMPU_TAB_REF B_TRUE /end COMPU_METHOD
/begin COMPU_VTAB B_TRUE "" TAB_VERB 2 0 "----" 1 "TRUE" /end COMPU_VTAB
/begin COMPU_METHOD DEZ "" RAT_FUNC "%6.2" "" COEFFS 0 1 0 0 0 1 /end COMPU_METHOD
/begin COMPU_METHOD dez "" RAT_FUNC "%6.2" "" COEFFS 0 1 0 0 0 1 /end COMPU_METHOD
/begin COMPU_METHOD dezsub1 "" RAT_FUNC "%6.2" "-" COEFFS 0 1 -1 0 0 1 /end COMPU_METHOD
/begin COMPU_METHOD dgrad_uw_q0p015 "" RAT_FUNC "%6.4" "hPa/V" COEFFS 0 65536 0 0 0 1024 /end COMPU_METHOD
/begin COMPU_METHOD dist_uw_q0p1 "" RAT_FUNC "%6.3" "-" COEFFS 0 10 0 0 0 1 /end COMPU_METHOD
/begin COMPU_METHOD fak_q0p000122 "" RAT_FUNC "%6.5" "1/(g*s)" COEFFS 0 65536 0 0 0 8 /end COMPU_METHOD
/begin COMPU_METHOD fak_sb_b0p25 "" RAT_FUNC "%6.4" "-" COEFFS 0 256 0 0 0 0.5 /end COMPU_METHOD
/begin COMPU_METHOD fak_ub_b1 "" RAT_FUNC "%6.4" "-" COEFFS 0 256 0 0 0 1 /end COMPU_METHOD
/begin COMPU_METHOD fak_ub_b16 "" RAT_FUNC "%6.4" "-" COEFFS 0 256 0 0 0 16 /end COMPU_METHOD
/begin COMPU_METHOD fak_ub_b2 "" RAT_FUNC "%6.4" "-" COEFFS 0 256 0 0 0 2 /end COMPU_METHOD
/begin COMPU_METHOD fak_ub_b4 "" RAT_FUNC "%6.4" "-" COEFFS 0 256 0 0 0 4 /end COMPU_METHOD
/begin COMPU_METHOD fak_ub_q0p01 "" RAT_FUNC "%6.4" "-" COEFFS 0 1 0 0 0 0.01 /end COMPU_METHOD
/begin COMPU_METHOD fak_uw_b1 "" RAT_FUNC "%7.6" "-" COEFFS 0 65536 0 0 0 1 /end COMPU_METHOD
/begin COMPU_METHOD fak_uw_b16 "" RAT_FUNC "%6.5" "-" COEFFS 0 65536 0 0 0 16 /end COMPU_METHOD
/begin COMPU_METHOD fak_uw_b2 "" RAT_FUNC "%7.6" "-" COEFFS 0 65536 0 0 0 2 /end COMPU_METHOD
/begin COMPU_METHOD fak_uw_b4 "" RAT_FUNC "%7.6" "-" COEFFS 0 65536 0 0 0 4 /end COMPU_METHOD
/begin COMPU_METHOD fak_uw_b64 "" RAT_FUNC "%6.5" "-" COEFFS 0 65536 0 0 0 64 /end COMPU_METHOD
/begin COMPU_METHOD fak_uw_b8 "" RAT_FUNC "%6.5" "-" COEFFS 0 65536 0 0 0 8 /end COMPU_METHOD
/begin COMPU_METHOD fak_uw_q0p001 "" RAT_FUNC "%6.5" "-" COEFFS 0 65536 0 0 0 65.536 /end COMPU_METHOD
/begin COMPU_METHOD fmfkr_dez "" RAT_FUNC "%6.2" "kHz" COEFFS 0 1 0 0 0 1 /end COMPU_METHOD
/begin COMPU_METHOD grd_q1_ms "" RAT_FUNC "%6.2" "1 / ms" COEFFS 0 1 0 0 0 1 /end COMPU_METHOD
/begin COMPU_METHOD ispg_q0p25 "" RAT_FUNC "%6.3" "uA/V" COEFFS 0 4 0 0 0 1 /end COMPU_METHOD
/begin COMPU_METHOD i_q0p125_uA "" RAT_FUNC "%6.3" "uA" COEFFS 0 8 0 0 0 1 /end COMPU_METHOD
/begin COMPU_METHOD i_q1_uA "" RAT_FUNC "%6.2" "uA" COEFFS 0 1 0 0 0 1 /end COMPU_METHOD
/begin COMPU_METHOD kw_q0p0039 "" RAT_FUNC "%6.4" "Grad KW" COEFFS 0 256 0 0 0 1 /end COMPU_METHOD
/begin COMPU_METHOD kw_q0p0078 "" RAT_FUNC "%6.4" "Grad KW" COEFFS 0 128 0 0 0 1 /end COMPU_METHOD
/begin COMPU_METHOD kw_q0p0156 "" RAT_FUNC "%6.4" "Grad KW" COEFFS 0 64 0 0 0 1 /end COMPU_METHOD
/begin COMPU_METHOD kw_q0p0625 "" RAT_FUNC "%6.4" "Grad KW" COEFFS 0 16 0 0 0 1 /end COMPU_METHOD
/begin COMPU_METHOD kw_q1 "" RAT_FUNC "%6.2" "Grad KW" COEFFS 0 1 0 0 0 1 /end COMPU_METHOD
/begin COMPU_METHOD kw_tooth_sy "" RAT_FUNC "%6.2" "°KW" COEFFS 0 0.166666666666667 0 0 0 1 /end COMPU_METHOD
/begin COMPU_METHOD m_sw_b3276p8 "" RAT_FUNC "%6.3" "kg/h" COEFFS 0 1 0 0 0 0.1 /end COMPU_METHOD
/begin COMPU_METHOD m_ub_b1020 "" RAT_FUNC "%6.2" "kg/h" COEFFS 0 1 0 0 0 4 /end COMPU_METHOD
/begin COMPU_METHOD m_ub_b23p3 "" RAT_FUNC "%6.3" "kg" COEFFS 0 2812.5 0 0 0 256 /end COMPU_METHOD
/begin COMPU_METHOD m_uw_b6553p5 "" RAT_FUNC "%6.3" "kg/h" COEFFS 0 1 0 0 0 0.1 /end COMPU_METHOD
/begin COMPU_METHOD nmot_ub_q40 "" RAT_FUNC "%6.1" "1/min" COEFFS 0 1 0 0 0 40 /end COMPU_METHOD
/begin COMPU_METHOD nmot_uw_q0p25 "" RAT_FUNC "%6.3" "1/min" COEFFS 0 1 0 0 0 0.25 /end COMPU_METHOD
/begin COMPU_METHOD pgrad_q0p039 "" RAT_FUNC "%6.4" "hPa/s" COEFFS 0 128 0 0 0 5 /end COMPU_METHOD
/begin COMPU_METHOD pgrad_q0p15625 "" RAT_FUNC "%6.3" "hPa/s" COEFFS 0 32 0 0 0 5 /end COMPU_METHOD
/begin COMPU_METHOD p_sw_q0p039 "" RAT_FUNC "%6.4" "hPa" COEFFS 0 256 0 0 0 10 /end COMPU_METHOD
/begin COMPU_METHOD p_ub_q10 "" RAT_FUNC "%6.1" "hPa" COEFFS 0 1 0 0 0 10 /end COMPU_METHOD
/begin COMPU_METHOD p_ub_q5 "" RAT_FUNC "%6.2" "hPa" COEFFS 0 1 0 0 0 5 /end COMPU_METHOD
/begin COMPU_METHOD p_uw_q0p039 "" RAT_FUNC "%6.4" "hPa" COEFFS 0 256 0 0 0 10 /end COMPU_METHOD
/begin COMPU_METHOD relDK_q0p02441 "" RAT_FUNC "%6.4" "%DK" COEFFS 0 65536 0 0 0 1600 /end COMPU_METHOD
/begin COMPU_METHOD relDK_ub_b100 "" RAT_FUNC "%6.3" "%DK" COEFFS 0 255 0 0 0 100 /end COMPU_METHOD
/begin COMPU_METHOD relO2_q9p765Em4 "" RAT_FUNC "%6.5" "% O2" COEFFS 0 1024 0 0 0 1 /end COMPU_METHOD
/begin COMPU_METHOD relPED_q0p00153 "" RAT_FUNC "%6.4" "% PED" COEFFS 0 65535 0 0 0 100 /end COMPU_METHOD
/begin COMPU_METHOD relPED_ub_b100 "" RAT_FUNC "%6.3" "%PED" COEFFS 0 255 0 0 0 100 /end COMPU_METHOD
/begin COMPU_METHOD reltemp_q2p543Em4 "" RAT_FUNC "%6.5" "%/K" COEFFS 0 98304 0 0 0 25 /end COMPU_METHOD
/begin COMPU_METHOD reltemp_q5p086Em4 "" RAT_FUNC "%6.5" "%/K" COEFFS 0 49152 0 0 0 25 /end COMPU_METHOD
/begin COMPU_METHOD rel_q0p0061 "" RAT_FUNC "%6.4" "%" COEFFS 0 65536 0 0 0 400 /end COMPU_METHOD
/begin COMPU_METHOD rel_q0p39 "" RAT_FUNC "%6.3" "%" COEFFS 0 256 0 0 0 100 /end COMPU_METHOD
/begin COMPU_METHOD rel_sw_b100 "" RAT_FUNC "%6.4" "%" COEFFS 0 32768 0 0 0 100 /end COMPU_METHOD
/begin COMPU_METHOD rel_sw_b50 "" RAT_FUNC "%6.4" "%" COEFFS 0 65536 0 0 0 100 /end COMPU_METHOD
/begin COMPU_METHOD rel_ub_b100 "" RAT_FUNC "%6.3" "%" COEFFS 0 256 0 0 0 100 /end COMPU_METHOD
/begin COMPU_METHOD rel_ub_b99p6 "" RAT_FUNC "%6.3" "%" COEFFS 0 256 0 0 0 100 /end COMPU_METHOD
/begin COMPU_METHOD rel_ub_q0p75 "" RAT_FUNC "%6.3" "%" COEFFS 0 1 0 0 0 0.75 /end COMPU_METHOD
/begin COMPU_METHOD rel_uw_b100 "" RAT_FUNC "%6.4" "%" COEFFS 0 65536 0 0 0 100 /end COMPU_METHOD
/begin COMPU_METHOD rel_uw_b200 "" RAT_FUNC "%6.4" "%" COEFFS 0 65536 0 0 0 200 /end COMPU_METHOD
/begin COMPU_METHOD rel_uw_b3072 "" RAT_FUNC "%6.4" "%" COEFFS 0 65536 0 0 0 3072 /end COMPU_METHOD
/begin COMPU_METHOD rel_uw_q0p0234 "" RAT_FUNC "%6.4" "%" COEFFS 0 32 0 0 0 0.75 /end COMPU_METHOD
/begin COMPU_METHOD rpspg_q0p0156 "" RAT_FUNC "%6.4" "Ohm/V" COEFFS 0 65536 0 0 0 1024 /end COMPU_METHOD
/begin COMPU_METHOD r_q0p0391 "" RAT_FUNC "%6.4" "Ohm" COEFFS 0 65536 0 0 0 2560 /end COMPU_METHOD
/begin COMPU_METHOD r_uw_q2 "" RAT_FUNC "%6.2" "Ohm" COEFFS 0 1 0 0 0 2 /end COMPU_METHOD
/begin COMPU_METHOD spg_q0p00039 "" RAT_FUNC "%6.5" "V" COEFFS 0 1 0 0 0 0.000390625 /end COMPU_METHOD
/begin COMPU_METHOD spg_q0p001 "" RAT_FUNC "%6.5" "V" COEFFS 0 1000 0 0 0 1 /end COMPU_METHOD
/begin COMPU_METHOD spg_q0p00488 "" RAT_FUNC "%6.4" "V" COEFFS 0 1024 0 0 0 5 /end COMPU_METHOD
/begin COMPU_METHOD spg_q0p1 "" RAT_FUNC "%6.3" "V" COEFFS 0 1 0 0 0 0.1 /end COMPU_METHOD
/begin COMPU_METHOD spg_q1p22Em4 "" RAT_FUNC "%6.5" "V" COEFFS 0 65536 0 0 0 8 /end COMPU_METHOD
/begin COMPU_METHOD spg_q4p88Em4 "" RAT_FUNC "%6.5" "V" COEFFS 0 2048 0 0 0 1 /end COMPU_METHOD
/begin COMPU_METHOD spg_sw_q0p00488 "" RAT_FUNC "%6.4" "V" COEFFS 0 1024 0 0 0 5 /end COMPU_METHOD
/begin COMPU_METHOD spg_ubatt "" RAT_FUNC "%6.4" "V" COEFFS 0 1 0 0 0 0.0704 /end COMPU_METHOD
/begin COMPU_METHOD spg_ubatt_sy "" RAT_FUNC "%6.4" "V" COEFFS 0 14.2222222222222 0 0 0 1 /end COMPU_METHOD
/begin COMPU_METHOD spg_ubatt_w "" RAT_FUNC "%6.4" "V" COEFFS 0 1 0 0 0 0.0176 /end COMPU_METHOD
/begin COMPU_METHOD spg_ubatt_w_sy "" RAT_FUNC "%6.4" "V" COEFFS 0 56.8888888888889 0 0 0 1 /end COMPU_METHOD
/begin COMPU_METHOD spg_ub_b28p5 "" RAT_FUNC "%6.3" "V" COEFFS 0 1 0 0 0 0.1113 /end COMPU_METHOD
/begin COMPU_METHOD spg_ub_b28p5_w "" RAT_FUNC "%6.4" "V" COEFFS 0 1 0 0 0 0.027825 /end COMPU_METHOD
/begin COMPU_METHOD spg_ub_b5 "" RAT_FUNC "%6.4" "V" COEFFS 0 256 0 0 0 5 /end COMPU_METHOD
/begin COMPU_METHOD spg_ub_q0p0052_o0p2 "" RAT_FUNC "%6.3" "V" COEFFS 0 255 51 0 0 1.33 /end COMPU_METHOD
/begin COMPU_METHOD spg_ub_q0p019 "" RAT_FUNC "%6.4" "V" COEFFS 0 256 0 0 0 5 /end COMPU_METHOD
/begin COMPU_METHOD spg_uw_b5 "" RAT_FUNC "%6.4" "V" COEFFS 0 1024 0 0 0 5 /end COMPU_METHOD
/begin COMPU_METHOD spg_uw_q0p001222 "" RAT_FUNC "%6.4" "V" COEFFS 0 65536 0 0 0 80 /end COMPU_METHOD
/begin COMPU_METHOD spg_uw_q0p00488 "" RAT_FUNC "%6.4" "V" COEFFS 0 1024 0 0 0 5 /end COMPU_METHOD
/begin COMPU_METHOD spg_uw_q0p00488_o1 "" RAT_FUNC "%6.3" "V" COEFFS 0 1024 1024 0 0 5 /end COMPU_METHOD
/begin COMPU_METHOD t100msxs_ub_b25p5 "" RAT_FUNC "%6.3" "s" COEFFS 0 1 0 0 0 0.1 /end COMPU_METHOD
/begin COMPU_METHOD t100msxs_uw_b6553p5 "" RAT_FUNC "%6.3" "s" COEFFS 0 1 0 0 0 0.1 /end COMPU_METHOD
/begin COMPU_METHOD t10msxs_q0p01_o0p05 "" RAT_FUNC "%6.4" "s" COEFFS 0 1 0.05 0 0 0.01 /end COMPU_METHOD
/begin COMPU_METHOD t10msxs_ub_b2p55 "" RAT_FUNC "%6.4" "s" COEFFS 0 1 0 0 0 0.01 /end COMPU_METHOD
/begin COMPU_METHOD t10msxs_uw_b655p35 "" RAT_FUNC "%6.4" "s" COEFFS 0 1 0 0 0 0.01 /end COMPU_METHOD
/begin COMPU_METHOD t1msxms_q1 "" RAT_FUNC "%6.2" "ms" COEFFS 0 1 0 0 0 1 /end COMPU_METHOD
/begin COMPU_METHOD t1sxs_ub_b255 "" RAT_FUNC "%6.2" "s" COEFFS 0 1 0 0 0 1 /end COMPU_METHOD
/begin COMPU_METHOD t1sxs_uw_q1 "" RAT_FUNC "%6.2" "s" COEFFS 0 1 0 0 0 1 /end COMPU_METHOD
/begin COMPU_METHOD t200msxs_uw_q0p2 "" RAT_FUNC "%6.3" "s" COEFFS 0 1 0 0 0 0.2 /end COMPU_METHOD
/begin COMPU_METHOD t20msxs_ub_b5p1 "" RAT_FUNC "%6.4" "s" COEFFS 0 1 0 0 0 0.02 /end COMPU_METHOD
/begin COMPU_METHOD t20msxs_uw_b1310 "" RAT_FUNC "%6.4" "s" COEFFS 0 1 0 0 0 0.02 /end COMPU_METHOD
/begin COMPU_METHOD t20msxs_uw_q0p02 "" RAT_FUNC "%6.4" "s" COEFFS 0 1 0 0 0 0.02 /end COMPU_METHOD
/begin COMPU_METHOD t50msxs_q0p05 "" RAT_FUNC "%6.4" "s" COEFFS 0 1 0 0 0 0.05 /end COMPU_METHOD
/begin COMPU_METHOD t50msxs_ub_b12p75 "" RAT_FUNC "%6.4" "s" COEFFS 0 1 0 0 0 0.05 /end COMPU_METHOD
/begin COMPU_METHOD temp_q0p0234 "" RAT_FUNC "%6.4" "K" COEFFS 0 256 0 0 0 6 /end COMPU_METHOD
/begin COMPU_METHOD temp_q0p0234_o273 "" RAT_FUNC "%6.1" "Grad C" COEFFS 0 1 273.15 0 0 0.0234375 /end COMPU_METHOD
/begin COMPU_METHOD temp_sb_b0p093 "" RAT_FUNC "%6.5" "Grad C" COEFFS 0 512 0 0 0 0.375 /end COMPU_METHOD
/begin COMPU_METHOD temp_ub_b191p25 "" RAT_FUNC "%6.3" "Grad C" COEFFS 0 1 0 0 0 0.75 /end COMPU_METHOD
/begin COMPU_METHOD temp_ub_q0p75_o48 "" RAT_FUNC "%6.2" "Grad C" COEFFS 0 1 48 0 0 0.75 /end COMPU_METHOD
/begin COMPU_METHOD temp_uw_q0p0029_o48 "" RAT_FUNC "%6.2" "Grad C" COEFFS 0 256 12288 0 0 0.75 /end COMPU_METHOD
/begin COMPU_METHOD tinjection_sy "" RAT_FUNC "%6.4" "ms" COEFFS 0 312.5 0 0 0 1 /end COMPU_METHOD
/begin COMPU_METHOD tknockcon_sy "" RAT_FUNC "%8.7" "s" COEFFS 0 312500 0 0 0 1 /end COMPU_METHOD
/begin COMPU_METHOD tknockintgrad_sy "" RAT_FUNC "%6.3" "V/s" COEFFS 0 10.738255033557 0 0 0 1 /end COMPU_METHOD
/begin COMPU_METHOD t_q0p001 "" RAT_FUNC "%6.5" "s" COEFFS 0 1000 0 0 0 1 /end COMPU_METHOD
/begin COMPU_METHOD t_q0p01 "" RAT_FUNC "%6.4" "s" COEFFS 0 100 0 0 0 1 /end COMPU_METHOD
/begin COMPU_METHOD t_q0p1 "" RAT_FUNC "%6.3" "s" COEFFS 0 10 0 0 0 1 /end COMPU_METHOD
/begin COMPU_METHOD t_q16us "" RAT_FUNC "%6.1" "us" COEFFS 0 1 0 0 0 16 /end COMPU_METHOD
/begin COMPU_METHOD vfzg_ub_q1p25 "" RAT_FUNC "%6.2" "km/h" COEFFS 0 1 0 0 0 1.25 /end COMPU_METHOD
/begin COMPU_METHOD vfzg_uw_b512 "" RAT_FUNC "%6.4" "km/h" COEFFS 0 65536 0 0 0 512 /end COMPU_METHOD
/begin COMPU_METHOD vfzg_uw_q0p00781 "" RAT_FUNC "%6.4" "km/h" COEFFS 0 1 0 0 0 0.0078125 /end COMPU_METHOD
/begin COMPU_METHOD vol_q1_l "" RAT_FUNC "%6.2" "l" COEFFS 0 1 0 0 0 1 /end COMPU_METHOD
/begin COMPU_METHOD zk100msxs_ub_b25p5 "" RAT_FUNC "%6.3" "s" COEFFS 0 0 256 0 10 0 /end COMPU_METHOD
/begin COMPU_METHOD zk100msxs_uw_b6553 "" RAT_FUNC "%6.1" "s" COEFFS 0 0 65536 0 10 0 /end COMPU_METHOD
/begin COMPU_METHOD zk10msxs_ub_b2p55 "" RAT_FUNC "%6.4" "s" COEFFS 0 0 255 0 100 0 /end COMPU_METHOD
/begin COMPU_METHOD zk10msxs_uw_b655 "" RAT_FUNC "%6.2" "s" COEFFS 0 0 65536 0 100 0 /end COMPU_METHOD
/begin COMPU_METHOD zk20msxs_uw_b1310 "" RAT_FUNC "%12.4" "s" COEFFS 0 0 65536 0 50 0 /end COMPU_METHOD
/begin COMPU_METHOD zk50msxs_ub_b12p8 "" RAT_FUNC "%6.3" "s" COEFFS 0 0 256 0 20 0 /end COMPU_METHOD
/begin COMPU_METHOD zw_ub_q0p75 "" RAT_FUNC "%6.3" "Grad KW" COEFFS 0 255 0 0 0 191.25 /end COMPU_METHOD
/begin COMPU_METHOD defaultAscii "" RAT_FUNC "%6.2" "" COEFFS 0 1 0 0 0 1 /end COMPU_METHOD
/begin RECORD_LAYOUT FklWUw FNC_VALUES 1 UWORD COLUMN_DIR DIRECT /end RECORD_LAYOUT
/begin RECORD_LAYOUT GkfWUb FNC_VALUES 1 UBYTE COLUMN_DIR DIRECT /end RECORD_LAYOUT
/begin RECORD_LAYOUT GklWSb FNC_VALUES 1 SBYTE COLUMN_DIR DIRECT /end RECORD_LAYOUT
/begin RECORD_LAYOUT GklWUb FNC_VALUES 1 UBYTE COLUMN_DIR DIRECT /end RECORD_LAYOUT
/begin RECORD_LAYOUT KfAxUbAyUbSstxUbSstyUbWSb NO_AXIS_PTS_X 1 UBYTE NO_AXIS_PTS_Y 2 UBYTE AXIS_PTS_X 3 UBYTE INDEX_INCR DIRECT AXIS_PTS_Y 4 UBYTE INDEX_INCR DIRECT FNC_VALUES 5 SBYTE COLUMN_DIR DIRECT /end RECORD_LAYOUT
/begin RECORD_LAYOUT KfAxUbAyUbSstxUbSstyUbWUb NO_AXIS_PTS_X 1 UBYTE NO_AXIS_PTS_Y 2 UBYTE AXIS_PTS_X 3 UBYTE INDEX_INCR DIRECT AXIS_PTS_Y 4 UBYTE INDEX_INCR DIRECT FNC_VALUES 5 UBYTE COLUMN_DIR DIRECT /end RECORD_LAYOUT
/begin RECORD_LAYOUT KfAxUwAyUwSstxUwSstyUwWUw NO_AXIS_PTS_X 1 UWORD NO_AXIS_PTS_Y 2 UWORD AXIS_PTS_X 3 UWORD INDEX_INCR DIRECT AXIS_PTS_Y 4 UWORD INDEX_INCR DIRECT FNC_VALUES 5 UWORD COLUMN_DIR DIRECT /end RECORD_LAYOUT
/begin RECORD_LAYOUT KlAUbSstSwWSw NO_AXIS_PTS_X 1 SWORD AXIS_PTS_X 2 SWORD INDEX_INCR DIRECT FNC_VALUES 3 SWORD COLUMN_DIR DIRECT /end RECORD_LAYOUT
/begin RECORD_LAYOUT KlAUbSstSwWUw NO_AXIS_PTS_X 1 UWORD AXIS_PTS_X 2 SWORD INDEX_INCR DIRECT FNC_VALUES 3 UWORD COLUMN_DIR DIRECT /end RECORD_LAYOUT
/begin RECORD_LAYOUT KlAUbSstUbWSb NO_AXIS_PTS_X 1 UBYTE AXIS_PTS_X 2 UBYTE INDEX_INCR DIRECT FNC_VALUES 3 SBYTE COLUMN_DIR DIRECT /end RECORD_LAYOUT
/begin RECORD_LAYOUT KlAUbSstUbWUb NO_AXIS_PTS_X 1 UBYTE AXIS_PTS_X 2 UBYTE INDEX_INCR DIRECT FNC_VALUES 3 UBYTE COLUMN_DIR DIRECT /end RECORD_LAYOUT
/begin RECORD_LAYOUT KlAUbSstUwWSw NO_AXIS_PTS_X 1 UWORD AXIS_PTS_X 2 UWORD INDEX_INCR DIRECT FNC_VALUES 3 SWORD COLUMN_DIR DIRECT /end RECORD_LAYOUT
/begin RECORD_LAYOUT KlAUbSstUwWUb NO_AXIS_PTS_X 1 UBYTE AXIS_PTS_X 2 UWORD INDEX_INCR DIRECT FNC_VALUES 3 UBYTE COLUMN_DIR DIRECT /end RECORD_LAYOUT
/begin RECORD_LAYOUT KlAUbSstUwWUw NO_AXIS_PTS_X 1 UWORD AXIS_PTS_X 2 UWORD INDEX_INCR DIRECT FNC_VALUES 3 UWORD COLUMN_DIR DIRECT /end RECORD_LAYOUT
/begin RECORD_LAYOUT KlAUwSstUwWUb NO_AXIS_PTS_X 1 UWORD AXIS_PTS_X 2 UWORD INDEX_INCR DIRECT FNC_VALUES 3 UBYTE COLUMN_DIR DIRECT /end RECORD_LAYOUT
/begin RECORD_LAYOUT KlAUwSstUwWUw NO_AXIS_PTS_X 1 UWORD AXIS_PTS_X 2 UWORD INDEX_INCR DIRECT FNC_VALUES 3 UWORD COLUMN_DIR DIRECT /end RECORD_LAYOUT
/begin RECORD_LAYOUT KtxC FNC_VALUES 1 UBYTE COLUMN_DIR DIRECT /end RECORD_LAYOUT
/begin RECORD_LAYOUT KwbUb FNC_VALUES 1 UBYTE COLUMN_DIR DIRECT /end RECORD_LAYOUT
/begin RECORD_LAYOUT KwbUw FNC_VALUES 1 UWORD COLUMN_DIR DIRECT /end RECORD_LAYOUT
/begin RECORD_LAYOUT KwSb FNC_VALUES 1 SBYTE COLUMN_DIR DIRECT /end RECORD_LAYOUT
/begin RECORD_LAYOUT KwSw FNC_VALUES 1 SWORD COLUMN_DIR DIRECT /end RECORD_LAYOUT
/begin RECORD_LAYOUT KwUb FNC_VALUES 1 UBYTE COLUMN_DIR DIRECT /end RECORD_LAYOUT
/begin RECORD_LAYOUT KwUw FNC_VALUES 1 UWORD COLUMN_DIR DIRECT /end RECORD_LAYOUT
/begin RECORD_LAYOUT SstAUbSstUb NO_AXIS_PTS_X 1 UBYTE AXIS_PTS_X 2 UBYTE INDEX_INCR DIRECT /end RECORD_LAYOUT
/end MODULE
/end PROJECT
