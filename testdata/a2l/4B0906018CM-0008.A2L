ASAP2_VERSION 1 3
/begin PROJECT X505P_24HG_1 "X505P"
/begin HEADER "" VERSION "X505P_24HG_1" PROJECT_NO X505P_24HG_1 /end HEADER
/begin MODULE DIM ""
/begin MOD_COMMON "" BYTE_ORDER MSB_LAST ALIGNMENT_BYTE 1 ALIGNMENT_WORD 2 ALIGNMENT_LONG 2 /end MOD_COMMON
/begin CHARACTERISTIC ABGMSIGH "Abgastemperaturschwelle für Signalunterbrechung mit Ri-Diagnose hinter KAT" VALUE 0x818640 KwUb 1275. temp_ub_q5_o50 -50.00 1225. FORMAT "%5.0" /end CHARACTERISTIC
/begin CHARACTERISTIC ALFO "Anfangswert für Lernfilter bei fuel-on/fuel-off Adaption" VALUE 0x81370E KwUw 359.9945 dtsegn_b720divZyl 0.00 359.9945 FORMAT "%8.4" /end CHARACTERISTIC
/begin CHARACTERISTIC ANWFOHE "Anzahl NW-Umdr. für Heilung" VALUE 0x8101A7 KwUb 255.0 dez 0.00 255.0 FORMAT "%5.1" /end CHARACTERISTIC
/begin CHARACTERISTIC ANWFOST "Anzahl NW-Umdr. für Reaktivierung fuel-on/-off Adaption nach Ausblendung" VALUE 0x8101A8 KwUb 255.0 dez 0.00 255.0 FORMAT "%5.1" /end CHARACTERISTIC
/begin CHARACTERISTIC ANZHZKH "Anzahl der Heizer-Einkopplungen hinter KAT" VALUE 0x810BA6 KwUb 255.0 dez 0.00 255.0 FORMAT "%5.1" /end CHARACTERISTIC
/begin CHARACTERISTIC ANZHZOFFH "Anzahl der Heizungsausschaltungen hinter KAT" VALUE 0x810BA7 KwUb 255.0 dez 0.00 255.0 FORMAT "%5.1" /end CHARACTERISTIC
/begin CHARACTERISTIC CDFO "Codewort zum Ausschalten und Rücksetzen der Adaption" VALUE 0x8101A9 KwUb 255.0 dez 0.00 255.0 FORMAT "%5.1" /end CHARACTERISTIC
/begin CHARACTERISTIC DFSEFO2N "drehzahlabh. max. plausible Abweichungen der FSE-Werte" CURVE 0x8101AA GklWSb 5.603 dtsegn_b11p25divZyl -2.813 2.791 FORMAT "%5.3"
 /begin AXIS_DESCR COM_AXIS nmot nmot_ub_q40 8 0.00 10200. AXIS_PTS_REF SDZ08DMUB2 /end AXIS_DESCR
/end CHARACTERISTIC
/begin CHARACTERISTIC DFSEFO3N "drehzahlabh. max. plausible Abweichungen der FSE-Werte" CURVE 0x8101B2 GklWSb 5.603 dtsegn_b11p25divZyl -2.813 2.791 FORMAT "%5.3"
 /begin AXIS_DESCR COM_AXIS nmot nmot_ub_q40 8 0.00 10200. AXIS_PTS_REF SDZ08DMUB3 /end AXIS_DESCR
/end CHARACTERISTIC
/begin CHARACTERISTIC DFSEFON "drehzahlabh. max. plausible Abweichungen der FSE-Werte" CURVE 0x8101BA GklWSb 5.603 dtsegn_b11p25divZyl -2.813 2.791 FORMAT "%5.3"
 /begin AXIS_DESCR COM_AXIS nmot nmot_ub_q40 8 0.00 10200. AXIS_PTS_REF SDZ08DMUB /end AXIS_DESCR
/end CHARACTERISTIC
/begin CHARACTERISTIC DFSERES "Differenz der Adaptionswerte zum Auslösen eines Reset der fuel-on/-off adaption" VALUE 0x8101C2 KwUb 5.603 dtsegn_b11p25divZyl 0.00 5.603 FORMAT "%5.3" /end CHARACTERISTIC
/begin CHARACTERISTIC DLAHISATO "obere Grenze für dlahisa, CARB-Tester, DLSSALRS" VALUE 0x8189AA KwUb 0.09961 fak_ub_b0p1_o0p05 -0.05000 0.04961 FORMAT "%7.5" /end CHARACTERISTIC
/begin CHARACTERISTIC DLAHISATU "untere Grenze für dlahisa, CARB-Tester, DLSSALRS" VALUE 0x8189AB KwUb 0.09961 fak_ub_b0p1_o0p05 -0.05000 0.04961 FORMAT "%7.5" /end CHARACTERISTIC
/begin CHARACTERISTIC DLAHPPLMN "minimale DLAHP-Schwelle zum Setzen des Plausfehlers ""B""" VALUE 0x81C50A KwSw 1.999969 fak_sw_b1 -1.000000 0.9999695 FORMAT "%8.6" /end CHARACTERISTIC
/begin CHARACTERISTIC DLAMELSH "Delta-Lambda-Sollwert für elektrische Sonendiagnose hinter KAT (Kurztrip)" VALUE 0x81C388 KwUw 15.99976 fak_uw_b16 0.00 15.99976 FORMAT "%8.5" /end CHARACTERISTIC
/begin CHARACTERISTIC DLURMIN_0_A "Drehzahlabh. Laufunruhe-Referenz-Minimalwert 1" CURVE 0x8103A9 GklWSb 172.5 luquant -86.57 85.89 FORMAT "%5.2"
 /begin AXIS_DESCR COM_AXIS nmot nmot_ub_q40 8 0.00 10200. AXIS_PTS_REF SNM08DMUB /end AXIS_DESCR
/end CHARACTERISTIC
/begin CHARACTERISTIC DLURMIN_1_A "Drehzahlabh. Laufunruhe-Referenz-Minimalwert 1" CURVE 0x8103B1 GklWSb 172.5 luquant -86.57 85.89 FORMAT "%5.2"
 /begin AXIS_DESCR COM_AXIS nmot nmot_ub_q40 8 0.00 10200. AXIS_PTS_REF SNM08DMUB /end AXIS_DESCR
/end CHARACTERISTIC
/begin CHARACTERISTIC DMRLSH "Momentenreserve für Diagnose Lambdasonden hinter KAT" VALUE 0x81C38A KwUw 99.99847 rel_uw_b100 0.00 99.99847 FORMAT "%8.5" /end CHARACTERISTIC
/begin CHARACTERISTIC DMRLSV "Momentenreserve für Diagnose Lambdasonde vor Kat" VALUE 0x81C50C KwUw 99.99847 rel_uw_b100 0.00 99.99847 FORMAT "%8.5" /end CHARACTERISTIC
/begin CHARACTERISTIC DMXRDL "Begrenzung bei max. Laufunruhe-Referenzwert-Änderung von dlurs" VALUE 0x8103B9 KwSb 85.89 luquant 0.00 85.89 FORMAT "%5.2" /end CHARACTERISTIC
/begin CHARACTERISTIC DRISIGH "Diagnoseschwelle Ri-Sonde für Signalunterbrechung hinter KAT" VALUE 0x81C38C KwUw 131070.0 r_uw_q2 0.00 131070.0 FORMAT "%8.1" /end CHARACTERISTIC
/begin CHARACTERISTIC DRLMX "Schwelle für Laständerung" VALUE 0x8186CC KwUb 191.3 rel_ub_q0p75 0.00 191.3 FORMAT "%5.1" /end CHARACTERISTIC
/begin CHARACTERISTIC DYNLSUFA "Grenzwert für LSU-Dynamik bei Kurztest" VALUE 0x81C50E KwUw 15.99976 fak_uw_b16 0.00 15.99976 FORMAT "%8.5" /end CHARACTERISTIC
/begin CHARACTERISTIC DYNLSUMX "Grenzwert für LSU-Dynamik" VALUE 0x81C510 KwUw 15.99976 fak_uw_b16 0.00 15.99976 FORMAT "%8.5" /end CHARACTERISTIC
/begin CHARACTERISTIC DYNLSURD "reduzierter Grenzwert für LSU-Dynamik" VALUE 0x81C512 KwUw 15.99976 fak_uw_b16 0.00 15.99976 FORMAT "%8.5" /end CHARACTERISTIC
/begin CHARACTERISTIC DYNLSUTO "obere Grenze für dynlsusa, CARB-Tester, DLSSALRS" VALUE 0x8189AC KwUb 4.980 fak_q0p0195 0.00 4.980 FORMAT "%5.3" /end CHARACTERISTIC
/begin CHARACTERISTIC DYNLSUTU "untere Grenze für dynlsusa, CARB-Tester, DLSSALRS" VALUE 0x8189AD KwUb 4.980 fak_q0p0195 0.00 4.980 FORMAT "%5.3" /end CHARACTERISTIC
/begin CHARACTERISTIC FLFO "Filterfaktor Lernfilter der fuel-on/-off Adaption" VALUE 0x813710 KwSw 1.999969 fak_uw_b2 -1.000000 0.9999695 FORMAT "%8.6" /end CHARACTERISTIC
/begin CHARACTERISTIC FS1FO "Filterfaktor Segmentzeit-Filter 1 der fuel-on/-off Adaption" VALUE 0x813712 KwUw 0.9999695 fak_uw_b2 0.00 0.9999695 FORMAT "%9.7" /end CHARACTERISTIC
/begin CHARACTERISTIC FS2FO "Filterfaktor Segmentzeit-Filter 2 der fuel-on/-off Adaption" VALUE 0x813714 KwUw 0.9999695 fak_uw_b2 0.00 0.9999695 FORMAT "%9.7" /end CHARACTERISTIC
/begin CHARACTERISTIC IMLHEMN "Minimale integierte Luftmasse zum Heilen eines Fehlers" VALUE 0x81C514 KwUw 1.820417 m_q2p777Em5_kg 0.00 1.820417 FORMAT "%8.6" /end CHARACTERISTIC
/begin CHARACTERISTIC IMLHEMNFA "Minimale integierte Luftmasse zum Heilen eines Fehlers, bei Bandendeprüfung" VALUE 0x81C516 KwUw 1.820417 m_q2p777Em5_kg 0.00 1.820417 FORMAT "%8.6" /end CHARACTERISTIC
/begin CHARACTERISTIC IMLPLCMN "minimale integrierte Luftmasse für den Plausibilitätscheck" VALUE 0x81C518 KwUw 1.820417 m_q2p777Em5_kg 0.00 1.820417 FORMAT "%8.6" /end CHARACTERISTIC
/begin CHARACTERISTIC IMLPLCMNB "minimale integrierte Luftmasse für den erweiterten Plausibilitätscheck" VALUE 0x81C51A KwUw 1.820417 m_q2p777Em5_kg 0.00 1.820417 FORMAT "%8.6" /end CHARACTERISTIC
/begin CHARACTERISTIC IVDYNLSU "Startwert für dynlsu_w" VALUE 0x81C51C KwUw 15.99976 fak_uw_b16 0.00 15.99976 FORMAT "%8.5" /end CHARACTERISTIC
/begin CHARACTERISTIC KDYNFA "Rekursionskonstante für LSU-Dynamik bei Kurztest" VALUE 0x81C51E KwUw 0.9999847 fak_uw_b1 0.00 0.9999847 FORMAT "%9.7" /end CHARACTERISTIC
/begin CHARACTERISTIC KDYNLSU "Rekursionskonstante für LSU-Dynamik" VALUE 0x81C520 KwUw 0.9999847 fak_uw_b1 0.00 0.9999847 FORMAT "%9.7" /end CHARACTERISTIC
/begin CHARACTERISTIC KFCFO "Kennfeld zur Definition der Bereichseigenschaften (dominant..)" MAP 0x8101C3 GkfWUb 255.0 dez 0.00 255.0 FORMAT "%5.1"
 /begin AXIS_DESCR COM_AXIS rl rel_ub_q0p75 3 0.00 191.3 AXIS_PTS_REF SDZ03DMUB /end AXIS_DESCR
 /begin AXIS_DESCR COM_AXIS nmot nmot_ub_q40 8 0.00 10200. AXIS_PTS_REF SDZ08DMUB /end AXIS_DESCR
/end CHARACTERISTIC
/begin CHARACTERISTIC KFCFO2 "Kennfeld zur Definition der Bereichseigenschaften (dominant..)" MAP 0x8101DB GkfWUb 255.0 dez 0.00 255.0 FORMAT "%5.1"
 /begin AXIS_DESCR COM_AXIS rl rel_ub_q0p75 3 0.00 191.3 AXIS_PTS_REF SDZ03DMUB2 /end AXIS_DESCR
 /begin AXIS_DESCR COM_AXIS nmot nmot_ub_q40 8 0.00 10200. AXIS_PTS_REF SDZ08DMUB2 /end AXIS_DESCR
/end CHARACTERISTIC
/begin CHARACTERISTIC KFCFO3 "Kennfeld zur Definition der Bereichseigenschaften (dominant..)" MAP 0x8101F3 GkfWUb 255.0 dez 0.00 255.0 FORMAT "%5.1"
 /begin AXIS_DESCR COM_AXIS rl rel_ub_q0p75 3 0.00 191.3 AXIS_PTS_REF SDZ03DMUB3 /end AXIS_DESCR
 /begin AXIS_DESCR COM_AXIS nmot nmot_ub_q40 8 0.00 10200. AXIS_PTS_REF SDZ08DMUB3 /end AXIS_DESCR
/end CHARACTERISTIC
/begin CHARACTERISTIC KFDLUR_0_A "Kennfeld für Laufunruhedifferenz dluts Referenzwert" MAP 0x8103BA GkfWSb 172.5 luquant -86.57 85.89 FORMAT "%5.2"
 /begin AXIS_DESCR COM_AXIS rl rel_ub_q0p75 8 0.00 191.3 AXIS_PTS_REF SRL08DMUB /end AXIS_DESCR
 /begin AXIS_DESCR COM_AXIS nmot nmot_ub_q40 8 0.00 10200. AXIS_PTS_REF SNM08DMUB /end AXIS_DESCR
/end CHARACTERISTIC
/begin CHARACTERISTIC KFDLUR_1_A "Kennfeld für Laufunruhedifferenz dluts Referenzwert" MAP 0x8103FA GkfWSb 172.5 luquant -86.57 85.89 FORMAT "%5.2"
 /begin AXIS_DESCR COM_AXIS rl rel_ub_q0p75 8 0.00 191.3 AXIS_PTS_REF SRL08DMUB /end AXIS_DESCR
 /begin AXIS_DESCR COM_AXIS nmot nmot_ub_q40 8 0.00 10200. AXIS_PTS_REF SNM08DMUB /end AXIS_DESCR
/end CHARACTERISTIC
/begin CHARACTERISTIC KFDLUR1 "Kennfeld für Laufunruhedifferenz dluts Referenzwert" MAP 0x81043A GkfWSb 172.5 luquant -86.57 85.89 FORMAT "%5.2"
 /begin AXIS_DESCR COM_AXIS rl rel_ub_q0p75 8 0.00 191.3 AXIS_PTS_REF SRL08DMUB /end AXIS_DESCR
 /begin AXIS_DESCR COM_AXIS nmot nmot_ub_q40 8 0.00 10200. AXIS_PTS_REF SNM08DMUB /end AXIS_DESCR
/end CHARACTERISTIC
/begin CHARACTERISTIC KFDLUR2 "Kennfeld für Laufunruhedifferenz dluts Referenzwert" MAP 0x81047A GkfWSb 172.5 luquant -86.57 85.89 FORMAT "%5.2"
 /begin AXIS_DESCR COM_AXIS rl rel_ub_q0p75 8 0.00 191.3 AXIS_PTS_REF SRL08DMUB /end AXIS_DESCR
 /begin AXIS_DESCR COM_AXIS nmot nmot_ub_q40 8 0.00 10200. AXIS_PTS_REF SNM08DMUB /end AXIS_DESCR
/end CHARACTERISTIC
/begin CHARACTERISTIC KFDLURZ "Kennfeld für Laufunruhedifferenz dluts Referenzwert bei ZAS" MAP 0x8104BA GkfWSb 172.5 luquant -86.57 85.89 FORMAT "%5.2"
 /begin AXIS_DESCR COM_AXIS rl rel_ub_q0p75 8 0.00 191.3 AXIS_PTS_REF SRL08DMUB /end AXIS_DESCR
 /begin AXIS_DESCR COM_AXIS nmot nmot_ub_q40 8 0.00 10200. AXIS_PTS_REF SNM08DMUB /end AXIS_DESCR
/end CHARACTERISTIC
/begin CHARACTERISTIC LAMDYNO "obere Lambdaschwelle für Dynamikprüfung LSU" VALUE 0x81C522 KwUw 15.99976 fak_uw_b16 0.00 15.99976 FORMAT "%8.5" /end CHARACTERISTIC
/begin CHARACTERISTIC LAMDYNU "untere Lambdaschwelle für Dynamikprüfung LSU" VALUE 0x81C524 KwUw 15.99976 fak_uw_b16 0.00 15.99976 FORMAT "%8.5" /end CHARACTERISTIC
/begin CHARACTERISTIC LAMMN "Untere Plausibilitätsschwelle für Lambda" VALUE 0x81C526 KwUw 15.99976 fak_uw_b16 0.00 15.99976 FORMAT "%8.5" /end CHARACTERISTIC
/begin CHARACTERISTIC LAMMX "Obere Plausibilitätsschwelle für Lambda" VALUE 0x81C528 KwUw 15.99976 fak_uw_b16 0.00 15.99976 FORMAT "%8.5" /end CHARACTERISTIC
/begin CHARACTERISTIC LAMSSAMN "untere Grenze für lamsosa und lamsisa, CARB-Tester, DLSSALRS" VALUE 0x8189AE KwUb 1.992 fak_ub_b2 0.00 1.992 FORMAT "%5.3" /end CHARACTERISTIC
/begin CHARACTERISTIC LAMSSAMX "obere Grenze für lamsosa und lamsisa, CARB-Tester, DLSSALRS" VALUE 0x8189AF KwUb 1.992 fak_ub_b2 0.00 1.992 FORMAT "%5.3" /end CHARACTERISTIC
/begin CHARACTERISTIC LAMSSMN "Minimales Lambdasoll für  stöchiometrischen Betrieb" VALUE 0x81C52A KwUw 15.99976 fak_uw_b16 0.00 15.99976 FORMAT "%8.5" /end CHARACTERISTIC
/begin CHARACTERISTIC LAMSSMX "Maximales Lambdasoll für  stöchiometrischen Betrieb" VALUE 0x81C52C KwUw 15.99976 fak_uw_b16 0.00 15.99976 FORMAT "%8.5" /end CHARACTERISTIC
/begin CHARACTERISTIC LASPLCFT "Fettschwelle für den Sollwert von Lambda für den Plausibilitätscheck" VALUE 0x81C52E KwUw 15.99976 fak_uw_b16 0.00 15.99976 FORMAT "%8.5" /end CHARACTERISTIC
/begin CHARACTERISTIC LASPLCMR "Magerschwelle für den Sollwert von Lambda für den Plausibilitätscheck" VALUE 0x81C530 KwUw 15.99976 fak_uw_b16 0.00 15.99976 FORMAT "%8.5" /end CHARACTERISTIC
/begin CHARACTERISTIC LSUNAMN "untere Schwelle für LSU nicht aktiv" VALUE 0x81C532 KwUw 15.99976 fak_uw_b16 0.00 15.99976 FORMAT "%8.5" /end CHARACTERISTIC
/begin CHARACTERISTIC LSUNAMX "obere Schwelle für LSU nicht aktiv" VALUE 0x81C534 KwUw 15.99976 fak_uw_b16 0.00 15.99976 FORMAT "%8.5" /end CHARACTERISTIC
/begin CHARACTERISTIC LURFOST_0_A "Laufruhe-Referenzwert für stop fuel-on/-off Adaption, Vergleich mit lunw" VALUE 0x810225 KwUb 172.5 luquant 0.00 172.5 FORMAT "%5.1" /end CHARACTERISTIC
/begin CHARACTERISTIC LURFOST_1_A "Laufruhe-Referenzwert für stop fuel-on/-off Adaption, Vergleich mit lunw" VALUE 0x810226 KwUb 172.5 luquant 0.00 172.5 FORMAT "%5.1" /end CHARACTERISTIC
/begin CHARACTERISTIC MDERFOKH "Anzahl Aussetzer für Adaptionsstop (Heilung) bei B_kh = 1" VALUE 0x813716 KwUw 65535.00 dez 0.00 65535.00 FORMAT "%8.2" /end CHARACTERISTIC
/begin CHARACTERISTIC MDERKFON "Anzahl Aussetzer für Adaptionsstop (Heilung)" VALUE 0x813718 KwUw 65535.00 dez 0.00 65535.00 FORMAT "%8.2" /end CHARACTERISTIC
/begin CHARACTERISTIC MSAPLMN "untere Schwelle für Plausibilitätsprüfung LSU" VALUE 0x81C536 KwUw 6553.500 m_uw_b6553p5 0.00 6553.500 FORMAT "%8.3" /end CHARACTERISTIC
/begin CHARACTERISTIC NMIDLU "Min. Drehzahl für Ausblendung der Aussetzererkennung DMDDLU" VALUE 0x8104FA KwUb 10200. nmot_ub_q40 0.00 10200. FORMAT "%5.0" /end CHARACTERISTIC
/begin CHARACTERISTIC NMOTDYFA "untere Drehzahlschwelle für Dynamikprüfung LSU bei Kurztest" VALUE 0x8186CD KwUb 10200. nmot_ub_q40 0.00 10200. FORMAT "%5.0" /end CHARACTERISTIC
/begin CHARACTERISTIC NMOTDYNO "obere Drehzahlschwelle für Dynamikprüfung LSU" VALUE 0x8186CE KwUb 10200. nmot_ub_q40 0.00 10200. FORMAT "%5.0" /end CHARACTERISTIC
/begin CHARACTERISTIC NMOTDYNU "untere Drehzahlschwelle für Dynamikprüfung LSU" VALUE 0x8186CF KwUb 10200. nmot_ub_q40 0.00 10200. FORMAT "%5.0" /end CHARACTERISTIC
/begin CHARACTERISTIC RISIGRESH "Schwelle für Reset Signalunterbrechung mit Ri-Diagnose hinter KAT" VALUE 0x81C38E KwUw 131070.0 r_uw_q2 0.00 131070.0 FORMAT "%8.1" /end CHARACTERISTIC
/begin CHARACTERISTIC RLDYNFA "Lastschwelle für Dynamikprüfung LSU bei Kurztest" VALUE 0x8186D0 KwUb 191.3 rel_ub_q0p75 0.00 191.3 FORMAT "%5.1" /end CHARACTERISTIC
/begin CHARACTERISTIC RLDYNO "obere Lastschwelle für Dynamikprüfung LSU" VALUE 0x8186D1 KwUb 191.3 rel_ub_q0p75 0.00 191.3 FORMAT "%5.1" /end CHARACTERISTIC
/begin CHARACTERISTIC RLDYNU "untere Lastschwelle für Dynamikprüfung LSU" VALUE 0x8186D2 KwUb 191.3 rel_ub_q0p75 0.00 191.3 FORMAT "%5.1" /end CHARACTERISTIC
/begin CHARACTERISTIC SAFK1 "Filterkonstante 1 für Lambdasonden-Signalausgabe" VALUE 0x81D6C8 KwUw 0.9999847 fak_uw_b1 0.00 0.9999847 FORMAT "%9.7" /end CHARACTERISTIC
/begin CHARACTERISTIC SDLAOF "Schwelle delta Lambda Offset Regler hinter Kat" VALUE 0x81C538 KwSw 1.999969 fak_sw_b1 -1.000000 0.9999695 FORMAT "%8.6" /end CHARACTERISTIC
/begin CHARACTERISTIC SDULSUMX "Schwelle delta Spannung max pro Rechentakt" VALUE 0x813A6A KwUw 319.9951 spg_uw_q0p00488 0.00 319.9951 FORMAT "%8.4" /end CHARACTERISTIC
/begin AXIS_PTS SDZ03DMUB "SST-Verteilung in DMD, 3 Drehzahl-SST" 0x810227 rl SstAUbSstUb 191.3 rel_ub_q0p75 3 0.00 191.3 FORMAT "%5.1" DEPOSIT ABSOLUTE /end AXIS_PTS
/begin AXIS_PTS SDZ03DMUB2 "SST-Verteilung in DMD, 3 Drehzahl-SST" 0x81022B rl SstAUbSstUb 191.3 rel_ub_q0p75 3 0.00 191.3 FORMAT "%5.1" DEPOSIT ABSOLUTE /end AXIS_PTS
/begin AXIS_PTS SDZ03DMUB3 "SST-Verteilung in DMD, 3 Drehzahl-SST" 0x81022F rl SstAUbSstUb 191.3 rel_ub_q0p75 3 0.00 191.3 FORMAT "%5.1" DEPOSIT ABSOLUTE /end AXIS_PTS
/begin AXIS_PTS SDZ08DMUB "SST-Verteilung in DMD, 8 Drehzahl-SST" 0x810233 nmot SstAUbSstUb 10200. nmot_ub_q40 8 0.00 10200. FORMAT "%5.0" DEPOSIT ABSOLUTE /end AXIS_PTS
/begin AXIS_PTS SDZ08DMUB2 "SST-Verteilung in DMD, 8 Drehzahl-SST" 0x81023C nmot SstAUbSstUb 10200. nmot_ub_q40 8 0.00 10200. FORMAT "%5.0" DEPOSIT ABSOLUTE /end AXIS_PTS
/begin AXIS_PTS SDZ08DMUB3 "SST-Verteilung in DMD, 8 Drehzahl-SST" 0x810245 nmot SstAUbSstUb 10200. nmot_ub_q40 8 0.00 10200. FORMAT "%5.0" DEPOSIT ABSOLUTE /end AXIS_PTS
/begin CHARACTERISTIC SFONTM "Schwellwert tmot für fuel-on Adaption aktiv" VALUE 0x81020B KwUb 191.3 temp_ub_q0p75_o48 -48.00 143.3 FORMAT "%5.1" /end CHARACTERISTIC
/begin CHARACTERISTIC SLFOO2N "Obere Schwelle (Schwellwert-KL) für Lernfilterwert bei fuel-on/-off Adaption" CURVE 0x81020C GklWUb 1.401 dtsegn_b720divZyl 0.00 1.401 FORMAT "%5.3"
 /begin AXIS_DESCR COM_AXIS nmot nmot_ub_q40 8 0.00 10200. AXIS_PTS_REF SDZ08DMUB2 /end AXIS_DESCR
/end CHARACTERISTIC
/begin CHARACTERISTIC SLFOO3N "Obere Schwelle (Schwellwert-KL) für Lernfilterwert bei fuel-on/-off Adaption" CURVE 0x810214 GklWUb 1.401 dtsegn_b720divZyl 0.00 1.401 FORMAT "%5.3"
 /begin AXIS_DESCR COM_AXIS nmot nmot_ub_q40 8 0.00 10200. AXIS_PTS_REF SDZ08DMUB3 /end AXIS_DESCR
/end CHARACTERISTIC
/begin CHARACTERISTIC SLFOON "Obere Schwelle (Schwellwert-KL) für Lernfilterwert bei fuel-on/-off Adaption" CURVE 0x81021C GklWUb 1.401 dtsegn_b720divZyl 0.00 1.401 FORMAT "%5.3"
 /begin AXIS_DESCR COM_AXIS nmot nmot_ub_q40 8 0.00 10200. AXIS_PTS_REF SDZ08DMUB /end AXIS_DESCR
/end CHARACTERISTIC
/begin CHARACTERISTIC SLFOU "Untere Schwelle für Lernfilterwert bei fuel-on/-off Adaption" VALUE 0x81371A KwSw 179.9945 dtsegn_b720divZyl 0.00 179.9945 FORMAT "%8.4" /end CHARACTERISTIC
/begin AXIS_PTS SNM08DMUB "SST-Verteilung in DMD, 8 Drehzahl-SST" 0x81007B nmot SstAUbSstUb 10200. nmot_ub_q40 8 0.00 10200. FORMAT "%5.0" DEPOSIT ABSOLUTE /end AXIS_PTS
/begin AXIS_PTS SRL08DMUB "SST-Verteilung in DMD, 8 Last-SST" 0x8100E2 rl SstAUbSstUb 191.3 rel_ub_q0p75 8 0.00 191.3 FORMAT "%5.1" DEPOSIT ABSOLUTE /end AXIS_PTS
/begin CHARACTERISTIC SULSULUFT "Schwellwert für Plausibilitätsfehler LSU an Luft" VALUE 0x81C53A KwUw 319.9951 spg_uw_q0p00488 0.00 319.9951 FORMAT "%8.4" /end CHARACTERISTIC
/begin CHARACTERISTIC SULSUMX "Schwellwert für Plausibilitätsfehler CJ110" VALUE 0x81C53C KwUw 319.9951 spg_uw_q0p00488 0.00 319.9951 FORMAT "%8.4" /end CHARACTERISTIC
/begin CHARACTERISTIC TABGMCSD "Abgastemperaturschwelle für CSD-Messung" VALUE 0x810BA8 KwUb 1275. temp_ub_q5_o50 -50.00 1225. FORMAT "%5.0" /end CHARACTERISTIC
/begin CHARACTERISTIC TALASMX "Abgastemperatur-Schwellwert für Prüfung Heizerkopplung" VALUE 0x81C53E KwUw 1535.977 temp_q0p0234_o273 -273.1500 1262.827 FORMAT "%8.3" /end CHARACTERISTIC
/begin CHARACTERISTIC TALSUSMX "Maximaler Abgastemperatur-Schwellwert für die Plausibilitätsdiagnose" VALUE 0x81C540 KwUw 1535.977 temp_q0p0234_o273 -273.1500 1262.827 FORMAT "%8.3" /end CHARACTERISTIC
/begin CHARACTERISTIC TASIG "Zeit für Ausblendung von Störspitzen außerhalb Band für Erk. Signalunterbrechung" VALUE 0x810BA9 KwUb 5.100 t20msxs_ub_b5p1 0.00 5.100 FORMAT "%5.3" /end CHARACTERISTIC
/begin CHARACTERISTIC TKATMSHU "Kat-Temperatur für ausreichende Sondenheizung" VALUE 0x818641 KwUb 1275. temp_ub_q5_o50 -50.00 1225. FORMAT "%5.0" /end CHARACTERISTIC
/begin CHARACTERISTIC TMSH "Motortemperaturschwelle für Erkennung Kaltstart für Messung Sonde hinter KAT" VALUE 0x818642 KwUb 191.3 temp_ub_q0p75_o48 -48.00 143.3 FORMAT "%5.1" /end CHARACTERISTIC
/begin CHARACTERISTIC TMSHA "Motorabstelltemperaturschwelle für Messung Abkühlung Sonde hinter KAT" VALUE 0x818643 KwUb 191.3 temp_ub_q0p75_o48 -48.00 143.3 FORMAT "%5.1" /end CHARACTERISTIC
/begin CHARACTERISTIC TNSTDNH "Zeit nach Start für Diagnose Adernschluß (Monoflop)" VALUE 0x810BAA KwUb 5.100 t20msxs_ub_b5p1 0.00 5.100 FORMAT "%5.3" /end CHARACTERISTIC
/begin CHARACTERISTIC TNSTFON "Zeit nach Start Adaptionsstop (Heilung) freigegeben" VALUE 0x81371C KwUw 655.3500 t10msxs_uw_b655p35 0.00 655.3500 FORMAT "%8.4" /end CHARACTERISTIC
/begin CHARACTERISTIC TRSAFA "Überwachungszeit Kabelbruch hinter KAT: Funktions Anforderung für Kurz-Trip-Test" VALUE 0x81C390 KwUw 6553.500 t100msxs_uw_q100 0.00 6553.500 FORMAT "%8.3" /end CHARACTERISTIC
/begin CHARACTERISTIC TRSAH "Überwachungszeit für Kabelbruch (Spg. im Band) für Sonde hinter KAT" VALUE 0x81C392 KwUw 6553.500 t100msxs_uw_q100 0.00 6553.500 FORMAT "%8.3" /end CHARACTERISTIC
/begin CHARACTERISTIC TRSE "Verzögerungszeit für Regelung ein" VALUE 0x818644 KwUb 25.50 t100msxs_ub_b25p5 0.00 25.50 FORMAT "%5.2" /end CHARACTERISTIC
/begin CHARACTERISTIC TTBMH "Zeit für theoretische Sondenbetriebsbereitschaft mit Heizung" VALUE 0x81C394 KwUw 6553.500 t100msxs_uw_q100 0.00 6553.500 FORMAT "%8.3" /end CHARACTERISTIC
/begin CHARACTERISTIC TUHKFH "Verzögerungszeit für Ausgabe Fehler Heizer-Einkopplung  hinter KAT" VALUE 0x81C396 KwUw 6553.500 t100msxs_uw_q100 0.00 6553.500 FORMAT "%8.3" /end CHARACTERISTIC
/begin CHARACTERISTIC TUSEHKH "Verzögerungszeit nach Taupunktende für Enable Messung HZ-Kopplung  hinter KAT" VALUE 0x81C398 KwUw 6553.500 t100msxs_uw_q100 0.00 6553.500 FORMAT "%8.3" /end CHARACTERISTIC
/begin CHARACTERISTIC TUSHZMFH "Zeitfenster für Messung Heizertakt-Einkopplung  auf Sondensignal hinter  KAT" VALUE 0x810BAB KwUb 2.550 t10msxs_ub_b2p55 0.00 2.550 FORMAT "%5.3" /end CHARACTERISTIC
/begin CHARACTERISTIC TUSKS "Entstörzeit für Abschalten einzelner Funktionen Sonde hinter KAT" VALUE 0x810BAC KwUb 5.100 t20msxs_ub_b5p1 0.00 5.100 FORMAT "%5.3" /end CHARACTERISTIC
/begin CHARACTERISTIC TUSMAX "Überwachungszeit für Usmax" VALUE 0x818645 KwUb 25.50 t100msxs_ub_b25p5 0.00 25.50 FORMAT "%5.2" /end CHARACTERISTIC
/begin CHARACTERISTIC TUSTAL "Verzög.zeit für Erkennung Adernschluß nach ""Tank leer"" fahren für Sonde h. KAT" VALUE 0x81C39A KwUw 6553.500 t100msxs_uw_q100 0.00 6553.500 FORMAT "%8.3" /end CHARACTERISTIC
/begin CHARACTERISTIC TVCJLSU "Verzögerungszeit für Fehler CJ110" VALUE 0x8186D3 KwUb 25.50 t100msxs_ub_b25p5 0.00 25.50 FORMAT "%5.2" /end CHARACTERISTIC
/begin CHARACTERISTIC TVDRL "Verzögerungszeit für Dynamikmessung LSU" VALUE 0x8186D4 KwUb 25.50 t100msxs_ub_b25p5 0.00 25.50 FORMAT "%5.2" /end CHARACTERISTIC
/begin CHARACTERISTIC TVHKLSU "Verzögerungszeit für Diagnose Heizerkopplung" VALUE 0x81C542 KwUw 6553.500 t100msxs_uw_b6553p5 0.00 6553.500 FORMAT "%8.3" /end CHARACTERISTIC
/begin CHARACTERISTIC TVHKLSUV "Zeit für Diagnose Heizerkopplung" VALUE 0x810BBD KwUb 2.550 t10msxs_ub_b2p55 0.00 2.550 FORMAT "%5.3" /end CHARACTERISTIC
/begin CHARACTERISTIC TVLSUEK "Verzögerungszeit für Fehlerkorrektur stetige Lambdasonde LSU" VALUE 0x81C544 KwUw 6553.500 t100msxs_uw_b6553p5 0.00 6553.500 FORMAT "%8.3" /end CHARACTERISTIC
/begin CHARACTERISTIC TVLSUHK "Verzögerungszeit nach Start für Diagnose Heizerkopplung" VALUE 0x81C546 KwUw 655.3500 t10msxs_uw_b655p35 0.00 655.3500 FORMAT "%8.4" /end CHARACTERISTIC
/begin CHARACTERISTIC TVLSULUFT "Verzögerungszeit für Fehler LSU in Luft" VALUE 0x8186D5 KwUb 25.50 t100msxs_ub_b25p5 0.00 25.50 FORMAT "%5.2" /end CHARACTERISTIC
/begin CHARACTERISTIC TVLSUOF "Verzögerungszeit für Fehler stetige Lambdasonde LSU ""Offset""" VALUE 0x81C548 KwUw 6553.500 t100msxs_uw_b6553p5 0.00 6553.500 FORMAT "%8.3" /end CHARACTERISTIC
/begin CHARACTERISTIC TVLSUPER "Verzögerungszeit für B_lsuftb und B_lsumrb" VALUE 0x8186D6 KwUb 25.50 t100msxs_ub_b25p5 0.00 25.50 FORMAT "%5.2" /end CHARACTERISTIC
/begin CHARACTERISTIC TVLSUTRIM "Verzögerungszeit für Fehler LSU Abgleichleitung unterbrochen" VALUE 0x8186D7 KwUb 25.50 t100msxs_ub_b25p5 0.00 25.50 FORMAT "%5.2" /end CHARACTERISTIC
/begin CHARACTERISTIC TVLUES1MN "Min. Tastverhältnis Lüfter 1" VALUE 0x8187D0 KwUb 99.61 tv_ub_b100 0.00 99.61 FORMAT "%5.2" /end CHARACTERISTIC
/begin CHARACTERISTIC TVLUES1MX "Max. Tastverhältnis Lüfter 1" VALUE 0x8187D1 KwUb 99.61 tv_ub_b100 0.00 99.61 FORMAT "%5.2" /end CHARACTERISTIC
/begin CHARACTERISTIC TVMRFT "Verzögerungszeit für Lambdasonde hinter Kat mager oder fett" VALUE 0x8186D8 KwUb 25.50 t100msxs_ub_b25p5 0.00 25.50 FORMAT "%5.2" /end CHARACTERISTIC
/begin CHARACTERISTIC TVSNPF "Verzögerungszeit in der Störungen bei der Entprellung unterdrückt werden" VALUE 0x8186D9 KwUb 25.50 t100msxs_ub_b25p5 0.00 25.50 FORMAT "%5.2" /end CHARACTERISTIC
/begin CHARACTERISTIC TVTKLSU "Verzögerungszeit beim Eintragen eines Fehlers aufgrund eines leeren Tanks" VALUE 0x81C54A KwUw 6553.500 t100msxs_uw_b6553p5 0.00 6553.500 FORMAT "%8.3" /end CHARACTERISTIC
/begin CHARACTERISTIC TWDLSSA "Mindestprüfzeit für DLSSA-Extremwertbestimmung" VALUE 0x81D6CA KwUw 3276.750 t50msxs_uw_b3276p75 0.00 3276.750 FORMAT "%8.3" /end CHARACTERISTIC
/begin CHARACTERISTIC UBDLS "Batteriespannungsschwelle zur Freigabe der Sonden-Diagnose" VALUE 0x818646 KwUb 17.95 spg_ubatt 0.00 17.95 FORMAT "%5.2" /end CHARACTERISTIC
/begin CHARACTERISTIC USHKFT "Sondenspannungs-Schwelle für Erkennung ""Abgas fett"" hinter Kat" VALUE 0x81C54C KwUw 319.9951 spg_uw_q0p00488_o1 -1.000000 318.9951 FORMAT "%8.4" /end CHARACTERISTIC
/begin CHARACTERISTIC USHKHZK "Schwelle für Überprüfung Heizereinkopplung auf Sondensignal (hinter KAT)" VALUE 0x81397E KwUw 319.9951 spg_uw_q0p00488_o1 -1.000000 318.9951 FORMAT "%8.4" /end CHARACTERISTIC
/begin CHARACTERISTIC USHKMR "Sondenspannungs-Schwelle für Erkennung ""Abgas mager"" hinter Kat" VALUE 0x81C54E KwUw 319.9951 spg_uw_q0p00488_o1 -1.000000 318.9951 FORMAT "%8.4" /end CHARACTERISTIC
/begin CHARACTERISTIC USIVMAXH "Init value für max.Sondenspg. hinter Kat nach Powerfail u. Fehlersp. löschen" VALUE 0x8189B0 KwUb 1.330 spg_ub_b1p33 0.00 1.330 FORMAT "%5.3" /end CHARACTERISTIC
/begin CHARACTERISTIC USIVMINH "Init value für min.Sondenspg. hinter Kat nach Powerfail u. Fehlersp. löschen" VALUE 0x8189B1 KwUb 1.330 spg_ub_b1p33 0.00 1.330 FORMAT "%5.3" /end CHARACTERISTIC
/begin CHARACTERISTIC USMAX "Schwelle für Sondenkurzschluß nach Ubat" VALUE 0x813980 KwUw 319.9951 spg_uw_q0p00488_o1 -1.000000 318.9951 FORMAT "%8.4" /end CHARACTERISTIC
/begin CHARACTERISTIC USMIN "Schwelle für Sondenkurzschluß nach Masse" VALUE 0x813982 KwUw 319.9951 spg_uw_q0p00488_o1 -1.000000 318.9951 FORMAT "%8.4" /end CHARACTERISTIC
/begin CHARACTERISTIC USMNSHMN "min. erkannte Sondenspannung hinter Kat für Signalausgabe (min. plaus. Wert)" VALUE 0x8189B2 KwUb 1.330 spg_ub_b1p33 0.00 1.330 FORMAT "%5.3" /end CHARACTERISTIC
/begin CHARACTERISTIC USMNSHMX "min. erkannte Sondenspannung hinter Kat für Signalausgabe (max. plaus. Wert)" VALUE 0x8189B3 KwUb 1.330 spg_ub_b1p33 0.00 1.330 FORMAT "%5.3" /end CHARACTERISTIC
/begin CHARACTERISTIC USMXSHMN "max. erkannte Sondenspannung hinter Kat für Signalausgabe (min. plaus. Wert)" VALUE 0x8189B4 KwUb 1.330 spg_ub_b1p33 0.00 1.330 FORMAT "%5.3" /end CHARACTERISTIC
/begin CHARACTERISTIC USMXSHMX "max. erkannte Sondenspannung hinter Kat für Signalausgabe (max. plaus. Wert)" VALUE 0x8189B5 KwUb 1.330 spg_ub_b1p33 0.00 1.330 FORMAT "%5.3" /end CHARACTERISTIC
/begin CHARACTERISTIC USREFH "Schwelle für Sondenbetriebsbereitschaft hinter KAT bei fettem Gemisch" VALUE 0x813984 KwUw 319.9951 spg_uw_q0p00488_o1 -1.000000 318.9951 FORMAT "%8.4" /end CHARACTERISTIC
/begin CHARACTERISTIC USREMH "Schwelle für Sondenbetriebsbereitschaft hinter KAT bei magerem Gemisch" VALUE 0x813986 KwUw 319.9951 spg_uw_q0p00488_o1 -1.000000 318.9951 FORMAT "%8.4" /end CHARACTERISTIC
/begin CHARACTERISTIC USRHKSHJ "Regelschwelle für Regelung hinter Kat, DLSSA-Ausgabe umgerechn. Wert" VALUE 0x8189B6 KwUb 1.330 spg_ub_b1p33 0.00 1.330 FORMAT "%5.3" /end CHARACTERISTIC
/begin CHARACTERISTIC USRJ "" VALUE 0x8189B7 KwUb 1.330 spg_ub_b1p33 0.00 1.330 FORMAT "%5.3" /end CHARACTERISTIC
/begin CHARACTERISTIC ZASMASK "Zylinderabschaltmaske für CIFI aus ZAS" VALUE 0x810224 KwUb 255.0 dez 0.00 255.0 FORMAT "%5.1" /end CHARACTERISTIC
/begin CHARACTERISTIC ZDYNFA "Zählerwert für Dynamikmessung LSU bei Kurztest" VALUE 0x8186DA KwUb 255.0 dez 0.00 255.0 FORMAT "%5.1" /end CHARACTERISTIC
/begin CHARACTERISTIC ZDYNLSU "Zählerwert für Dynamikmessung LSU" VALUE 0x8186DB KwUb 255.0 dez 0.00 255.0 FORMAT "%5.1" /end CHARACTERISTIC
/begin CHARACTERISTIC ZEHK "Fehlerzähler für Heizerkopplung auf das Lambdasignal" VALUE 0x8186DC KwUb 255.0 dez 0.00 255.0 FORMAT "%5.1" /end CHARACTERISTIC
/begin CHARACTERISTIC ZLAMFT "Zeitkonstante für Filterung von lamsoni" VALUE 0x813A6C KwUw 6553.5000000 zk100msxs_uw_b6553 0.10000000000 6553.6000000 FORMAT "%12.7" /end CHARACTERISTIC
/begin CHARACTERISTIC ZLAMHP "Filterzeitkonstante für lamsoni_w Hochpass" VALUE 0x813A6E KwUw 655.34999985 zk10msxs_uw_b655 0.010000152590 655.36000000 FORMAT "%12.8" /end CHARACTERISTIC
/begin CHARACTERISTIC ZLAMLP "Filterzeitkonstante für lamsoni_w Tiefpass" VALUE 0x813A70 KwUw 655.34999985 zk10msxs_uw_b655 0.010000152590 655.36000000 FORMAT "%12.8" /end CHARACTERISTIC
/begin MEASUREMENT anwfoh "zählt Anzahl der NW-Umdr. für Heilung der fuel-on/-off Adaption" UBYTE dez 1 100 0 255 FORMAT "%5.1" ECU_ADDRESS 0xE41D /end MEASUREMENT
/begin MEASUREMENT anwfos "zählt Anzahl der NW-Umdr. von Bedingungen für Adaption erfüllt bis Lernbeginn" UBYTE dez 1 100 0 255 FORMAT "%5.1" ECU_ADDRESS 0xE41C /end MEASUREMENT
/begin MEASUREMENT anzdyn "Anzahl der Dynamikmessungen LSU" UBYTE dez 1 100 0 255 FORMAT "%5.1" ECU_ADDRESS 0x380954 /end MEASUREMENT
/begin MEASUREMENT B_adsh "Bedingung Adernschluß bei Lambdasonden hinter Kat" UBYTE B_TRUE 1 100 0 1 BIT_MASK 0x1 FORMAT "%13.11" ECU_ADDRESS 0x380938 /end MEASUREMENT
/begin MEASUREMENT B_adshs "Bedingung Adernschluß ""setzen"" bei Lambdasonden hinter Kat" UBYTE B_TRUE 1 100 0 1 BIT_MASK 0x10 FORMAT "%13.11" ECU_ADDRESS 0x380937 /end MEASUREMENT
/begin MEASUREMENT B_anzhzkh "Beding. Anzahl der Heizereinkoppl. zum Sonden Signal ist erreicht hinter KAT" UWORD B_TRUE 1 100 0 1 BIT_MASK 0x100 FORMAT "%13.11" ECU_ADDRESS 0xFD32 /end MEASUREMENT
/begin MEASUREMENT B_anzhzoh "Bedingung Anzahl der Heizungs-Ausschaltungen ist erreicht hinter KAT" UWORD B_TRUE 1 100 0 1 BIT_MASK 0x200 FORMAT "%13.11" ECU_ADDRESS 0xFD32 /end MEASUREMENT
/begin MEASUREMENT B_dluerk_m "Monitor, Aussetzer erkannt in DMDDLU" UBYTE B_TRUE 1 100 0 1 BIT_MASK 0x1 FORMAT "%13.11" ECU_ADDRESS 0xE3DB /end MEASUREMENT
/begin MEASUREMENT B_dmd_reset "" UWORD B_TRUE 1 100 0 1 BIT_MASK 0x10 FORMAT "%13.11" ECU_ADDRESS 0xFDBC /end MEASUREMENT
/begin MEASUREMENT B_drlmx "Laständerung unterhalb Schwellwert" UBYTE B_TRUE 1 100 0 1 BIT_MASK 0x1 FORMAT "%13.11" ECU_ADDRESS 0x380956 /end MEASUREMENT
/begin MEASUREMENT B_dshen "Bedingung Freigabe Sondendiagnose hinter KAT" UWORD B_TRUE 1 100 0 1 BIT_MASK 0x400 FORMAT "%13.11" ECU_ADDRESS 0xFD32 /end MEASUREMENT
/begin MEASUREMENT B_dylsu "Dynamik LSU geprüft" UBYTE B_TRUE 1 100 0 1 BIT_MASK 0x2 FORMAT "%13.11" ECU_ADDRESS 0x380956 /end MEASUREMENT
/begin MEASUREMENT B_dylsuav "Dynamiküberwachung LSU aktiv" UBYTE B_TRUE 1 100 0 1 BIT_MASK 0x4 FORMAT "%13.11" ECU_ADDRESS 0x380956 /end MEASUREMENT
/begin MEASUREMENT B_dylsuf "Freigabe Dynamikprüfung LSU" UBYTE B_TRUE 1 100 0 1 BIT_MASK 0x8 FORMAT "%13.11" ECU_ADDRESS 0x380956 /end MEASUREMENT
/begin MEASUREMENT B_elaof "Bedingung Error Lambda-Offset LSU" UWORD B_TRUE 1 100 0 1 BIT_MASK 0x8 FORMAT "%13.11" ECU_ADDRESS 0xFD3A /end MEASUREMENT
/begin MEASUREMENT B_elshv "Hilfsbit zur Auswertung des Erorbits E_lshv zur Umschaltung Mono/Stereo hint KAT" UBYTE B_TRUE 1 100 0 1 BIT_MASK 0x4 FORMAT "%13.11" ECU_ADDRESS 0x380938 /end MEASUREMENT
/begin MEASUREMENT B_elsu "Bedingung Fehler oder Fehler-Vormerkung LSU (keine Betriebsbereitschaft)" UWORD B_TRUE 1 100 0 1 BIT_MASK 0x10 FORMAT "%13.11" ECU_ADDRESS 0xFD3A /end MEASUREMENT
/begin MEASUREMENT B_enlues "Speicherbit für Zyklusflag" UWORD B_TRUE 1 100 0 1 BIT_MASK 0x400 FORMAT "%13.11" ECU_ADDRESS 0xFD4E /end MEASUREMENT
/begin MEASUREMENT B_enlues1 "Speicherbit für Zyklusflag" UWORD B_TRUE 1 100 0 1 BIT_MASK 0x800 FORMAT "%13.11" ECU_ADDRESS 0xFD4E /end MEASUREMENT
/begin MEASUREMENT B_falsu "Bedingung Funktionsanforderung Lambda-Sonde vor KAT" UWORD B_TRUE 1 100 0 1 BIT_MASK 0x20 FORMAT "%13.11" ECU_ADDRESS 0xFD3A /end MEASUREMENT
/begin MEASUREMENT B_fodo "Bedingung fuel-on/-off adaption in dominantem Bereich aktiv" UBYTE B_TRUE 1 100 0 1 BIT_MASK 0x2 FORMAT "%13.11" ECU_ADDRESS 0x383255 /end MEASUREMENT
/begin MEASUREMENT B_fodon "Bedingung fuel-on Adaption in drehzahldominantem Bereich aktiv" UBYTE B_TRUE 1 100 0 1 BIT_MASK 0x8 FORMAT "%13.11" ECU_ADDRESS 0x383255 /end MEASUREMENT
/begin MEASUREMENT B_fof_m "Monitor, Bedingung fuel-off Adaption aktiv" UBYTE B_TRUE 1 100 0 1 BIT_MASK 0x40 FORMAT "%13.11" ECU_ADDRESS 0xE43C /end MEASUREMENT
/begin MEASUREMENT B_fohe "aktueller Bereich ist ein Heilbereich" UBYTE B_TRUE 1 100 0 1 BIT_MASK 0x80 FORMAT "%13.11" ECU_ADDRESS 0x383255 /end MEASUREMENT
/begin MEASUREMENT B_fohold "fuel-on Adaption angehalten" UBYTE B_TRUE 1 100 0 1 BIT_MASK 0x4 FORMAT "%13.11" ECU_ADDRESS 0x383256 /end MEASUREMENT
/begin MEASUREMENT B_fontm "Motortemperatur genügend hoch für fuel-on-Adaption" UWORD B_TRUE 1 100 0 1 BIT_MASK 0x20 FORMAT "%13.11" ECU_ADDRESS 0xFDB8 /end MEASUREMENT
/begin MEASUREMENT B_fon_m "Monitor, Bedingung fuel-on Adaption aktiv" UBYTE B_TRUE 1 100 0 1 BIT_MASK 0x1 FORMAT "%13.11" ECU_ADDRESS 0xE43C /end MEASUREMENT
/begin MEASUREMENT B_for11 "KF-Bereich 11 fertig gelernt (ready)" UBYTE B_TRUE 1 100 0 1 BIT_MASK 0x1 FORMAT "%13.11" ECU_ADDRESS 0x383259 /end MEASUREMENT
/begin MEASUREMENT B_for12 "KF-Bereich 12 fertig gelernt (ready)" UBYTE B_TRUE 1 100 0 1 BIT_MASK 0x1 FORMAT "%13.11" ECU_ADDRESS 0x38325A /end MEASUREMENT
/begin MEASUREMENT B_for13 "KF-Bereich 13 fertig gelernt (ready)" UBYTE B_TRUE 1 100 0 1 BIT_MASK 0x1 FORMAT "%13.11" ECU_ADDRESS 0x38325B /end MEASUREMENT
/begin MEASUREMENT B_for21 "KF-Bereich 21 fertig gelernt (ready)" UBYTE B_TRUE 1 100 0 1 BIT_MASK 0x2 FORMAT "%13.11" ECU_ADDRESS 0x383259 /end MEASUREMENT
/begin MEASUREMENT B_for22 "KF-Bereich 22 fertig gelernt (ready)" UBYTE B_TRUE 1 100 0 1 BIT_MASK 0x2 FORMAT "%13.11" ECU_ADDRESS 0x38325A /end MEASUREMENT
/begin MEASUREMENT B_for23 "KF-Bereich 23 fertig gelernt (ready)" UBYTE B_TRUE 1 100 0 1 BIT_MASK 0x2 FORMAT "%13.11" ECU_ADDRESS 0x38325B /end MEASUREMENT
/begin MEASUREMENT B_for31 "KF-Bereich 31 fertig gelernt" UBYTE B_TRUE 1 100 0 1 BIT_MASK 0x4 FORMAT "%13.11" ECU_ADDRESS 0x383259 /end MEASUREMENT
/begin MEASUREMENT B_for32 "KF-Bereich 32 fertig gelernt" UBYTE B_TRUE 1 100 0 1 BIT_MASK 0x4 FORMAT "%13.11" ECU_ADDRESS 0x38325A /end MEASUREMENT
/begin MEASUREMENT B_for33 "KF-Bereich 33 fertig gelernt" UBYTE B_TRUE 1 100 0 1 BIT_MASK 0x4 FORMAT "%13.11" ECU_ADDRESS 0x38325B /end MEASUREMENT
/begin MEASUREMENT B_for41 "KF-Bereich 41 fertig gelernt" UBYTE B_TRUE 1 100 0 1 BIT_MASK 0x8 FORMAT "%13.11" ECU_ADDRESS 0x383259 /end MEASUREMENT
/begin MEASUREMENT B_for42 "KF-Bereich 42 fertig gelernt" UBYTE B_TRUE 1 100 0 1 BIT_MASK 0x8 FORMAT "%13.11" ECU_ADDRESS 0x38325A /end MEASUREMENT
/begin MEASUREMENT B_for43 "KF-Bereich 43 fertig gelernt" UBYTE B_TRUE 1 100 0 1 BIT_MASK 0x8 FORMAT "%13.11" ECU_ADDRESS 0x38325B /end MEASUREMENT
/begin MEASUREMENT B_for51 "KF-Bereich 51 fertig gelernt" UBYTE B_TRUE 1 100 0 1 BIT_MASK 0x10 FORMAT "%13.11" ECU_ADDRESS 0x383259 /end MEASUREMENT
/begin MEASUREMENT B_for52 "KF-Bereich 52 fertig gelernt" UBYTE B_TRUE 1 100 0 1 BIT_MASK 0x10 FORMAT "%13.11" ECU_ADDRESS 0x38325A /end MEASUREMENT
/begin MEASUREMENT B_for53 "KF-Bereich 53 fertig gelernt" UBYTE B_TRUE 1 100 0 1 BIT_MASK 0x10 FORMAT "%13.11" ECU_ADDRESS 0x38325B /end MEASUREMENT
/begin MEASUREMENT B_for61 "KF-Bereich 61 fertig gelernt" UBYTE B_TRUE 1 100 0 1 BIT_MASK 0x20 FORMAT "%13.11" ECU_ADDRESS 0x383259 /end MEASUREMENT
/begin MEASUREMENT B_for62 "KF-Bereich 62 fertig gelernt" UBYTE B_TRUE 1 100 0 1 BIT_MASK 0x20 FORMAT "%13.11" ECU_ADDRESS 0x38325A /end MEASUREMENT
/begin MEASUREMENT B_for63 "KF-Bereich 63 fertig gelernt" UBYTE B_TRUE 1 100 0 1 BIT_MASK 0x20 FORMAT "%13.11" ECU_ADDRESS 0x38325B /end MEASUREMENT
/begin MEASUREMENT B_for71 "KF-Bereich 71 fertig gelernt" UBYTE B_TRUE 1 100 0 1 BIT_MASK 0x40 FORMAT "%13.11" ECU_ADDRESS 0x383259 /end MEASUREMENT
/begin MEASUREMENT B_for72 "KF-Bereich 72 fertig gelernt" UBYTE B_TRUE 1 100 0 1 BIT_MASK 0x40 FORMAT "%13.11" ECU_ADDRESS 0x38325A /end MEASUREMENT
/begin MEASUREMENT B_for73 "KF-Bereich 73 fertig gelernt" UBYTE B_TRUE 1 100 0 1 BIT_MASK 0x40 FORMAT "%13.11" ECU_ADDRESS 0x38325B /end MEASUREMENT
/begin MEASUREMENT B_for81 "KF-Bereich 81 fertig gelernt" UBYTE B_TRUE 1 100 0 1 BIT_MASK 0x80 FORMAT "%13.11" ECU_ADDRESS 0x383259 /end MEASUREMENT
/begin MEASUREMENT B_for82 "KF-Bereich 82 fertig gelernt" UBYTE B_TRUE 1 100 0 1 BIT_MASK 0x80 FORMAT "%13.11" ECU_ADDRESS 0x38325A /end MEASUREMENT
/begin MEASUREMENT B_for83 "KF-Bereich 83 fertig gelernt" UBYTE B_TRUE 1 100 0 1 BIT_MASK 0x80 FORMAT "%13.11" ECU_ADDRESS 0x38325B /end MEASUREMENT
/begin MEASUREMENT B_fordo_m "Monitor, Bedingung Adaption in mind. einem dominanten Bereich ready" UBYTE B_TRUE 1 100 0 1 BIT_MASK 0x20 FORMAT "%13.11" ECU_ADDRESS 0xE3DB /end MEASUREMENT
/begin MEASUREMENT B_forn01 "mindestens ein Bereich im Drehzahlbereich 01 hat fertig gelernt" UBYTE B_TRUE 1 100 0 1 BIT_MASK 0x1 FORMAT "%13.11" ECU_ADDRESS 0x383257 /end MEASUREMENT
/begin MEASUREMENT B_forn02 "mindestens ein Bereich im Drehzahlbereich 02 hat fertig gelernt" UBYTE B_TRUE 1 100 0 1 BIT_MASK 0x2 FORMAT "%13.11" ECU_ADDRESS 0x383257 /end MEASUREMENT
/begin MEASUREMENT B_forn03 "mindestens ein Bereich im Drehzahlbereich 03 hat fertig gelernt" UBYTE B_TRUE 1 100 0 1 BIT_MASK 0x4 FORMAT "%13.11" ECU_ADDRESS 0x383257 /end MEASUREMENT
/begin MEASUREMENT B_forn04 "mindestens ein Bereich im Drehzahlbereich 04 hat fertig gelernt" UBYTE B_TRUE 1 100 0 1 BIT_MASK 0x8 FORMAT "%13.11" ECU_ADDRESS 0x383257 /end MEASUREMENT
/begin MEASUREMENT B_forn05 "mindestens ein Bereich im Drehzahlbereich 05 hat fertig gelernt" UBYTE B_TRUE 1 100 0 1 BIT_MASK 0x10 FORMAT "%13.11" ECU_ADDRESS 0x383257 /end MEASUREMENT
/begin MEASUREMENT B_forn06 "mindestens ein Bereich im Drehzahlbereich 06 hat fertig gelernt" UBYTE B_TRUE 1 100 0 1 BIT_MASK 0x20 FORMAT "%13.11" ECU_ADDRESS 0x383257 /end MEASUREMENT
/begin MEASUREMENT B_forn07 "mindestens ein Bereich im Drehzahlbereich 07 hat fertig gelernt" UBYTE B_TRUE 1 100 0 1 BIT_MASK 0x40 FORMAT "%13.11" ECU_ADDRESS 0x383257 /end MEASUREMENT
/begin MEASUREMENT B_forn08 "mindestens ein Bereich im Drehzahlbereich 08 hat fertig gelernt" UBYTE B_TRUE 1 100 0 1 BIT_MASK 0x80 FORMAT "%13.11" ECU_ADDRESS 0x383257 /end MEASUREMENT
/begin MEASUREMENT B_forn_m "Monitor, Bedingung Adaption im aktuellen Drehzahlbereich ready" UBYTE B_TRUE 1 100 0 1 BIT_MASK 0x40 FORMAT "%13.11" ECU_ADDRESS 0xE3DB /end MEASUREMENT
/begin MEASUREMENT B_forset "Reset der fuel-on/-off Adaption" UWORD B_TRUE 1 100 0 1 BIT_MASK 0x4000 FORMAT "%13.11" ECU_ADDRESS 0xFDB8 /end MEASUREMENT
/begin MEASUREMENT B_forun "Status fuel-on/-off Adaption aktiv" UBYTE B_TRUE 1 100 0 1 BIT_MASK 0x10 FORMAT "%13.11" ECU_ADDRESS 0x383256 /end MEASUREMENT
/begin MEASUREMENT B_for_m "Monitor, Bedingung Adaption im aktuellen Bereich ready" UBYTE B_TRUE 1 100 0 1 BIT_MASK 0x10 FORMAT "%13.11" ECU_ADDRESS 0xE3DB /end MEASUREMENT
/begin MEASUREMENT B_fos "Bedingung fuel-on/-off aktueller Bereich ist ein Schubbereich" UBYTE B_TRUE 1 100 0 1 BIT_MASK 0x4 FORMAT "%13.11" ECU_ADDRESS 0x383255 /end MEASUREMENT
/begin MEASUREMENT B_foxfg "Bedingung fuel-on/-off freigegeben" UBYTE B_TRUE 1 100 0 1 BIT_MASK 0x8 FORMAT "%13.11" ECU_ADDRESS 0x383256 /end MEASUREMENT
/begin MEASUREMENT B_heallsv "Bedingung Heilen des Fehlerpfades LSV" UBYTE B_TRUE 1 100 0 1 BIT_MASK 0x10 FORMAT "%13.11" ECU_ADDRESS 0x380956 /end MEASUREMENT
/begin MEASUREMENT B_heatf "Freigabe Heizerkopplung LSU" UBYTE B_TRUE 1 100 0 1 BIT_MASK 0x1 FORMAT "%13.11" ECU_ADDRESS 0x380955 /end MEASUREMENT
/begin MEASUREMENT B_helsu "Diagnose Heizerkopplung LSU erfolgt" UBYTE B_TRUE 1 100 0 1 BIT_MASK 0x20 FORMAT "%13.11" ECU_ADDRESS 0x380956 /end MEASUREMENT
/begin MEASUREMENT B_helsuf "Bedingung Freigabe Heilung LSU" UBYTE B_TRUE 1 100 0 1 BIT_MASK 0x40 FORMAT "%13.11" ECU_ADDRESS 0x380956 /end MEASUREMENT
/begin MEASUREMENT B_hzkfh "Bedingung Fehler Heizer-Einkopplung hinter Haupt KAT" UWORD B_TRUE 1 100 0 1 BIT_MASK 0x800 FORMAT "%13.11" ECU_ADDRESS 0xFD32 /end MEASUREMENT
/begin MEASUREMENT B_hzkfmvh "Bedingung Fehler Heizer-Einkopplung mit zeitlicher Verzögerung hinter KAT" UBYTE B_TRUE 1 100 0 1 BIT_MASK 0x1 FORMAT "%13.11" ECU_ADDRESS 0x380939 /end MEASUREMENT
/begin MEASUREMENT B_hzkhzyk "Bedingung Heizereinkopplung für Bildung Zyklusbit  hinter Haupt KAT" UWORD B_TRUE 1 100 0 1 BIT_MASK 0x1000 FORMAT "%13.11" ECU_ADDRESS 0xFD32 /end MEASUREMENT
/begin MEASUREMENT B_hzoffh "Bedingung Heizung ausgeschaltet  hinter Haupt KAT" UWORD B_TRUE 1 100 0 1 BIT_MASK 0x2000 FORMAT "%13.11" ECU_ADDRESS 0xFD32 /end MEASUREMENT
/begin MEASUREMENT B_lrasp "Bedingung stop LRA wegen LSU-Fehler" UBYTE B_TRUE 1 100 0 1 BIT_MASK 0x2 FORMAT "%13.11" ECU_ADDRESS 0x380955 /end MEASUREMENT
/begin MEASUREMENT B_lshklt "Bedingung Lambdasonde hinter Kat kalt" UWORD B_TRUE 1 100 0 1 BIT_MASK 0x4000 FORMAT "%13.11" ECU_ADDRESS 0xFD32 /end MEASUREMENT
/begin MEASUREMENT B_lshkpft "Bedingung Lambdasondensignal hinter dem Kat. plausibel fett" UBYTE B_TRUE 1 100 0 1 BIT_MASK 0x80 FORMAT "%13.11" ECU_ADDRESS 0x380956 /end MEASUREMENT
/begin MEASUREMENT B_lshkpmr "Bedingung Lambdasondensignal hinter dem Kat. plausibel mager" UBYTE B_TRUE 1 100 0 1 BIT_MASK 0x1 FORMAT "%13.11" ECU_ADDRESS 0x380957 /end MEASUREMENT
/begin MEASUREMENT B_lsuabgl "Bedingung Abgleichleitung stetige Lambda-Sonde LSU unterbrochen" UBYTE B_TRUE 1 100 0 1 BIT_MASK 0x2 FORMAT "%13.11" ECU_ADDRESS 0x380957 /end MEASUREMENT
/begin MEASUREMENT B_lsuft "LSU Bank1 fett, nicht plausibel" UBYTE B_TRUE 1 100 0 1 BIT_MASK 0x8 FORMAT "%13.11" ECU_ADDRESS 0x380958 /end MEASUREMENT
/begin MEASUREMENT B_lsufta "LSU Bank1 fett, nicht plausibel" UBYTE B_TRUE 1 100 0 1 BIT_MASK 0x4 FORMAT "%13.11" ECU_ADDRESS 0x380957 /end MEASUREMENT
/begin MEASUREMENT B_lsuftb "LSU Bank1 fett, nicht plausibel" UBYTE B_TRUE 1 100 0 1 BIT_MASK 0x8 FORMAT "%13.11" ECU_ADDRESS 0x380957 /end MEASUREMENT
/begin MEASUREMENT B_lsulone "Bedingung Lambdasondensignal ist Lambda = 1" UBYTE B_TRUE 1 100 0 1 BIT_MASK 0x10 FORMAT "%13.11" ECU_ADDRESS 0x380957 /end MEASUREMENT
/begin MEASUREMENT B_lsultk "Bedingung ""LSU-an-Luft-Fehler"" ist mit ""Tank-Leer-Bedingung"" entprellt" UBYTE B_TRUE 1 100 0 1 BIT_MASK 0x40 FORMAT "%13.11" ECU_ADDRESS 0x380959 /end MEASUREMENT
/begin MEASUREMENT B_lsumr "LSU Bank1 mager, nicht plausibel" UBYTE B_TRUE 1 100 0 1 BIT_MASK 0x20 FORMAT "%13.11" ECU_ADDRESS 0x380957 /end MEASUREMENT
/begin MEASUREMENT B_lsumra "LSU Bank1 mager, nicht plausibel" UBYTE B_TRUE 1 100 0 1 BIT_MASK 0x40 FORMAT "%13.11" ECU_ADDRESS 0x380957 /end MEASUREMENT
/begin MEASUREMENT B_lsumrb "LSU Bank1 mager, nicht plausibel" UBYTE B_TRUE 1 100 0 1 BIT_MASK 0x80 FORMAT "%13.11" ECU_ADDRESS 0x380957 /end MEASUREMENT
/begin MEASUREMENT B_lsumx "Maximalwert der LSU-Spannung überschritten (CJ110)" UBYTE B_TRUE 1 100 0 1 BIT_MASK 0x1 FORMAT "%13.11" ECU_ADDRESS 0x380958 /end MEASUREMENT
/begin MEASUREMENT B_lsuna "LSU nicht aktiv, Bank1" UBYTE B_TRUE 1 100 0 1 BIT_MASK 0x2 FORMAT "%13.11" ECU_ADDRESS 0x380958 /end MEASUREMENT
/begin MEASUREMENT B_lsupft "Bedingung Lambdasondensignal plausibel fett" UBYTE B_TRUE 1 100 0 1 BIT_MASK 0x4 FORMAT "%13.11" ECU_ADDRESS 0x380958 /end MEASUREMENT
/begin MEASUREMENT B_lsupmr "Bedingung Lambdasondensignal plausibel mager" UBYTE B_TRUE 1 100 0 1 BIT_MASK 0x10 FORMAT "%13.11" ECU_ADDRESS 0x380958 /end MEASUREMENT
/begin MEASUREMENT B_lsurfc "Bedingung: Resettiere Fehler Counter" UBYTE B_TRUE 1 100 0 1 BIT_MASK 0x20 FORMAT "%13.11" ECU_ADDRESS 0x380958 /end MEASUREMENT
/begin MEASUREMENT B_luft "LSU an Luft" UBYTE B_TRUE 1 100 0 1 BIT_MASK 0x40 FORMAT "%13.11" ECU_ADDRESS 0x380958 /end MEASUREMENT
/begin MEASUREMENT B_maxflsh "Kurzsschluß nach UBatt bei Sonde hinter KAT erkannt" UBYTE B_TRUE 1 100 0 1 BIT_MASK 0x1 FORMAT "%13.11" ECU_ADDRESS 0x380936 /end MEASUREMENT
/begin MEASUREMENT B_maxflsu "Lambdaoffset vor / hinter Kat zu groß, Bank1" UBYTE B_TRUE 1 100 0 1 BIT_MASK 0x80 FORMAT "%13.11" ECU_ADDRESS 0x380958 /end MEASUREMENT
/begin MEASUREMENT B_mderk "Aussetzer erkannt, Verknüpfung mehrerer Funktionen" UWORD B_TRUE 1 100 0 1 BIT_MASK 0x10 FORMAT "%13.11" ECU_ADDRESS 0xFDB8 /end MEASUREMENT
/begin MEASUREMENT B_minflsh "Adernschluß oder KS nach Masse bei Sonde  hinter KAT erkannt" UBYTE B_TRUE 1 100 0 1 BIT_MASK 0x4 FORMAT "%13.11" ECU_ADDRESS 0x380936 /end MEASUREMENT
/begin MEASUREMENT B_minflsu "Dynamikfehler LSU, Bank1" UBYTE B_TRUE 1 100 0 1 BIT_MASK 0x1 FORMAT "%13.11" ECU_ADDRESS 0x380959 /end MEASUREMENT
/begin MEASUREMENT B_noadsh "Bedingung kein Adernschluß bei Lambdasonden hinter Kat" UBYTE B_TRUE 1 100 0 1 BIT_MASK 0x40 FORMAT "%13.11" ECU_ADDRESS 0x380937 /end MEASUREMENT
/begin MEASUREMENT B_noflsv "Bedingung: es liegt kein Fehler im Fehlerpfad LSV vor" UBYTE B_TRUE 1 100 0 1 BIT_MASK 0x2 FORMAT "%13.11" ECU_ADDRESS 0x380959 /end MEASUREMENT
/begin MEASUREMENT B_nolsh "Bedingung Diagnosefunktion mit i.O.-Meldung hinter KAT beendet." UWORD B_TRUE 1 100 0 1 BIT_MASK 0x8000 FORMAT "%13.11" ECU_ADDRESS 0xFD32 /end MEASUREMENT
/begin MEASUREMENT B_nplflsh "Adernschluß bei Sonde hinter KAT erkannt" UBYTE B_TRUE 1 100 0 1 BIT_MASK 0x40 FORMAT "%13.11" ECU_ADDRESS 0x380936 /end MEASUREMENT
/begin MEASUREMENT B_nplflsu "Lambdasignal nicht plausibel" UBYTE B_TRUE 1 100 0 1 BIT_MASK 0x8 FORMAT "%13.11" ECU_ADDRESS 0x380955 /end MEASUREMENT
/begin MEASUREMENT B_npsna "Bedingung nicht plaus.: Sonde nicht aktiv" UBYTE B_TRUE 1 100 0 1 BIT_MASK 0x4 FORMAT "%13.11" ECU_ADDRESS 0x380959 /end MEASUREMENT
/begin MEASUREMENT B_npvshns "Bedingung nicht plaus.: Gemisch vor dem Kat Lambda=1, hinter dem Kat nicht" UBYTE B_TRUE 1 100 0 1 BIT_MASK 0x8 FORMAT "%13.11" ECU_ADDRESS 0x380959 /end MEASUREMENT
/begin MEASUREMENT B_plenvh "Freigabe DLSU Plauspfad" UBYTE B_TRUE 1 100 0 1 BIT_MASK 0x10 FORMAT "%13.11" ECU_ADDRESS 0x380959 /end MEASUREMENT
/begin MEASUREMENT B_plok "Plausibilität der FSE-Werte in allen Drehzahlbereichen gegeben" UWORD B_TRUE 1 100 0 1 BIT_MASK 0x1 FORMAT "%13.11" ECU_ADDRESS 0xFD24 /end MEASUREMENT
/begin MEASUREMENT B_plok01 "Plausibilität der FSE-Werte im Drehzahlbereich 01 gegeben" UBYTE B_TRUE 1 100 0 1 BIT_MASK 0x1 FORMAT "%13.11" ECU_ADDRESS 0x383258 /end MEASUREMENT
/begin MEASUREMENT B_plok02 "Plausibilität der FSE-Werte im Drehzahlbereich 02 gegeben" UBYTE B_TRUE 1 100 0 1 BIT_MASK 0x2 FORMAT "%13.11" ECU_ADDRESS 0x383258 /end MEASUREMENT
/begin MEASUREMENT B_plok03 "Plausibilität der FSE-Werte im Drehzahlbereich 03 gegeben" UBYTE B_TRUE 1 100 0 1 BIT_MASK 0x4 FORMAT "%13.11" ECU_ADDRESS 0x383258 /end MEASUREMENT
/begin MEASUREMENT B_plok04 "Plausibilität der FSE-Werte im Drehzahlbereich 04 gegeben" UBYTE B_TRUE 1 100 0 1 BIT_MASK 0x8 FORMAT "%13.11" ECU_ADDRESS 0x383258 /end MEASUREMENT
/begin MEASUREMENT B_plok05 "Plausibilität der FSE-Werte im Drehzahlbereich 05 gegeben" UBYTE B_TRUE 1 100 0 1 BIT_MASK 0x10 FORMAT "%13.11" ECU_ADDRESS 0x383258 /end MEASUREMENT
/begin MEASUREMENT B_plok06 "Plausibilität der FSE-Werte im Drehzahlbereich 06 gegeben" UBYTE B_TRUE 1 100 0 1 BIT_MASK 0x20 FORMAT "%13.11" ECU_ADDRESS 0x383258 /end MEASUREMENT
/begin MEASUREMENT B_plok07 "Plausibilität der FSE-Werte im Drehzahlbereich 07 gegeben" UBYTE B_TRUE 1 100 0 1 BIT_MASK 0x40 FORMAT "%13.11" ECU_ADDRESS 0x383258 /end MEASUREMENT
/begin MEASUREMENT B_plok08 "Plausibilität der FSE-Werte im Drehzahlbereich 08 gegeben" UBYTE B_TRUE 1 100 0 1 BIT_MASK 0x80 FORMAT "%13.11" ECU_ADDRESS 0x383258 /end MEASUREMENT
/begin MEASUREMENT B_plokn_m "Monitor, Plausibilität der FSE-Werte im aktuellen Drehzahlbereich gegeben" UBYTE B_TRUE 1 100 0 1 BIT_MASK 0x80 FORMAT "%13.11" ECU_ADDRESS 0xE3DB /end MEASUREMENT
/begin MEASUREMENT B_risigh "Bedingung Signalunterbrechung Sondenmasse mit Ri-Diagnose hinter KAT" UWORD B_TRUE 1 100 0 1 BIT_MASK 0x1 FORMAT "%13.11" ECU_ADDRESS 0xFD34 /end MEASUREMENT
/begin MEASUREMENT B_sbbhk "Bedingung Sonde betriebsbereit hinter Kat" UWORD B_TRUE 1 100 0 1 BIT_MASK 0x2 FORMAT "%13.11" ECU_ADDRESS 0xFD34 /end MEASUREMENT
/begin MEASUREMENT B_sigflsh "Signalunterbrechung (Kabelbruch) Bei Sonde hinter KAT erkannt" UBYTE B_TRUE 1 100 0 1 BIT_MASK 0x10 FORMAT "%13.11" ECU_ADDRESS 0x380936 /end MEASUREMENT
/begin MEASUREMENT B_sigflsu "Übersprechen vom Heizertakt auf Lambdasignal" UBYTE B_TRUE 1 100 0 1 BIT_MASK 0x20 FORMAT "%13.11" ECU_ADDRESS 0x380959 /end MEASUREMENT
/begin MEASUREMENT B_stcal "Bedingung: alle Eingangsbedingungen der Dynamikprüfung sind gegeben" UBYTE B_TRUE 1 100 0 1 BIT_MASK 0x2 FORMAT "%13.11" ECU_ADDRESS 0x383325 /end MEASUREMENT
/begin MEASUREMENT B_stcdyn "Bedingung Start Berechnung Dynamik der LSU" UBYTE B_TRUE 1 100 0 1 BIT_MASK 0x4 FORMAT "%13.11" ECU_ADDRESS 0x380955 /end MEASUREMENT
/begin MEASUREMENT B_trsah "Bedingung Kabelbruch für Sonde hinter KAT" UBYTE B_TRUE 1 100 0 1 BIT_MASK 0x4 FORMAT "%13.11" ECU_ADDRESS 0x380937 /end MEASUREMENT
/begin MEASUREMENT B_tsroov_m "Monitor, Bedingung Segmentzeit-Wordoverflow" UBYTE B_TRUE 1 100 0 1 BIT_MASK 0x20 FORMAT "%13.11" ECU_ADDRESS 0xE43C /end MEASUREMENT
/begin MEASUREMENT B_ttbmhh "Bedingung theoretische Sondenbetriebsbereitschaft hinter KAT mit Heizung" UWORD B_TRUE 1 100 0 1 BIT_MASK 0x4 FORMAT "%13.11" ECU_ADDRESS 0xFD34 /end MEASUREMENT
/begin MEASUREMENT B_tusmaxh "Bedingung KS nach UBatt wird zeitl. verz. in Fehlerspeicher übertrag.  h. KAT" UBYTE B_TRUE 1 100 0 1 BIT_MASK 0x40 FORMAT "%13.11" ECU_ADDRESS 0x380938 /end MEASUREMENT
/begin MEASUREMENT B_uhsig "Bedingung Sondenspannung hinter KAT im Spannungsband für Signalunterbrechung" UBYTE B_TRUE 1 100 0 1 BIT_MASK 0x1 FORMAT "%13.11" ECU_ADDRESS 0x380937 /end MEASUREMENT
/begin MEASUREMENT B_vlsuftb "Bedingung: LSU hat Kennlinienverschiebung nach fett (zeigt zu fett an)" UBYTE B_TRUE 1 100 0 1 BIT_MASK 0x1 FORMAT "%13.11" ECU_ADDRESS 0x384A6C /end MEASUREMENT
/begin MEASUREMENT B_vlsumrb "Bedingung: LSU hat Kennlinienverschiebung nach mager (zeigt zu mager an)" UBYTE B_TRUE 1 100 0 1 BIT_MASK 0x1 FORMAT "%13.11" ECU_ADDRESS 0x383325 /end MEASUREMENT
/begin MEASUREMENT B_zlshv "Hilfsbit zur Auswertung des Zyklusbits Z_lshv für Vertausch. Sonde h. Kat" UBYTE B_TRUE 1 100 0 1 BIT_MASK 0x8 FORMAT "%13.11" ECU_ADDRESS 0x380938 /end MEASUREMENT
/begin MEASUREMENT cfoxx "zeigt die Eigenschaften des aktuellen KF-Bereiches der Fuel-on/-off Adaption" UBYTE dez 1 100 0 255 FORMAT "%5.1" ECU_ADDRESS 0x383255 /end MEASUREMENT
/begin MEASUREMENT dfse01 "Status Plausibilitätsprüfung der fuel-on/-off Adaption im Drehzahlber.01 erfüllt" SBYTE dtsegn_b11p25divZyl 1 100 -2.8125 2.79053 FORMAT "%5.3" ECU_ADDRESS 0xE3F9 /end MEASUREMENT
/begin MEASUREMENT dfse02 "Status Plausibilitätsprüfung der fuel-on/-off Adaption im Drehzahlber.02erfüllt" SBYTE dtsegn_b11p25divZyl 1 100 -2.8125 2.79053 FORMAT "%5.3" ECU_ADDRESS 0xE3FA /end MEASUREMENT
/begin MEASUREMENT dfse03 "Status Plausibilitätsprüfung der fuel-on/-off Adaption im Drehzahlber.3 erfüllt" SBYTE dtsegn_b11p25divZyl 1 100 -2.8125 2.79053 FORMAT "%5.3" ECU_ADDRESS 0xE3FB /end MEASUREMENT
/begin MEASUREMENT dfse04 "Status Plausibilitätsprüfung der fuel-on/-off Adaption im Drehzahlber.4 erfüllt" SBYTE dtsegn_b11p25divZyl 1 100 -2.8125 2.79053 FORMAT "%5.3" ECU_ADDRESS 0xE3FC /end MEASUREMENT
/begin MEASUREMENT dfse05 "Status Plausibilitätsprüfung der fuel-on/-off Adaption im Drehzahlber.5 erfüllt" SBYTE dtsegn_b11p25divZyl 1 100 -2.8125 2.79053 FORMAT "%5.3" ECU_ADDRESS 0xE3FD /end MEASUREMENT
/begin MEASUREMENT dfse06 "Status Plausibilitätsprüfung der fuel-on/-off Adaption im Drehzahlber.6 erfüllt" SBYTE dtsegn_b11p25divZyl 1 100 -2.8125 2.79053 FORMAT "%5.3" ECU_ADDRESS 0xE3FE /end MEASUREMENT
/begin MEASUREMENT dfse07 "Status Plausibilitätsprüfung der fuel-on/-off Adaption im Drehzahlber.7 erfüllt" SBYTE dtsegn_b11p25divZyl 1 100 -2.8125 2.79053 FORMAT "%5.3" ECU_ADDRESS 0xE3FF /end MEASUREMENT
/begin MEASUREMENT dfse08 "Status Plausibilitätsprüfung der fuel-on/-off Adaption im Drehzahlber.8 erfüllt" SBYTE dtsegn_b11p25divZyl 1 100 -2.8125 2.79053 FORMAT "%5.3" ECU_ADDRESS 0xE400 /end MEASUREMENT
/begin MEASUREMENT dfsen "Differenz der FSE-Werte im Normalbetrieb im aktuellen n-Bereich" SBYTE dtsegn_b11p25divZyl 1 100 -2.8125 2.79053 FORMAT "%5.3" ECU_ADDRESS 0xE401 /end MEASUREMENT
/begin MEASUREMENT dfseresz "Resetzähler Plausibilitätsprüfung FSE" UWORD dez 1 100 0 65535 FORMAT "%8.2" ECU_ADDRESS 0x38384C /end MEASUREMENT
/begin MEASUREMENT dlahisa "I-Anteil LRSHK Signalausgabe DLSSA (SY_STETLR := TRUE), Bank 1" UBYTE fak_ub_b0p1_o0p05 1 100 -0.05 0.0496094 FORMAT "%7.5" ECU_ADDRESS 0x384878 /end MEASUREMENT
/begin MEASUREMENT DLSHerrors "" UBYTE dez 1 100 0 255 FORMAT "%5.1" ECU_ADDRESS 0x380936 /end MEASUREMENT
/begin MEASUREMENT DLSHintbits "" UBYTE dez 1 100 0 255 FORMAT "%5.1" ECU_ADDRESS 0x380937 /end MEASUREMENT
/begin MEASUREMENT DLSHintbits2 "" UBYTE dez 1 100 0 255 FORMAT "%5.1" ECU_ADDRESS 0x380938 /end MEASUREMENT
/begin MEASUREMENT DLSHintbits3 "" UBYTE dez 1 100 0 255 FORMAT "%5.1" ECU_ADDRESS 0x380939 /end MEASUREMENT
/begin MEASUREMENT dlurs "Laufunruhedifferenz-Referenzwert, signed" SBYTE luquant 1 100 -86.567 85.8907 FORMAT "%5.2" ECU_ADDRESS 0xE422 /end MEASUREMENT
/begin MEASUREMENT dlurs_m "Monitor, Laufunruhedifferenz-Referenzwert, signed, verzögerte Ausgabe" SBYTE luquant 1 100 -86.567 85.8907 FORMAT "%5.2" ECU_ADDRESS 0xE3D9 /end MEASUREMENT
/begin MEASUREMENT dluts "Laufunruhedifferenz-Testgröße, signed" SBYTE luquant 1 100 -86.567 85.8907 FORMAT "%5.2" ECU_ADDRESS 0xE405 /end MEASUREMENT
/begin MEASUREMENT dluts1 "Differenz Laufunruhe-Testgröße, signed" SBYTE luquant 1 100 -86.567 85.8907 FORMAT "%5.2" ECU_ADDRESS 0xE406 /end MEASUREMENT
/begin MEASUREMENT dluts2 "Differenz Laufunruhe-Testgröße, signed" SBYTE luquant 1 100 -86.567 85.8907 FORMAT "%5.2" ECU_ADDRESS 0xE407 /end MEASUREMENT
/begin MEASUREMENT dluts3 "Differenz Laufunruhe-Testgröße, signed" SBYTE luquant 1 100 -86.567 85.8907 FORMAT "%5.2" ECU_ADDRESS 0xE408 /end MEASUREMENT
/begin MEASUREMENT dluts4 "Differenz Laufunruhe-Testgröße, signed" SBYTE luquant 1 100 -86.567 85.8907 FORMAT "%5.2" ECU_ADDRESS 0xE409 /end MEASUREMENT
/begin MEASUREMENT dluts5 "Differenz Laufunruhe-Testgröße, signed" SBYTE luquant 1 100 -86.567 85.8907 FORMAT "%5.2" ECU_ADDRESS 0xE40A /end MEASUREMENT
/begin MEASUREMENT dluts6 "Differenz Laufunruhe-Testgröße, signed" SBYTE luquant 1 100 -86.567 85.8907 FORMAT "%5.2" ECU_ADDRESS 0xE40B /end MEASUREMENT
/begin MEASUREMENT dluts7 "Differenz Laufunruhe-Testgröße, signed" SBYTE luquant 1 100 -86.567 85.8907 FORMAT "%5.2" ECU_ADDRESS 0xE40C /end MEASUREMENT
/begin MEASUREMENT dluts8 "Differenz Laufunruhe-Testgröße, signed" SBYTE luquant 1 100 -86.567 85.8907 FORMAT "%5.2" ECU_ADDRESS 0xE40D /end MEASUREMENT
/begin MEASUREMENT dluts_m "Monitor, Laufunruhedifferenz-Testgröße, signed, verzögerte Ausgabe" SBYTE luquant 1 100 -86.567 85.8907 FORMAT "%5.2" ECU_ADDRESS 0xE3D8 /end MEASUREMENT
/begin MEASUREMENT dmrlsh_w "Momenten-Reserve für Sondendiagnose hinter Kat" UWORD rel_uw_b100 1 100 0 99.9985 FORMAT "%8.5" ECU_ADDRESS 0x384A2A /end MEASUREMENT
/begin MEASUREMENT dmrlsv_w "Momenten-Reserve für Sondendiagnose vor Kat" UWORD rel_uw_b100 1 100 0 99.9985 FORMAT "%8.5" ECU_ADDRESS 0x384A5E /end MEASUREMENT
/begin MEASUREMENT dynlsusa "Dynamikwert der LSU, DLSSA" UBYTE fak_q0p0195 1 100 0 4.98047 FORMAT "%5.3" ECU_ADDRESS 0x384879 /end MEASUREMENT
/begin MEASUREMENT dynlsu_w "Dynamikwert der LSU" UWORD fak_uw_b16 1 100 0 15.9998 FORMAT "%8.5" ECU_ADDRESS 0x383C5A /end MEASUREMENT
/begin MEASUREMENT esst_sdz03dmub "" UWORD dez 1 100 0 65535 FORMAT "%8.2" ECU_ADDRESS 0x380F8C /end MEASUREMENT
/begin MEASUREMENT esst_sdz08dmub "" UWORD dez 1 100 0 65535 FORMAT "%8.2" ECU_ADDRESS 0x380F8E /end MEASUREMENT
/begin MEASUREMENT fdmd_m "Statusflag diagnose misfire detection, Monitor, verzögerte Ausgabe" UBYTE DEZ 1 100 0 255 FORMAT "%5.1" ECU_ADDRESS 0xE3DB /end MEASUREMENT
/begin MEASUREMENT ffon "Statusbyte Übersicht fuel-on Adaption" UBYTE dez 1 100 0 255 FORMAT "%5.1" ECU_ADDRESS 0x383256 /end MEASUREMENT
/begin MEASUREMENT ffonn1 "Statusbyte fuel-on/-off Adaption (KF-Bereiche fertig gelernt)" UBYTE dez 1 100 0 255 FORMAT "%5.1" ECU_ADDRESS 0x383259 /end MEASUREMENT
/begin MEASUREMENT ffonn2 "Statusbyte fuel-on/-off Adaption (KF-Bereiche fertig gelernt)" UBYTE dez 1 100 0 255 FORMAT "%5.1" ECU_ADDRESS 0x38325A /end MEASUREMENT
/begin MEASUREMENT ffonn3 "Statusbyte fuel-on/-off Adaption (KF-Bereiche fertig gelernt)" UBYTE dez 1 100 0 255 FORMAT "%5.1" ECU_ADDRESS 0x38325B /end MEASUREMENT
/begin MEASUREMENT fforn1 "Statusbyte fuel-on/-off Adaption (n-Bereiche fertig gelernt)" UBYTE dez 1 100 0 255 FORMAT "%5.1" ECU_ADDRESS 0x383257 /end MEASUREMENT
/begin MEASUREMENT ffpl1 "Statusbyte der fuel-on/-off Adaption (FSE-Werte der Drz.-Bereiche plausibel I)" UBYTE dez 1 100 0 255 FORMAT "%5.1" ECU_ADDRESS 0x383258 /end MEASUREMENT
/begin MEASUREMENT flg_m "Monitor Status Laufunruhe-Berechnung" UBYTE DEZ 1 100 0 255 FORMAT "%5.1" ECU_ADDRESS 0xE43C /end MEASUREMENT
/begin MEASUREMENT flmx "aktuell maximaler Lernfilterwert" SWORD dtsegn_b720divZyl 1 100 -180 179.995 FORMAT "%8.4" ECU_ADDRESS 0xE4A0 /end MEASUREMENT
/begin MEASUREMENT flmxresz "Resetzähler Lernfilterwert weggelaufen" UWORD dez 1 100 0 65535 FORMAT "%8.2" ECU_ADDRESS 0x38384E /end MEASUREMENT
/begin MEASUREMENT fln11_02 "Lernfilterwert, negativ, Betriebsbereich 11, Zylinder 2" SWORD dtsegn_b720divZyl 1 100 -180 179.995 FORMAT "%8.4" ECU_ADDRESS 0x38345C /end MEASUREMENT
/begin MEASUREMENT fln11_03 "Lernfilterwert, negativ" SWORD dtsegn_b720divZyl 1 100 -180 179.995 FORMAT "%8.4" ECU_ADDRESS 0x38348C /end MEASUREMENT
/begin MEASUREMENT fln11_04 "Lernfilterwert, negativ" SWORD dtsegn_b720divZyl 1 100 -180 179.995 FORMAT "%8.4" ECU_ADDRESS 0x3834BC /end MEASUREMENT
/begin MEASUREMENT fln11_05 "Lernfilterwert, negativ" SWORD dtsegn_b720divZyl 1 100 -180 179.995 FORMAT "%8.4" ECU_ADDRESS 0x3834EC /end MEASUREMENT
/begin MEASUREMENT fln11_06 "Lernfilterwert, negativ" SWORD dtsegn_b720divZyl 1 100 -180 179.995 FORMAT "%8.4" ECU_ADDRESS 0x38351C /end MEASUREMENT
/begin MEASUREMENT fln11_07 "Lernfilterwert, negativ" SWORD dtsegn_b720divZyl 1 100 -180 179.995 FORMAT "%8.4" ECU_ADDRESS 0x38354C /end MEASUREMENT
/begin MEASUREMENT fln11_08 "Lernfilterwert, negativ" SWORD dtsegn_b720divZyl 1 100 -180 179.995 FORMAT "%8.4" ECU_ADDRESS 0x38357C /end MEASUREMENT
/begin MEASUREMENT fln12_02 "Lernfilterwert, negativ" SWORD dtsegn_b720divZyl 1 100 -180 179.995 FORMAT "%8.4" ECU_ADDRESS 0x38346C /end MEASUREMENT
/begin MEASUREMENT fln12_03 "Lernfilterwert, negativ" SWORD dtsegn_b720divZyl 1 100 -180 179.995 FORMAT "%8.4" ECU_ADDRESS 0x38349C /end MEASUREMENT
/begin MEASUREMENT fln12_04 "Lernfilterwert, negativ" SWORD dtsegn_b720divZyl 1 100 -180 179.995 FORMAT "%8.4" ECU_ADDRESS 0x3834CC /end MEASUREMENT
/begin MEASUREMENT fln12_05 "Lernfilterwert, negativ" SWORD dtsegn_b720divZyl 1 100 -180 179.995 FORMAT "%8.4" ECU_ADDRESS 0x3834FC /end MEASUREMENT
/begin MEASUREMENT fln12_06 "Lernfilterwert, negativ" SWORD dtsegn_b720divZyl 1 100 -180 179.995 FORMAT "%8.4" ECU_ADDRESS 0x38352C /end MEASUREMENT
/begin MEASUREMENT fln12_07 "Lernfilterwert, negativ" SWORD dtsegn_b720divZyl 1 100 -180 179.995 FORMAT "%8.4" ECU_ADDRESS 0x38355C /end MEASUREMENT
/begin MEASUREMENT fln12_08 "Lernfilterwert, negativ" SWORD dtsegn_b720divZyl 1 100 -180 179.995 FORMAT "%8.4" ECU_ADDRESS 0x38358C /end MEASUREMENT
/begin MEASUREMENT fln13_02 "Lernfilterwert, negativ" SWORD dtsegn_b720divZyl 1 100 -180 179.995 FORMAT "%8.4" ECU_ADDRESS 0x38347C /end MEASUREMENT
/begin MEASUREMENT fln13_03 "Lernfilterwert, negativ" SWORD dtsegn_b720divZyl 1 100 -180 179.995 FORMAT "%8.4" ECU_ADDRESS 0x3834AC /end MEASUREMENT
/begin MEASUREMENT fln13_04 "Lernfilterwert, negativ" SWORD dtsegn_b720divZyl 1 100 -180 179.995 FORMAT "%8.4" ECU_ADDRESS 0x3834DC /end MEASUREMENT
/begin MEASUREMENT fln13_05 "Lernfilterwert, negativ" SWORD dtsegn_b720divZyl 1 100 -180 179.995 FORMAT "%8.4" ECU_ADDRESS 0x38350C /end MEASUREMENT
/begin MEASUREMENT fln13_06 "Lernfilterwert, negativ" SWORD dtsegn_b720divZyl 1 100 -180 179.995 FORMAT "%8.4" ECU_ADDRESS 0x38353C /end MEASUREMENT
/begin MEASUREMENT fln13_07 "Lernfilterwert, negativ" SWORD dtsegn_b720divZyl 1 100 -180 179.995 FORMAT "%8.4" ECU_ADDRESS 0x38356C /end MEASUREMENT
/begin MEASUREMENT fln13_08 "Lernfilterwert, negativ" SWORD dtsegn_b720divZyl 1 100 -180 179.995 FORMAT "%8.4" ECU_ADDRESS 0x38359C /end MEASUREMENT
/begin MEASUREMENT fln21_02 "Lernfilterwert, negativ" SWORD dtsegn_b720divZyl 1 100 -180 179.995 FORMAT "%8.4" ECU_ADDRESS 0x38345E /end MEASUREMENT
/begin MEASUREMENT fln21_03 "Lernfilterwert, negativ" SWORD dtsegn_b720divZyl 1 100 -180 179.995 FORMAT "%8.4" ECU_ADDRESS 0x38348E /end MEASUREMENT
/begin MEASUREMENT fln21_04 "Lernfilterwert, negativ" SWORD dtsegn_b720divZyl 1 100 -180 179.995 FORMAT "%8.4" ECU_ADDRESS 0x3834BE /end MEASUREMENT
/begin MEASUREMENT fln21_05 "Lernfilterwert, negativ" SWORD dtsegn_b720divZyl 1 100 -180 179.995 FORMAT "%8.4" ECU_ADDRESS 0x3834EE /end MEASUREMENT
/begin MEASUREMENT fln21_06 "Lernfilterwert, negativ" SWORD dtsegn_b720divZyl 1 100 -180 179.995 FORMAT "%8.4" ECU_ADDRESS 0x38351E /end MEASUREMENT
/begin MEASUREMENT fln21_07 "Lernfilterwert, negativ" SWORD dtsegn_b720divZyl 1 100 -180 179.995 FORMAT "%8.4" ECU_ADDRESS 0x38354E /end MEASUREMENT
/begin MEASUREMENT fln21_08 "Lernfilterwert, negativ" SWORD dtsegn_b720divZyl 1 100 -180 179.995 FORMAT "%8.4" ECU_ADDRESS 0x38357E /end MEASUREMENT
/begin MEASUREMENT fln22_02 "Lernfilterwert, negativ" SWORD dtsegn_b720divZyl 1 100 -180 179.995 FORMAT "%8.4" ECU_ADDRESS 0x38346E /end MEASUREMENT
/begin MEASUREMENT fln22_03 "Lernfilterwert, negativ" SWORD dtsegn_b720divZyl 1 100 -180 179.995 FORMAT "%8.4" ECU_ADDRESS 0x38349E /end MEASUREMENT
/begin MEASUREMENT fln22_04 "Lernfilterwert, negativ" SWORD dtsegn_b720divZyl 1 100 -180 179.995 FORMAT "%8.4" ECU_ADDRESS 0x3834CE /end MEASUREMENT
/begin MEASUREMENT fln22_05 "Lernfilterwert, negativ" SWORD dtsegn_b720divZyl 1 100 -180 179.995 FORMAT "%8.4" ECU_ADDRESS 0x3834FE /end MEASUREMENT
/begin MEASUREMENT fln22_06 "Lernfilterwert, negativ" SWORD dtsegn_b720divZyl 1 100 -180 179.995 FORMAT "%8.4" ECU_ADDRESS 0x38352E /end MEASUREMENT
/begin MEASUREMENT fln22_07 "Lernfilterwert, negativ" SWORD dtsegn_b720divZyl 1 100 -180 179.995 FORMAT "%8.4" ECU_ADDRESS 0x38355E /end MEASUREMENT
/begin MEASUREMENT fln22_08 "Lernfilterwert, negativ" SWORD dtsegn_b720divZyl 1 100 -180 179.995 FORMAT "%8.4" ECU_ADDRESS 0x38358E /end MEASUREMENT
/begin MEASUREMENT fln23_02 "Lernfilterwert, negativ" SWORD dtsegn_b720divZyl 1 100 -180 179.995 FORMAT "%8.4" ECU_ADDRESS 0x38347E /end MEASUREMENT
/begin MEASUREMENT fln23_03 "Lernfilterwert, negativ" SWORD dtsegn_b720divZyl 1 100 -180 179.995 FORMAT "%8.4" ECU_ADDRESS 0x3834AE /end MEASUREMENT
/begin MEASUREMENT fln23_04 "Lernfilterwert, negativ" SWORD dtsegn_b720divZyl 1 100 -180 179.995 FORMAT "%8.4" ECU_ADDRESS 0x3834DE /end MEASUREMENT
/begin MEASUREMENT fln23_05 "Lernfilterwert, negativ" SWORD dtsegn_b720divZyl 1 100 -180 179.995 FORMAT "%8.4" ECU_ADDRESS 0x38350E /end MEASUREMENT
/begin MEASUREMENT fln23_06 "Lernfilterwert, negativ" SWORD dtsegn_b720divZyl 1 100 -180 179.995 FORMAT "%8.4" ECU_ADDRESS 0x38353E /end MEASUREMENT
/begin MEASUREMENT fln23_07 "Lernfilterwert, negativ" SWORD dtsegn_b720divZyl 1 100 -180 179.995 FORMAT "%8.4" ECU_ADDRESS 0x38356E /end MEASUREMENT
/begin MEASUREMENT fln23_08 "Lernfilterwert, negativ" SWORD dtsegn_b720divZyl 1 100 -180 179.995 FORMAT "%8.4" ECU_ADDRESS 0x38359E /end MEASUREMENT
/begin MEASUREMENT fln31_02 "Lernfilterwert, negativ" SWORD dtsegn_b720divZyl 1 100 -180 179.995 FORMAT "%8.4" ECU_ADDRESS 0x383460 /end MEASUREMENT
/begin MEASUREMENT fln31_03 "Lernfilterwert, negativ" SWORD dtsegn_b720divZyl 1 100 -180 179.995 FORMAT "%8.4" ECU_ADDRESS 0x383490 /end MEASUREMENT
/begin MEASUREMENT fln31_04 "Lernfilterwert, negativ" SWORD dtsegn_b720divZyl 1 100 -180 179.995 FORMAT "%8.4" ECU_ADDRESS 0x3834C0 /end MEASUREMENT
/begin MEASUREMENT fln31_05 "Lernfilterwert, negativ" SWORD dtsegn_b720divZyl 1 100 -180 179.995 FORMAT "%8.4" ECU_ADDRESS 0x3834F0 /end MEASUREMENT
/begin MEASUREMENT fln31_06 "Lernfilterwert, negativ" SWORD dtsegn_b720divZyl 1 100 -180 179.995 FORMAT "%8.4" ECU_ADDRESS 0x383520 /end MEASUREMENT
/begin MEASUREMENT fln31_07 "Lernfilterwert, negativ" SWORD dtsegn_b720divZyl 1 100 -180 179.995 FORMAT "%8.4" ECU_ADDRESS 0x383550 /end MEASUREMENT
/begin MEASUREMENT fln31_08 "Lernfilterwert, negativ" SWORD dtsegn_b720divZyl 1 100 -180 179.995 FORMAT "%8.4" ECU_ADDRESS 0x383580 /end MEASUREMENT
/begin MEASUREMENT fln32_02 "Lernfilterwert, negativ" SWORD dtsegn_b720divZyl 1 100 -180 179.995 FORMAT "%8.4" ECU_ADDRESS 0x383470 /end MEASUREMENT
/begin MEASUREMENT fln32_03 "Lernfilterwert, negativ" SWORD dtsegn_b720divZyl 1 100 -180 179.995 FORMAT "%8.4" ECU_ADDRESS 0x3834A0 /end MEASUREMENT
/begin MEASUREMENT fln32_04 "Lernfilterwert, negativ" SWORD dtsegn_b720divZyl 1 100 -180 179.995 FORMAT "%8.4" ECU_ADDRESS 0x3834D0 /end MEASUREMENT
/begin MEASUREMENT fln32_05 "Lernfilterwert, negativ" SWORD dtsegn_b720divZyl 1 100 -180 179.995 FORMAT "%8.4" ECU_ADDRESS 0x383500 /end MEASUREMENT
/begin MEASUREMENT fln32_06 "Lernfilterwert, negativ" SWORD dtsegn_b720divZyl 1 100 -180 179.995 FORMAT "%8.4" ECU_ADDRESS 0x383530 /end MEASUREMENT
/begin MEASUREMENT fln32_07 "Lernfilterwert, negativ" SWORD dtsegn_b720divZyl 1 100 -180 179.995 FORMAT "%8.4" ECU_ADDRESS 0x383560 /end MEASUREMENT
/begin MEASUREMENT fln32_08 "Lernfilterwert, negativ" SWORD dtsegn_b720divZyl 1 100 -180 179.995 FORMAT "%8.4" ECU_ADDRESS 0x383590 /end MEASUREMENT
/begin MEASUREMENT fln33_02 "Lernfilterwert, negativ" SWORD dtsegn_b720divZyl 1 100 -180 179.995 FORMAT "%8.4" ECU_ADDRESS 0x383480 /end MEASUREMENT
/begin MEASUREMENT fln33_03 "Lernfilterwert, negativ" SWORD dtsegn_b720divZyl 1 100 -180 179.995 FORMAT "%8.4" ECU_ADDRESS 0x3834B0 /end MEASUREMENT
/begin MEASUREMENT fln33_04 "Lernfilterwert, negativ" SWORD dtsegn_b720divZyl 1 100 -180 179.995 FORMAT "%8.4" ECU_ADDRESS 0x3834E0 /end MEASUREMENT
/begin MEASUREMENT fln33_05 "Lernfilterwert, negativ" SWORD dtsegn_b720divZyl 1 100 -180 179.995 FORMAT "%8.4" ECU_ADDRESS 0x383510 /end MEASUREMENT
/begin MEASUREMENT fln33_06 "Lernfilterwert, negativ" SWORD dtsegn_b720divZyl 1 100 -180 179.995 FORMAT "%8.4" ECU_ADDRESS 0x383540 /end MEASUREMENT
/begin MEASUREMENT fln33_07 "Lernfilterwert, negativ" SWORD dtsegn_b720divZyl 1 100 -180 179.995 FORMAT "%8.4" ECU_ADDRESS 0x383570 /end MEASUREMENT
/begin MEASUREMENT fln33_08 "Lernfilterwert, negativ" SWORD dtsegn_b720divZyl 1 100 -180 179.995 FORMAT "%8.4" ECU_ADDRESS 0x3835A0 /end MEASUREMENT
/begin MEASUREMENT fln41_02 "Lernfilterwert, negativ" SWORD dtsegn_b720divZyl 1 100 -180 179.995 FORMAT "%8.4" ECU_ADDRESS 0x383462 /end MEASUREMENT
/begin MEASUREMENT fln41_03 "Lernfilterwert, negativ" SWORD dtsegn_b720divZyl 1 100 -180 179.995 FORMAT "%8.4" ECU_ADDRESS 0x383492 /end MEASUREMENT
/begin MEASUREMENT fln41_04 "Lernfilterwert, negativ" SWORD dtsegn_b720divZyl 1 100 -180 179.995 FORMAT "%8.4" ECU_ADDRESS 0x3834C2 /end MEASUREMENT
/begin MEASUREMENT fln41_05 "Lernfilterwert, negativ" SWORD dtsegn_b720divZyl 1 100 -180 179.995 FORMAT "%8.4" ECU_ADDRESS 0x3834F2 /end MEASUREMENT
/begin MEASUREMENT fln41_06 "Lernfilterwert, negativ" SWORD dtsegn_b720divZyl 1 100 -180 179.995 FORMAT "%8.4" ECU_ADDRESS 0x383522 /end MEASUREMENT
/begin MEASUREMENT fln41_07 "Lernfilterwert, negativ" SWORD dtsegn_b720divZyl 1 100 -180 179.995 FORMAT "%8.4" ECU_ADDRESS 0x383552 /end MEASUREMENT
/begin MEASUREMENT fln41_08 "Lernfilterwert, negativ" SWORD dtsegn_b720divZyl 1 100 -180 179.995 FORMAT "%8.4" ECU_ADDRESS 0x383582 /end MEASUREMENT
/begin MEASUREMENT fln42_02 "Lernfilterwert, negativ" SWORD dtsegn_b720divZyl 1 100 -180 179.995 FORMAT "%8.4" ECU_ADDRESS 0x383472 /end MEASUREMENT
/begin MEASUREMENT fln42_03 "Lernfilterwert, negativ" SWORD dtsegn_b720divZyl 1 100 -180 179.995 FORMAT "%8.4" ECU_ADDRESS 0x3834A2 /end MEASUREMENT
/begin MEASUREMENT fln42_04 "Lernfilterwert, negativ" SWORD dtsegn_b720divZyl 1 100 -180 179.995 FORMAT "%8.4" ECU_ADDRESS 0x3834D2 /end MEASUREMENT
/begin MEASUREMENT fln42_05 "Lernfilterwert, negativ" SWORD dtsegn_b720divZyl 1 100 -180 179.995 FORMAT "%8.4" ECU_ADDRESS 0x383502 /end MEASUREMENT
/begin MEASUREMENT fln42_06 "Lernfilterwert, negativ" SWORD dtsegn_b720divZyl 1 100 -180 179.995 FORMAT "%8.4" ECU_ADDRESS 0x383532 /end MEASUREMENT
/begin MEASUREMENT fln42_07 "Lernfilterwert, negativ" SWORD dtsegn_b720divZyl 1 100 -180 179.995 FORMAT "%8.4" ECU_ADDRESS 0x383562 /end MEASUREMENT
/begin MEASUREMENT fln42_08 "Lernfilterwert, negativ" SWORD dtsegn_b720divZyl 1 100 -180 179.995 FORMAT "%8.4" ECU_ADDRESS 0x383592 /end MEASUREMENT
/begin MEASUREMENT fln43_02 "Lernfilterwert, negativ" SWORD dtsegn_b720divZyl 1 100 -180 179.995 FORMAT "%8.4" ECU_ADDRESS 0x383482 /end MEASUREMENT
/begin MEASUREMENT fln43_03 "Lernfilterwert, negativ" SWORD dtsegn_b720divZyl 1 100 -180 179.995 FORMAT "%8.4" ECU_ADDRESS 0x3834B2 /end MEASUREMENT
/begin MEASUREMENT fln43_04 "Lernfilterwert, negativ" SWORD dtsegn_b720divZyl 1 100 -180 179.995 FORMAT "%8.4" ECU_ADDRESS 0x3834E2 /end MEASUREMENT
/begin MEASUREMENT fln43_05 "Lernfilterwert, negativ" SWORD dtsegn_b720divZyl 1 100 -180 179.995 FORMAT "%8.4" ECU_ADDRESS 0x383512 /end MEASUREMENT
/begin MEASUREMENT fln43_06 "Lernfilterwert, negativ" SWORD dtsegn_b720divZyl 1 100 -180 179.995 FORMAT "%8.4" ECU_ADDRESS 0x383542 /end MEASUREMENT
/begin MEASUREMENT fln43_07 "Lernfilterwert, negativ" SWORD dtsegn_b720divZyl 1 100 -180 179.995 FORMAT "%8.4" ECU_ADDRESS 0x383572 /end MEASUREMENT
/begin MEASUREMENT fln43_08 "Lernfilterwert, negativ" SWORD dtsegn_b720divZyl 1 100 -180 179.995 FORMAT "%8.4" ECU_ADDRESS 0x3835A2 /end MEASUREMENT
/begin MEASUREMENT fln51_02 "Lernfilterwert, negativ" SWORD dtsegn_b720divZyl 1 100 -180 179.995 FORMAT "%8.4" ECU_ADDRESS 0x383464 /end MEASUREMENT
/begin MEASUREMENT fln51_03 "Lernfilterwert, negativ" SWORD dtsegn_b720divZyl 1 100 -180 179.995 FORMAT "%8.4" ECU_ADDRESS 0x383494 /end MEASUREMENT
/begin MEASUREMENT fln51_04 "Lernfilterwert, negativ" SWORD dtsegn_b720divZyl 1 100 -180 179.995 FORMAT "%8.4" ECU_ADDRESS 0x3834C4 /end MEASUREMENT
/begin MEASUREMENT fln51_05 "Lernfilterwert, negativ" SWORD dtsegn_b720divZyl 1 100 -180 179.995 FORMAT "%8.4" ECU_ADDRESS 0x3834F4 /end MEASUREMENT
/begin MEASUREMENT fln51_06 "Lernfilterwert, negativ" SWORD dtsegn_b720divZyl 1 100 -180 179.995 FORMAT "%8.4" ECU_ADDRESS 0x383524 /end MEASUREMENT
/begin MEASUREMENT fln51_07 "Lernfilterwert, negativ" SWORD dtsegn_b720divZyl 1 100 -180 179.995 FORMAT "%8.4" ECU_ADDRESS 0x383554 /end MEASUREMENT
/begin MEASUREMENT fln51_08 "Lernfilterwert, negativ" SWORD dtsegn_b720divZyl 1 100 -180 179.995 FORMAT "%8.4" ECU_ADDRESS 0x383584 /end MEASUREMENT
/begin MEASUREMENT fln52_02 "Lernfilterwert, negativ" SWORD dtsegn_b720divZyl 1 100 -180 179.995 FORMAT "%8.4" ECU_ADDRESS 0x383474 /end MEASUREMENT
/begin MEASUREMENT fln52_03 "Lernfilterwert, negativ" SWORD dtsegn_b720divZyl 1 100 -180 179.995 FORMAT "%8.4" ECU_ADDRESS 0x3834A4 /end MEASUREMENT
/begin MEASUREMENT fln52_04 "Lernfilterwert, negativ" SWORD dtsegn_b720divZyl 1 100 -180 179.995 FORMAT "%8.4" ECU_ADDRESS 0x3834D4 /end MEASUREMENT
/begin MEASUREMENT fln52_05 "Lernfilterwert, negativ" SWORD dtsegn_b720divZyl 1 100 -180 179.995 FORMAT "%8.4" ECU_ADDRESS 0x383504 /end MEASUREMENT
/begin MEASUREMENT fln52_06 "Lernfilterwert, negativ" SWORD dtsegn_b720divZyl 1 100 -180 179.995 FORMAT "%8.4" ECU_ADDRESS 0x383534 /end MEASUREMENT
/begin MEASUREMENT fln52_07 "Lernfilterwert, negativ" SWORD dtsegn_b720divZyl 1 100 -180 179.995 FORMAT "%8.4" ECU_ADDRESS 0x383564 /end MEASUREMENT
/begin MEASUREMENT fln52_08 "Lernfilterwert, negativ" SWORD dtsegn_b720divZyl 1 100 -180 179.995 FORMAT "%8.4" ECU_ADDRESS 0x383594 /end MEASUREMENT
/begin MEASUREMENT fln53_02 "Lernfilterwert, negativ" SWORD dtsegn_b720divZyl 1 100 -180 179.995 FORMAT "%8.4" ECU_ADDRESS 0x383484 /end MEASUREMENT
/begin MEASUREMENT fln53_03 "Lernfilterwert, negativ" SWORD dtsegn_b720divZyl 1 100 -180 179.995 FORMAT "%8.4" ECU_ADDRESS 0x3834B4 /end MEASUREMENT
/begin MEASUREMENT fln53_04 "Lernfilterwert, negativ" SWORD dtsegn_b720divZyl 1 100 -180 179.995 FORMAT "%8.4" ECU_ADDRESS 0x3834E4 /end MEASUREMENT
/begin MEASUREMENT fln53_05 "Lernfilterwert, negativ" SWORD dtsegn_b720divZyl 1 100 -180 179.995 FORMAT "%8.4" ECU_ADDRESS 0x383514 /end MEASUREMENT
/begin MEASUREMENT fln53_06 "Lernfilterwert, negativ" SWORD dtsegn_b720divZyl 1 100 -180 179.995 FORMAT "%8.4" ECU_ADDRESS 0x383544 /end MEASUREMENT
/begin MEASUREMENT fln53_07 "Lernfilterwert, negativ" SWORD dtsegn_b720divZyl 1 100 -180 179.995 FORMAT "%8.4" ECU_ADDRESS 0x383574 /end MEASUREMENT
/begin MEASUREMENT fln53_08 "Lernfilterwert, negativ" SWORD dtsegn_b720divZyl 1 100 -180 179.995 FORMAT "%8.4" ECU_ADDRESS 0x3835A4 /end MEASUREMENT
/begin MEASUREMENT fln61_02 "Lernfilterwert, negativ" SWORD dtsegn_b720divZyl 1 100 -180 179.995 FORMAT "%8.4" ECU_ADDRESS 0x383466 /end MEASUREMENT
/begin MEASUREMENT fln61_03 "Lernfilterwert, negativ" SWORD dtsegn_b720divZyl 1 100 -180 179.995 FORMAT "%8.4" ECU_ADDRESS 0x383496 /end MEASUREMENT
/begin MEASUREMENT fln61_04 "Lernfilterwert, negativ" SWORD dtsegn_b720divZyl 1 100 -180 179.995 FORMAT "%8.4" ECU_ADDRESS 0x3834C6 /end MEASUREMENT
/begin MEASUREMENT fln61_05 "Lernfilterwert, negativ" SWORD dtsegn_b720divZyl 1 100 -180 179.995 FORMAT "%8.4" ECU_ADDRESS 0x3834F6 /end MEASUREMENT
/begin MEASUREMENT fln61_06 "Lernfilterwert, negativ" SWORD dtsegn_b720divZyl 1 100 -180 179.995 FORMAT "%8.4" ECU_ADDRESS 0x383526 /end MEASUREMENT
/begin MEASUREMENT fln61_07 "Lernfilterwert, negativ" SWORD dtsegn_b720divZyl 1 100 -180 179.995 FORMAT "%8.4" ECU_ADDRESS 0x383556 /end MEASUREMENT
/begin MEASUREMENT fln61_08 "Lernfilterwert, negativ" SWORD dtsegn_b720divZyl 1 100 -180 179.995 FORMAT "%8.4" ECU_ADDRESS 0x383586 /end MEASUREMENT
/begin MEASUREMENT fln62_02 "Lernfilterwert, negativ" SWORD dtsegn_b720divZyl 1 100 -180 179.995 FORMAT "%8.4" ECU_ADDRESS 0x383476 /end MEASUREMENT
/begin MEASUREMENT fln62_03 "Lernfilterwert, negativ" SWORD dtsegn_b720divZyl 1 100 -180 179.995 FORMAT "%8.4" ECU_ADDRESS 0x3834A6 /end MEASUREMENT
/begin MEASUREMENT fln62_04 "Lernfilterwert, negativ" SWORD dtsegn_b720divZyl 1 100 -180 179.995 FORMAT "%8.4" ECU_ADDRESS 0x3834D6 /end MEASUREMENT
/begin MEASUREMENT fln62_05 "Lernfilterwert, negativ" SWORD dtsegn_b720divZyl 1 100 -180 179.995 FORMAT "%8.4" ECU_ADDRESS 0x383506 /end MEASUREMENT
/begin MEASUREMENT fln62_06 "Lernfilterwert, negativ" SWORD dtsegn_b720divZyl 1 100 -180 179.995 FORMAT "%8.4" ECU_ADDRESS 0x383536 /end MEASUREMENT
/begin MEASUREMENT fln62_07 "Lernfilterwert, negativ" SWORD dtsegn_b720divZyl 1 100 -180 179.995 FORMAT "%8.4" ECU_ADDRESS 0x383566 /end MEASUREMENT
/begin MEASUREMENT fln62_08 "Lernfilterwert, negativ" SWORD dtsegn_b720divZyl 1 100 -180 179.995 FORMAT "%8.4" ECU_ADDRESS 0x383596 /end MEASUREMENT
/begin MEASUREMENT fln63_02 "Lernfilterwert, negativ" SWORD dtsegn_b720divZyl 1 100 -180 179.995 FORMAT "%8.4" ECU_ADDRESS 0x383486 /end MEASUREMENT
/begin MEASUREMENT fln63_03 "Lernfilterwert, negativ" SWORD dtsegn_b720divZyl 1 100 -180 179.995 FORMAT "%8.4" ECU_ADDRESS 0x3834B6 /end MEASUREMENT
/begin MEASUREMENT fln63_04 "Lernfilterwert, negativ" SWORD dtsegn_b720divZyl 1 100 -180 179.995 FORMAT "%8.4" ECU_ADDRESS 0x3834E6 /end MEASUREMENT
/begin MEASUREMENT fln63_05 "Lernfilterwert, negativ" SWORD dtsegn_b720divZyl 1 100 -180 179.995 FORMAT "%8.4" ECU_ADDRESS 0x383516 /end MEASUREMENT
/begin MEASUREMENT fln63_06 "Lernfilterwert, negativ" SWORD dtsegn_b720divZyl 1 100 -180 179.995 FORMAT "%8.4" ECU_ADDRESS 0x383546 /end MEASUREMENT
/begin MEASUREMENT fln63_07 "Lernfilterwert, negativ" SWORD dtsegn_b720divZyl 1 100 -180 179.995 FORMAT "%8.4" ECU_ADDRESS 0x383576 /end MEASUREMENT
/begin MEASUREMENT fln63_08 "Lernfilterwert, negativ" SWORD dtsegn_b720divZyl 1 100 -180 179.995 FORMAT "%8.4" ECU_ADDRESS 0x3835A6 /end MEASUREMENT
/begin MEASUREMENT fln71_02 "Lernfilterwert, negativ" SWORD dtsegn_b720divZyl 1 100 -180 179.995 FORMAT "%8.4" ECU_ADDRESS 0x383468 /end MEASUREMENT
/begin MEASUREMENT fln71_03 "Lernfilterwert, negativ" SWORD dtsegn_b720divZyl 1 100 -180 179.995 FORMAT "%8.4" ECU_ADDRESS 0x383498 /end MEASUREMENT
/begin MEASUREMENT fln71_04 "Lernfilterwert, negativ" SWORD dtsegn_b720divZyl 1 100 -180 179.995 FORMAT "%8.4" ECU_ADDRESS 0x3834C8 /end MEASUREMENT
/begin MEASUREMENT fln71_05 "Lernfilterwert, negativ" SWORD dtsegn_b720divZyl 1 100 -180 179.995 FORMAT "%8.4" ECU_ADDRESS 0x3834F8 /end MEASUREMENT
/begin MEASUREMENT fln71_06 "Lernfilterwert, negativ" SWORD dtsegn_b720divZyl 1 100 -180 179.995 FORMAT "%8.4" ECU_ADDRESS 0x383528 /end MEASUREMENT
/begin MEASUREMENT fln71_07 "Lernfilterwert, negativ" SWORD dtsegn_b720divZyl 1 100 -180 179.995 FORMAT "%8.4" ECU_ADDRESS 0x383558 /end MEASUREMENT
/begin MEASUREMENT fln71_08 "Lernfilterwert, negativ" SWORD dtsegn_b720divZyl 1 100 -180 179.995 FORMAT "%8.4" ECU_ADDRESS 0x383588 /end MEASUREMENT
/begin MEASUREMENT fln72_02 "Lernfilterwert, negativ" SWORD dtsegn_b720divZyl 1 100 -180 179.995 FORMAT "%8.4" ECU_ADDRESS 0x383478 /end MEASUREMENT
/begin MEASUREMENT fln72_03 "Lernfilterwert, negativ" SWORD dtsegn_b720divZyl 1 100 -180 179.995 FORMAT "%8.4" ECU_ADDRESS 0x3834A8 /end MEASUREMENT
/begin MEASUREMENT fln72_04 "Lernfilterwert, negativ" SWORD dtsegn_b720divZyl 1 100 -180 179.995 FORMAT "%8.4" ECU_ADDRESS 0x3834D8 /end MEASUREMENT
/begin MEASUREMENT fln72_05 "Lernfilterwert, negativ" SWORD dtsegn_b720divZyl 1 100 -180 179.995 FORMAT "%8.4" ECU_ADDRESS 0x383508 /end MEASUREMENT
/begin MEASUREMENT fln72_06 "Lernfilterwert, negativ" SWORD dtsegn_b720divZyl 1 100 -180 179.995 FORMAT "%8.4" ECU_ADDRESS 0x383538 /end MEASUREMENT
/begin MEASUREMENT fln72_07 "Lernfilterwert, negativ" SWORD dtsegn_b720divZyl 1 100 -180 179.995 FORMAT "%8.4" ECU_ADDRESS 0x383568 /end MEASUREMENT
/begin MEASUREMENT fln72_08 "Lernfilterwert, negativ" SWORD dtsegn_b720divZyl 1 100 -180 179.995 FORMAT "%8.4" ECU_ADDRESS 0x383598 /end MEASUREMENT
/begin MEASUREMENT fln73_02 "Lernfilterwert, negativ" SWORD dtsegn_b720divZyl 1 100 -180 179.995 FORMAT "%8.4" ECU_ADDRESS 0x383488 /end MEASUREMENT
/begin MEASUREMENT fln73_03 "Lernfilterwert, negativ" SWORD dtsegn_b720divZyl 1 100 -180 179.995 FORMAT "%8.4" ECU_ADDRESS 0x3834B8 /end MEASUREMENT
/begin MEASUREMENT fln73_04 "Lernfilterwert, negativ" SWORD dtsegn_b720divZyl 1 100 -180 179.995 FORMAT "%8.4" ECU_ADDRESS 0x3834E8 /end MEASUREMENT
/begin MEASUREMENT fln73_05 "Lernfilterwert, negativ" SWORD dtsegn_b720divZyl 1 100 -180 179.995 FORMAT "%8.4" ECU_ADDRESS 0x383518 /end MEASUREMENT
/begin MEASUREMENT fln73_06 "Lernfilterwert, negativ" SWORD dtsegn_b720divZyl 1 100 -180 179.995 FORMAT "%8.4" ECU_ADDRESS 0x383548 /end MEASUREMENT
/begin MEASUREMENT fln73_07 "Lernfilterwert, negativ" SWORD dtsegn_b720divZyl 1 100 -180 179.995 FORMAT "%8.4" ECU_ADDRESS 0x383578 /end MEASUREMENT
/begin MEASUREMENT fln73_08 "Lernfilterwert, negativ" SWORD dtsegn_b720divZyl 1 100 -180 179.995 FORMAT "%8.4" ECU_ADDRESS 0x3835A8 /end MEASUREMENT
/begin MEASUREMENT fln81_02 "Lernfilterwert, negativ" SWORD dtsegn_b720divZyl 1 100 -180 179.995 FORMAT "%8.4" ECU_ADDRESS 0x38346A /end MEASUREMENT
/begin MEASUREMENT fln81_03 "Lernfilterwert, negativ" SWORD dtsegn_b720divZyl 1 100 -180 179.995 FORMAT "%8.4" ECU_ADDRESS 0x38349A /end MEASUREMENT
/begin MEASUREMENT fln81_04 "Lernfilterwert, negativ" SWORD dtsegn_b720divZyl 1 100 -180 179.995 FORMAT "%8.4" ECU_ADDRESS 0x3834CA /end MEASUREMENT
/begin MEASUREMENT fln81_05 "Lernfilterwert, negativ" SWORD dtsegn_b720divZyl 1 100 -180 179.995 FORMAT "%8.4" ECU_ADDRESS 0x3834FA /end MEASUREMENT
/begin MEASUREMENT fln81_06 "Lernfilterwert, negativ" SWORD dtsegn_b720divZyl 1 100 -180 179.995 FORMAT "%8.4" ECU_ADDRESS 0x38352A /end MEASUREMENT
/begin MEASUREMENT fln81_07 "Lernfilterwert, negativ" SWORD dtsegn_b720divZyl 1 100 -180 179.995 FORMAT "%8.4" ECU_ADDRESS 0x38355A /end MEASUREMENT
/begin MEASUREMENT fln81_08 "Lernfilterwert, negativ" SWORD dtsegn_b720divZyl 1 100 -180 179.995 FORMAT "%8.4" ECU_ADDRESS 0x38358A /end MEASUREMENT
/begin MEASUREMENT fln82_02 "Lernfilterwert, negativ" SWORD dtsegn_b720divZyl 1 100 -180 179.995 FORMAT "%8.4" ECU_ADDRESS 0x38347A /end MEASUREMENT
/begin MEASUREMENT fln82_03 "Lernfilterwert, negativ" SWORD dtsegn_b720divZyl 1 100 -180 179.995 FORMAT "%8.4" ECU_ADDRESS 0x3834AA /end MEASUREMENT
/begin MEASUREMENT fln82_04 "Lernfilterwert, negativ" SWORD dtsegn_b720divZyl 1 100 -180 179.995 FORMAT "%8.4" ECU_ADDRESS 0x3834DA /end MEASUREMENT
/begin MEASUREMENT fln82_05 "Lernfilterwert, negativ" SWORD dtsegn_b720divZyl 1 100 -180 179.995 FORMAT "%8.4" ECU_ADDRESS 0x38350A /end MEASUREMENT
/begin MEASUREMENT fln82_06 "Lernfilterwert, negativ" SWORD dtsegn_b720divZyl 1 100 -180 179.995 FORMAT "%8.4" ECU_ADDRESS 0x38353A /end MEASUREMENT
/begin MEASUREMENT fln82_07 "Lernfilterwert, negativ" SWORD dtsegn_b720divZyl 1 100 -180 179.995 FORMAT "%8.4" ECU_ADDRESS 0x38356A /end MEASUREMENT
/begin MEASUREMENT fln82_08 "Lernfilterwert, negativ" SWORD dtsegn_b720divZyl 1 100 -180 179.995 FORMAT "%8.4" ECU_ADDRESS 0x38359A /end MEASUREMENT
/begin MEASUREMENT fln83_02 "Lernfilterwert, negativ" SWORD dtsegn_b720divZyl 1 100 -180 179.995 FORMAT "%8.4" ECU_ADDRESS 0x38348A /end MEASUREMENT
/begin MEASUREMENT fln83_03 "Lernfilterwert, negativ" SWORD dtsegn_b720divZyl 1 100 -180 179.995 FORMAT "%8.4" ECU_ADDRESS 0x3834BA /end MEASUREMENT
/begin MEASUREMENT fln83_04 "Lernfilterwert, negativ" SWORD dtsegn_b720divZyl 1 100 -180 179.995 FORMAT "%8.4" ECU_ADDRESS 0x3834EA /end MEASUREMENT
/begin MEASUREMENT fln83_05 "Lernfilterwert, negativ" SWORD dtsegn_b720divZyl 1 100 -180 179.995 FORMAT "%8.4" ECU_ADDRESS 0x38351A /end MEASUREMENT
/begin MEASUREMENT fln83_06 "Lernfilterwert, negativ" SWORD dtsegn_b720divZyl 1 100 -180 179.995 FORMAT "%8.4" ECU_ADDRESS 0x38354A /end MEASUREMENT
/begin MEASUREMENT fln83_07 "Lernfilterwert, negativ" SWORD dtsegn_b720divZyl 1 100 -180 179.995 FORMAT "%8.4" ECU_ADDRESS 0x38357A /end MEASUREMENT
/begin MEASUREMENT fln83_08 "Lernfilterwert, negativ" SWORD dtsegn_b720divZyl 1 100 -180 179.995 FORMAT "%8.4" ECU_ADDRESS 0x3835AA /end MEASUREMENT
/begin MEASUREMENT flp11_02 "Lernfilterwert, positiv" SWORD dtsegn_b720divZyl 1 100 -180 179.995 FORMAT "%8.4" ECU_ADDRESS 0x3835AC /end MEASUREMENT
/begin MEASUREMENT flp11_03 "Lernfilterwert, positiv" SWORD dtsegn_b720divZyl 1 100 -180 179.995 FORMAT "%8.4" ECU_ADDRESS 0x3835DC /end MEASUREMENT
/begin MEASUREMENT flp11_04 "Lernfilterwert, positiv" SWORD dtsegn_b720divZyl 1 100 -180 179.995 FORMAT "%8.4" ECU_ADDRESS 0x38360C /end MEASUREMENT
/begin MEASUREMENT flp11_05 "Lernfilterwert, positiv" SWORD dtsegn_b720divZyl 1 100 -180 179.995 FORMAT "%8.4" ECU_ADDRESS 0x38363C /end MEASUREMENT
/begin MEASUREMENT flp11_06 "Lernfilterwert, positiv" SWORD dtsegn_b720divZyl 1 100 -180 179.995 FORMAT "%8.4" ECU_ADDRESS 0x38366C /end MEASUREMENT
/begin MEASUREMENT flp11_07 "Lernfilterwert, positiv" SWORD dtsegn_b720divZyl 1 100 -180 179.995 FORMAT "%8.4" ECU_ADDRESS 0x38369C /end MEASUREMENT
/begin MEASUREMENT flp11_08 "Lernfilterwert, positiv" SWORD dtsegn_b720divZyl 1 100 -180 179.995 FORMAT "%8.4" ECU_ADDRESS 0x3836CC /end MEASUREMENT
/begin MEASUREMENT flp12_02 "Lernfilterwert, positiv" SWORD dtsegn_b720divZyl 1 100 -180 179.995 FORMAT "%8.4" ECU_ADDRESS 0x3835BC /end MEASUREMENT
/begin MEASUREMENT flp12_03 "Lernfilterwert, positiv" SWORD dtsegn_b720divZyl 1 100 -180 179.995 FORMAT "%8.4" ECU_ADDRESS 0x3835EC /end MEASUREMENT
/begin MEASUREMENT flp12_04 "Lernfilterwert, positiv" SWORD dtsegn_b720divZyl 1 100 -180 179.995 FORMAT "%8.4" ECU_ADDRESS 0x38361C /end MEASUREMENT
/begin MEASUREMENT flp12_05 "Lernfilterwert, positiv" SWORD dtsegn_b720divZyl 1 100 -180 179.995 FORMAT "%8.4" ECU_ADDRESS 0x38364C /end MEASUREMENT
/begin MEASUREMENT flp12_06 "Lernfilterwert, positiv" SWORD dtsegn_b720divZyl 1 100 -180 179.995 FORMAT "%8.4" ECU_ADDRESS 0x38367C /end MEASUREMENT
/begin MEASUREMENT flp12_07 "Lernfilterwert, positiv" SWORD dtsegn_b720divZyl 1 100 -180 179.995 FORMAT "%8.4" ECU_ADDRESS 0x3836AC /end MEASUREMENT
/begin MEASUREMENT flp12_08 "Lernfilterwert, positiv" SWORD dtsegn_b720divZyl 1 100 -180 179.995 FORMAT "%8.4" ECU_ADDRESS 0x3836DC /end MEASUREMENT
/begin MEASUREMENT flp13_02 "Lernfilterwert, positiv" SWORD dtsegn_b720divZyl 1 100 -180 179.995 FORMAT "%8.4" ECU_ADDRESS 0x3835CC /end MEASUREMENT
/begin MEASUREMENT flp13_03 "Lernfilterwert, positiv" SWORD dtsegn_b720divZyl 1 100 -180 179.995 FORMAT "%8.4" ECU_ADDRESS 0x3835FC /end MEASUREMENT
/begin MEASUREMENT flp13_04 "Lernfilterwert, positiv" SWORD dtsegn_b720divZyl 1 100 -180 179.995 FORMAT "%8.4" ECU_ADDRESS 0x38362C /end MEASUREMENT
/begin MEASUREMENT flp13_05 "Lernfilterwert, positiv" SWORD dtsegn_b720divZyl 1 100 -180 179.995 FORMAT "%8.4" ECU_ADDRESS 0x38365C /end MEASUREMENT
/begin MEASUREMENT flp13_06 "Lernfilterwert, positiv" SWORD dtsegn_b720divZyl 1 100 -180 179.995 FORMAT "%8.4" ECU_ADDRESS 0x38368C /end MEASUREMENT
/begin MEASUREMENT flp13_07 "Lernfilterwert, positiv" SWORD dtsegn_b720divZyl 1 100 -180 179.995 FORMAT "%8.4" ECU_ADDRESS 0x3836BC /end MEASUREMENT
/begin MEASUREMENT flp13_08 "Lernfilterwert, positiv" SWORD dtsegn_b720divZyl 1 100 -180 179.995 FORMAT "%8.4" ECU_ADDRESS 0x3836EC /end MEASUREMENT
/begin MEASUREMENT flp21_02 "Lernfilterwert, positiv" SWORD dtsegn_b720divZyl 1 100 -180 179.995 FORMAT "%8.4" ECU_ADDRESS 0x3835AE /end MEASUREMENT
/begin MEASUREMENT flp21_03 "Lernfilterwert, positiv" SWORD dtsegn_b720divZyl 1 100 -180 179.995 FORMAT "%8.4" ECU_ADDRESS 0x3835DE /end MEASUREMENT
/begin MEASUREMENT flp21_04 "Lernfilterwert, positiv" SWORD dtsegn_b720divZyl 1 100 -180 179.995 FORMAT "%8.4" ECU_ADDRESS 0x38360E /end MEASUREMENT
/begin MEASUREMENT flp21_05 "Lernfilterwert, positiv" SWORD dtsegn_b720divZyl 1 100 -180 179.995 FORMAT "%8.4" ECU_ADDRESS 0x38363E /end MEASUREMENT
/begin MEASUREMENT flp21_06 "Lernfilterwert, positiv" SWORD dtsegn_b720divZyl 1 100 -180 179.995 FORMAT "%8.4" ECU_ADDRESS 0x38366E /end MEASUREMENT
/begin MEASUREMENT flp21_07 "Lernfilterwert, positiv" SWORD dtsegn_b720divZyl 1 100 -180 179.995 FORMAT "%8.4" ECU_ADDRESS 0x38369E /end MEASUREMENT
/begin MEASUREMENT flp21_08 "Lernfilterwert, positiv" SWORD dtsegn_b720divZyl 1 100 -180 179.995 FORMAT "%8.4" ECU_ADDRESS 0x3836CE /end MEASUREMENT
/begin MEASUREMENT flp22_02 "Lernfilterwert, positiv" SWORD dtsegn_b720divZyl 1 100 -180 179.995 FORMAT "%8.4" ECU_ADDRESS 0x3835BE /end MEASUREMENT
/begin MEASUREMENT flp22_03 "Lernfilterwert, positiv" SWORD dtsegn_b720divZyl 1 100 -180 179.995 FORMAT "%8.4" ECU_ADDRESS 0x3835EE /end MEASUREMENT
/begin MEASUREMENT flp22_04 "Lernfilterwert, positiv" SWORD dtsegn_b720divZyl 1 100 -180 179.995 FORMAT "%8.4" ECU_ADDRESS 0x38361E /end MEASUREMENT
/begin MEASUREMENT flp22_05 "Lernfilterwert, positiv" SWORD dtsegn_b720divZyl 1 100 -180 179.995 FORMAT "%8.4" ECU_ADDRESS 0x38364E /end MEASUREMENT
/begin MEASUREMENT flp22_06 "Lernfilterwert, positiv" SWORD dtsegn_b720divZyl 1 100 -180 179.995 FORMAT "%8.4" ECU_ADDRESS 0x38367E /end MEASUREMENT
/begin MEASUREMENT flp22_07 "Lernfilterwert, positiv" SWORD dtsegn_b720divZyl 1 100 -180 179.995 FORMAT "%8.4" ECU_ADDRESS 0x3836AE /end MEASUREMENT
/begin MEASUREMENT flp22_08 "Lernfilterwert, positiv" SWORD dtsegn_b720divZyl 1 100 -180 179.995 FORMAT "%8.4" ECU_ADDRESS 0x3836DE /end MEASUREMENT
/begin MEASUREMENT flp23_02 "Lernfilterwert, positiv" SWORD dtsegn_b720divZyl 1 100 -180 179.995 FORMAT "%8.4" ECU_ADDRESS 0x3835CE /end MEASUREMENT
/begin MEASUREMENT flp23_03 "Lernfilterwert, positiv" SWORD dtsegn_b720divZyl 1 100 -180 179.995 FORMAT "%8.4" ECU_ADDRESS 0x3835FE /end MEASUREMENT
/begin MEASUREMENT flp23_04 "Lernfilterwert, positiv" SWORD dtsegn_b720divZyl 1 100 -180 179.995 FORMAT "%8.4" ECU_ADDRESS 0x38362E /end MEASUREMENT
/begin MEASUREMENT flp23_05 "Lernfilterwert, positiv" SWORD dtsegn_b720divZyl 1 100 -180 179.995 FORMAT "%8.4" ECU_ADDRESS 0x38365E /end MEASUREMENT
/begin MEASUREMENT flp23_06 "Lernfilterwert, positiv" SWORD dtsegn_b720divZyl 1 100 -180 179.995 FORMAT "%8.4" ECU_ADDRESS 0x38368E /end MEASUREMENT
/begin MEASUREMENT flp23_07 "Lernfilterwert, positiv" SWORD dtsegn_b720divZyl 1 100 -180 179.995 FORMAT "%8.4" ECU_ADDRESS 0x3836BE /end MEASUREMENT
/begin MEASUREMENT flp23_08 "Lernfilterwert, positiv" SWORD dtsegn_b720divZyl 1 100 -180 179.995 FORMAT "%8.4" ECU_ADDRESS 0x3836EE /end MEASUREMENT
/begin MEASUREMENT flp31_02 "Lernfilterwert, positiv" SWORD dtsegn_b720divZyl 1 100 -180 179.995 FORMAT "%8.4" ECU_ADDRESS 0x3835B0 /end MEASUREMENT
/begin MEASUREMENT flp31_03 "Lernfilterwert, positiv" SWORD dtsegn_b720divZyl 1 100 -180 179.995 FORMAT "%8.4" ECU_ADDRESS 0x3835E0 /end MEASUREMENT
/begin MEASUREMENT flp31_04 "Lernfilterwert, positiv" SWORD dtsegn_b720divZyl 1 100 -180 179.995 FORMAT "%8.4" ECU_ADDRESS 0x383610 /end MEASUREMENT
/begin MEASUREMENT flp31_05 "Lernfilterwert, positiv" SWORD dtsegn_b720divZyl 1 100 -180 179.995 FORMAT "%8.4" ECU_ADDRESS 0x383640 /end MEASUREMENT
/begin MEASUREMENT flp31_06 "Lernfilterwert, positiv" SWORD dtsegn_b720divZyl 1 100 -180 179.995 FORMAT "%8.4" ECU_ADDRESS 0x383670 /end MEASUREMENT
/begin MEASUREMENT flp31_07 "Lernfilterwert, positiv" SWORD dtsegn_b720divZyl 1 100 -180 179.995 FORMAT "%8.4" ECU_ADDRESS 0x3836A0 /end MEASUREMENT
/begin MEASUREMENT flp31_08 "Lernfilterwert, positiv" SWORD dtsegn_b720divZyl 1 100 -180 179.995 FORMAT "%8.4" ECU_ADDRESS 0x3836D0 /end MEASUREMENT
/begin MEASUREMENT flp32_02 "Lernfilterwert, positiv" SWORD dtsegn_b720divZyl 1 100 -180 179.995 FORMAT "%8.4" ECU_ADDRESS 0x3835C0 /end MEASUREMENT
/begin MEASUREMENT flp32_03 "Lernfilterwert, positiv" SWORD dtsegn_b720divZyl 1 100 -180 179.995 FORMAT "%8.4" ECU_ADDRESS 0x3835F0 /end MEASUREMENT
/begin MEASUREMENT flp32_04 "Lernfilterwert, positiv" SWORD dtsegn_b720divZyl 1 100 -180 179.995 FORMAT "%8.4" ECU_ADDRESS 0x383620 /end MEASUREMENT
/begin MEASUREMENT flp32_05 "Lernfilterwert, positiv" SWORD dtsegn_b720divZyl 1 100 -180 179.995 FORMAT "%8.4" ECU_ADDRESS 0x383650 /end MEASUREMENT
/begin MEASUREMENT flp32_06 "Lernfilterwert, positiv" SWORD dtsegn_b720divZyl 1 100 -180 179.995 FORMAT "%8.4" ECU_ADDRESS 0x383680 /end MEASUREMENT
/begin MEASUREMENT flp32_07 "Lernfilterwert, positiv" SWORD dtsegn_b720divZyl 1 100 -180 179.995 FORMAT "%8.4" ECU_ADDRESS 0x3836B0 /end MEASUREMENT
/begin MEASUREMENT flp32_08 "Lernfilterwert, positiv" SWORD dtsegn_b720divZyl 1 100 -180 179.995 FORMAT "%8.4" ECU_ADDRESS 0x3836E0 /end MEASUREMENT
/begin MEASUREMENT flp33_02 "Lernfilterwert, positiv" SWORD dtsegn_b720divZyl 1 100 -180 179.995 FORMAT "%8.4" ECU_ADDRESS 0x3835D0 /end MEASUREMENT
/begin MEASUREMENT flp33_03 "Lernfilterwert, positiv" SWORD dtsegn_b720divZyl 1 100 -180 179.995 FORMAT "%8.4" ECU_ADDRESS 0x383600 /end MEASUREMENT
/begin MEASUREMENT flp33_04 "Lernfilterwert, positiv" SWORD dtsegn_b720divZyl 1 100 -180 179.995 FORMAT "%8.4" ECU_ADDRESS 0x383630 /end MEASUREMENT
/begin MEASUREMENT flp33_05 "Lernfilterwert, positiv" SWORD dtsegn_b720divZyl 1 100 -180 179.995 FORMAT "%8.4" ECU_ADDRESS 0x383660 /end MEASUREMENT
/begin MEASUREMENT flp33_06 "Lernfilterwert, positiv" SWORD dtsegn_b720divZyl 1 100 -180 179.995 FORMAT "%8.4" ECU_ADDRESS 0x383690 /end MEASUREMENT
/begin MEASUREMENT flp33_07 "Lernfilterwert, positiv" SWORD dtsegn_b720divZyl 1 100 -180 179.995 FORMAT "%8.4" ECU_ADDRESS 0x3836C0 /end MEASUREMENT
/begin MEASUREMENT flp33_08 "Lernfilterwert, positiv" SWORD dtsegn_b720divZyl 1 100 -180 179.995 FORMAT "%8.4" ECU_ADDRESS 0x3836F0 /end MEASUREMENT
/begin MEASUREMENT flp41_02 "Lernfilterwert, positiv" SWORD dtsegn_b720divZyl 1 100 -180 179.995 FORMAT "%8.4" ECU_ADDRESS 0x3835B2 /end MEASUREMENT
/begin MEASUREMENT flp41_03 "Lernfilterwert, positiv" SWORD dtsegn_b720divZyl 1 100 -180 179.995 FORMAT "%8.4" ECU_ADDRESS 0x3835E2 /end MEASUREMENT
/begin MEASUREMENT flp41_04 "Lernfilterwert, positiv" SWORD dtsegn_b720divZyl 1 100 -180 179.995 FORMAT "%8.4" ECU_ADDRESS 0x383612 /end MEASUREMENT
/begin MEASUREMENT flp41_05 "Lernfilterwert, positiv" SWORD dtsegn_b720divZyl 1 100 -180 179.995 FORMAT "%8.4" ECU_ADDRESS 0x383642 /end MEASUREMENT
/begin MEASUREMENT flp41_06 "Lernfilterwert, positiv" SWORD dtsegn_b720divZyl 1 100 -180 179.995 FORMAT "%8.4" ECU_ADDRESS 0x383672 /end MEASUREMENT
/begin MEASUREMENT flp41_07 "Lernfilterwert, positiv" SWORD dtsegn_b720divZyl 1 100 -180 179.995 FORMAT "%8.4" ECU_ADDRESS 0x3836A2 /end MEASUREMENT
/begin MEASUREMENT flp41_08 "Lernfilterwert, positiv" SWORD dtsegn_b720divZyl 1 100 -180 179.995 FORMAT "%8.4" ECU_ADDRESS 0x3836D2 /end MEASUREMENT
/begin MEASUREMENT flp42_02 "Lernfilterwert, positiv" SWORD dtsegn_b720divZyl 1 100 -180 179.995 FORMAT "%8.4" ECU_ADDRESS 0x3835C2 /end MEASUREMENT
/begin MEASUREMENT flp42_03 "Lernfilterwert, positiv" SWORD dtsegn_b720divZyl 1 100 -180 179.995 FORMAT "%8.4" ECU_ADDRESS 0x3835F2 /end MEASUREMENT
/begin MEASUREMENT flp42_04 "Lernfilterwert, positiv" SWORD dtsegn_b720divZyl 1 100 -180 179.995 FORMAT "%8.4" ECU_ADDRESS 0x383622 /end MEASUREMENT
/begin MEASUREMENT flp42_05 "Lernfilterwert, positiv" SWORD dtsegn_b720divZyl 1 100 -180 179.995 FORMAT "%8.4" ECU_ADDRESS 0x383652 /end MEASUREMENT
/begin MEASUREMENT flp42_06 "Lernfilterwert, positiv" SWORD dtsegn_b720divZyl 1 100 -180 179.995 FORMAT "%8.4" ECU_ADDRESS 0x383682 /end MEASUREMENT
/begin MEASUREMENT flp42_07 "Lernfilterwert, positiv" SWORD dtsegn_b720divZyl 1 100 -180 179.995 FORMAT "%8.4" ECU_ADDRESS 0x3836B2 /end MEASUREMENT
/begin MEASUREMENT flp42_08 "Lernfilterwert, positiv" SWORD dtsegn_b720divZyl 1 100 -180 179.995 FORMAT "%8.4" ECU_ADDRESS 0x3836E2 /end MEASUREMENT
/begin MEASUREMENT flp43_02 "Lernfilterwert, positiv" SWORD dtsegn_b720divZyl 1 100 -180 179.995 FORMAT "%8.4" ECU_ADDRESS 0x3835D2 /end MEASUREMENT
/begin MEASUREMENT flp43_03 "Lernfilterwert, positiv" SWORD dtsegn_b720divZyl 1 100 -180 179.995 FORMAT "%8.4" ECU_ADDRESS 0x383602 /end MEASUREMENT
/begin MEASUREMENT flp43_04 "Lernfilterwert, positiv" SWORD dtsegn_b720divZyl 1 100 -180 179.995 FORMAT "%8.4" ECU_ADDRESS 0x383632 /end MEASUREMENT
/begin MEASUREMENT flp43_05 "Lernfilterwert, positiv" SWORD dtsegn_b720divZyl 1 100 -180 179.995 FORMAT "%8.4" ECU_ADDRESS 0x383662 /end MEASUREMENT
/begin MEASUREMENT flp43_06 "Lernfilterwert, positiv" SWORD dtsegn_b720divZyl 1 100 -180 179.995 FORMAT "%8.4" ECU_ADDRESS 0x383692 /end MEASUREMENT
/begin MEASUREMENT flp43_07 "Lernfilterwert, positiv" SWORD dtsegn_b720divZyl 1 100 -180 179.995 FORMAT "%8.4" ECU_ADDRESS 0x3836C2 /end MEASUREMENT
/begin MEASUREMENT flp43_08 "Lernfilterwert, positiv" SWORD dtsegn_b720divZyl 1 100 -180 179.995 FORMAT "%8.4" ECU_ADDRESS 0x3836F2 /end MEASUREMENT
/begin MEASUREMENT flp51_02 "Lernfilterwert, positiv" SWORD dtsegn_b720divZyl 1 100 -180 179.995 FORMAT "%8.4" ECU_ADDRESS 0x3835B4 /end MEASUREMENT
/begin MEASUREMENT flp51_03 "Lernfilterwert, positiv" SWORD dtsegn_b720divZyl 1 100 -180 179.995 FORMAT "%8.4" ECU_ADDRESS 0x3835E4 /end MEASUREMENT
/begin MEASUREMENT flp51_04 "Lernfilterwert, positiv" SWORD dtsegn_b720divZyl 1 100 -180 179.995 FORMAT "%8.4" ECU_ADDRESS 0x383614 /end MEASUREMENT
/begin MEASUREMENT flp51_05 "Lernfilterwert, positiv" SWORD dtsegn_b720divZyl 1 100 -180 179.995 FORMAT "%8.4" ECU_ADDRESS 0x383644 /end MEASUREMENT
/begin MEASUREMENT flp51_06 "Lernfilterwert, positiv" SWORD dtsegn_b720divZyl 1 100 -180 179.995 FORMAT "%8.4" ECU_ADDRESS 0x383674 /end MEASUREMENT
/begin MEASUREMENT flp51_07 "Lernfilterwert, positiv" SWORD dtsegn_b720divZyl 1 100 -180 179.995 FORMAT "%8.4" ECU_ADDRESS 0x3836A4 /end MEASUREMENT
/begin MEASUREMENT flp51_08 "Lernfilterwert, positiv" SWORD dtsegn_b720divZyl 1 100 -180 179.995 FORMAT "%8.4" ECU_ADDRESS 0x3836D4 /end MEASUREMENT
/begin MEASUREMENT flp52_02 "Lernfilterwert, positiv" SWORD dtsegn_b720divZyl 1 100 -180 179.995 FORMAT "%8.4" ECU_ADDRESS 0x3835C4 /end MEASUREMENT
/begin MEASUREMENT flp52_03 "Lernfilterwert, positiv" SWORD dtsegn_b720divZyl 1 100 -180 179.995 FORMAT "%8.4" ECU_ADDRESS 0x3835F4 /end MEASUREMENT
/begin MEASUREMENT flp52_04 "Lernfilterwert, positiv" SWORD dtsegn_b720divZyl 1 100 -180 179.995 FORMAT "%8.4" ECU_ADDRESS 0x383624 /end MEASUREMENT
/begin MEASUREMENT flp52_05 "Lernfilterwert, positiv" SWORD dtsegn_b720divZyl 1 100 -180 179.995 FORMAT "%8.4" ECU_ADDRESS 0x383654 /end MEASUREMENT
/begin MEASUREMENT flp52_06 "Lernfilterwert, positiv" SWORD dtsegn_b720divZyl 1 100 -180 179.995 FORMAT "%8.4" ECU_ADDRESS 0x383684 /end MEASUREMENT
/begin MEASUREMENT flp52_07 "Lernfilterwert, positiv" SWORD dtsegn_b720divZyl 1 100 -180 179.995 FORMAT "%8.4" ECU_ADDRESS 0x3836B4 /end MEASUREMENT
/begin MEASUREMENT flp52_08 "Lernfilterwert, positiv" SWORD dtsegn_b720divZyl 1 100 -180 179.995 FORMAT "%8.4" ECU_ADDRESS 0x3836E4 /end MEASUREMENT
/begin MEASUREMENT flp53_02 "Lernfilterwert, positiv" SWORD dtsegn_b720divZyl 1 100 -180 179.995 FORMAT "%8.4" ECU_ADDRESS 0x3835D4 /end MEASUREMENT
/begin MEASUREMENT flp53_03 "Lernfilterwert, positiv" SWORD dtsegn_b720divZyl 1 100 -180 179.995 FORMAT "%8.4" ECU_ADDRESS 0x383604 /end MEASUREMENT
/begin MEASUREMENT flp53_04 "Lernfilterwert, positiv" SWORD dtsegn_b720divZyl 1 100 -180 179.995 FORMAT "%8.4" ECU_ADDRESS 0x383634 /end MEASUREMENT
/begin MEASUREMENT flp53_05 "Lernfilterwert, positiv" SWORD dtsegn_b720divZyl 1 100 -180 179.995 FORMAT "%8.4" ECU_ADDRESS 0x383664 /end MEASUREMENT
/begin MEASUREMENT flp53_06 "Lernfilterwert, positiv" SWORD dtsegn_b720divZyl 1 100 -180 179.995 FORMAT "%8.4" ECU_ADDRESS 0x383694 /end MEASUREMENT
/begin MEASUREMENT flp53_07 "Lernfilterwert, positiv" SWORD dtsegn_b720divZyl 1 100 -180 179.995 FORMAT "%8.4" ECU_ADDRESS 0x3836C4 /end MEASUREMENT
/begin MEASUREMENT flp53_08 "Lernfilterwert, positiv" SWORD dtsegn_b720divZyl 1 100 -180 179.995 FORMAT "%8.4" ECU_ADDRESS 0x3836F4 /end MEASUREMENT
/begin MEASUREMENT flp61_02 "Lernfilterwert, positiv" SWORD dtsegn_b720divZyl 1 100 -180 179.995 FORMAT "%8.4" ECU_ADDRESS 0x3835B6 /end MEASUREMENT
/begin MEASUREMENT flp61_03 "Lernfilterwert, positiv" SWORD dtsegn_b720divZyl 1 100 -180 179.995 FORMAT "%8.4" ECU_ADDRESS 0x3835E6 /end MEASUREMENT
/begin MEASUREMENT flp61_04 "Lernfilterwert, positiv" SWORD dtsegn_b720divZyl 1 100 -180 179.995 FORMAT "%8.4" ECU_ADDRESS 0x383616 /end MEASUREMENT
/begin MEASUREMENT flp61_05 "Lernfilterwert, positiv" SWORD dtsegn_b720divZyl 1 100 -180 179.995 FORMAT "%8.4" ECU_ADDRESS 0x383646 /end MEASUREMENT
/begin MEASUREMENT flp61_06 "Lernfilterwert, positiv" SWORD dtsegn_b720divZyl 1 100 -180 179.995 FORMAT "%8.4" ECU_ADDRESS 0x383676 /end MEASUREMENT
/begin MEASUREMENT flp61_07 "Lernfilterwert, positiv" SWORD dtsegn_b720divZyl 1 100 -180 179.995 FORMAT "%8.4" ECU_ADDRESS 0x3836A6 /end MEASUREMENT
/begin MEASUREMENT flp61_08 "Lernfilterwert, positiv" SWORD dtsegn_b720divZyl 1 100 -180 179.995 FORMAT "%8.4" ECU_ADDRESS 0x3836D6 /end MEASUREMENT
/begin MEASUREMENT flp62_02 "Lernfilterwert, positiv" SWORD dtsegn_b720divZyl 1 100 -180 179.995 FORMAT "%8.4" ECU_ADDRESS 0x3835C6 /end MEASUREMENT
/begin MEASUREMENT flp62_03 "Lernfilterwert, positiv" SWORD dtsegn_b720divZyl 1 100 -180 179.995 FORMAT "%8.4" ECU_ADDRESS 0x3835F6 /end MEASUREMENT
/begin MEASUREMENT flp62_04 "Lernfilterwert, positiv" SWORD dtsegn_b720divZyl 1 100 -180 179.995 FORMAT "%8.4" ECU_ADDRESS 0x383626 /end MEASUREMENT
/begin MEASUREMENT flp62_05 "Lernfilterwert, positiv" SWORD dtsegn_b720divZyl 1 100 -180 179.995 FORMAT "%8.4" ECU_ADDRESS 0x383656 /end MEASUREMENT
/begin MEASUREMENT flp62_06 "Lernfilterwert, positiv" SWORD dtsegn_b720divZyl 1 100 -180 179.995 FORMAT "%8.4" ECU_ADDRESS 0x383686 /end MEASUREMENT
/begin MEASUREMENT flp62_07 "Lernfilterwert, positiv" SWORD dtsegn_b720divZyl 1 100 -180 179.995 FORMAT "%8.4" ECU_ADDRESS 0x3836B6 /end MEASUREMENT
/begin MEASUREMENT flp62_08 "Lernfilterwert, positiv" SWORD dtsegn_b720divZyl 1 100 -180 179.995 FORMAT "%8.4" ECU_ADDRESS 0x3836E6 /end MEASUREMENT
/begin MEASUREMENT flp63_02 "Lernfilterwert, positiv" SWORD dtsegn_b720divZyl 1 100 -180 179.995 FORMAT "%8.4" ECU_ADDRESS 0x3835D6 /end MEASUREMENT
/begin MEASUREMENT flp63_03 "Lernfilterwert, positiv" SWORD dtsegn_b720divZyl 1 100 -180 179.995 FORMAT "%8.4" ECU_ADDRESS 0x383606 /end MEASUREMENT
/begin MEASUREMENT flp63_04 "Lernfilterwert, positiv" SWORD dtsegn_b720divZyl 1 100 -180 179.995 FORMAT "%8.4" ECU_ADDRESS 0x383636 /end MEASUREMENT
/begin MEASUREMENT flp63_05 "Lernfilterwert, positiv" SWORD dtsegn_b720divZyl 1 100 -180 179.995 FORMAT "%8.4" ECU_ADDRESS 0x383666 /end MEASUREMENT
/begin MEASUREMENT flp63_06 "Lernfilterwert, positiv" SWORD dtsegn_b720divZyl 1 100 -180 179.995 FORMAT "%8.4" ECU_ADDRESS 0x383696 /end MEASUREMENT
/begin MEASUREMENT flp63_07 "Lernfilterwert, positiv" SWORD dtsegn_b720divZyl 1 100 -180 179.995 FORMAT "%8.4" ECU_ADDRESS 0x3836C6 /end MEASUREMENT
/begin MEASUREMENT flp63_08 "Lernfilterwert, positiv" SWORD dtsegn_b720divZyl 1 100 -180 179.995 FORMAT "%8.4" ECU_ADDRESS 0x3836F6 /end MEASUREMENT
/begin MEASUREMENT flp71_02 "Lernfilterwert, positiv" SWORD dtsegn_b720divZyl 1 100 -180 179.995 FORMAT "%8.4" ECU_ADDRESS 0x3835B8 /end MEASUREMENT
/begin MEASUREMENT flp71_03 "Lernfilterwert, positiv" SWORD dtsegn_b720divZyl 1 100 -180 179.995 FORMAT "%8.4" ECU_ADDRESS 0x3835E8 /end MEASUREMENT
/begin MEASUREMENT flp71_04 "Lernfilterwert, positiv" SWORD dtsegn_b720divZyl 1 100 -180 179.995 FORMAT "%8.4" ECU_ADDRESS 0x383618 /end MEASUREMENT
/begin MEASUREMENT flp71_05 "Lernfilterwert, positiv" SWORD dtsegn_b720divZyl 1 100 -180 179.995 FORMAT "%8.4" ECU_ADDRESS 0x383648 /end MEASUREMENT
/begin MEASUREMENT flp71_06 "Lernfilterwert, positiv" SWORD dtsegn_b720divZyl 1 100 -180 179.995 FORMAT "%8.4" ECU_ADDRESS 0x383678 /end MEASUREMENT
/begin MEASUREMENT flp71_07 "Lernfilterwert, positiv" SWORD dtsegn_b720divZyl 1 100 -180 179.995 FORMAT "%8.4" ECU_ADDRESS 0x3836A8 /end MEASUREMENT
/begin MEASUREMENT flp71_08 "Lernfilterwert, positiv" SWORD dtsegn_b720divZyl 1 100 -180 179.995 FORMAT "%8.4" ECU_ADDRESS 0x3836D8 /end MEASUREMENT
/begin MEASUREMENT flp72_02 "Lernfilterwert, positiv" SWORD dtsegn_b720divZyl 1 100 -180 179.995 FORMAT "%8.4" ECU_ADDRESS 0x3835C8 /end MEASUREMENT
/begin MEASUREMENT flp72_03 "Lernfilterwert, positiv" SWORD dtsegn_b720divZyl 1 100 -180 179.995 FORMAT "%8.4" ECU_ADDRESS 0x3835F8 /end MEASUREMENT
/begin MEASUREMENT flp72_04 "Lernfilterwert, positiv" SWORD dtsegn_b720divZyl 1 100 -180 179.995 FORMAT "%8.4" ECU_ADDRESS 0x383628 /end MEASUREMENT
/begin MEASUREMENT flp72_05 "Lernfilterwert, positiv" SWORD dtsegn_b720divZyl 1 100 -180 179.995 FORMAT "%8.4" ECU_ADDRESS 0x383658 /end MEASUREMENT
/begin MEASUREMENT flp72_06 "Lernfilterwert, positiv" SWORD dtsegn_b720divZyl 1 100 -180 179.995 FORMAT "%8.4" ECU_ADDRESS 0x383688 /end MEASUREMENT
/begin MEASUREMENT flp72_07 "Lernfilterwert, positiv" SWORD dtsegn_b720divZyl 1 100 -180 179.995 FORMAT "%8.4" ECU_ADDRESS 0x3836B8 /end MEASUREMENT
/begin MEASUREMENT flp72_08 "Lernfilterwert, positiv" SWORD dtsegn_b720divZyl 1 100 -180 179.995 FORMAT "%8.4" ECU_ADDRESS 0x3836E8 /end MEASUREMENT
/begin MEASUREMENT flp73_02 "Lernfilterwert, positiv" SWORD dtsegn_b720divZyl 1 100 -180 179.995 FORMAT "%8.4" ECU_ADDRESS 0x3835D8 /end MEASUREMENT
/begin MEASUREMENT flp73_03 "Lernfilterwert, positiv" SWORD dtsegn_b720divZyl 1 100 -180 179.995 FORMAT "%8.4" ECU_ADDRESS 0x383608 /end MEASUREMENT
/begin MEASUREMENT flp73_04 "Lernfilterwert, positiv" SWORD dtsegn_b720divZyl 1 100 -180 179.995 FORMAT "%8.4" ECU_ADDRESS 0x383638 /end MEASUREMENT
/begin MEASUREMENT flp73_05 "Lernfilterwert, positiv" SWORD dtsegn_b720divZyl 1 100 -180 179.995 FORMAT "%8.4" ECU_ADDRESS 0x383668 /end MEASUREMENT
/begin MEASUREMENT flp73_06 "Lernfilterwert, positiv" SWORD dtsegn_b720divZyl 1 100 -180 179.995 FORMAT "%8.4" ECU_ADDRESS 0x383698 /end MEASUREMENT
/begin MEASUREMENT flp73_07 "Lernfilterwert, positiv" SWORD dtsegn_b720divZyl 1 100 -180 179.995 FORMAT "%8.4" ECU_ADDRESS 0x3836C8 /end MEASUREMENT
/begin MEASUREMENT flp73_08 "Lernfilterwert, positiv" SWORD dtsegn_b720divZyl 1 100 -180 179.995 FORMAT "%8.4" ECU_ADDRESS 0x3836F8 /end MEASUREMENT
/begin MEASUREMENT flp81_02 "Lernfilterwert, positiv" SWORD dtsegn_b720divZyl 1 100 -180 179.995 FORMAT "%8.4" ECU_ADDRESS 0x3835BA /end MEASUREMENT
/begin MEASUREMENT flp81_03 "Lernfilterwert, positiv" SWORD dtsegn_b720divZyl 1 100 -180 179.995 FORMAT "%8.4" ECU_ADDRESS 0x3835EA /end MEASUREMENT
/begin MEASUREMENT flp81_04 "Lernfilterwert, positiv" SWORD dtsegn_b720divZyl 1 100 -180 179.995 FORMAT "%8.4" ECU_ADDRESS 0x38361A /end MEASUREMENT
/begin MEASUREMENT flp81_05 "Lernfilterwert, positiv" SWORD dtsegn_b720divZyl 1 100 -180 179.995 FORMAT "%8.4" ECU_ADDRESS 0x38364A /end MEASUREMENT
/begin MEASUREMENT flp81_06 "Lernfilterwert, positiv" SWORD dtsegn_b720divZyl 1 100 -180 179.995 FORMAT "%8.4" ECU_ADDRESS 0x38367A /end MEASUREMENT
/begin MEASUREMENT flp81_07 "Lernfilterwert, positiv" SWORD dtsegn_b720divZyl 1 100 -180 179.995 FORMAT "%8.4" ECU_ADDRESS 0x3836AA /end MEASUREMENT
/begin MEASUREMENT flp81_08 "Lernfilterwert, positiv" SWORD dtsegn_b720divZyl 1 100 -180 179.995 FORMAT "%8.4" ECU_ADDRESS 0x3836DA /end MEASUREMENT
/begin MEASUREMENT flp82_02 "Lernfilterwert, positiv" SWORD dtsegn_b720divZyl 1 100 -180 179.995 FORMAT "%8.4" ECU_ADDRESS 0x3835CA /end MEASUREMENT
/begin MEASUREMENT flp82_03 "Lernfilterwert, positiv" SWORD dtsegn_b720divZyl 1 100 -180 179.995 FORMAT "%8.4" ECU_ADDRESS 0x3835FA /end MEASUREMENT
/begin MEASUREMENT flp82_04 "Lernfilterwert, positiv" SWORD dtsegn_b720divZyl 1 100 -180 179.995 FORMAT "%8.4" ECU_ADDRESS 0x38362A /end MEASUREMENT
/begin MEASUREMENT flp82_05 "Lernfilterwert, positiv" SWORD dtsegn_b720divZyl 1 100 -180 179.995 FORMAT "%8.4" ECU_ADDRESS 0x38365A /end MEASUREMENT
/begin MEASUREMENT flp82_06 "Lernfilterwert, positiv" SWORD dtsegn_b720divZyl 1 100 -180 179.995 FORMAT "%8.4" ECU_ADDRESS 0x38368A /end MEASUREMENT
/begin MEASUREMENT flp82_07 "Lernfilterwert, positiv" SWORD dtsegn_b720divZyl 1 100 -180 179.995 FORMAT "%8.4" ECU_ADDRESS 0x3836BA /end MEASUREMENT
/begin MEASUREMENT flp82_08 "Lernfilterwert, positiv" SWORD dtsegn_b720divZyl 1 100 -180 179.995 FORMAT "%8.4" ECU_ADDRESS 0x3836EA /end MEASUREMENT
/begin MEASUREMENT flp83_02 "Lernfilterwert, positiv" SWORD dtsegn_b720divZyl 1 100 -180 179.995 FORMAT "%8.4" ECU_ADDRESS 0x3835DA /end MEASUREMENT
/begin MEASUREMENT flp83_03 "Lernfilterwert, positiv" SWORD dtsegn_b720divZyl 1 100 -180 179.995 FORMAT "%8.4" ECU_ADDRESS 0x38360A /end MEASUREMENT
/begin MEASUREMENT flp83_04 "Lernfilterwert, positiv" SWORD dtsegn_b720divZyl 1 100 -180 179.995 FORMAT "%8.4" ECU_ADDRESS 0x38363A /end MEASUREMENT
/begin MEASUREMENT flp83_05 "Lernfilterwert, positiv" SWORD dtsegn_b720divZyl 1 100 -180 179.995 FORMAT "%8.4" ECU_ADDRESS 0x38366A /end MEASUREMENT
/begin MEASUREMENT flp83_06 "Lernfilterwert, positiv" SWORD dtsegn_b720divZyl 1 100 -180 179.995 FORMAT "%8.4" ECU_ADDRESS 0x38369A /end MEASUREMENT
/begin MEASUREMENT flp83_07 "Lernfilterwert, positiv" SWORD dtsegn_b720divZyl 1 100 -180 179.995 FORMAT "%8.4" ECU_ADDRESS 0x3836CA /end MEASUREMENT
/begin MEASUREMENT flp83_08 "Lernfilterwert, positiv" SWORD dtsegn_b720divZyl 1 100 -180 179.995 FORMAT "%8.4" ECU_ADDRESS 0x3836FA /end MEASUREMENT
/begin MEASUREMENT fostat "Status der fuel-on/-off Adaption im aktuellen Betriebsbereich" UBYTE dez 1 100 0 255 FORMAT "%5.1" ECU_ADDRESS 0xE3F8 /end MEASUREMENT
/begin MEASUREMENT fostat_m "Monitor, Status der Adpation im akt. Bereich, verzögerte Ausgabe" UBYTE dez 1 100 0 255 FORMAT "%5.1" ECU_ADDRESS 0xE3DC /end MEASUREMENT
/begin MEASUREMENT fs11_02 "Filterwert Segmentabweichung, Betriebsbereich 11, Zündung 2" UWORD dtsegn_b720divZylP5 1 100 -180 179.995 FORMAT "%8.4" ECU_ADDRESS 0x3836FC /end MEASUREMENT
/begin MEASUREMENT fs11_03 "Filterwert Segmentabweichung, Betriebsbereich 11, Zündung 3" UWORD dtsegn_b720divZylP5 1 100 -180 179.995 FORMAT "%8.4" ECU_ADDRESS 0x38372C /end MEASUREMENT
/begin MEASUREMENT fs11_04 "Filterwert Segmentabweichung, Betriebsbereich 11, Zündung 4" UWORD dtsegn_b720divZylP5 1 100 -180 179.995 FORMAT "%8.4" ECU_ADDRESS 0x38375C /end MEASUREMENT
/begin MEASUREMENT fs11_05 "Filterwert Segmentabweichung, Betriebsbereich 11, Zündung 5" UWORD dtsegn_b720divZylP5 1 100 -180 179.995 FORMAT "%8.4" ECU_ADDRESS 0x38378C /end MEASUREMENT
/begin MEASUREMENT fs11_06 "Filterwert Segmentabweichung, Betriebsbereich 11, Zündung 6" UWORD dtsegn_b720divZylP5 1 100 -180 179.995 FORMAT "%8.4" ECU_ADDRESS 0x3837BC /end MEASUREMENT
/begin MEASUREMENT fs11_07 "Filterwert Segmentabweichung, Betriebsbereich 11, Zündung 7" UWORD dtsegn_b720divZylP5 1 100 -180 179.995 FORMAT "%8.4" ECU_ADDRESS 0x3837EC /end MEASUREMENT
/begin MEASUREMENT fs11_08 "Filterwert Segmentabweichung, Betriebsbereich 11, Zündung 8" UWORD dtsegn_b720divZylP5 1 100 -180 179.995 FORMAT "%8.4" ECU_ADDRESS 0x38381C /end MEASUREMENT
/begin MEASUREMENT fs12_02 "Filterwert Segmentabweichung, Betriebsbereich 12, Zündung 2" UWORD dtsegn_b720divZylP5 1 100 -180 179.995 FORMAT "%8.4" ECU_ADDRESS 0x38370C /end MEASUREMENT
/begin MEASUREMENT fs12_03 "Filterwert Segmentabweichung, Betriebsbereich 12, Zündung 3" UWORD dtsegn_b720divZylP5 1 100 -180 179.995 FORMAT "%8.4" ECU_ADDRESS 0x38373C /end MEASUREMENT
/begin MEASUREMENT fs12_04 "Filterwert Segmentabweichung, Betriebsbereich 12, Zündung 4" UWORD dtsegn_b720divZylP5 1 100 -180 179.995 FORMAT "%8.4" ECU_ADDRESS 0x38376C /end MEASUREMENT
/begin MEASUREMENT fs12_05 "Filterwert Segmentabweichung, Betriebsbereich 12, Zündung 5" UWORD dtsegn_b720divZylP5 1 100 -180 179.995 FORMAT "%8.4" ECU_ADDRESS 0x38379C /end MEASUREMENT
/begin MEASUREMENT fs12_06 "Filterwert Segmentabweichung, Betriebsbereich 12, Zündung 6" UWORD dtsegn_b720divZylP5 1 100 -180 179.995 FORMAT "%8.4" ECU_ADDRESS 0x3837CC /end MEASUREMENT
/begin MEASUREMENT fs12_07 "Filterwert Segmentabweichung, Betriebsbereich 12, Zündung 7" UWORD dtsegn_b720divZylP5 1 100 -180 179.995 FORMAT "%8.4" ECU_ADDRESS 0x3837FC /end MEASUREMENT
/begin MEASUREMENT fs12_08 "Filterwert Segmentabweichung, Betriebsbereich 12, Zündung 8" UWORD dtsegn_b720divZylP5 1 100 -180 179.995 FORMAT "%8.4" ECU_ADDRESS 0x38382C /end MEASUREMENT
/begin MEASUREMENT fs13_02 "Filterwert Segmentabweichung, Betriebsbereich 13, Zündung 2" UWORD dtsegn_b720divZylP5 1 100 -180 179.995 FORMAT "%8.4" ECU_ADDRESS 0x38371C /end MEASUREMENT
/begin MEASUREMENT fs13_03 "Filterwert Segmentabweichung, Betriebsbereich 13, Zündung 3" UWORD dtsegn_b720divZylP5 1 100 -180 179.995 FORMAT "%8.4" ECU_ADDRESS 0x38374C /end MEASUREMENT
/begin MEASUREMENT fs13_04 "Filterwert Segmentabweichung, Betriebsbereich 13, Zündung 4" UWORD dtsegn_b720divZylP5 1 100 -180 179.995 FORMAT "%8.4" ECU_ADDRESS 0x38377C /end MEASUREMENT
/begin MEASUREMENT fs13_05 "Filterwert Segmentabweichung, Betriebsbereich 13, Zündung 5" UWORD dtsegn_b720divZylP5 1 100 -180 179.995 FORMAT "%8.4" ECU_ADDRESS 0x3837AC /end MEASUREMENT
/begin MEASUREMENT fs13_06 "Filterwert Segmentabweichung, Betriebsbereich 13, Zündung 6" UWORD dtsegn_b720divZylP5 1 100 -180 179.995 FORMAT "%8.4" ECU_ADDRESS 0x3837DC /end MEASUREMENT
/begin MEASUREMENT fs13_07 "Filterwert Segmentabweichung, Betriebsbereich 13, Zündung 7" UWORD dtsegn_b720divZylP5 1 100 -180 179.995 FORMAT "%8.4" ECU_ADDRESS 0x38380C /end MEASUREMENT
/begin MEASUREMENT fs13_08 "Filterwert Segmentabweichung, Betriebsbereich 13, Zündung 8" UWORD dtsegn_b720divZylP5 1 100 -180 179.995 FORMAT "%8.4" ECU_ADDRESS 0x38383C /end MEASUREMENT
/begin MEASUREMENT fs21_02 "Filterwert Segmentabweichung, Betriebsbereich 21, Zündung 2" UWORD dtsegn_b720divZylP5 1 100 -180 179.995 FORMAT "%8.4" ECU_ADDRESS 0x3836FE /end MEASUREMENT
/begin MEASUREMENT fs21_03 "Filterwert Segmentabweichung, Betriebsbereich 21, Zündung 3" UWORD dtsegn_b720divZylP5 1 100 -180 179.995 FORMAT "%8.4" ECU_ADDRESS 0x38372E /end MEASUREMENT
/begin MEASUREMENT fs21_04 "Filterwert Segmentabweichung, Betriebsbereich 21, Zündung 4" UWORD dtsegn_b720divZylP5 1 100 -180 179.995 FORMAT "%8.4" ECU_ADDRESS 0x38375E /end MEASUREMENT
/begin MEASUREMENT fs21_05 "Filterwert Segmentabweichung, Betriebsbereich 21, Zündung 5" UWORD dtsegn_b720divZylP5 1 100 -180 179.995 FORMAT "%8.4" ECU_ADDRESS 0x38378E /end MEASUREMENT
/begin MEASUREMENT fs21_06 "Filterwert Segmentabweichung, Betriebsbereich 21, Zündung 6" UWORD dtsegn_b720divZylP5 1 100 -180 179.995 FORMAT "%8.4" ECU_ADDRESS 0x3837BE /end MEASUREMENT
/begin MEASUREMENT fs21_07 "Filterwert Segmentabweichung, Betriebsbereich 21, Zündung 7" UWORD dtsegn_b720divZylP5 1 100 -180 179.995 FORMAT "%8.4" ECU_ADDRESS 0x3837EE /end MEASUREMENT
/begin MEASUREMENT fs21_08 "Filterwert Segmentabweichung, Betriebsbereich 21, Zündung 8" UWORD dtsegn_b720divZylP5 1 100 -180 179.995 FORMAT "%8.4" ECU_ADDRESS 0x38381E /end MEASUREMENT
/begin MEASUREMENT fs22_02 "Filterwert Segmentabweichung, Betriebsbereich 22, Zündung 2" UWORD dtsegn_b720divZylP5 1 100 -180 179.995 FORMAT "%8.4" ECU_ADDRESS 0x38370E /end MEASUREMENT
/begin MEASUREMENT fs22_03 "Filterwert Segmentabweichung, Betriebsbereich 22, Zündung 3" UWORD dtsegn_b720divZylP5 1 100 -180 179.995 FORMAT "%8.4" ECU_ADDRESS 0x38373E /end MEASUREMENT
/begin MEASUREMENT fs22_04 "Filterwert Segmentabweichung, Betriebsbereich 22, Zündung 4" UWORD dtsegn_b720divZylP5 1 100 -180 179.995 FORMAT "%8.4" ECU_ADDRESS 0x38376E /end MEASUREMENT
/begin MEASUREMENT fs22_05 "Filterwert Segmentabweichung, Betriebsbereich 22, Zündung 5" UWORD dtsegn_b720divZylP5 1 100 -180 179.995 FORMAT "%8.4" ECU_ADDRESS 0x38379E /end MEASUREMENT
/begin MEASUREMENT fs22_06 "Filterwert Segmentabweichung, Betriebsbereich 22, Zündung 6" UWORD dtsegn_b720divZylP5 1 100 -180 179.995 FORMAT "%8.4" ECU_ADDRESS 0x3837CE /end MEASUREMENT
/begin MEASUREMENT fs22_07 "Filterwert Segmentabweichung, Betriebsbereich 22, Zündung 7" UWORD dtsegn_b720divZylP5 1 100 -180 179.995 FORMAT "%8.4" ECU_ADDRESS 0x3837FE /end MEASUREMENT
/begin MEASUREMENT fs22_08 "Filterwert Segmentabweichung, Betriebsbereich 22, Zündung 8" UWORD dtsegn_b720divZylP5 1 100 -180 179.995 FORMAT "%8.4" ECU_ADDRESS 0x38382E /end MEASUREMENT
/begin MEASUREMENT fs23_02 "Filterwert Segmentabweichung, Betriebsbereich 23, Zündung 2" UWORD dtsegn_b720divZylP5 1 100 -180 179.995 FORMAT "%8.4" ECU_ADDRESS 0x38371E /end MEASUREMENT
/begin MEASUREMENT fs23_03 "Filterwert Segmentabweichung, Betriebsbereich 23, Zündung 3" UWORD dtsegn_b720divZylP5 1 100 -180 179.995 FORMAT "%8.4" ECU_ADDRESS 0x38374E /end MEASUREMENT
/begin MEASUREMENT fs23_04 "Filterwert Segmentabweichung, Betriebsbereich 23, Zündung 4" UWORD dtsegn_b720divZylP5 1 100 -180 179.995 FORMAT "%8.4" ECU_ADDRESS 0x38377E /end MEASUREMENT
/begin MEASUREMENT fs23_05 "Filterwert Segmentabweichung, Betriebsbereich 23, Zündung 5" UWORD dtsegn_b720divZylP5 1 100 -180 179.995 FORMAT "%8.4" ECU_ADDRESS 0x3837AE /end MEASUREMENT
/begin MEASUREMENT fs23_06 "Filterwert Segmentabweichung, Betriebsbereich 23, Zündung 6" UWORD dtsegn_b720divZylP5 1 100 -180 179.995 FORMAT "%8.4" ECU_ADDRESS 0x3837DE /end MEASUREMENT
/begin MEASUREMENT fs23_07 "Filterwert Segmentabweichung, Betriebsbereich 23, Zündung 7" UWORD dtsegn_b720divZylP5 1 100 -180 179.995 FORMAT "%8.4" ECU_ADDRESS 0x38380E /end MEASUREMENT
/begin MEASUREMENT fs23_08 "Filterwert Segmentabweichung, Betriebsbereich 23, Zündung 8" UWORD dtsegn_b720divZylP5 1 100 -180 179.995 FORMAT "%8.4" ECU_ADDRESS 0x38383E /end MEASUREMENT
/begin MEASUREMENT fs31_02 "Filterwert Segmentabweichung, Betriebsbereich 31, Zylinder 2" UWORD dtsegn_b720divZylP5 1 100 -180 179.995 FORMAT "%8.4" ECU_ADDRESS 0x383700 /end MEASUREMENT
/begin MEASUREMENT fs31_03 "Filterwert Segmentabweichung, Betriebsbereich 31" UWORD dtsegn_b720divZylP5 1 100 -180 179.995 FORMAT "%8.4" ECU_ADDRESS 0x383730 /end MEASUREMENT
/begin MEASUREMENT fs31_04 "Filterwert Segmentabweichung, Betriebsbereich 31" UWORD dtsegn_b720divZylP5 1 100 -180 179.995 FORMAT "%8.4" ECU_ADDRESS 0x383760 /end MEASUREMENT
/begin MEASUREMENT fs31_05 "Filterwert Segmentabweichung, Betriebsbereich 31" UWORD dtsegn_b720divZylP5 1 100 -180 179.995 FORMAT "%8.4" ECU_ADDRESS 0x383790 /end MEASUREMENT
/begin MEASUREMENT fs31_06 "Filterwert Segmentabweichung, Betriebsbereich 31" UWORD dtsegn_b720divZylP5 1 100 -180 179.995 FORMAT "%8.4" ECU_ADDRESS 0x3837C0 /end MEASUREMENT
/begin MEASUREMENT fs31_07 "Filterwert Segmentabweichung, Betriebsbereich 31" UWORD dtsegn_b720divZylP5 1 100 -180 179.995 FORMAT "%8.4" ECU_ADDRESS 0x3837F0 /end MEASUREMENT
/begin MEASUREMENT fs31_08 "Filterwert Segmentabweichung, Betriebsbereich 31" UWORD dtsegn_b720divZylP5 1 100 -180 179.995 FORMAT "%8.4" ECU_ADDRESS 0x383820 /end MEASUREMENT
/begin MEASUREMENT fs32_02 "Filterwert Segmentabweichung, Betriebsbereich 32, Zylinder 2" UWORD dtsegn_b720divZylP5 1 100 -180 179.995 FORMAT "%8.4" ECU_ADDRESS 0x383710 /end MEASUREMENT
/begin MEASUREMENT fs32_03 "Filterwert Segmentabweichung, Betriebsbereich 32" UWORD dtsegn_b720divZylP5 1 100 -180 179.995 FORMAT "%8.4" ECU_ADDRESS 0x383740 /end MEASUREMENT
/begin MEASUREMENT fs32_04 "Filterwert Segmentabweichung, Betriebsbereich 32" UWORD dtsegn_b720divZylP5 1 100 -180 179.995 FORMAT "%8.4" ECU_ADDRESS 0x383770 /end MEASUREMENT
/begin MEASUREMENT fs32_05 "Filterwert Segmentabweichung, Betriebsbereich 32" UWORD dtsegn_b720divZylP5 1 100 -180 179.995 FORMAT "%8.4" ECU_ADDRESS 0x3837A0 /end MEASUREMENT
/begin MEASUREMENT fs32_06 "Filterwert Segmentabweichung, Betriebsbereich 32" UWORD dtsegn_b720divZylP5 1 100 -180 179.995 FORMAT "%8.4" ECU_ADDRESS 0x3837D0 /end MEASUREMENT
/begin MEASUREMENT fs32_07 "Filterwert Segmentabweichung, Betriebsbereich 32" UWORD dtsegn_b720divZylP5 1 100 -180 179.995 FORMAT "%8.4" ECU_ADDRESS 0x383800 /end MEASUREMENT
/begin MEASUREMENT fs32_08 "Filterwert Segmentabweichung, Betriebsbereich 32" UWORD dtsegn_b720divZylP5 1 100 -180 179.995 FORMAT "%8.4" ECU_ADDRESS 0x383830 /end MEASUREMENT
/begin MEASUREMENT fs33_02 "Filterwert Segmentabweichung, Betriebsbereich 33, Zylinder 2" UWORD dtsegn_b720divZylP5 1 100 -180 179.995 FORMAT "%8.4" ECU_ADDRESS 0x383720 /end MEASUREMENT
/begin MEASUREMENT fs33_03 "Filterwert Segmentabweichung, Betriebsbereich 33" UWORD dtsegn_b720divZylP5 1 100 -180 179.995 FORMAT "%8.4" ECU_ADDRESS 0x383750 /end MEASUREMENT
/begin MEASUREMENT fs33_04 "Filterwert Segmentabweichung, Betriebsbereich 33" UWORD dtsegn_b720divZylP5 1 100 -180 179.995 FORMAT "%8.4" ECU_ADDRESS 0x383780 /end MEASUREMENT
/begin MEASUREMENT fs33_05 "Filterwert Segmentabweichung, Betriebsbereich 33" UWORD dtsegn_b720divZylP5 1 100 -180 179.995 FORMAT "%8.4" ECU_ADDRESS 0x3837B0 /end MEASUREMENT
/begin MEASUREMENT fs33_06 "Filterwert Segmentabweichung, Betriebsbereich 33" UWORD dtsegn_b720divZylP5 1 100 -180 179.995 FORMAT "%8.4" ECU_ADDRESS 0x3837E0 /end MEASUREMENT
/begin MEASUREMENT fs33_07 "Filterwert Segmentabweichung, Betriebsbereich 33" UWORD dtsegn_b720divZylP5 1 100 -180 179.995 FORMAT "%8.4" ECU_ADDRESS 0x383810 /end MEASUREMENT
/begin MEASUREMENT fs33_08 "Filterwert Segmentabweichung, Betriebsbereich 33" UWORD dtsegn_b720divZylP5 1 100 -180 179.995 FORMAT "%8.4" ECU_ADDRESS 0x383840 /end MEASUREMENT
/begin MEASUREMENT fs41_02 "Filterwert Segmentabweichung, Betriebsbereich 41, Zylinder 2" UWORD dtsegn_b720divZylP5 1 100 -180 179.995 FORMAT "%8.4" ECU_ADDRESS 0x383702 /end MEASUREMENT
/begin MEASUREMENT fs41_03 "Filterwert Segmentabweichung, Betriebsbereich 41" UWORD dtsegn_b720divZylP5 1 100 -180 179.995 FORMAT "%8.4" ECU_ADDRESS 0x383732 /end MEASUREMENT
/begin MEASUREMENT fs41_04 "Filterwert Segmentabweichung, Betriebsbereich 41" UWORD dtsegn_b720divZylP5 1 100 -180 179.995 FORMAT "%8.4" ECU_ADDRESS 0x383762 /end MEASUREMENT
/begin MEASUREMENT fs41_05 "Filterwert Segmentabweichung, Betriebsbereich 41" UWORD dtsegn_b720divZylP5 1 100 -180 179.995 FORMAT "%8.4" ECU_ADDRESS 0x383792 /end MEASUREMENT
/begin MEASUREMENT fs41_06 "Filterwert Segmentabweichung, Betriebsbereich 41" UWORD dtsegn_b720divZylP5 1 100 -180 179.995 FORMAT "%8.4" ECU_ADDRESS 0x3837C2 /end MEASUREMENT
/begin MEASUREMENT fs41_07 "Filterwert Segmentabweichung, Betriebsbereich 41" UWORD dtsegn_b720divZylP5 1 100 -180 179.995 FORMAT "%8.4" ECU_ADDRESS 0x3837F2 /end MEASUREMENT
/begin MEASUREMENT fs41_08 "Filterwert Segmentabweichung, Betriebsbereich 41" UWORD dtsegn_b720divZylP5 1 100 -180 179.995 FORMAT "%8.4" ECU_ADDRESS 0x383822 /end MEASUREMENT
/begin MEASUREMENT fs42_02 "Filterwert Segmentabweichung, Betriebsbereich 42, Zylinder 2" UWORD dtsegn_b720divZylP5 1 100 -180 179.995 FORMAT "%8.4" ECU_ADDRESS 0x383712 /end MEASUREMENT
/begin MEASUREMENT fs42_03 "Filterwert Segmentabweichung, Betriebsbereich 42" UWORD dtsegn_b720divZylP5 1 100 -180 179.995 FORMAT "%8.4" ECU_ADDRESS 0x383742 /end MEASUREMENT
/begin MEASUREMENT fs42_04 "Filterwert Segmentabweichung, Betriebsbereich 42" UWORD dtsegn_b720divZylP5 1 100 -180 179.995 FORMAT "%8.4" ECU_ADDRESS 0x383772 /end MEASUREMENT
/begin MEASUREMENT fs42_05 "Filterwert Segmentabweichung, Betriebsbereich 42" UWORD dtsegn_b720divZylP5 1 100 -180 179.995 FORMAT "%8.4" ECU_ADDRESS 0x3837A2 /end MEASUREMENT
/begin MEASUREMENT fs42_06 "Filterwert Segmentabweichung, Betriebsbereich 42" UWORD dtsegn_b720divZylP5 1 100 -180 179.995 FORMAT "%8.4" ECU_ADDRESS 0x3837D2 /end MEASUREMENT
/begin MEASUREMENT fs42_07 "Filterwert Segmentabweichung, Betriebsbereich 42" UWORD dtsegn_b720divZylP5 1 100 -180 179.995 FORMAT "%8.4" ECU_ADDRESS 0x383802 /end MEASUREMENT
/begin MEASUREMENT fs42_08 "Filterwert Segmentabweichung, Betriebsbereich 42" UWORD dtsegn_b720divZylP5 1 100 -180 179.995 FORMAT "%8.4" ECU_ADDRESS 0x383832 /end MEASUREMENT
/begin MEASUREMENT fs43_02 "Filterwert Segmentabweichung, Betriebsbereich 43, Zylinder 2" UWORD dtsegn_b720divZylP5 1 100 -180 179.995 FORMAT "%8.4" ECU_ADDRESS 0x383722 /end MEASUREMENT
/begin MEASUREMENT fs43_03 "Filterwert Segmentabweichung, Betriebsbereich 43" UWORD dtsegn_b720divZylP5 1 100 -180 179.995 FORMAT "%8.4" ECU_ADDRESS 0x383752 /end MEASUREMENT
/begin MEASUREMENT fs43_04 "Filterwert Segmentabweichung, Betriebsbereich 43" UWORD dtsegn_b720divZylP5 1 100 -180 179.995 FORMAT "%8.4" ECU_ADDRESS 0x383782 /end MEASUREMENT
/begin MEASUREMENT fs43_05 "Filterwert Segmentabweichung, Betriebsbereich 43" UWORD dtsegn_b720divZylP5 1 100 -180 179.995 FORMAT "%8.4" ECU_ADDRESS 0x3837B2 /end MEASUREMENT
/begin MEASUREMENT fs43_06 "Filterwert Segmentabweichung, Betriebsbereich 43" UWORD dtsegn_b720divZylP5 1 100 -180 179.995 FORMAT "%8.4" ECU_ADDRESS 0x3837E2 /end MEASUREMENT
/begin MEASUREMENT fs43_07 "Filterwert Segmentabweichung, Betriebsbereich 43" UWORD dtsegn_b720divZylP5 1 100 -180 179.995 FORMAT "%8.4" ECU_ADDRESS 0x383812 /end MEASUREMENT
/begin MEASUREMENT fs43_08 "Filterwert Segmentabweichung, Betriebsbereich 43" UWORD dtsegn_b720divZylP5 1 100 -180 179.995 FORMAT "%8.4" ECU_ADDRESS 0x383842 /end MEASUREMENT
/begin MEASUREMENT fs51_02 "Filterwert Segmentabweichung, Betriebsbereich 51, Zylinder 2" UWORD dtsegn_b720divZylP5 1 100 -180 179.995 FORMAT "%8.4" ECU_ADDRESS 0x383704 /end MEASUREMENT
/begin MEASUREMENT fs51_03 "Filterwert Segmentabweichung, Betriebsbereich 51" UWORD dtsegn_b720divZylP5 1 100 -180 179.995 FORMAT "%8.4" ECU_ADDRESS 0x383734 /end MEASUREMENT
/begin MEASUREMENT fs51_04 "Filterwert Segmentabweichung, Betriebsbereich 51" UWORD dtsegn_b720divZylP5 1 100 -180 179.995 FORMAT "%8.4" ECU_ADDRESS 0x383764 /end MEASUREMENT
/begin MEASUREMENT fs51_05 "Filterwert Segmentabweichung, Betriebsbereich 51" UWORD dtsegn_b720divZylP5 1 100 -180 179.995 FORMAT "%8.4" ECU_ADDRESS 0x383794 /end MEASUREMENT
/begin MEASUREMENT fs51_06 "Filterwert Segmentabweichung, Betriebsbereich 51" UWORD dtsegn_b720divZylP5 1 100 -180 179.995 FORMAT "%8.4" ECU_ADDRESS 0x3837C4 /end MEASUREMENT
/begin MEASUREMENT fs51_07 "Filterwert Segmentabweichung, Betriebsbereich 51" UWORD dtsegn_b720divZylP5 1 100 -180 179.995 FORMAT "%8.4" ECU_ADDRESS 0x3837F4 /end MEASUREMENT
/begin MEASUREMENT fs51_08 "Filterwert Segmentabweichung, Betriebsbereich 51" UWORD dtsegn_b720divZylP5 1 100 -180 179.995 FORMAT "%8.4" ECU_ADDRESS 0x383824 /end MEASUREMENT
/begin MEASUREMENT fs52_02 "Filterwert Segmentabweichung, Betriebsbereich 52, Zylinder 2" UWORD dtsegn_b720divZylP5 1 100 -180 179.995 FORMAT "%8.4" ECU_ADDRESS 0x383714 /end MEASUREMENT
/begin MEASUREMENT fs52_03 "Filterwert Segmentabweichung, Betriebsbereich 52" UWORD dtsegn_b720divZylP5 1 100 -180 179.995 FORMAT "%8.4" ECU_ADDRESS 0x383744 /end MEASUREMENT
/begin MEASUREMENT fs52_04 "Filterwert Segmentabweichung, Betriebsbereich 52" UWORD dtsegn_b720divZylP5 1 100 -180 179.995 FORMAT "%8.4" ECU_ADDRESS 0x383774 /end MEASUREMENT
/begin MEASUREMENT fs52_05 "Filterwert Segmentabweichung, Betriebsbereich 52" UWORD dtsegn_b720divZylP5 1 100 -180 179.995 FORMAT "%8.4" ECU_ADDRESS 0x3837A4 /end MEASUREMENT
/begin MEASUREMENT fs52_06 "Filterwert Segmentabweichung, Betriebsbereich 52" UWORD dtsegn_b720divZylP5 1 100 -180 179.995 FORMAT "%8.4" ECU_ADDRESS 0x3837D4 /end MEASUREMENT
/begin MEASUREMENT fs52_07 "Filterwert Segmentabweichung, Betriebsbereich 52" UWORD dtsegn_b720divZylP5 1 100 -180 179.995 FORMAT "%8.4" ECU_ADDRESS 0x383804 /end MEASUREMENT
/begin MEASUREMENT fs52_08 "Filterwert Segmentabweichung, Betriebsbereich 52" UWORD dtsegn_b720divZylP5 1 100 -180 179.995 FORMAT "%8.4" ECU_ADDRESS 0x383834 /end MEASUREMENT
/begin MEASUREMENT fs53_02 "Filterwert Segmentabweichung, Betriebsbereich 53, Zylinder 2" UWORD dtsegn_b720divZylP5 1 100 -180 179.995 FORMAT "%8.4" ECU_ADDRESS 0x383724 /end MEASUREMENT
/begin MEASUREMENT fs53_03 "Filterwert Segmentabweichung, Betriebsbereich 53" UWORD dtsegn_b720divZylP5 1 100 -180 179.995 FORMAT "%8.4" ECU_ADDRESS 0x383754 /end MEASUREMENT
/begin MEASUREMENT fs53_04 "Filterwert Segmentabweichung, Betriebsbereich 53" UWORD dtsegn_b720divZylP5 1 100 -180 179.995 FORMAT "%8.4" ECU_ADDRESS 0x383784 /end MEASUREMENT
/begin MEASUREMENT fs53_05 "Filterwert Segmentabweichung, Betriebsbereich 53" UWORD dtsegn_b720divZylP5 1 100 -180 179.995 FORMAT "%8.4" ECU_ADDRESS 0x3837B4 /end MEASUREMENT
/begin MEASUREMENT fs53_06 "Filterwert Segmentabweichung, Betriebsbereich 53" UWORD dtsegn_b720divZylP5 1 100 -180 179.995 FORMAT "%8.4" ECU_ADDRESS 0x3837E4 /end MEASUREMENT
/begin MEASUREMENT fs53_07 "Filterwert Segmentabweichung, Betriebsbereich 53" UWORD dtsegn_b720divZylP5 1 100 -180 179.995 FORMAT "%8.4" ECU_ADDRESS 0x383814 /end MEASUREMENT
/begin MEASUREMENT fs53_08 "Filterwert Segmentabweichung, Betriebsbereich 53" UWORD dtsegn_b720divZylP5 1 100 -180 179.995 FORMAT "%8.4" ECU_ADDRESS 0x383844 /end MEASUREMENT
/begin MEASUREMENT fs61_02 "Filterwert Segmentabweichung, Betriebsbereich 61, Zylinder 2" UWORD dtsegn_b720divZylP5 1 100 -180 179.995 FORMAT "%8.4" ECU_ADDRESS 0x383706 /end MEASUREMENT
/begin MEASUREMENT fs61_03 "Filterwert Segmentabweichung, Betriebsbereich 61" UWORD dtsegn_b720divZylP5 1 100 -180 179.995 FORMAT "%8.4" ECU_ADDRESS 0x383736 /end MEASUREMENT
/begin MEASUREMENT fs61_04 "Filterwert Segmentabweichung, Betriebsbereich 61" UWORD dtsegn_b720divZylP5 1 100 -180 179.995 FORMAT "%8.4" ECU_ADDRESS 0x383766 /end MEASUREMENT
/begin MEASUREMENT fs61_05 "Filterwert Segmentabweichung, Betriebsbereich 61" UWORD dtsegn_b720divZylP5 1 100 -180 179.995 FORMAT "%8.4" ECU_ADDRESS 0x383796 /end MEASUREMENT
/begin MEASUREMENT fs61_06 "Filterwert Segmentabweichung, Betriebsbereich 61" UWORD dtsegn_b720divZylP5 1 100 -180 179.995 FORMAT "%8.4" ECU_ADDRESS 0x3837C6 /end MEASUREMENT
/begin MEASUREMENT fs61_07 "Filterwert Segmentabweichung, Betriebsbereich 61" UWORD dtsegn_b720divZylP5 1 100 -180 179.995 FORMAT "%8.4" ECU_ADDRESS 0x3837F6 /end MEASUREMENT
/begin MEASUREMENT fs61_08 "Filterwert Segmentabweichung, Betriebsbereich 61" UWORD dtsegn_b720divZylP5 1 100 -180 179.995 FORMAT "%8.4" ECU_ADDRESS 0x383826 /end MEASUREMENT
/begin MEASUREMENT fs62_02 "Filterwert Segmentabweichung, Betriebsbereich 62, Zylinder 2" UWORD dtsegn_b720divZylP5 1 100 -180 179.995 FORMAT "%8.4" ECU_ADDRESS 0x383716 /end MEASUREMENT
/begin MEASUREMENT fs62_03 "Filterwert Segmentabweichung, Betriebsbereich 62" UWORD dtsegn_b720divZylP5 1 100 -180 179.995 FORMAT "%8.4" ECU_ADDRESS 0x383746 /end MEASUREMENT
/begin MEASUREMENT fs62_04 "Filterwert Segmentabweichung, Betriebsbereich 62" UWORD dtsegn_b720divZylP5 1 100 -180 179.995 FORMAT "%8.4" ECU_ADDRESS 0x383776 /end MEASUREMENT
/begin MEASUREMENT fs62_05 "Filterwert Segmentabweichung, Betriebsbereich 62" UWORD dtsegn_b720divZylP5 1 100 -180 179.995 FORMAT "%8.4" ECU_ADDRESS 0x3837A6 /end MEASUREMENT
/begin MEASUREMENT fs62_06 "Filterwert Segmentabweichung, Betriebsbereich 62" UWORD dtsegn_b720divZylP5 1 100 -180 179.995 FORMAT "%8.4" ECU_ADDRESS 0x3837D6 /end MEASUREMENT
/begin MEASUREMENT fs62_07 "Filterwert Segmentabweichung, Betriebsbereich 62" UWORD dtsegn_b720divZylP5 1 100 -180 179.995 FORMAT "%8.4" ECU_ADDRESS 0x383806 /end MEASUREMENT
/begin MEASUREMENT fs62_08 "Filterwert Segmentabweichung, Betriebsbereich 62" UWORD dtsegn_b720divZylP5 1 100 -180 179.995 FORMAT "%8.4" ECU_ADDRESS 0x383836 /end MEASUREMENT
/begin MEASUREMENT fs63_02 "Filterwert Segmentabweichung, Betriebsbereich 63, Zylinder 2" UWORD dtsegn_b720divZylP5 1 100 -180 179.995 FORMAT "%8.4" ECU_ADDRESS 0x383726 /end MEASUREMENT
/begin MEASUREMENT fs63_03 "Filterwert Segmentabweichung, Betriebsbereich 63" UWORD dtsegn_b720divZylP5 1 100 -180 179.995 FORMAT "%8.4" ECU_ADDRESS 0x383756 /end MEASUREMENT
/begin MEASUREMENT fs63_04 "Filterwert Segmentabweichung, Betriebsbereich 63" UWORD dtsegn_b720divZylP5 1 100 -180 179.995 FORMAT "%8.4" ECU_ADDRESS 0x383786 /end MEASUREMENT
/begin MEASUREMENT fs63_05 "Filterwert Segmentabweichung, Betriebsbereich 63" UWORD dtsegn_b720divZylP5 1 100 -180 179.995 FORMAT "%8.4" ECU_ADDRESS 0x3837B6 /end MEASUREMENT
/begin MEASUREMENT fs63_06 "Filterwert Segmentabweichung, Betriebsbereich 63" UWORD dtsegn_b720divZylP5 1 100 -180 179.995 FORMAT "%8.4" ECU_ADDRESS 0x3837E6 /end MEASUREMENT
/begin MEASUREMENT fs63_07 "Filterwert Segmentabweichung, Betriebsbereich 63" UWORD dtsegn_b720divZylP5 1 100 -180 179.995 FORMAT "%8.4" ECU_ADDRESS 0x383816 /end MEASUREMENT
/begin MEASUREMENT fs63_08 "Filterwert Segmentabweichung, Betriebsbereich 63" UWORD dtsegn_b720divZylP5 1 100 -180 179.995 FORMAT "%8.4" ECU_ADDRESS 0x383846 /end MEASUREMENT
/begin MEASUREMENT fs71_02 "Filterwert Segmentabweichung, Betriebsbereich 71, Zylinder 2" UWORD dtsegn_b720divZylP5 1 100 -180 179.995 FORMAT "%8.4" ECU_ADDRESS 0x383708 /end MEASUREMENT
/begin MEASUREMENT fs71_03 "Filterwert Segmentabweichung, Betriebsbereich 71, Zylinder 3" UWORD dtsegn_b720divZylP5 1 100 -180 179.995 FORMAT "%8.4" ECU_ADDRESS 0x383738 /end MEASUREMENT
/begin MEASUREMENT fs71_04 "Filterwert Segmentabweichung, Betriebsbereich 71, Zylinder 4" UWORD dtsegn_b720divZylP5 1 100 -180 179.995 FORMAT "%8.4" ECU_ADDRESS 0x383768 /end MEASUREMENT
/begin MEASUREMENT fs71_05 "Filterwert Segmentabweichung, Betriebsbereich 71, Zylinder 5" UWORD dtsegn_b720divZylP5 1 100 -180 179.995 FORMAT "%8.4" ECU_ADDRESS 0x383798 /end MEASUREMENT
/begin MEASUREMENT fs71_06 "Filterwert Segmentabweichung, Betriebsbereich 71, Zylinder 6" UWORD dtsegn_b720divZylP5 1 100 -180 179.995 FORMAT "%8.4" ECU_ADDRESS 0x3837C8 /end MEASUREMENT
/begin MEASUREMENT fs71_07 "Filterwert Segmentabweichung, Betriebsbereich 71, Zylinder 7" UWORD dtsegn_b720divZylP5 1 100 -180 179.995 FORMAT "%8.4" ECU_ADDRESS 0x3837F8 /end MEASUREMENT
/begin MEASUREMENT fs71_08 "Filterwert Segmentabweichung, Betriebsbereich 71, Zylinder 8" UWORD dtsegn_b720divZylP5 1 100 -180 179.995 FORMAT "%8.4" ECU_ADDRESS 0x383828 /end MEASUREMENT
/begin MEASUREMENT fs72_02 "Filterwert Segmentabweichung, Betriebsbereich 72, Zylinder 2" UWORD dtsegn_b720divZylP5 1 100 -180 179.995 FORMAT "%8.4" ECU_ADDRESS 0x383718 /end MEASUREMENT
/begin MEASUREMENT fs72_03 "Filterwert Segmentabweichung, Betriebsbereich 72, Zylinder 3" UWORD dtsegn_b720divZylP5 1 100 -180 179.995 FORMAT "%8.4" ECU_ADDRESS 0x383748 /end MEASUREMENT
/begin MEASUREMENT fs72_04 "Filterwert Segmentabweichung, Betriebsbereich 72, Zylinder 4" UWORD dtsegn_b720divZylP5 1 100 -180 179.995 FORMAT "%8.4" ECU_ADDRESS 0x383778 /end MEASUREMENT
/begin MEASUREMENT fs72_05 "Filterwert Segmentabweichung, Betriebsbereich 72, Zylinder 5" UWORD dtsegn_b720divZylP5 1 100 -180 179.995 FORMAT "%8.4" ECU_ADDRESS 0x3837A8 /end MEASUREMENT
/begin MEASUREMENT fs72_06 "Filterwert Segmentabweichung, Betriebsbereich 72, Zylinder 6" UWORD dtsegn_b720divZylP5 1 100 -180 179.995 FORMAT "%8.4" ECU_ADDRESS 0x3837D8 /end MEASUREMENT
/begin MEASUREMENT fs72_07 "Filterwert Segmentabweichung, Betriebsbereich 72, Zylinder 7" UWORD dtsegn_b720divZylP5 1 100 -180 179.995 FORMAT "%8.4" ECU_ADDRESS 0x383808 /end MEASUREMENT
/begin MEASUREMENT fs72_08 "Filterwert Segmentabweichung, Betriebsbereich 72, Zylinder 8" UWORD dtsegn_b720divZylP5 1 100 -180 179.995 FORMAT "%8.4" ECU_ADDRESS 0x383838 /end MEASUREMENT
/begin MEASUREMENT fs73_02 "Filterwert Segmentabweichung, Betriebsbereich 73, Zylinder 2" UWORD dtsegn_b720divZylP5 1 100 -180 179.995 FORMAT "%8.4" ECU_ADDRESS 0x383728 /end MEASUREMENT
/begin MEASUREMENT fs73_03 "Filterwert Segmentabweichung, Betriebsbereich 73, Zylinder 3" UWORD dtsegn_b720divZylP5 1 100 -180 179.995 FORMAT "%8.4" ECU_ADDRESS 0x383758 /end MEASUREMENT
/begin MEASUREMENT fs73_04 "Filterwert Segmentabweichung, Betriebsbereich 73, Zylinder 4" UWORD dtsegn_b720divZylP5 1 100 -180 179.995 FORMAT "%8.4" ECU_ADDRESS 0x383788 /end MEASUREMENT
/begin MEASUREMENT fs73_05 "Filterwert Segmentabweichung, Betriebsbereich 73, Zylinder 5" UWORD dtsegn_b720divZylP5 1 100 -180 179.995 FORMAT "%8.4" ECU_ADDRESS 0x3837B8 /end MEASUREMENT
/begin MEASUREMENT fs73_06 "Filterwert Segmentabweichung, Betriebsbereich 73, Zylinder 6" UWORD dtsegn_b720divZylP5 1 100 -180 179.995 FORMAT "%8.4" ECU_ADDRESS 0x3837E8 /end MEASUREMENT
/begin MEASUREMENT fs73_07 "Filterwert Segmentabweichung, Betriebsbereich 73, Zylinder 7" UWORD dtsegn_b720divZylP5 1 100 -180 179.995 FORMAT "%8.4" ECU_ADDRESS 0x383818 /end MEASUREMENT
/begin MEASUREMENT fs73_08 "Filterwert Segmentabweichung, Betriebsbereich 73, Zylinder 8" UWORD dtsegn_b720divZylP5 1 100 -180 179.995 FORMAT "%8.4" ECU_ADDRESS 0x383848 /end MEASUREMENT
/begin MEASUREMENT fs81_02 "Filterwert Segmentabweichung, Betriebsbereich 81, Zylinder 2" UWORD dtsegn_b720divZylP5 1 100 -180 179.995 FORMAT "%8.4" ECU_ADDRESS 0x38370A /end MEASUREMENT
/begin MEASUREMENT fs81_03 "Filterwert Segmentabweichung, Betriebsbereich 81, Zylinder 3" UWORD dtsegn_b720divZylP5 1 100 -180 179.995 FORMAT "%8.4" ECU_ADDRESS 0x38373A /end MEASUREMENT
/begin MEASUREMENT fs81_04 "Filterwert Segmentabweichung, Betriebsbereich 81, Zylinder 4" UWORD dtsegn_b720divZylP5 1 100 -180 179.995 FORMAT "%8.4" ECU_ADDRESS 0x38376A /end MEASUREMENT
/begin MEASUREMENT fs81_05 "Filterwert Segmentabweichung, Betriebsbereich 81, Zylinder 5" UWORD dtsegn_b720divZylP5 1 100 -180 179.995 FORMAT "%8.4" ECU_ADDRESS 0x38379A /end MEASUREMENT
/begin MEASUREMENT fs81_06 "Filterwert Segmentabweichung, Betriebsbereich 81, Zylinder 6" UWORD dtsegn_b720divZylP5 1 100 -180 179.995 FORMAT "%8.4" ECU_ADDRESS 0x3837CA /end MEASUREMENT
/begin MEASUREMENT fs81_07 "Filterwert Segmentabweichung, Betriebsbereich 81, Zylinder 7" UWORD dtsegn_b720divZylP5 1 100 -180 179.995 FORMAT "%8.4" ECU_ADDRESS 0x3837FA /end MEASUREMENT
/begin MEASUREMENT fs81_08 "Filterwert Segmentabweichung, Betriebsbereich 81, Zylinder 8" UWORD dtsegn_b720divZylP5 1 100 -180 179.995 FORMAT "%8.4" ECU_ADDRESS 0x38382A /end MEASUREMENT
/begin MEASUREMENT fs82_02 "Filterwert Segmentabweichung, Betriebsbereich 82, Zylinder 2" UWORD dtsegn_b720divZylP5 1 100 -180 179.995 FORMAT "%8.4" ECU_ADDRESS 0x38371A /end MEASUREMENT
/begin MEASUREMENT fs82_03 "Filterwert Segmentabweichung, Betriebsbereich 82, Zylinder 3" UWORD dtsegn_b720divZylP5 1 100 -180 179.995 FORMAT "%8.4" ECU_ADDRESS 0x38374A /end MEASUREMENT
/begin MEASUREMENT fs82_04 "Filterwert Segmentabweichung, Betriebsbereich 82, Zylinder 4" UWORD dtsegn_b720divZylP5 1 100 -180 179.995 FORMAT "%8.4" ECU_ADDRESS 0x38377A /end MEASUREMENT
/begin MEASUREMENT fs82_05 "Filterwert Segmentabweichung, Betriebsbereich 82, Zylinder 5" UWORD dtsegn_b720divZylP5 1 100 -180 179.995 FORMAT "%8.4" ECU_ADDRESS 0x3837AA /end MEASUREMENT
/begin MEASUREMENT fs82_06 "Filterwert Segmentabweichung, Betriebsbereich 82, Zylinder 6" UWORD dtsegn_b720divZylP5 1 100 -180 179.995 FORMAT "%8.4" ECU_ADDRESS 0x3837DA /end MEASUREMENT
/begin MEASUREMENT fs82_07 "Filterwert Segmentabweichung, Betriebsbereich 82, Zylinder 7" UWORD dtsegn_b720divZylP5 1 100 -180 179.995 FORMAT "%8.4" ECU_ADDRESS 0x38380A /end MEASUREMENT
/begin MEASUREMENT fs82_08 "Filterwert Segmentabweichung, Betriebsbereich 82, Zylinder 8" UWORD dtsegn_b720divZylP5 1 100 -180 179.995 FORMAT "%8.4" ECU_ADDRESS 0x38383A /end MEASUREMENT
/begin MEASUREMENT fs83_02 "Filterwert Segmentabweichung, Betriebsbereich 83, Zylinder 2" UWORD dtsegn_b720divZylP5 1 100 -180 179.995 FORMAT "%8.4" ECU_ADDRESS 0x38372A /end MEASUREMENT
/begin MEASUREMENT fs83_03 "Filterwert Segmentabweichung, Betriebsbereich 83, Zylinder 3" UWORD dtsegn_b720divZylP5 1 100 -180 179.995 FORMAT "%8.4" ECU_ADDRESS 0x38375A /end MEASUREMENT
/begin MEASUREMENT fs83_04 "Filterwert Segmentabweichung, Betriebsbereich 83, Zylinder 4" UWORD dtsegn_b720divZylP5 1 100 -180 179.995 FORMAT "%8.4" ECU_ADDRESS 0x38378A /end MEASUREMENT
/begin MEASUREMENT fs83_05 "Filterwert Segmentabweichung, Betriebsbereich 83, Zylinder 5" UWORD dtsegn_b720divZylP5 1 100 -180 179.995 FORMAT "%8.4" ECU_ADDRESS 0x3837BA /end MEASUREMENT
/begin MEASUREMENT fs83_06 "Filterwert Segmentabweichung, Betriebsbereich 83, Zylinder 6" UWORD dtsegn_b720divZylP5 1 100 -180 179.995 FORMAT "%8.4" ECU_ADDRESS 0x3837EA /end MEASUREMENT
/begin MEASUREMENT fs83_07 "Filterwert Segmentabweichung, Betriebsbereich 83, Zylinder 7" UWORD dtsegn_b720divZylP5 1 100 -180 179.995 FORMAT "%8.4" ECU_ADDRESS 0x38381A /end MEASUREMENT
/begin MEASUREMENT fs83_08 "Filterwert Segmentabweichung, Betriebsbereich 83, Zylinder 8" UWORD dtsegn_b720divZylP5 1 100 -180 179.995 FORMAT "%8.4" ECU_ADDRESS 0x38384A /end MEASUREMENT
/begin MEASUREMENT fse "aktueller Filterwert Segmentabweichung, zur Segmentzeit-Korrektur" SBYTE dtsegn_b11p25divZyl 1 100 -2.8125 2.79053 FORMAT "%5.3" ECU_ADDRESS 0xE41B /end MEASUREMENT
/begin MEASUREMENT fse11_02 "Filterwert Segmentabweichung, eingerechnet" UBYTE dtsegno_b11p25divZyl 1 100 -2.8125 2.79053 FORMAT "%5.3" ECU_ADDRESS 0x38325C /end MEASUREMENT
/begin MEASUREMENT fse11_03 "Filterwert Segmentabweichung, eingerechnet" UBYTE dtsegno_b11p25divZyl 1 100 -2.8125 2.79053 FORMAT "%5.3" ECU_ADDRESS 0x383274 /end MEASUREMENT
/begin MEASUREMENT fse11_04 "Filterwert Segmentabweichung, eingerechnet" UBYTE dtsegno_b11p25divZyl 1 100 -2.8125 2.79053 FORMAT "%5.3" ECU_ADDRESS 0x38328C /end MEASUREMENT
/begin MEASUREMENT fse11_05 "Filterwert Segmentabweichung, eingerechnet" UBYTE dtsegno_b11p25divZyl 1 100 -2.8125 2.79053 FORMAT "%5.3" ECU_ADDRESS 0x3832A4 /end MEASUREMENT
/begin MEASUREMENT fse11_06 "Filterwert Segmentabweichung, eingerechnet" UBYTE dtsegno_b11p25divZyl 1 100 -2.8125 2.79053 FORMAT "%5.3" ECU_ADDRESS 0x3832BC /end MEASUREMENT
/begin MEASUREMENT fse11_07 "Filterwert Segmentabweichung, eingerechnet" UBYTE dtsegno_b11p25divZyl 1 100 -2.8125 2.79053 FORMAT "%5.3" ECU_ADDRESS 0x3832D4 /end MEASUREMENT
/begin MEASUREMENT fse11_08 "Filterwert Segmentabweichung, eingerechnet" UBYTE dtsegno_b11p25divZyl 1 100 -2.8125 2.79053 FORMAT "%5.3" ECU_ADDRESS 0x3832EC /end MEASUREMENT
/begin MEASUREMENT fse12_02 "Filterwert Segmentabweichung, eingerechnet" UBYTE dtsegno_b11p25divZyl 1 100 -2.8125 2.79053 FORMAT "%5.3" ECU_ADDRESS 0x383264 /end MEASUREMENT
/begin MEASUREMENT fse12_03 "Filterwert Segmentabweichung, eingerechnet" UBYTE dtsegno_b11p25divZyl 1 100 -2.8125 2.79053 FORMAT "%5.3" ECU_ADDRESS 0x38327C /end MEASUREMENT
/begin MEASUREMENT fse12_04 "Filterwert Segmentabweichung, eingerechnet" UBYTE dtsegno_b11p25divZyl 1 100 -2.8125 2.79053 FORMAT "%5.3" ECU_ADDRESS 0x383294 /end MEASUREMENT
/begin MEASUREMENT fse12_05 "Filterwert Segmentabweichung, eingerechnet" UBYTE dtsegno_b11p25divZyl 1 100 -2.8125 2.79053 FORMAT "%5.3" ECU_ADDRESS 0x3832AC /end MEASUREMENT
/begin MEASUREMENT fse12_06 "Filterwert Segmentabweichung, eingerechnet" UBYTE dtsegno_b11p25divZyl 1 100 -2.8125 2.79053 FORMAT "%5.3" ECU_ADDRESS 0x3832C4 /end MEASUREMENT
/begin MEASUREMENT fse12_07 "Filterwert Segmentabweichung, eingerechnet" UBYTE dtsegno_b11p25divZyl 1 100 -2.8125 2.79053 FORMAT "%5.3" ECU_ADDRESS 0x3832DC /end MEASUREMENT
/begin MEASUREMENT fse12_08 "Filterwert Segmentabweichung, eingerechnet" UBYTE dtsegno_b11p25divZyl 1 100 -2.8125 2.79053 FORMAT "%5.3" ECU_ADDRESS 0x3832F4 /end MEASUREMENT
/begin MEASUREMENT fse13_02 "Filterwert Segmentabweichung, eingerechnet" UBYTE dtsegno_b11p25divZyl 1 100 -2.8125 2.79053 FORMAT "%5.3" ECU_ADDRESS 0x38326C /end MEASUREMENT
/begin MEASUREMENT fse13_03 "Filterwert Segmentabweichung, eingerechnet" UBYTE dtsegno_b11p25divZyl 1 100 -2.8125 2.79053 FORMAT "%5.3" ECU_ADDRESS 0x383284 /end MEASUREMENT
/begin MEASUREMENT fse13_04 "Filterwert Segmentabweichung, eingerechnet" UBYTE dtsegno_b11p25divZyl 1 100 -2.8125 2.79053 FORMAT "%5.3" ECU_ADDRESS 0x38329C /end MEASUREMENT
/begin MEASUREMENT fse13_05 "Filterwert Segmentabweichung, eingerechnet" UBYTE dtsegno_b11p25divZyl 1 100 -2.8125 2.79053 FORMAT "%5.3" ECU_ADDRESS 0x3832B4 /end MEASUREMENT
/begin MEASUREMENT fse13_06 "Filterwert Segmentabweichung, eingerechnet" UBYTE dtsegno_b11p25divZyl 1 100 -2.8125 2.79053 FORMAT "%5.3" ECU_ADDRESS 0x3832CC /end MEASUREMENT
/begin MEASUREMENT fse13_07 "Filterwert Segmentabweichung, eingerechnet" UBYTE dtsegno_b11p25divZyl 1 100 -2.8125 2.79053 FORMAT "%5.3" ECU_ADDRESS 0x3832E4 /end MEASUREMENT
/begin MEASUREMENT fse13_08 "Filterwert Segmentabweichung, eingerechnet" UBYTE dtsegno_b11p25divZyl 1 100 -2.8125 2.79053 FORMAT "%5.3" ECU_ADDRESS 0x3832FC /end MEASUREMENT
/begin MEASUREMENT fse21_02 "Filterwert Segmentabweichung, eingerechnet" UBYTE dtsegno_b11p25divZyl 1 100 -2.8125 2.79053 FORMAT "%5.3" ECU_ADDRESS 0x38325D /end MEASUREMENT
/begin MEASUREMENT fse21_03 "Filterwert Segmentabweichung, eingerechnet" UBYTE dtsegno_b11p25divZyl 1 100 -2.8125 2.79053 FORMAT "%5.3" ECU_ADDRESS 0x383275 /end MEASUREMENT
/begin MEASUREMENT fse21_04 "Filterwert Segmentabweichung, eingerechnet" UBYTE dtsegno_b11p25divZyl 1 100 -2.8125 2.79053 FORMAT "%5.3" ECU_ADDRESS 0x38328D /end MEASUREMENT
/begin MEASUREMENT fse21_05 "Filterwert Segmentabweichung, eingerechnet" UBYTE dtsegno_b11p25divZyl 1 100 -2.8125 2.79053 FORMAT "%5.3" ECU_ADDRESS 0x3832A5 /end MEASUREMENT
/begin MEASUREMENT fse21_06 "Filterwert Segmentabweichung, eingerechnet" UBYTE dtsegno_b11p25divZyl 1 100 -2.8125 2.79053 FORMAT "%5.3" ECU_ADDRESS 0x3832BD /end MEASUREMENT
/begin MEASUREMENT fse21_07 "Filterwert Segmentabweichung, eingerechnet" UBYTE dtsegno_b11p25divZyl 1 100 -2.8125 2.79053 FORMAT "%5.3" ECU_ADDRESS 0x3832D5 /end MEASUREMENT
/begin MEASUREMENT fse21_08 "Filterwert Segmentabweichung, eingerechnet" UBYTE dtsegno_b11p25divZyl 1 100 -2.8125 2.79053 FORMAT "%5.3" ECU_ADDRESS 0x3832ED /end MEASUREMENT
/begin MEASUREMENT fse22_02 "Filterwert Segmentabweichung, eingerechnet" UBYTE dtsegno_b11p25divZyl 1 100 -2.8125 2.79053 FORMAT "%5.3" ECU_ADDRESS 0x383265 /end MEASUREMENT
/begin MEASUREMENT fse22_03 "Filterwert Segmentabweichung, eingerechnet" UBYTE dtsegno_b11p25divZyl 1 100 -2.8125 2.79053 FORMAT "%5.3" ECU_ADDRESS 0x38327D /end MEASUREMENT
/begin MEASUREMENT fse22_04 "Filterwert Segmentabweichung, eingerechnet" UBYTE dtsegno_b11p25divZyl 1 100 -2.8125 2.79053 FORMAT "%5.3" ECU_ADDRESS 0x383295 /end MEASUREMENT
/begin MEASUREMENT fse22_05 "Filterwert Segmentabweichung, eingerechnet" UBYTE dtsegno_b11p25divZyl 1 100 -2.8125 2.79053 FORMAT "%5.3" ECU_ADDRESS 0x3832AD /end MEASUREMENT
/begin MEASUREMENT fse22_06 "Filterwert Segmentabweichung, eingerechnet" UBYTE dtsegno_b11p25divZyl 1 100 -2.8125 2.79053 FORMAT "%5.3" ECU_ADDRESS 0x3832C5 /end MEASUREMENT
/begin MEASUREMENT fse22_07 "Filterwert Segmentabweichung, eingerechnet" UBYTE dtsegno_b11p25divZyl 1 100 -2.8125 2.79053 FORMAT "%5.3" ECU_ADDRESS 0x3832DD /end MEASUREMENT
/begin MEASUREMENT fse22_08 "Filterwert Segmentabweichung, eingerechnet" UBYTE dtsegno_b11p25divZyl 1 100 -2.8125 2.79053 FORMAT "%5.3" ECU_ADDRESS 0x3832F5 /end MEASUREMENT
/begin MEASUREMENT fse23_02 "Filterwert Segmentabweichung, eingerechnet" UBYTE dtsegno_b11p25divZyl 1 100 -2.8125 2.79053 FORMAT "%5.3" ECU_ADDRESS 0x38326D /end MEASUREMENT
/begin MEASUREMENT fse23_03 "Filterwert Segmentabweichung, eingerechnet" UBYTE dtsegno_b11p25divZyl 1 100 -2.8125 2.79053 FORMAT "%5.3" ECU_ADDRESS 0x383285 /end MEASUREMENT
/begin MEASUREMENT fse23_04 "Filterwert Segmentabweichung, eingerechnet" UBYTE dtsegno_b11p25divZyl 1 100 -2.8125 2.79053 FORMAT "%5.3" ECU_ADDRESS 0x38329D /end MEASUREMENT
/begin MEASUREMENT fse23_05 "Filterwert Segmentabweichung, eingerechnet" UBYTE dtsegno_b11p25divZyl 1 100 -2.8125 2.79053 FORMAT "%5.3" ECU_ADDRESS 0x3832B5 /end MEASUREMENT
/begin MEASUREMENT fse23_06 "Filterwert Segmentabweichung, eingerechnet" UBYTE dtsegno_b11p25divZyl 1 100 -2.8125 2.79053 FORMAT "%5.3" ECU_ADDRESS 0x3832CD /end MEASUREMENT
/begin MEASUREMENT fse23_07 "Filterwert Segmentabweichung, eingerechnet" UBYTE dtsegno_b11p25divZyl 1 100 -2.8125 2.79053 FORMAT "%5.3" ECU_ADDRESS 0x3832E5 /end MEASUREMENT
/begin MEASUREMENT fse23_08 "Filterwert Segmentabweichung, eingerechnet" UBYTE dtsegno_b11p25divZyl 1 100 -2.8125 2.79053 FORMAT "%5.3" ECU_ADDRESS 0x3832FD /end MEASUREMENT
/begin MEASUREMENT fse31_02 "Filterwert Segmentabweichung, eingerechnet" UBYTE dtsegno_b11p25divZyl 1 100 -2.8125 2.79053 FORMAT "%5.3" ECU_ADDRESS 0x38325E /end MEASUREMENT
/begin MEASUREMENT fse31_03 "Filterwert Segmentabweichung, eingerechnet" UBYTE dtsegno_b11p25divZyl 1 100 -2.8125 2.79053 FORMAT "%5.3" ECU_ADDRESS 0x383276 /end MEASUREMENT
/begin MEASUREMENT fse31_04 "Filterwert Segmentabweichung, eingerechnet" UBYTE dtsegno_b11p25divZyl 1 100 -2.8125 2.79053 FORMAT "%5.3" ECU_ADDRESS 0x38328E /end MEASUREMENT
/begin MEASUREMENT fse31_05 "Filterwert Segmentabweichung, eingerechnet" UBYTE dtsegno_b11p25divZyl 1 100 -2.8125 2.79053 FORMAT "%5.3" ECU_ADDRESS 0x3832A6 /end MEASUREMENT
/begin MEASUREMENT fse31_06 "Filterwert Segmentabweichung, eingerechnet" UBYTE dtsegno_b11p25divZyl 1 100 -2.8125 2.79053 FORMAT "%5.3" ECU_ADDRESS 0x3832BE /end MEASUREMENT
/begin MEASUREMENT fse31_07 "Filterwert Segmentabweichung, eingerechnet" UBYTE dtsegno_b11p25divZyl 1 100 -2.8125 2.79053 FORMAT "%5.3" ECU_ADDRESS 0x3832D6 /end MEASUREMENT
/begin MEASUREMENT fse31_08 "Filterwert Segmentabweichung, eingerechnet" UBYTE dtsegno_b11p25divZyl 1 100 -2.8125 2.79053 FORMAT "%5.3" ECU_ADDRESS 0x3832EE /end MEASUREMENT
/begin MEASUREMENT fse32_02 "Filterwert Segmentabweichung, eingerechnet" UBYTE dtsegno_b11p25divZyl 1 100 -2.8125 2.79053 FORMAT "%5.3" ECU_ADDRESS 0x383266 /end MEASUREMENT
/begin MEASUREMENT fse32_03 "Filterwert Segmentabweichung, eingerechnet" UBYTE dtsegno_b11p25divZyl 1 100 -2.8125 2.79053 FORMAT "%5.3" ECU_ADDRESS 0x38327E /end MEASUREMENT
/begin MEASUREMENT fse32_04 "Filterwert Segmentabweichung, eingerechnet" UBYTE dtsegno_b11p25divZyl 1 100 -2.8125 2.79053 FORMAT "%5.3" ECU_ADDRESS 0x383296 /end MEASUREMENT
/begin MEASUREMENT fse32_05 "Filterwert Segmentabweichung, eingerechnet" UBYTE dtsegno_b11p25divZyl 1 100 -2.8125 2.79053 FORMAT "%5.3" ECU_ADDRESS 0x3832AE /end MEASUREMENT
/begin MEASUREMENT fse32_06 "Filterwert Segmentabweichung, eingerechnet" UBYTE dtsegno_b11p25divZyl 1 100 -2.8125 2.79053 FORMAT "%5.3" ECU_ADDRESS 0x3832C6 /end MEASUREMENT
/begin MEASUREMENT fse32_07 "Filterwert Segmentabweichung, eingerechnet" UBYTE dtsegno_b11p25divZyl 1 100 -2.8125 2.79053 FORMAT "%5.3" ECU_ADDRESS 0x3832DE /end MEASUREMENT
/begin MEASUREMENT fse32_08 "Filterwert Segmentabweichung, eingerechnet" UBYTE dtsegno_b11p25divZyl 1 100 -2.8125 2.79053 FORMAT "%5.3" ECU_ADDRESS 0x3832F6 /end MEASUREMENT
/begin MEASUREMENT fse33_02 "Filterwert Segmentabweichung, eingerechnet" UBYTE dtsegno_b11p25divZyl 1 100 -2.8125 2.79053 FORMAT "%5.3" ECU_ADDRESS 0x38326E /end MEASUREMENT
/begin MEASUREMENT fse33_03 "Filterwert Segmentabweichung, eingerechnet" UBYTE dtsegno_b11p25divZyl 1 100 -2.8125 2.79053 FORMAT "%5.3" ECU_ADDRESS 0x383286 /end MEASUREMENT
/begin MEASUREMENT fse33_04 "Filterwert Segmentabweichung, eingerechnet" UBYTE dtsegno_b11p25divZyl 1 100 -2.8125 2.79053 FORMAT "%5.3" ECU_ADDRESS 0x38329E /end MEASUREMENT
/begin MEASUREMENT fse33_05 "Filterwert Segmentabweichung, eingerechnet" UBYTE dtsegno_b11p25divZyl 1 100 -2.8125 2.79053 FORMAT "%5.3" ECU_ADDRESS 0x3832B6 /end MEASUREMENT
/begin MEASUREMENT fse33_06 "Filterwert Segmentabweichung, eingerechnet" UBYTE dtsegno_b11p25divZyl 1 100 -2.8125 2.79053 FORMAT "%5.3" ECU_ADDRESS 0x3832CE /end MEASUREMENT
/begin MEASUREMENT fse33_07 "Filterwert Segmentabweichung, eingerechnet" UBYTE dtsegno_b11p25divZyl 1 100 -2.8125 2.79053 FORMAT "%5.3" ECU_ADDRESS 0x3832E6 /end MEASUREMENT
/begin MEASUREMENT fse33_08 "Filterwert Segmentabweichung, eingerechnet" UBYTE dtsegno_b11p25divZyl 1 100 -2.8125 2.79053 FORMAT "%5.3" ECU_ADDRESS 0x3832FE /end MEASUREMENT
/begin MEASUREMENT fse41_02 "Filterwert Segmentabweichung, eingerechnet" UBYTE dtsegno_b11p25divZyl 1 100 -2.8125 2.79053 FORMAT "%5.3" ECU_ADDRESS 0x38325F /end MEASUREMENT
/begin MEASUREMENT fse41_03 "Filterwert Segmentabweichung, eingerechnet" UBYTE dtsegno_b11p25divZyl 1 100 -2.8125 2.79053 FORMAT "%5.3" ECU_ADDRESS 0x383277 /end MEASUREMENT
/begin MEASUREMENT fse41_04 "Filterwert Segmentabweichung, eingerechnet" UBYTE dtsegno_b11p25divZyl 1 100 -2.8125 2.79053 FORMAT "%5.3" ECU_ADDRESS 0x38328F /end MEASUREMENT
/begin MEASUREMENT fse41_05 "Filterwert Segmentabweichung, eingerechnet" UBYTE dtsegno_b11p25divZyl 1 100 -2.8125 2.79053 FORMAT "%5.3" ECU_ADDRESS 0x3832A7 /end MEASUREMENT
/begin MEASUREMENT fse41_06 "Filterwert Segmentabweichung, eingerechnet" UBYTE dtsegno_b11p25divZyl 1 100 -2.8125 2.79053 FORMAT "%5.3" ECU_ADDRESS 0x3832BF /end MEASUREMENT
/begin MEASUREMENT fse41_07 "Filterwert Segmentabweichung, eingerechnet" UBYTE dtsegno_b11p25divZyl 1 100 -2.8125 2.79053 FORMAT "%5.3" ECU_ADDRESS 0x3832D7 /end MEASUREMENT
/begin MEASUREMENT fse41_08 "Filterwert Segmentabweichung, eingerechnet" UBYTE dtsegno_b11p25divZyl 1 100 -2.8125 2.79053 FORMAT "%5.3" ECU_ADDRESS 0x3832EF /end MEASUREMENT
/begin MEASUREMENT fse42_02 "Filterwert Segmentabweichung, eingerechnet" UBYTE dtsegno_b11p25divZyl 1 100 -2.8125 2.79053 FORMAT "%5.3" ECU_ADDRESS 0x383267 /end MEASUREMENT
/begin MEASUREMENT fse42_03 "Filterwert Segmentabweichung, eingerechnet" UBYTE dtsegno_b11p25divZyl 1 100 -2.8125 2.79053 FORMAT "%5.3" ECU_ADDRESS 0x38327F /end MEASUREMENT
/begin MEASUREMENT fse42_04 "Filterwert Segmentabweichung, eingerechnet" UBYTE dtsegno_b11p25divZyl 1 100 -2.8125 2.79053 FORMAT "%5.3" ECU_ADDRESS 0x383297 /end MEASUREMENT
/begin MEASUREMENT fse42_05 "Filterwert Segmentabweichung, eingerechnet" UBYTE dtsegno_b11p25divZyl 1 100 -2.8125 2.79053 FORMAT "%5.3" ECU_ADDRESS 0x3832AF /end MEASUREMENT
/begin MEASUREMENT fse42_06 "Filterwert Segmentabweichung, eingerechnet" UBYTE dtsegno_b11p25divZyl 1 100 -2.8125 2.79053 FORMAT "%5.3" ECU_ADDRESS 0x3832C7 /end MEASUREMENT
/begin MEASUREMENT fse42_07 "Filterwert Segmentabweichung, eingerechnet" UBYTE dtsegno_b11p25divZyl 1 100 -2.8125 2.79053 FORMAT "%5.3" ECU_ADDRESS 0x3832DF /end MEASUREMENT
/begin MEASUREMENT fse42_08 "Filterwert Segmentabweichung, eingerechnet" UBYTE dtsegno_b11p25divZyl 1 100 -2.8125 2.79053 FORMAT "%5.3" ECU_ADDRESS 0x3832F7 /end MEASUREMENT
/begin MEASUREMENT fse43_02 "Filterwert Segmentabweichung, eingerechnet" UBYTE dtsegno_b11p25divZyl 1 100 -2.8125 2.79053 FORMAT "%5.3" ECU_ADDRESS 0x38326F /end MEASUREMENT
/begin MEASUREMENT fse43_03 "Filterwert Segmentabweichung, eingerechnet" UBYTE dtsegno_b11p25divZyl 1 100 -2.8125 2.79053 FORMAT "%5.3" ECU_ADDRESS 0x383287 /end MEASUREMENT
/begin MEASUREMENT fse43_04 "Filterwert Segmentabweichung, eingerechnet" UBYTE dtsegno_b11p25divZyl 1 100 -2.8125 2.79053 FORMAT "%5.3" ECU_ADDRESS 0x38329F /end MEASUREMENT
/begin MEASUREMENT fse43_05 "Filterwert Segmentabweichung, eingerechnet" UBYTE dtsegno_b11p25divZyl 1 100 -2.8125 2.79053 FORMAT "%5.3" ECU_ADDRESS 0x3832B7 /end MEASUREMENT
/begin MEASUREMENT fse43_06 "Filterwert Segmentabweichung, eingerechnet" UBYTE dtsegno_b11p25divZyl 1 100 -2.8125 2.79053 FORMAT "%5.3" ECU_ADDRESS 0x3832CF /end MEASUREMENT
/begin MEASUREMENT fse43_07 "Filterwert Segmentabweichung, eingerechnet" UBYTE dtsegno_b11p25divZyl 1 100 -2.8125 2.79053 FORMAT "%5.3" ECU_ADDRESS 0x3832E7 /end MEASUREMENT
/begin MEASUREMENT fse43_08 "Filterwert Segmentabweichung, eingerechnet" UBYTE dtsegno_b11p25divZyl 1 100 -2.8125 2.79053 FORMAT "%5.3" ECU_ADDRESS 0x3832FF /end MEASUREMENT
/begin MEASUREMENT fse51_02 "Filterwert Segmentabweichung, eingerechnet" UBYTE dtsegno_b11p25divZyl 1 100 -2.8125 2.79053 FORMAT "%5.3" ECU_ADDRESS 0x383260 /end MEASUREMENT
/begin MEASUREMENT fse51_03 "Filterwert Segmentabweichung, eingerechnet" UBYTE dtsegno_b11p25divZyl 1 100 -2.8125 2.79053 FORMAT "%5.3" ECU_ADDRESS 0x383278 /end MEASUREMENT
/begin MEASUREMENT fse51_04 "Filterwert Segmentabweichung, eingerechnet" UBYTE dtsegno_b11p25divZyl 1 100 -2.8125 2.79053 FORMAT "%5.3" ECU_ADDRESS 0x383290 /end MEASUREMENT
/begin MEASUREMENT fse51_05 "Filterwert Segmentabweichung, eingerechnet" UBYTE dtsegno_b11p25divZyl 1 100 -2.8125 2.79053 FORMAT "%5.3" ECU_ADDRESS 0x3832A8 /end MEASUREMENT
/begin MEASUREMENT fse51_06 "Filterwert Segmentabweichung, eingerechnet" UBYTE dtsegno_b11p25divZyl 1 100 -2.8125 2.79053 FORMAT "%5.3" ECU_ADDRESS 0x3832C0 /end MEASUREMENT
/begin MEASUREMENT fse51_07 "Filterwert Segmentabweichung, eingerechnet" UBYTE dtsegno_b11p25divZyl 1 100 -2.8125 2.79053 FORMAT "%5.3" ECU_ADDRESS 0x3832D8 /end MEASUREMENT
/begin MEASUREMENT fse51_08 "Filterwert Segmentabweichung, eingerechnet" UBYTE dtsegno_b11p25divZyl 1 100 -2.8125 2.79053 FORMAT "%5.3" ECU_ADDRESS 0x3832F0 /end MEASUREMENT
/begin MEASUREMENT fse52_02 "Filterwert Segmentabweichung, eingerechnet" UBYTE dtsegno_b11p25divZyl 1 100 -2.8125 2.79053 FORMAT "%5.3" ECU_ADDRESS 0x383268 /end MEASUREMENT
/begin MEASUREMENT fse52_03 "Filterwert Segmentabweichung, eingerechnet" UBYTE dtsegno_b11p25divZyl 1 100 -2.8125 2.79053 FORMAT "%5.3" ECU_ADDRESS 0x383280 /end MEASUREMENT
/begin MEASUREMENT fse52_04 "Filterwert Segmentabweichung, eingerechnet" UBYTE dtsegno_b11p25divZyl 1 100 -2.8125 2.79053 FORMAT "%5.3" ECU_ADDRESS 0x383298 /end MEASUREMENT
/begin MEASUREMENT fse52_05 "Filterwert Segmentabweichung, eingerechnet" UBYTE dtsegno_b11p25divZyl 1 100 -2.8125 2.79053 FORMAT "%5.3" ECU_ADDRESS 0x3832B0 /end MEASUREMENT
/begin MEASUREMENT fse52_06 "Filterwert Segmentabweichung, eingerechnet" UBYTE dtsegno_b11p25divZyl 1 100 -2.8125 2.79053 FORMAT "%5.3" ECU_ADDRESS 0x3832C8 /end MEASUREMENT
/begin MEASUREMENT fse52_07 "Filterwert Segmentabweichung, eingerechnet" UBYTE dtsegno_b11p25divZyl 1 100 -2.8125 2.79053 FORMAT "%5.3" ECU_ADDRESS 0x3832E0 /end MEASUREMENT
/begin MEASUREMENT fse52_08 "Filterwert Segmentabweichung, eingerechnet" UBYTE dtsegno_b11p25divZyl 1 100 -2.8125 2.79053 FORMAT "%5.3" ECU_ADDRESS 0x3832F8 /end MEASUREMENT
/begin MEASUREMENT fse53_02 "Filterwert Segmentabweichung, eingerechnet" UBYTE dtsegno_b11p25divZyl 1 100 -2.8125 2.79053 FORMAT "%5.3" ECU_ADDRESS 0x383270 /end MEASUREMENT
/begin MEASUREMENT fse53_03 "Filterwert Segmentabweichung, eingerechnet" UBYTE dtsegno_b11p25divZyl 1 100 -2.8125 2.79053 FORMAT "%5.3" ECU_ADDRESS 0x383288 /end MEASUREMENT
/begin MEASUREMENT fse53_04 "Filterwert Segmentabweichung, eingerechnet" UBYTE dtsegno_b11p25divZyl 1 100 -2.8125 2.79053 FORMAT "%5.3" ECU_ADDRESS 0x3832A0 /end MEASUREMENT
/begin MEASUREMENT fse53_05 "Filterwert Segmentabweichung, eingerechnet" UBYTE dtsegno_b11p25divZyl 1 100 -2.8125 2.79053 FORMAT "%5.3" ECU_ADDRESS 0x3832B8 /end MEASUREMENT
/begin MEASUREMENT fse53_06 "Filterwert Segmentabweichung, eingerechnet" UBYTE dtsegno_b11p25divZyl 1 100 -2.8125 2.79053 FORMAT "%5.3" ECU_ADDRESS 0x3832D0 /end MEASUREMENT
/begin MEASUREMENT fse53_07 "Filterwert Segmentabweichung, eingerechnet" UBYTE dtsegno_b11p25divZyl 1 100 -2.8125 2.79053 FORMAT "%5.3" ECU_ADDRESS 0x3832E8 /end MEASUREMENT
/begin MEASUREMENT fse53_08 "Filterwert Segmentabweichung, eingerechnet" UBYTE dtsegno_b11p25divZyl 1 100 -2.8125 2.79053 FORMAT "%5.3" ECU_ADDRESS 0x383300 /end MEASUREMENT
/begin MEASUREMENT fse61_02 "Filterwert Segmentabweichung, eingerechnet" UBYTE dtsegno_b11p25divZyl 1 100 -2.8125 2.79053 FORMAT "%5.3" ECU_ADDRESS 0x383261 /end MEASUREMENT
/begin MEASUREMENT fse61_03 "Filterwert Segmentabweichung, eingerechnet" UBYTE dtsegno_b11p25divZyl 1 100 -2.8125 2.79053 FORMAT "%5.3" ECU_ADDRESS 0x383279 /end MEASUREMENT
/begin MEASUREMENT fse61_04 "Filterwert Segmentabweichung, eingerechnet" UBYTE dtsegno_b11p25divZyl 1 100 -2.8125 2.79053 FORMAT "%5.3" ECU_ADDRESS 0x383291 /end MEASUREMENT
/begin MEASUREMENT fse61_05 "Filterwert Segmentabweichung, eingerechnet" UBYTE dtsegno_b11p25divZyl 1 100 -2.8125 2.79053 FORMAT "%5.3" ECU_ADDRESS 0x3832A9 /end MEASUREMENT
/begin MEASUREMENT fse61_06 "Filterwert Segmentabweichung, eingerechnet" UBYTE dtsegno_b11p25divZyl 1 100 -2.8125 2.79053 FORMAT "%5.3" ECU_ADDRESS 0x3832C1 /end MEASUREMENT
/begin MEASUREMENT fse61_07 "Filterwert Segmentabweichung, eingerechnet" UBYTE dtsegno_b11p25divZyl 1 100 -2.8125 2.79053 FORMAT "%5.3" ECU_ADDRESS 0x3832D9 /end MEASUREMENT
/begin MEASUREMENT fse61_08 "Filterwert Segmentabweichung, eingerechnet" UBYTE dtsegno_b11p25divZyl 1 100 -2.8125 2.79053 FORMAT "%5.3" ECU_ADDRESS 0x3832F1 /end MEASUREMENT
/begin MEASUREMENT fse62_02 "Filterwert Segmentabweichung, eingerechnet" UBYTE dtsegno_b11p25divZyl 1 100 -2.8125 2.79053 FORMAT "%5.3" ECU_ADDRESS 0x383269 /end MEASUREMENT
/begin MEASUREMENT fse62_03 "Filterwert Segmentabweichung, eingerechnet" UBYTE dtsegno_b11p25divZyl 1 100 -2.8125 2.79053 FORMAT "%5.3" ECU_ADDRESS 0x383281 /end MEASUREMENT
/begin MEASUREMENT fse62_04 "Filterwert Segmentabweichung, eingerechnet" UBYTE dtsegno_b11p25divZyl 1 100 -2.8125 2.79053 FORMAT "%5.3" ECU_ADDRESS 0x383299 /end MEASUREMENT
/begin MEASUREMENT fse62_05 "Filterwert Segmentabweichung, eingerechnet" UBYTE dtsegno_b11p25divZyl 1 100 -2.8125 2.79053 FORMAT "%5.3" ECU_ADDRESS 0x3832B1 /end MEASUREMENT
/begin MEASUREMENT fse62_06 "Filterwert Segmentabweichung, eingerechnet" UBYTE dtsegno_b11p25divZyl 1 100 -2.8125 2.79053 FORMAT "%5.3" ECU_ADDRESS 0x3832C9 /end MEASUREMENT
/begin MEASUREMENT fse62_07 "Filterwert Segmentabweichung, eingerechnet" UBYTE dtsegno_b11p25divZyl 1 100 -2.8125 2.79053 FORMAT "%5.3" ECU_ADDRESS 0x3832E1 /end MEASUREMENT
/begin MEASUREMENT fse62_08 "Filterwert Segmentabweichung, eingerechnet" UBYTE dtsegno_b11p25divZyl 1 100 -2.8125 2.79053 FORMAT "%5.3" ECU_ADDRESS 0x3832F9 /end MEASUREMENT
/begin MEASUREMENT fse63_02 "Filterwert Segmentabweichung, eingerechnet" UBYTE dtsegno_b11p25divZyl 1 100 -2.8125 2.79053 FORMAT "%5.3" ECU_ADDRESS 0x383271 /end MEASUREMENT
/begin MEASUREMENT fse63_03 "Filterwert Segmentabweichung, eingerechnet" UBYTE dtsegno_b11p25divZyl 1 100 -2.8125 2.79053 FORMAT "%5.3" ECU_ADDRESS 0x383289 /end MEASUREMENT
/begin MEASUREMENT fse63_04 "Filterwert Segmentabweichung, eingerechnet" UBYTE dtsegno_b11p25divZyl 1 100 -2.8125 2.79053 FORMAT "%5.3" ECU_ADDRESS 0x3832A1 /end MEASUREMENT
/begin MEASUREMENT fse63_05 "Filterwert Segmentabweichung, eingerechnet" UBYTE dtsegno_b11p25divZyl 1 100 -2.8125 2.79053 FORMAT "%5.3" ECU_ADDRESS 0x3832B9 /end MEASUREMENT
/begin MEASUREMENT fse63_06 "Filterwert Segmentabweichung, eingerechnet" UBYTE dtsegno_b11p25divZyl 1 100 -2.8125 2.79053 FORMAT "%5.3" ECU_ADDRESS 0x3832D1 /end MEASUREMENT
/begin MEASUREMENT fse63_07 "Filterwert Segmentabweichung, eingerechnet" UBYTE dtsegno_b11p25divZyl 1 100 -2.8125 2.79053 FORMAT "%5.3" ECU_ADDRESS 0x3832E9 /end MEASUREMENT
/begin MEASUREMENT fse63_08 "Filterwert Segmentabweichung, eingerechnet" UBYTE dtsegno_b11p25divZyl 1 100 -2.8125 2.79053 FORMAT "%5.3" ECU_ADDRESS 0x383301 /end MEASUREMENT
/begin MEASUREMENT fse71_02 "Filterwert Segmentabweichung, eingerechnet" UBYTE dtsegno_b11p25divZyl 1 100 -2.8125 2.79053 FORMAT "%5.3" ECU_ADDRESS 0x383262 /end MEASUREMENT
/begin MEASUREMENT fse71_03 "Filterwert Segmentabweichung, eingerechnet" UBYTE dtsegno_b11p25divZyl 1 100 -2.8125 2.79053 FORMAT "%5.3" ECU_ADDRESS 0x38327A /end MEASUREMENT
/begin MEASUREMENT fse71_04 "Filterwert Segmentabweichung, eingerechnet" UBYTE dtsegno_b11p25divZyl 1 100 -2.8125 2.79053 FORMAT "%5.3" ECU_ADDRESS 0x383292 /end MEASUREMENT
/begin MEASUREMENT fse71_05 "Filterwert Segmentabweichung, eingerechnet" UBYTE dtsegno_b11p25divZyl 1 100 -2.8125 2.79053 FORMAT "%5.3" ECU_ADDRESS 0x3832AA /end MEASUREMENT
/begin MEASUREMENT fse71_06 "Filterwert Segmentabweichung, eingerechnet" UBYTE dtsegno_b11p25divZyl 1 100 -2.8125 2.79053 FORMAT "%5.3" ECU_ADDRESS 0x3832C2 /end MEASUREMENT
/begin MEASUREMENT fse71_07 "Filterwert Segmentabweichung, eingerechnet" UBYTE dtsegno_b11p25divZyl 1 100 -2.8125 2.79053 FORMAT "%5.3" ECU_ADDRESS 0x3832DA /end MEASUREMENT
/begin MEASUREMENT fse71_08 "Filterwert Segmentabweichung, eingerechnet" UBYTE dtsegno_b11p25divZyl 1 100 -2.8125 2.79053 FORMAT "%5.3" ECU_ADDRESS 0x3832F2 /end MEASUREMENT
/begin MEASUREMENT fse72_02 "Filterwert Segmentabweichung, eingerechnet" UBYTE dtsegno_b11p25divZyl 1 100 -2.8125 2.79053 FORMAT "%5.3" ECU_ADDRESS 0x38326A /end MEASUREMENT
/begin MEASUREMENT fse72_03 "Filterwert Segmentabweichung, eingerechnet" UBYTE dtsegno_b11p25divZyl 1 100 -2.8125 2.79053 FORMAT "%5.3" ECU_ADDRESS 0x383282 /end MEASUREMENT
/begin MEASUREMENT fse72_04 "Filterwert Segmentabweichung, eingerechnet" UBYTE dtsegno_b11p25divZyl 1 100 -2.8125 2.79053 FORMAT "%5.3" ECU_ADDRESS 0x38329A /end MEASUREMENT
/begin MEASUREMENT fse72_05 "Filterwert Segmentabweichung, eingerechnet" UBYTE dtsegno_b11p25divZyl 1 100 -2.8125 2.79053 FORMAT "%5.3" ECU_ADDRESS 0x3832B2 /end MEASUREMENT
/begin MEASUREMENT fse72_06 "Filterwert Segmentabweichung, eingerechnet" UBYTE dtsegno_b11p25divZyl 1 100 -2.8125 2.79053 FORMAT "%5.3" ECU_ADDRESS 0x3832CA /end MEASUREMENT
/begin MEASUREMENT fse72_07 "Filterwert Segmentabweichung, eingerechnet" UBYTE dtsegno_b11p25divZyl 1 100 -2.8125 2.79053 FORMAT "%5.3" ECU_ADDRESS 0x3832E2 /end MEASUREMENT
/begin MEASUREMENT fse72_08 "Filterwert Segmentabweichung, eingerechnet" UBYTE dtsegno_b11p25divZyl 1 100 -2.8125 2.79053 FORMAT "%5.3" ECU_ADDRESS 0x3832FA /end MEASUREMENT
/begin MEASUREMENT fse73_02 "Filterwert Segmentabweichung, eingerechnet" UBYTE dtsegno_b11p25divZyl 1 100 -2.8125 2.79053 FORMAT "%5.3" ECU_ADDRESS 0x383272 /end MEASUREMENT
/begin MEASUREMENT fse73_03 "Filterwert Segmentabweichung, eingerechnet" UBYTE dtsegno_b11p25divZyl 1 100 -2.8125 2.79053 FORMAT "%5.3" ECU_ADDRESS 0x38328A /end MEASUREMENT
/begin MEASUREMENT fse73_04 "Filterwert Segmentabweichung, eingerechnet" UBYTE dtsegno_b11p25divZyl 1 100 -2.8125 2.79053 FORMAT "%5.3" ECU_ADDRESS 0x3832A2 /end MEASUREMENT
/begin MEASUREMENT fse73_05 "Filterwert Segmentabweichung, eingerechnet" UBYTE dtsegno_b11p25divZyl 1 100 -2.8125 2.79053 FORMAT "%5.3" ECU_ADDRESS 0x3832BA /end MEASUREMENT
/begin MEASUREMENT fse73_06 "Filterwert Segmentabweichung, eingerechnet" UBYTE dtsegno_b11p25divZyl 1 100 -2.8125 2.79053 FORMAT "%5.3" ECU_ADDRESS 0x3832D2 /end MEASUREMENT
/begin MEASUREMENT fse73_07 "Filterwert Segmentabweichung, eingerechnet" UBYTE dtsegno_b11p25divZyl 1 100 -2.8125 2.79053 FORMAT "%5.3" ECU_ADDRESS 0x3832EA /end MEASUREMENT
/begin MEASUREMENT fse73_08 "Filterwert Segmentabweichung, eingerechnet" UBYTE dtsegno_b11p25divZyl 1 100 -2.8125 2.79053 FORMAT "%5.3" ECU_ADDRESS 0x383302 /end MEASUREMENT
/begin MEASUREMENT fse81_02 "Filterwert Segmentabweichung, eingerechnet" UBYTE dtsegno_b11p25divZyl 1 100 -2.8125 2.79053 FORMAT "%5.3" ECU_ADDRESS 0x383263 /end MEASUREMENT
/begin MEASUREMENT fse81_03 "Filterwert Segmentabweichung, eingerechnet" UBYTE dtsegno_b11p25divZyl 1 100 -2.8125 2.79053 FORMAT "%5.3" ECU_ADDRESS 0x38327B /end MEASUREMENT
/begin MEASUREMENT fse81_04 "Filterwert Segmentabweichung, eingerechnet" UBYTE dtsegno_b11p25divZyl 1 100 -2.8125 2.79053 FORMAT "%5.3" ECU_ADDRESS 0x383293 /end MEASUREMENT
/begin MEASUREMENT fse81_05 "Filterwert Segmentabweichung, eingerechnet" UBYTE dtsegno_b11p25divZyl 1 100 -2.8125 2.79053 FORMAT "%5.3" ECU_ADDRESS 0x3832AB /end MEASUREMENT
/begin MEASUREMENT fse81_06 "Filterwert Segmentabweichung, eingerechnet" UBYTE dtsegno_b11p25divZyl 1 100 -2.8125 2.79053 FORMAT "%5.3" ECU_ADDRESS 0x3832C3 /end MEASUREMENT
/begin MEASUREMENT fse81_07 "Filterwert Segmentabweichung, eingerechnet" UBYTE dtsegno_b11p25divZyl 1 100 -2.8125 2.79053 FORMAT "%5.3" ECU_ADDRESS 0x3832DB /end MEASUREMENT
/begin MEASUREMENT fse81_08 "Filterwert Segmentabweichung, eingerechnet" UBYTE dtsegno_b11p25divZyl 1 100 -2.8125 2.79053 FORMAT "%5.3" ECU_ADDRESS 0x3832F3 /end MEASUREMENT
/begin MEASUREMENT fse82_02 "Filterwert Segmentabweichung, eingerechnet" UBYTE dtsegno_b11p25divZyl 1 100 -2.8125 2.79053 FORMAT "%5.3" ECU_ADDRESS 0x38326B /end MEASUREMENT
/begin MEASUREMENT fse82_03 "Filterwert Segmentabweichung, eingerechnet" UBYTE dtsegno_b11p25divZyl 1 100 -2.8125 2.79053 FORMAT "%5.3" ECU_ADDRESS 0x383283 /end MEASUREMENT
/begin MEASUREMENT fse82_04 "Filterwert Segmentabweichung, eingerechnet" UBYTE dtsegno_b11p25divZyl 1 100 -2.8125 2.79053 FORMAT "%5.3" ECU_ADDRESS 0x38329B /end MEASUREMENT
/begin MEASUREMENT fse82_05 "Filterwert Segmentabweichung, eingerechnet" UBYTE dtsegno_b11p25divZyl 1 100 -2.8125 2.79053 FORMAT "%5.3" ECU_ADDRESS 0x3832B3 /end MEASUREMENT
/begin MEASUREMENT fse82_06 "Filterwert Segmentabweichung, eingerechnet" UBYTE dtsegno_b11p25divZyl 1 100 -2.8125 2.79053 FORMAT "%5.3" ECU_ADDRESS 0x3832CB /end MEASUREMENT
/begin MEASUREMENT fse82_07 "Filterwert Segmentabweichung, eingerechnet" UBYTE dtsegno_b11p25divZyl 1 100 -2.8125 2.79053 FORMAT "%5.3" ECU_ADDRESS 0x3832E3 /end MEASUREMENT
/begin MEASUREMENT fse82_08 "Filterwert Segmentabweichung, eingerechnet" UBYTE dtsegno_b11p25divZyl 1 100 -2.8125 2.79053 FORMAT "%5.3" ECU_ADDRESS 0x3832FB /end MEASUREMENT
/begin MEASUREMENT fse83_02 "Filterwert Segmentabweichung, eingerechnet" UBYTE dtsegno_b11p25divZyl 1 100 -2.8125 2.79053 FORMAT "%5.3" ECU_ADDRESS 0x383273 /end MEASUREMENT
/begin MEASUREMENT fse83_03 "Filterwert Segmentabweichung, eingerechnet" UBYTE dtsegno_b11p25divZyl 1 100 -2.8125 2.79053 FORMAT "%5.3" ECU_ADDRESS 0x38328B /end MEASUREMENT
/begin MEASUREMENT fse83_04 "Filterwert Segmentabweichung, eingerechnet" UBYTE dtsegno_b11p25divZyl 1 100 -2.8125 2.79053 FORMAT "%5.3" ECU_ADDRESS 0x3832A3 /end MEASUREMENT
/begin MEASUREMENT fse83_05 "Filterwert Segmentabweichung, eingerechnet" UBYTE dtsegno_b11p25divZyl 1 100 -2.8125 2.79053 FORMAT "%5.3" ECU_ADDRESS 0x3832BB /end MEASUREMENT
/begin MEASUREMENT fse83_06 "Filterwert Segmentabweichung, eingerechnet" UBYTE dtsegno_b11p25divZyl 1 100 -2.8125 2.79053 FORMAT "%5.3" ECU_ADDRESS 0x3832D3 /end MEASUREMENT
/begin MEASUREMENT fse83_07 "Filterwert Segmentabweichung, eingerechnet" UBYTE dtsegno_b11p25divZyl 1 100 -2.8125 2.79053 FORMAT "%5.3" ECU_ADDRESS 0x3832EB /end MEASUREMENT
/begin MEASUREMENT fse83_08 "Filterwert Segmentabweichung, eingerechnet" UBYTE dtsegno_b11p25divZyl 1 100 -2.8125 2.79053 FORMAT "%5.3" ECU_ADDRESS 0x383303 /end MEASUREMENT
/begin MEASUREMENT idxfo "Index: Kennzeichnet den aktuellen KF-Bereich" UWORD dez 1 100 0 65535 FORMAT "%8.2" ECU_ADDRESS 0xE488 /end MEASUREMENT
/begin MEASUREMENT idxfob "Index: Kennzeichnet den aktuellen KF-Bereich (Drehz., Last)" UBYTE dez 1 100 0 255 FORMAT "%5.1" ECU_ADDRESS 0xE41F /end MEASUREMENT
/begin MEASUREMENT idxfon "Drehzahlindex für Betriebsbereich der fuel-on Adaption" UBYTE dez 1 100 0 255 FORMAT "%5.1" ECU_ADDRESS 0xE488 /end MEASUREMENT
/begin MEASUREMENT idxforl "Lastindex für Betriebsbereich der fuel-on Adaption" UBYTE dez 1 100 0 255 FORMAT "%5.1" ECU_ADDRESS 0xE489 /end MEASUREMENT
/begin MEASUREMENT imlfta_w "Integrierte Luftmasse zum Setzen des Fehlers LSU fett (Typa)" UWORD m_q2p777Em5_kg 1 100 0 1.82042 FORMAT "%8.6" ECU_ADDRESS 0x384A60 /end MEASUREMENT
/begin MEASUREMENT imlftb_w "Integrierte Luftmasse zum Setzen des Fehlers LSU fett (Typ b)" UWORD m_q2p777Em5_kg 1 100 0 1.82042 FORMAT "%8.6" ECU_ADDRESS 0x384A62 /end MEASUREMENT
/begin MEASUREMENT imlhe_w "Integrierte Luftmasse zum Heilen des Fehlers LSV" UWORD m_q2p777Em5_kg 1 100 0 1.82042 FORMAT "%8.6" ECU_ADDRESS 0x384A64 /end MEASUREMENT
/begin MEASUREMENT imlmra_w "Integrierte Luftmasse zum Setzen des Fehlers LSU mager (Typ a)" UWORD m_q2p777Em5_kg 1 100 0 1.82042 FORMAT "%8.6" ECU_ADDRESS 0x384A66 /end MEASUREMENT
/begin MEASUREMENT imlmrb_w "Integrierte Luftmasse zum Setzen des Fehlers LSU mager (Typ b)" UWORD m_q2p777Em5_kg 1 100 0 1.82042 FORMAT "%8.6" ECU_ADDRESS 0x384A68 /end MEASUREMENT
/begin MEASUREMENT imlna_w "Integrierte Luftmasse zum Setzen des Fehlers Sonde nicht aktiv" UWORD m_q2p777Em5_kg 1 100 0 1.82042 FORMAT "%8.6" ECU_ADDRESS 0x384A6A /end MEASUREMENT
/begin MEASUREMENT lamelsh_w "Lambdasoll für elektrische Sondendiagnose hinter KAT (Kurztrip)" UWORD fak_uw_b16 1 100 0 15.9998 FORMAT "%8.5" ECU_ADDRESS 0x381A94 /end MEASUREMENT
/begin MEASUREMENT lamsam_w "Lambdaamplitude nach Filterung" SWORD fak_sw_b8 1 100 -8 7.99976 FORMAT "%8.6" ECU_ADDRESS 0x381C1A /end MEASUREMENT
/begin MEASUREMENT lamsisa "Lambda Ist an Sonde Signalausgabe DLSSA, Bank 1" UBYTE fak_ub_b2 1 100 0 1.99219 FORMAT "%5.3" ECU_ADDRESS 0x38487A /end MEASUREMENT
/begin MEASUREMENT lamsosa "Lambda Soll an Sonde Signalausgabe DLSSA, Bank 1" UBYTE fak_ub_b2 1 100 0 1.99219 FORMAT "%5.3" ECU_ADDRESS 0x38487B /end MEASUREMENT
/begin MEASUREMENT lsunpstat "Statusbyte: Teilprüfungserkennung für Plausibilitätsfehler" UBYTE dez 1 100 0 255 FORMAT "%5.1" ECU_ADDRESS 0x384017 /end MEASUREMENT
/begin MEASUREMENT lunw "Laufunruhe über 1 NW-Umdr." UBYTE luquant 1 100 0 172.458 FORMAT "%5.1" ECU_ADDRESS 0xE419 /end MEASUREMENT
/begin MEASUREMENT slfoo "" SWORD dtsegn_b720divZyl 1 100 -180 179.995 FORMAT "%8.4" ECU_ADDRESS 0xE4E0 /end MEASUREMENT
/begin MEASUREMENT ts01 "Segmentdauer Zylinder 1" UWORD tsquant 1 100 0 53738.7 FORMAT "%8.2" ECU_ADDRESS 0xE460 /end MEASUREMENT
/begin MEASUREMENT ts02 "Segmentdauer Zylinder 2" UWORD tsquant 1 100 0 53738.7 FORMAT "%8.2" ECU_ADDRESS 0xE462 /end MEASUREMENT
/begin MEASUREMENT ts03 "Segmentdauer Zylinder 3" UWORD tsquant 1 100 0 53738.7 FORMAT "%8.2" ECU_ADDRESS 0xE464 /end MEASUREMENT
/begin MEASUREMENT ts04 "Segmentdauer Zylinder 4" UWORD tsquant 1 100 0 53738.7 FORMAT "%8.2" ECU_ADDRESS 0xE466 /end MEASUREMENT
/begin MEASUREMENT ts05 "Segmentdauer Zylinder 5" UWORD tsquant 1 100 0 53738.7 FORMAT "%8.2" ECU_ADDRESS 0xE468 /end MEASUREMENT
/begin MEASUREMENT ts06 "Segmentdauer Zylinder 6" UWORD tsquant 1 100 0 53738.7 FORMAT "%8.2" ECU_ADDRESS 0xE46A /end MEASUREMENT
/begin MEASUREMENT ts07 "Segmentdauer Zylinder 7" UWORD tsquant 1 100 0 53738.7 FORMAT "%8.2" ECU_ADDRESS 0xE46C /end MEASUREMENT
/begin MEASUREMENT ts08 "Segmentdauer Zylinder 8" UWORD tsquant 1 100 0 53738.7 FORMAT "%8.2" ECU_ADDRESS 0xE46E /end MEASUREMENT
/begin MEASUREMENT tsk_m "Monitor korrigierte Segmentdauer" UWORD tsquant 1 100 0 53738.7 FORMAT "%8.2" ECU_ADDRESS 0xE442 /end MEASUREMENT
/begin MEASUREMENT ts_m "Monitor Segmentdauer" UWORD tsquant 1 100 0 53738.7 FORMAT "%8.2" ECU_ADDRESS 0xE43A /end MEASUREMENT
/begin MEASUREMENT twdlssh_w "Timer für Mindestprüfzeit für DLSSA-Extremwertbestimmung hinter KAT" UWORD t50msxs_uw_b3276p75 1 100 0 3276.75 FORMAT "%8.3" ECU_ADDRESS 0x384AE8 /end MEASUREMENT
/begin MEASUREMENT ushkj "Spannung Lambdasonde hinter Kat, ohne Offset, DLSSA, Bank 1" UBYTE spg_ub_b1p33 1 100 0 1.33 FORMAT "%5.3" ECU_ADDRESS 0x38487C /end MEASUREMENT
/begin MEASUREMENT ushkjf_w "Gefilterte Spannung Lambdasonde hinter Kat, ohne Offset, DLSSA" UWORD spg_uw_b1p33 1 100 0 1.33 FORMAT "%8.6" ECU_ADDRESS 0x384AEA /end MEASUREMENT
/begin MEASUREMENT usmnsha "minimal erkannter Sondenspannungswert h.K. (alt), DLSSA, Bank 1" UBYTE spg_ub_b1p33 1 100 0 1.33 FORMAT "%5.3" ECU_ADDRESS 0x38487D /end MEASUREMENT
/begin MEASUREMENT usmnshn "minimal erkannter Sondenspannungswert h.K. (neu), DLSSA" UBYTE spg_ub_b1p33 1 100 0 1.33 FORMAT "%5.3" ECU_ADDRESS 0x38401B /end MEASUREMENT
/begin MEASUREMENT usmxsha "maximal erkannter Sondenspannungswert h.K. (alt), DLSSA, Bank 1" UBYTE spg_ub_b1p33 1 100 0 1.33 FORMAT "%5.3" ECU_ADDRESS 0x38487E /end MEASUREMENT
/begin MEASUREMENT usmxshn "maximal erkannter Sondenspannungswert h.K. (neu), DLSSA" UBYTE spg_ub_b1p33 1 100 0 1.33 FORMAT "%5.3" ECU_ADDRESS 0x38401C /end MEASUREMENT
/begin MEASUREMENT xs02 "Segmentabweichung, normiert" UWORD dtsegn_b720divZyl 1 100 0 359.995 FORMAT "%8.4" ECU_ADDRESS 0xE4D0 /end MEASUREMENT
/begin MEASUREMENT xs03 "Segmentabweichung, normiert" UWORD dtsegn_b720divZyl 1 100 0 359.995 FORMAT "%8.4" ECU_ADDRESS 0xE4D2 /end MEASUREMENT
/begin MEASUREMENT xs04 "Segmentabweichung, normiert" UWORD dtsegn_b720divZyl 1 100 0 359.995 FORMAT "%8.4" ECU_ADDRESS 0xE4D4 /end MEASUREMENT
/begin MEASUREMENT xs05 "Segmentabweichung, normiert" UWORD dtsegn_b720divZyl 1 100 0 359.995 FORMAT "%8.4" ECU_ADDRESS 0xE4D6 /end MEASUREMENT
/begin MEASUREMENT xs06 "Segmentabweichung, normiert" UWORD dtsegn_b720divZyl 1 100 0 359.995 FORMAT "%8.4" ECU_ADDRESS 0xE4D8 /end MEASUREMENT
/begin MEASUREMENT xs07 "Segmentabweichung, normiert" UWORD dtsegn_b720divZyl 1 100 0 359.995 FORMAT "%8.4" ECU_ADDRESS 0xE4DA /end MEASUREMENT
/begin MEASUREMENT xs08 "Segmentabweichung, normiert" UWORD dtsegn_b720divZyl 1 100 0 359.995 FORMAT "%8.4" ECU_ADDRESS 0xE4DC /end MEASUREMENT
/begin MEASUREMENT zhklsu "Zähler Heizerkopplung LSU" UBYTE dez 1 100 0 255 FORMAT "%5.1" ECU_ADDRESS 0x38095A /end MEASUREMENT
/begin MEASUREMENT zhzkh "Zähler für Fehler-Messungen von Heizungs-Einkopplungen hinter  Haupt KAT" UBYTE dez 1 100 0 255 FORMAT "%5.1" ECU_ADDRESS 0x38093A /end MEASUREMENT
/begin MEASUREMENT zhzoffh "Zähler für Heizungs-Ausschaltungen hinter Haupt KAT" UBYTE dez 1 100 0 255 FORMAT "%5.1" ECU_ADDRESS 0x38093B /end MEASUREMENT
/begin FUNCTION DLSH "26.150    Diagnose; Sondenbetriebsbereitschaft hinter Kat"
 /begin DEF_CHARACTERISTIC ABGMSIGH ANZHZKH ANZHZOFFH DLAMELSH DMRLSH DRISIGH RISIGRESH TABGMCSD TASIG TKATMSHU TMSH TMSHA TNSTDNH TRSAFA TRSAH TRSE TTBMH TUHKFH TUSEHKH TUSHZMFH TUSKS TUSMAX TUSTAL UBDLS USHKHZK USMAX USMIN USREFH USREMH /end DEF_CHARACTERISTIC
 /begin REF_CHARACTERISTIC /end REF_CHARACTERISTIC
 /begin IN_MEASUREMENT B_atmtpk B_cdlsh B_fa B_falsh B_hsha B_hshe B_lsh B_lsh2 B_nmot B_pwf B_st B_tal B_talval rinh_w tkatm tmot tmotab ub ushk_w /end IN_MEASUREMENT
 /begin OUT_MEASUREMENT B_risigh B_sbbhk B_ttbmhh dmrlsh_w lamelsh_w zhzkh zhzoffh /end OUT_MEASUREMENT
 /begin LOC_MEASUREMENT B_adsh B_adshs B_anzhzkh B_anzhzoh B_dshen B_elshv B_hzkfh B_hzkfmvh B_hzkhzyk B_hzoffh B_lshklt B_maxflsh B_minflsh B_noadsh B_nolsh B_nplflsh B_sigflsh B_trsah B_tusmaxh B_uhsig B_zlshv DLSHerrors DLSHintbits DLSHintbits2 DLSHintbits3 /end LOC_MEASUREMENT
 /begin SUB_FUNCTION /end SUB_FUNCTION
/end FUNCTION
/begin FUNCTION DLSSA "14.90     Signalausgabe Lambdasonden"
 /begin DEF_CHARACTERISTIC DLAHISATO DLAHISATU DYNLSUTO DYNLSUTU LAMSSAMN LAMSSAMX SAFK1 TWDLSSA USIVMAXH USIVMINH USMNSHMN USMNSHMX USMXSHMN USMXSHMX USRHKSHJ USRJ /end DEF_CHARACTERISTIC
 /begin REF_CHARACTERISTIC /end REF_CHARACTERISTIC
 /begin IN_MEASUREMENT B_lrhk B_pwf dlahi_w dynlsu_w lamsoni_w lamsons_w ushk /end IN_MEASUREMENT
 /begin OUT_MEASUREMENT dlahisa dynlsusa lamsisa lamsosa ushkj usmnshn usmxshn /end OUT_MEASUREMENT
 /begin LOC_MEASUREMENT twdlssh_w ushkjf_w usmnsha usmxsha /end LOC_MEASUREMENT
 /begin SUB_FUNCTION /end SUB_FUNCTION
/end FUNCTION
/begin FUNCTION DLSU "4.180     Diagnose stetige Lambdasonde LSU"
 /begin DEF_CHARACTERISTIC DLAHPPLMN DMRLSV DRLMX DYNLSUFA DYNLSUMX DYNLSURD IMLHEMN IMLHEMNFA IMLPLCMN IMLPLCMNB IVDYNLSU KDYNFA KDYNLSU LAMDYNO LAMDYNU LAMMN LAMMX LAMSSMN LAMSSMX LASPLCFT LASPLCMR LSUNAMN LSUNAMX MSAPLMN NMOTDYFA NMOTDYNO NMOTDYNU RLDYNFA RLDYNO RLDYNU SDLAOF SDULSUMX SULSULUFT SULSUMX TALASMX TALSUSMX TVCJLSU TVDRL TVHKLSU TVHKLSUV TVLSUEK TVLSUHK TVLSULUFT TVLSUOF TVLSUPER TVLSUTRIM TVMRFT TVSNPF TVTKLSU USHKFT USHKMR ZDYNFA ZDYNLSU ZEHK ZLAMFT ZLAMHP ZLAMLP /end DEF_CHARACTERISTIC
 /begin REF_CHARACTERISTIC CWDLSU /end REF_CHARACTERISTIC
 /begin IN_MEASUREMENT B_atmtpa B_cdlsv B_dsls B_ehlsu B_evloc B_fa B_falsv B_frmax B_frmin B_hsve B_kh B_lamverg B_lrhk B_lrhkp B_lrs B_lshswok B_lsuab B_mdarv B_nphsv B_pwf B_sbbhk B_sbbvk B_sls B_stend B_tal B_talval B_tehb B_vekat B_za dfrzaf_w dlahi_w dlahp_w lamsoni_w lamsons_w msabg_w nmot rl tavvkm_w tnst_w ushk_w usvkk_w uulsuv_w /end IN_MEASUREMENT
 /begin OUT_MEASUREMENT anzdyn B_elaof B_elsu B_falsu B_heatf B_lrasp B_nplflsu B_stcdyn B_vlsuftb dmrlsv_w dynlsu_w lsunpstat /end OUT_MEASUREMENT
 /begin LOC_MEASUREMENT B_drlmx B_dylsu B_dylsuav B_dylsuf B_heallsv B_helsu B_helsuf B_lshkpft B_lshkpmr B_lsuabgl B_lsuft B_lsufta B_lsuftb B_lsulone B_lsultk B_lsumr B_lsumra B_lsumrb B_lsumx B_lsuna B_lsupft B_lsupmr B_lsurfc B_luft B_maxflsu B_minflsu B_noflsv B_npsna B_npvshns B_plenvh B_sigflsu B_stcal B_vlsumrb imlfta_w imlftb_w imlhe_w imlmra_w imlmrb_w imlna_w lamsam_w zhklsu /end LOC_MEASUREMENT
 /begin SUB_FUNCTION /end SUB_FUNCTION
/end FUNCTION
/begin FUNCTION DLUES1E "1.30      Endstufendiagnose Lüftersteuerung 1" /begin DEF_CHARACTERISTIC TVLUES1MN TVLUES1MX /end DEF_CHARACTERISTIC /begin REF_CHARACTERISTIC /end REF_CHARACTERISTIC /begin IN_MEASUREMENT B_desee tvlues1 /end IN_MEASUREMENT /begin OUT_MEASUREMENT B_enlues B_enlues1 /end OUT_MEASUREMENT /begin LOC_MEASUREMENT /end LOC_MEASUREMENT /begin SUB_FUNCTION /end SUB_FUNCTION /end FUNCTION
/begin FUNCTION DMDDLU "7.60      Diagnose Misfire Detection Differenzbildung der Laufunruhe"
 /begin DEF_CHARACTERISTIC DLURMIN_0_A DLURMIN_1_A DMXRDL KFDLUR_0_A KFDLUR_1_A KFDLUR1 KFDLUR2 KFDLURZ NMIDLU /end DEF_CHARACTERISTIC
 /begin REF_CHARACTERISTIC SNM08DMUB SRL08DMUB /end REF_CHARACTERISTIC
 /begin IN_MEASUREMENT esst_snm08dmub esst_srl08dmub nmot rl /end IN_MEASUREMENT
 /begin OUT_MEASUREMENT B_dluerk_m dlurs_m dluts_m fdmd_m flg_m /end OUT_MEASUREMENT
 /begin LOC_MEASUREMENT dlurs dluts dluts1 dluts2 dluts3 dluts4 dluts5 dluts6 dluts7 dluts8 /end LOC_MEASUREMENT
 /begin SUB_FUNCTION /end SUB_FUNCTION
/end FUNCTION
/begin FUNCTION DMDFON "6.60      Diagnosis Misfire Detection Fuel-on Adaptation"
 /begin DEF_CHARACTERISTIC ALFO ANWFOHE ANWFOST CDFO DFSEFO2N DFSEFO3N DFSEFON DFSERES FLFO FS1FO FS2FO KFCFO KFCFO2 KFCFO3 LURFOST_0_A LURFOST_1_A MDERFOKH MDERKFON SDZ03DMUB SDZ03DMUB2 SDZ03DMUB3 SDZ08DMUB SDZ08DMUB2 SDZ08DMUB3 SFONTM SLFOO2N SLFOO3N SLFOON SLFOU TNSTFON ZASMASK /end DEF_CHARACTERISTIC
 /begin REF_CHARACTERISTIC /end REF_CHARACTERISTIC
 /begin IN_MEASUREMENT B_autget B_cvt nmot rl /end IN_MEASUREMENT
 /begin OUT_MEASUREMENT B_dmd_reset B_fof_m B_fon_m B_fordo_m B_forn_m B_for_m B_plokn_m B_tsroov_m fostat_m tsk_m ts_m /end OUT_MEASUREMENT
 /begin LOC_MEASUREMENT anwfoh anwfos B_fodo B_fodon B_fohe B_fohold B_fontm B_for11 B_for12 B_for13 B_for21 B_for22 B_for23 B_for31 B_for32 B_for33 B_for41 B_for42 B_for43 B_for51 B_for52 B_for53 B_for61 B_for62 B_for63 B_for71 B_for72 B_for73 B_for81 B_for82 B_for83 B_forn01 B_forn02 B_forn03 B_forn04 B_forn05 B_forn06 B_forn07 B_forn08 B_forset B_forun B_fos B_foxfg B_plok B_plok01 B_plok02 B_plok03 B_plok04 B_plok05 B_plok06 B_plok07 B_plok08 cfoxx dfse01 dfse02 dfse03 dfse04 dfse05 dfse06 dfse07 dfse08 dfsen dfseresz esst_sdz03dmub esst_sdz08dmub ffon ffonn1 ffonn2 ffonn3 fforn1 ffpl1 flmx flmxresz fln11_02 fln11_03 fln11_04 fln11_05 fln11_06 fln11_07 fln11_08 fln12_02 fln12_03 fln12_04 fln12_05 fln12_06 fln12_07 fln12_08 fln13_02 fln13_03 fln13_04 fln13_05 fln13_06 fln13_07 fln13_08 fln21_02 fln21_03 fln21_04 fln21_05 fln21_06 fln21_07 fln21_08 fln22_02 fln22_03 fln22_04 fln22_05 fln22_06 fln22_07 fln22_08 fln23_02 fln23_03 fln23_04 fln23_05 fln23_06 fln23_07 fln23_08 fln31_02 fln31_03 fln31_04 fln31_05 fln31_06 fln31_07 fln31_08 fln32_02 fln32_03 fln32_04 fln32_05 fln32_06 fln32_07 fln32_08 fln33_02 fln33_03 fln33_04 fln33_05 fln33_06 fln33_07 fln33_08 fln41_02 fln41_03 fln41_04 fln41_05 fln41_06 fln41_07 fln41_08 fln42_02 fln42_03 fln42_04 fln42_05 fln42_06 fln42_07 fln42_08 fln43_02 fln43_03 fln43_04 fln43_05 fln43_06 fln43_07 fln43_08 fln51_02 fln51_03 fln51_04 fln51_05 fln51_06 fln51_07 fln51_08 fln52_02 fln52_03 fln52_04 fln52_05 fln52_06 fln52_07 fln52_08 fln53_02 fln53_03 fln53_04 fln53_05 fln53_06 fln53_07 fln53_08 fln61_02 fln61_03 fln61_04 fln61_05 fln61_06 fln61_07 fln61_08 fln62_02 fln62_03 fln62_04 fln62_05 fln62_06 fln62_07 fln62_08 fln63_02 fln63_03 fln63_04 fln63_05 fln63_06 fln63_07 fln63_08 fln71_02 fln71_03 fln71_04 fln71_05 fln71_06 fln71_07 fln71_08 fln72_02 fln72_03 fln72_04 fln72_05 fln72_06 fln72_07 fln72_08 fln73_02 fln73_03 fln73_04 fln73_05 fln73_06 fln73_07 fln73_08 fln81_02 fln81_03 fln81_04 fln81_05 fln81_06 fln81_07 fln81_08 fln82_02 fln82_03 fln82_04 fln82_05 fln82_06 fln82_07 fln82_08 fln83_02 fln83_03 fln83_04 fln83_05 fln83_06 fln83_07 fln83_08 flp11_02 flp11_03 flp11_04 flp11_05 flp11_06 flp11_07 flp11_08 flp12_02 flp12_03 flp12_04 flp12_05 flp12_06 flp12_07 flp12_08 flp13_02 flp13_03 flp13_04 flp13_05 flp13_06 flp13_07 flp13_08 flp21_02 flp21_03 flp21_04 flp21_05 flp21_06 flp21_07 flp21_08 flp22_02 flp22_03 flp22_04 flp22_05 flp22_06 flp22_07 flp22_08 flp23_02 flp23_03 flp23_04 flp23_05 flp23_06 flp23_07 flp23_08 flp31_02 flp31_03 flp31_04 flp31_05 flp31_06 flp31_07 flp31_08 flp32_02 flp32_03 flp32_04 flp32_05 flp32_06 flp32_07 flp32_08 flp33_02 flp33_03 flp33_04 flp33_05 flp33_06 flp33_07 flp33_08 flp41_02 flp41_03 flp41_04 flp41_05 flp41_06 flp41_07 flp41_08 flp42_02 flp42_03 flp42_04 flp42_05 flp42_06 flp42_07 flp42_08 flp43_02 flp43_03 flp43_04 flp43_05 flp43_06 flp43_07 flp43_08 flp51_02 flp51_03 flp51_04 flp51_05 flp51_06 flp51_07 flp51_08 flp52_02 flp52_03 flp52_04 flp52_05 flp52_06 flp52_07 flp52_08 flp53_02 flp53_03 flp53_04 flp53_05 flp53_06 flp53_07 flp53_08 flp61_02 flp61_03 flp61_04 flp61_05 flp61_06 flp61_07 flp61_08 flp62_02 flp62_03 flp62_04 flp62_05 flp62_06 flp62_07 flp62_08 flp63_02 flp63_03 flp63_04 flp63_05 flp63_06 flp63_07 flp63_08 flp71_02 flp71_03 flp71_04 flp71_05 flp71_06 flp71_07 flp71_08 flp72_02 flp72_03 flp72_04 flp72_05 flp72_06 flp72_07 flp72_08 flp73_02 flp73_03 flp73_04 flp73_05 flp73_06 flp73_07 flp73_08 flp81_02 flp81_03 flp81_04 flp81_05 flp81_06 flp81_07 flp81_08 flp82_02 flp82_03 flp82_04 flp82_05 flp82_06 flp82_07 flp82_08 flp83_02 flp83_03 flp83_04 flp83_05 flp83_06 flp83_07 flp83_08 fostat fs11_02 fs11_03 fs11_04 fs11_05 fs11_06 fs11_07 fs11_08 fs12_02 fs12_03 fs12_04 fs12_05 fs12_06 fs12_07 fs12_08 fs13_02 fs13_03 fs13_04 fs13_05 fs13_06 fs13_07 fs13_08 fs21_02 fs21_03 fs21_04 fs21_05 fs21_06 fs21_07 fs21_08 fs22_02 fs22_03 fs22_04 fs22_05 fs22_06 fs22_07 fs22_08 fs23_02 fs23_03 fs23_04 fs23_05 fs23_06 fs23_07 fs23_08 fs31_02 fs31_03 fs31_04 fs31_05 fs31_06 fs31_07 fs31_08 fs32_02 fs32_03 fs32_04 fs32_05 fs32_06 fs32_07 fs32_08 fs33_02 fs33_03 fs33_04 fs33_05 fs33_06 fs33_07 fs33_08 fs41_02 fs41_03 fs41_04 fs41_05 fs41_06 fs41_07 fs41_08 fs42_02 fs42_03 fs42_04 fs42_05 fs42_06 fs42_07 fs42_08 fs43_02 fs43_03 fs43_04 fs43_05 fs43_06 fs43_07 fs43_08 fs51_02 fs51_03 fs51_04 fs51_05 fs51_06 fs51_07 fs51_08 fs52_02 fs52_03 fs52_04 fs52_05 fs52_06 fs52_07 fs52_08 fs53_02 fs53_03 fs53_04 fs53_05 fs53_06 fs53_07 fs53_08 fs61_02 fs61_03 fs61_04 fs61_05 fs61_06 fs61_07 fs61_08 fs62_02 fs62_03 fs62_04 fs62_05 fs62_06 fs62_07 fs62_08 fs63_02 fs63_03 fs63_04 fs63_05 fs63_06 fs63_07 fs63_08 fs71_02 fs71_03 fs71_04 fs71_05 fs71_06 fs71_07 fs71_08 fs72_02 fs72_03 fs72_04 fs72_05 fs72_06 fs72_07 fs72_08 fs73_02 fs73_03 fs73_04 fs73_05 fs73_06 fs73_07 fs73_08 fs81_02 fs81_03 fs81_04 fs81_05 fs81_06 fs81_07 fs81_08 fs82_02 fs82_03 fs82_04 fs82_05 fs82_06 fs82_07 fs82_08 fs83_02 fs83_03 fs83_04 fs83_05 fs83_06 fs83_07 fs83_08 fse fse11_02 fse11_03 fse11_04 fse11_05 fse11_06 fse11_07 fse11_08 fse12_02 fse12_03 fse12_04 fse12_05 fse12_06 fse12_07 fse12_08 fse13_02 fse13_03 fse13_04 fse13_05 fse13_06 fse13_07 fse13_08 fse21_02 fse21_03 fse21_04 fse21_05 fse21_06 fse21_07 fse21_08 fse22_02 fse22_03 fse22_04 fse22_05 fse22_06 fse22_07 fse22_08 fse23_02 fse23_03 fse23_04 fse23_05 fse23_06 fse23_07 fse23_08 fse31_02 fse31_03 fse31_04 fse31_05 fse31_06 fse31_07 fse31_08 fse32_02 fse32_03 fse32_04 fse32_05 fse32_06 fse32_07 fse32_08 fse33_02 fse33_03 fse33_04 fse33_05 fse33_06 fse33_07 fse33_08 fse41_02 fse41_03 fse41_04 fse41_05 fse41_06 fse41_07 fse41_08 fse42_02 fse42_03 fse42_04 fse42_05 fse42_06 fse42_07 fse42_08 fse43_02 fse43_03 fse43_04 fse43_05 fse43_06 fse43_07 fse43_08 fse51_02 fse51_03 fse51_04 fse51_05 fse51_06 fse51_07 fse51_08 fse52_02 fse52_03 fse52_04 fse52_05 fse52_06 fse52_07 fse52_08 fse53_02 fse53_03 fse53_04 fse53_05 fse53_06 fse53_07 fse53_08 fse61_02 fse61_03 fse61_04 fse61_05 fse61_06 fse61_07 fse61_08 fse62_02 fse62_03 fse62_04 fse62_05 fse62_06 fse62_07 fse62_08 fse63_02 fse63_03 fse63_04 fse63_05 fse63_06 fse63_07 fse63_08 fse71_02 fse71_03 fse71_04 fse71_05 fse71_06 fse71_07 fse71_08 fse72_02 fse72_03 fse72_04 fse72_05 fse72_06 fse72_07 fse72_08 fse73_02 fse73_03 fse73_04 fse73_05 fse73_06 fse73_07 fse73_08 fse81_02 fse81_03 fse81_04 fse81_05 fse81_06 fse81_07 fse81_08 fse82_02 fse82_03 fse82_04 fse82_05 fse82_06 fse82_07 fse82_08 fse83_02 fse83_03 fse83_04 fse83_05 fse83_06 fse83_07 fse83_08 idxfo idxfob idxfon idxforl lunw slfoo ts01 ts02 ts03 ts04 ts05 ts06 ts07 ts08 xs02 xs03 xs04 xs05 xs06 xs07 xs08 /end LOC_MEASUREMENT
 /begin SUB_FUNCTION /end SUB_FUNCTION
/end FUNCTION
/begin FUNCTION DMDLAD "5.10      Logic and Delay; Log. Verknüpfung versch. Blöcke zur Aussetzererkennung" /begin DEF_CHARACTERISTIC /end DEF_CHARACTERISTIC /begin REF_CHARACTERISTIC /end REF_CHARACTERISTIC /begin IN_MEASUREMENT /end IN_MEASUREMENT /begin OUT_MEASUREMENT B_mderk /end OUT_MEASUREMENT /begin LOC_MEASUREMENT /end LOC_MEASUREMENT /begin SUB_FUNCTION /end SUB_FUNCTION /end FUNCTION
/begin COMPU_METHOD B_TRUE "boolsche Zustände, positive Logik" TAB_VERB "%6.3" "" COMPU_TAB_REF B_TRUE /end COMPU_METHOD
/begin COMPU_VTAB B_TRUE "boolsche Zustände, positive Logik" TAB_VERB 2 0 "----" 1 "TRUE" /end COMPU_VTAB
/begin COMPU_METHOD DEZ "1 : 1 Umrechnug (dez/hex)" RAT_FUNC "%6.2" "" COEFFS 0 1 0 0 0 1 /end COMPU_METHOD
/begin COMPU_METHOD dez "1 : 1 Umrechnug (dez/hex)" RAT_FUNC "%6.2" "" COEFFS 0 1 0 0 0 1 /end COMPU_METHOD
/begin COMPU_METHOD dtsegno_b11p25divZyl "" RAT_FUNC "%6.5" "grad/KW" COEFFS 0 45.5111 128 0 0 1 /end COMPU_METHOD
/begin COMPU_METHOD dtsegn_b11p25divZyl "" RAT_FUNC "%6.4" "grad/KW" COEFFS 0 45.5111 0 0 0 1 /end COMPU_METHOD
/begin COMPU_METHOD dtsegn_b720divZyl "" RAT_FUNC "%6.4" "grad/KW" COEFFS 0 182.044 0 0 0 1 /end COMPU_METHOD
/begin COMPU_METHOD dtsegn_b720divZylP5 "" RAT_FUNC "%6.1" "grad/KW" COEFFS 0 182.044 32768 0 0 1 /end COMPU_METHOD
/begin COMPU_METHOD fak_q0p0195 "" RAT_FUNC "%6.4" "-" COEFFS 0 256 0 0 0 5 /end COMPU_METHOD
/begin COMPU_METHOD fak_sw_b1 "" RAT_FUNC "%7.6" "-" COEFFS 0 65536 0 0 0 2 /end COMPU_METHOD
/begin COMPU_METHOD fak_sw_b8 "" RAT_FUNC "%6.5" "-" COEFFS 0 65536 0 0 0 16 /end COMPU_METHOD
/begin COMPU_METHOD fak_ub_b0p1_o0p05 "" RAT_FUNC "%8.7" "-" COEFFS 0 256 12.8 0 0 0.1 /end COMPU_METHOD
/begin COMPU_METHOD fak_ub_b2 "" RAT_FUNC "%6.4" "-" COEFFS 0 256 0 0 0 2 /end COMPU_METHOD
/begin COMPU_METHOD fak_uw_b1 "" RAT_FUNC "%7.6" "-" COEFFS 0 65536 0 0 0 1 /end COMPU_METHOD
/begin COMPU_METHOD fak_uw_b16 "" RAT_FUNC "%6.5" "-" COEFFS 0 65536 0 0 0 16 /end COMPU_METHOD
/begin COMPU_METHOD fak_uw_b2 "" RAT_FUNC "%7.6" "-" COEFFS 0 65536 0 0 0 2 /end COMPU_METHOD
/begin COMPU_METHOD luquant "Umrechnung Laufunruhe in DMD" RAT_FUNC "%6.3" "(Umdr./sec)^2" COEFFS 0 1.47862 0 0 0 1 /end COMPU_METHOD
/begin COMPU_METHOD m_q2p777Em5_kg "" RAT_FUNC "%7.6" "kg" COEFFS 0 3600 0 0 0 0.1 /end COMPU_METHOD
/begin COMPU_METHOD m_uw_b6553p5 "" RAT_FUNC "%6.3" "kg/h" COEFFS 0 1 0 0 0 0.1 /end COMPU_METHOD
/begin COMPU_METHOD nmot_ub_q40 "" RAT_FUNC "%6.1" "Upm" COEFFS 0 1 0 0 0 40 /end COMPU_METHOD
/begin COMPU_METHOD rel_ub_q0p75 "" RAT_FUNC "%6.3" "%" COEFFS 0 1 0 0 0 0.75 /end COMPU_METHOD
/begin COMPU_METHOD rel_uw_b100 "" RAT_FUNC "%6.4" "%" COEFFS 0 65536 0 0 0 100 /end COMPU_METHOD
/begin COMPU_METHOD r_uw_q2 "" RAT_FUNC "%6.2" "Ohm" COEFFS 0 1 0 0 0 2 /end COMPU_METHOD
/begin COMPU_METHOD spg_ubatt "" RAT_FUNC "%6.4" "V" COEFFS 0 1 0 0 0 0.0704 /end COMPU_METHOD
/begin COMPU_METHOD spg_ub_b1p33 "" RAT_FUNC "%6.4" "V" COEFFS 0 255 0 0 0 1.33 /end COMPU_METHOD
/begin COMPU_METHOD spg_uw_b1p33 "" RAT_FUNC "%7.6" "V" COEFFS 0 65535 0 0 0 1.33 /end COMPU_METHOD
/begin COMPU_METHOD spg_uw_q0p00488 "" RAT_FUNC "%6.4" "V" COEFFS 0 1024 0 0 0 5 /end COMPU_METHOD
/begin COMPU_METHOD spg_uw_q0p00488_o1 "" RAT_FUNC "%6.3" "V" COEFFS 0 1024 1024 0 0 5 /end COMPU_METHOD
/begin COMPU_METHOD t100msxs_ub_b25p5 "" RAT_FUNC "%6.3" "s" COEFFS 0 1 0 0 0 0.1 /end COMPU_METHOD
/begin COMPU_METHOD t100msxs_uw_b6553p5 "" RAT_FUNC "%6.3" "s" COEFFS 0 1 0 0 0 0.1 /end COMPU_METHOD
/begin COMPU_METHOD t100msxs_uw_q100 "" RAT_FUNC "%6.3" "s" COEFFS 0 1 0 0 0 0.1 /end COMPU_METHOD
/begin COMPU_METHOD t10msxs_ub_b2p55 "" RAT_FUNC "%6.4" "s" COEFFS 0 1 0 0 0 0.01 /end COMPU_METHOD
/begin COMPU_METHOD t10msxs_uw_b655p35 "" RAT_FUNC "%6.4" "s" COEFFS 0 1 0 0 0 0.01 /end COMPU_METHOD
/begin COMPU_METHOD t20msxs_ub_b5p1 "" RAT_FUNC "%6.4" "s" COEFFS 0 1 0 0 0 0.02 /end COMPU_METHOD
/begin COMPU_METHOD t50msxs_uw_b3276p75 "" RAT_FUNC "%6.4" "s" COEFFS 0 1 0 0 0 0.05 /end COMPU_METHOD
/begin COMPU_METHOD temp_q0p0234_o273 "" RAT_FUNC "%6.1" "Grad C" COEFFS 0 1 273.15 0 0 0.0234375 /end COMPU_METHOD
/begin COMPU_METHOD temp_ub_q0p75_o48 "" RAT_FUNC "%6.2" "Grad C" COEFFS 0 1 48 0 0 0.75 /end COMPU_METHOD
/begin COMPU_METHOD temp_ub_q5_o50 "" RAT_FUNC "%6.2" "Grad C" COEFFS 0 1 50 0 0 5 /end COMPU_METHOD
/begin COMPU_METHOD tsquant "Umrechnung Segmentzeit in DMD" RAT_FUNC "%6.2" "us" COEFFS 0 1.21951 0 0 0 1 /end COMPU_METHOD
/begin COMPU_METHOD tv_ub_b100 "" RAT_FUNC "%6.3" "%" COEFFS 0 256 0 0 0 100 /end COMPU_METHOD
/begin COMPU_METHOD zk100msxs_uw_b6553 "" RAT_FUNC "%12.4" "s" COEFFS 0 0 65536 0 10 0 /end COMPU_METHOD
/begin COMPU_METHOD zk10msxs_uw_b655 "" RAT_FUNC "%12.5" "s" COEFFS 0 0 65536 0 100 0 /end COMPU_METHOD
/begin RECORD_LAYOUT GkfWSb FNC_VALUES 1 SBYTE COLUMN_DIR DIRECT /end RECORD_LAYOUT
/begin RECORD_LAYOUT GkfWUb FNC_VALUES 1 UBYTE COLUMN_DIR DIRECT /end RECORD_LAYOUT
/begin RECORD_LAYOUT GklWSb FNC_VALUES 1 SBYTE COLUMN_DIR DIRECT /end RECORD_LAYOUT
/begin RECORD_LAYOUT GklWUb FNC_VALUES 1 UBYTE COLUMN_DIR DIRECT /end RECORD_LAYOUT
/begin RECORD_LAYOUT KwSb FNC_VALUES 1 SBYTE COLUMN_DIR DIRECT /end RECORD_LAYOUT
/begin RECORD_LAYOUT KwSw FNC_VALUES 1 SWORD COLUMN_DIR DIRECT /end RECORD_LAYOUT
/begin RECORD_LAYOUT KwUb FNC_VALUES 1 UBYTE COLUMN_DIR DIRECT /end RECORD_LAYOUT
/begin RECORD_LAYOUT KwUw FNC_VALUES 1 UWORD COLUMN_DIR DIRECT /end RECORD_LAYOUT
/begin RECORD_LAYOUT SstAUbSstUb NO_AXIS_PTS_X 1 UBYTE AXIS_PTS_X 2 UBYTE INDEX_INCR DIRECT /end RECORD_LAYOUT
/end MODULE
/end PROJECT
