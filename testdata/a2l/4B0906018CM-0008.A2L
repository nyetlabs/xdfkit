ASAP2_VERSION 1 3
/begin PROJECT X505P_24HG_1 "X505P"
/begin HEADER "" VERSION "X505P_24HG_1" PROJECT_NO X505P_24HG_1 /end HEADER
/begin MODULE DIM ""
/begin MOD_COMMON "" BYTE_ORDER MSB_LAST ALIGNMENT_BYTE 1 ALIGNMENT_WORD 2 ALIGNMENT_LONG 2 /end MOD_COMMON
/begin CHARACTERISTIC ANZEAUS "Anzahl der auszublendenden Einspritzungen" VALUE 0x810B4A KwUb 3.000 dez 4.000 7.000 FORMAT "%5.3" /end CHARACTERISTIC
/begin CHARACTERISTIC AUFW100M "Zusaetzlich Testverzoegerung fuer 100ms-Task" VALUE 0x827E9A KwUw 1310700. t20usxus_q20 0.00 1310700. FORMAT "%8.0" /end CHARACTERISTIC
/begin CHARACTERISTIC AUFW10MS "Zusaetzlich Testverzoegerung fuer 10ms-Task" VALUE 0x811B95 KwUb 5100. t20usxus_q20 0.00 5100. FORMAT "%5.0" /end CHARACTERISTIC
/begin CHARACTERISTIC AUFW20MS "Zusaetzlich Testverzoegerung fuer 20ms-Task" VALUE 0x816EBC KwUw 1310700. t20usxus_q20 0.00 1310700. FORMAT "%8.0" /end CHARACTERISTIC
/begin CHARACTERISTIC AUFWSYNC "Zusaetzlich Testverzoegerung fuer Synchro-Task" VALUE 0x811B96 KwUb 5100. t20usxus_q20 0.00 5100. FORMAT "%5.0" /end CHARACTERISTIC
/begin CHARACTERISTIC CDAGR "Codewort DAGR abschalten (EURO-Codierung), CD..=0 -> keine Diagnose" VALUE 0x818194 KwUb 255.0 dez 0.00 255.0 FORMAT "%5.1" /end CHARACTERISTIC
/begin CHARACTERISTIC CDAGRL "Codewort Diagnose Lagesensor abschalten (EURO-Codierung), CD..=0 -> keine Diag." VALUE 0x818195 KwUb 255.0 dez 0.00 255.0 FORMAT "%5.1" /end CHARACTERISTIC
/begin CHARACTERISTIC CDATR "Konfigurationsbyte Diagnose Abgastemperaturregelung" VALUE 0x818196 KwUb 255.0 dez 0.00 255.0 FORMAT "%5.1" /end CHARACTERISTIC
/begin CHARACTERISTIC CDATS "Konfigurationsbyte Diagnose Abgastemperatursensor" VALUE 0x818197 KwUb 255.0 dez 0.00 255.0 FORMAT "%5.1" /end CHARACTERISTIC
/begin CHARACTERISTIC CDBKVP_0_A "Codewort zur Freigabe der Diagnose Bremskraftverstärker-Pumpe DBKVP" VALUE 0x81AD52 KwUb 255.0 dez 0.00 255.0 FORMAT "%5.1" /end CHARACTERISTIC
/begin CHARACTERISTIC CDBKVP_1_A "Codewort zur Freigabe der Diagnose Bremskraftverstärker-Pumpe DBKVP" VALUE 0x81AD53 KwUb 255.0 dez 0.00 255.0 FORMAT "%5.1" /end CHARACTERISTIC
/begin CHARACTERISTIC CDDSBKV_0_A "Codewort für %DDSBKV" VALUE 0x81AD54 KwUb 255.0 dez 0.00 255.0 FORMAT "%5.1" /end CHARACTERISTIC
/begin CHARACTERISTIC CDDSBKV_1_A "Codewort für %DDSBKV" VALUE 0x81AD55 KwUb 255.0 dez 0.00 255.0 FORMAT "%5.1" /end CHARACTERISTIC
/begin CHARACTERISTIC CDDST "Codewort Tankdrucksensor-Diagnose abschalten (EURO-Codierung)" VALUE 0x818198 KwUb 255.0 dez 0.00 255.0 FORMAT "%5.1" /end CHARACTERISTIC
/begin CHARACTERISTIC CDEGFE "Codewort Diagnose Eingangsgrößen Füllungserfassung" VALUE 0x818199 KwUb 255.0 dez 0.00 255.0 FORMAT "%5.1" /end CHARACTERISTIC
/begin CHARACTERISTIC CDEHFM "Codewort zum Aktivieren der Auswertung des HFM" VALUE 0x81819A KwUb 255.0 dez 0.00 255.0 FORMAT "%5.1" /end CHARACTERISTIC
/begin CHARACTERISTIC CDGGGTS "Codewort GGGTS (Kühlwassertemperatur über Kombi)" VALUE 0x81819B KwUb 255.0 dez 0.00 255.0 FORMAT "%5.1" /end CHARACTERISTIC
/begin CHARACTERISTIC CDHSH "Codewort Heizerdiagnose hinter Kat (CDHSH = 0  => keine Diagnose)" VALUE 0x81819C KwUb 255.0 dez 0.00 255.0 FORMAT "%5.1" /end CHARACTERISTIC
/begin CHARACTERISTIC CDHSHE "Eurobit für Diagnose Entstufe Lambdasondenheizung hinter Kat" VALUE 0x81819D KwUb 255.0 dez 0.00 255.0 FORMAT "%5.1" /end CHARACTERISTIC
/begin CHARACTERISTIC CDHSV "Codewort Heizerdiagnose vor Kat im (CDHSV = 0  => keine Diagnose)" VALUE 0x81819E KwUb 255.0 dez 0.00 255.0 FORMAT "%5.1" /end CHARACTERISTIC
/begin CHARACTERISTIC CDHSVE "Codewort DHLSE Heizer Endstufe diagnose vor Kat" VALUE 0x81819F KwUb 255.0 dez 0.00 255.0 FORMAT "%5.1" /end CHARACTERISTIC
/begin CHARACTERISTIC CDHSVSA "Codewort Heizerdiagnose vor Kat im Schub (CDHSVsa = 0  => keine Diagnose)" VALUE 0x8181A0 KwUb 255.0 dez 0.00 255.0 FORMAT "%5.1" /end CHARACTERISTIC
/begin CHARACTERISTIC CDKAT "Codewort Katalysator-Diagnose im OBDII-Mode (invers: Europa-Mode)" VALUE 0x8181A1 KwUb 255.0 dez 0.00 255.0 FORMAT "%5.1" /end CHARACTERISTIC
/begin CHARACTERISTIC CDKATSP "Codewort Katalysator-Diagnose im OBDII-Mode (invers: Europa-Mode)" VALUE 0x8181A2 KwUb 255.0 dez 0.00 255.0 FORMAT "%5.1" /end CHARACTERISTIC
/begin CHARACTERISTIC CDKATSPF "Katdiagnose, Freigabe" VALUE 0x8181A3 KwUb 255.0 dez 0.00 255.0 FORMAT "%5.1" /end CHARACTERISTIC
/begin CHARACTERISTIC CDKVS "Codeword DKVS aktiv/inaktiv, CD..=0 -> keine Diagnose" VALUE 0x8181A4 KwUb 255.0 dez 0.00 255.0 FORMAT "%5.1" /end CHARACTERISTIC
/begin CHARACTERISTIC CDLASH "Codewort Lambdasondenalterungsdiagnose (SHK) im OBDII-Mode (invers: Europa-Mode)" VALUE 0x8181A5 KwUb 255.0 dez 0.00 255.0 FORMAT "%5.1" /end CHARACTERISTIC
/begin CHARACTERISTIC CDLATP "Codewort Lambdasondenalterungsdiagnose (TP) im OBDII-Mode (invers: Europa-Mode)" VALUE 0x8181A6 KwUb 255.0 dez 0.00 255.0 FORMAT "%5.1" /end CHARACTERISTIC
/begin CHARACTERISTIC CDLATV "Codewort Lambdasondenalterungsdiagnose (tv) im OBDII-Mode (invers: Europa-Mode)" VALUE 0x8181A7 KwUb 255.0 dez 0.00 255.0 FORMAT "%5.1" /end CHARACTERISTIC
/begin CHARACTERISTIC CDLDP "Codewort LDP-Diagnose im OBDII-Modus (invers: Europa-Modus), CD..=0 -> keine Dia" VALUE 0x8181A8 KwUb 255.0 dez 0.00 255.0 FORMAT "%5.1" /end CHARACTERISTIC
/begin CHARACTERISTIC CDLLR "Codewort DLLR abschalten (EURO-Codierung), CD..=0 -> keine Diagnose" VALUE 0x8181A9 KwUb 255.0 dez 0.00 255.0 FORMAT "%5.1" /end CHARACTERISTIC
/begin CHARACTERISTIC CDLSA "Codewort Lambdasondenalterungsdiagnose, Konfig.-byte, für Applikationszwecke" VALUE 0x8181AA KwUb 255.0 dez 0.00 255.0 FORMAT "%5.1" /end CHARACTERISTIC
/begin CHARACTERISTIC CDLSH "Codewort Sondendiagnose hinter Kat im OBDII-Mode (invers: Europa-Mode)" VALUE 0x8181AB KwUb 255.0 dez 0.00 255.0 FORMAT "%5.1" /end CHARACTERISTIC
/begin CHARACTERISTIC CDLSV "Codewort Sondendiagnose vor KAT im OBDII-Mode" VALUE 0x8181AC KwUb 255.0 dez 0.00 255.0 FORMAT "%5.1" /end CHARACTERISTIC
/begin CHARACTERISTIC CDLSVV "Codewort Diagnose vertauschte Sonden vor Kat im OBDII-Mode (invers: Europa-Mode)" VALUE 0x8181AD KwUb 255.0 dez 0.00 255.0 FORMAT "%5.1" /end CHARACTERISTIC
/begin CHARACTERISTIC CDMD "Codewort DMD abschalten (EURO-Codierung), CD..=0 -> keine Diagnose" VALUE 0x8181AE KwUb 255.0 dez 0.00 255.0 FORMAT "%5.1" /end CHARACTERISTIC
/begin CHARACTERISTIC CDNWS "Codewort DNWS abschalten (EURO-Codierung), CD..=0 -> keine Diagnose" VALUE 0x8181AF KwUb 255.0 dez 0.00 255.0 FORMAT "%5.1" /end CHARACTERISTIC
/begin CHARACTERISTIC CDSLS "Euro-Byte für Diagnose Sekundärluft-System" VALUE 0x8181B0 KwUb 255.0 dez 0.00 255.0 FORMAT "%5.1" /end CHARACTERISTIC
/begin CHARACTERISTIC CDSWE_0_A "Codewort DSWE abschalten (EURO-Codierung), CD..=0 -> keine Diagnose" VALUE 0x81AD56 KwUb 255.0 dez 0.00 255.0 FORMAT "%5.1" /end CHARACTERISTIC
/begin CHARACTERISTIC CDSWE_1_A "Codewort DSWE abschalten (EURO-Codierung), CD..=0 -> keine Diagnose" VALUE 0x81AD57 KwUb 255.0 dez 0.00 255.0 FORMAT "%5.1" /end CHARACTERISTIC
/begin CHARACTERISTIC CDSWE_2_A "Codewort DSWE abschalten (EURO-Codierung), CD..=0 -> keine Diagnose" VALUE 0x81AD58 KwUb 255.0 dez 0.00 255.0 FORMAT "%5.1" /end CHARACTERISTIC
/begin CHARACTERISTIC CDSWE_3_A "Codewort DSWE abschalten (EURO-Codierung), CD..=0 -> keine Diagnose" VALUE 0x81AD59 KwUb 255.0 dez 0.00 255.0 FORMAT "%5.1" /end CHARACTERISTIC
/begin CHARACTERISTIC CDSWE_4_A "Codewort DSWE abschalten (EURO-Codierung), CD..=0 -> keine Diagnose" VALUE 0x81AD5A KwUb 255.0 dez 0.00 255.0 FORMAT "%5.1" /end CHARACTERISTIC
/begin CHARACTERISTIC CDSWE_5_A "Codewort DSWE abschalten (EURO-Codierung), CD..=0 -> keine Diagnose" VALUE 0x81AD5B KwUb 255.0 dez 0.00 255.0 FORMAT "%5.1" /end CHARACTERISTIC
/begin CHARACTERISTIC CDSWE_6_A "Codewort DSWE abschalten (EURO-Codierung), CD..=0 -> keine Diagnose" VALUE 0x81AD5C KwUb 255.0 dez 0.00 255.0 FORMAT "%5.1" /end CHARACTERISTIC
/begin CHARACTERISTIC CDSWE_7_A "Codewort DSWE abschalten (EURO-Codierung), CD..=0 -> keine Diagnose" VALUE 0x81AD5D KwUb 255.0 dez 0.00 255.0 FORMAT "%5.1" /end CHARACTERISTIC
/begin CHARACTERISTIC CDTANKL "Codewort DTANKL abschalten (EURO-Codierung), CD..=0 -> keine Diagnose" VALUE 0x8181B1 KwUb 255.0 dez 0.00 255.0 FORMAT "%5.1" /end CHARACTERISTIC
/begin CHARACTERISTIC CDTES "Codewort Tankentlüftungsdiagnose abschalten (EURO-Codierung), CD..=0 ->keine Dia" VALUE 0x8181B2 KwUb 255.0 dez 0.00 255.0 FORMAT "%5.1" /end CHARACTERISTIC
/begin CHARACTERISTIC CDWVERAD "Codewort : Sperrung Bedarfsadaption dmvadll für AG" VALUE 0x8181B3 KwUb 255.0 dez 0.00 255.0 FORMAT "%5.1" /end CHARACTERISTIC
/begin CHARACTERISTIC CNFMDVER "Codewort zur Konfiguration von MDVER" VALUE 0x81A11D KwUb 255.0 dez 0.00 255.0 FORMAT "%5.1" /end CHARACTERISTIC
/begin CHARACTERISTIC CNFMDWAN "Codewort für die Einberechnung von MDWAN in der LLR" VALUE 0x811702 KwUb 255.0 dez 0.00 255.0 FORMAT "%5.1" /end CHARACTERISTIC
/begin CHARACTERISTIC CNFSL "Codewort für Einberechnung der Servolenkung in der LLR" VALUE 0x819FCB KwUb 255.0 dez 0.00 255.0 FORMAT "%5.1" /end CHARACTERISTIC
/begin CHARACTERISTIC CWADRES "Codewort für Adaptionswerte löschen bei FSP löschen" VALUE 0x8181B4 KwUb 255.0 dez 0.00 255.0 FORMAT "%5.1" /end CHARACTERISTIC
/begin CHARACTERISTIC CWDLSU "Codewort für DLSU" VALUE 0x8181B5 KwUb 255.0 dez 0.00 255.0 FORMAT "%5.1" /end CHARACTERISTIC
/begin CHARACTERISTIC CWDMIL "Codewort ti-Dauerstrichregelung RKTI" VALUE 0x818EBD KwUb 255.0 dez 0.00 255.0 FORMAT "%5.1" /end CHARACTERISTIC
/begin CHARACTERISTIC CWERFIL "Codewort zur Auswahl Filtervar. für die Ausgabe von AS.-Fehler an das Scan Tool" VALUE 0x8181B6 KwUb 255.0 dez 0.00 255.0 FORMAT "%5.1" /end CHARACTERISTIC
/begin CHARACTERISTIC CWFASL "Codewort: Testereingriff Sekundärluftdiagnose" VALUE 0x8182E8 KwUb 255.0 dez 0.00 255.0 FORMAT "%5.1" /end CHARACTERISTIC
/begin CHARACTERISTIC CWGRABH "Codewort für GRA-Bedienhebel" VALUE 0x8181B7 KwUb 255.0 dez 0.00 255.0 FORMAT "%5.1" /end CHARACTERISTIC
/begin CHARACTERISTIC CWKMMILSCT "Ausgabe ""Km bei MIL on""  für Scan Tool abschalten (0 = keine Ausgabe in PID $21)" VALUE 0x8181B8 KwUb 255.0 dez 0.00 255.0 FORMAT "%5.1" /end CHARACTERISTIC
/begin CHARACTERISTIC CWKONABG "Codewort für Konfiguration Abgasbehandlung" VALUE 0x8181B9 KwUb 255.0 dez 0.00 255.0 FORMAT "%5.1" /end CHARACTERISTIC
/begin CHARACTERISTIC CWKONFLS "Beschreibung der Lambdasondenposition hinter Katalysator im Abgasstrang" VALUE 0x8181BA KwUb 255.0 dez 0.00 255.0 FORMAT "%5.1" /end CHARACTERISTIC
/begin CHARACTERISTIC CWKONFZ1_0_A "Codewort für Konfiguration Fahrzeug" VALUE 0x81AD5E KwUb 255.0 dez 0.00 255.0 FORMAT "%5.1" /end CHARACTERISTIC
/begin CHARACTERISTIC CWKONFZ1_1_A "Codewort für Konfiguration Fahrzeug" VALUE 0x81AD5F KwUb 255.0 dez 0.00 255.0 FORMAT "%5.1" /end CHARACTERISTIC
/begin CHARACTERISTIC CWKONFZ1_2_A "Codewort für Konfiguration Fahrzeug" VALUE 0x81AD60 KwUb 255.0 dez 0.00 255.0 FORMAT "%5.1" /end CHARACTERISTIC
/begin CHARACTERISTIC CWKONFZ1_3_A "Codewort für Konfiguration Fahrzeug" VALUE 0x81AD61 KwUb 255.0 dez 0.00 255.0 FORMAT "%5.1" /end CHARACTERISTIC
/begin CHARACTERISTIC CWKONFZ1_4_A "Codewort für Konfiguration Fahrzeug" VALUE 0x81AD62 KwUb 255.0 dez 0.00 255.0 FORMAT "%5.1" /end CHARACTERISTIC
/begin CHARACTERISTIC CWKONFZ1_5_A "Codewort für Konfiguration Fahrzeug" VALUE 0x81AD63 KwUb 255.0 dez 0.00 255.0 FORMAT "%5.1" /end CHARACTERISTIC
/begin CHARACTERISTIC CWKONFZ1_6_A "Codewort für Konfiguration Fahrzeug" VALUE 0x81AD64 KwUb 255.0 dez 0.00 255.0 FORMAT "%5.1" /end CHARACTERISTIC
/begin CHARACTERISTIC CWKONFZ1_7_A "Codewort für Konfiguration Fahrzeug" VALUE 0x81AD65 KwUb 255.0 dez 0.00 255.0 FORMAT "%5.1" /end CHARACTERISTIC
/begin CHARACTERISTIC CWKONLS "Codewort für Konfiguration Lambda Sonden" VALUE 0x8181BB KwUb 255.0 dez 0.00 255.0 FORMAT "%5.1" /end CHARACTERISTIC
/begin CHARACTERISTIC CWLSHA "Codewort für Lambdasonden hinter KAT Alterung in %DLSAHK" VALUE 0x8181BC KwUb 255.0 dez 0.00 255.0 FORMAT "%5.1" /end CHARACTERISTIC
/begin CHARACTERISTIC CWMDAPP "Codewort Applikation ohne Drehmomentfunktionen" VALUE 0x8181BD KwUb 255.0 dez 0.00 255.0 FORMAT "%5.1" /end CHARACTERISTIC
/begin CHARACTERISTIC CWMDRLKO "Codewort: Klimakompressormoment abh. von rl, nmot" VALUE 0x819FCC KwUb 255.0 dez 0.00 255.0 FORMAT "%5.1" /end CHARACTERISTIC
/begin CHARACTERISTIC CWNLPH "Freigabe der jeweiligen Phasengebernotlauffunktion" VALUE 0x810B4B KwUb 255.0 dez 0.00 255.0 FORMAT "%5.1" /end CHARACTERISTIC
/begin CHARACTERISTIC CWNMAXMD "Codeword Drehzahlbegrenzung" VALUE 0x811A9F KwUb 255.0 dez 0.00 255.0 FORMAT "%5.1" /end CHARACTERISTIC
/begin CHARACTERISTIC CWNWFW "Codewort für Umschaltung der Bildung Faktor Winkel Nockenwelle" VALUE 0x81A54C KwUb 255.0 dez 0.00 255.0 FORMAT "%5.1" /end CHARACTERISTIC
/begin CHARACTERISTIC CWOBD "Codewort für Konfiguration OBD Zertifikationsnachweis" VALUE 0x8181BE KwUb 255.0 dez 0.00 255.0 FORMAT "%5.1" /end CHARACTERISTIC
/begin CHARACTERISTIC CWPKAPP "Codewort Applikation Druckreferenz für Kraftstoffdruckregler" VALUE 0x818EBE KwUb 255.0 dez 0.00 255.0 FORMAT "%5.1" /end CHARACTERISTIC
/begin CHARACTERISTIC CWSCTMDE "Codewort zum abschalten bestimmter Scan Tool Modes/Services (Bit=0 ->  Mode aus)" VALUE 0x8181BF KwUb 255.0 dez 0.00 255.0 FORMAT "%5.1" /end CHARACTERISTIC
/begin CHARACTERISTIC CWSLS "Codewort für Sekundärluftsystem" VALUE 0x8181C0 KwUb 255.0 dez 0.00 255.0 FORMAT "%5.1" /end CHARACTERISTIC
/begin CHARACTERISTIC CWTF "Codewort für Konfiguration Temperaturfühler" VALUE 0x8181C1 KwUb 255.0 dez 0.00 255.0 FORMAT "%5.1" /end CHARACTERISTIC
/begin CHARACTERISTIC CWTUM "Codewort: Umgebungstemperatur für Klimakompressor" VALUE 0x819FCD KwUb 255.0 dez 0.00 255.0 FORMAT "%5.1" /end CHARACTERISTIC
/begin CHARACTERISTIC CWUHR "Codewort für Uhr" VALUE 0x8181C2 KwUb 255.0 dez 0.00 255.0 FORMAT "%5.1" /end CHARACTERISTIC
/begin CHARACTERISTIC DDWPEDMDK "delta Pedalgradient zur Sperrung des Verlustmomentfilters beim Kriechen (CVT)" VALUE 0x827A3A KwUw 50.00000 rel_uw_b100 0.00 50.00000 FORMAT "%8.5" /end CHARACTERISTIC
/begin CHARACTERISTIC DMADFK "Maximal adaptierbares Delta-Verlustmoment pro Adaptionsphase Fahrst.+Kompr." VALUE 0x819F83 KwUb 24.90 rel_ub_b24p9 0.00 24.90 FORMAT "%5.2" /end CHARACTERISTIC
/begin CHARACTERISTIC DMADFS "Maximal adaptierbares Delta-Verlustmoment pro Adaptionsphase mit Fahrstufe ein" VALUE 0x819F84 KwUb 24.90 rel_ub_b24p9 0.00 24.90 FORMAT "%5.2" /end CHARACTERISTIC
/begin CHARACTERISTIC DMADKO "Maximal adaptierbares Delta-Verlustmoment pro Adaptionsphase Kompr.ein" VALUE 0x819F85 KwUb 24.90 rel_ub_b24p9 0.00 24.90 FORMAT "%5.2" /end CHARACTERISTIC
/begin CHARACTERISTIC DMADLL "Maximal adaptierbares Delta-Verlustmoment pro Adaptionsphase ohne Last" VALUE 0x819F86 KwUb 24.90 rel_ub_b24p9 0.00 24.90 FORMAT "%5.2" /end CHARACTERISTIC
/begin CHARACTERISTIC DMADMNFK "Minimal adaptierbares Delta-Verlustmoment Fahrstufe eingelegt + Kompressor ein" VALUE 0x819F87 KwUb 24.90 rel_ub_bn24p9 -24.90 0.00 FORMAT "%5.2" /end CHARACTERISTIC
/begin CHARACTERISTIC DMADMNFS "Minimal adaptierbares Delta-Verlustmoment Fahrstufe eingelegt" VALUE 0x819F88 KwUb 24.90 rel_ub_bn24p9 -24.90 0.00 FORMAT "%5.2" /end CHARACTERISTIC
/begin CHARACTERISTIC DMADMNKO "Minimal adaptierbares Delta-Verlustmoment Klimakompressor ein" VALUE 0x819F89 KwUb 24.90 rel_ub_bn24p9 -24.90 0.00 FORMAT "%5.2" /end CHARACTERISTIC
/begin CHARACTERISTIC DMADMNLL "Minimal adaptierbares Delta-Verlustmoment ohne Last" VALUE 0x819F8A KwUb 24.90 rel_ub_bn24p9 -24.90 0.00 FORMAT "%5.2" /end CHARACTERISTIC
/begin CHARACTERISTIC DMADMXFK "Maximal adaptierbares Delta-Verlustmoment Farstufe + Klimakompressor ein" VALUE 0x819F8B KwUb 24.90 rel_ub_b24p9 0.00 24.90 FORMAT "%5.2" /end CHARACTERISTIC
/begin CHARACTERISTIC DMADMXFS "Maximal adaptierbares Delta-Verlustmoment Farstufe ein" VALUE 0x819F8C KwUb 24.90 rel_ub_b24p9 0.00 24.90 FORMAT "%5.2" /end CHARACTERISTIC
/begin CHARACTERISTIC DMADMXKO "Maximal adaptierbares Delta-Verlustmoment Klimakompressor ein" VALUE 0x819F8D KwUb 24.90 rel_ub_b24p9 0.00 24.90 FORMAT "%5.2" /end CHARACTERISTIC
/begin CHARACTERISTIC DMADMXLL "Maximal adaptierbares Delta-Verlustmoment ohne Last" VALUE 0x819F8E KwUb 24.90 rel_ub_b24p9 0.00 24.90 FORMAT "%5.2" /end CHARACTERISTIC
/begin CHARACTERISTIC DMAUFN "Delta-Moment Aufregelung nach Drehmomenteingriff" CURVE 0x828D8E KlAUwSstUwWUw 99.99847 rel_uw_b100 0.00 99.99847 FORMAT "%8.5"
 /begin AXIS_DESCR STD_AXIS nmot_w nmot_uw_q0p25 8 0.00 16383.75 FORMAT "%8.2" DEPOSIT ABSOLUTE /end AXIS_DESCR
/end CHARACTERISTIC
/begin CHARACTERISTIC DMDLWS "Lenkhilfelastmoment" CURVE 0x8271DA KlAUwSstSwWUw 49.99924 rel_q0p7629Em3 0.00 49.99924 FORMAT "%8.5"
 /begin AXIS_DESCR STD_AXIS lws_w lw_sw_q0p04375 6 -1434.044 1434.000 FORMAT "%8.3" DEPOSIT ABSOLUTE /end AXIS_DESCR
/end CHARACTERISTIC
/begin CHARACTERISTIC DMDNSM "Delta Moment zur Nachstartkompensation" CURVE 0x81A11E KlAUbSstUbWUb 99.61 rel_ub_b99p6 0.00 99.61 FORMAT "%5.2"
 /begin AXIS_DESCR STD_AXIS tmot temp_ub_q0p75_o48 8 -48.00 143.3 FORMAT "%5.1" DEPOSIT ABSOLUTE /end AXIS_DESCR
/end CHARACTERISTIC
/begin CHARACTERISTIC DMDRKO "Momentenreserve für AC-Kompressor" VALUE 0x819FCE KwUb 99.61 rel_ub_b99p6 0.00 99.61 FORMAT "%5.2" /end CHARACTERISTIC
/begin CHARACTERISTIC DMDWANK "delta Wandlermoment für Sperrung des Verlustmomentfilters beim Kriechen (CVT)" VALUE 0x827A3C KwUw 99.99847 rel_uw_b100 0.00 99.99847 FORMAT "%8.5" /end CHARACTERISTIC
/begin CHARACTERISTIC DMDWANMX "Begrenzung des Wandlermoments für Sicherheitskonzept" VALUE 0x811703 KwUb 100.0 rel_q0p392 0.00 100.0 FORMAT "%5.1" /end CHARACTERISTIC
/begin CHARACTERISTIC DMDWHYS "Hysterese für Bildung D-Anteil-Wandlermoment" VALUE 0x811704 KwUb 99.61 rel_ub_b99p6 0.00 99.61 FORMAT "%5.2" /end CHARACTERISTIC
/begin CHARACTERISTIC DMDWM "D-Anteil Wandlermoment bei Einlegen der Fahrstufe" CURVE 0x819F91 GklWUb 99.61 rel_ub_b99p6 0.00 99.61 FORMAT "%5.2"
 /begin AXIS_DESCR COM_AXIS twnd temp_ub_q0p75_o48 8 -48.00 143.3 AXIS_PTS_REF STW08MDUB /end AXIS_DESCR
/end CHARACTERISTIC
/begin CHARACTERISTIC DMKO "Begrenzung des Kompressormoments für Sicherheitskonzept" VALUE 0x819FCF KwUb 99.61 rel_ub_b100 0.00 99.61 FORMAT "%5.2" /end CHARACTERISTIC
/begin CHARACTERISTIC DMLFS "Begrenzung des Lüftermoments für Sicherheitskonzept" VALUE 0x819FD0 KwUb 99.61 rel_ub_b100 0.00 99.61 FORMAT "%5.2" /end CHARACTERISTIC
/begin CHARACTERISTIC DMSERVL "Begrenzung des Moments der Servolenkung für Sicherheitskonzept" VALUE 0x819FD1 KwUb 99.61 rel_ub_b100 0.00 99.61 FORMAT "%5.2" /end CHARACTERISTIC
/begin CHARACTERISTIC DMSLP "Begrenzung des Moments der Sekundärluftpumpe für Sicherheitskonzept" VALUE 0x819FD2 KwUb 99.61 rel_ub_b100 0.00 99.61 FORMAT "%5.2" /end CHARACTERISTIC
/begin CHARACTERISTIC DMVERLMN "minimale Verlustmomentschwelle" VALUE 0x816D48 KwUw 99.99847 rel_uw_b100 0.00 99.99847 FORMAT "%8.5" /end CHARACTERISTIC
/begin CHARACTERISTIC DNABW "Drehzahldifferenz bei Motor abwürgen" VALUE 0x813942 KwSw 16383.75 nmot_sw_q0p25 -8192.000 8191.750 FORMAT "%8.3" /end CHARACTERISTIC
/begin CHARACTERISTIC DNMAX "Zulässige Verminderung der Maximaldrehzahl pro Rechenschritt" VALUE 0x816D4A KwUw 16383.75 nmot_uw_q0p25 0.00 16383.75 FORMAT "%8.2" /end CHARACTERISTIC
/begin CHARACTERISTIC DNMAXDZ "Delta-Drehzahl, Abregelung der Drehzahlgrenze bei doppelter Zündausgabe" VALUE 0x816D4C KwUw 16383.75 nmot_uw_q0p25 0.00 16383.75 FORMAT "%8.2" /end CHARACTERISTIC
/begin CHARACTERISTIC DNMAXH "Überschreitung der Maximaldrehzahl für Einspritzausblendung an allen Zylindern" VALUE 0x816D4E KwUw 2550.000 nmot_uw_q0p25 0.00 2550.000 FORMAT "%8.3" /end CHARACTERISTIC
/begin CHARACTERISTIC DNSIRES "Differenz Soll- und Istdrehzahl, Reset-Wert" VALUE 0x816D50 KwSw 16383.75 nmot_sw_q0p25 -8192.000 8191.750 FORMAT "%8.3" /end CHARACTERISTIC
/begin CHARACTERISTIC DPSLV "minimale Druckdifferenz Sekundärluftventi" VALUE 0x8182E9 KwUb 1275. p_ub_q5 0.00 1275. FORMAT "%5.0" /end CHARACTERISTIC
/begin CHARACTERISTIC DWPEDMDK "minimaler Pedalgradient zur Sperr. des Verlustmomentfilters beim Kriechen (CVT)" VALUE 0x827A3E KwSw 99.99847 rel_sw_b50 -50.00000 49.99847 FORMAT "%8.5" /end CHARACTERISTIC
/begin CHARACTERISTIC DYNMXNL "Schwellwert für Dynamikbewertung -> hohe Dynamik" VALUE 0x813976 KwUw 40000.00 t5usxus_q5 0.00 40000.00 FORMAT "%8.2" /end CHARACTERISTIC
/begin CHARACTERISTIC DZWETA "Deltazündwinkel aus Wirkungsgrad" CURVE 0x81217A FklWSb 191.3 zw_sb_q0p75 -96.00 95.25 FORMAT "%5.2"
 /begin AXIS_DESCR FIX_AXIS etazws rel_ub_b127p5 201 0.00 100.0 FORMAT "%5.1" FIX_AXIS_PAR 0 0 201 /end AXIS_DESCR
/end CHARACTERISTIC
/begin CHARACTERISTIC FABMDWA "Faktor zur Absteuerung des Wandlermoments abhängig von nturb/nsol" CURVE 0x811705 KlAUbSstUbWUb 0.9961 fak_ub_b1 0.00 0.9961
 /begin AXIS_DESCR STD_AXIS qntns fak_ub_b8 6 0.00 7.969 FORMAT "%5.3" DEPOSIT ABSOLUTE /end AXIS_DESCR
/end CHARACTERISTIC
/begin CHARACTERISTIC FDMDWAN "Wichtungsfaktor für Einrechnung D-Anteil in Wandlermoment" VALUE 0x811712 KwUb 0.9961 fak_ub_b1 0.00 0.9961 /end CHARACTERISTIC
/begin CHARACTERISTIC FIRNLIGN "Mindestwert für Winkelfehler nach der ersten Zündung" VALUE 0x810B5E KwUb 255.0 kw_q1 0.00 255.0 FORMAT "%5.1" /end CHARACTERISTIC
/begin CHARACTERISTIC FKKVS "Korrekturfaktor Kraftstoffversorgungssystem" MAP 0x81D728 KfAxUbAyUbSstxUbSstyUwWUw 1.999969 fak_uw_b2 0.00 1.999969 FORMAT "%8.6"
 /begin AXIS_DESCR STD_AXIS nmot nmot_ub_q40 16 0.00 10200. FORMAT "%5.0" DEPOSIT ABSOLUTE /end AXIS_DESCR
 /begin AXIS_DESCR STD_AXIS tevfakge_w tinjection_sy 16 0.00 174.7600 FORMAT "%8.4" DEPOSIT ABSOLUTE /end AXIS_DESCR
/end CHARACTERISTIC
/begin CHARACTERISTIC FMDWAT "Faktor zur Berechnung des Wandlermoments abh. von der Öltemperatur des Wandlers" CURVE 0x819F99 GklWUb 0.000119850000 fak_ub_q4p7Em7 0.00 0.000119850000 FORMAT "%14.12"
 /begin AXIS_DESCR COM_AXIS twnd temp_ub_q0p75_o48 8 -48.00 143.3 AXIS_PTS_REF STW08MDUB /end AXIS_DESCR
/end CHARACTERISTIC
/begin CHARACTERISTIC FMSL "Faktor Korrektur Sekundärluftmasse" VALUE 0x8182EA KwUb 1.992 fak_ub_b2 0.00 1.992 FORMAT "%5.3" /end CHARACTERISTIC
/begin CHARACTERISTIC FMSLOFF "Schwelle Ausräumen der Sekundärluft beendet" VALUE 0x8182EB KwUb 0.9961 fak_ub_b1 0.00 0.9961 /end CHARACTERISTIC
/begin CHARACTERISTIC FMSRHOL "Dichtekorrektur der Sekundärluftmasse" CURVE 0x81AEDC KlAUwSstUwWUw 1.999969 fak_uw_b2 0.00 1.999969 FORMAT "%8.6"
 /begin AXIS_DESCR STD_AXIS frhokor_w fak_uw_b4 4 0.00 3.999939 FORMAT "%8.6" DEPOSIT ABSOLUTE /end AXIS_DESCR
/end CHARACTERISTIC
/begin CHARACTERISTIC FMSTMOT "tmot- Korrektur der Sekundärluftmasse" CURVE 0x8182EC KlAUbSstUbWUb 1.992 fak_ub_b2 0.00 1.992 FORMAT "%5.3"
 /begin AXIS_DESCR STD_AXIS tmot temp_ub_q0p75_o48 8 -48.00 143.3 FORMAT "%5.1" DEPOSIT ABSOLUTE /end AXIS_DESCR
/end CHARACTERISTIC
/begin CHARACTERISTIC FNLMI0 "Bewertungsfaktor von tsegph(k) für gleitenden Mittelwert" VALUE 0x810B5F KwUb 7.969 fak_ub_b8 0.00 7.969 FORMAT "%5.3" /end CHARACTERISTIC
/begin CHARACTERISTIC FNLMI1 "Bewertungsfaktor von tsegph(k-1) für gleitenden Mittelwert" VALUE 0x810B60 KwUb 7.969 fak_ub_b8 0.00 7.969 FORMAT "%5.3" /end CHARACTERISTIC
/begin CHARACTERISTIC FNLMI2 "Bewertungsfaktor von tsegph(k-2) für gleitenden Mittelwert" VALUE 0x810B61 KwUb 7.969 fak_ub_b8 0.00 7.969 FORMAT "%5.3" /end CHARACTERISTIC
/begin CHARACTERISTIC FNRAD "Faktor zwischen Raddrehzahl und Geschwindigkeit f(Radumfang)" VALUE 0x811713 KwUb 15.94 fak_ub_b16 0.00 15.94 FORMAT "%5.2" /end CHARACTERISTIC
/begin CHARACTERISTIC FNWSKRE "Faktor Nockenwellen-Sollwinkelkorrektur durch klopfende Verbrennungen Einlaß" CURVE 0x81A5C4 KlAUbSstUbWUb 1.000 fak_ub_b2 0.00 1.000 FORMAT "%5.3"
 /begin AXIS_DESCR STD_AXIS wkrma zw_ub_qn0p75 3 -191.3 0.00 FORMAT "%5.1" DEPOSIT ABSOLUTE /end AXIS_DESCR
/end CHARACTERISTIC
/begin CHARACTERISTIC FRLFSDP "Einspritzkorrektur bei RLFS" CURVE 0x81D95A KlAUwSstSwWUw 1.999969 fak_uw_b2 0.00 1.999969 FORMAT "%8.6"
 /begin AXIS_DESCR STD_AXIS dpus_w p_sw_q0p078 11 -2560.0000 2559.9219 FORMAT "%9.4" DEPOSIT ABSOLUTE /end AXIS_DESCR
/end CHARACTERISTIC
/begin CHARACTERISTIC FVDMDWAN "Verstärkungsfaktor zur Bildung D-Ateil-Wandlermomnet" VALUE 0x811714 KwUb 7.969 fak_ub_b8 0.00 7.969 FORMAT "%5.3" /end CHARACTERISTIC
/begin CHARACTERISTIC IMLSLMN_0_A "min. Verhältnisfaktor psum_w/mlsu für Einschaltung SLS" VALUE 0x81AF42 KwUb 0.9961 fak_ub_b1 0.00 0.9961 /end CHARACTERISTIC
/begin CHARACTERISTIC IMLSLMN_1_A "min. Verhältnisfaktor psum_w/mlsu für Einschaltung SLS" VALUE 0x81AF43 KwUb 0.9961 fak_ub_b1 0.00 0.9961 /end CHARACTERISTIC
/begin CHARACTERISTIC IMLSLMX_0_A "max. Verhältnisfaktor psum_w/mlsu für Einschaltung SLS" VALUE 0x81AF44 KwUb 0.9961 fak_ub_b1 0.00 0.9961 /end CHARACTERISTIC
/begin CHARACTERISTIC IMLSLMX_1_A "max. Verhältnisfaktor psum_w/mlsu für Einschaltung SLS" VALUE 0x81AF45 KwUb 0.9961 fak_ub_b1 0.00 0.9961 /end CHARACTERISTIC
/begin CHARACTERISTIC IMLSLSA "Schwelle Luftmassenintegral für Anfang Sekundärluft im Abgas" VALUE 0x81AEEE KwUw 4660.267 m_uw_b4660 0.00 4660.267 FORMAT "%8.3" /end CHARACTERISTIC
/begin CHARACTERISTIC IMLSLSE "Schwelle Luftmassenintegral für Ende Sekundärluft im Abgas" VALUE 0x81AEF0 KwUw 4660.267 m_uw_b4660 0.00 4660.267 FORMAT "%8.3" /end CHARACTERISTIC
/begin CHARACTERISTIC ITNMXH "Verweilzeit unterhalb unterer Drehzahlgrenze vor Aktivierung der oberen Grenze" VALUE 0x816D52 KwUw 655.3500 t10msxs_uw_b655p35 0.00 655.3500 FORMAT "%8.4" /end CHARACTERISTIC
/begin CHARACTERISTIC KFDMDKOE "Anfangswert Momentenfilter bei Klimakompressor Einschalten" MAP 0x819FD3 GkfWSb 99.60 rel_sb_q0p39 -50.00 49.61 FORMAT "%5.2"
 /begin AXIS_DESCR COM_AXIS nmot nmot_ub_q40 6 0.00 10200. AXIS_PTS_REF SNM06KOUB /end AXIS_DESCR
 /begin AXIS_DESCR COM_AXIS tlok temp_ub_q0p75_o48 6 -48.00 143.3 AXIS_PTS_REF STA06LLUB /end AXIS_DESCR
/end CHARACTERISTIC
/begin CHARACTERISTIC KFFMSML "Abgasgegendruckkorrektur der Sekundärluftmasse" MAP 0x8182FD KfAxUbAyUbSstxUbSstyUbWUb 1.992 fak_ub_b2 0.00 1.992 FORMAT "%5.3"
 /begin AXIS_DESCR STD_AXIS nmot nmot_ub_q40 8 0.00 10200. FORMAT "%5.0" DEPOSIT ABSOLUTE /end AXIS_DESCR
 /begin AXIS_DESCR STD_AXIS rl rel_ub_q0p75 8 0.00 191.3 FORMAT "%5.1" DEPOSIT ABSOLUTE /end AXIS_DESCR
/end CHARACTERISTIC
/begin CHARACTERISTIC KFFNWE "Wichtung Nockenwelle Einlass" MAP 0x81A54D KfAxUbAyUbSstxUbSstyUbWUb 0.9961 fak_ub_b1 0.00 0.9961 /begin AXIS_DESCR STD_AXIS fnwue fak_ub_b1 6 0.00 0.9961 DEPOSIT ABSOLUTE /end AXIS_DESCR
 /begin AXIS_DESCR STD_AXIS rl rel_ub_q0p75 6 0.00 191.3 FORMAT "%5.1" DEPOSIT ABSOLUTE /end AXIS_DESCR
/end CHARACTERISTIC
/begin CHARACTERISTIC KFMDDLWS "Lenkhilfelastmoment abhängig von der Lenkwinkelgeschwindigkeit" MAP 0x8161EC KfAxSwAySwSstxSwSstySwWSw 99.99847 rel_uw_b100 -50.00000 49.99847 FORMAT "%8.5"
 /begin AXIS_DESCR STD_AXIS dlwsu_w dlw_sw_q0p04375 6 -1434.044 1434.000 FORMAT "%8.3" DEPOSIT ABSOLUTE /end AXIS_DESCR
 /begin AXIS_DESCR STD_AXIS lws_w lw_sw_q0p04375 6 -1434.044 1434.000 FORMAT "%8.3" DEPOSIT ABSOLUTE /end AXIS_DESCR
/end CHARACTERISTIC
/begin CHARACTERISTIC KFMDKO "Drehmomentaufnahme Klimakompressor" MAP 0x819FF7 GkfWUb 49.80 rel_q0p1953 0.00 49.80 FORMAT "%5.2"
 /begin AXIS_DESCR COM_AXIS nmot nmot_ub_q40 6 0.00 10200. AXIS_PTS_REF SNM06KOUB /end AXIS_DESCR
 /begin AXIS_DESCR COM_AXIS tlok temp_ub_q0p75_o48 6 -48.00 143.3 AXIS_PTS_REF STA06LLUB /end AXIS_DESCR
/end CHARACTERISTIC
/begin CHARACTERISTIC KFMDRKO "Kennfeld: Klimakompressormoment abh. von rl, nmot" MAP 0x81A01B GkfWUb 49.80 rel_q0p1953 0.00 49.80 FORMAT "%5.2"
 /begin AXIS_DESCR COM_AXIS nmot nmot_ub_q40 6 0.00 10200. AXIS_PTS_REF SNM06KOUB /end AXIS_DESCR
 /begin AXIS_DESCR COM_AXIS rl rel_ub_q0p75 6 0.00 191.3 AXIS_PTS_REF SRL06KOUB /end AXIS_DESCR
/end CHARACTERISTIC
/begin CHARACTERISTIC KFMDRKOE "Kennfeld: Klimakompressormoment dyn. Anteil abh. von rl, nmot" MAP 0x81A03F GkfWSb 99.60 rel_sb_q0p39 -50.00 49.61 FORMAT "%5.2"
 /begin AXIS_DESCR COM_AXIS nmot nmot_ub_q40 6 0.00 10200. AXIS_PTS_REF SNM06KOUB /end AXIS_DESCR
 /begin AXIS_DESCR COM_AXIS rl rel_ub_q0p75 6 0.00 191.3 AXIS_PTS_REF SRL06KOUB /end AXIS_DESCR
/end CHARACTERISTIC
/begin CHARACTERISTIC KFMDS "Schleppmoment Drehzahl- und Lastabhängigkeit" MAP 0x827A40 GkfWUw 99.99847 rel_uw_b100 0.00 99.99847 FORMAT "%8.5"
 /begin AXIS_DESCR COM_AXIS nmot_w nmot_uw_q0p25 16 0.00 16383.75 AXIS_PTS_REF SNM16OPUW /end AXIS_DESCR
 /begin AXIS_DESCR COM_AXIS rl_w rel_uw_q0p0234 11 0.00 1535.977 AXIS_PTS_REF SRL11OPUW /end AXIS_DESCR
/end CHARACTERISTIC
/begin CHARACTERISTIC KFMDWMX "Max. Begrenzung für Drehmomentaufnahme des Wandlers" MAP 0x811715 KfAxUbAyUbSstxUbSstyUbWUb 99.61 rel_ub_b99p6 0.00 99.61 FORMAT "%5.2"
 /begin AXIS_DESCR STD_AXIS vfzg vfzg_ub_q1p25 6 0.00 318.8 FORMAT "%5.1" DEPOSIT ABSOLUTE /end AXIS_DESCR
 /begin AXIS_DESCR STD_AXIS tmot temp_ub_q0p75_o48 8 -48.00 143.3 FORMAT "%5.1" DEPOSIT ABSOLUTE /end AXIS_DESCR
/end CHARACTERISTIC
/begin CHARACTERISTIC KFMIZUFIL "Zulässiges indiziertes Moment zur Momentenbegrenzung vor Filter" MAP 0x811AB6 GkfWUb 99.61 rel_ub_b99p6 0.00 99.61 FORMAT "%5.2"
 /begin AXIS_DESCR COM_AXIS wped relPED_ub_b100 8 0.00 100.0 AXIS_PTS_REF SWP08OPUB /end AXIS_DESCR
 /begin AXIS_DESCR COM_AXIS nmot nmot_ub_q40 8 0.00 10200. AXIS_PTS_REF SNM08OPUB /end AXIS_DESCR
/end CHARACTERISTIC
/begin CHARACTERISTIC KFMIZUNS "Zulässiges Moment bei Nachstartaufweitung" MAP 0x811AF6 GkfWUb 99.61 rel_ub_b99p6 0.00 99.61 FORMAT "%5.2"
 /begin AXIS_DESCR COM_AXIS wped relPED_ub_b100 8 0.00 100.0 AXIS_PTS_REF SWP08OPUB /end AXIS_DESCR
 /begin AXIS_DESCR COM_AXIS nmot nmot_ub_q40 8 0.00 10200. AXIS_PTS_REF SNM08OPUB /end AXIS_DESCR
/end CHARACTERISTIC
/begin CHARACTERISTIC KFMIZUOF "Zulässiges indiziertes Moment zur Momentenbegrenzung" MAP 0x811B36 GkfWUb 99.61 rel_ub_b99p6 0.00 99.61 FORMAT "%5.2"
 /begin AXIS_DESCR COM_AXIS mizuvfil rel_ub_b99p6 8 0.00 99.61 AXIS_PTS_REF SMO08OPUB /end AXIS_DESCR
 /begin AXIS_DESCR COM_AXIS nmot nmot_ub_q40 8 0.00 10200. AXIS_PTS_REF SNM08OPUB /end AXIS_DESCR
/end CHARACTERISTIC
/begin CHARACTERISTIC KFNWKHE "Kennfeld für Nockenwellenspreizung bei Katheizen (Einlaß)" MAP 0x8281DC GkfWSw 511.9922 kw_sw_q0p0078 -256.0000 255.9922 FORMAT "%8.4"
 /begin AXIS_DESCR COM_AXIS nmot_w nmot_uw_q0p25 16 0.00 16383.75 AXIS_PTS_REF SNM16NEUW /end AXIS_DESCR
 /begin AXIS_DESCR COM_AXIS rlnw_w rel_uw_q0p0234 8 0.00 1535.977 AXIS_PTS_REF SRL08NEUW /end AXIS_DESCR
/end CHARACTERISTIC
/begin CHARACTERISTIC KFNWKHLLE "Kennfeld für Nockenwellenspreizung bei Katheizen und B_ll (Einlaß)" MAP 0x8282DC GkfWSw 511.9922 kw_sw_q0p0078 -256.0000 255.9922 FORMAT "%8.4"
 /begin AXIS_DESCR COM_AXIS nmot_w nmot_uw_q0p25 5 0.00 16383.75 AXIS_PTS_REF SNM05NEUW /end AXIS_DESCR
 /begin AXIS_DESCR COM_AXIS rlnw_w rel_uw_q0p0234 5 0.00 1535.977 AXIS_PTS_REF SRL05NEUW /end AXIS_DESCR
/end CHARACTERISTIC
/begin CHARACTERISTIC KFNWKRE "Sollwinkel Nockenwelle  bei klopfender Verbrennung Einlaß" MAP 0x82830E GkfWSw 511.9922 kw_sw_q0p0078 -256.0000 255.9922 FORMAT "%8.4"
 /begin AXIS_DESCR COM_AXIS nmot_w nmot_uw_q0p25 16 0.00 16383.75 AXIS_PTS_REF SNM16NEUW /end AXIS_DESCR
 /begin AXIS_DESCR COM_AXIS rlnw_w rel_uw_q0p0234 8 0.00 1535.977 AXIS_PTS_REF SRL08NEUW /end AXIS_DESCR
/end CHARACTERISTIC
/begin CHARACTERISTIC KFNWLLE "Kennfeld für Nockenwellenspreizung im Leerlauf (Einlaß)" MAP 0x82840E GkfWSw 511.9922 kw_sw_q0p0078 -256.0000 255.9922 FORMAT "%8.4"
 /begin AXIS_DESCR COM_AXIS nmot_w nmot_uw_q0p25 5 0.00 16383.75 AXIS_PTS_REF SNM05NEUW /end AXIS_DESCR
 /begin AXIS_DESCR COM_AXIS rlnw_w rel_uw_q0p0234 5 0.00 1535.977 AXIS_PTS_REF SRL05NEUW /end AXIS_DESCR
/end CHARACTERISTIC
/begin CHARACTERISTIC KFNWSE "Kennfeld für Nockenwellenspreizung (Einlaß)" MAP 0x828440 GkfWSw 511.9922 kw_sw_q0p0078 -256.0000 255.9922 FORMAT "%8.4"
 /begin AXIS_DESCR COM_AXIS nmot_w nmot_uw_q0p25 16 0.00 16383.75 AXIS_PTS_REF SNM16NEUW /end AXIS_DESCR
 /begin AXIS_DESCR COM_AXIS rlnw_w rel_uw_q0p0234 8 0.00 1535.977 AXIS_PTS_REF SRL08NEUW /end AXIS_DESCR
/end CHARACTERISTIC
/begin CHARACTERISTIC KFNWTME "Faktor Übergang von Kalt- auf Warm-Kennfelder bei Nockenwellensollwinkeln Einlaß" MAP 0x81A5CB KfAxUbAyUbSstxUbSstyUbWUb 1.992 fak_ub_b2 0.00 1.992 FORMAT "%5.3"
 /begin AXIS_DESCR STD_AXIS tmot temp_ub_q0p75_o48 4 -48.00 143.3 FORMAT "%5.1" DEPOSIT ABSOLUTE /end AXIS_DESCR
 /begin AXIS_DESCR STD_AXIS tmst temp_ub_q0p75_o48 4 -48.00 143.3 FORMAT "%5.1" DEPOSIT ABSOLUTE /end AXIS_DESCR
/end CHARACTERISTIC
/begin CHARACTERISTIC KFNWWLE "Kennfeld für Nockenwellenspreizung im Warmlauf (Einlaß)" MAP 0x828540 GkfWSw 511.9922 kw_sw_q0p0078 -256.0000 255.9922 FORMAT "%8.4"
 /begin AXIS_DESCR COM_AXIS nmot_w nmot_uw_q0p25 16 0.00 16383.75 AXIS_PTS_REF SNM16NEUW /end AXIS_DESCR
 /begin AXIS_DESCR COM_AXIS rlnw_w rel_uw_q0p0234 8 0.00 1535.977 AXIS_PTS_REF SRL08NEUW /end AXIS_DESCR
/end CHARACTERISTIC
/begin CHARACTERISTIC KFNWWLLE "Kennfeld für Nockenwellenspreizung im Warmlauf bei B_ll (Einlaß)" MAP 0x828640 GkfWSw 511.9922 kw_sw_q0p0078 -256.0000 255.9922 FORMAT "%8.4"
 /begin AXIS_DESCR COM_AXIS nmot_w nmot_uw_q0p25 5 0.00 16383.75 AXIS_PTS_REF SNM05NEUW /end AXIS_DESCR
 /begin AXIS_DESCR COM_AXIS rlnw_w rel_uw_q0p0234 5 0.00 1535.977 AXIS_PTS_REF SRL05NEUW /end AXIS_DESCR
/end CHARACTERISTIC
/begin CHARACTERISTIC KFNWWUE "Kennfeld Basiswinkel für Nockenwellenverstellung (Einlaß)" MAP 0x8280E6 KfAxUwAyUwSstxUwSstyUwWSw 511.9922 kw_sw_q0p0078 -256.0000 255.9922 FORMAT "%8.4"
 /begin AXIS_DESCR STD_AXIS nmot_w nmot_uw_q0p25 12 0.00 16383.75 FORMAT "%8.2" DEPOSIT ABSOLUTE /end AXIS_DESCR
 /begin AXIS_DESCR STD_AXIS rlnw_w rel_uw_q0p0234 8 0.00 1535.977 FORMAT "%8.3" DEPOSIT ABSOLUTE /end AXIS_DESCR
/end CHARACTERISTIC
/begin CHARACTERISTIC KFWNWSAPE "Kennfeld für Nockenwellenspreizung während Applikationsphase Einlass" MAP 0x828672 KfAxUwAyUwSstxUwSstyUwWSw 511.9922 kw_sw_q0p0078 -256.0000 255.9922 FORMAT "%8.4"
 /begin AXIS_DESCR STD_AXIS nmot_w nmot_uw_q0p25 12 0.00 16383.75 FORMAT "%8.2" DEPOSIT ABSOLUTE /end AXIS_DESCR
 /begin AXIS_DESCR STD_AXIS rk_w rel_uw_b3072 8 0.00 3071.953 FORMAT "%8.3" DEPOSIT ABSOLUTE /end AXIS_DESCR
/end CHARACTERISTIC
/begin CHARACTERISTIC KINMXNL "Verstärkung Integralanteil der NMAX-Regelung bei stromloser Drosselklappe" VALUE 0x811AA0 KwUb 5.080 relnmot_q0p02 0.02000 5.100 FORMAT "%5.3" /end CHARACTERISTIC
/begin CHARACTERISTIC KINMXRLG "Verstärkung Integralanteil der NMAX-Regelung im Normalbetrieb" MAP 0x81A130 GkfWUb 5.100 relnmot_q0p02 0.00 5.100 FORMAT "%5.3"
 /begin AXIS_DESCR COM_AXIS rl rel_ub_q0p75 8 0.00 191.3 AXIS_PTS_REF SRL08NXUB /end AXIS_DESCR
 /begin AXIS_DESCR COM_AXIS gangi dez 8 0.00 255.0 AXIS_PTS_REF SGA08MDUB /end AXIS_DESCR
/end CHARACTERISTIC
/begin CHARACTERISTIC KLDMMX "Maximal zulässige Momentenreserven" CURVE 0x811B76 KlAUbSstUbWUb 99.61 rel_ub_b99p6 0.00 99.61 FORMAT "%5.2"
 /begin AXIS_DESCR STD_AXIS nmot nmot_ub_q40 8 0.00 10200. FORMAT "%5.0" DEPOSIT ABSOLUTE /end AXIS_DESCR
/end CHARACTERISTIC
/begin CHARACTERISTIC KLDTPH "Festwertkennlinie eines Gewichtungsfaktors für die Dynamikbewertung" CURVE 0x810B62 FklWUb 0.9961 fak_q0p0039 0.00 0.9961
 /begin AXIS_DESCR FIX_AXIS dtsegph_w t5usxus_q5 16 -40960.00 40955.00 FORMAT "%8.2" FIX_AXIS_PAR -8192 10 16 /end AXIS_DESCR
/end CHARACTERISTIC
/begin CHARACTERISTIC KLDTPHST "Festwertkennlinie eines Gewichtungsfaktors für Motorstart" CURVE 0x810B72 FklWUb 0.9961 fak_q0p0039 0.00 0.9961
 /begin AXIS_DESCR FIX_AXIS dtsegph_w t5usxus_q5 16 -40960.00 40955.00 FORMAT "%8.2" FIX_AXIS_PAR -8192 10 16 /end AXIS_DESCR
/end CHARACTERISTIC
/begin CHARACTERISTIC KLDYNCOR "Wert für Dynamikkorrektur nach der ersten Zündung" CURVE 0x81C220 KlAUbSstUbWUw 60000.00 t5usxus_q5 0.00 60000.00 FORMAT "%8.2"
 /begin AXIS_DESCR STD_AXIS tmot temp_ub_q0p75_o48 4 -48.00 143.3 FORMAT "%5.1" DEPOSIT ABSOLUTE /end AXIS_DESCR
/end CHARACTERISTIC
/begin CHARACTERISTIC KLFMKNM "Korrekturfaktor bei Kompressormoment über CAN" CURVE 0x8271F4 KlAUwSstUwWUw 6.999878 fak_uw_b8 1.000000 7.999878 FORMAT "%8.6"
 /begin AXIS_DESCR STD_AXIS nmot nmot_ub_q40 4 0.00 2621400. FORMAT "%8.0" DEPOSIT ABSOLUTE /end AXIS_DESCR
/end CHARACTERISTIC
/begin CHARACTERISTIC KLFNWA "Wichtung Nockenwelle Auslaß" CURVE 0x812167 KlAUbSstUbWUb 0.9961 fak_ub_b1 0.00 0.9961 /begin AXIS_DESCR STD_AXIS fnwua fak_ub_b1 6 0.00 0.9961 DEPOSIT ABSOLUTE /end AXIS_DESCR /end CHARACTERISTIC
/begin CHARACTERISTIC KLMDLFTV "Kennlinie Lüftermoment bei Elektrolüfter" CURVE 0x811808 KlAUbSstUbWUb 24.91 rel_q0p0977 0.00 24.91 FORMAT "%5.2"
 /begin AXIS_DESCR STD_AXIS tvlues1 tv_ub_b100 4 0.00 99.61 FORMAT "%5.2" DEPOSIT ABSOLUTE /end AXIS_DESCR
/end CHARACTERISTIC
/begin CHARACTERISTIC KLNLPHN "Korrektur des Sensor-Phasengangs" CURVE 0x810B82 FklWSb 15.94 kw_q0p0625 -8.000 7.938 FORMAT "%5.3"
 /begin AXIS_DESCR FIX_AXIS nmot nmot_ub_q40 16 0.00 5080. FORMAT "%5.0" FIX_AXIS_PAR 0 3 16 /end AXIS_DESCR
/end CHARACTERISTIC
/begin CHARACTERISTIC KLTNMXPR "Zeit für Drehzahlprädiktion der NMAX-Regelung" CURVE 0x81A170 GklWUb 5.080 relnmot_q0p02 0.02000 5.100 FORMAT "%5.3" /begin AXIS_DESCR COM_AXIS gangi dez 8 0.00 255.0 AXIS_PTS_REF SGA08MDUB /end AXIS_DESCR /end CHARACTERISTIC
/begin CHARACTERISTIC KLTNRDE "Kennlinie für Rückdrehzahnzeiten" CURVE 0x81846A KlAUbSstUbWUb 255.0 t1msxms_q1 0.00 255.0 FORMAT "%5.1"
 /begin AXIS_DESCR STD_AXIS tmot temp_ub_q0p75_o48 3 -48.00 143.3 FORMAT "%5.1" DEPOSIT ABSOLUTE /end AXIS_DESCR
/end CHARACTERISTIC
/begin CHARACTERISTIC KLWNWI "Festwertkennlinie eines Gewichtungsfaktors für den Winkelfehler" CURVE 0x810B92 FklWUb 0.9961 fak_q0p0039 0.00 0.9961
 /begin AXIS_DESCR FIX_AXIS wnwix_w kw_sw_b128 16 -127.9961 128.0000 FORMAT "%8.4" FIX_AXIS_PAR -32767 12 16 /end AXIS_DESCR
/end CHARACTERISTIC
/begin CHARACTERISTIC KMITIBGR "Steigungsfaktor für das Aufintegrieren von dtimx_w zur Momentenbeggrenzung" VALUE 0x818EBF KwUb 91.20 rkti_k_sy 0.00 91.20 FORMAT "%5.2" /end CHARACTERISTIC
/begin CHARACTERISTIC KNLSYN "Sicherheitsfaktor für Notlauf-Synchronisationsbedingung" VALUE 0x810BA2 KwUb 7.969 fak_ub_b8 0.00 7.969 FORMAT "%5.3" /end CHARACTERISTIC
/begin CHARACTERISTIC KRKTE "Umrechnung relative Kraftstoffmasse rk in effektive Einspritzzeit te" VALUE 0x81D988 KwUw 7.281667 rkti11_sy 0.00 7.281667 FORMAT "%8.6" /end CHARACTERISTIC
/begin CHARACTERISTIC LWSER "Lenkhilfelastmoment bei fehlerhaftem Lenkwinkelsensor" VALUE 0x81A063 KwUb 49.80 rel_q0p1953 0.00 49.80 FORMAT "%5.2" /end CHARACTERISTIC
/begin CHARACTERISTIC MDATNM "Drehmomentaufnahme AT-Getriebe in Fahrstufe N/P" CURVE 0x827012 GklWSw 99.99695 rel_sw_b100 0.00 99.99695 FORMAT "%8.5"
 /begin AXIS_DESCR COM_AXIS twnd temp_ub_q0p75_o48 8 -48.00 143.3 AXIS_PTS_REF STW08MDUB /end AXIS_DESCR
/end CHARACTERISTIC
/begin CHARACTERISTIC MDATRM "Drehmomentanteil (Pumpenanteil) AT-Getriebe in Fahrstufe R" CURVE 0x827022 GklWSw 99.99695 rel_sw_b100 0.00 99.99695 FORMAT "%8.5"
 /begin AXIS_DESCR COM_AXIS twnd temp_ub_q0p75_o48 8 -48.00 143.3 AXIS_PTS_REF STW08MDUB /end AXIS_DESCR
/end CHARACTERISTIC
/begin CHARACTERISTIC MDIMX "Maximales indiziertes Motormoment" VALUE 0x811AA1 KwUb 99.61 rel_ub_b99p6 0.00 99.61 FORMAT "%5.2" /end CHARACTERISTIC
/begin CHARACTERISTIC MDSH "Höhenabhängiger Anteil des Schleppmomentes" CURVE 0x827BA0 KlAUbSstUbWSb 49.90 rel_q0p1957 -25.05 24.85 FORMAT "%5.2"
 /begin AXIS_DESCR STD_AXIS fho fak_ub_b4 6 0.00 3.984 FORMAT "%5.3" DEPOSIT ABSOLUTE /end AXIS_DESCR
/end CHARACTERISTIC
/begin CHARACTERISTIC MDSL "Momentenanforderung der Servolenkung" VALUE 0x81A064 KwUb 49.80 rel_q0p1953 0.00 49.80 FORMAT "%5.2" /end CHARACTERISTIC
/begin CHARACTERISTIC MDSLP "Moment zur Kompensation der Sekundärluftpumpe (stat.)" VALUE 0x81A065 KwUb 99.61 rel_ub_b100 0.00 99.61 FORMAT "%5.2" /end CHARACTERISTIC
/begin CHARACTERISTIC MDSLPE "Moment zur Kompensation der Sekundärluftpumpe (Einschalten)" VALUE 0x81A066 KwSb 99.60 rel_sb_q0p39 -50.00 49.61 FORMAT "%5.2" /end CHARACTERISTIC
/begin CHARACTERISTIC MDSM "Schleppmoment Temperaturanteil" CURVE 0x827BAE GklWUw 99.99847 rel_uw_b100 0.00 99.99847 FORMAT "%8.5"
 /begin AXIS_DESCR COM_AXIS tmot temp_ub_q0p75_o48 10 -48.00 143.3 AXIS_PTS_REF STM10__UB /end AXIS_DESCR
/end CHARACTERISTIC
/begin CHARACTERISTIC MDVGLW "Momentenbedarf der Vorgelegewelle" CURVE 0x827BC2 KlAUbSstUbWUw 99.99847 rel_uw_b100 0.00 99.99847 FORMAT "%8.5"
 /begin AXIS_DESCR STD_AXIS tmot temp_ub_q0p75_o48 6 -48.00 143.3 FORMAT "%5.1" DEPOSIT ABSOLUTE /end AXIS_DESCR
/end CHARACTERISTIC
/begin CHARACTERISTIC MDWANER "Ersatzwert für mdwan_w bei Fehler" VALUE 0x811755 KwUb 99.61 rel_ub_b99p6 0.00 99.61 FORMAT "%5.2" /end CHARACTERISTIC
/begin CHARACTERISTIC MDWANK "minimales Wandlermoment für Sperrung des Velustmomentfilters beim Kriechen (CVT)" VALUE 0x827BD6 KwUw 99.99847 rel_uw_b100 0.00 99.99847 FORMAT "%8.5" /end CHARACTERISTIC
/begin CHARACTERISTIC MKLLS "Momentaufnahme Klimakompressorlüfter" CURVE 0x827206 KlAUwSstUwWUw 99.99847 rel_uw_b100 0.00 99.99847 FORMAT "%8.5"
 /begin AXIS_DESCR STD_AXIS mkllsc rel_q0p39 6 0.00 25599.61 FORMAT "%8.2" DEPOSIT ABSOLUTE /end AXIS_DESCR
/end CHARACTERISTIC
/begin CHARACTERISTIC MLSLMX "max. Motor-Luftmasse für Sekundärlufteinblasung" VALUE 0x81AEF2 KwUw 6553.500 m_q0p1 0.00 6553.500 FORMAT "%8.3" /end CHARACTERISTIC
/begin CHARACTERISTIC MSLUB "Sekundärluftmasse abhängig von der Batteriespannung" CURVE 0x81AEF4 KlAUwSstUwWUw 102.3984 m_uw_b102p4 0.00 102.3984 FORMAT "%8.4"
 /begin AXIS_DESCR STD_AXIS ubsqf_w spg_q0p00039 8 0.00 25.59961 FORMAT "%8.5" DEPOSIT ABSOLUTE /end AXIS_DESCR
/end CHARACTERISTIC
/begin CHARACTERISTIC MXNLFEHL "Maximale Anzahl von Fehlern der Synchronisationsüberwachung bei hoher Dynamik" VALUE 0x810BA3 KwUb 8.000 dez 0.00 8.000 FORMAT "%5.3" /end CHARACTERISTIC
/begin CHARACTERISTIC NFANWS "Drehzahlschwelle für Funktionsanforderung NWS" VALUE 0x81A5C0 KwUb 10200. nmot_ub_q40 0.00 10200. FORMAT "%5.0" /end CHARACTERISTIC
/begin CHARACTERISTIC NMAX "Drehzahlbegrenzung" VALUE 0x816D54 KwUw 16383.75 nmot_uw_q0p25 0.00 16383.75 FORMAT "%8.2" /end CHARACTERISTIC
/begin CHARACTERISTIC NMAXDV "Drehzahlbegrenzung bei Fehlererkennung Geschwindigkeitssignal" VALUE 0x816D56 KwUw 10200.00 nmot_uw_q0p25 0.00 10200.00 FORMAT "%8.2" /end CHARACTERISTIC
/begin CHARACTERISTIC NMAXDVG "Drehzahlgrenze für Automatik-Getriebe bei Fehler Geschwindigkeitssignal" CURVE 0x827BF2 GklWUw 16383.75 nmot_uw_q0p25 0.00 16383.75 FORMAT "%8.2" /begin AXIS_DESCR COM_AXIS gangi dez 8 0.00 255.0 AXIS_PTS_REF SGA08MDUB /end AXIS_DESCR /end CHARACTERISTIC
/begin CHARACTERISTIC NMAXDZ "Drehzahlgrenze bei doppelter Zündausgabe" VALUE 0x816D58 KwUw 16383.75 nmot_uw_q0p25 0.00 16383.75 FORMAT "%8.2" /end CHARACTERISTIC
/begin CHARACTERISTIC NMAXGA "Maximal zulässige Motordrehzahl (stationär)" CURVE 0x827C02 GklWUw 16383.75 nmot_uw_q0p25 0.00 16383.75 FORMAT "%8.2" /begin AXIS_DESCR COM_AXIS gangi dez 8 0.00 255.0 AXIS_PTS_REF SGA08MDUB /end AXIS_DESCR /end CHARACTERISTIC
/begin CHARACTERISTIC NMAXNL "Drehzahlgrenze bei Drehzahlgeber-Notlauf" VALUE 0x816D5A KwUw 16383.75 nmot_uw_q0p25 0.00 16383.75 FORMAT "%8.2" /end CHARACTERISTIC
/begin CHARACTERISTIC NMAXOG "erhöhte Drehzahlgrenze" VALUE 0x816D5C KwUw 16383.75 nmot_uw_q0p25 0.00 16383.75 FORMAT "%8.2" /end CHARACTERISTIC
/begin CHARACTERISTIC NMKFNWLLE "Drehzahlschwelle zur Aktivierung LL-Sollwinkelkennfelder bei Einlaßnockenwelle" VALUE 0x817808 KwUw 16383.75 nmot_uw_q0p25 0.00 16383.75 FORMAT "%8.2" /end CHARACTERISTIC
/begin CHARACTERISTIC NMOTRDE "Drehzahlschwelle zur Freigabe der Funktion RDE" VALUE 0x810B40 KwUb 2550. nmot_ub_q10 0.00 2550. FORMAT "%5.0" /end CHARACTERISTIC
/begin CHARACTERISTIC NMXDAEF "Maximaldrehzahl bei Drosselklappen-Antrieb-Ersatzbetrieb" CURVE 0x811AA2 KlAUbSstUbWUb 10200. nmot_ub_q40 0.00 10200. FORMAT "%5.0"
 /begin AXIS_DESCR STD_AXIS wped relPED_ub_b100 6 0.00 100.0 FORMAT "%5.1" DEPOSIT ABSOLUTE /end AXIS_DESCR
/end CHARACTERISTIC
/begin CHARACTERISTIC NMXDKPU "Maximaldrehzahl bei Sicherheitskraftstoffabschaltung (SKA)" VALUE 0x816D5E KwUw 16383.75 nmot_uw_q0p25 0.00 16383.75 FORMAT "%8.2" /end CHARACTERISTIC
/begin CHARACTERISTIC NMXPNL "Verstärkung Proportionalanteil der NMAX-Regelung bei stromloser Drosselklappe" VALUE 0x81A178 KwUb 0.9961 relnmot_q0p0039 0.00 0.9961 /end CHARACTERISTIC
/begin CHARACTERISTIC NMXPRLG "Verstärkung Proportionalanteil der NMAX-Regelung im Normalbetrieb" MAP 0x81A179 GkfWUb 0.9961 relnmot_q0p0039 0.00 0.9961
 /begin AXIS_DESCR COM_AXIS rl rel_ub_q0p75 8 0.00 191.3 AXIS_PTS_REF SRL08NXUB /end AXIS_DESCR
 /begin AXIS_DESCR COM_AXIS gangi dez 8 0.00 255.0 AXIS_PTS_REF SGA08MDUB /end AXIS_DESCR
/end CHARACTERISTIC
/begin CHARACTERISTIC NPHERKMN "minimale Motordrehzahl für Phasensuche" VALUE 0x810B4C KwUb 10200. nmot_ub_q40 0.00 10200. FORMAT "%5.0" /end CHARACTERISTIC
/begin CHARACTERISTIC NPHERKMX "maximale Motordrehzahl für Phasensuche" VALUE 0x810B4D KwUb 10200. nmot_ub_q40 0.00 10200. FORMAT "%5.0" /end CHARACTERISTIC
/begin CHARACTERISTIC NPHINVMN "minimale Motordrehzahl für Initialisierung" VALUE 0x810B4E KwUb 10200. nmot_ub_q40 0.00 10200. FORMAT "%5.0" /end CHARACTERISTIC
/begin CHARACTERISTIC NPHINVMX "maximale Motordrehzahl für Initialisierung" VALUE 0x810B4F KwUb 10200. nmot_ub_q40 0.00 10200. FORMAT "%5.0" /end CHARACTERISTIC
/begin CHARACTERISTIC NSTART "Motordrehzahlschwelle für Unterdrehzahl-Ausstieg bei Nachstartaufweitung" VALUE 0x811B87 KwUb 10200. nmot_ub_q40 0.00 10200. FORMAT "%5.0" /end CHARACTERISTIC
/begin CHARACTERISTIC NSTEND "Motordrehzahlschwelle für Start Ende bei Nachstartaufweitung" VALUE 0x811B88 KwUb 10200. nmot_ub_q40 0.00 10200. FORMAT "%5.0" /end CHARACTERISTIC
/begin CHARACTERISTIC NSWO1 "Drehzahlschwelle 1 Umschaltg. zur Rechenzeitersparnis" VALUE 0x8181C3 KwUb 10200. nmot_ub_q40 0.00 10200. FORMAT "%5.0" /end CHARACTERISTIC
/begin CHARACTERISTIC NSWO2 "Drehzahlschwelle 2 Umschaltg. zur Rechenzeitersparnis" VALUE 0x8181C4 KwUb 10200. nmot_ub_q40 0.00 10200. FORMAT "%5.0" /end CHARACTERISTIC
/begin CHARACTERISTIC PSAPES "Saugrohrdruck für Applikation Einspritzung" VALUE 0x81D98A KwUw 2559.961 p_uw_q0p039 0.00 2559.961 FORMAT "%8.3" /end CHARACTERISTIC
/begin CHARACTERISTIC PVMITIBGR "P-Verstärkungsfaktor für Momentenbegrenzung bei Dauerstricheinspritzung" VALUE 0x818EC0 KwUb 9.120 rkti_p_sy 0.00 9.120 FORMAT "%5.3" /end CHARACTERISTIC
/begin CHARACTERISTIC RDUNDEF "Winkelbereich in dem keine Plausibilisierung des Rückdrehverdachts möglich ist" VALUE 0x810B41 KwUb 1530. kw_q6 0.00 1530. FORMAT "%5.0" /end CHARACTERISTIC
/begin CHARACTERISTIC RESETMAX "Schalter zum Resetieren von perfmax_w" VALUE 0x81A1EB KwUb 1.000 dez 0.00 1.000 FORMAT "%5.3" /end CHARACTERISTIC
/begin CHARACTERISTIC RLPHERKMN "minimale Last für Phasensuche" VALUE 0x810B50 KwUb 191.3 rel_ub_q0p75 0.00 191.3 FORMAT "%5.1" /end CHARACTERISTIC
/begin CHARACTERISTIC RLPHERKMX "maximale Last für Phasensuche" VALUE 0x810B51 KwUb 191.3 rel_ub_q0p75 0.00 191.3 FORMAT "%5.1" /end CHARACTERISTIC
/begin AXIS_PTS SGA08MDUB "Stützstellenverteilung Ist Gang 8 Sst." 0x81005F gangi SstAUbSstUb 255.0 dez 8 0.00 255.0 FORMAT "%5.1" DEPOSIT ABSOLUTE /end AXIS_PTS
/begin CHARACTERISTIC SGIDB8 "Baugruppe Hardware" ASCII 0x81A1E4 KtxC 255.0 defaultAscii 0.00 255.0 NUMBER 3 /end CHARACTERISTIC
/begin CHARACTERISTIC SGIDB9 "Sorte Hardware" ASCII 0x81A1E8 KtxC 255.0 defaultAscii 0.00 255.0 NUMBER 2 /end CHARACTERISTIC
/begin AXIS_PTS SMO08OPUB "Stützstellenverteilung für zulässiges Moment mizuvfil" 0x811B89 mizuvfil SstAUbSstUb 99.61 rel_ub_b99p6 8 0.00 99.61 FORMAT "%5.2" DEPOSIT ABSOLUTE /end AXIS_PTS
/begin AXIS_PTS SNM05NEUW "Drehzahlstützstellen Nockenwellensollwinkel Einlaß" 0x813424 nmot_w SstAUwSstUw 16383.75 nmot_uw_q0p25 5 0.00 16383.75 FORMAT "%8.2" DEPOSIT ABSOLUTE /end AXIS_PTS
/begin AXIS_PTS SNM05NWUB "Drehzahlstützstellen Nockenwellensollwinkel" 0x8181EE nmot SstAUbSstUb 10200. nmot_ub_q40 5 0.00 10200. FORMAT "%5.0" DEPOSIT ABSOLUTE /end AXIS_PTS
/begin AXIS_PTS SNM06KOUB "Verteilung für Klimakompressorkennlinien" 0x81A067 nmot SstAUbSstUb 10200. nmot_ub_q40 6 0.00 10200. FORMAT "%5.0" DEPOSIT ABSOLUTE /end AXIS_PTS
/begin AXIS_PTS SNM08OPUB "Stützstellenverteilung für Motordrehzahl nmot" 0x81008D nmot SstAUbSstUb 10200. nmot_ub_q40 8 0.00 10200. FORMAT "%5.0" DEPOSIT ABSOLUTE /end AXIS_PTS
/begin AXIS_PTS SNM16NEUW "Drehzahlstützstellen Nockenwellensollwinkel Einlaß" 0x81349C nmot_w SstAUwSstUw 16383.75 nmot_uw_q0p25 16 0.00 16383.75 FORMAT "%8.2" DEPOSIT ABSOLUTE /end AXIS_PTS
/begin AXIS_PTS SNM16OPUW "Stützstellenverteilung Drehzahl" 0x8134BE nmot_w SstAUwSstUw 16383.75 nmot_uw_q0p25 16 0.00 16383.75 FORMAT "%8.2" DEPOSIT ABSOLUTE /end AXIS_PTS
/begin AXIS_PTS SRL05NEUW "Laststützstellen Nockenwellensollwinkel Einlaß" 0x813502 rlnw_w SstAUwSstUw 1535.977 rel_uw_q0p0234 5 0.00 1535.977 FORMAT "%8.3" DEPOSIT ABSOLUTE /end AXIS_PTS
/begin AXIS_PTS SRL06KOUB "Stützstellenverteilung Kompressormoment" 0x81A06E rl SstAUbSstUb 191.3 rel_ub_q0p75 6 0.00 191.3 FORMAT "%5.1" DEPOSIT ABSOLUTE /end AXIS_PTS
/begin AXIS_PTS SRL08NEUW "Laststützstellen Nockenwellensollwinkel Einlaß" 0x813520 rlnw_w SstAUwSstUw 1535.977 rel_uw_q0p0234 8 0.00 1535.977 FORMAT "%8.3" DEPOSIT ABSOLUTE /end AXIS_PTS
/begin AXIS_PTS SRL08NXUB "Stützstellenverteilung relative Luftfüllung 8 Sst." 0x81827A rl SstAUbSstUb 191.3 rel_ub_q0p75 8 0.00 191.3 FORMAT "%5.1" DEPOSIT ABSOLUTE /end AXIS_PTS
/begin AXIS_PTS SRL11OPUW "Stützstellenverteilung relative Luftfüllung" 0x816D30 rl_w SstAUwSstUw 1535.977 rel_uw_q0p0234 11 0.00 1535.977 FORMAT "%8.3" DEPOSIT ABSOLUTE /end AXIS_PTS
/begin AXIS_PTS STA06LLUB "Temperatur: Ansaugluft bzw. PWM-Signal von AC/Kompressor" 0x81A075 tlok SstAUbSstUb 191.3 temp_ub_q0p75_o48 6 -48.00 143.3 FORMAT "%5.1" DEPOSIT ABSOLUTE /end AXIS_PTS
/begin AXIS_PTS STM10__UB "" 0x8182CC tmot SstAUbSstUb 191.3 temp_ub_q0p75_o48 10 -48.00 143.3 FORMAT "%5.1" DEPOSIT ABSOLUTE /end AXIS_PTS
/begin AXIS_PTS STW08MDUB "Stützstellenverteilung  Temperatur des Drehmomentenwandlers" 0x819FA1 twnd SstAUbSstUb 191.3 temp_ub_q0p75_o48 8 -48.00 143.3 FORMAT "%5.1" DEPOSIT ABSOLUTE /end AXIS_PTS
/begin AXIS_PTS SWP08OPUB "Stützstellenverteilung für Pedalstellung wped" 0x810152 wped SstAUbSstUb 100.0 relPED_ub_b100 8 0.00 100.0 FORMAT "%5.1" DEPOSIT ABSOLUTE /end AXIS_PTS
/begin CHARACTERISTIC TANSMN "Ansauglufttemperaturschwelle zur Nachstartaufweitung" VALUE 0x811B92 KwUb 191.3 temp_ub_q0p75_o48 -48.00 143.3 FORMAT "%5.1" /end CHARACTERISTIC
/begin CHARACTERISTIC TASLSO "obere Ansauglufttemperaturschwelle für Sekundärluftsystem" VALUE 0x81834F KwUb 191.3 temp_ub_q0p75_o48 -48.00 143.3 FORMAT "%5.1" /end CHARACTERISTIC
/begin CHARACTERISTIC TASLSU "untere Ansauglufttemperaturschwelle für Sekundärluftsystem" VALUE 0x818350 KwUb 191.3 temp_ub_q0p75_o48 -48.00 143.3 FORMAT "%5.1" /end CHARACTERISTIC
/begin CHARACTERISTIC TDDSLA "Dauer Sekundärlufteinblasung für Adaptionsphase" VALUE 0x818351 KwUb 25.50 t100msxs_ub_b25p5 0.00 25.50 FORMAT "%5.2" /end CHARACTERISTIC
/begin CHARACTERISTIC TDMKOW "Entprellzeit nach Momentenreserve: Klimakompressor" VALUE 0x827220 KwUw 1310.700 t20msxs_uw_q0p02 0.00 1310.700 FORMAT "%8.3" /end CHARACTERISTIC
/begin CHARACTERISTIC TDSLKT "Dauer Kurztest Sekundärluftdiagnose für Massenmessung" VALUE 0x818352 KwUb 25.50 t100msxs_ub_b25p5 0.00 25.50 FORMAT "%5.2" /end CHARACTERISTIC
/begin CHARACTERISTIC TEMIN "minimales TE" VALUE 0x813FC0 KwUw 174.7600 tinjection_sy 0.00 174.7600 FORMAT "%8.4" /end CHARACTERISTIC
/begin CHARACTERISTIC TEMINVA "minimales TE bei VA" VALUE 0x813FC2 KwUw 174.7600 tinjection_sy 0.00 174.7600 FORMAT "%8.4" /end CHARACTERISTIC
/begin CHARACTERISTIC TFASLAMN "Mindestzeit nach Katheizen für Testeranforderung Sekundärluftdiagnose" VALUE 0x81AF16 KwUw 6553.500 t100msxs_uw_b6553p6 0.00 6553.500 FORMAT "%8.3" /end CHARACTERISTIC
/begin CHARACTERISTIC TFMIZU "Filterzeitkonstante zur Filterung des zulässigen Moments" VALUE 0x816D62 KwUw 655.34999985 zk10msxs_uw_b655 0.010000152590 655.36000000 FORMAT "%12.8" /end CHARACTERISTIC
/begin CHARACTERISTIC TLMSSLAB "Entprellzeit für Abbruch Sekundärluftanfettung" VALUE 0x818353 KwUb 25.40 t100msxs_ub_b25p5 0.1000 25.50 FORMAT "%5.2" /end CHARACTERISTIC
/begin CHARACTERISTIC TLMSSLMX "Maximale Zeit für Sekundärluftanfettung im Leerlauf" VALUE 0x818354 KwUb 255.0 t100msxs_ub_b255 0.00 255.0 FORMAT "%5.1" /end CHARACTERISTIC
/begin CHARACTERISTIC TMDMAD "Motortemperaturschwelle für Freigabe der Adaption des Verlustmoments" VALUE 0x819F8F KwUb 191.3 temp_ub_q0p75_o48 -48.00 143.3 FORMAT "%5.1" /end CHARACTERISTIC
/begin CHARACTERISTIC TMFASLMN "Motortemperaturschwelle Testeranforderung Sekundärluftdiagnose" VALUE 0x818355 KwUb 191.3 temp_ub_q0p75_o48 -48.00 143.3 FORMAT "%5.1" /end CHARACTERISTIC
/begin CHARACTERISTIC TMNSMN "Motortemperaturschwelle für die Nachstartaufweitung" VALUE 0x811B93 KwUb 191.3 temp_ub_q0p75_o48 -48.00 143.3 FORMAT "%5.1" /end CHARACTERISTIC
/begin CHARACTERISTIC TMNWLLKHE "Motortemperaturschwelle zur Aktivierung Katheiz KF im Leerlauf Einlaßnockenwelle" VALUE 0x812174 KwUb 191.3 temp_ub_q0p75_o48 -48.00 143.3 FORMAT "%5.1" /end CHARACTERISTIC
/begin CHARACTERISTIC TMOTNMX "Motortemperatur-Schwelle für Aktivierung der erhöhten Drehzahlgrenze" VALUE 0x827C12 KwUb 191.3 temp_ub_q0p75_o48 -48.00 143.3 FORMAT "%5.1" /end CHARACTERISTIC
/begin CHARACTERISTIC TMSSLO "obere Starttemperaturschwelle für Sekundärluft" VALUE 0x818356 KwUb 191.3 temp_ub_q0p75_o48 -48.00 143.3 FORMAT "%5.1" /end CHARACTERISTIC
/begin CHARACTERISTIC TMSSLSTO "obere Temperaturschwelle für Sekundärluft im Start" VALUE 0x818357 KwUb 191.3 temp_ub_q0p75_o48 -48.00 143.3 FORMAT "%5.1" /end CHARACTERISTIC
/begin CHARACTERISTIC TMSSLSTU "untere Temperaturschwelle für Sekundärluft im Start" VALUE 0x818358 KwUb 191.3 temp_ub_q0p75_o48 -48.00 143.3 FORMAT "%5.1" /end CHARACTERISTIC
/begin CHARACTERISTIC TMSSLU "untere Starttemperaturschwelle für Sekundärluft" VALUE 0x818359 KwUb 191.3 temp_ub_q0p75_o48 -48.00 143.3 FORMAT "%5.1" /end CHARACTERISTIC
/begin CHARACTERISTIC TNLPHWAIT "Zeit für Zahnaufweitung bei B_rphsp" VALUE 0x81C22E KwUw 30000.00 t5usxus_q5 0.00 30000.00 FORMAT "%8.2" /end CHARACTERISTIC
/begin CHARACTERISTIC TNLSGMN "Minimale Zeit für SG-Nachlauf" VALUE 0x827CD6 KwUw 6553.300 t100msxs_uw_b6553p6 0.2000000 6553.500 FORMAT "%8.3" /end CHARACTERISTIC
/begin CHARACTERISTIC TNLSGMX "Maximale Zeit für SG-Nachlauf" VALUE 0x827CD8 KwUw 6553.500 t100msxs_uw_b6553p6 0.00 6553.500 FORMAT "%8.3" /end CHARACTERISTIC
/begin CHARACTERISTIC TNLSYNMN "Maximalwert der Phasenperiodendauer für Synchronisationsfreigabe" VALUE 0x813978 KwUw 2615400. t40usxus_q40 6000.000 2621400. FORMAT "%8.0" /end CHARACTERISTIC
/begin CHARACTERISTIC TNLSYNMX "Minimalwert der Phasenperiodendauer für Synchronisationsfreigabe" VALUE 0x81397A KwUw 400000.0 t40usxus_q40 0.00 400000.0 FORMAT "%8.1" /end CHARACTERISTIC
/begin CHARACTERISTIC TNMXH "Maximale Zeitdauer für erhöhte Drehzahlgrenze" VALUE 0x816D60 KwUw 655.3500 t10msxs_uw_b655p35 0.00 655.3500 FORMAT "%8.4" /end CHARACTERISTIC
/begin CHARACTERISTIC TNSC "Nachstartüberwachungszeit" VALUE 0x816D64 KwUw 1310.700 t20msxs_uw_q0p02 0.00 1310.700 FORMAT "%8.3" /end CHARACTERISTIC
/begin CHARACTERISTIC TNSOF "Entprellzeit zur Abschaltung der Nachstartaufweitung" VALUE 0x811B94 KwUb 5.100 t20msxs_ub_b5p1 0.00 5.100 FORMAT "%5.3" /end CHARACTERISTIC
/begin CHARACTERISTIC TNWAPTE "Zeit Einlassnockenwelle in Aktivposition bei Testereingriff" VALUE 0x81A5C1 KwUb 12.75 t50msxs_q0p05 0.00 12.75 FORMAT "%5.2" /end CHARACTERISTIC
/begin CHARACTERISTIC TNWFARE "Zeitkonstante für Sollwinkelaufsteuerung der Einlassnockenwelle durch  Tester" VALUE 0x8281DA KwUw 3276.7499992 zk50msxs_uw_b3276p8 0.050000762951 3276.8000000 FORMAT "%12.7" /end CHARACTERISTIC
/begin CHARACTERISTIC TNWPPTE "Zeit Einlassnockenwelle in Passivposition bei Testereingriff" VALUE 0x81A5C2 KwUb 12.75 t50msxs_q0p05 0.00 12.75 FORMAT "%5.2" /end CHARACTERISTIC
/begin CHARACTERISTIC TNWSABGKE "Zeitkonstante für Sollwertänderungsbegrenzung Einlaßnockenwelle kalt" CURVE 0x81A5E5 GklWUb 12.7498039 zk50msxs_ub_b12p8 0.0501960784 12.8000000 FORMAT "%10.7"
 /begin AXIS_DESCR COM_AXIS nmot nmot_ub_q40 5 0.00 10200. AXIS_PTS_REF SNM05NWUB /end AXIS_DESCR
/end CHARACTERISTIC
/begin CHARACTERISTIC TNWSNABGE "Zeitkonstante für negative Sollwertänderungsbegrenzung Einlaßnockenwelle" CURVE 0x81A5EA GklWUb 12.7498039 zk50msxs_ub_b12p8 0.0501960784 12.8000000 FORMAT "%10.7"
 /begin AXIS_DESCR COM_AXIS nmot nmot_ub_q40 5 0.00 10200. AXIS_PTS_REF SNM05NWUB /end AXIS_DESCR
/end CHARACTERISTIC
/begin CHARACTERISTIC TNWSPABGE "Zeitkonstante für positive Sollwertänderungsbegrenzung Einlaßnockenwelle" CURVE 0x81A5EF GklWUb 12.7498039 zk50msxs_ub_b12p8 0.0501960784 12.8000000 FORMAT "%10.7"
 /begin AXIS_DESCR COM_AXIS nmot nmot_ub_q40 5 0.00 10200. AXIS_PTS_REF SNM05NWUB /end AXIS_DESCR
/end CHARACTERISTIC
/begin CHARACTERISTIC TNWVBGNE "Zeit bis Verstellung der Einlassnockenwelle durch Tester beginnt" VALUE 0x81A5C3 KwUb 12.75 t50msxs_q0p05 0.00 12.75 FORMAT "%5.2" /end CHARACTERISTIC
/begin CHARACTERISTIC TPHERKMN "minimale Motortemperatur für Phasensuche" VALUE 0x810B52 KwUb 191.3 temp_ub_q0p75_o48 -48.00 143.3 FORMAT "%5.1" /end CHARACTERISTIC
/begin CHARACTERISTIC TPHSABSP "Sperrzeit für die Phasensuche, wenn der geeignete Betriebsbereich verl. wurde" VALUE 0x810B53 KwUb 255.0 t1sxs_ub_b255 0.00 255.0 FORMAT "%5.1" /end CHARACTERISTIC
/begin CHARACTERISTIC TPHSSP "Sperrzeit für Phasensuche nach erfolgloser Suche" VALUE 0x810B54 KwUb 255.0 t1sxs_ub_b255 0.00 255.0 FORMAT "%5.1" /end CHARACTERISTIC
/begin CHARACTERISTIC TSLABB "Verweilzeit für Sekundärluft- Abbruchbedingung" VALUE 0x81835A KwUb 25.40 t100msxs_ub_b25p5 0.1000 25.50 FORMAT "%5.2" /end CHARACTERISTIC
/begin CHARACTERISTIC TSLPMN "Mindesteinschaltdauer der Sekundärluftpumpe" VALUE 0x81835B KwUb 25.40 t100msxs_ub_b25p5 0.1000 25.50 FORMAT "%5.2" /end CHARACTERISTIC
/begin CHARACTERISTIC TSLUBST "Entprellzeit für Sekundärluft ein im Start bei UBSLSTMN" VALUE 0x81835C KwUb 25.50 t100msxs_ub_b25p5 0.00 25.50 FORMAT "%5.2" /end CHARACTERISTIC
/begin CHARACTERISTIC TVDSLOFF "Zeitverzögerung Schließen Sekundärluftventil bei Adaption/Kurztrip" VALUE 0x81835D KwUb 25.50 t100msxs_ub_b25p5 0.00 25.50 FORMAT "%5.2" /end CHARACTERISTIC
/begin CHARACTERISTIC TVFSAM "Temperaturabhängige Verzögerungszeit für Fahrstufe AUS" CURVE 0x819FAA GklWUb 5.100 t20msxs_ub_b5p1 0.00 5.100 FORMAT "%5.3"
 /begin AXIS_DESCR COM_AXIS twnd temp_ub_q0p75_o48 8 -48.00 143.3 AXIS_PTS_REF STW08MDUB /end AXIS_DESCR
/end CHARACTERISTIC
/begin CHARACTERISTIC TVFSEM "Temperaturabhängige Verzögerungszeit für Fahrstufe EIN" CURVE 0x819FB2 GklWUb 5.100 t20msxs_ub_b5p1 0.00 5.100 FORMAT "%5.3"
 /begin AXIS_DESCR COM_AXIS twnd temp_ub_q0p75_o48 8 -48.00 143.3 AXIS_PTS_REF STW08MDUB /end AXIS_DESCR
/end CHARACTERISTIC
/begin CHARACTERISTIC TVFSRAM "motortemperaturabhängige Verzögerungszeit für Fahrstufe aus (R)" CURVE 0x819FBA GklWUb 5.100 t20msxs_ub_b5p1 0.00 5.100 FORMAT "%5.3"
 /begin AXIS_DESCR COM_AXIS twnd temp_ub_q0p75_o48 8 -48.00 143.3 AXIS_PTS_REF STW08MDUB /end AXIS_DESCR
/end CHARACTERISTIC
/begin CHARACTERISTIC TVFSREM "motortemperaturabhängige Verzögerungszeit für Fahrstufe ein (R)" CURVE 0x819FC2 GklWUb 5.100 t20msxs_ub_b5p1 0.00 5.100 FORMAT "%5.3"
 /begin AXIS_DESCR COM_AXIS twnd temp_ub_q0p75_o48 8 -48.00 143.3 AXIS_PTS_REF STW08MDUB /end AXIS_DESCR
/end CHARACTERISTIC
/begin CHARACTERISTIC TVFUE "Verzögerungszeit für den Aufbau der Füllung" VALUE 0x811756 KwUb 5.100 t20msxs_ub_b5p1 0.00 5.100 FORMAT "%5.3" /end CHARACTERISTIC
/begin CHARACTERISTIC TVMDCVTK "Verzögerungzeit zur Sperrung des Verlustmomentfilters beim Kriechen (CVT)" VALUE 0x81A12F KwUb 5.100 t20msxs_ub_b5p1 0.00 5.100 FORMAT "%5.3" /end CHARACTERISTIC
/begin CHARACTERISTIC TVSLVOFF "Zeitverzögerung Schließen Sekundärluftventil" VALUE 0x81835E KwUb 25.50 t100msxs_ub_b25p5 0.00 25.50 FORMAT "%5.2" /end CHARACTERISTIC
/begin CHARACTERISTIC TVSLVON "Zeitverzögerung Öffnen Sekundärluftventil" VALUE 0x81835F KwUb 25.40 t100msxs_ub_b25p5 0.1000 25.50 FORMAT "%5.2" /end CHARACTERISTIC
/begin CHARACTERISTIC TVTSPEV "Korrektur der Einspritzzeit in Abhängigkeit von evtmod" CURVE 0x81D98C KlAUwSstUwWUw 174.7600 tinjection_sy 0.00 174.7600 FORMAT "%8.4"
 /begin AXIS_DESCR STD_AXIS evtmodev temp_ub_q0p75_o48 4 -48.00000 49103.25 FORMAT "%8.2" DEPOSIT ABSOLUTE /end AXIS_DESCR
/end CHARACTERISTIC
/begin CHARACTERISTIC TVUB "Spannungskorrektur" CURVE 0x813FC4 KlAUbSstUbWUw 174.7600 tinjection_sy 0.00 174.7600 FORMAT "%8.4"
 /begin AXIS_DESCR STD_AXIS ub spg_ubatt 5 0.00 17.95 FORMAT "%5.2" DEPOSIT ABSOLUTE /end AXIS_DESCR
/end CHARACTERISTIC
/begin CHARACTERISTIC TWDMAD "Wartezeit bis Freigabe der Adaption des Verlustmoments" VALUE 0x819F90 KwUb 51.00 t200msxs_ub_b51 0.00 51.00 FORMAT "%5.2" /end CHARACTERISTIC
/begin CHARACTERISTIC UBDTRDE "Batteriespannungsabfall für Erkennung 'Starter eingerückt'" VALUE 0x818471 KwUb 17.95 spg_ubatt 0.00 17.95 FORMAT "%5.2" /end CHARACTERISTIC
/begin CHARACTERISTIC UBNLMN "Minimale Batterie-Sollspannung" VALUE 0x81A1E1 KwUb 17.95 spg_ubatt 0.00 17.95 FORMAT "%5.2" /end CHARACTERISTIC
/begin CHARACTERISTIC UBSLMN "min. Spannung für Sekundärluft ein" VALUE 0x81AF18 KwUw 25.59961 spg_q0p00039 0.00 25.59961 FORMAT "%8.5" /end CHARACTERISTIC
/begin CHARACTERISTIC UBSLMX "max. Spannung für Sekundärluft ein" VALUE 0x81AF1A KwUw 25.59961 spg_q0p00039 0.00 25.59961 FORMAT "%8.5" /end CHARACTERISTIC
/begin CHARACTERISTIC UBSLSTMN "min.Spannung für Sekundärluft ein im Start" VALUE 0x81AF1C KwUw 25.59961 spg_q0p00039 0.00 25.59961 FORMAT "%8.5" /end CHARACTERISTIC
/begin CHARACTERISTIC UEVERG "Übersetzungsverhältnis abh. vom eingelegten Gang" CURVE 0x811757 FklWUb 31.88 fak_ub_b32 0.00 31.88 FORMAT "%5.2"
 /begin AXIS_DESCR FIX_AXIS gangi dez 8 0.00 7.000 FORMAT "%5.3" FIX_AXIS_PAR 0 0 8 /end AXIS_DESCR
/end CHARACTERISTIC
/begin CHARACTERISTIC VNMX "Geschwindigkeits-Schwelle für Aktivierung der erhöhten Drehzahlgrenze" VALUE 0x811AAF KwUb 318.8 vfzg_ub_q1p25 0.00 318.8 FORMAT "%5.1" /end CHARACTERISTIC
/begin CHARACTERISTIC VSLS "Schwelle Fahrzeuggeschwindigkeit für SLS ein" VALUE 0x818360 KwUb 318.8 vfzg_ub_q1p25 0.00 318.8 FORMAT "%5.1" /end CHARACTERISTIC
/begin CHARACTERISTIC WESSOT "Winkel Einlass schliesst spät bis OT" VALUE 0x810004 KwUb 717.2 kw_q2p8125 0.00 717.2 FORMAT "%5.1" /end CHARACTERISTIC
/begin CHARACTERISTIC WNWBKVE "Winkel NW-Position  mit min. Überschneidung Einlaßnockenwelle bei BKV leer" VALUE 0x82875E KwSw 511.9922 kw_sw_q0p0078 -256.0000 255.9922 FORMAT "%8.4" /end CHARACTERISTIC
/begin CHARACTERISTIC WNWDSHKE "Deltasollwinkel Nockenwelle Korrektur Katheizen über Höhe Einlaß" CURVE 0x828760 KlAUwSstUwWSw 511.9922 kw_sw_q0p0078 -256.0000 255.9922 FORMAT "%8.4"
 /begin AXIS_DESCR STD_AXIS fho_w fak_uw_b4 4 0.00 3.999939 FORMAT "%8.6" DEPOSIT ABSOLUTE /end AXIS_DESCR
/end CHARACTERISTIC
/begin CHARACTERISTIC WNWRAS "Winkel Auslassventil schlie in Referenzposition bezogen auf Ladungswechsel(LWOT)" VALUE 0x827FEA KwSw 511.9922 kw_sw_q0p0078 -256.0000 255.9922 FORMAT "%8.4" /end CHARACTERISTIC
/begin CHARACTERISTIC WNWREO "Winkel Einlassventil öffnet in Referenzposition bezogen auf Ladungswechsel(LWOT)" VALUE 0x828772 KwSw 511.9922 kw_sw_q0p0078 -256.0000 255.9922 FORMAT "%8.4" /end CHARACTERISTIC
/begin CHARACTERISTIC WNWSAMXE "Maxwert zur Berechnung der Sollwertänderungsbegrenzung Einlass Nockenwelle" VALUE 0x828774 KwUw 255.9961 kw_q0p0039 0.00 255.9961 FORMAT "%8.4" /end CHARACTERISTIC
/begin CHARACTERISTIC WNWSEAPP "Applikationswert für den Einlaß-Nockenwellensollwinkel" VALUE 0x828776 KwSw 511.9922 kw_sw_q0p0078 -256.0000 255.9922 FORMAT "%8.4" /end CHARACTERISTIC
/begin CHARACTERISTIC WNWSMNA "Minimal zulässiger Sollwert für Nockenwellenverstellung Auslass schliesst (LWOT)" VALUE 0x827FEC KwSw 511.9922 kw_sw_q0p0078 -256.0000 255.9922 FORMAT "%8.4" /end CHARACTERISTIC
/begin CHARACTERISTIC WNWSMNE "Minimal zulässiger Sollwert für Nockenwellenverstellung Einlass öffnet (LWOT)" VALUE 0x828778 KwSw 511.9922 kw_sw_q0p0078 -256.0000 255.9922 FORMAT "%8.4" /end CHARACTERISTIC
/begin CHARACTERISTIC WNWSMXA "Maximal zulässiger Sollwert für Nockenwellenverstellung Auslass schliesst (LWOT)" VALUE 0x827FEE KwSw 511.9922 kw_sw_q0p0078 -256.0000 255.9922 FORMAT "%8.4" /end CHARACTERISTIC
/begin CHARACTERISTIC WNWSMXE "Maximal zulässiger Sollwert für Nockenwellenverstellung Einlass öffnet (LWOT)" VALUE 0x82877A KwSw 511.9922 kw_sw_q0p0078 -256.0000 255.9922 FORMAT "%8.4" /end CHARACTERISTIC
/begin CHARACTERISTIC WNWSTE "Sollwinkel für Einlaßnockenwellenposition während Start" CURVE 0x82877C KlAUbSstSwWSw 511.9922 kw_sw_q0p0078 -256.0000 255.9922 FORMAT "%8.4"
 /begin AXIS_DESCR STD_AXIS tmot temp_ub_q0p75_o48 4 -24624.00 24527.25 FORMAT "%8.2" DEPOSIT ABSOLUTE /end AXIS_DESCR
/end CHARACTERISTIC
/begin CHARACTERISTIC WNWSWOFE "Sollwinkel für Einlaßnockenwellenposition bei S_KL15 = aus" CURVE 0x82878E KlAUbSstSwWSw 511.9922 kw_sw_q0p0078 -256.0000 255.9922 FORMAT "%8.4"
 /begin AXIS_DESCR STD_AXIS tumg temp_ub_q0p75_o48 4 -24624.00 24527.25 FORMAT "%8.2" DEPOSIT ABSOLUTE /end AXIS_DESCR
/end CHARACTERISTIC
/begin CHARACTERISTIC ZFLMSSL "Zeitkonstante Gemischanteil Sekundärluft" VALUE 0x818361 KwUb 25.4996 zk100msxs_ub_b25p5 0.100392 25.6000 FORMAT "%7.4" /end CHARACTERISTIC
/begin CHARACTERISTIC ZFMDVERL "Zeitkonstante für Filterung Verlustmoment" VALUE 0x811A9E KwUb 2.53000 zk20msxs_ub_b5p1 0.0200000 2.55000 FORMAT "%7.5" /end CHARACTERISTIC
/begin CHARACTERISTIC ZKDMADFK "Zeitkonstante für Adaption des Verlustmoments Fahrstufe und Kompressor ein" VALUE 0x81FBB4 KwUw 816.00000000 zk200msxs_uw_b13107 3.2000000000 819.20000000 FORMAT "%12.8" /end CHARACTERISTIC
/begin CHARACTERISTIC ZKDMADFS "Zeitkonstante für Adaption des Verlustmoments Fahrstufe ein" VALUE 0x81FBB6 KwUw 816.00000000 zk200msxs_uw_b13107 3.2000000000 819.20000000 FORMAT "%12.8" /end CHARACTERISTIC
/begin CHARACTERISTIC ZKDMADKO "Zeitkonstante für Adaption des Verlustmoments Klimakompressor ein" VALUE 0x81FBB8 KwUw 816.00000000 zk200msxs_uw_b13107 3.2000000000 819.20000000 FORMAT "%12.8" /end CHARACTERISTIC
/begin CHARACTERISTIC ZKDMADLL "Zeitkonstante für Adaption des Verlustmoments ohne Last" VALUE 0x81FBBA KwUw 816.00000000 zk200msxs_uw_b13107 3.2000000000 819.20000000 FORMAT "%12.8" /end CHARACTERISTIC
/begin CHARACTERISTIC ZKDMDW "Zeitkonstante für Abregelung D-Anteil Wandlermoment" VALUE 0x81175F KwUb 5.08000 zk20msxs_ub_b5p1 0.0200000 5.10000 FORMAT "%7.5" /end CHARACTERISTIC
/begin CHARACTERISTIC ZKMDKO "Zeitkonstante Klimakompressor-Lastabregelung" VALUE 0x81A07C KwUb 5.09992 zk20msxs_ub_b5p12 0.0200784 5.12000 FORMAT "%7.5" /end CHARACTERISTIC
/begin CHARACTERISTIC ZKMDSLP "Zeitkonstante zur Abregelung des Einschaltmomentes der Sek-Luftpumpe" VALUE 0x81A07D KwUb 5.09992 zk20msxs_ub_b5p12 0.0200784 5.12000 FORMAT "%7.5" /end CHARACTERISTIC
/begin CHARACTERISTIC ZKMDWAB "Zeitkonstante für Abregelung der  Drehmomentaufnahme des Wandlers" VALUE 0x811760 KwUb 5.08000 zk20msxs_ub_b5p1 0.0200000 5.10000 FORMAT "%7.5" /end CHARACTERISTIC
/begin CHARACTERISTIC ZKMDWAUF "Zeitkonstante für Aufregelung der  Drehmomentaufnahme des Wandlers" VALUE 0x811761 KwUb 5.08000 zk20msxs_ub_b5p1 0.0200000 5.10000 FORMAT "%7.5" /end CHARACTERISTIC
/begin CHARACTERISTIC ZKMDWF "Zeitkonstante für Filterung Wandlermoment zur Bildung D-Anteil" VALUE 0x811762 KwUb 5.08000 zk20msxs_ub_b5p1 0.0200000 5.10000 FORMAT "%7.5" /end CHARACTERISTIC
/begin CHARACTERISTIC ZKSLPOFF "Zeitkonstante Runterlauf Sekundärluftgebläse" VALUE 0x818362 KwUb 25.4996 zk100msxs_ub_b25p5 0.100392 25.6000 FORMAT "%7.4" /end CHARACTERISTIC
/begin CHARACTERISTIC ZKSLPON "Zeitkonstante Hochlauf Sekundärluftgebläse" VALUE 0x818363 KwUb 25.4996 zk100msxs_ub_b25p5 0.100392 25.6000 FORMAT "%7.4" /end CHARACTERISTIC
/begin CHARACTERISTIC ZKSLSOFML "Zeitkonstante Ausräumen der Sekundärluft nach Ventil schließen" CURVE 0x81AF1E KlAUwSstUwWUw 6553.4999985 zk100msxs_uw_b6553 0.10000152590 6553.6000000 FORMAT "%12.7"
 /begin AXIS_DESCR STD_AXIS ml_w m_uw_b6553p5 4 0.00 6553.500 FORMAT "%8.3" DEPOSIT ABSOLUTE /end AXIS_DESCR
/end CHARACTERISTIC
/begin CHARACTERISTIC ZKSLSONML "Zeitkonstante Einbringen der Sekundärluft nach Ventil öffnen" CURVE 0x81AF30 KlAUwSstUwWUw 6553.4999985 zk100msxs_uw_b6553 0.10000152590 6553.6000000 FORMAT "%12.7"
 /begin AXIS_DESCR STD_AXIS ml_w m_uw_b6553p5 4 0.00 6553.500 FORMAT "%8.3" DEPOSIT ABSOLUTE /end AXIS_DESCR
/end CHARACTERISTIC
/begin CHARACTERISTIC ZKUEVERG "Filterzeitkonstante: Turbinendrehzahl bei Gangwechsel" VALUE 0x811763 KwUb 5.08000 zk20msxs_ub_b5p1 0.0200000 5.10000 FORMAT "%7.5" /end CHARACTERISTIC
/begin CHARACTERISTIC ZMDDLWS "Zeitkonstant für Lenkhilfelastmoment" VALUE 0x81A07E KwUb 5.09992 zk20msxs_ub_b5p12 0.0200784 5.12000 FORMAT "%7.5" /end CHARACTERISTIC
/begin CHARACTERISTIC ZMDNSM "Zeitkonstante zur Abrgelung des Nachstart-Momentenoffset" CURVE 0x827BD8 KlAUbSstUbWUw 3276.7499992 zk50msxs_uw_b3276p8 0.050000762951 3276.8000000 FORMAT "%12.7"
 /begin AXIS_DESCR STD_AXIS tmot temp_ub_q0p75_o48 8 -48.00 143.3 FORMAT "%5.1" DEPOSIT ABSOLUTE /end AXIS_DESCR
/end CHARACTERISTIC
/begin CHARACTERISTIC ZTSPEV "Zeitkonstante zur Bildung der Spulentemperatur eines Einspritzventils" VALUE 0x81D99E KwUw 6553.4999985 zk100msxs_uw_b6553 0.10000152590 6553.6000000 FORMAT "%12.7" /end CHARACTERISTIC
/begin CHARACTERISTIC ZYLEAUS "auszublendender Zylinder" VALUE 0x810B55 KwUb 255.0 dez 0.00 255.0 FORMAT "%5.1" /end CHARACTERISTIC
/begin MEASUREMENT anzeausb "Anzahl der auszublendenen Einspritzungen; begrenzt zwischen 4 und 7" UBYTE dez 1 100 0 255 FORMAT "%5.1" ECU_ADDRESS 0x380923 /end MEASUREMENT
/begin MEASUREMENT B_2ph "Bedingung, daß zweite Phasenflankeninformation vorliegt" UWORD B_TRUE 1 100 0 1 BIT_MASK 0x2 FORMAT "%13.11" ECU_ADDRESS 0xFD30 /end MEASUREMENT
/begin MEASUREMENT B_3ph "Bedingung, daß dritte Phasenflankeninformation vorliegt" UWORD B_TRUE 1 100 0 1 BIT_MASK 0x4 FORMAT "%13.11" ECU_ADDRESS 0xFD30 /end MEASUREMENT
/begin MEASUREMENT B_4wd "Bedingung Allrad-Antrieb" UWORD B_TRUE 1 100 0 1 BIT_MASK 0x1 FORMAT "%13.11" ECU_ADDRESS 0xFD00 /end MEASUREMENT
/begin MEASUREMENT B_abstnl "Bedingung Abstellzeitermittlung über SG-Nachlauf" UWORD B_TRUE 1 100 0 1 BIT_MASK 0x2 FORMAT "%13.11" ECU_ADDRESS 0xFD00 /end MEASUREMENT
/begin MEASUREMENT B_abw "Bedingung Abwürgen Motor" UBYTE B_TRUE 1 100 0 1 BIT_MASK 0x8 FORMAT "%13.11" ECU_ADDRESS 0x380918 /end MEASUREMENT
/begin MEASUREMENT B_adrkra "Bedingung Adaptionswerte von KR resetieren bei Fehlerspeicher löschen" UWORD B_TRUE 1 100 0 1 BIT_MASK 0x4 FORMAT "%13.11" ECU_ADDRESS 0xFD00 /end MEASUREMENT
/begin MEASUREMENT B_adrldra "Ladedruck Adaptionswerte löschen bei Fehlerspeicher löschen" UWORD B_TRUE 1 100 0 1 BIT_MASK 0x8 FORMAT "%13.11" ECU_ADDRESS 0xFD00 /end MEASUREMENT
/begin MEASUREMENT B_adrlra "Bedingung Adaptionswerte LRA resetieren bei Fehlerspeicher löschen" UWORD B_TRUE 1 100 0 1 BIT_MASK 0x10 FORMAT "%13.11" ECU_ADDRESS 0xFD00 /end MEASUREMENT
/begin MEASUREMENT B_adrmdver "Bedingung Verlustmomentenadaption löschen bei Fehlerspeicher Lösschen" UWORD B_TRUE 1 100 0 1 BIT_MASK 0x20 FORMAT "%13.11" ECU_ADDRESS 0xFD00 /end MEASUREMENT
/begin MEASUREMENT B_adrmsdk "Bedingung Adaptionswerte DK  resetieren bei Fehlerspeicher löschen" UWORD B_TRUE 1 100 0 1 BIT_MASK 0x40 FORMAT "%13.11" ECU_ADDRESS 0xFD00 /end MEASUREMENT
/begin MEASUREMENT B_adrsta "Bedingung Adaptionswerte von STADAP resetieren bei Fehlerspeicher löschen" UWORD B_TRUE 1 100 0 1 BIT_MASK 0x80 FORMAT "%13.11" ECU_ADDRESS 0xFD00 /end MEASUREMENT
/begin MEASUREMENT B_adwfk "Bedingung Adaptionswert Fahrstufe und Kompressor ein verwenden" UBYTE B_TRUE 1 100 0 1 BIT_MASK 0x10 FORMAT "%13.11" ECU_ADDRESS 0x380ABA /end MEASUREMENT
/begin MEASUREMENT B_adwfs "Bedingung Adaptionswert Fahrstufe ein verwenden" UBYTE B_TRUE 1 100 0 1 BIT_MASK 0x20 FORMAT "%13.11" ECU_ADDRESS 0x380ABA /end MEASUREMENT
/begin MEASUREMENT B_adwko "Bedingung Adaptionswert Klimakompressor ein verwenden" UBYTE B_TRUE 1 100 0 1 BIT_MASK 0x40 FORMAT "%13.11" ECU_ADDRESS 0x380ABA /end MEASUREMENT
/begin MEASUREMENT B_anlaus "Bedingung für Anlasser ausgerückt" UBYTE B_TRUE 1 100 0 1 BIT_MASK 0x1 FORMAT "%13.11" ECU_ADDRESS 0x380918 /end MEASUREMENT
/begin MEASUREMENT B_asrfz "Bedingung für ASR im Fahrzeug" UWORD B_TRUE 1 100 0 1 BIT_MASK 0x100 FORMAT "%13.11" ECU_ADDRESS 0xFD00 /end MEASUREMENT
/begin MEASUREMENT B_autget "Bedingung Automatikgetriebe" UWORD B_TRUE 1 100 0 1 BIT_MASK 0x200 FORMAT "%13.11" ECU_ADDRESS 0xFD00 /end MEASUREMENT
/begin MEASUREMENT B_cdagr "Funktion über Codewort CDAGR freigegeben" UWORD B_TRUE 1 100 0 1 BIT_MASK 0x8000 FORMAT "%13.11" ECU_ADDRESS 0x380B94 /end MEASUREMENT
/begin MEASUREMENT B_cdagrl "Funktion über Codewort CDAGRL freigeben" UWORD B_TRUE 1 100 0 1 BIT_MASK 0x200 FORMAT "%13.11" ECU_ADDRESS 0x380B96 /end MEASUREMENT
/begin MEASUREMENT B_cdanws "Funktion über Codewort CDNWS freigegeben (Auslaß)" UWORD B_TRUE 1 100 0 1 BIT_MASK 0x2000 FORMAT "%13.11" ECU_ADDRESS 0x380B96 /end MEASUREMENT
/begin MEASUREMENT B_cdatr "Bedingung: Diagnose Abgastemperaturregelung freigegeben" UWORD B_TRUE 1 100 0 1 BIT_MASK 0x400 FORMAT "%13.11" ECU_ADDRESS 0x380B94 /end MEASUREMENT
/begin MEASUREMENT B_cdats "Bedingung Diagnose Abgastemperatursensor freigegeben" UWORD B_TRUE 1 100 0 1 BIT_MASK 0x200 FORMAT "%13.11" ECU_ADDRESS 0x380B94 /end MEASUREMENT
/begin MEASUREMENT B_cdbkvp "Funktion über Codewort CDBKVP freigegeben" UWORD B_TRUE 1 100 0 1 BIT_MASK 0x20 FORMAT "%13.11" ECU_ADDRESS 0x380B98 /end MEASUREMENT
/begin MEASUREMENT B_cddsbkv "Funktion über Codewort CDDSBKV freigegeben" UWORD B_TRUE 1 100 0 1 BIT_MASK 0x10 FORMAT "%13.11" ECU_ADDRESS 0x380B98 /end MEASUREMENT
/begin MEASUREMENT B_cddst "Funktion über Codewort CDDST freigegeben" UWORD B_TRUE 1 100 0 1 BIT_MASK 0x1000 FORMAT "%13.11" ECU_ADDRESS 0x380B94 /end MEASUREMENT
/begin MEASUREMENT B_cdegfe "Bedingung: Diagnose DEGFE freigegeben." UWORD B_TRUE 1 100 0 1 BIT_MASK 0x40 FORMAT "%13.11" ECU_ADDRESS 0x380B98 /end MEASUREMENT
/begin MEASUREMENT B_cdehfm "Funktion %DHFM über Codewort CDEHFM in %KONCW freigegeben" UWORD B_TRUE 1 100 0 1 BIT_MASK 0x4000 FORMAT "%13.11" ECU_ADDRESS 0x380B96 /end MEASUREMENT
/begin MEASUREMENT B_cdenws "Funktion über Codewort CDNWS freigegeben (Einlaß)" UWORD B_TRUE 1 100 0 1 BIT_MASK 0x2 FORMAT "%13.11" ECU_ADDRESS 0x380B96 /end MEASUREMENT
/begin MEASUREMENT B_cdgts "Bedingung: Funktion GGGTS über Codewort CDGGGTS freigeben" UWORD B_TRUE 1 100 0 1 BIT_MASK 0x400 FORMAT "%13.11" ECU_ADDRESS 0xFD00 /end MEASUREMENT
/begin MEASUREMENT B_cdhsh "Funktion über Codewort CDHSH freigegeben" UWORD B_TRUE 1 100 0 1 BIT_MASK 0x80 FORMAT "%13.11" ECU_ADDRESS 0x380B94 /end MEASUREMENT
/begin MEASUREMENT B_cdhshe "Funktion über Codewort CDHSHE freigegeben" UWORD B_TRUE 1 100 0 1 BIT_MASK 0x80 FORMAT "%13.11" ECU_ADDRESS 0x380B96 /end MEASUREMENT
/begin MEASUREMENT B_cdhsv "Funktion über Codewort CDHSV freigegeben" UWORD B_TRUE 1 100 0 1 BIT_MASK 0x40 FORMAT "%13.11" ECU_ADDRESS 0x380B94 /end MEASUREMENT
/begin MEASUREMENT B_cdhsve "Funktion über Codewort CDHSVE freigegeben" UWORD B_TRUE 1 100 0 1 BIT_MASK 0x100 FORMAT "%13.11" ECU_ADDRESS 0x380B96 /end MEASUREMENT
/begin MEASUREMENT B_cdhsvsa "Funktion über Codewort CDHSVSA freigegeben" UWORD B_TRUE 1 100 0 1 BIT_MASK 0x800 FORMAT "%13.11" ECU_ADDRESS 0x380B96 /end MEASUREMENT
/begin MEASUREMENT B_cdkat "Funktion über Codewort CDKAT freigegeben" UWORD B_TRUE 1 100 0 1 BIT_MASK 0x100 FORMAT "%13.11" ECU_ADDRESS 0x380B94 /end MEASUREMENT
/begin MEASUREMENT B_cdkatsp "Bedingung Katalysatordiagnosefunktion %DKATSP über Codewort CDKATSP freigegeben" UWORD B_TRUE 1 100 0 1 BIT_MASK 0x1 FORMAT "%13.11" ECU_ADDRESS 0x380B98 /end MEASUREMENT
/begin MEASUREMENT B_cdkatspf "Funktion DKATSP für Feld- bzw. Strassenbetrieb freigegeben" UWORD B_TRUE 1 100 0 1 BIT_MASK 0x2 FORMAT "%13.11" ECU_ADDRESS 0x380B98 /end MEASUREMENT
/begin MEASUREMENT B_cdkatspt "Funktion DKATSP für Testerbetrieb freigegeben" UWORD B_TRUE 1 100 0 1 BIT_MASK 0x4 FORMAT "%13.11" ECU_ADDRESS 0x380B98 /end MEASUREMENT
/begin MEASUREMENT B_cdkvs "Funktion über Codewort CDKVS freigegeben" UWORD B_TRUE 1 100 0 1 BIT_MASK 0x800 FORMAT "%13.11" ECU_ADDRESS 0x380B94 /end MEASUREMENT
/begin MEASUREMENT B_cdlash "Funktion über Codewort CDLASH freigegeben" UWORD B_TRUE 1 100 0 1 BIT_MASK 0x40 FORMAT "%13.11" ECU_ADDRESS 0x380B96 /end MEASUREMENT
/begin MEASUREMENT B_cdlatp "Funktion über Codewort CDLATP freigegeben" UWORD B_TRUE 1 100 0 1 BIT_MASK 0x10 FORMAT "%13.11" ECU_ADDRESS 0x380B96 /end MEASUREMENT
/begin MEASUREMENT B_cdlatv "Funktion über Codewort CDLATV freigeben" UWORD B_TRUE 1 100 0 1 BIT_MASK 0x20 FORMAT "%13.11" ECU_ADDRESS 0x380B96 /end MEASUREMENT
/begin MEASUREMENT B_cdldp "Funktion über Codewort CDLDP freigegeben" UWORD B_TRUE 1 100 0 1 BIT_MASK 0x4000 FORMAT "%13.11" ECU_ADDRESS 0x380B94 /end MEASUREMENT
/begin MEASUREMENT B_cdllr "Funktion normale Drehzahldiagnose über Codewort CDLLR freigegeben" UWORD B_TRUE 1 100 0 1 BIT_MASK 0x8 FORMAT "%13.11" ECU_ADDRESS 0x380B96 /end MEASUREMENT
/begin MEASUREMENT B_cdlsa "Funktion über Codewort CDLSA freigegeben" UWORD B_TRUE 1 100 0 1 BIT_MASK 0x20 FORMAT "%13.11" ECU_ADDRESS 0x380B94 /end MEASUREMENT
/begin MEASUREMENT B_cdlsh "Funktion über Codewort CDLSH freigegeben" UWORD B_TRUE 1 100 0 1 BIT_MASK 0x10 FORMAT "%13.11" ECU_ADDRESS 0x380B94 /end MEASUREMENT
/begin MEASUREMENT B_cdlsv "Funktion über Codewort CDLSV freigegeben" UWORD B_TRUE 1 100 0 1 BIT_MASK 0x8 FORMAT "%13.11" ECU_ADDRESS 0x380B94 /end MEASUREMENT
/begin MEASUREMENT B_cdlsvv "Funktion über Codewort CDLSVV freigegeben" UWORD B_TRUE 1 100 0 1 BIT_MASK 0x400 FORMAT "%13.11" ECU_ADDRESS 0x380B96 /end MEASUREMENT
/begin MEASUREMENT B_cdmd "Funktion über Codewort CDMD freigegeben" UWORD B_TRUE 1 100 0 1 BIT_MASK 0x1 FORMAT "%13.11" ECU_ADDRESS 0x380B94 /end MEASUREMENT
/begin MEASUREMENT B_cdnws "Funktion über Codewort CDNWS freigegeben" UWORD B_TRUE 1 100 0 1 BIT_MASK 0x4 FORMAT "%13.11" ECU_ADDRESS 0x380B96 /end MEASUREMENT
/begin MEASUREMENT B_cdsls "Funktion über Codewort CDSLS freigegeben" UWORD B_TRUE 1 100 0 1 BIT_MASK 0x1 FORMAT "%13.11" ECU_ADDRESS 0x380B96 /end MEASUREMENT
/begin MEASUREMENT B_cdswe "Funktion über Codewort CDSWE freigegeben" UWORD B_TRUE 1 100 0 1 BIT_MASK 0x2 FORMAT "%13.11" ECU_ADDRESS 0x380B94 /end MEASUREMENT
/begin MEASUREMENT B_cdtankl "Funktion über Codewort CDTANKL freigegeben" UWORD B_TRUE 1 100 0 1 BIT_MASK 0x4 FORMAT "%13.11" ECU_ADDRESS 0x380B94 /end MEASUREMENT
/begin MEASUREMENT B_cdtes "Funktion über Codewort CDTES freigegeben" UWORD B_TRUE 1 100 0 1 BIT_MASK 0x2000 FORMAT "%13.11" ECU_ADDRESS 0x380B94 /end MEASUREMENT
/begin MEASUREMENT B_cnfwan "Bedingung : Drehmomentaufnahme des Wandlers über CAN" UWORD B_TRUE 1 100 0 1 BIT_MASK 0x100 FORMAT "%13.11" ECU_ADDRESS 0xFD84 /end MEASUREMENT
/begin MEASUREMENT B_cvt "Bedingung continuously variable transmission" UWORD B_TRUE 1 100 0 1 BIT_MASK 0x800 FORMAT "%13.11" ECU_ADDRESS 0xFD00 /end MEASUREMENT
/begin MEASUREMENT B_cwlshdyn "Beding. Abschaltung für Teilfunktion Dynamikprüfung Sonde hinter KAT in %DLSAHK" UWORD B_TRUE 1 100 0 1 BIT_MASK 0x1000 FORMAT "%13.11" ECU_ADDRESS 0xFD00 /end MEASUREMENT
/begin MEASUREMENT B_cwlshmf "Beding. Ein/Abschaltung Schwingungsprüfung für Einmalprüfung Sonde hinter KAT" UWORD B_TRUE 1 100 0 1 BIT_MASK 0x2000 FORMAT "%13.11" ECU_ADDRESS 0xFD00 /end MEASUREMENT
/begin MEASUREMENT B_cwlshsch "Bedingung Abschaltung für Teilfunktion im Schub Sonde hinter KAT in %DLSAHK" UWORD B_TRUE 1 100 0 1 BIT_MASK 0x4000 FORMAT "%13.11" ECU_ADDRESS 0xFD00 /end MEASUREMENT
/begin MEASUREMENT B_cwlshvl "Bed. Abschaltung für Teilfunktion im Vollastbetrieb Sonde hinter KAT in %DLSAHK" UWORD B_TRUE 1 100 0 1 BIT_MASK 0x80 FORMAT "%13.11" ECU_ADDRESS 0x380B98 /end MEASUREMENT
/begin MEASUREMENT B_delaysyn "Flag für eine Verzögerung um 1 Lücke zur Neusynchronisierung" UWORD B_TRUE 1 100 0 1 BIT_MASK 0x200 FORMAT "%13.11" ECU_ADDRESS 0xFD2A /end MEASUREMENT
/begin MEASUREMENT B_dknolu "Bedingung: Notluftfahren aktiv" UWORD B_TRUE 1 100 0 1 BIT_MASK 0x8 FORMAT "%13.11" ECU_ADDRESS 0xFD48 /end MEASUREMENT
/begin MEASUREMENT B_dknot "Bedingung DK-Poti-Notfahren aktiv" UWORD B_TRUE 1 100 0 1 BIT_MASK 0x10 FORMAT "%13.11" ECU_ADDRESS 0xFD48 /end MEASUREMENT
/begin MEASUREMENT B_dkpiu "Bedingung: irreversible SKA" UWORD B_TRUE 1 100 0 1 BIT_MASK 0x20 FORMAT "%13.11" ECU_ADDRESS 0xFD48 /end MEASUREMENT
/begin MEASUREMENT B_dkpru "Bedingung: reversible SKA" UWORD B_TRUE 1 100 0 1 BIT_MASK 0x40 FORMAT "%13.11" ECU_ADDRESS 0xFD48 /end MEASUREMENT
/begin MEASUREMENT B_dkpu "Bedingung Sicherheitskraftstoffabschaltung (SKA)" UWORD B_TRUE 1 100 0 1 BIT_MASK 0x80 FORMAT "%13.11" ECU_ADDRESS 0xFD48 /end MEASUREMENT
/begin MEASUREMENT B_dkunb "Bedingung: Drosselklappenposition unbekannt" UWORD B_TRUE 1 100 0 1 BIT_MASK 0x100 FORMAT "%13.11" ECU_ADDRESS 0xFD48 /end MEASUREMENT
/begin MEASUREMENT B_dmrwan "Bedingung Aufbau Momentenreserve für Wandlermoment" UWORD B_TRUE 1 100 0 1 BIT_MASK 0x200 FORMAT "%13.11" ECU_ADDRESS 0xFD84 /end MEASUREMENT
/begin MEASUREMENT B_dmverlin "Bedingung dmverl = 0" UWORD B_TRUE 1 100 0 1 BIT_MASK 0x2 FORMAT "%13.11" ECU_ADDRESS 0xFD8E /end MEASUREMENT
/begin MEASUREMENT B_dopzue "Bedingung doppelte Zündausgabe(Phasengebernotlauf)" UWORD B_TRUE 1 100 0 1 BIT_MASK 0x400 FORMAT "%13.11" ECU_ADDRESS 0xFD2A /end MEASUREMENT
/begin MEASUREMENT B_dslreset "Bedingung: Zurücksetzen Sekundärluftadaption/Kurztest" UWORD B_TRUE 1 100 0 1 BIT_MASK 0x2 FORMAT "%13.11" ECU_ADDRESS 0x3849E8 /end MEASUREMENT
/begin MEASUREMENT B_dslset "Bedingung: Setzen Sekundärluftadaption/Kurztest" UWORD B_TRUE 1 100 0 1 BIT_MASK 0x1 FORMAT "%13.11" ECU_ADDRESS 0x3849E8 /end MEASUREMENT
/begin MEASUREMENT B_dslvh "Bedingung Ladedrucksensor vorhanden" UWORD B_TRUE 1 100 0 1 BIT_MASK 0x8000 FORMAT "%13.11" ECU_ADDRESS 0xFD00 /end MEASUREMENT
/begin MEASUREMENT B_dssv "Bedingung Saugrohr-Drucksensor vorhanden als Hauptlastsensor" UWORD B_TRUE 1 100 0 1 BIT_MASK 0x1 FORMAT "%13.11" ECU_ADDRESS 0xFD02 /end MEASUREMENT
/begin MEASUREMENT B_dssvnl "Bedingung Saugrohr-Drucksensor als Nebenlastsensor vorhanden" UWORD B_TRUE 1 100 0 1 BIT_MASK 0x2 FORMAT "%13.11" ECU_ADDRESS 0xFD02 /end MEASUREMENT
/begin MEASUREMENT B_dsuv "Umgebungsdrucksensor ist vorhanden" UWORD B_TRUE 1 100 0 1 BIT_MASK 0x4 FORMAT "%13.11" ECU_ADDRESS 0xFD02 /end MEASUREMENT
/begin MEASUREMENT B_enabrde "Bedingung für Freigabe der Rückdreherkennung" UWORD B_TRUE 1 100 0 1 BIT_MASK 0x4000 FORMAT "%13.11" ECU_ADDRESS 0xFD28 /end MEASUREMENT
/begin MEASUREMENT B_enimiti "Bedingung Freigabe des Reglers zur Momentenbegrenzung bei Dauereinspritzung" UBYTE B_TRUE 1 100 0 1 BIT_MASK 0x1 FORMAT "%13.11" ECU_ADDRESS 0x3809E6 /end MEASUREMENT
/begin MEASUREMENT B_ensynnl "Freigabe der Synchronisation für Notlauf-Drehzahlgeber" UWORD B_TRUE 1 100 0 1 BIT_MASK 0x8 FORMAT "%13.11" ECU_ADDRESS 0xFD30 /end MEASUREMENT
/begin MEASUREMENT B_fanwsea "Bedingung Funktionsanforderung Diagnose NWS aktiv (Einlaß)" UBYTE B_TRUE 1 100 0 1 BIT_MASK 0x8 FORMAT "%13.11" ECU_ADDRESS 0x384925 /end MEASUREMENT
/begin MEASUREMENT B_fanwstae "Umschaltung auf Sollwertvorgabe durch Tester bei Einlassnockenwelle" UBYTE B_TRUE 1 100 0 1 BIT_MASK 0x2 FORMAT "%13.11" ECU_ADDRESS 0x380B5F /end MEASUREMENT
/begin MEASUREMENT B_fasla "Bedingung: externe Anforderung an Sekundärluft aktiv" UWORD B_TRUE 1 100 0 1 BIT_MASK 0x4 FORMAT "%13.11" ECU_ADDRESS 0xFD0E /end MEASUREMENT
/begin MEASUREMENT B_fpwdkap "DK-Steuerung direkt über Fahrpedal" UWORD B_TRUE 1 100 0 1 BIT_MASK 0x8 FORMAT "%13.11" ECU_ADDRESS 0xFD02 /end MEASUREMENT
/begin MEASUREMENT B_fsu "Bedingung Fahrstufe, Umschaltung" UWORD B_TRUE 1 100 0 1 BIT_MASK 0x400 FORMAT "%13.11" ECU_ADDRESS 0xFD84 /end MEASUREMENT
/begin MEASUREMENT B_gapnldg "Information über die Position der Lücke" UWORD B_TRUE 1 100 0 1 BIT_MASK 0x10 FORMAT "%13.11" ECU_ADDRESS 0xFD30 /end MEASUREMENT
/begin MEASUREMENT B_gra6p "Bedingung 6-Positionen-Lenkstockhebel für GRA-Bedienung" UWORD B_TRUE 1 100 0 1 BIT_MASK 0x10 FORMAT "%13.11" ECU_ADDRESS 0xFD02 /end MEASUREMENT
/begin MEASUREMENT B_gracan "Bedingung Empfang der GRA-Bediensignale über CAN" UWORD B_TRUE 1 100 0 1 BIT_MASK 0x20 FORMAT "%13.11" ECU_ADDRESS 0xFD02 /end MEASUREMENT
/begin MEASUREMENT B_hfmv "Bedingung HFM vorhanden" UWORD B_TRUE 1 100 0 1 BIT_MASK 0x40 FORMAT "%13.11" ECU_ADDRESS 0xFD02 /end MEASUREMENT
/begin MEASUREMENT B_intats "" UWORD B_TRUE 1 100 0 1 BIT_MASK 0x8000 FORMAT "%13.11" ECU_ADDRESS 0xFD06 /end MEASUREMENT
/begin MEASUREMENT B_intatserr "" UWORD B_TRUE 1 100 0 1 BIT_MASK 0x1 FORMAT "%13.11" ECU_ADDRESS 0xFD08 /end MEASUREMENT
/begin MEASUREMENT B_intatsfirstneg "" UWORD B_TRUE 1 100 0 1 BIT_MASK 0x2 FORMAT "%13.11" ECU_ADDRESS 0xFD08 /end MEASUREMENT
/begin MEASUREMENT B_intatsfirstpos "" UWORD B_TRUE 1 100 0 1 BIT_MASK 0x4 FORMAT "%13.11" ECU_ADDRESS 0xFD08 /end MEASUREMENT
/begin MEASUREMENT B_itnmxh "Bedingung: Verweilzeit unterhalb Drehzahlgrenze abgelaufen" UWORD B_TRUE 1 100 0 1 BIT_MASK 0x4 FORMAT "%13.11" ECU_ADDRESS 0xFD8E /end MEASUREMENT
/begin MEASUREMENT B_i_ska_fr "FR-Fehlerreaktion irreversible SKA (Sicherheits-Kraftstoff-Abschaltung)" UWORD B_TRUE 1 100 0 1 BIT_MASK 0x200 FORMAT "%13.11" ECU_ADDRESS 0xFD48 /end MEASUREMENT
/begin MEASUREMENT B_katfz "Bedingung Kat in Fahrzeug eingebaut" UWORD B_TRUE 1 100 0 1 BIT_MASK 0x80 FORMAT "%13.11" ECU_ADDRESS 0xFD02 /end MEASUREMENT
/begin MEASUREMENT B_kath "Bedingung Kat Heizung in Fahrzeug eingebaut" UWORD B_TRUE 1 100 0 1 BIT_MASK 0x100 FORMAT "%13.11" ECU_ADDRESS 0xFD02 /end MEASUREMENT
/begin MEASUREMENT B_kllknl "Synchronisationsbedingung für zphflsyn=3 erfüllt" UWORD B_TRUE 1 100 0 1 BIT_MASK 0x20 FORMAT "%13.11" ECU_ADDRESS 0xFD30 /end MEASUREMENT
/begin MEASUREMENT B_kmmilsct "Ausgabe ""km bei MIL on"" für Scan Tool abschalten (0 = keine Ausgabe in PID $21)" UWORD B_TRUE 1 100 0 1 BIT_MASK 0x200 FORMAT "%13.11" ECU_ADDRESS 0xFD02 /end MEASUREMENT
/begin MEASUREMENT B_ldsafw "LDR läuft auf Steuerung mit Festwert LDRAPP" UWORD B_TRUE 1 100 0 1 BIT_MASK 0x400 FORMAT "%13.11" ECU_ADDRESS 0xFD02 /end MEASUREMENT
/begin MEASUREMENT B_ldsapp "LDR läuft auf Steuerung mit KFLDRAPP" UWORD B_TRUE 1 100 0 1 BIT_MASK 0x800 FORMAT "%13.11" ECU_ADDRESS 0xFD02 /end MEASUREMENT
/begin MEASUREMENT B_lkklnl "Synchronisationsbedingung für zphflsyn=1 erfüllt" UWORD B_TRUE 1 100 0 1 BIT_MASK 0x40 FORMAT "%13.11" ECU_ADDRESS 0xFD30 /end MEASUREMENT
/begin MEASUREMENT B_lmsslof "Bedingung Lambda-Motor-Soll-Sekundärluftanteil, Aus" UWORD B_TRUE 1 100 0 1 BIT_MASK 0x8 FORMAT "%13.11" ECU_ADDRESS 0xFD0E /end MEASUREMENT
/begin MEASUREMENT B_ls3 "Bedingung 3. Lambda-Sonde nach Auslaß vorbaut (Bank1)" UWORD B_TRUE 1 100 0 1 BIT_MASK 0x1000 FORMAT "%13.11" ECU_ADDRESS 0xFD02 /end MEASUREMENT
/begin MEASUREMENT B_ls32 "Bedingung 3. Lambda-Sonde nach Auslaß vorbaut (Bank2)" UWORD B_TRUE 1 100 0 1 BIT_MASK 0x2000 FORMAT "%13.11" ECU_ADDRESS 0xFD02 /end MEASUREMENT
/begin MEASUREMENT B_ls4 "Bedingung 4. Lambda-Sonde nach Auslaß vorbaut (Bank1)" UWORD B_TRUE 1 100 0 1 BIT_MASK 0x4000 FORMAT "%13.11" ECU_ADDRESS 0xFD02 /end MEASUREMENT
/begin MEASUREMENT B_ls42 "Bedingung 4. Lambda-Sonde nach Auslaß vorbaut (Bank2)" UWORD B_TRUE 1 100 0 1 BIT_MASK 0x8000 FORMAT "%13.11" ECU_ADDRESS 0xFD02 /end MEASUREMENT
/begin MEASUREMENT B_lsh "Bedingung Lambda-Sonde hinter Kat verbaut" UWORD B_TRUE 1 100 0 1 BIT_MASK 0x1 FORMAT "%13.11" ECU_ADDRESS 0xFD04 /end MEASUREMENT
/begin MEASUREMENT B_lsh2 "Bedingung Lambda-Sonde hinter Kat verbaut (Bank2)" UWORD B_TRUE 1 100 0 1 BIT_MASK 0x2 FORMAT "%13.11" ECU_ADDRESS 0xFD04 /end MEASUREMENT
/begin MEASUREMENT B_lsv "Bedingung Lambda-Sonde vor Kat verbaut, 1. Sonde nach Auslaß (Bank1)" UWORD B_TRUE 1 100 0 1 BIT_MASK 0x4 FORMAT "%13.11" ECU_ADDRESS 0xFD04 /end MEASUREMENT
/begin MEASUREMENT B_lsv2 "Bedingung Lambda-Sonde vor Kat verbaut, 1. Sonde nach Auslaß (Bank2)" UWORD B_TRUE 1 100 0 1 BIT_MASK 0x8 FORMAT "%13.11" ECU_ADDRESS 0xFD04 /end MEASUREMENT
/begin MEASUREMENT B_lzs_dash "" UBYTE B_TRUE 1 100 0 1 BIT_MASK 0x10 FORMAT "%13.11" ECU_ADDRESS 0x3833EC /end MEASUREMENT
/begin MEASUREMENT B_lzs_kr "" UBYTE B_TRUE 1 100 0 1 BIT_MASK 0x1 FORMAT "%13.11" ECU_ADDRESS 0x3833EC /end MEASUREMENT
/begin MEASUREMENT B_lzs_ldr "" UBYTE B_TRUE 1 100 0 1 BIT_MASK 0x4 FORMAT "%13.11" ECU_ADDRESS 0x3833EC /end MEASUREMENT
/begin MEASUREMENT B_lzs_lr "" UBYTE B_TRUE 1 100 0 1 BIT_MASK 0x2 FORMAT "%13.11" ECU_ADDRESS 0x3833EC /end MEASUREMENT
/begin MEASUREMENT B_lzs_lsd "" UBYTE B_TRUE 1 100 0 1 BIT_MASK 0x8 FORMAT "%13.11" ECU_ADDRESS 0x3833EC /end MEASUREMENT
/begin MEASUREMENT B_lzs_sa "" UBYTE B_TRUE 1 100 0 1 BIT_MASK 0x20 FORMAT "%13.11" ECU_ADDRESS 0x3833EC /end MEASUREMENT
/begin MEASUREMENT B_m8te "Bedingung Fkt-Anforderung Tankentlüftung nach SAE J1979 Mode 8 TID $01" UBYTE B_TRUE 1 100 0 1 BIT_MASK 0x1 FORMAT "%13.11" ECU_ADDRESS 0x3808FD /end MEASUREMENT
/begin MEASUREMENT B_m9cvnclr "Bedingung zum Löschen der Checksumme (CVN)" UBYTE B_TRUE 1 100 0 1 BIT_MASK 0x2 FORMAT "%13.11" ECU_ADDRESS 0x3808FD /end MEASUREMENT
/begin MEASUREMENT B_madfk "Bedingung Momentenadaption Fahrstufe und Klimakompressor ein" UBYTE B_TRUE 1 100 0 1 BIT_MASK 0x1 FORMAT "%13.11" ECU_ADDRESS 0x380ABA /end MEASUREMENT
/begin MEASUREMENT B_madfs "Bedingung Momentenadaption Fahrstufe ein" UBYTE B_TRUE 1 100 0 1 BIT_MASK 0x2 FORMAT "%13.11" ECU_ADDRESS 0x380ABA /end MEASUREMENT
/begin MEASUREMENT B_madko "Bedingung Momentenadaption Klimakompressor ein" UBYTE B_TRUE 1 100 0 1 BIT_MASK 0x4 FORMAT "%13.11" ECU_ADDRESS 0x380ABA /end MEASUREMENT
/begin MEASUREMENT B_madll "Bedingung Momentenadaption ohne Last" UBYTE B_TRUE 1 100 0 1 BIT_MASK 0x8 FORMAT "%13.11" ECU_ADDRESS 0x380ABA /end MEASUREMENT
/begin MEASUREMENT B_mdcvtk "Bedingung: keine Filterung des Verlustmoments beim Kriechen  (CVT)" UBYTE B_TRUE 1 100 0 1 BIT_MASK 0x1 FORMAT "%13.11" ECU_ADDRESS 0x380AD9 /end MEASUREMENT
/begin MEASUREMENT B_mde8e "Bedingung Mode $08 erlaubt" UWORD B_TRUE 1 100 0 1 BIT_MASK 0x10 FORMAT "%13.11" ECU_ADDRESS 0xFD04 /end MEASUREMENT
/begin MEASUREMENT B_mde9e "Bedingung Mode $09 erlaubt" UWORD B_TRUE 1 100 0 1 BIT_MASK 0x20 FORMAT "%13.11" ECU_ADDRESS 0xFD04 /end MEASUREMENT
/begin MEASUREMENT B_mdmxzu "Bedingung maximales Moment zulässig" UWORD B_TRUE 1 100 0 1 BIT_MASK 0x200 FORMAT "%13.11" ECU_ADDRESS 0xFD8E /end MEASUREMENT
/begin MEASUREMENT B_motstop "Bedingung für Abbruch von Einspritzung und Zündung" UWORD B_TRUE 1 100 0 1 BIT_MASK 0x8000 FORMAT "%13.11" ECU_ADDRESS 0xFD28 /end MEASUREMENT
/begin MEASUREMENT B_msloff "Sekundärluftmasse ausgeräumt nach Sekundärluftphase" UWORD B_TRUE 1 100 0 1 BIT_MASK 0x10 FORMAT "%13.11" ECU_ADDRESS 0xFD0E /end MEASUREMENT
/begin MEASUREMENT B_mslon "Sekundärluftmasse eingeschwungen nach Start der Sekundärluft" UWORD B_TRUE 1 100 0 1 BIT_MASK 0x20 FORMAT "%13.11" ECU_ADDRESS 0xFD0E /end MEASUREMENT
/begin MEASUREMENT B_mt "Bedingung Handschaltgetriebe" UWORD B_TRUE 1 100 0 1 BIT_MASK 0x40 FORMAT "%13.11" ECU_ADDRESS 0xFD04 /end MEASUREMENT
/begin MEASUREMENT B_mzns "Nachstartaufweitung des zul. Moments aktiv" UWORD B_TRUE 1 100 0 1 BIT_MASK 0x400 FORMAT "%13.11" ECU_ADDRESS 0xFD8E /end MEASUREMENT
/begin MEASUREMENT B_nachl "Steuerung SG-Nachlauf" UWORD B_TRUE 1 100 0 1 BIT_MASK 0x8000 FORMAT "%13.11" ECU_ADDRESS 0x383CCC /end MEASUREMENT
/begin MEASUREMENT B_nachlend "Bedingung SG-Nachlauf regulär beendet" UWORD B_TRUE 1 100 0 1 BIT_MASK 0x4000 FORMAT "%13.11" ECU_ADDRESS 0x383CCC /end MEASUREMENT
/begin MEASUREMENT B_nachlram "Steuerung SG-Nachlauf mit Systemcheck" UWORD B_TRUE 1 100 0 1 BIT_MASK 0x4000 FORMAT "%13.11" ECU_ADDRESS 0xFD8E /end MEASUREMENT
/begin MEASUREMENT B_nachlstp "Bedingung SG-Nachlauf beendet" UWORD B_TRUE 1 100 0 1 BIT_MASK 0x2000 FORMAT "%13.11" ECU_ADDRESS 0x383CCC /end MEASUREMENT
/begin MEASUREMENT B_niveau "Bedingung Fahrzeugkarosse höhenverstellbar" UWORD B_TRUE 1 100 0 1 BIT_MASK 0x80 FORMAT "%13.11" ECU_ADDRESS 0xFD04 /end MEASUREMENT
/begin MEASUREMENT B_nlacls "Anforderung Steuergerätenachlauf von AC-Lüftersteuerung" UWORD B_TRUE 1 100 0 1 BIT_MASK 0x2 FORMAT "%13.11" ECU_ADDRESS 0x383CCC /end MEASUREMENT
/begin MEASUREMENT B_nlale "Anforderung Steuergerätenachlauf von Funktion ALE" UWORD B_TRUE 1 100 0 1 BIT_MASK 0x1 FORMAT "%13.11" ECU_ADDRESS 0x383CCC /end MEASUREMENT
/begin MEASUREMENT B_nlasicOBP "" UBYTE B_TRUE 1 100 0 1 BIT_MASK 0x2 FORMAT "%13.11" ECU_ADDRESS 0x3833E9 /end MEASUREMENT
/begin MEASUREMENT B_nlatm "Anforderung Steuergerätenachlauf für Abgastemp.Modell Sondenschutz" UWORD B_TRUE 1 100 0 1 BIT_MASK 0x800 FORMAT "%13.11" ECU_ADDRESS 0x383CCC /end MEASUREMENT
/begin MEASUREMENT B_nlcan "Bedingung für SG-Nachlauf von CAN" UWORD B_TRUE 1 100 0 1 BIT_MASK 0x200 FORMAT "%13.11" ECU_ADDRESS 0x383CCC /end MEASUREMENT
/begin MEASUREMENT B_nldte "Anforderung Steuergerätenachlauf Diagnose Tankentlüftung" UWORD B_TRUE 1 100 0 1 BIT_MASK 0x100 FORMAT "%13.11" ECU_ADDRESS 0x383CCC /end MEASUREMENT
/begin MEASUREMENT B_nldval "Anforderung Steuergeräte Nachlauf wegen DVAL (Validierung)" UWORD B_TRUE 1 100 0 1 BIT_MASK 0x1 FORMAT "%13.11" ECU_ADDRESS 0x383CCA /end MEASUREMENT
/begin MEASUREMENT B_nldve "Anforderung Steuergerätenachlauf von DVE" UWORD B_TRUE 1 100 0 1 BIT_MASK 0x1000 FORMAT "%13.11" ECU_ADDRESS 0x383CCC /end MEASUREMENT
/begin MEASUREMENT B_nlEEPR "Bedingung Nachlauf EEPROM schreiben" UWORD B_TRUE 1 100 0 1 BIT_MASK 0x20 FORMAT "%13.11" ECU_ADDRESS 0x383CCC /end MEASUREMENT
/begin MEASUREMENT B_nletm "Bedingung Nachlauf tmot-Fehler" UWORD B_TRUE 1 100 0 1 BIT_MASK 0x4 FORMAT "%13.11" ECU_ADDRESS 0x383CCA /end MEASUREMENT
/begin MEASUREMENT B_nlfrOBP "" UBYTE B_TRUE 1 100 0 1 BIT_MASK 0x1 FORMAT "%13.11" ECU_ADDRESS 0x3833E9 /end MEASUREMENT
/begin MEASUREMENT B_nlmls "Anforderung Steuergerätenachlauf von Motor-Lüftersteuerung" UWORD B_TRUE 1 100 0 1 BIT_MASK 0x8 FORMAT "%13.11" ECU_ADDRESS 0x383CCC /end MEASUREMENT
/begin MEASUREMENT B_nlobd "Anforderung Steuergerätenachlauf von OBD" UWORD B_TRUE 1 100 0 1 BIT_MASK 0x10 FORMAT "%13.11" ECU_ADDRESS 0x383CCC /end MEASUREMENT
/begin MEASUREMENT B_nlOBP "" UBYTE B_TRUE 1 100 0 1 BIT_MASK 0x4 FORMAT "%13.11" ECU_ADDRESS 0x3833E9 /end MEASUREMENT
/begin MEASUREMENT B_nlph "Bedingung kein Phasensignal von den Phasengebern" UWORD B_TRUE 1 100 0 1 BIT_MASK 0x800 FORMAT "%13.11" ECU_ADDRESS 0xFD2A /end MEASUREMENT
/begin MEASUREMENT B_nlsgls "Anforderung Steuergerätenachlauf von Steuergeräte-Lüftersteuerung" UWORD B_TRUE 1 100 0 1 BIT_MASK 0x40 FORMAT "%13.11" ECU_ADDRESS 0x383CCC /end MEASUREMENT
/begin MEASUREMENT B_nlsiko "Bedingung Nachlauf EGAS-Überwachung" UWORD B_TRUE 1 100 0 1 BIT_MASK 0x80 FORMAT "%13.11" ECU_ADDRESS 0x383CCC /end MEASUREMENT
/begin MEASUREMENT B_nlubr "Bedingung Anforderung Steuergerätenachlauf für UBR-Diagnose" UWORD B_TRUE 1 100 0 1 BIT_MASK 0x2 FORMAT "%13.11" ECU_ADDRESS 0x383CCA /end MEASUREMENT
/begin MEASUREMENT B_nlwfs "SG-Bedingung SG-Nachlauf durch Wegfahrsperrensteuergerät" UWORD B_TRUE 1 100 0 1 BIT_MASK 0x400 FORMAT "%13.11" ECU_ADDRESS 0x383CCC /end MEASUREMENT
/begin MEASUREMENT B_nlwst "Anforderung Steuergerätenachlauf für Wiederholstarterkennung" UWORD B_TRUE 1 100 0 1 BIT_MASK 0x4 FORMAT "%13.11" ECU_ADDRESS 0x383CCC /end MEASUREMENT
/begin MEASUREMENT B_nmax "Bedingung Drehzahlbegrenzung aktiv" UWORD B_TRUE 1 100 0 1 BIT_MASK 0x8 FORMAT "%13.11" ECU_ADDRESS 0xFD8E /end MEASUREMENT
/begin MEASUREMENT B_nmaxd "Bedingung Drehzahlbegrenzung mit Einspritzausblendung an allen Zylindern" UWORD B_TRUE 1 100 0 1 BIT_MASK 0x10 FORMAT "%13.11" ECU_ADDRESS 0xFD8E /end MEASUREMENT
/begin MEASUREMENT B_noknldg "Drehzahl ist in zulässigem Fenster für Synchronisation im Notlauf" UWORD B_TRUE 1 100 0 1 BIT_MASK 0x80 FORMAT "%13.11" ECU_ADDRESS 0xFD30 /end MEASUREMENT
/begin MEASUREMENT B_nosynph "Flag für falsche Zylinderzuordnung bei Synchronisierlücke" UWORD B_TRUE 1 100 0 1 BIT_MASK 0x1000 FORMAT "%13.11" ECU_ADDRESS 0xFD2A /end MEASUREMENT
/begin MEASUREMENT B_notlu_fr "Anforderung Notluftfahren vom Funktionsrechner" UWORD B_TRUE 1 100 0 1 BIT_MASK 0x400 FORMAT "%13.11" ECU_ADDRESS 0xFD48 /end MEASUREMENT
/begin MEASUREMENT B_nozwe "Bedingung kein Zündwinkeleingriff der Drehmomentstruktur" UWORD B_TRUE 1 100 0 1 BIT_MASK 0x4000 FORMAT "%13.11" ECU_ADDRESS 0xFDA2 /end MEASUREMENT
/begin MEASUREMENT B_nsakt "Nachstart aktiv für Nachstartaufweitung" UWORD B_TRUE 1 100 0 1 BIT_MASK 0x800 FORMAT "%13.11" ECU_ADDRESS 0xFD8E /end MEASUREMENT
/begin MEASUREMENT B_nsend "Nachstartüberwachungszeit abgelaufen" UWORD B_TRUE 1 100 0 1 BIT_MASK 0x1000 FORMAT "%13.11" ECU_ADDRESS 0xFD8E /end MEASUREMENT
/begin MEASUREMENT B_nswo1 "Bedingung Drehzahl > NSWO1" UWORD B_TRUE 1 100 0 1 BIT_MASK 0x100 FORMAT "%13.11" ECU_ADDRESS 0xFD04 /end MEASUREMENT
/begin MEASUREMENT B_nswo2 "Bedingung Drehzahl > NSWO2" UWORD B_TRUE 1 100 0 1 BIT_MASK 0x200 FORMAT "%13.11" ECU_ADDRESS 0xFD04 /end MEASUREMENT
/begin MEASUREMENT B_nweapte "Ende der Ansteuerung Einlassnockenwelle in Aktivposition durch Tester" UBYTE B_TRUE 1 100 0 1 BIT_MASK 0x4 FORMAT "%13.11" ECU_ADDRESS 0x380B5F /end MEASUREMENT
/begin MEASUREMENT B_nwseve "Eingeschränkte Nockenwellenverstellung aktiv Einlassnockenwelle" UBYTE B_TRUE 1 100 0 1 BIT_MASK 0x1 FORMAT "%13.11" ECU_ADDRESS 0x380B5D /end MEASUREMENT
/begin MEASUREMENT B_nwtve "Bedingung NW-Tastverhältnis im PWM-Interrupt (Einlaß)" UBYTE B_TRUE 1 100 0 1 BIT_MASK 0x1 FORMAT "%13.11" ECU_ADDRESS 0x380B58 /end MEASUREMENT
/begin MEASUREMENT B_optpherk "Bedingung geeigneter Motorbetriebszustand für Phasenerkennung" UWORD B_TRUE 1 100 0 1 BIT_MASK 0x2000 FORMAT "%13.11" ECU_ADDRESS 0xFD2A /end MEASUREMENT
/begin MEASUREMENT B_phfalse "SW generierte Phasenpegelinformation ist unplausibel" UWORD B_TRUE 1 100 0 1 BIT_MASK 0x100 FORMAT "%13.11" ECU_ADDRESS 0xFD30 /end MEASUREMENT
/begin MEASUREMENT B_phnegtiv "Bedingung gibt an, ob der Interrupt von einer negativen Flanke ausgelöst wurde" UWORD B_TRUE 1 100 0 1 BIT_MASK 0x200 FORMAT "%13.11" ECU_ADDRESS 0xFD30 /end MEASUREMENT
/begin MEASUREMENT B_phnldg "Phasenlage aus Notlauf DG" UWORD B_TRUE 1 100 0 1 BIT_MASK 0x400 FORMAT "%13.11" ECU_ADDRESS 0xFD30 /end MEASUREMENT
/begin MEASUREMENT B_phsnl "Bedingung Phasensuche während PG-Notlauf" UWORD B_TRUE 1 100 0 1 BIT_MASK 0x4000 FORMAT "%13.11" ECU_ADDRESS 0xFD2A /end MEASUREMENT
/begin MEASUREMENT B_phsnlab "Bedingung Phasensuche während PG-Notlauf abgeschlossen" UWORD B_TRUE 1 100 0 1 BIT_MASK 0x8000 FORMAT "%13.11" ECU_ADDRESS 0xFD2A /end MEASUREMENT
/begin MEASUREMENT B_phsnlinv "Bedingung Phaselage invertieren" UWORD B_TRUE 1 100 0 1 BIT_MASK 0x1 FORMAT "%13.11" ECU_ADDRESS 0xFD2C /end MEASUREMENT
/begin MEASUREMENT B_phsnlok "Bedingung Phasensuche während PG-Notlauf erfolgreich" UWORD B_TRUE 1 100 0 1 BIT_MASK 0x2 FORMAT "%13.11" ECU_ADDRESS 0xFD2C /end MEASUREMENT
/begin MEASUREMENT B_plsolap "Umschaltbedingung: Soll-Ladedruck auf Applikationssolladedruck" UWORD B_TRUE 1 100 0 1 BIT_MASK 0x400 FORMAT "%13.11" ECU_ADDRESS 0xFD04 /end MEASUREMENT
/begin MEASUREMENT B_png "Bedingung Planetennachgelege vorhanden" UWORD B_TRUE 1 100 0 1 BIT_MASK 0x800 FORMAT "%13.11" ECU_ADDRESS 0xFD04 /end MEASUREMENT
/begin MEASUREMENT B_portStatusOld "" UWORD B_TRUE 1 100 0 1 BIT_MASK 0x8 FORMAT "%13.11" ECU_ADDRESS 0xFD08 /end MEASUREMENT
/begin MEASUREMENT B_pwfCsErr "Bedingung Checksummenfehler nach Powerfail" UWORD B_TRUE 1 100 0 1 BIT_MASK 0x800 FORMAT "%13.11" ECU_ADDRESS 0xFD9A /end MEASUREMENT
/begin MEASUREMENT B_rdeplaus "Bedingung: Rückdreher plausibel" UWORD B_TRUE 1 100 0 1 BIT_MASK 0x1 FORMAT "%13.11" ECU_ADDRESS 0xFD2A /end MEASUREMENT
/begin MEASUREMENT B_rdeundef "Bedingung: Rückdreher undefiniert / keine Aussage möglich" UWORD B_TRUE 1 100 0 1 BIT_MASK 0x2 FORMAT "%13.11" ECU_ADDRESS 0xFD2A /end MEASUREMENT
/begin MEASUREMENT B_resetsyn "Rücksetzbedingung für die Notlaufsynchronisation" UWORD B_TRUE 1 100 0 1 BIT_MASK 0x800 FORMAT "%13.11" ECU_ADDRESS 0xFD30 /end MEASUREMENT
/begin MEASUREMENT B_rgang "Bedingung Rückwärtsgang eingelegt" UWORD B_TRUE 1 100 0 1 BIT_MASK 0x800 FORMAT "%13.11" ECU_ADDRESS 0xFD84 /end MEASUREMENT
/begin MEASUREMENT B_rphsp "Bedingung für Zahnsignale zu schnell ausgegeben" UWORD B_TRUE 1 100 0 1 BIT_MASK 0x1000 FORMAT "%13.11" ECU_ADDRESS 0xFD30 /end MEASUREMENT
/begin MEASUREMENT B_sldsl4 "Bedingung: Freigabe Sekundärluft für Diagnosephase 4" UWORD B_TRUE 1 100 0 1 BIT_MASK 0x4 FORMAT "%13.11" ECU_ADDRESS 0x3849E8 /end MEASUREMENT
/begin MEASUREMENT B_slkhof "Bedingung Abschalten der Sekundärluftpumpe durch imlpr-Schwelle" UWORD B_TRUE 1 100 0 1 BIT_MASK 0x40 FORMAT "%13.11" ECU_ADDRESS 0xFD0E /end MEASUREMENT
/begin MEASUREMENT B_slkt "Bedingung: Freigabe Sekundärluft für Kurztest" UWORD B_TRUE 1 100 0 1 BIT_MASK 0x8 FORMAT "%13.11" ECU_ADDRESS 0x3849E8 /end MEASUREMENT
/begin MEASUREMENT B_slp "Bedingung für Sekundärluftpumpe" UWORD B_TRUE 1 100 0 1 BIT_MASK 0x80 FORMAT "%13.11" ECU_ADDRESS 0xFD0E /end MEASUREMENT
/begin MEASUREMENT B_slpanst "Bit zur Auswertung des Endstufenfehler in der %SLS" UWORD B_TRUE 1 100 0 1 BIT_MASK 0x400 FORMAT "%13.11" ECU_ADDRESS 0x3849E8 /end MEASUREMENT
/begin MEASUREMENT B_slpena "Bedingung Einschalten der Sekundärluftpumpe" UWORD B_TRUE 1 100 0 1 BIT_MASK 0x10 FORMAT "%13.11" ECU_ADDRESS 0x3849E8 /end MEASUREMENT
/begin MEASUREMENT B_slpmn "Mindestbetriebszeit der Sekundärluftpumpe" UWORD B_TRUE 1 100 0 1 BIT_MASK 0x100 FORMAT "%13.11" ECU_ADDRESS 0xFD0E /end MEASUREMENT
/begin MEASUREMENT B_slpoff "Sekundärluftpumpe abgeschaltet" UWORD B_TRUE 1 100 0 1 BIT_MASK 0x200 FORMAT "%13.11" ECU_ADDRESS 0xFD0E /end MEASUREMENT
/begin MEASUREMENT B_slpofst "Bedingung für Setzen Flip Flop  B_slpoff" UWORD B_TRUE 1 100 0 1 BIT_MASK 0x20 FORMAT "%13.11" ECU_ADDRESS 0x3849E8 /end MEASUREMENT
/begin MEASUREMENT B_sls "Bedingung Sekundärluft aktiv" UWORD B_TRUE 1 100 0 1 BIT_MASK 0x400 FORMAT "%13.11" ECU_ADDRESS 0xFD0E /end MEASUREMENT
/begin MEASUREMENT B_slsadap "Bedingung: Sekundärluftmassenadaption" UWORD B_TRUE 1 100 0 1 BIT_MASK 0x800 FORMAT "%13.11" ECU_ADDRESS 0xFD0E /end MEASUREMENT
/begin MEASUREMENT B_slsdis "Bedingung für  Abschalten der Sekundärluftpumpe" UWORD B_TRUE 1 100 0 1 BIT_MASK 0x80 FORMAT "%13.11" ECU_ADDRESS 0x3849E8 /end MEASUREMENT
/begin MEASUREMENT B_slserr "Bedingungen sperren Einschalten der Sekundärluftpumpe" UWORD B_TRUE 1 100 0 1 BIT_MASK 0x100 FORMAT "%13.11" ECU_ADDRESS 0x3849E8 /end MEASUREMENT
/begin MEASUREMENT B_slsfz "Bedingung SLS in Fahrzeug eingebaut" UWORD B_TRUE 1 100 0 1 BIT_MASK 0x1000 FORMAT "%13.11" ECU_ADDRESS 0xFD04 /end MEASUREMENT
/begin MEASUREMENT B_slsinhi "Bedingung sperrt Setzen von Bit B_sls" UWORD B_TRUE 1 100 0 1 BIT_MASK 0x40 FORMAT "%13.11" ECU_ADDRESS 0x3849E8 /end MEASUREMENT
/begin MEASUREMENT B_slsoab "Bedingung SLS ohne Abbruchkriterium durchgeführt" UWORD B_TRUE 1 100 0 1 BIT_MASK 0x1000 FORMAT "%13.11" ECU_ADDRESS 0xFD0E /end MEASUREMENT
/begin MEASUREMENT B_slsoff "Sekundärlufteinblasung nach Ausräumen der Sekundärluft beendet" UWORD B_TRUE 1 100 0 1 BIT_MASK 0x2000 FORMAT "%13.11" ECU_ADDRESS 0xFD0E /end MEASUREMENT
/begin MEASUREMENT B_slv "Bedingung für Sekundärluftventil" UWORD B_TRUE 1 100 0 1 BIT_MASK 0x4000 FORMAT "%13.11" ECU_ADDRESS 0xFD0E /end MEASUREMENT
/begin MEASUREMENT B_slvanst "Bit zur Auswertung des Endstufenfehler in der %SLS" UWORD B_TRUE 1 100 0 1 BIT_MASK 0x200 FORMAT "%13.11" ECU_ADDRESS 0x3849E8 /end MEASUREMENT
/begin MEASUREMENT B_stimnlph "Aussetzer stimuliert durch NLPH" UWORD B_TRUE 1 100 0 1 BIT_MASK 0x4 FORMAT "%13.11" ECU_ADDRESS 0xFD2C /end MEASUREMENT
/begin MEASUREMENT B_synnldg "Bedingung: Motorposition im Notlauf DG aus PG-Signal erkannt" UWORD B_TRUE 1 100 0 1 BIT_MASK 0x2000 FORMAT "%13.11" ECU_ADDRESS 0xFD30 /end MEASUREMENT
/begin MEASUREMENT B_synoknl "Synchronisation für den Notlauf ist erlaubt" UWORD B_TRUE 1 100 0 1 BIT_MASK 0x4000 FORMAT "%13.11" ECU_ADDRESS 0xFD30 /end MEASUREMENT
/begin MEASUREMENT B_temin "Bedingung TEMIN-Begrenzung aktiv, Bank 1" UWORD B_TRUE 1 100 0 1 BIT_MASK 0x4000 FORMAT "%13.11" ECU_ADDRESS 0xFD56 /end MEASUREMENT
/begin MEASUREMENT B_tfu "Bedingung Temperaturfühler Umgebung vorhanden" UWORD B_TRUE 1 100 0 1 BIT_MASK 0x2000 FORMAT "%13.11" ECU_ADDRESS 0xFD04 /end MEASUREMENT
/begin MEASUREMENT B_tnmxh "Bedingung: Zeitdauer für erhöhte Drehzahlgrenze abgelaufen" UWORD B_TRUE 1 100 0 1 BIT_MASK 0x20 FORMAT "%13.11" ECU_ADDRESS 0xFD8E /end MEASUREMENT
/begin MEASUREMENT B_uhrrmin "Bedingung Uhr mit relativem Minutenzähler" UWORD B_TRUE 1 100 0 1 BIT_MASK 0x4000 FORMAT "%13.11" ECU_ADDRESS 0xFD04 /end MEASUREMENT
/begin MEASUREMENT B_uhrrsec "Bedingung Uhr mit relativem Sekundenzähler" UWORD B_TRUE 1 100 0 1 BIT_MASK 0x8000 FORMAT "%13.11" ECU_ADDRESS 0xFD04 /end MEASUREMENT
/begin MEASUREMENT B_verrueck "Bedingung Verdacht Rückdrehen" UBYTE B_TRUE 1 100 0 1 BIT_MASK 0x2 FORMAT "%13.11" ECU_ADDRESS 0x380918 /end MEASUREMENT
/begin MEASUREMENT B_waitgap "Bedingung: Warten auf nächste Lückenüberprüfung bei RDE" UBYTE B_TRUE 1 100 0 1 BIT_MASK 0x4 FORMAT "%13.11" ECU_ADDRESS 0x380918 /end MEASUREMENT
/begin MEASUREMENT B_wdksap "DK-Steuerung über Festwert, Bit 1 hat Priorität" UWORD B_TRUE 1 100 0 1 BIT_MASK 0x1 FORMAT "%13.11" ECU_ADDRESS 0xFD06 /end MEASUREMENT
/begin MEASUREMENT B_wnwioutx "Bedingung für unplausiblen Winkelfehler" UWORD B_TRUE 1 100 0 1 BIT_MASK 0x8000 FORMAT "%13.11" ECU_ADDRESS 0xFD30 /end MEASUREMENT
/begin MEASUREMENT B_wnws0e "Bedingung NW-Sollwertvorgabe ist 0" UBYTE B_TRUE 1 100 0 1 BIT_MASK 0x1 FORMAT "%13.11" ECU_ADDRESS 0x380B5E /end MEASUREMENT
/begin MEASUREMENT B_zwappl "Bedingung Zündwinkelapplikation ohne Drehmomenteingriffe" UWORD B_TRUE 1 100 0 1 BIT_MASK 0x2 FORMAT "%13.11" ECU_ADDRESS 0xFD06 /end MEASUREMENT
/begin MEASUREMENT B_zwvzm "" UWORD B_TRUE 1 100 0 1 BIT_MASK 0x8000 FORMAT "%13.11" ECU_ADDRESS 0xFDA2 /end MEASUREMENT
/begin MEASUREMENT ccperSav "" UWORD dez 1 100 0 65535 FORMAT "%8.2" ECU_ADDRESS 0xF7BA /end MEASUREMENT
/begin MEASUREMENT ccpwSav "" UWORD dez 1 100 0 65535 FORMAT "%8.2" ECU_ADDRESS 0xF7BC /end MEASUREMENT
/begin MEASUREMENT cd_bits1_w "Sammelbits(Word)" UWORD dez 1 100 0 65535 FORMAT "%8.2" ECU_ADDRESS 0x380B94 /end MEASUREMENT
/begin MEASUREMENT cd_bits2_w "" UWORD dez 1 100 0 65535 FORMAT "%8.2" ECU_ADDRESS 0x380B96 /end MEASUREMENT
/begin MEASUREMENT cd_bits3_w "" UWORD dez 1 100 0 65535 FORMAT "%8.2" ECU_ADDRESS 0x380B98 /end MEASUREMENT
/begin MEASUREMENT cntbg_w "Anzahl Aufrufe des BG-Rasters pro Berechnungsintervall" UWORD dez 1 100 0 65535 FORMAT "%8.2" ECU_ADDRESS 0x382810 /end MEASUREMENT
/begin MEASUREMENT ctr_RSABlock "" UWORD dez 1 100 0 65535 FORMAT "%8.2" ECU_ADDRESS 0x382792 /end MEASUREMENT
/begin MEASUREMENT cw_erfil "Status Codewort Filtervariante für Ausgabe der AS-Fehler an GST" UBYTE dez 1 100 0 255 FORMAT "%5.1" ECU_ADDRESS 0x380888 /end MEASUREMENT
/begin MEASUREMENT cw_obd "Status Codewort CWOBD" UBYTE dez 1 100 0 255 FORMAT "%5.1" ECU_ADDRESS 0x380889 /end MEASUREMENT
/begin MEASUREMENT cyclebg_w "Laufzeit des Background-Task" UWORD runtime2_sy 1 100 0 699040 FORMAT "%8.1" ECU_ADDRESS 0x385314 /end MEASUREMENT
/begin MEASUREMENT dlwsu_w "Lenkwinkelgeschwindigkeit" SWORD dlw_sw_q0p04375 1 100 -1434.04 1434 FORMAT "%8.3" ECU_ADDRESS 0x38259C /end MEASUREMENT
/begin MEASUREMENT dmaufr_w "Delta Aufregelmoment" UWORD rel_uw_b100 1 100 0 99.9985 FORMAT "%8.5" ECU_ADDRESS 0x382C64 /end MEASUREMENT
/begin MEASUREMENT dmdwan_w "D-Anteil Wandlermoment bei Fahrstufe einlegen" UWORD rel_uw_b200 1 100 0 199.997 FORMAT "%8.4" ECU_ADDRESS 0x382552 /end MEASUREMENT
/begin MEASUREMENT dmnmxi_w "Drehmoment aus Integralanteil der NMAX-Regelung" SWORD rel_sw_b100 1 100 -100 99.9969 FORMAT "%8.4" ECU_ADDRESS 0x3826D4 /end MEASUREMENT
/begin MEASUREMENT dmnmxp_w "Drehmoment aus Proportionalanteil der NMAX-Regelung" SWORD rel_sw_b100 1 100 -100 99.9969 FORMAT "%8.4" ECU_ADDRESS 0x3826D6 /end MEASUREMENT
/begin MEASUREMENT dmr3lf_w "Drehmomentenreserve bei Elektrolüfter mit PWM-Ansteuerung" UWORD rel_uw_b100 1 100 0 99.9985 FORMAT "%8.5" ECU_ADDRESS 0x38259E /end MEASUREMENT
/begin MEASUREMENT dmrac "Reservemoment für AC-Kompressor" UBYTE rel_ub_b99p6 1 100 0 99.6094 FORMAT "%5.2" ECU_ADDRESS 0x380ABD /end MEASUREMENT
/begin MEASUREMENT dmrlf "Momentreserve für Lüfter" UBYTE rel_ub_b99p6 1 100 0 99.6094 FORMAT "%5.2" ECU_ADDRESS 0x380ABE /end MEASUREMENT
/begin MEASUREMENT dmrwan "Momentreserve für Drehmomentaufnahme des Wandlers" UBYTE rel_ub_b99p6 1 100 0 99.6094 FORMAT "%5.2" ECU_ADDRESS 0x380ABB /end MEASUREMENT
/begin MEASUREMENT dmvadfk_w "Delta-Motordrehmoment aus Verlustmoment-Adaption (B_fs=1 & B_ko=1)" SWORD rel_sw_b100 1 100 -100 99.9969 FORMAT "%8.4" ECU_ADDRESS 0x384068 /end MEASUREMENT
/begin MEASUREMENT dmvadfs_w "Delta-Motordrehmoment aus Verlustmoment-Adaption (B_fs=1)" SWORD rel_sw_b100 1 100 -100 99.9969 FORMAT "%8.4" ECU_ADDRESS 0x38406A /end MEASUREMENT
/begin MEASUREMENT dmvadko_w "Delta-Motordrehmoment aus Verlustmoment-Adaption (B_ko=1)" SWORD rel_sw_b100 1 100 -100 99.9969 FORMAT "%8.4" ECU_ADDRESS 0x38406C /end MEASUREMENT
/begin MEASUREMENT dmvadll_w "Delta-Motordrehmoment aus Verlustmoment-Adaption (B_ll=1)" SWORD rel_sw_b100 1 100 -100 99.9969 FORMAT "%8.4" ECU_ADDRESS 0x38406E /end MEASUREMENT
/begin MEASUREMENT dmvad_w "Delta-Motordrehmoment aus Verlustmoment-Adaption" SWORD rel_sw_b100 1 100 -100 99.9969 FORMAT "%8.4" ECU_ADDRESS 0x384C0E /end MEASUREMENT
/begin MEASUREMENT dmvamnfk_w "Minimalbegrenzung der Verlustmomentadaption (B_fs=1 & B_ko=1)" SWORD rel_sw_b100 1 100 -100 99.9969 FORMAT "%8.4" ECU_ADDRESS 0x384C10 /end MEASUREMENT
/begin MEASUREMENT dmvamnfs_w "Minimalbegrenzung der Verlustmomentadaption (B_fs=1)" SWORD rel_sw_b100 1 100 -100 99.9969 FORMAT "%8.4" ECU_ADDRESS 0x384C12 /end MEASUREMENT
/begin MEASUREMENT dmvamnko_w "Minimalbegrenzung der Verlustmomentadaption (B_ko=1)" SWORD rel_sw_b100 1 100 -100 99.9969 FORMAT "%8.4" ECU_ADDRESS 0x384C14 /end MEASUREMENT
/begin MEASUREMENT dmvamnll_w "Minimalbegrenzung der Verlustmomentadaption (B_ll=1)" SWORD rel_sw_b100 1 100 -100 99.9969 FORMAT "%8.4" ECU_ADDRESS 0x384C16 /end MEASUREMENT
/begin MEASUREMENT dmvamxfk_w "0aximalbegrenzung der Verlustmomentadaption (B_fs=1 & B_ko=1)" SWORD rel_sw_b100 1 100 -100 99.9969 FORMAT "%8.4" ECU_ADDRESS 0x384C18 /end MEASUREMENT
/begin MEASUREMENT dmvamxfs_w "Maximalbegrenzung der Verlustmomentadaption (B_fs=1)" SWORD rel_sw_b100 1 100 -100 99.9969 FORMAT "%8.4" ECU_ADDRESS 0x384C1A /end MEASUREMENT
/begin MEASUREMENT dmvamxko_w "Maximalbegrenzung der Verlustmomentadaption (B_ko=1)" SWORD rel_sw_b100 1 100 -100 99.9969 FORMAT "%8.4" ECU_ADDRESS 0x384C1C /end MEASUREMENT
/begin MEASUREMENT dmvamxll_w "Maximalbegrenzung der Verlustmomentadaption (B_ll=1)" SWORD rel_sw_b100 1 100 -100 99.9969 FORMAT "%8.4" ECU_ADDRESS 0x384C1E /end MEASUREMENT
/begin MEASUREMENT dmverl_w "Verlustmoment nach DT1-Filter" SWORD rel_sw_b100 1 100 -100 99.9969 FORMAT "%8.4" ECU_ADDRESS 0x3826B8 /end MEASUREMENT
/begin MEASUREMENT dnsi_w "Differenz zwischen Soll- und Ist-Motordrehzahl" SWORD nmot_sw_q0p25 1 100 -8192 8191.75 FORMAT "%8.3" ECU_ADDRESS 0x3826D8 /end MEASUREMENT
/begin MEASUREMENT dnturb_w "Turbinendrehzahldifferenz des Wandlers" SWORD nmot_q0p1453421 1 100 -4762.57 4762.42 FORMAT "%8.3" ECU_ADDRESS 0x382554 /end MEASUREMENT
/begin MEASUREMENT dpus_w "Delta Druck Umgebung Saugrohr" SWORD p_sw_q0p078 1 100 -2560 2559.92 FORMAT "%9.4" ECU_ADDRESS 0x384AEC /end MEASUREMENT
/begin MEASUREMENT dtimx_w "Differenz zwischen max.Einspritzzeit und theoretischer max. Einspritzzeit" SWORD tinjection_sy 1 100 -87.3813 87.3787 FORMAT "%8.5" ECU_ADDRESS 0x384AEE /end MEASUREMENT
/begin MEASUREMENT dtsegph_w "Faktor zur Bewertung der Motordynamik" SWORD t5usxus_q5 1 100 -163840 163835 FORMAT "%8.1" ECU_ADDRESS 0x381A2C /end MEASUREMENT
/begin MEASUREMENT dwnwse_w "Differenz zwischen geschätztem Nockenwellenwinkel und Sollwinkel (t-1) Einlass" SWORD kw_sw_q0p0078 1 100 -256 255.992 FORMAT "%8.4" ECU_ADDRESS 0x385394 /end MEASUREMENT
/begin MEASUREMENT dzws "Delta Zündwinekl zwischen zwopt und zwsol" SBYTE zw_sb_q0p75 1 100 -96 95.25 FORMAT "%5.2" ECU_ADDRESS 0x380B6C /end MEASUREMENT
/begin MEASUREMENT esst_smo08opub "" UWORD dez 1 100 0 65535 FORMAT "%8.2" ECU_ADDRESS 0x3826FC /end MEASUREMENT
/begin MEASUREMENT esst_snm06koub "" UWORD dez 1 100 0 65535 FORMAT "%8.2" ECU_ADDRESS 0x384C26 /end MEASUREMENT
/begin MEASUREMENT esst_srl06koub "" UWORD dez 1 100 0 65535 FORMAT "%8.2" ECU_ADDRESS 0x384C28 /end MEASUREMENT
/begin MEASUREMENT esst_sta06llub "" UWORD dez 1 100 0 65535 FORMAT "%8.2" ECU_ADDRESS 0x384C2A /end MEASUREMENT
/begin MEASUREMENT esst_stw08mdub "" UWORD dez 1 100 0 65535 FORMAT "%8.2" ECU_ADDRESS 0x384C20 /end MEASUREMENT
/begin MEASUREMENT etazws "Sollzündwinkelwirkungsgrad" UBYTE rel_ub_b127p5 1 100 0 127.5 FORMAT "%5.1" ECU_ADDRESS 0x380B6D /end MEASUREMENT
/begin MEASUREMENT evtmodev "Spulentemperatur eines Einspritzventils" UBYTE temp_ub_q0p75_o48 1 100 -48 143.25 FORMAT "%5.1" ECU_ADDRESS 0x384884 /end MEASUREMENT
/begin MEASUREMENT flamsl_w "Faktor Lambdaänderung durch Sekundärluft" UWORD fak_uw_b16 1 100 0 15.9998 FORMAT "%8.5" ECU_ADDRESS 0x3849DA /end MEASUREMENT
/begin MEASUREMENT flmssl "Faktor Lambda-Motor-Soll-Sekundärluftanteil" UBYTE fak_ub_b1 1 100 0 0.996094 ECU_ADDRESS 0x38480C /end MEASUREMENT
/begin MEASUREMENT fmsagd "Korrekturfaktor Abgasgegendruck der Sekundärluftmasse" UBYTE fak_ub_b2 1 100 0 1.99219 FORMAT "%5.3" ECU_ADDRESS 0x38480D /end MEASUREMENT
/begin MEASUREMENT fmsldyn "Faktor Dynamikbeschreibung Sekundärluft" UBYTE fak_ub_b1 1 100 0 0.996094 ECU_ADDRESS 0x38480E /end MEASUREMENT
/begin MEASUREMENT fmslkor "Faktor zur Korrektur der Sekundärluftmasse" UBYTE fak_ub_b8 1 100 0 7.96875 FORMAT "%5.3" ECU_ADDRESS 0x38480F /end MEASUREMENT
/begin MEASUREMENT fmslrho "Dichtekorrektur der Sekundärluftmasse" UBYTE fak_ub_b2 1 100 0 1.99219 FORMAT "%5.3" ECU_ADDRESS 0x384810 /end MEASUREMENT
/begin MEASUREMENT fmsltm "tmot- Korrektur der Sekundärluftmasse" UBYTE fak_ub_b2 1 100 0 1.99219 FORMAT "%5.3" ECU_ADDRESS 0x384811 /end MEASUREMENT
/begin MEASUREMENT fnwaa "Faktor Wichtung NW-Auslaß" UBYTE fak_ub_b1 1 100 0 0.996094 ECU_ADDRESS 0x380B5A /end MEASUREMENT
/begin MEASUREMENT fnwea "Faktor Wichtung NW-Einlaß" UBYTE fak_ub_b1 1 100 0 0.996094 ECU_ADDRESS 0x380B5B /end MEASUREMENT
/begin MEASUREMENT fnwua "Gewichtungsfaktor Nockenwellenüberschneidung (Auslaß)" UBYTE fak_ub_b1 1 100 0 0.996094 ECU_ADDRESS 0x384913 /end MEASUREMENT
/begin MEASUREMENT fnwue "Gewichtungsfaktor Nockenwellenüberschneidung (Einlaß)" UBYTE fak_ub_b1 1 100 0 0.996094 ECU_ADDRESS 0x384914 /end MEASUREMENT
/begin MEASUREMENT fnwu_w "Faktor Nockenwellen Gesamtüberschneidung" UWORD fak_uw_b2 1 100 0 1.99997 FORMAT "%8.6" ECU_ADDRESS 0x38536A /end MEASUREMENT
/begin MEASUREMENT fnwwarme "Faktor Nockenwellensollwinkel Übergang kalt -> Warmkennfelder Einlaß" UBYTE fak_ub_b2 1 100 0 1.99219 FORMAT "%5.3" ECU_ADDRESS 0x384927 /end MEASUREMENT
/begin MEASUREMENT frkte_w "Faktor Umrechnung rel. Kraftstoffmasse rk in effekt. Einspritzzeit te" UWORD rkti11_sy 1 100 0 7.28167 FORMAT "%8.6" ECU_ADDRESS 0x384AF0 /end MEASUREMENT
/begin MEASUREMENT fslpdyn "Faktor Dynamikbeschreibung Sekundärluftpumpe" UBYTE fak_ub_b1 1 100 0 0.996094 ECU_ADDRESS 0x384812 /end MEASUREMENT
/begin MEASUREMENT ftek_w "Korrekturfaktor für effektive Einspritzzeit" UWORD fak_uw_b2 1 100 0 1.99997 FORMAT "%8.6" ECU_ADDRESS 0x3820A2 /end MEASUREMENT
/begin MEASUREMENT grundwert "Abstand SW-Bezugsmarke zu OT in °KW" UBYTE dez 1 100 0 255 FORMAT "%5.1" ECU_ADDRESS 0x38088A /end MEASUREMENT
/begin MEASUREMENT imlsla_w "Luftmassenintegral für Einbringen der Sekundärluft" UWORD m_uw_b4660 1 100 0 4660.27 FORMAT "%8.3" ECU_ADDRESS 0x3849DC /end MEASUREMENT
/begin MEASUREMENT imlsle_w "Luftmassenintegral für Ende der Sekundärluft im Abgas" UWORD m_uw_b4660 1 100 0 4660.27 FORMAT "%8.3" ECU_ADDRESS 0x3849DE /end MEASUREMENT
/begin MEASUREMENT itnmaxp_w "Timer abwärts für Aktivierungsdauer der alternativen Reglerabstimmung" UWORD t10msxs_uw_b655p35 1 100 0 655.35 FORMAT "%8.4" ECU_ADDRESS 0x3826DA /end MEASUREMENT
/begin MEASUREMENT itnmxh_w "Timer abwärts, Zeitdauer unterhalb unterer Drehzahlgrenze" UWORD t10msxs_uw_b655p35 1 100 0 655.35 FORMAT "%8.4" ECU_ADDRESS 0x3826DC /end MEASUREMENT
/begin MEASUREMENT kfmds_w "Schleppmoment Drehzahl- und Lastabhängigkeit" UWORD rel_uw_b100 1 100 0 99.9985 FORMAT "%8.5" ECU_ADDRESS 0x384C36 /end MEASUREMENT
/begin MEASUREMENT kinmx "Verstärkung Integralanteil der NMAX-Regelung" UBYTE relnmot_q0p02 1 100 0 5.1 FORMAT "%5.3" ECU_ADDRESS 0x3848E8 /end MEASUREMENT
/begin MEASUREMENT laufzbg_w "Laufzeit fuer Background-Task" UWORD runtime1_sy 1 100 0 43690 FORMAT "%8.2" ECU_ADDRESS 0x385316 /end MEASUREMENT
/begin MEASUREMENT laufzmbg_w "gemittelte Laufzeit fuer Background-Task" UWORD runtime1_sy 1 100 0 43690 FORMAT "%8.2" ECU_ADDRESS 0x385318 /end MEASUREMENT
/begin MEASUREMENT lzmaxnmot "Drehzahl waehrend maximaler Last" UBYTE nmot_ub_q40 1 100 0 10200 FORMAT "%5.0" ECU_ADDRESS 0x3833EA /end MEASUREMENT
/begin MEASUREMENT lzmaxrl "Relative Luftfuellung waehrend maximaler Last" UBYTE rel_ub_b99p6 1 100 0 99.6094 FORMAT "%5.2" ECU_ADDRESS 0x3833EB /end MEASUREMENT
/begin MEASUREMENT lzmaxstate "Bitbasis fuer Statusbits" UBYTE dez 1 100 0 255 FORMAT "%5.1" ECU_ADDRESS 0x3833EC /end MEASUREMENT
/begin MEASUREMENT lzmaxwdkba "Relativer Drosselklappenwinkel waehrend maximaler Last" UBYTE relDK_ub_b100 1 100 0 100 FORMAT "%5.1" ECU_ADDRESS 0x3833ED /end MEASUREMENT
/begin MEASUREMENT lzmaxwped "Relativer Fahrpedalwinkel waehrend maximaler Last" UBYTE rel_ub_b99p6 1 100 0 99.6094 FORMAT "%5.2" ECU_ADDRESS 0x3833EE /end MEASUREMENT
/begin MEASUREMENT md3lf_w "Lüftermoment bei Elektrolüfter mit PWM-Ansteuerung" UWORD rel_uw_b100 1 100 0 99.9985 FORMAT "%8.5" ECU_ADDRESS 0x3825A0 /end MEASUREMENT
/begin MEASUREMENT mdatxm_w "Drehmomentaufnahme des Wandlers bei B_fs = false" UWORD rel_uw_b200 1 100 0 199.997 FORMAT "%8.4" ECU_ADDRESS 0x382556 /end MEASUREMENT
/begin MEASUREMENT mddlws_w "Lastmoment abhängig vom Lenkwinkelgradient" SWORD rel_sw_b50 1 100 -50 49.9985 FORMAT "%8.5" ECU_ADDRESS 0x3825A2 /end MEASUREMENT
/begin MEASUREMENT mdgen_w "Generatormoment" UWORD rel_uw_b100 1 100 0 99.9985 FORMAT "%8.5" ECU_ADDRESS 0x3825A4 /end MEASUREMENT
/begin MEASUREMENT mdkoini "Kompressormoment beim Einschalten" UBYTE rel_ub_b99p6 1 100 0 99.6094 FORMAT "%5.2" ECU_ADDRESS 0x3848E2 /end MEASUREMENT
/begin MEASUREMENT mdko_w "Momentenaufnahme Klimakompressor" UWORD rel_uw_b100 1 100 0 99.9985 FORMAT "%8.5" ECU_ADDRESS 0x3825A6 /end MEASUREMENT
/begin MEASUREMENT mdlfs_w "Momentenaufnahme des Motorlüfters" UWORD rel_uw_b100 1 100 0 99.9985 FORMAT "%8.5" ECU_ADDRESS 0x3825A8 /end MEASUREMENT
/begin MEASUREMENT mdlws_w "Lastmoment abhängig vom Lenkwinkel" UWORD rel_uw_b100 1 100 0 99.9985 FORMAT "%8.5" ECU_ADDRESS 0x3825AA /end MEASUREMENT
/begin MEASUREMENT mdns_w "Nachstartmoment" UWORD rel_uw_b100 1 100 0 99.9985 FORMAT "%8.5" ECU_ADDRESS 0x3826BA /end MEASUREMENT
/begin MEASUREMENT mdslpf_w "Momentenaufnahme der Sekundärluftpumpe" UWORD rel_uw_b100 1 100 0 99.9985 FORMAT "%8.5" ECU_ADDRESS 0x3825AC /end MEASUREMENT
/begin MEASUREMENT mdsm_w "Schleppmoment Temperatur-Anteil" UWORD rel_uw_b100 1 100 0 99.9985 FORMAT "%8.5" ECU_ADDRESS 0x384C38 /end MEASUREMENT
/begin MEASUREMENT mdswl_w "Verbrauchermoment: Servolenkung" UWORD rel_uw_b100 1 100 0 99.9985 FORMAT "%8.5" ECU_ADDRESS 0x3825AE /end MEASUREMENT
/begin MEASUREMENT mds_w "Motorschleppmoment" UWORD rel_uw_b100 1 100 0 99.9985 FORMAT "%8.5" ECU_ADDRESS 0x3826BC /end MEASUREMENT
/begin MEASUREMENT MDVERADlokbits "" UBYTE dez 1 100 0 255 FORMAT "%5.1" ECU_ADDRESS 0x380ABA /end MEASUREMENT
/begin MEASUREMENT mdverb "Momentenbedarf der Nebenaggregate" UBYTE rel_ub_b100 1 100 0 99.6094 FORMAT "%5.2" ECU_ADDRESS 0x380ABF /end MEASUREMENT
/begin MEASUREMENT mdverb_w "Momentenbedarf der Nebenaggregate" UWORD rel_uw_b100 1 100 0 99.9985 FORMAT "%8.5" ECU_ADDRESS 0x3825B0 /end MEASUREMENT
/begin MEASUREMENT mdverf_w "Gefiltertes Verlustmoment" UWORD rel_uw_b100 1 100 0 99.9985 FORMAT "%8.5" ECU_ADDRESS 0x3826BE /end MEASUREMENT
/begin MEASUREMENT mdverl_w "Motor-Verlustmoment" UWORD rel_uw_b100 1 100 0 99.9985 FORMAT "%8.5" ECU_ADDRESS 0x3826C0 /end MEASUREMENT
/begin MEASUREMENT mdvervf_w "ungefiltertes Verlustmoment" SWORD rel_sw_b100 1 100 -100 99.9969 FORMAT "%8.4" ECU_ADDRESS 0x3826C2 /end MEASUREMENT
/begin MEASUREMENT mdvglw_w "Momentenbedarf der Vorgelegewelle" UWORD rel_uw_b100 1 100 0 99.9985 FORMAT "%8.5" ECU_ADDRESS 0x3826C4 /end MEASUREMENT
/begin MEASUREMENT mdwancb_w "Drehmomentaufnahme des Wandlers über CAN nach Begrenzung" UWORD rel_uw_b200 1 100 0 199.997 FORMAT "%8.4" ECU_ADDRESS 0x382558 /end MEASUREMENT
/begin MEASUREMENT mdwanvf_w "Drehmomentaufnahme des Wandlers vor Filterung" UWORD rel_uw_b200 1 100 0 199.997 FORMAT "%8.4" ECU_ADDRESS 0x38255A /end MEASUREMENT
/begin MEASUREMENT mdwan_w "Drehmomentaufnahme des Wandlers" UWORD rel_uw_b200 1 100 0 199.997 FORMAT "%8.4" ECU_ADDRESS 0x38255C /end MEASUREMENT
/begin MEASUREMENT mifabh_w "begrenztes ind. Motormoment Fahrerwunsch (sample & hold)" UWORD rel_uw_b100 1 100 0 99.9985 FORMAT "%8.5" ECU_ADDRESS 0x384C3A /end MEASUREMENT
/begin MEASUREMENT minmxb_w "indiziertes Soll-Moment für NMAX-Begrenzung ohne Begrenzung" SWORD rel_sw_b100 1 100 -100 99.9969 FORMAT "%8.4" ECU_ADDRESS 0x3826DE /end MEASUREMENT
/begin MEASUREMENT minmx_w "Momentenanforderung der Drehzahlbegrenzung" UWORD rel_uw_b100 1 100 0 99.9985 FORMAT "%8.5" ECU_ADDRESS 0x3826E0 /end MEASUREMENT
/begin MEASUREMENT miszullb_w "Maximal zulässiges indiziertes Moment für Luftpfad (begrenzt)" UWORD rel_uw_b100 1 100 0 99.9985 FORMAT "%8.5" ECU_ADDRESS 0x3826FE /end MEASUREMENT
/begin MEASUREMENT miszull_w "Maximal zulässiges indiziertes Moment für Luftpfad" UWORD rel_uw_b100 1 100 0 99.9985 FORMAT "%8.5" ECU_ADDRESS 0x382700 /end MEASUREMENT
/begin MEASUREMENT miszul_w "Maximal zulässiges indiziertes Moment" UWORD rel_uw_b100 1 100 0 99.9985 FORMAT "%8.5" ECU_ADDRESS 0x382702 /end MEASUREMENT
/begin MEASUREMENT mitibgri_w "I-Anteil für begrenztes Moment aus ti-Regelung bei ununterbrochener Einspritzung" UWORD rel_uw_b100 1 100 0 99.9985 FORMAT "%8.5" ECU_ADDRESS 0x384AF2 /end MEASUREMENT
/begin MEASUREMENT mitibgrp_w "P-Anteil für begrenztes Moment aus ti-Regelung bei ununterbrochener Einspritzung" SWORD rel_uw_b100 1 100 -50 49.9985 FORMAT "%8.5" ECU_ADDRESS 0x384AF4 /end MEASUREMENT
/begin MEASUREMENT mitibgr_w "begrenztes Moment aus ti-Regelung bei ununterbrochener Einspritzung" UWORD rel_uw_b100 1 100 0 99.9985 FORMAT "%8.5" ECU_ADDRESS 0x384AF6 /end MEASUREMENT
/begin MEASUREMENT mizufil_w "Zulässiges indiziertes Moment nach Filter" UWORD rel_uw_b100 1 100 0 99.9985 FORMAT "%8.5" ECU_ADDRESS 0x382704 /end MEASUREMENT
/begin MEASUREMENT mizuofil "Zulässiges indiziertes Moment ohne Filter" UBYTE rel_ub_b99p6 1 100 0 99.6094 FORMAT "%5.2" ECU_ADDRESS 0x380AE1 /end MEASUREMENT
/begin MEASUREMENT mizuvfil "Zulässiges indiziertes Moment vor Filter" UBYTE rel_ub_b99p6 1 100 0 99.6094 FORMAT "%5.2" ECU_ADDRESS 0x380AE2 /end MEASUREMENT
/begin MEASUREMENT msl "Sekundärluftmassenstrom" UBYTE m_ub_q0p4 1 100 0 102 FORMAT "%5.1" ECU_ADDRESS 0x384813 /end MEASUREMENT
/begin MEASUREMENT mslkorr_w "korr. Sekundärluftmassenstrom unter Berücksichtigung der Pumpendynamik (Bank1)" UWORD m_uw_b6553p5 1 100 0 6553.5 FORMAT "%8.3" ECU_ADDRESS 0x3849E0 /end MEASUREMENT
/begin MEASUREMENT mslpub_w "Sekundärluftmassenstrom, batteriespannungsabhängig 16-Bit" UWORD m_uw_b6553p5 1 100 0 6553.5 FORMAT "%8.3" ECU_ADDRESS 0x3849E2 /end MEASUREMENT
/begin MEASUREMENT mslstat "statischer Sekundärluftmassenstrom" UBYTE m_ub_q0p4 1 100 0 102 FORMAT "%5.1" ECU_ADDRESS 0x384814 /end MEASUREMENT
/begin MEASUREMENT mslstat_w "statische Sekundärluftmassestrom, 16-Bit" UWORD m_uw_b6553p5 1 100 0 6553.5 FORMAT "%8.3" ECU_ADDRESS 0x3849E4 /end MEASUREMENT
/begin MEASUREMENT msl_w "Sekundärluftmassenstrom 16-Bit Wert" UWORD m_uw_b6553p5 1 100 0 6553.5 FORMAT "%8.3" ECU_ADDRESS 0x3849E6 /end MEASUREMENT
/begin MEASUREMENT mtsegph_w "Gleitender Mittelwert der Phasenperiodendauer" UWORD t40usxus_q40 1 100 0 2.6214e+006 FORMAT "%8.0" ECU_ADDRESS 0x381A2E /end MEASUREMENT
/begin MEASUREMENT nmaxdvg_w "gangabhängige Drehzahlbegrenzung bei Fehlererkennung Geschwindigkeitssignal" UWORD nmot_uw_q0p25 1 100 0 16383.8 FORMAT "%8.2" ECU_ADDRESS 0x384C3C /end MEASUREMENT
/begin MEASUREMENT nmaxga_w "Maximal zulässige gangabhängige Motordrehzahl" UWORD nmot_uw_q0p25 1 100 0 16383.8 FORMAT "%8.2" ECU_ADDRESS 0x384C3E /end MEASUREMENT
/begin MEASUREMENT nmax_w "Drehzahlgrenze ohne Berücksichtigung von Drosselklappen-Fehlern" UWORD nmot_uw_q0p25 1 100 0 16383.8 FORMAT "%8.2" ECU_ADDRESS 0x3826E2 /end MEASUREMENT
/begin MEASUREMENT nmotpr_w "Prädizierte Motordrehzahl für NMAX-Regelung" UWORD nmot_uw_q0p25 1 100 0 16383.8 FORMAT "%8.2" ECU_ADDRESS 0x3826E4 /end MEASUREMENT
/begin MEASUREMENT nmxpr "Verstärkung Proportionalanteil der NMAX-Regelung" UBYTE relnmot_q0p0039 1 100 0 0.996094 ECU_ADDRESS 0x3848E9 /end MEASUREMENT
/begin MEASUREMENT nsber_w "Solldrehzahl für NMAX-Regelung" UWORD nmot_uw_q0p25 1 100 0 16383.8 FORMAT "%8.2" ECU_ADDRESS 0x3826E6 /end MEASUREMENT
/begin MEASUREMENT nsynnldg "Neusynchronisationsmonitor für NLDG" UBYTE dez 1 100 0 255 FORMAT "%5.1" ECU_ADDRESS 0x380933 /end MEASUREMENT
/begin MEASUREMENT nsynnlph "Neusynchronisationsmonitor für NLPH" UBYTE dez 1 100 0 255 FORMAT "%5.1" ECU_ADDRESS 0x380924 /end MEASUREMENT
/begin MEASUREMENT nturbv_w "Vorraussichtliche Turbinendrehzahl des Wandlers" UWORD nmot_q0p1453421 1 100 0 9524.99 FORMAT "%8.3" ECU_ADDRESS 0x38255E /end MEASUREMENT
/begin MEASUREMENT nturb_w "Turbinendrehzahl des Wandlers" UWORD nmot_q0p1453421 1 100 0 9524.99 FORMAT "%8.3" ECU_ADDRESS 0x382560 /end MEASUREMENT
/begin MEASUREMENT NWEVOausbits01 "" UBYTE dez 1 100 0 255 FORMAT "%5.1" ECU_ADDRESS 0x380B5D /end MEASUREMENT
/begin MEASUREMENT NWSOLLEausbits "" UBYTE dez 1 100 0 255 FORMAT "%5.1" ECU_ADDRESS 0x380B5E /end MEASUREMENT
/begin MEASUREMENT NWSOLLElokbits "" UBYTE dez 1 100 0 255 FORMAT "%5.1" ECU_ADDRESS 0x380B5F /end MEASUREMENT
/begin MEASUREMENT NWSYVARausbits "" UBYTE dez 1 100 0 255 FORMAT "%5.1" ECU_ADDRESS 0x380B58 /end MEASUREMENT
/begin MEASUREMENT OBPSWOFFbits "" UBYTE dez 1 100 0 255 FORMAT "%5.1" ECU_ADDRESS 0x3833E9 /end MEASUREMENT
/begin MEASUREMENT PercentToResetmax_w "" UWORD rel_uw_b100 1 100 0 99.9985 FORMAT "%8.5" ECU_ADDRESS 0x384070 /end MEASUREMENT
/begin MEASUREMENT PercentToReset_w "" UWORD rel_uw_b100 1 100 0 99.9985 FORMAT "%8.5" ECU_ADDRESS 0x38531A /end MEASUREMENT
/begin MEASUREMENT perfilt_bg "Gefilterte Systemauslastung, berechnet im Background-Task" UWORD rel_uw_b100 1 100 0 99.9985 FORMAT "%8.5" ECU_ADDRESS 0x382812 /end MEASUREMENT
/begin MEASUREMENT perfmax_w "Maximale system Belastung" UWORD rel_uw_b100 1 100 0 99.9985 FORMAT "%8.5" ECU_ADDRESS 0x383CD2 /end MEASUREMENT
/begin MEASUREMENT perform_bg "Aktuelle Systemauslastung, berechnet im Background-Task" UWORD rel_uw_b100 1 100 0 99.9985 FORMAT "%8.5" ECU_ADDRESS 0x382814 /end MEASUREMENT
/begin MEASUREMENT phLosCtr_w "Zähler Neusynchronisation durch falsche Synchronisation an BM (word)" UWORD dez 1 100 0 65535 FORMAT "%8.2" ECU_ADDRESS 0x383C4C /end MEASUREMENT
/begin MEASUREMENT qntns "Quotient aus Turbinendrehzahl des Wandlers und Solldrehzahl der LLR" UBYTE fak_ub_b8 1 100 0 7.96875 FORMAT "%5.3" ECU_ADDRESS 0x380ABC /end MEASUREMENT
/begin MEASUREMENT rdeBits "" UBYTE dez 1 100 0 255 FORMAT "%5.1" ECU_ADDRESS 0x380918 /end MEASUREMENT
/begin MEASUREMENT resetMonIdx "" UWORD dez 1 100 0 65535 FORMAT "%8.2" ECU_ADDRESS 0x384072 /end MEASUREMENT
/begin MEASUREMENT RKTIlokbits "" UBYTE dez 1 100 0 255 FORMAT "%5.1" ECU_ADDRESS 0x3809E6 /end MEASUREMENT
/begin MEASUREMENT rlossCtr_w "Zähler der jeden Task-Verlust" UWORD dez 1 100 0 65535 FORMAT "%8.2" ECU_ADDRESS 0x383CD4 /end MEASUREMENT
/begin MEASUREMENT rstMon "" UWORD dez 1 100 0 65535 FORMAT "%8.2" ARRAY_SIZE 12 ECU_ADDRESS 0x384074 /end MEASUREMENT
/begin MEASUREMENT scattBits "" UBYTE dez 1 100 0 255 FORMAT "%5.1" ECU_ADDRESS 0x3808FD /end MEASUREMENT
/begin MEASUREMENT SLSlokBits "" UWORD dez 1 100 0 65535 FORMAT "%8.2" ECU_ADDRESS 0x3849E8 /end MEASUREMENT
/begin MEASUREMENT statetnwe "Anzeige: aktueller Zustand bei Ansteuerung Einlaßnockenwelle durch Tester" UBYTE dez 1 100 0 255 FORMAT "%5.1" ECU_ADDRESS 0x384926 /end MEASUREMENT
/begin MEASUREMENT swOffD2Bits "" UWORD dez 1 100 0 65535 FORMAT "%8.2" ECU_ADDRESS 0x383CCA /end MEASUREMENT
/begin MEASUREMENT swOffDlBits "" UWORD dez 1 100 0 65535 FORMAT "%8.2" ECU_ADDRESS 0x383CCC /end MEASUREMENT
/begin MEASUREMENT S_NLENAS "" UWORD B_TRUE 1 100 0 1 BIT_MASK 0x2 FORMAT "%13.11" ECU_ADDRESS 0xFD90 /end MEASUREMENT
/begin MEASUREMENT tcchats_w "Highzeit Abgastemperatursensor von CC-Einheit" UWORD dez 1 100 0 65535 FORMAT "%8.2" ECU_ADDRESS 0xF7BE /end MEASUREMENT
/begin MEASUREMENT tccpats_w "Periodendauer Abgastemperatursensor von CC-Einheit" UWORD dez 1 100 0 65535 FORMAT "%8.2" ECU_ADDRESS 0xF7C0 /end MEASUREMENT
/begin MEASUREMENT tevfakge_w "Adressierung Kennfeld FKKVS mit effektiver Einspritzzeit vor Feinabgleich" UWORD tinjection_sy 1 100 0 174.76 FORMAT "%8.4" ECU_ADDRESS 0x3820A4 /end MEASUREMENT
/begin MEASUREMENT tevfa_w "effektive Einspritzzeit vor Feinabgleich (word)" UWORD tinjection_sy 1 100 0 174.76 FORMAT "%8.4" ECU_ADDRESS 0x3820A6 /end MEASUREMENT
/begin MEASUREMENT te_w "Effektive Einspritzzeit (word)" UWORD tinjection_sy 1 100 0 174.76 FORMAT "%8.4" ECU_ADDRESS 0x3820A8 /end MEASUREMENT
/begin MEASUREMENT timevovCtrOld "" UWORD dez 1 100 0 65535 FORMAT "%8.2" ECU_ADDRESS 0xF7C2 /end MEASUREMENT
/begin MEASUREMENT timxth_w "theoretische maximale Einspritzzeit" UWORD tinjection_sy 1 100 0 174.76 FORMAT "%8.4" ECU_ADDRESS 0x384AF8 /end MEASUREMENT
/begin MEASUREMENT timx_w "maximale Einspritzzeit" UWORD tinjection_sy 1 100 0 174.76 FORMAT "%8.4" ECU_ADDRESS 0x384AFA /end MEASUREMENT
/begin MEASUREMENT ti_b1 "Einspritzzeit für EV's auf Bank1" UWORD tinjection_sy 1 100 0 174.76 FORMAT "%8.4" ECU_ADDRESS 0x3820AA /end MEASUREMENT
/begin MEASUREMENT ti_b2 "Einspritzzeit für EV's auf Bank2" UWORD tinjection_sy 1 100 0 174.76 FORMAT "%8.4" ECU_ADDRESS 0x3820AC /end MEASUREMENT
/begin MEASUREMENT ti_tvu_w "Batteriespannungsabhängige Einspritzzeitkorrektur CPU-Quantisierung" UWORD tinjection_sy 1 100 0 174.76 FORMAT "%8.4" ECU_ADDRESS 0xF9CC /end MEASUREMENT
/begin MEASUREMENT ti_w "Einspritzzeit" UWORD tinjection5_sy 1 100 0 873.8 FORMAT "%8.4" ECU_ADDRESS 0x3820AE /end MEASUREMENT
/begin MEASUREMENT tlok "Außentemperatur als Lastinformation für Klimakompressor" UBYTE temp_ub_q0p75_o48 1 100 -48 143.25 FORMAT "%5.1" ECU_ADDRESS 0x3848E3 /end MEASUREMENT
/begin MEASUREMENT tnachlOBP "" UWORD t100msxs_uw_b6553p6 1 100 0 6553.5 FORMAT "%8.3" ECU_ADDRESS 0x383CD0 /end MEASUREMENT
/begin MEASUREMENT tnachl_w "SG-Nachlaufzeit" UWORD t100msxs_uw_b6553p6 1 100 0 6553.5 FORMAT "%8.3" ECU_ADDRESS 0x383CCE /end MEASUREMENT
/begin MEASUREMENT tnbmphs0_w "Zahnperiodendauer eines NBM-Signals durch linearen Algorithmus" UWORD t5usxus_q5 1 100 0 327675 FORMAT "%8.1" ECU_ADDRESS 0x381A30 /end MEASUREMENT
/begin MEASUREMENT tnbmrde "Zahnperiodenzeit des letzten nbm Signals (in 1ms Raster)" UBYTE t1msxms_q1 1 100 0 255 FORMAT "%5.1" ECU_ADDRESS 0xF8BC /end MEASUREMENT
/begin MEASUREMENT tnbmrde1 "Zahnperiodenzeit des zweitletzten nbm Signals (in 1ms Raster)" UBYTE t1msxms_q1 1 100 0 255 FORMAT "%5.1" ECU_ADDRESS 0xF8BD /end MEASUREMENT
/begin MEASUREMENT tnbmrde2 "Zahnperiodenzeit des drittletzten nbm Signals (in 1ms Raster)" UBYTE t1msxms_q1 1 100 0 255 FORMAT "%5.1" ECU_ADDRESS 0xF8BE /end MEASUREMENT
/begin MEASUREMENT tnmax_w "Zeit bis zur Umschaltung der Abstimmung der Drehzahlbegrenzung" UWORD t10msxs_uw_b655p35 1 100 0 655.35 FORMAT "%8.4" ECU_ADDRESS 0x384C40 /end MEASUREMENT
/begin MEASUREMENT tnmxh_w "Timer abwärts für Zeit oberhalb der unteren Drehzahlgrenze" UWORD t10msxs_uw_b655p35 1 100 0 655.35 FORMAT "%8.4" ECU_ADDRESS 0x3826E8 /end MEASUREMENT
/begin MEASUREMENT tnscCtr_w "Nachstartzeitzähler für die Nachstart Momentenaufweitung" UWORD t20msxs_uw_q0p02 1 100 0 1310.7 FORMAT "%8.3" ECU_ADDRESS 0x382706 /end MEASUREMENT
/begin MEASUREMENT tnsofCtr "" UBYTE t20msxs_ub_b5p1 1 100 0 5.1 FORMAT "%5.3" ECU_ADDRESS 0x380AE3 /end MEASUREMENT
/begin MEASUREMENT tnwsbge "Zeitkonstante für Sollwertänderungsbegrenzung Einlassnockenwelle" UBYTE zk50msxs_ub_b12p8 1 100 0.0501961 12.8 FORMAT "%10.7" ECU_ADDRESS 0x384928 /end MEASUREMENT
/begin MEASUREMENT tPh1_w "Segmentzeit des letzten Phasensegments" UWORD t40usxus_q40 1 100 0 2.6214e+006 FORMAT "%8.0" ECU_ADDRESS 0x381A32 /end MEASUREMENT
/begin MEASUREMENT tsegph_w "Periodendauer eines Phasensegments" UWORD t40usxus_q40 1 100 0 2.6214e+006 FORMAT "%8.0" ECU_ADDRESS 0x381A34 /end MEASUREMENT
/begin MEASUREMENT ttvie_w "Zeitpunkt des TV-Interrupts (Einlaß)" UWORD dez 1 100 0 65535 FORMAT "%8.2" ECU_ADDRESS 0x382C0C /end MEASUREMENT
/begin MEASUREMENT tvsp_w "Einspritzzeit Verzugszeit in Abhängigkeit von evtmod" UWORD tinjection_sy 1 100 0 174.76 FORMAT "%8.4" ECU_ADDRESS 0x384AFC /end MEASUREMENT
/begin MEASUREMENT tvu_w "Batteriespannungskorrektur" UWORD tinjection_sy 1 100 0 174.76 FORMAT "%8.4" ECU_ADDRESS 0x3820B0 /end MEASUREMENT
/begin MEASUREMENT twnd "Temperatur für Wandleröl" UBYTE temp_ub_q0p75_o48 1 100 -48 143.25 FORMAT "%5.1" ECU_ADDRESS 0x3848E1 /end MEASUREMENT
/begin MEASUREMENT ubrde "Batteriespannungsschwelle für Anlasser ausgerückt" UBYTE spg_ubatt 1 100 0 17.952 FORMAT "%5.2" ECU_ADDRESS 0x380919 /end MEASUREMENT
/begin MEASUREMENT wdmdkoe "Momentenaufnahme Klimakompressor beim Einschalten" SBYTE rel_sb_q0p39 1 100 -49.9968 49.6062 FORMAT "%5.2" ECU_ADDRESS 0x3848E4 /end MEASUREMENT
/begin MEASUREMENT wessbm "Winkel Einlass schliesst spät bis Bezugsmarke" UBYTE kw_q2p8125 1 100 0 717.188 FORMAT "%5.1" ECU_ADDRESS 0x38088B /end MEASUREMENT
/begin MEASUREMENT wkfmdko_w "Momentenaufnahme Klimakompressor vor Filter" UWORD rel_uw_b100 1 100 0 99.9985 FORMAT "%8.5" ECU_ADDRESS 0x3825B2 /end MEASUREMENT
/begin MEASUREMENT wkwas_rde "Korrigierter Winkel im Arbeitsspiel für RDE" UBYTE kw_q6 1 100 0 1530 FORMAT "%5.0" ECU_ADDRESS 0x38091A /end MEASUREMENT
/begin MEASUREMENT wnwdshke_w "Deltasollwinkel Nockenwelle Einlaß Höhenkorrektur bei Katheizen" SWORD kw_sw_q0p0078 1 100 -256 255.992 FORMAT "%8.4" ECU_ADDRESS 0x385396 /end MEASUREMENT
/begin MEASUREMENT wnwehom_w "Vorsteuerwert für NW-Sollwinkel im Homogenbetrieb Einlaß" SWORD kw_sw_q0p0078 1 100 -256 255.992 FORMAT "%8.4" ECU_ADDRESS 0x385398 /end MEASUREMENT
/begin MEASUREMENT wnweos "Sollwinkel für Nockenwelle Einlaß öffnet" UBYTE kw_ub_q0p5 1 100 0 127.5 FORMAT "%5.1" ECU_ADDRESS 0x384929 /end MEASUREMENT
/begin MEASUREMENT wnwgv_w "Gesamtverstellwinkel  Ein- und Auslass Nockenwelle" UWORD kw_uw_q0p0078 1 100 0 511.992 FORMAT "%8.4" ECU_ADDRESS 0x38536C /end MEASUREMENT
/begin MEASUREMENT wnwise_w "Istwinkel für Einlaßnockenwelle" SWORD kw_q0p0039 1 100 -128 127.996 FORMAT "%8.4" ECU_ADDRESS 0x382C0E /end MEASUREMENT
/begin MEASUREMENT wnwix_w "Winkelfehler der berechneten Winkelbasis an der negativen Phasenflanke" SWORD kw_sw_b128 1 100 -128 127.996 FORMAT "%8.4" ECU_ADDRESS 0x381A36 /end MEASUREMENT
/begin MEASUREMENT wnwkhe_w "Sollwinkel Nockenwelle Einlaß bei Katheizen" SWORD kw_sw_q0p0078 1 100 -256 255.992 FORMAT "%8.4" ECU_ADDRESS 0x38539A /end MEASUREMENT
/begin MEASUREMENT wnwkhlle_w "Sollwinkel Nockenwelle Einlaß bei Katheizen und B_ll" SWORD kw_sw_q0p0078 1 100 -256 255.992 FORMAT "%8.4" ECU_ADDRESS 0x38539C /end MEASUREMENT
/begin MEASUREMENT wnwkwasx_w "Berechnete Winkelbasis zum Zeitpunkt der negativen Phasenflanke" UWORD kw_q0p0156 1 100 0 1023.98 FORMAT "%8.3" ECU_ADDRESS 0x381A38 /end MEASUREMENT
/begin MEASUREMENT wnwsae_w "aktiver Sollwinkel, der aus den verschiedenen Kennfeldern selektiert wurde Einla" SWORD kw_sw_q0p0078 1 100 -256 255.992 FORMAT "%8.4" ECU_ADDRESS 0x38539E /end MEASUREMENT
/begin MEASUREMENT wnwsape_w "Sollwinkel Einlassnockenwelle aus Kennfeld oder Festwert für Applikationszwecke" SWORD kw_sw_q0p0078 1 100 -256 255.992 FORMAT "%8.4" ECU_ADDRESS 0x3853A0 /end MEASUREMENT
/begin MEASUREMENT wnwsbge_w "Sollwert Nockewellenverstellung nach Änderungsbegrenzung Einlassnockenwelle" SWORD kw_sw_q0p0078 1 100 -256 255.992 FORMAT "%8.4" ECU_ADDRESS 0x3853A2 /end MEASUREMENT
/begin MEASUREMENT wnwsemx "max. erlaubter NW-Einlaß-Sollwinkel" UBYTE kw_ub_q0p5 1 100 0 127.5 FORMAT "%5.1" ECU_ADDRESS 0x38492A /end MEASUREMENT
/begin MEASUREMENT wnwseve2_w "Sollwinkel für eingeschränkte Nockenwellenverstellung Einlass 2" SWORD kw_sw_q0p0078 1 100 -256 255.992 FORMAT "%8.4" ECU_ADDRESS 0x38538E /end MEASUREMENT
/begin MEASUREMENT wnwseve_w "Sollwinkel für eingeschränkte Nockenwellenverstellung Einlass" SWORD kw_sw_q0p0078 1 100 -256 255.992 FORMAT "%8.4" ECU_ADDRESS 0x385390 /end MEASUREMENT
/begin MEASUREMENT wnwse_w "Sollwinkel Nockenwelle Einlass öffnet" SWORD kw_sw_q0p0078 1 100 -256 255.992 FORMAT "%8.4" ECU_ADDRESS 0x3853A4 /end MEASUREMENT
/begin MEASUREMENT wnwsfae_w "Sollwinkel bei Testereingriff Einlassnockenwelle" SWORD kw_sw_q0p0078 1 100 -256 255.992 FORMAT "%8.4" ECU_ADDRESS 0x38538C /end MEASUREMENT
/begin MEASUREMENT wnwskwe_w "Sollwinkel Nockenwelle Einlaß aus Kalt oder Warmkennfeld" SWORD kw_sw_q0p0078 1 100 -256 255.992 FORMAT "%8.4" ECU_ADDRESS 0x3853A6 /end MEASUREMENT
/begin MEASUREMENT wnwskwke_w "Sollwinkel Nockenwelle Einlaß aus Kalt oder Warmkennfeld mit Klopfeingriff" SWORD kw_sw_q0p0078 1 100 -256 255.992 FORMAT "%8.4" ECU_ADDRESS 0x3853A8 /end MEASUREMENT
/begin MEASUREMENT wnwskwle_w "Sollwinkel Nockenwelle Einlaß aus Kalt oder Warmkennfeld bei B_ll" SWORD kw_sw_q0p0078 1 100 -256 255.992 FORMAT "%8.4" ECU_ADDRESS 0x3853AA /end MEASUREMENT
/begin MEASUREMENT wnwsmne_w "minimaler Sollwinkel Nockenwelle Einlaß öffnet" SWORD kw_sw_q0p0078 1 100 -256 255.992 FORMAT "%8.4" ECU_ADDRESS 0x3853AC /end MEASUREMENT
/begin MEASUREMENT wnwsmxe_w "maximaler Sollwinkel Nockenwelle Einlaß öffnet" SWORD kw_sw_q0p0078 1 100 -256 255.992 FORMAT "%8.4" ECU_ADDRESS 0x3853AE /end MEASUREMENT
/begin MEASUREMENT wnwspasx_w "Adaptierter Wert der aktuellen Phasenflanke" UWORD kw_q0p0156 1 100 0 1023.98 FORMAT "%8.3" ECU_ADDRESS 0x381A3A /end MEASUREMENT
/begin MEASUREMENT wnwsswe_w "gespeicherter Nockenwellensollwinkel Einlaß" SWORD kw_sw_q0p0078 1 100 -256 255.992 FORMAT "%8.4" ECU_ADDRESS 0x3853B0 /end MEASUREMENT
/begin MEASUREMENT wnwstvh_w "Sollwinkel bei Verstellstop durch umschalten der Nockenhöhe Einlassnockenwelle" SWORD kw_sw_q0p0078 1 100 -256 255.992 FORMAT "%8.4" ECU_ADDRESS 0x385392 /end MEASUREMENT
/begin MEASUREMENT wnwue "Winkel Nockenwellenueberschneidung" UBYTE kw_q0p5 1 100 0 127.5 FORMAT "%5.1" ECU_ADDRESS 0x384915 /end MEASUREMENT
/begin MEASUREMENT wnwue_w "Winkel Nockenwellenueberschneidung" UWORD kw_q0p0019 1 100 0 127.998 FORMAT "%8.4" ECU_ADDRESS 0x38536E /end MEASUREMENT
/begin MEASUREMENT wnwug_w "Grundüberschneidungswinkel  Ein- und Auslass Nockenwelle" SWORD kw_sw_q0p0078 1 100 -256 255.992 FORMAT "%8.4" ECU_ADDRESS 0x385370 /end MEASUREMENT
/begin MEASUREMENT wnwu_w "Gesamtüberschneidungswinkel  Ein- und Auslass Nockenw. incl. Grundüberschneidung" SWORD kw_sw_q0p0078 1 100 -256 255.992 FORMAT "%8.4" ECU_ADDRESS 0x385372 /end MEASUREMENT
/begin MEASUREMENT wnwva_w "Verstellwinkel  Auslass Nockenwelle" SWORD kw_sw_q0p0078 1 100 -256 255.992 FORMAT "%8.4" ECU_ADDRESS 0x385374 /end MEASUREMENT
/begin MEASUREMENT wnwve_w "Verstellwinkel  Einlass Nockenwelle" SWORD kw_sw_q0p0078 1 100 -256 255.992 FORMAT "%8.4" ECU_ADDRESS 0x385376 /end MEASUREMENT
/begin MEASUREMENT wnwvg_w "Gesamtverstellwinkel der Nockenwelle" UWORD kw_q0p0019 1 100 0 127.998 FORMAT "%8.4" ECU_ADDRESS 0x385378 /end MEASUREMENT
/begin MEASUREMENT wnwvumxa_w "Max. möglicher Überschneidungswinkel durch Verstellung der Auslass-Nockenwelle" UWORD kw_uw_q0p0078 1 100 0 511.992 FORMAT "%8.4" ECU_ADDRESS 0x38537A /end MEASUREMENT
/begin MEASUREMENT wnwvumxe_w "Max. möglicher Überschneidungswinkel durch Verstellung der Einlass-Nockenwelle" UWORD kw_uw_q0p0078 1 100 0 511.992 FORMAT "%8.4" ECU_ADDRESS 0x38537C /end MEASUREMENT
/begin MEASUREMENT wnwvumx_w "Max. möglicher Überschneidungswinkel durch Verstellung der Nockenwelle(n)" UWORD kw_uw_q0p0078 1 100 0 511.992 FORMAT "%8.4" ECU_ADDRESS 0x38537E /end MEASUREMENT
/begin MEASUREMENT wnwvu_w "Überschneidungswinkel  Ein- und Auslass Nockenw.  nur durch Verstellung" UWORD kw_uw_q0p0078 1 100 0 511.992 FORMAT "%8.4" ECU_ADDRESS 0x385380 /end MEASUREMENT
/begin MEASUREMENT znlphausf "Zähler für erkannte Aussetzer an falscher Position" UBYTE dez 1 100 0 255 FORMAT "%5.1" ECU_ADDRESS 0x380925 /end MEASUREMENT
/begin MEASUREMENT znlphausr "Zähler für erkannte Aussetzer an richtiger Position" UBYTE dez 1 100 0 255 FORMAT "%5.1" ECU_ADDRESS 0x380926 /end MEASUREMENT
/begin MEASUREMENT znlphstim "Zähler für Stimuli-Bits von Aussetzertrommel" UBYTE dez 1 100 0 255 FORMAT "%5.1" ECU_ADDRESS 0x380927 /end MEASUREMENT
/begin MEASUREMENT zphflsyn "Phasenflankenzähler bei Erkennen der Motorposition im Notlauf DG" UBYTE dez 1 100 0 255 FORMAT "%5.1" ECU_ADDRESS 0x380934 /end MEASUREMENT
/begin MEASUREMENT zphflx "Zähler äquidistanter Phasenflanken von %WANWKW" UBYTE dez 1 100 0 255 FORMAT "%5.1" ECU_ADDRESS 0x380935 /end MEASUREMENT
/begin MEASUREMENT zwsol "Soll-Zündwinkel aus Momenteneingriff" SBYTE zw_sb_q0p75 1 100 -96 95.25 FORMAT "%5.2" ECU_ADDRESS 0x380B6E /end MEASUREMENT
/begin MEASUREMENT zyleausb "auszublendender Zylinder; binäre Darstellung" UBYTE dez 1 100 0 255 FORMAT "%5.1" ECU_ADDRESS 0x380928 /end MEASUREMENT
/begin MEASUREMENT zzbank "Zylinderzuordnung zu Abgasbänken" UWORD dez 1 100 0 65535 FORMAT "%8.2" ECU_ADDRESS 0x380B9A /end MEASUREMENT
/begin FUNCTION MDVER "5.120     Motor-Verlustmoment"
 /begin DEF_CHARACTERISTIC CNFMDVER DDWPEDMDK DMDNSM DMDWANK DMVERLMN DWPEDMDK KFMDS MDSH MDSM MDVGLW MDWANK TVMDCVTK ZFMDVERL ZMDNSM /end DEF_CHARACTERISTIC
 /begin REF_CHARACTERISTIC SNM16OPUW SRL11OPUW STM10__UB /end REF_CHARACTERISTIC
 /begin IN_MEASUREMENT B_cvt B_kuppl B_llrein B_sa dmvad_w dwped_w esst_snm16opuw esst_srl11opuw esst_stm10__ub fho mdverb_w mdwan_w nmotll nmot_w nsol rl_w tmot /end IN_MEASUREMENT
 /begin OUT_MEASUREMENT dmverl_w mdns_w mdverf_w mdverl_w mdvglw_w /end OUT_MEASUREMENT
 /begin LOC_MEASUREMENT B_dmverlin B_mdcvtk kfmds_w mdsm_w mds_w mdvervf_w /end LOC_MEASUREMENT
 /begin SUB_FUNCTION /end SUB_FUNCTION
/end FUNCTION
/begin FUNCTION MDVERAD "12.30     Adaption Verlustmoment"
 /begin DEF_CHARACTERISTIC DMADFK DMADFS DMADKO DMADLL DMADMNFK DMADMNFS DMADMNKO DMADMNLL DMADMXFK DMADMXFS DMADMXKO DMADMXLL TMDMAD TWDMAD ZKDMADFK ZKDMADFS ZKDMADKO ZKDMADLL /end DEF_CHARACTERISTIC
 /begin REF_CHARACTERISTIC CDWVERAD /end REF_CHARACTERISTIC
 /begin IN_MEASUREMENT B_adrmdver B_cvtad B_dtes B_fs B_koe B_llr B_llrein B_nswo1 B_pwf B_vllr dmllri_w tmot /end IN_MEASUREMENT
 /begin OUT_MEASUREMENT dmvad_w /end OUT_MEASUREMENT
 /begin LOC_MEASUREMENT B_adwfk B_adwfs B_adwko B_madfk B_madfs B_madko B_madll dmvadfk_w dmvadfs_w dmvadko_w dmvadll_w dmvamnfk_w dmvamnfs_w dmvamnko_w dmvamnll_w dmvamxfk_w dmvamxfs_w dmvamxko_w dmvamxll_w MDVERADlokbits /end LOC_MEASUREMENT
 /begin SUB_FUNCTION /end SUB_FUNCTION
/end FUNCTION
/begin FUNCTION MDVERB "12.270    Momentenbedarf der Nebenaggregate (z.B. Klimaanlage, sonst. Verbraucher)"
 /begin DEF_CHARACTERISTIC CNFSL CWMDRLKO CWTUM DMDLWS DMDRKO DMKO DMLFS DMSERVL DMSLP KFDMDKOE KFMDDLWS KFMDKO KFMDRKO KFMDRKOE KLFMKNM KLMDLFTV LWSER MDSL MDSLP MDSLPE MKLLS SNM06KOUB SRL06KOUB STA06LLUB TDMKOW ZKMDKO ZKMDSLP ZMDDLWS /end DEF_CHARACTERISTIC
 /begin REF_CHARACTERISTIC MDNORM /end REF_CHARACTERISTIC
 /begin IN_MEASUREMENT B_acres B_koe B_lwser B_sl B_slp dlws_w lws_w mkllsc mkolsc nmot rl tans tumg tvlues1 /end IN_MEASUREMENT
 /begin OUT_MEASUREMENT dmrac dmrlf esst_snm06koub esst_srl06koub esst_sta06llub mdgen_w mdko_w mdlfs_w mdslpf_w mdswl_w mdverb mdverb_w /end OUT_MEASUREMENT
 /begin LOC_MEASUREMENT dlwsu_w dmr3lf_w md3lf_w mddlws_w mdkoini mdlws_w tlok wdmdkoe wkfmdko_w /end LOC_MEASUREMENT
 /begin SUB_FUNCTION /end SUB_FUNCTION
/end FUNCTION
/begin FUNCTION MDWAN "6.110     Drehmomentaufnahme des Wandlers"
 /begin DEF_CHARACTERISTIC CNFMDWAN DMDWANMX DMDWHYS DMDWM FABMDWA FDMDWAN FMDWAT FNRAD FVDMDWAN KFMDWMX MDATNM MDATRM MDWANER STW08MDUB TVFSAM TVFSEM TVFSRAM TVFSREM TVFUE UEVERG ZKDMDW ZKMDWAB ZKMDWAUF ZKMDWF ZKUEVERG /end DEF_CHARACTERISTIC
 /begin REF_CHARACTERISTIC /end REF_CHARACTERISTIC
 /begin IN_MEASUREMENT B_autget B_fs B_mdwaner gangi mdwancan nstat nturbc_w tmot vfzg vfzg_w /end IN_MEASUREMENT
 /begin OUT_MEASUREMENT B_dmrwan B_rgang dmdwan_w dmrwan mdwanvf_w mdwan_w /end OUT_MEASUREMENT
 /begin LOC_MEASUREMENT B_cnfwan B_fsu dnturb_w esst_stw08mdub mdatxm_w mdwancb_w nturbv_w nturb_w qntns twnd /end LOC_MEASUREMENT
 /begin SUB_FUNCTION /end SUB_FUNCTION
/end FUNCTION
/begin FUNCTION MDZUL "4.21      Maximal zulässiges Moment"
 /begin DEF_CHARACTERISTIC KFMIZUFIL KFMIZUNS KFMIZUOF KLDMMX NSTART NSTEND SMO08OPUB TANSMN TFMIZU TMNSMN TNSC TNSOF /end DEF_CHARACTERISTIC
 /begin REF_CHARACTERISTIC MDIMX SNM08OPUB SWP08OPUB /end REF_CHARACTERISTIC
 /begin IN_MEASUREMENT B_fgr B_mrakt B_msr B_mzns_um B_sgs dmrmx_w esst_snm08opub esst_swp08opub etazwbm etazwmn nmot tans tmot wped /end IN_MEASUREMENT
 /begin OUT_MEASUREMENT miszull_w miszul_w /end OUT_MEASUREMENT
 /begin LOC_MEASUREMENT B_mdmxzu B_mzns B_nsakt B_nsend esst_smo08opub miszullb_w mizufil_w mizuofil mizuvfil tnscCtr_w tnsofCtr /end LOC_MEASUREMENT
 /begin SUB_FUNCTION /end SUB_FUNCTION
/end FUNCTION
/begin FUNCTION MDZW "1.120     Berechnung Moment in Sollzündwinkel" /begin DEF_CHARACTERISTIC DMAUFN DZWETA /end DEF_CHARACTERISTIC /begin REF_CHARACTERISTIC /end REF_CHARACTERISTIC
 /begin IN_MEASUREMENT B_zwvs B_zwvz etazaist mibas_w miopt_w misol_w mizsol_w mizwmn_w nmot_w redist zwopt /end IN_MEASUREMENT
 /begin OUT_MEASUREMENT B_nozwe zwsol /end OUT_MEASUREMENT
 /begin LOC_MEASUREMENT B_zwvzm dmaufr_w dzws etazws /end LOC_MEASUREMENT
 /begin SUB_FUNCTION /end SUB_FUNCTION
/end FUNCTION
/begin FUNCTION MOTAUS "5.70      Motor-Abstellen" /begin DEF_CHARACTERISTIC TNLSGMN TNLSGMX UBNLMN /end DEF_CHARACTERISTIC /begin REF_CHARACTERISTIC /end REF_CHARACTERISTIC /begin IN_MEASUREMENT B_kl15 B_pwf B_stend ub /end IN_MEASUREMENT
 /begin OUT_MEASUREMENT B_nachl B_nachlend B_nachlram B_nachlstp B_nlacls B_nlale B_nlatm B_nlcan B_nldte B_nldval B_nldve B_nlEEPR B_nletm B_nlmls B_nlobd B_nlsgls B_nlsiko B_nlubr B_nlwfs B_nlwst swOffD2Bits swOffDlBits tnachl_w /end OUT_MEASUREMENT
 /begin LOC_MEASUREMENT /end LOC_MEASUREMENT
 /begin SUB_FUNCTION /end SUB_FUNCTION
/end FUNCTION
/begin FUNCTION NLDG "2.70      Notlauf Drehzahlgeber"
 /begin DEF_CHARACTERISTIC DYNMXNL FIRNLIGN FNLMI0 FNLMI1 FNLMI2 KLDTPH KLDTPHST KLDYNCOR KLNLPHN KLWNWI KNLSYN MXNLFEHL TNLPHWAIT TNLSYNMN TNLSYNMX /end DEF_CHARACTERISTIC
 /begin REF_CHARACTERISTIC CWNWREF /end REF_CHARACTERISTIC
 /begin IN_MEASUREMENT B_nldg B_phad B_phsok B_st B_switchpg B_wnwiout nmot synstate tmot wnwi_ad_w wnwkwas_w wnwspas_w zphfl /end IN_MEASUREMENT
 /begin OUT_MEASUREMENT B_phnldg B_synnldg nsynnldg zphflsyn /end OUT_MEASUREMENT
 /begin LOC_MEASUREMENT B_2ph B_3ph B_ensynnl B_gapnldg B_kllknl B_lkklnl B_noknldg B_phfalse B_phnegtiv B_resetsyn B_rphsp B_synoknl B_wnwioutx dtsegph_w mtsegph_w tnbmphs0_w tPh1_w tsegph_w wnwix_w wnwkwasx_w wnwspasx_w zphflx /end LOC_MEASUREMENT
 /begin SUB_FUNCTION /end SUB_FUNCTION
/end FUNCTION
/begin FUNCTION NLPH "5.20      Notlauf Phasengeber"
 /begin DEF_CHARACTERISTIC ANZEAUS CWNLPH NPHERKMN NPHERKMX NPHINVMN NPHINVMX RLPHERKMN RLPHERKMX TPHERKMN TPHSABSP TPHSSP ZYLEAUS /end DEF_CHARACTERISTIC
 /begin REF_CHARACTERISTIC /end REF_CHARACTERISTIC
 /begin IN_MEASUREMENT B_bm B_dluerk_m B_ll B_luaerk_m B_luerk_m B_lustop_m B_mdstim_m B_mdstop_m B_nldg B_nlphea B_phaact B_phsok B_synph nmot rl synstate tmot zzyl /end IN_MEASUREMENT
 /begin OUT_MEASUREMENT anzeausb B_dopzue B_nlph B_nosynph B_phsnl B_phsnlab B_phsnlinv B_phsnlok B_stimnlph nsynnlph phLosCtr_w znlphausf znlphausr znlphstim zyleausb /end OUT_MEASUREMENT
 /begin LOC_MEASUREMENT B_delaysyn B_optpherk /end LOC_MEASUREMENT
 /begin SUB_FUNCTION /end SUB_FUNCTION
/end FUNCTION
/begin FUNCTION NMAXMD "4.80      Drehzahlbegrenzung"
 /begin DEF_CHARACTERISTIC CWNMAXMD DNMAX DNMAXDZ DNMAXH DNSIRES ITNMXH KINMXNL KINMXRLG KLTNMXPR MDIMX NMAX NMAXDV NMAXDVG NMAXDZ NMAXGA NMAXNL NMAXOG NMXDAEF NMXDKPU NMXPNL NMXPRLG TMOTNMX TNMXH VNMX /end DEF_CHARACTERISTIC
 /begin REF_CHARACTERISTIC SGA08MDUB SRL08NXUB /end REF_CHARACTERISTIC
 /begin IN_MEASUREMENT B_autget B_dknolu B_dkpu B_dopzue B_nldg B_nmaxext esst_sga08mdub esst_srl08nxub gangi mifab_w ngfil_w nmaxext_w nmot_w rl tmot vfzg wped /end IN_MEASUREMENT
 /begin OUT_MEASUREMENT B_nmax B_nmaxd minmx_w nsber_w /end OUT_MEASUREMENT
 /begin LOC_MEASUREMENT B_itnmxh B_tnmxh dmnmxi_w dmnmxp_w dnsi_w itnmaxp_w itnmxh_w kinmx mifabh_w minmxb_w nmaxdvg_w nmaxga_w nmax_w nmotpr_w nmxpr tnmax_w tnmxh_w /end LOC_MEASUREMENT
 /begin SUB_FUNCTION /end SUB_FUNCTION
/end FUNCTION
/begin FUNCTION NWEVO "1.10      Nockenwelle: eingeschränkte Verstellmöglichkeiten wegen Öldruck" /begin DEF_CHARACTERISTIC /end DEF_CHARACTERISTIC /begin REF_CHARACTERISTIC WNWREO /end REF_CHARACTERISTIC /begin IN_MEASUREMENT wnwe_w /end IN_MEASUREMENT /begin OUT_MEASUREMENT B_nwseve NWEVOausbits01 wnwseve2_w wnwseve_w /end OUT_MEASUREMENT /begin LOC_MEASUREMENT wnwstvh_w /end LOC_MEASUREMENT /begin SUB_FUNCTION /end SUB_FUNCTION /end FUNCTION
/begin FUNCTION NWFW "2.30      Berechnung Faktor Winkel Nockenwelle" /begin DEF_CHARACTERISTIC CWNWFW KFFNWE KFNWWUE KLFNWA /end DEF_CHARACTERISTIC /begin REF_CHARACTERISTIC /end REF_CHARACTERISTIC /begin IN_MEASUREMENT fnwua fnwue nmot_w rl rlnw_w wnwsmxe_w wnwve_w /end IN_MEASUREMENT /begin OUT_MEASUREMENT fnwaa fnwea /end OUT_MEASUREMENT /begin LOC_MEASUREMENT /end LOC_MEASUREMENT /begin SUB_FUNCTION /end SUB_FUNCTION /end FUNCTION
/begin FUNCTION NWSFAT "1.10      Nockenwellensteuerung, Sollwertvorgabe durch Tester" /begin DEF_CHARACTERISTIC NFANWS TNWAPTE TNWFARE TNWPPTE TNWVBGNE /end DEF_CHARACTERISTIC /begin REF_CHARACTERISTIC /end REF_CHARACTERISTIC
 /begin IN_MEASUREMENT B_fa B_fanwse B_fanwstae nmot NWSOLLElokbits wnwsmne_w wnwsmxe_w /end IN_MEASUREMENT
 /begin OUT_MEASUREMENT B_fanwsea wnwsfae_w /end OUT_MEASUREMENT
 /begin LOC_MEASUREMENT statetnwe /end LOC_MEASUREMENT
 /begin SUB_FUNCTION /end SUB_FUNCTION
/end FUNCTION
/begin FUNCTION NWSOLLE "2.50      Sollwertvorgabe NWS (Einlaßseitig)"
 /begin DEF_CHARACTERISTIC FNWSKRE KFNWKHE KFNWKHLLE KFNWKRE KFNWLLE KFNWSE KFNWTME KFNWWLE KFNWWLLE KFWNWSAPE NMKFNWLLE TMNWLLKHE TNWSABGKE TNWSNABGE TNWSPABGE WNWBKVE WNWDSHKE WNWREO WNWSAMXE WNWSEAPP WNWSMNE WNWSMXE WNWSTE WNWSWOFE /end DEF_CHARACTERISTIC
 /begin REF_CHARACTERISTIC SNM05NEUW SNM05NWUB SNM16NEUW SRL05NEUW SRL08NEUW /end REF_CHARACTERISTIC
 /begin IN_MEASUREMENT B_bkvnwab B_dnwse B_enwsve B_fanwsea B_ll B_nwrpose B_nws B_nwsapkfe B_nwsappe B_nwseve B_nwskflle B_nwsst B_wnwsmxfe esst_snm05neuw esst_snm05nwub esst_snm16neuw esst_srl05neuw esst_srl08neuw fho_w fnwkhe nmot nmot_w rk_w rlnw_w tmot tmst tumg wkrma wnwe_w wnwseve_w wnwsfae_w /end IN_MEASUREMENT
 /begin OUT_MEASUREMENT B_wnws0e NWSOLLEausbits wnwehom_w wnweos wnwsemx wnwse_w wnwsmne_w wnwsmxe_w /end OUT_MEASUREMENT
 /begin LOC_MEASUREMENT B_fanwstae B_nweapte dwnwse_w fnwwarme NWSOLLElokbits tnwsbge wnwdshke_w wnwkhe_w wnwkhlle_w wnwsae_w wnwsape_w wnwsbge_w wnwskwe_w wnwskwke_w wnwskwle_w wnwsswe_w /end LOC_MEASUREMENT
 /begin SUB_FUNCTION /end SUB_FUNCTION
/end FUNCTION
/begin FUNCTION NWSYVAR "2.20      Nockenwellen-Systemvarianten" /begin DEF_CHARACTERISTIC /end DEF_CHARACTERISTIC /begin REF_CHARACTERISTIC /end REF_CHARACTERISTIC /begin IN_MEASUREMENT wnwi_ad_w /end IN_MEASUREMENT /begin OUT_MEASUREMENT B_nwtve NWSYVARausbits ttvie_w wnwise_w /end OUT_MEASUREMENT /begin LOC_MEASUREMENT /end LOC_MEASUREMENT /begin SUB_FUNCTION /end SUB_FUNCTION /end FUNCTION
/begin FUNCTION NWWUE "5.20      Berechnung der Nockenwellenüberschneidung" /begin DEF_CHARACTERISTIC WNWRAS WNWSMNA WNWSMXA /end DEF_CHARACTERISTIC /begin REF_CHARACTERISTIC WNWREO /end REF_CHARACTERISTIC /begin IN_MEASUREMENT wnwe_w wnwsmne_w wnwsmxe_w /end IN_MEASUREMENT
 /begin OUT_MEASUREMENT fnwua fnwue fnwu_w wnwue wnwue_w wnwvg_w wnwvumxa_w wnwvumxe_w wnwvumx_w wnwvu_w /end OUT_MEASUREMENT
 /begin LOC_MEASUREMENT wnwgv_w wnwug_w wnwu_w wnwva_w wnwve_w /end LOC_MEASUREMENT
 /begin SUB_FUNCTION /end SUB_FUNCTION
/end FUNCTION
/begin FUNCTION OBPC_71 "" /begin DEF_CHARACTERISTIC SGIDB8 SGIDB9 /end DEF_CHARACTERISTIC /begin REF_CHARACTERISTIC CNSDEF SGIDB7 VARDEF /end REF_CHARACTERISTIC /begin IN_MEASUREMENT B_kl15 /end IN_MEASUREMENT
 /begin OUT_MEASUREMENT B_nlasicOBP B_nlfrOBP B_nlOBP OBPSWOFFbits S_NLENAS tnachlOBP /end OUT_MEASUREMENT
 /begin LOC_MEASUREMENT /end LOC_MEASUREMENT
 /begin SUB_FUNCTION /end SUB_FUNCTION
/end FUNCTION
/begin FUNCTION OBP_CAN "" /begin DEF_CHARACTERISTIC /end DEF_CHARACTERISTIC /begin REF_CHARACTERISTIC /end REF_CHARACTERISTIC /begin IN_MEASUREMENT /end IN_MEASUREMENT /begin OUT_MEASUREMENT /end OUT_MEASUREMENT /begin LOC_MEASUREMENT /end LOC_MEASUREMENT /begin SUB_FUNCTION /end SUB_FUNCTION /end FUNCTION
/begin FUNCTION OBP_EEP "" /begin DEF_CHARACTERISTIC /end DEF_CHARACTERISTIC /begin REF_CHARACTERISTIC /end REF_CHARACTERISTIC /begin IN_MEASUREMENT /end IN_MEASUREMENT /begin OUT_MEASUREMENT /end OUT_MEASUREMENT /begin LOC_MEASUREMENT /end LOC_MEASUREMENT /begin SUB_FUNCTION /end SUB_FUNCTION /end FUNCTION
/begin FUNCTION obp_t "" /begin DEF_CHARACTERISTIC /end DEF_CHARACTERISTIC /begin REF_CHARACTERISTIC /end REF_CHARACTERISTIC /begin IN_MEASUREMENT B_nlOBP /end IN_MEASUREMENT /begin OUT_MEASUREMENT /end OUT_MEASUREMENT /begin LOC_MEASUREMENT /end LOC_MEASUREMENT /begin SUB_FUNCTION /end SUB_FUNCTION /end FUNCTION
/begin FUNCTION PHAS "Phaseninterrupt" /begin DEF_CHARACTERISTIC /end DEF_CHARACTERISTIC /begin REF_CHARACTERISTIC /end REF_CHARACTERISTIC /begin IN_MEASUREMENT B_nldg B_phase B_phnegtiv B_switchpg zrph /end IN_MEASUREMENT /begin OUT_MEASUREMENT /end OUT_MEASUREMENT /begin LOC_MEASUREMENT /end LOC_MEASUREMENT /begin SUB_FUNCTION /end SUB_FUNCTION /end FUNCTION
/begin FUNCTION PK "" /begin DEF_CHARACTERISTIC /end DEF_CHARACTERISTIC /begin REF_CHARACTERISTIC /end REF_CHARACTERISTIC /begin IN_MEASUREMENT /end IN_MEASUREMENT /begin OUT_MEASUREMENT /end OUT_MEASUREMENT /begin LOC_MEASUREMENT /end LOC_MEASUREMENT /begin SUB_FUNCTION /end SUB_FUNCTION /end FUNCTION
/begin FUNCTION POWERFA "" /begin DEF_CHARACTERISTIC /end DEF_CHARACTERISTIC /begin REF_CHARACTERISTIC /end REF_CHARACTERISTIC /begin IN_MEASUREMENT /end IN_MEASUREMENT /begin OUT_MEASUREMENT B_pwfCsErr /end OUT_MEASUREMENT /begin LOC_MEASUREMENT /end LOC_MEASUREMENT /begin SUB_FUNCTION /end SUB_FUNCTION /end FUNCTION
/begin FUNCTION PROKON "4.20      Projektkonfiguration"
 /begin DEF_CHARACTERISTIC CDAGR CDAGRL CDATR CDATS CDBKVP_0_A CDBKVP_1_A CDDSBKV_0_A CDDSBKV_1_A CDDST CDEGFE CDEHFM CDGGGTS CDHSH CDHSHE CDHSV CDHSVE CDHSVSA CDKAT CDKATSP CDKATSPF CDKVS CDLASH CDLATP CDLATV CDLDP CDLLR CDLSA CDLSH CDLSV CDLSVV CDMD CDNWS CDSLS CDSWE_0_A CDSWE_1_A CDSWE_2_A CDSWE_3_A CDSWE_4_A CDSWE_5_A CDSWE_6_A CDSWE_7_A CDTANKL CDTES CDWVERAD CWADRES CWDLSU CWERFIL CWGRABH CWKMMILSCT CWKONABG CWKONFLS CWKONFZ1_0_A CWKONFZ1_1_A CWKONFZ1_2_A CWKONFZ1_3_A CWKONFZ1_4_A CWKONFZ1_5_A CWKONFZ1_6_A CWKONFZ1_7_A CWKONLS CWLSHA CWMDAPP CWOBD CWSCTMDE CWSLS CWTF CWUHR NSWO1 NSWO2 WESSOT /end DEF_CHARACTERISTIC
 /begin REF_CHARACTERISTIC /end REF_CHARACTERISTIC
 /begin IN_MEASUREMENT nmot /end IN_MEASUREMENT
 /begin OUT_MEASUREMENT B_4wd B_abstnl B_adrkra B_adrldra B_adrlra B_adrmdver B_adrmsdk B_adrsta B_asrfz B_autget B_cdagr B_cdagrl B_cdanws B_cdatr B_cdats B_cdbkvp B_cddsbkv B_cddst B_cdegfe B_cdehfm B_cdenws B_cdgts B_cdhsh B_cdhshe B_cdhsv B_cdhsve B_cdhsvsa B_cdkat B_cdkatsp B_cdkatspf B_cdkatspt B_cdkvs B_cdlash B_cdlatp B_cdlatv B_cdldp B_cdllr B_cdlsa B_cdlsh B_cdlsv B_cdlsvv B_cdmd B_cdnws B_cdsls B_cdswe B_cdtankl B_cdtes B_cvt B_cwlshdyn B_cwlshmf B_cwlshsch B_cwlshvl B_dslvh B_dssv B_dssvnl B_dsuv B_fpwdkap B_gra6p B_gracan B_hfmv B_katfz B_kath B_kmmilsct B_ldsafw B_ldsapp B_ls3 B_ls32 B_ls4 B_ls42 B_lsh B_lsh2 B_lsv B_lsv2 B_mde8e B_mde9e B_mt B_niveau B_nswo1 B_nswo2 B_plsolap B_png B_slsfz B_tfu B_uhrrmin B_uhrrsec B_wdksap B_zwappl cd_bits1_w cd_bits2_w cd_bits3_w cw_erfil cw_obd grundwert wessbm zzbank /end OUT_MEASUREMENT
 /begin LOC_MEASUREMENT /end LOC_MEASUREMENT
 /begin SUB_FUNCTION /end SUB_FUNCTION
/end FUNCTION
/begin FUNCTION PWMATS "" /begin DEF_CHARACTERISTIC /end DEF_CHARACTERISTIC /begin REF_CHARACTERISTIC /end REF_CHARACTERISTIC /begin IN_MEASUREMENT B_timev_inc timevovCtr /end IN_MEASUREMENT /begin OUT_MEASUREMENT B_intats B_intatserr tcchats_w tccpats_w /end OUT_MEASUREMENT
 /begin LOC_MEASUREMENT B_intatsfirstneg B_intatsfirstpos B_portStatusOld ccperSav ccpwSav timevovCtrOld /end LOC_MEASUREMENT
 /begin SUB_FUNCTION /end SUB_FUNCTION
/end FUNCTION
/begin FUNCTION RDE "1.40      Rückdreherkennung" /begin DEF_CHARACTERISTIC DNABW KLTNRDE NMOTRDE RDUNDEF UBDTRDE /end DEF_CHARACTERISTIC /begin REF_CHARACTERISTIC /end REF_CHARACTERISTIC
 /begin IN_MEASUREMENT B_fbm B_nmin dnmot_w nmotll synstate tmot ub vfzg_w wkwbzm0_w wkw_w wub zzseg /end IN_MEASUREMENT
 /begin OUT_MEASUREMENT B_enabrde B_motstop B_rdeplaus B_rdeundef /end OUT_MEASUREMENT
 /begin LOC_MEASUREMENT B_abw B_anlaus B_verrueck B_waitgap rdeBits tnbmrde tnbmrde1 tnbmrde2 ubrde wkwas_rde /end LOC_MEASUREMENT
 /begin SUB_FUNCTION /end SUB_FUNCTION
/end FUNCTION
/begin FUNCTION RKTI "11.40     Einspritzdauerberechnung ti aus relativer Kraftstoffmasse rk"
 /begin DEF_CHARACTERISTIC CWDMIL CWPKAPP FKKVS FRLFSDP KMITIBGR KRKTE PSAPES PVMITIBGR TEMIN TEMINVA TVTSPEV TVUB ZTSPEV /end DEF_CHARACTERISTIC
 /begin REF_CHARACTERISTIC /end REF_CHARACTERISTIC
 /begin IN_MEASUREMENT B_ba B_bag B_stend B_va evtmod mifab_w nmot nmot_w ps_w pu_w rk_w ub vsfpses /end IN_MEASUREMENT
 /begin OUT_MEASUREMENT B_temin dtimx_w evtmodev mitibgr_w timxth_w timx_w ti_b1 ti_b2 ti_tvu_w ti_w tvsp_w /end OUT_MEASUREMENT
 /begin LOC_MEASUREMENT B_enimiti dpus_w frkte_w ftek_w mitibgri_w mitibgrp_w RKTIlokbits tevfakge_w tevfa_w te_w tvu_w /end LOC_MEASUREMENT
 /begin SUB_FUNCTION /end SUB_FUNCTION
/end FUNCTION
/begin FUNCTION RSA "" /begin DEF_CHARACTERISTIC /end DEF_CHARACTERISTIC /begin REF_CHARACTERISTIC /end REF_CHARACTERISTIC /begin IN_MEASUREMENT /end IN_MEASUREMENT /begin OUT_MEASUREMENT /end OUT_MEASUREMENT /begin LOC_MEASUREMENT ctr_RSABlock /end LOC_MEASUREMENT /begin SUB_FUNCTION /end SUB_FUNCTION /end FUNCTION
/begin FUNCTION rstmon "Reset Monitor" /begin DEF_CHARACTERISTIC /end DEF_CHARACTERISTIC /begin REF_CHARACTERISTIC /end REF_CHARACTERISTIC /begin IN_MEASUREMENT /end IN_MEASUREMENT /begin OUT_MEASUREMENT resetMonIdx /end OUT_MEASUREMENT /begin LOC_MEASUREMENT rstMon /end LOC_MEASUREMENT /begin SUB_FUNCTION /end SUB_FUNCTION /end FUNCTION
/begin FUNCTION RUNTIME "" /begin DEF_CHARACTERISTIC AUFW100M AUFW10MS AUFW20MS AUFWSYNC RESETMAX /end DEF_CHARACTERISTIC /begin REF_CHARACTERISTIC /end REF_CHARACTERISTIC
 /begin IN_MEASUREMENT B_dash B_kr B_ldr B_llr B_lrs B_lsd B_sa nmot nmot_w rl wdkba wped /end IN_MEASUREMENT
 /begin OUT_MEASUREMENT B_lzs_dash B_lzs_kr B_lzs_ldr B_lzs_lr B_lzs_lsd B_lzs_sa cyclebg_w laufzbg_w laufzmbg_w lzmaxnmot lzmaxrl lzmaxstate lzmaxwdkba lzmaxwped PercentToResetmax_w PercentToReset_w perfilt_bg perfmax_w perform_bg rlossCtr_w /end OUT_MEASUREMENT
 /begin LOC_MEASUREMENT cntbg_w /end LOC_MEASUREMENT
 /begin SUB_FUNCTION /end SUB_FUNCTION
/end FUNCTION
/begin FUNCTION SCATT "20.90     SCAN TOOL-Testerschnittstelle" /begin DEF_CHARACTERISTIC /end DEF_CHARACTERISTIC /begin REF_CHARACTERISTIC /end REF_CHARACTERISTIC /begin IN_MEASUREMENT B_m9cvnout B_mde8e B_mde9e fcmEnd /end IN_MEASUREMENT /begin OUT_MEASUREMENT B_m8te B_m9cvnclr scattBits /end OUT_MEASUREMENT /begin LOC_MEASUREMENT /end LOC_MEASUREMENT /begin SUB_FUNCTION /end SUB_FUNCTION /end FUNCTION
/begin FUNCTION SLS "88.150    Sekundärluftsteuerung"
 /begin DEF_CHARACTERISTIC CWFASL DPSLV FMSL FMSLOFF FMSRHOL FMSTMOT IMLSLMN_0_A IMLSLMN_1_A IMLSLMX_0_A IMLSLMX_1_A IMLSLSA IMLSLSE KFFMSML MLSLMX MSLUB TASLSO TASLSU TDDSLA TDSLKT TFASLAMN TLMSSLAB TLMSSLMX TMFASLMN TMSSLO TMSSLSTO TMSSLSTU TMSSLU TSLABB TSLPMN TSLUBST TVDSLOFF TVSLVOFF TVSLVON UBSLMN UBSLMX UBSLSTMN VSLS ZFLMSSL ZKSLPOFF ZKSLPON ZKSLSOFML ZKSLSONML /end DEF_CHARACTERISTIC
 /begin REF_CHARACTERISTIC CWSLS /end REF_CHARACTERISTIC
 /begin IN_MEASUREMENT ATMbits B_atmtpl B_brems B_dslfa B_dslsp4 B_dspe B_fa B_fasls B_fs B_kh B_kha B_khab B_kuppl B_ll B_mslmn B_nmot B_slsfz B_st B_stend fmsla frhokor_w imlpr mlbb_w ml_w nmot ps_w pu rl tans tmot tmst tnst_w ubsqf_w verhmsb_w vfzg /end IN_MEASUREMENT
 /begin OUT_MEASUREMENT B_fasla B_lmsslof B_msloff B_slkhof B_slp B_slpmn B_slpoff B_sls B_slsadap B_slsoab B_slsoff B_slv flamsl_w flmssl fmslrho msl mslstat mslstat_w msl_w /end OUT_MEASUREMENT
 /begin LOC_MEASUREMENT B_dslreset B_dslset B_mslon B_sldsl4 B_slkt B_slpanst B_slpena B_slpofst B_slsdis B_slserr B_slsinhi B_slvanst fmsagd fmsldyn fmslkor fmsltm fslpdyn imlsla_w imlsle_w mslkorr_w mslpub_w SLSlokBits /end LOC_MEASUREMENT
 /begin SUB_FUNCTION /end SUB_FUNCTION
/end FUNCTION
/begin FUNCTION SREAKT "7.70      EGAS: Sicherheitskonzept, Fehlerreaktionen" /begin DEF_CHARACTERISTIC /end DEF_CHARACTERISTIC /begin REF_CHARACTERISTIC /end REF_CHARACTERISTIC
 /begin IN_MEASUREMENT B_appnolu B_dkp1e B_dkp2e B_dkpaw B_dlrbe B_dlrpide B_fproab B_fprzab B_i_ska_um B_nlpne B_ubdve B_ub_ok B_umauab B_wdksive /end IN_MEASUREMENT
 /begin OUT_MEASUREMENT B_dknolu B_dknot B_dkpiu B_dkpru B_dkpu B_i_ska_fr B_notlu_fr /end OUT_MEASUREMENT
 /begin LOC_MEASUREMENT B_dkunb /end LOC_MEASUREMENT
 /begin SUB_FUNCTION /end SUB_FUNCTION
/end FUNCTION
/begin COMPU_METHOD B_TRUE "boolsche Zustände, positive Logik" TAB_VERB "%6.3" "" COMPU_TAB_REF B_TRUE /end COMPU_METHOD
/begin COMPU_VTAB B_TRUE "boolsche Zustände, positive Logik" TAB_VERB 2 0 "----" 1 "TRUE" /end COMPU_VTAB
/begin COMPU_METHOD dez "1 : 1 Umrechnug (dez/hex)" RAT_FUNC "%6.2" "" COEFFS 0 1 0 0 0 1 /end COMPU_METHOD
/begin COMPU_METHOD dlw_sw_q0p04375 "" RAT_FUNC "%6.4" "°/s" COEFFS 0 32767 0 0 0 1434 /end COMPU_METHOD
/begin COMPU_METHOD fak_q0p0039 "" RAT_FUNC "%6.4" "-" COEFFS 0 256 0 0 0 1 /end COMPU_METHOD
/begin COMPU_METHOD fak_ub_b1 "" RAT_FUNC "%6.4" "-" COEFFS 0 256 0 0 0 1 /end COMPU_METHOD
/begin COMPU_METHOD fak_ub_b16 "" RAT_FUNC "%6.4" "-" COEFFS 0 256 0 0 0 16 /end COMPU_METHOD
/begin COMPU_METHOD fak_ub_b2 "" RAT_FUNC "%6.4" "-" COEFFS 0 256 0 0 0 2 /end COMPU_METHOD
/begin COMPU_METHOD fak_ub_b32 "" RAT_FUNC "%6.3" "-" COEFFS 0 256 0 0 0 32 /end COMPU_METHOD
/begin COMPU_METHOD fak_ub_b4 "" RAT_FUNC "%6.4" "-" COEFFS 0 256 0 0 0 4 /end COMPU_METHOD
/begin COMPU_METHOD fak_ub_b8 "" RAT_FUNC "%6.4" "-" COEFFS 0 256 0 0 0 8 /end COMPU_METHOD
/begin COMPU_METHOD fak_ub_q4p7Em7 "" RAT_FUNC "%11.10" "-" COEFFS 0 1 0 0 0 4.7e-007 /end COMPU_METHOD
/begin COMPU_METHOD fak_uw_b16 "" RAT_FUNC "%6.5" "-" COEFFS 0 65536 0 0 0 16 /end COMPU_METHOD
/begin COMPU_METHOD fak_uw_b2 "" RAT_FUNC "%7.6" "-" COEFFS 0 65536 0 0 0 2 /end COMPU_METHOD
/begin COMPU_METHOD fak_uw_b4 "" RAT_FUNC "%7.6" "-" COEFFS 0 65536 0 0 0 4 /end COMPU_METHOD
/begin COMPU_METHOD fak_uw_b8 "" RAT_FUNC "%6.5" "-" COEFFS 0 65536 0 0 0 8 /end COMPU_METHOD
/begin COMPU_METHOD kw_q0p0019 "" RAT_FUNC "%6.4" "°KW" COEFFS 0 512 0 0 0 1 /end COMPU_METHOD
/begin COMPU_METHOD kw_q0p0039 "" RAT_FUNC "%6.4" "°KW" COEFFS 0 256 0 0 0 1 /end COMPU_METHOD
/begin COMPU_METHOD kw_q0p0156 "" RAT_FUNC "%6.4" "°KW" COEFFS 0 64 0 0 0 1 /end COMPU_METHOD
/begin COMPU_METHOD kw_q0p0625 "" RAT_FUNC "%6.4" "°KW" COEFFS 0 16 0 0 0 1 /end COMPU_METHOD
/begin COMPU_METHOD kw_q0p5 "" RAT_FUNC "%6.3" "°KW" COEFFS 0 2 0 0 0 1 /end COMPU_METHOD
/begin COMPU_METHOD kw_q1 "" RAT_FUNC "%6.2" "°KW" COEFFS 0 1 0 0 0 1 /end COMPU_METHOD
/begin COMPU_METHOD kw_q2p8125 "" RAT_FUNC "%6.2" "°KW" COEFFS 0 1 0 0 0 2.8125 /end COMPU_METHOD
/begin COMPU_METHOD kw_q6 "" RAT_FUNC "%6.2" "°KW" COEFFS 0 1 0 0 0 6 /end COMPU_METHOD
/begin COMPU_METHOD kw_sw_b128 "" RAT_FUNC "%6.4" "°KW" COEFFS 0 65536 0 0 0 256 /end COMPU_METHOD
/begin COMPU_METHOD kw_sw_q0p0078 "" RAT_FUNC "%6.4" "°KW" COEFFS 0 128 0 0 0 1 /end COMPU_METHOD
/begin COMPU_METHOD kw_ub_q0p5 "" RAT_FUNC "%6.3" "°KW" COEFFS 0 256 0 0 0 128 /end COMPU_METHOD
/begin COMPU_METHOD kw_uw_q0p0078 "" RAT_FUNC "%6.4" "°KW" COEFFS 0 128 0 0 0 1 /end COMPU_METHOD
/begin COMPU_METHOD lw_sw_q0p04375 "" RAT_FUNC "%6.4" "°" COEFFS 0 32767 0 0 0 1434 /end COMPU_METHOD
/begin COMPU_METHOD m_q0p1 "" RAT_FUNC "%6.3" "kg/h" COEFFS 0 10 0 0 0 1 /end COMPU_METHOD
/begin COMPU_METHOD m_ub_q0p4 "" RAT_FUNC "%6.3" "kg" COEFFS 0 1 0 0 0 0.4 /end COMPU_METHOD
/begin COMPU_METHOD m_uw_b102p4 "" RAT_FUNC "%6.4" "kg/h" COEFFS 0 65536 0 0 0 102.4 /end COMPU_METHOD
/begin COMPU_METHOD m_uw_b4660 "" RAT_FUNC "%6.4" "g" COEFFS 0 3600 0 0 0 256 /end COMPU_METHOD
/begin COMPU_METHOD m_uw_b6553p5 "" RAT_FUNC "%6.3" "kg/h" COEFFS 0 1 0 0 0 0.1 /end COMPU_METHOD
/begin COMPU_METHOD nmot_q0p1453421 "" RAT_FUNC "%6.3" "U/min" COEFFS 0 1 0 0 0 0.145342 /end COMPU_METHOD
/begin COMPU_METHOD nmot_sw_q0p25 "" RAT_FUNC "%6.3" "U/min" COEFFS 0 1 0 0 0 0.25 /end COMPU_METHOD
/begin COMPU_METHOD nmot_ub_q10 "" RAT_FUNC "%6.1" "U/min" COEFFS 0 1 0 0 0 10 /end COMPU_METHOD
/begin COMPU_METHOD nmot_ub_q40 "" RAT_FUNC "%6.1" "Upm" COEFFS 0 1 0 0 0 40 /end COMPU_METHOD
/begin COMPU_METHOD nmot_uw_q0p25 "" RAT_FUNC "%6.3" "U/min" COEFFS 0 1 0 0 0 0.25 /end COMPU_METHOD
/begin COMPU_METHOD p_sw_q0p078 "" RAT_FUNC "%9.5" "hPa" COEFFS 0 256 0 0 0 20 /end COMPU_METHOD
/begin COMPU_METHOD p_ub_q5 "" RAT_FUNC "%6.2" "hPa" COEFFS 0 1 0 0 0 5 /end COMPU_METHOD
/begin COMPU_METHOD p_uw_q0p039 "" RAT_FUNC "%6.4" "hPa" COEFFS 0 256 0 0 0 10 /end COMPU_METHOD
/begin COMPU_METHOD relDK_ub_b100 "" RAT_FUNC "%6.3" "% DK" COEFFS 0 255 0 0 0 100 /end COMPU_METHOD
/begin COMPU_METHOD relnmot_q0p0039 "" RAT_FUNC "%6.4" "%/(U/min)" COEFFS 0 256 0 0 0 1 /end COMPU_METHOD
/begin COMPU_METHOD relnmot_q0p02 "" RAT_FUNC "%6.4" "%/(U/min)/s" COEFFS 0 1 0 0 0 0.02 /end COMPU_METHOD
/begin COMPU_METHOD relPED_ub_b100 "" RAT_FUNC "%6.3" "% PED" COEFFS 0 255 0 0 0 100 /end COMPU_METHOD
/begin COMPU_METHOD rel_q0p0977 "" RAT_FUNC "%6.3" "%" COEFFS 0 1 0 0 0 0.0977 /end COMPU_METHOD
/begin COMPU_METHOD rel_q0p1953 "" RAT_FUNC "%6.3" "%" COEFFS 0 256 0 0 0 50 /end COMPU_METHOD
/begin COMPU_METHOD rel_q0p1957 "" RAT_FUNC "%6.3" "%" COEFFS 0 511 0 0 0 100 /end COMPU_METHOD
/begin COMPU_METHOD rel_q0p39 "" RAT_FUNC "%6.3" "%" COEFFS 0 256 0 0 0 100 /end COMPU_METHOD
/begin COMPU_METHOD rel_q0p392 "" RAT_FUNC "%6.3" "%" COEFFS 0 255 0 0 0 100 /end COMPU_METHOD
/begin COMPU_METHOD rel_q0p7629Em3 "" RAT_FUNC "%6.5" "%" COEFFS 0 65536 0 0 0 50 /end COMPU_METHOD
/begin COMPU_METHOD rel_sb_q0p39 "" RAT_FUNC "%6.3" "%" COEFFS 0 1 0 0 0 0.3906 /end COMPU_METHOD
/begin COMPU_METHOD rel_sw_b100 "" RAT_FUNC "%6.4" "%" COEFFS 0 32768 0 0 0 100 /end COMPU_METHOD
/begin COMPU_METHOD rel_sw_b50 "" RAT_FUNC "%6.4" "%" COEFFS 0 65536 0 0 0 100 /end COMPU_METHOD
/begin COMPU_METHOD rel_ub_b100 "" RAT_FUNC "%6.3" "%" COEFFS 0 256 0 0 0 100 /end COMPU_METHOD
/begin COMPU_METHOD rel_ub_b127p5 "" RAT_FUNC "%6.3" "%" COEFFS 0 2 0 0 0 1 /end COMPU_METHOD
/begin COMPU_METHOD rel_ub_b24p9 "" RAT_FUNC "%6.3" "%" COEFFS 0 255 0 0 0 24.9 /end COMPU_METHOD
/begin COMPU_METHOD rel_ub_b99p6 "" RAT_FUNC "%6.3" "%" COEFFS 0 256 0 0 0 100 /end COMPU_METHOD
/begin COMPU_METHOD rel_ub_bn24p9 "" RAT_FUNC "%6.5" "%" COEFFS 0 -255 0 0 0 24.9 /end COMPU_METHOD
/begin COMPU_METHOD rel_ub_q0p75 "" RAT_FUNC "%6.3" "%" COEFFS 0 1 0 0 0 0.75 /end COMPU_METHOD
/begin COMPU_METHOD rel_uw_b100 "" RAT_FUNC "%6.4" "%" COEFFS 0 65536 0 0 0 100 /end COMPU_METHOD
/begin COMPU_METHOD rel_uw_b200 "" RAT_FUNC "%6.4" "%" COEFFS 0 65536 0 0 0 200 /end COMPU_METHOD
/begin COMPU_METHOD rel_uw_b3072 "" RAT_FUNC "%6.4" "%" COEFFS 0 65536 0 0 0 3072 /end COMPU_METHOD
/begin COMPU_METHOD rel_uw_q0p0234 "" RAT_FUNC "%6.4" "%" COEFFS 0 32 0 0 0 0.75 /end COMPU_METHOD
/begin COMPU_METHOD rkti11_sy "" RAT_FUNC "%6.5" "ms/%" COEFFS 0 9000 0 0 0 1 /end COMPU_METHOD
/begin COMPU_METHOD rkti_k_sy "" RAT_FUNC "%6.3" "%/(ms*s)" COEFFS 0 2.7962 0 0 0 1 /end COMPU_METHOD
/begin COMPU_METHOD rkti_p_sy "" RAT_FUNC "%6.4" "%/ms" COEFFS 0 27.962 0 0 0 1 /end COMPU_METHOD
/begin COMPU_METHOD runtime1_sy "" RAT_FUNC "%6.3" "us" COEFFS 0 1.5 0 0 0 1 /end COMPU_METHOD
/begin COMPU_METHOD runtime2_sy "" RAT_FUNC "%6.1" "us" COEFFS 0 0.09375 0 0 0 1 /end COMPU_METHOD
/begin COMPU_METHOD spg_q0p00039 "" RAT_FUNC "%6.5" "V" COEFFS 0 1 0 0 0 0.000390625 /end COMPU_METHOD
/begin COMPU_METHOD spg_ubatt "" RAT_FUNC "%6.4" "V" COEFFS 0 1 0 0 0 0.0704 /end COMPU_METHOD
/begin COMPU_METHOD t100msxs_ub_b255 "" RAT_FUNC "%6.2" "s" COEFFS 0 1 0 0 0 1 /end COMPU_METHOD
/begin COMPU_METHOD t100msxs_ub_b25p5 "" RAT_FUNC "%6.3" "s" COEFFS 0 1 0 0 0 0.1 /end COMPU_METHOD
/begin COMPU_METHOD t100msxs_uw_b6553p6 "" RAT_FUNC "%6.3" "s" COEFFS 0 10 0 0 0 1 /end COMPU_METHOD
/begin COMPU_METHOD t10msxs_uw_b655p35 "" RAT_FUNC "%6.4" "s" COEFFS 0 1 0 0 0 0.01 /end COMPU_METHOD
/begin COMPU_METHOD t1msxms_q1 "" RAT_FUNC "%6.2" "ms" COEFFS 0 1 0 0 0 1 /end COMPU_METHOD
/begin COMPU_METHOD t1sxs_ub_b255 "" RAT_FUNC "%6.2" "s" COEFFS 0 1 0 0 0 1 /end COMPU_METHOD
/begin COMPU_METHOD t200msxs_ub_b51 "" RAT_FUNC "%6.3" "s" COEFFS 0 1 0 0 0 0.2 /end COMPU_METHOD
/begin COMPU_METHOD t20msxs_ub_b5p1 "" RAT_FUNC "%6.4" "s" COEFFS 0 1 0 0 0 0.02 /end COMPU_METHOD
/begin COMPU_METHOD t20msxs_uw_q0p02 "" RAT_FUNC "%6.4" "s" COEFFS 0 1 0 0 0 0.02 /end COMPU_METHOD
/begin COMPU_METHOD t20usxus_q20 "" RAT_FUNC "%6.1" "us" COEFFS 0 1 0 0 0 20 /end COMPU_METHOD
/begin COMPU_METHOD t40usxus_q40 "" RAT_FUNC "%6.1" "us" COEFFS 0 1 0 0 0 40 /end COMPU_METHOD
/begin COMPU_METHOD t50msxs_q0p05 "" RAT_FUNC "%6.4" "s" COEFFS 0 1 0 0 0 0.05 /end COMPU_METHOD
/begin COMPU_METHOD t5usxus_q5 "" RAT_FUNC "%6.2" "us" COEFFS 0 1 0 0 0 5 /end COMPU_METHOD
/begin COMPU_METHOD temp_ub_q0p75_o48 "" RAT_FUNC "%6.2" "Grad C" COEFFS 0 1 48 0 0 0.75 /end COMPU_METHOD
/begin COMPU_METHOD tinjection5_sy "" RAT_FUNC "%6.4" "ms" COEFFS 0 75 0 0 0 1 /end COMPU_METHOD
/begin COMPU_METHOD tinjection_sy "" RAT_FUNC "%6.4" "ms" COEFFS 0 375 0 0 0 1 /end COMPU_METHOD
/begin COMPU_METHOD tv_ub_b100 "" RAT_FUNC "%6.3" "%" COEFFS 0 256 0 0 0 100 /end COMPU_METHOD
/begin COMPU_METHOD vfzg_ub_q1p25 "" RAT_FUNC "%6.2" "km/h" COEFFS 0 1 0 0 0 1.25 /end COMPU_METHOD
/begin COMPU_METHOD zk100msxs_ub_b25p5 "" RAT_FUNC "%6.3" "s" COEFFS 0 0 256 0 10 0 /end COMPU_METHOD
/begin COMPU_METHOD zk100msxs_uw_b6553 "" RAT_FUNC "%12.4" "s" COEFFS 0 0 65536 0 10 0 /end COMPU_METHOD
/begin COMPU_METHOD zk10msxs_uw_b655 "" RAT_FUNC "%12.5" "s" COEFFS 0 0 65536 0 100 0 /end COMPU_METHOD
/begin COMPU_METHOD zk200msxs_uw_b13107 "" RAT_FUNC "%12.3" "s" COEFFS 0 0 13107.2 0 1 0 /end COMPU_METHOD
/begin COMPU_METHOD zk20msxs_ub_b5p1 "" RAT_FUNC "%6.4" "s" COEFFS 0 0 5.1 0 1 0 /end COMPU_METHOD
/begin COMPU_METHOD zk20msxs_ub_b5p12 "" RAT_FUNC "%6.4" "s" COEFFS 0 0 256 0 50 0 /end COMPU_METHOD
/begin COMPU_METHOD zk50msxs_ub_b12p8 "" RAT_FUNC "%10.5" "s" COEFFS 0 0 128 0 10 0 /end COMPU_METHOD
/begin COMPU_METHOD zk50msxs_uw_b3276p8 "" RAT_FUNC "%12.4" "s" COEFFS 0 0 65536 0 20 0 /end COMPU_METHOD
/begin COMPU_METHOD zw_sb_q0p75 "" RAT_FUNC "%6.3" "grad KW" COEFFS 0 255 0 0 0 191.25 /end COMPU_METHOD
/begin COMPU_METHOD zw_ub_qn0p75 "" RAT_FUNC "%6.4" "grad KW" COEFFS 0 1 0 0 0 -0.75 /end COMPU_METHOD
/begin COMPU_METHOD defaultAscii "" RAT_FUNC "%6.2" "" COEFFS 0 1 0 0 0 1 /end COMPU_METHOD
/begin RECORD_LAYOUT FklWSb FNC_VALUES 1 SBYTE COLUMN_DIR DIRECT /end RECORD_LAYOUT
/begin RECORD_LAYOUT FklWUb FNC_VALUES 1 UBYTE COLUMN_DIR DIRECT /end RECORD_LAYOUT
/begin RECORD_LAYOUT GkfWSb FNC_VALUES 1 SBYTE COLUMN_DIR DIRECT /end RECORD_LAYOUT
/begin RECORD_LAYOUT GkfWSw FNC_VALUES 1 SWORD COLUMN_DIR DIRECT /end RECORD_LAYOUT
/begin RECORD_LAYOUT GkfWUb FNC_VALUES 1 UBYTE COLUMN_DIR DIRECT /end RECORD_LAYOUT
/begin RECORD_LAYOUT GkfWUw FNC_VALUES 1 UWORD COLUMN_DIR DIRECT /end RECORD_LAYOUT
/begin RECORD_LAYOUT GklWSw FNC_VALUES 1 SWORD COLUMN_DIR DIRECT /end RECORD_LAYOUT
/begin RECORD_LAYOUT GklWUb FNC_VALUES 1 UBYTE COLUMN_DIR DIRECT /end RECORD_LAYOUT
/begin RECORD_LAYOUT GklWUw FNC_VALUES 1 UWORD COLUMN_DIR DIRECT /end RECORD_LAYOUT
/begin RECORD_LAYOUT KfAxSwAySwSstxSwSstySwWSw NO_AXIS_PTS_X 1 SWORD NO_AXIS_PTS_Y 2 SWORD AXIS_PTS_X 3 SWORD INDEX_INCR DIRECT AXIS_PTS_Y 4 SWORD INDEX_INCR DIRECT FNC_VALUES 5 SWORD COLUMN_DIR DIRECT /end RECORD_LAYOUT
/begin RECORD_LAYOUT KfAxUbAyUbSstxUbSstyUbWUb NO_AXIS_PTS_X 1 UBYTE NO_AXIS_PTS_Y 2 UBYTE AXIS_PTS_X 3 UBYTE INDEX_INCR DIRECT AXIS_PTS_Y 4 UBYTE INDEX_INCR DIRECT FNC_VALUES 5 UBYTE COLUMN_DIR DIRECT /end RECORD_LAYOUT
/begin RECORD_LAYOUT KfAxUbAyUbSstxUbSstyUwWUw NO_AXIS_PTS_X 1 UBYTE NO_AXIS_PTS_Y 2 UBYTE AXIS_PTS_X 3 UBYTE INDEX_INCR DIRECT AXIS_PTS_Y 4 UWORD INDEX_INCR DIRECT FNC_VALUES 5 UWORD COLUMN_DIR DIRECT /end RECORD_LAYOUT
/begin RECORD_LAYOUT KfAxUwAyUwSstxUwSstyUwWSw NO_AXIS_PTS_X 1 UWORD NO_AXIS_PTS_Y 2 UWORD AXIS_PTS_X 3 UWORD INDEX_INCR DIRECT AXIS_PTS_Y 4 UWORD INDEX_INCR DIRECT FNC_VALUES 5 SWORD COLUMN_DIR DIRECT /end RECORD_LAYOUT
/begin RECORD_LAYOUT KlAUbSstSwWSw NO_AXIS_PTS_X 1 SWORD AXIS_PTS_X 2 SWORD INDEX_INCR DIRECT FNC_VALUES 3 SWORD COLUMN_DIR DIRECT /end RECORD_LAYOUT
/begin RECORD_LAYOUT KlAUbSstUbWSb NO_AXIS_PTS_X 1 UBYTE AXIS_PTS_X 2 UBYTE INDEX_INCR DIRECT FNC_VALUES 3 SBYTE COLUMN_DIR DIRECT /end RECORD_LAYOUT
/begin RECORD_LAYOUT KlAUbSstUbWUb NO_AXIS_PTS_X 1 UBYTE AXIS_PTS_X 2 UBYTE INDEX_INCR DIRECT FNC_VALUES 3 UBYTE COLUMN_DIR DIRECT /end RECORD_LAYOUT
/begin RECORD_LAYOUT KlAUbSstUbWUw NO_AXIS_PTS_X 1 UBYTE AXIS_PTS_X 2 UBYTE INDEX_INCR DIRECT FNC_VALUES 3 UWORD COLUMN_DIR DIRECT /end RECORD_LAYOUT
/begin RECORD_LAYOUT KlAUwSstSwWUw NO_AXIS_PTS_X 1 UWORD AXIS_PTS_X 2 SWORD INDEX_INCR DIRECT FNC_VALUES 3 UWORD COLUMN_DIR DIRECT /end RECORD_LAYOUT
/begin RECORD_LAYOUT KlAUwSstUwWSw NO_AXIS_PTS_X 1 UWORD AXIS_PTS_X 2 UWORD INDEX_INCR DIRECT FNC_VALUES 3 SWORD COLUMN_DIR DIRECT /end RECORD_LAYOUT
/begin RECORD_LAYOUT KlAUwSstUwWUw NO_AXIS_PTS_X 1 UWORD AXIS_PTS_X 2 UWORD INDEX_INCR DIRECT FNC_VALUES 3 UWORD COLUMN_DIR DIRECT /end RECORD_LAYOUT
/begin RECORD_LAYOUT KtxC FNC_VALUES 1 UBYTE COLUMN_DIR DIRECT /end RECORD_LAYOUT
/begin RECORD_LAYOUT KwSb FNC_VALUES 1 SBYTE COLUMN_DIR DIRECT /end RECORD_LAYOUT
/begin RECORD_LAYOUT KwSw FNC_VALUES 1 SWORD COLUMN_DIR DIRECT /end RECORD_LAYOUT
/begin RECORD_LAYOUT KwUb FNC_VALUES 1 UBYTE COLUMN_DIR DIRECT /end RECORD_LAYOUT
/begin RECORD_LAYOUT KwUw FNC_VALUES 1 UWORD COLUMN_DIR DIRECT /end RECORD_LAYOUT
/begin RECORD_LAYOUT SstAUbSstUb NO_AXIS_PTS_X 1 UBYTE AXIS_PTS_X 2 UBYTE INDEX_INCR DIRECT /end RECORD_LAYOUT
/begin RECORD_LAYOUT SstAUwSstUw NO_AXIS_PTS_X 1 UWORD AXIS_PTS_X 2 UWORD INDEX_INCR DIRECT /end RECORD_LAYOUT
/end MODULE
/end PROJECT
