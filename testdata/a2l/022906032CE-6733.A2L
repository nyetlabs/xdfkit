ASAP2_VERSION 1 3
/begin PROJECT S1103A_25G5_0 "S1103A"
/begin HEADER "" VERSION "S1103A_25G5_0" PROJECT_NO S1103A_25G5_0 /end HEADER
/begin MODULE DIM ""
/begin MOD_COMMON "" BYTE_ORDER MSB_LAST ALIGNMENT_BYTE 1 ALIGNMENT_WORD 2 ALIGNMENT_LONG 2 /end MOD_COMMON
/begin CHARACTERISTIC ACSZNBM "" VALUE 0x8FD38B KwUb 255.0 dez 0.00 255.0 FORMAT "%5.1" /end CHARACTERISTIC
/begin CHARACTERISTIC ACSZRPH "" VALUE 0x8FD38C KwUb 255.0 dez 0.00 255.0 FORMAT "%5.1" /end CHARACTERISTIC
/begin CHARACTERISTIC ANZTPMX "" VALUE 0x8E0ED0 KwUb 255.0 dez 0.00 255.0 FORMAT "%5.1" /end CHARACTERISTIC
/begin CHARACTERISTIC ANZTPUD "" VALUE 0x8E0ED1 KwUb 255.0 dez 0.00 255.0 FORMAT "%5.1" /end CHARACTERISTIC
/begin CHARACTERISTIC ANZ_ZRPH "" VALUE 0x8FCD5F KwUb 255.0 dez 0.00 255.0 FORMAT "%5.1" /end CHARACTERISTIC
/begin CHARACTERISTIC APDTEFRE "" VALUE 0x8E3907 KwUb 50.00 dez 0.00 50.00 FORMAT "%5.2" /end CHARACTERISTIC
/begin CHARACTERISTIC APDTEVX "" VALUE 0x8E3908 KwUb 10.00 dez 0.00 10.00 FORMAT "%5.2" /end CHARACTERISTIC
/begin CHARACTERISTIC AVDTEVX "" VALUE 0x8E3909 KwUb 20.00 dez 0.00 20.00 FORMAT "%5.2" /end CHARACTERISTIC
/begin CHARACTERISTIC BFGRO "" VALUE 0x8FDD5E KwSw 27.7802865 bfzg_sw_q4p239Em4 -13.8903552 13.8899313 /end CHARACTERISTIC
/begin CHARACTERISTIC BFGRU "" VALUE 0x8FDD60 KwSw 27.7802865 bfzg_sw_q4p239Em4 -13.8903552 13.8899313 /end CHARACTERISTIC
/begin CHARACTERISTIC BRABEVI "" CURVE 0x8E8388 KlAUwSstUwWUw 27.78029 bfzg_uw_q4p239Em4 0.00 27.78029 FORMAT "%8.5"
 /begin AXIS_DESCR STD_AXIS vfgr_w vfzg_uw_b512 8 0.00 511.9922 FORMAT "%8.4" DEPOSIT ABSOLUTE /end AXIS_DESCR
/end CHARACTERISTIC
/begin CHARACTERISTIC BRATD "" VALUE 0x8E83AA KwUw 27.78029 bfzg_uw_q4p239Em4 0.00 27.78029 FORMAT "%8.5" /end CHARACTERISTIC
/begin CHARACTERISTIC BRATU "" VALUE 0x8E83AC KwUw 27.78029 bfzg_uw_q4p239Em4 0.00 27.78029 FORMAT "%8.5" /end CHARACTERISTIC
/begin CHARACTERISTIC BSWKB "" VALUE 0x8E83AE KwSw 27.7802865 bfzg_sw_q4p239Em4 -13.8903552 13.8899313 /end CHARACTERISTIC
/begin CHARACTERISTIC BSWKV "" VALUE 0x8E83B0 KwSw 27.7802865 bfzg_sw_q4p239Em4 -13.8903552 13.8899313 /end CHARACTERISTIC
/begin CHARACTERISTIC CLDPTVC "" VALUE 0x8E390A KwUb 255.0 dez 0.00 255.0 FORMAT "%5.1" /end CHARACTERISTIC
/begin CHARACTERISTIC CSGRA "" VALUE 0x8FCFBA KwUb 255.0 DEZ 0.00 255.0 FORMAT "%5.1" /end CHARACTERISTIC
/begin CHARACTERISTIC CUKA "" VALUE 0x8FD06A KwUb 255.0 dez 0.00 255.0 FORMAT "%5.1" /end CHARACTERISTIC
/begin CHARACTERISTIC CWANLEN "" VALUE 0x8E03CE KwUb 255.0 dez 0.00 255.0 FORMAT "%5.1" /end CHARACTERISTIC
/begin CHARACTERISTIC CWCANMD "" VALUE 0x8FCD60 KwUb 255.0 dez 0.00 255.0 FORMAT "%5.1" /end CHARACTERISTIC
/begin CHARACTERISTIC CWCS_0_A "" VALUE 0x8E3FDD KwUb 255.0 DEZ 0.00 255.0 FORMAT "%5.1" /end CHARACTERISTIC
/begin CHARACTERISTIC CWCS_1_A "" VALUE 0x8E3FDE KwUb 255.0 DEZ 0.00 255.0 FORMAT "%5.1" /end CHARACTERISTIC
/begin CHARACTERISTIC CWDTEAPP "" VALUE 0x8E390B KwUb 255.0 dez 0.00 255.0 FORMAT "%5.1" /end CHARACTERISTIC
/begin CHARACTERISTIC CWDTEV "" VALUE 0x8E390C KwUb 255.0 dez 0.00 255.0 FORMAT "%5.1" /end CHARACTERISTIC
/begin CHARACTERISTIC CWFGRABED "" VALUE 0x8FCFB2 KwUb 255.0 dez 0.00 255.0 FORMAT "%5.1" /end CHARACTERISTIC
/begin CHARACTERISTIC CWFGRBESI "" VALUE 0x8E0ECF KwUb 255.0 dez 0.00 255.0 FORMAT "%5.1" /end CHARACTERISTIC
/begin CHARACTERISTIC CWFGRFULO "" VALUE 0x8E0ED2 KwUb 255.0 dez 0.00 255.0 FORMAT "%5.1" /end CHARACTERISTIC
/begin CHARACTERISTIC CWFGRFULO2 "" VALUE 0x8E0ED3 KwUb 255.0 dez 0.00 255.0 FORMAT "%5.1" /end CHARACTERISTIC
/begin CHARACTERISTIC CWFGRGA "" VALUE 0x8FCFB3 KwUb 255.0 dez 0.00 255.0 FORMAT "%5.1" /end CHARACTERISTIC
/begin CHARACTERISTIC CWFGRLVZ "" VALUE 0x8E83B2 KwUw 65535.00 dez 0.00 65535.00 FORMAT "%8.2" /end CHARACTERISTIC
/begin CHARACTERISTIC CWFGRREGL "" VALUE 0x8E0EF6 KwUb 255.0 dez 0.00 255.0 FORMAT "%5.1" /end CHARACTERISTIC
/begin CHARACTERISTIC CWFLSUBB "" VALUE 0x8E350E KwUb 255.0 dez 0.00 255.0 FORMAT "%5.1" /end CHARACTERISTIC
/begin CHARACTERISTIC CWFS "" VALUE 0x8FCD26 KwUb 255.0 dez 0.00 255.0 FORMAT "%5.1" /end CHARACTERISTIC
/begin CHARACTERISTIC CWFUEDK "" VALUE 0x8FE672 KwUw 65535.00 dez 0.00 65535.00 FORMAT "%8.2" /end CHARACTERISTIC
/begin CHARACTERISTIC CWFUEREG "" VALUE 0x8E1463 KwUb 255.0 dez 0.00 255.0 FORMAT "%5.1" /end CHARACTERISTIC
/begin CHARACTERISTIC CWGEMD "" VALUE 0x8FCD27 KwUb 255.0 dez 0.00 255.0 FORMAT "%5.1" /end CHARACTERISTIC
/begin CHARACTERISTIC CWGGCEGS "" VALUE 0x8FD8E8 KwUw 65535.00 dez 0.00 65535.00 FORMAT "%8.2" /end CHARACTERISTIC
/begin CHARACTERISTIC CWKL15SP "" VALUE 0x8FCD61 KwUb 255.0 dez 0.00 255.0 FORMAT "%5.1" /end CHARACTERISTIC
/begin CHARACTERISTIC CWMSRCAN "" VALUE 0x8FCD30 KwUb 255.0 DEZ 0.00 255.0 FORMAT "%5.1" /end CHARACTERISTIC
/begin CHARACTERISTIC CWUTEKU "" VALUE 0x8E390D KwUb 255.0 dez 0.00 255.0 FORMAT "%5.1" /end CHARACTERISTIC
/begin CHARACTERISTIC CWWDKSPE "" VALUE 0x8FCFD2 KwUb 255.0 dez 0.00 255.0 FORMAT "%5.1" /end CHARACTERISTIC
/begin CHARACTERISTIC DBZ_AIR "" VALUE 0x8FD38D KwUb 255.0 DEZ 0.00 255.0 FORMAT "%5.1" /end CHARACTERISTIC
/begin CHARACTERISTIC DBZ_GE3 "" VALUE 0x8FCD2D KwUb 127.0 dez 0.00 127.0 FORMAT "%5.1" /end CHARACTERISTIC
/begin CHARACTERISTIC DBZ_GRA "" VALUE 0x8FCFBB KwUb 255.0 DEZ 0.00 255.0 FORMAT "%5.1" /end CHARACTERISTIC
/begin CHARACTERISTIC DBZ_MX "" VALUE 0x8FCD32 KwUb 255.0 DEZ 0.00 255.0 FORMAT "%5.1" /end CHARACTERISTIC
/begin CHARACTERISTIC DDFDTEAB "" VALUE 0x8E390E KwUb 99.61 rel_ub_b99p6 0.00 99.61 FORMAT "%5.2" /end CHARACTERISTIC
/begin CHARACTERISTIC DFAFRG "" VALUE 0x8E1464 KwUb 0.9961 fak_ub_b1 0.00 0.9961 /end CHARACTERISTIC
/begin CHARACTERISTIC DFRMDTEE "" VALUE 0x8EEC22 KwUw 0.03125000 fak_uw_b2 0.00 0.03125000 FORMAT "%10.8" /end CHARACTERISTIC
/begin CHARACTERISTIC DFRMDTEF "" VALUE 0x8EEC24 KwSw 0.2000122 fak_sw_b1 -0.2000122 0.00 FORMAT "%9.7" /end CHARACTERISTIC
/begin CHARACTERISTIC DFRMDTEM "" VALUE 0x8EEC26 KwSw 0.2000122 fak_sw_b1 0.00 0.2000122 FORMAT "%9.7" /end CHARACTERISTIC
/begin CHARACTERISTIC DKNOTBEGR "" CURVE 0x8EA19C KlAUbSstUbWUw 100.0000 relDK_uw_b100 0.00 100.0000 FORMAT "%8.4"
 /begin AXIS_DESCR STD_AXIS nmot nmot_ub_q40 8 0.00 10200. FORMAT "%5.0" DEPOSIT ABSOLUTE /end AXIS_DESCR
/end CHARACTERISTIC
/begin CHARACTERISTIC DMLDTEFN "" VALUE 0x8EEC28 KwSw 2.000000 m_q0p0031 -2.000000 0.00 FORMAT "%8.6" /end CHARACTERISTIC
/begin CHARACTERISTIC DMLDTEFX "" VALUE 0x8EEC2A KwSw 3.025000 m_q0p0031 0.00 3.025000 FORMAT "%8.6" /end CHARACTERISTIC
/begin CHARACTERISTIC DMLDTEMN "" VALUE 0x8EEC2C KwSw 2.000000 m_q0p0031 -2.000000 0.00 FORMAT "%8.6" /end CHARACTERISTIC
/begin CHARACTERISTIC DMLDTEMX "" VALUE 0x8EEC2E KwSw 2.000000 m_q0p0031 0.00 2.000000 FORMAT "%8.6" /end CHARACTERISTIC
/begin CHARACTERISTIC DMSNTEMN "" VALUE 0x8EEC30 KwSw 3281.700 m_q0p1 -5.000000 3276.700 FORMAT "%8.3" /end CHARACTERISTIC
/begin CHARACTERISTIC DMSNTEMX "" VALUE 0x8EEC32 KwSw 3274.700 m_q0p1 2.000000 3276.700 FORMAT "%8.3" /end CHARACTERISTIC
/begin CHARACTERISTIC DMVTEVDO "" VALUE 0x8EEC34 KwSw 199.9969 rel_sw_b100 -100.0000 99.99695 FORMAT "%8.4" /end CHARACTERISTIC
/begin CHARACTERISTIC DN10BURN "" VALUE 0x8FD03B KwUb 2550. nmot_ub_q10 0.00 2550. FORMAT "%5.0" /end CHARACTERISTIC
/begin CHARACTERISTIC DNDTEO "" VALUE 0x8E390F KwSb 200.0 nmot_ub_q10 0.00 200.0 FORMAT "%5.1" /end CHARACTERISTIC
/begin CHARACTERISTIC DNDTEU "" VALUE 0x8E3910 KwSb 200.0 nmot_ub_q10 -200.0 0.00 FORMAT "%5.1" /end CHARACTERISTIC
/begin CHARACTERISTIC DNFGRMX "" VALUE 0x8FDD62 KwUw 16383.75 nmot_uw_q0p25 0.00 16383.75 FORMAT "%8.2" /end CHARACTERISTIC
/begin CHARACTERISTIC DNLLCAUVW "" VALUE 0x8FD900 KwUw 16383.75 nmot_uw_q0p25 0.00 16383.75 FORMAT "%8.2" /end CHARACTERISTIC
/begin CHARACTERISTIC DNMZGEZW "" VALUE 0x8FD8EA KwSw 199.9969 rel_sw_b100 -100.0000 99.99695 FORMAT "%8.4" /end CHARACTERISTIC
/begin CHARACTERISTIC DNNSOL "" VALUE 0x8E3911 KwUb 200.0 nmot_ub_q10 0.00 200.0 FORMAT "%5.1" /end CHARACTERISTIC
/begin CHARACTERISTIC DRLSOLMF "" VALUE 0x8FE674 KwUw 1535.977 rel_uw_q0p0234 0.00 1535.977 FORMAT "%8.3" /end CHARACTERISTIC
/begin CHARACTERISTIC DRLZGEZW "" VALUE 0x8FD8EC KwSw 3071.953 rel_sw_b1536 -1536.000 1535.953 FORMAT "%8.3" /end CHARACTERISTIC
/begin CHARACTERISTIC DTMWUC "" VALUE 0x8FCDFB KwUb 191.3 temp_ub_b191p25 0.00 191.3 FORMAT "%5.1" /end CHARACTERISTIC
/begin CHARACTERISTIC DUF_T "" VALUE 0x8FCCC9 KwUb 25.50 t100msxs_ub_b25p5 0.00 25.50 FORMAT "%5.2" /end CHARACTERISTIC
/begin CHARACTERISTIC DUKK "" VALUE 0x8FE6C8 KwSw 3071.953 rel_sw_q0p0468 -1536.000 1535.953 FORMAT "%8.3" /end CHARACTERISTIC
/begin CHARACTERISTIC DURNPRST_A "" VALUE 0x8FCCCB KwUb 255.0 dez 0.00 255.0 FORMAT "%5.1" /end CHARACTERISTIC
/begin CHARACTERISTIC DVIVZMX "" VALUE 0x8FDD64 KwUw 511.9922 vfzg_uw_b512 0.00 511.9922 FORMAT "%8.4" /end CHARACTERISTIC
/begin CHARACTERISTIC DVIVZTMX "" VALUE 0x8E83B4 KwUw 511.9922 vfzg_uw_q0p0078125 0.00 511.9922 FORMAT "%8.4" /end CHARACTERISTIC
/begin CHARACTERISTIC DVLLVO "" VALUE 0x8E8480 KwUw 511.9922 vfzg_uw_q0p0078125 0.00 511.9922 FORMAT "%8.4" /end CHARACTERISTIC
/begin CHARACTERISTIC DVLLVU "" VALUE 0x8E8482 KwUw 511.9922 vfzg_uw_q0p0078125 0.00 511.9922 FORMAT "%8.4" /end CHARACTERISTIC
/begin CHARACTERISTIC DVMAXFGR "" VALUE 0x8E83B6 KwUw 511.9922 vfzg_uw_q0p0078125 0.00 511.9922 FORMAT "%8.4" /end CHARACTERISTIC
/begin CHARACTERISTIC DVOVRMX "" VALUE 0x8E837C KwUw 511.9922 vfzg_uw_b512 0.00 511.9922 FORMAT "%8.4" /end CHARACTERISTIC
/begin CHARACTERISTIC DVRAMPMX "" VALUE 0x8E83B8 KwUw 511.9922 vfzg_uw_q0p0078125 0.00 511.9922 FORMAT "%8.4" /end CHARACTERISTIC
/begin CHARACTERISTIC DVSAVO "" VALUE 0x8E8484 KwUw 511.9922 vfzg_uw_q0p0078125 0.00 511.9922 FORMAT "%8.4" /end CHARACTERISTIC
/begin CHARACTERISTIC DVSAVU "" VALUE 0x8E8486 KwUw 511.9922 vfzg_uw_q0p0078125 0.00 511.9922 FORMAT "%8.4" /end CHARACTERISTIC
/begin CHARACTERISTIC DVSKNBGA "" CURVE 0x8E83BA KlAUbSstUbWUw 511.9922 vfzg_uw_q0p0078125 0.00 511.9922 FORMAT "%8.4"
 /begin AXIS_DESCR STD_AXIS uevges fak_q0p1 8 0.00 25.50 FORMAT "%5.2" DEPOSIT ABSOLUTE /end AXIS_DESCR
/end CHARACTERISTIC
/begin CHARACTERISTIC DVSKNVGA "" CURVE 0x8E83D4 KlAUbSstUbWUw 511.9922 vfzg_uw_q0p0078125 0.00 511.9922 FORMAT "%8.4"
 /begin AXIS_DESCR STD_AXIS uevges fak_q0p1 8 0.00 25.50 FORMAT "%5.2" DEPOSIT ABSOLUTE /end AXIS_DESCR
/end CHARACTERISTIC
/begin CHARACTERISTIC DVSWKB "" VALUE 0x8E83EE KwUw 511.9922 vfzg_uw_q0p0078125 0.00 511.9922 FORMAT "%8.4" /end CHARACTERISTIC
/begin CHARACTERISTIC DVSWKV "" VALUE 0x8E83F0 KwUw 511.9922 vfzg_uw_q0p0078125 0.00 511.9922 FORMAT "%8.4" /end CHARACTERISTIC
/begin CHARACTERISTIC DVTIPUD "" VALUE 0x8E83F2 KwUw 511.9922 vfzg_uw_q0p0078125 0.00 511.9922 FORMAT "%8.4" /end CHARACTERISTIC
/begin CHARACTERISTIC DVZVIMX "" VALUE 0x8FDD66 KwUw 511.9922 vfzg_uw_b512 0.00 511.9922 FORMAT "%8.4" /end CHARACTERISTIC
/begin CHARACTERISTIC DVZVITMX "" VALUE 0x8E83F4 KwUw 511.9922 vfzg_uw_q0p0078125 0.00 511.9922 FORMAT "%8.4" /end CHARACTERISTIC
/begin CHARACTERISTIC DVZVIWA "" VALUE 0x8E83F6 KwUw 511.9922 vfzg_uw_q0p0078125 0.00 511.9922 FORMAT "%8.4" /end CHARACTERISTIC
/begin CHARACTERISTIC DWEEAMX "" VALUE 0x8FD008 KwUb 1530. zw_ub_q6 0.00 1530. FORMAT "%5.0" /end CHARACTERISTIC
/begin CHARACTERISTIC DWEEMX "" VALUE 0x8FD009 KwUb 1530. zw_ub_q6 0.00 1530. FORMAT "%5.0" /end CHARACTERISTIC
/begin CHARACTERISTIC DWLLPED "" VALUE 0x8FD902 KwUw 99.99847 relPED_uw_b100 0.00 99.99847 FORMAT "%8.5" /end CHARACTERISTIC
/begin CHARACTERISTIC DZUPHL "" VALUE 0x8FCFAE KwUb 255.0 dez 0.00 255.0 FORMAT "%5.1" /end CHARACTERISTIC
/begin CHARACTERISTIC DZUPKSMS "" VALUE 0x8FCFAF KwUb 255.0 dez 0.00 255.0 FORMAT "%5.1" /end CHARACTERISTIC
/begin CHARACTERISTIC DZUPKSUB "" VALUE 0x8FCFB0 KwUb 255.0 dez 0.00 255.0 FORMAT "%5.1" /end CHARACTERISTIC
/begin CHARACTERISTIC DZUPSIG "" VALUE 0x8FCFB1 KwUb 255.0 dez 0.00 255.0 FORMAT "%5.1" /end CHARACTERISTIC
/begin CHARACTERISTIC ENTDKLL "" VALUE 0x8FCFD3 KwUb 20.00 dez 0.00 20.00 FORMAT "%5.2" /end CHARACTERISTIC
/begin CHARACTERISTIC ENTDKNLL "" VALUE 0x8FCFD4 KwUb 20.00 dez 0.00 20.00 FORMAT "%5.2" /end CHARACTERISTIC
/begin CHARACTERISTIC ETAZWTEN "" VALUE 0x8E3912 KwUb 60.00 rel_ub_b127p5 0.00 60.00 FORMAT "%5.2" /end CHARACTERISTIC
/begin CHARACTERISTIC EVTMODMNDK "" VALUE 0x8FCFCF KwUb 191.3 temp_ub_q0p75_o48 -48.00 143.3 FORMAT "%5.1" /end CHARACTERISTIC
/begin CHARACTERISTIC FGMRIDV "" CURVE 0x8E8488 KlASwSstSwWSw 1.999939 fak_sw_b2 0.00 1.999939 FORMAT "%8.6"
 /begin AXIS_DESCR STD_AXIS dvzvi_w vfzg_sw_q0p00781 4 -256.0000 255.9922 FORMAT "%8.4" DEPOSIT ABSOLUTE /end AXIS_DESCR
/end CHARACTERISTIC
/begin AXIS_PTS FHO04ESUB "" 0x8E01C4 fho SstAUbSstUb 3.984 fak_ub_b4 4 0.00 3.984 FORMAT "%5.3" DEPOSIT ABSOLUTE /end AXIS_PTS
/begin CHARACTERISTIC FHODTEA "" VALUE 0x8EEC36 KwUw 1.900024 fak_uw_b4 0.09997559 2.000000 FORMAT "%8.6" /end CHARACTERISTIC
/begin CHARACTERISTIC FIMHU "" CURVE 0x8FD047 FklWUb 1.992 fak_ub_b2 0.00 1.992 FORMAT "%5.3"
 /begin AXIS_DESCR FIX_AXIS anzwefim dez 16 0.00 15.00 FORMAT "%5.2" FIX_AXIS_PAR 0 0 16 /end AXIS_DESCR
/end CHARACTERISTIC
/begin CHARACTERISTIC FIMWU "" CURVE 0x8FD057 FklWUb 1.992 fak_ub_b2 0.00 1.992 FORMAT "%5.3"
 /begin AXIS_DESCR FIX_AXIS anzwefim dez 16 0.00 15.00 FORMAT "%5.2" FIX_AXIS_PAR 0 0 16 /end AXIS_DESCR
/end CHARACTERISTIC
/begin CHARACTERISTIC FKADPMN "" VALUE 0x8E3913 KwSb 0.6953 fak_sb_b1 0.1016 0.7969 /end CHARACTERISTIC
/begin CHARACTERISTIC FKSTT "" CURVE 0x8EA8BA KlAUbSstUbWUw 63.99902 fak_uw_b64 0.00 63.99902 FORMAT "%8.5"
 /begin AXIS_DESCR STD_AXIS tmst temp_ub_q0p75_o48 12 -48.00 143.3 FORMAT "%5.1" DEPOSIT ABSOLUTE /end AXIS_DESCR
/end CHARACTERISTIC
/begin CHARACTERISTIC FKUKAO "" VALUE 0x8FD06B KwUb 3.984 fak_ub_b4 0.00 3.984 FORMAT "%5.3" /end CHARACTERISTIC
/begin CHARACTERISTIC FKUKAU "" VALUE 0x8FD06C KwUb 3.891 fak_ub_b4 0.09375 3.984 FORMAT "%5.3" /end CHARACTERISTIC
/begin CHARACTERISTIC FLAMRUKA "" VALUE 0x8FE716 KwUw 2.000000 fak_uw_b16 0.00 2.000000 FORMAT "%8.6" /end CHARACTERISTIC
/begin CHARACTERISTIC FLAMSBATM "" CURVE 0x8EADEC GklWUw 2.000000 fak_uw_b16 0.00 2.000000 FORMAT "%8.6"
 /begin AXIS_DESCR COM_AXIS tmot temp_ub_q0p75_o48 9 -48.00 143.3 FORMAT "%5.1" AXIS_PTS_REF STM09ESUB /end AXIS_DESCR
/end CHARACTERISTIC
/begin CHARACTERISTIC FLAMSVATM "" CURVE 0x8EADFE GklWUw 2.000000 fak_uw_b16 0.00 2.000000 FORMAT "%8.6"
 /begin AXIS_DESCR COM_AXIS tmot temp_ub_q0p75_o48 9 -48.00 143.3 FORMAT "%5.1" AXIS_PTS_REF STM09ESUB /end AXIS_DESCR
/end CHARACTERISTIC
/begin CHARACTERISTIC FMIUGDSN "" CURVE 0x8E9E90 KlAUwSstUwWUw 255.9961 fak_ub_b1 0.00 255.9961 FORMAT "%8.4"
 /begin AXIS_DESCR STD_AXIS nmot_w nmot_uw_q0p25 8 0.00 16383.75 FORMAT "%8.2" DEPOSIT ABSOLUTE /end AXIS_DESCR
/end CHARACTERISTIC
/begin CHARACTERISTIC FNSHO "" CURVE 0x8E1768 KlAUbSstUbWUb 1.992 fak_ub_b2 0.00 1.992 FORMAT "%5.3"
 /begin AXIS_DESCR STD_AXIS fho fak_ub_b4 4 0.00 3.984 FORMAT "%5.3" DEPOSIT ABSOLUTE /end AXIS_DESCR
/end CHARACTERISTIC
/begin CHARACTERISTIC FNSSM "" CURVE 0x8E1771 GklWUb 3.984 fak_ub_b4 0.00 3.984 FORMAT "%5.3"
 /begin AXIS_DESCR COM_AXIS tmst temp_ub_q0p75_o48 12 -48.00 143.3 FORMAT "%5.1" AXIS_PTS_REF STS12ESUB /end AXIS_DESCR
/end CHARACTERISTIC
/begin CHARACTERISTIC FPLMRM "" CURVE 0x8E1465 KlAUbSstUbWUb 0.9961 fak_ub_b1 0.00 0.9961
 /begin AXIS_DESCR STD_AXIS tmot temp_ub_q0p75_o48 6 -48.00 143.3 FORMAT "%5.1" DEPOSIT ABSOLUTE /end AXIS_DESCR
/end CHARACTERISTIC
/begin CHARACTERISTIC FPWDKAPP "" CURVE 0x8E9EB2 KlAUwSstUwWUw 99.99847 rel_uw_b100 0.00 99.99847 FORMAT "%8.5"
 /begin AXIS_DESCR STD_AXIS wped_w relPED_q0p00153 16 0.00 100.0000 FORMAT "%8.4" DEPOSIT ABSOLUTE /end AXIS_DESCR
/end CHARACTERISTIC
/begin CHARACTERISTIC FRKAP "" VALUE 0x8E1689 KwUb 1.992 fak_ub_b2 0.00 1.992 FORMAT "%5.3" /end CHARACTERISTIC
/begin CHARACTERISTIC FRMDPMO "" VALUE 0x8EEC38 KwUw 0.1499939 fak_uw_b2 1.000000 1.149994 FORMAT "%8.6" /end CHARACTERISTIC
/begin CHARACTERISTIC FRMDPMU "" VALUE 0x8EEC3A KwUw 0.1499939 fak_uw_b2 0.8500061 1.000000 FORMAT "%8.6" /end CHARACTERISTIC
/begin CHARACTERISTIC FRMDTEVO "" VALUE 0x8EEC3C KwUw 0.1499939 fak_uw_b2 1.000000 1.149994 FORMAT "%8.6" /end CHARACTERISTIC
/begin CHARACTERISTIC FRMDTEVU "" VALUE 0x8EEC3E KwUw 0.1499939 fak_uw_b2 0.8500061 1.000000 FORMAT "%8.6" /end CHARACTERISTIC
/begin CHARACTERISTIC FSTHO "" CURVE 0x8E1BFC KlAUbSstUbWUb 1.992 fak_ub_b2 0.00 1.992 FORMAT "%5.3"
 /begin AXIS_DESCR STD_AXIS fho fak_ub_b4 4 0.00 3.984 FORMAT "%5.3" DEPOSIT ABSOLUTE /end AXIS_DESCR
/end CHARACTERISTIC
/begin CHARACTERISTIC FSWKB "" VALUE 0x8E83F8 KwUw 19.99969 rel_uw_b20 0.00 19.99969 FORMAT "%8.5" /end CHARACTERISTIC
/begin CHARACTERISTIC FSWKV "" VALUE 0x8E83FA KwUw 19.99969 rel_uw_b20 0.00 19.99969 FORMAT "%8.5" /end CHARACTERISTIC
/begin CHARACTERISTIC FTEADDPO "" VALUE 0x8EEC40 KwSw 30.00000 fak_sw_b64 20.00000 50.00000 FORMAT "%8.5" /end CHARACTERISTIC
/begin CHARACTERISTIC FTEADDPU "" VALUE 0x8EEC42 KwSw 8.000000 fak_sw_b64 2.000000 10.00000 FORMAT "%8.5" /end CHARACTERISTIC
/begin CHARACTERISTIC FTEADSZ "" VALUE 0x8EEC44 KwSw 15.00000 fak_sw_b64 0.00 15.00000 FORMAT "%8.5" /end CHARACTERISTIC
/begin CHARACTERISTIC FUKABAKI "" VALUE 0x8FD06D KwUb 3.984 fak_ub_b4 0.00 3.984 FORMAT "%5.3" /end CHARACTERISTIC
/begin CHARACTERISTIC FUKABAKO "" VALUE 0x8FD06E KwUb 3.984 fak_ub_b4 0.00 3.984 FORMAT "%5.3" /end CHARACTERISTIC
/begin CHARACTERISTIC FUKABAKU "" VALUE 0x8FD06F KwUb 3.891 fak_ub_b4 0.09375 3.984 FORMAT "%5.3" /end CHARACTERISTIC
/begin CHARACTERISTIC FUKABAWI "" VALUE 0x8FD070 KwUb 3.984 fak_ub_b4 0.00 3.984 FORMAT "%5.3" /end CHARACTERISTIC
/begin CHARACTERISTIC FUKABAWO "" VALUE 0x8FD071 KwUb 3.984 fak_ub_b4 0.00 3.984 FORMAT "%5.3" /end CHARACTERISTIC
/begin CHARACTERISTIC FUKABAWU "" VALUE 0x8FD072 KwUb 3.891 fak_ub_b4 0.09375 3.984 FORMAT "%5.3" /end CHARACTERISTIC
/begin CHARACTERISTIC FUKAVAKI "" VALUE 0x8FD073 KwUb 3.984 fak_ub_b4 0.00 3.984 FORMAT "%5.3" /end CHARACTERISTIC
/begin CHARACTERISTIC FUKAVAKO "" VALUE 0x8FD074 KwUb 3.984 fak_ub_b4 0.00 3.984 FORMAT "%5.3" /end CHARACTERISTIC
/begin CHARACTERISTIC FUKAVAKU "" VALUE 0x8FD075 KwUb 3.891 fak_ub_b4 0.09375 3.984 FORMAT "%5.3" /end CHARACTERISTIC
/begin CHARACTERISTIC FUKAVAWI "" VALUE 0x8FD076 KwUb 3.984 fak_ub_b4 0.00 3.984 FORMAT "%5.3" /end CHARACTERISTIC
/begin CHARACTERISTIC FUKAVAWO "" VALUE 0x8FD077 KwUb 3.984 fak_ub_b4 0.00 3.984 FORMAT "%5.3" /end CHARACTERISTIC
/begin CHARACTERISTIC FUKAVAWU "" VALUE 0x8FD078 KwUb 3.891 fak_ub_b4 0.09375 3.984 FORMAT "%5.3" /end CHARACTERISTIC
/begin CHARACTERISTIC FUKBAE "" VALUE 0x8FE6CA KwUw 7.999878 fak_uw_b8 0.00 7.999878 FORMAT "%8.6" /end CHARACTERISTIC
/begin CHARACTERISTIC FUKLAMSBG "" CURVE 0x8EABBA KlAUwSstUwWUw 1.999969 fak_uw_b2 0.00 1.999969 FORMAT "%8.6"
 /begin AXIS_DESCR STD_AXIS lamsbg_w fak_uw_b16 6 0.00 15.99976 FORMAT "%8.5" DEPOSIT ABSOLUTE /end AXIS_DESCR
/end CHARACTERISTIC
/begin CHARACTERISTIC FUKNSTHO "" CURVE 0x8E1ED4 KlAUbSstUbWUb 1.992 fak_ub_b2 0.00 1.992 FORMAT "%5.3"
 /begin AXIS_DESCR STD_AXIS fho fak_ub_b4 6 0.00 3.984 FORMAT "%5.3" DEPOSIT ABSOLUTE /end AXIS_DESCR
/end CHARACTERISTIC
/begin CHARACTERISTIC FUKNSTM "" CURVE 0x8E1EE1 KlAUbSstUbWUb 3.984 fak_ub_b4 0.00 3.984 FORMAT "%5.3"
 /begin AXIS_DESCR STD_AXIS tmst temp_ub_q0p75_o48 9 -48.00 143.3 FORMAT "%5.1" DEPOSIT ABSOLUTE /end AXIS_DESCR
/end CHARACTERISTIC
/begin CHARACTERISTIC FUKTINEO "" CURVE 0x8EABD4 KlAUwSstUwWUw 1.999969 fak_uw_b2 0.00 1.999969 FORMAT "%8.6"
 /begin AXIS_DESCR STD_AXIS vti_w fak_uw_b2 6 0.00 1.999969 FORMAT "%8.6" DEPOSIT ABSOLUTE /end AXIS_DESCR
/end CHARACTERISTIC
/begin CHARACTERISTIC FUKVAE "" VALUE 0x8FE6CC KwUw 7.999878 fak_uw_b8 0.00 7.999878 FORMAT "%8.6" /end CHARACTERISTIC
/begin CHARACTERISTIC FVFKUKA "" VALUE 0x8FD079 KwUb 7.969 fak_ub_b8 0.00 7.969 FORMAT "%5.3" /end CHARACTERISTIC
/begin CHARACTERISTIC FWEEMRFAHO "" CURVE 0x8E1A6F KlAUbSstUbWUb 1.000 fak_ub_b2 0.00 1.000 FORMAT "%5.3"
 /begin AXIS_DESCR STD_AXIS fho fak_ub_b4 4 0.00 3.984 FORMAT "%5.3" DEPOSIT ABSOLUTE /end AXIS_DESCR
/end CHARACTERISTIC
/begin CHARACTERISTIC FWEEMRFAM "" CURVE 0x8E1A78 KlAUbSstUbWUb 1.000 fak_ub_b2 0.00 1.000 FORMAT "%5.3"
 /begin AXIS_DESCR STD_AXIS tmot temp_ub_q0p75_o48 5 -48.00 143.3 FORMAT "%5.1" DEPOSIT ABSOLUTE /end AXIS_DESCR
/end CHARACTERISTIC
/begin CHARACTERISTIC FWEHT "" CURVE 0x8E1DF5 KlAUbSstUbWUb 1.992 fak_ub_b2 0.00 1.992 FORMAT "%5.3"
 /begin AXIS_DESCR STD_AXIS tmot temp_ub_q0p75_o48 9 -48.00 143.3 FORMAT "%5.1" DEPOSIT ABSOLUTE /end AXIS_DESCR
/end CHARACTERISTIC
/begin CHARACTERISTIC FWEMRFA "" CURVE 0x8EAADE KlAUwSstUwWUb 1.992 fak_ub_b2 0.00 1.992 FORMAT "%5.3"
 /begin AXIS_DESCR STD_AXIS mrfa_w rel_uw_b200 6 0.00 199.9969 FORMAT "%8.4" DEPOSIT ABSOLUTE /end AXIS_DESCR
/end CHARACTERISTIC
/begin CHARACTERISTIC FWET "" CURVE 0x8E1E08 KlAUbSstUbWUb 1.992 fak_ub_b2 0.00 1.992 FORMAT "%5.3"
 /begin AXIS_DESCR STD_AXIS tmot temp_ub_q0p75_o48 9 -48.00 143.3 FORMAT "%5.1" DEPOSIT ABSOLUTE /end AXIS_DESCR
/end CHARACTERISTIC
/begin CHARACTERISTIC FWFN "" VALUE 0x8FE6CE KwSw 2.999954 rel_sw_b1p5 -1.500000 1.499954 FORMAT "%8.6" /end CHARACTERISTIC
/begin CHARACTERISTIC FWSTAB1 "" CURVE 0x8E177D GklWUb 1.992 fak_ub_b2 0.00 1.992 FORMAT "%5.3"
 /begin AXIS_DESCR COM_AXIS kstaa fak_ub_b2 6 0.00 1.992 FORMAT "%5.3" AXIS_PTS_REF SKS06ESUB /end AXIS_DESCR
/end CHARACTERISTIC
/begin CHARACTERISTIC FWSTAB2 "" CURVE 0x8E1783 GklWUb 1.992 fak_ub_b2 0.00 1.992 FORMAT "%5.3"
 /begin AXIS_DESCR COM_AXIS kstaa fak_ub_b2 6 0.00 1.992 FORMAT "%5.3" AXIS_PTS_REF SKS06ESUB /end AXIS_DESCR
/end CHARACTERISTIC
/begin CHARACTERISTIC FWSTAB3 "" CURVE 0x8E1789 GklWUb 1.992 fak_ub_b2 0.00 1.992 FORMAT "%5.3"
 /begin AXIS_DESCR COM_AXIS kstaa fak_ub_b2 6 0.00 1.992 FORMAT "%5.3" AXIS_PTS_REF SKS06ESUB /end AXIS_DESCR
/end CHARACTERISTIC
/begin CHARACTERISTIC FWSTAS1 "" CURVE 0x8E178F GklWUb 1.992 fak_ub_b2 0.00 1.992 FORMAT "%5.3"
 /begin AXIS_DESCR COM_AXIS kstaa fak_ub_b2 6 0.00 1.992 FORMAT "%5.3" AXIS_PTS_REF SKS06ESUB /end AXIS_DESCR
/end CHARACTERISTIC
/begin CHARACTERISTIC FWSTAS2 "" CURVE 0x8E1795 GklWUb 1.992 fak_ub_b2 0.00 1.992 FORMAT "%5.3"
 /begin AXIS_DESCR COM_AXIS kstaa fak_ub_b2 6 0.00 1.992 FORMAT "%5.3" AXIS_PTS_REF SKS06ESUB /end AXIS_DESCR
/end CHARACTERISTIC
/begin CHARACTERISTIC FWTMUEBO "" VALUE 0x8E03CF KwUb 191.3 temp_ub_q0p75_o48 -48.00 143.3 FORMAT "%5.1" /end CHARACTERISTIC
/begin CHARACTERISTIC FWTMUEBU "" VALUE 0x8E03D0 KwUb 191.3 temp_ub_q0p75_o48 -48.00 143.3 FORMAT "%5.1" /end CHARACTERISTIC
/begin CHARACTERISTIC FWTOUEBO "" VALUE 0x8E5F74 KwUw 1536.141 temp_q0p0234_o273 -273.1500 1262.991 FORMAT "%8.3" /end CHARACTERISTIC
/begin CHARACTERISTIC FWTOUEBU "" VALUE 0x8E5F76 KwUw 1536.141 temp_q0p0234_o273 -273.1500 1262.991 FORMAT "%8.3" /end CHARACTERISTIC
/begin CHARACTERISTIC FZANSSA1 "" CURVE 0x8E179B GklWUb 0.249023438 fak_ub_b0p25 0.00 0.249023438 FORMAT "%11.9"
 /begin AXIS_DESCR COM_AXIS tans temp_ub_q0p75_o48 6 -48.00 143.3 FORMAT "%5.1" AXIS_PTS_REF STA06ESUB /end AXIS_DESCR
/end CHARACTERISTIC
/begin CHARACTERISTIC FZANSSA2 "" CURVE 0x8E17A1 GklWUb 0.249023438 fak_ub_b0p25 0.00 0.249023438 FORMAT "%11.9"
 /begin AXIS_DESCR COM_AXIS tans temp_ub_q0p75_o48 6 -48.00 143.3 FORMAT "%5.1" AXIS_PTS_REF STA06ESUB /end AXIS_DESCR
/end CHARACTERISTIC
/begin CHARACTERISTIC FZANSSM1 "" CURVE 0x8E17A7 GklWUb 0.249023438 fak_ub_b0p25 0.00 0.249023438 FORMAT "%11.9"
 /begin AXIS_DESCR COM_AXIS tmst temp_ub_q0p75_o48 12 -48.00 143.3 FORMAT "%5.1" AXIS_PTS_REF STS12ESUB /end AXIS_DESCR
/end CHARACTERISTIC
/begin CHARACTERISTIC FZANSSM2 "" CURVE 0x8E17B3 GklWUb 0.249023438 fak_ub_b0p25 0.00 0.249023438 FORMAT "%11.9"
 /begin AXIS_DESCR COM_AXIS tmst temp_ub_q0p75_o48 12 -48.00 143.3 FORMAT "%5.1" AXIS_PTS_REF STS12ESUB /end AXIS_DESCR
/end CHARACTERISTIC
/begin CHARACTERISTIC FZANSSM3 "" CURVE 0x8E17BF GklWUb 0.249023438 fak_ub_b0p25 0.00 0.249023438 FORMAT "%11.9"
 /begin AXIS_DESCR COM_AXIS tmst temp_ub_q0p75_o48 12 -48.00 143.3 FORMAT "%5.1" AXIS_PTS_REF STS12ESUB /end AXIS_DESCR
/end CHARACTERISTIC
/begin CHARACTERISTIC FZASUN0 "" CURVE 0x8E19AA GklWUb 1.992 fak_ub_b2 0.00 1.992 FORMAT "%5.3"
 /begin AXIS_DESCR COM_AXIS nmot nmot_ub_q40 16 0.00 10200. FORMAT "%5.0" AXIS_PTS_REF SNM16CIUB /end AXIS_DESCR
/end CHARACTERISTIC
/begin CHARACTERISTIC FZASUN1 "" CURVE 0x8E19BA GklWUb 1.992 fak_ub_b2 0.00 1.992 FORMAT "%5.3"
 /begin AXIS_DESCR COM_AXIS nmot nmot_ub_q40 16 0.00 10200. FORMAT "%5.0" AXIS_PTS_REF SNM16CIUB /end AXIS_DESCR
/end CHARACTERISTIC
/begin CHARACTERISTIC FZASUN2 "" CURVE 0x8E19CA GklWUb 1.992 fak_ub_b2 0.00 1.992 FORMAT "%5.3"
 /begin AXIS_DESCR COM_AXIS nmot nmot_ub_q40 16 0.00 10200. FORMAT "%5.0" AXIS_PTS_REF SNM16CIUB /end AXIS_DESCR
/end CHARACTERISTIC
/begin CHARACTERISTIC FZASUN3 "" CURVE 0x8E19DA GklWUb 1.992 fak_ub_b2 0.00 1.992 FORMAT "%5.3"
 /begin AXIS_DESCR COM_AXIS nmot nmot_ub_q40 16 0.00 10200. FORMAT "%5.0" AXIS_PTS_REF SNM16CIUB /end AXIS_DESCR
/end CHARACTERISTIC
/begin CHARACTERISTIC FZASUN4 "" CURVE 0x8E19EA GklWUb 1.992 fak_ub_b2 0.00 1.992 FORMAT "%5.3"
 /begin AXIS_DESCR COM_AXIS nmot nmot_ub_q40 16 0.00 10200. FORMAT "%5.0" AXIS_PTS_REF SNM16CIUB /end AXIS_DESCR
/end CHARACTERISTIC
/begin CHARACTERISTIC FZASUN5 "" CURVE 0x8E19FA GklWUb 1.992 fak_ub_b2 0.00 1.992 FORMAT "%5.3"
 /begin AXIS_DESCR COM_AXIS nmot nmot_ub_q40 16 0.00 10200. FORMAT "%5.0" AXIS_PTS_REF SNM16CIUB /end AXIS_DESCR
/end CHARACTERISTIC
/begin CHARACTERISTIC FZNASUN0 "" CURVE 0x8E1A0A GklWUb 1.992 fak_ub_b2 0.00 1.992 FORMAT "%5.3"
 /begin AXIS_DESCR COM_AXIS nmot nmot_ub_q40 16 0.00 10200. FORMAT "%5.0" AXIS_PTS_REF SNM16CIUB /end AXIS_DESCR
/end CHARACTERISTIC
/begin CHARACTERISTIC FZNASUN1 "" CURVE 0x8E1A1A GklWUb 1.992 fak_ub_b2 0.00 1.992 FORMAT "%5.3"
 /begin AXIS_DESCR COM_AXIS nmot nmot_ub_q40 16 0.00 10200. FORMAT "%5.0" AXIS_PTS_REF SNM16CIUB /end AXIS_DESCR
/end CHARACTERISTIC
/begin CHARACTERISTIC FZNASUN2 "" CURVE 0x8E1A2A GklWUb 1.992 fak_ub_b2 0.00 1.992 FORMAT "%5.3"
 /begin AXIS_DESCR COM_AXIS nmot nmot_ub_q40 16 0.00 10200. FORMAT "%5.0" AXIS_PTS_REF SNM16CIUB /end AXIS_DESCR
/end CHARACTERISTIC
/begin CHARACTERISTIC FZNASUN3 "" CURVE 0x8E1A3A GklWUb 1.992 fak_ub_b2 0.00 1.992 FORMAT "%5.3"
 /begin AXIS_DESCR COM_AXIS nmot nmot_ub_q40 16 0.00 10200. FORMAT "%5.0" AXIS_PTS_REF SNM16CIUB /end AXIS_DESCR
/end CHARACTERISTIC
/begin CHARACTERISTIC FZNASUN4 "" CURVE 0x8E1A4A GklWUb 1.992 fak_ub_b2 0.00 1.992 FORMAT "%5.3"
 /begin AXIS_DESCR COM_AXIS nmot nmot_ub_q40 16 0.00 10200. FORMAT "%5.0" AXIS_PTS_REF SNM16CIUB /end AXIS_DESCR
/end CHARACTERISTIC
/begin CHARACTERISTIC FZNASUN5 "" CURVE 0x8E1A5A GklWUb 1.992 fak_ub_b2 0.00 1.992 FORMAT "%5.3"
 /begin AXIS_DESCR COM_AXIS nmot nmot_ub_q40 16 0.00 10200. FORMAT "%5.0" AXIS_PTS_REF SNM16CIUB /end AXIS_DESCR
/end CHARACTERISTIC
/begin CHARACTERISTIC GANGNOT "" VALUE 0x8FCD28 KwUb 255.0 dez 0.00 255.0 FORMAT "%5.1" /end CHARACTERISTIC
/begin CHARACTERISTIC GE3MDTMX "" VALUE 0x8FD8F6 KwSw 5111.922 mdt_sw_b2556 -2556.000 2555.922 FORMAT "%8.3" /end CHARACTERISTIC
/begin CHARACTERISTIC ILMRMN "" VALUE 0x8FE66E KwSw 1535.977 rel_sw_q0p0234 -768.0000 767.9766 FORMAT "%8.4" /end CHARACTERISTIC
/begin CHARACTERISTIC ILMRMX "" VALUE 0x8FE670 KwSw 1535.977 rel_sw_q0p0234 -768.0000 767.9766 FORMAT "%8.4" /end CHARACTERISTIC
/begin CHARACTERISTIC ILMRN "" CURVE 0x8E1472 GklWUb 7.969 fak_ub_b8 0.00 7.969 FORMAT "%5.3"
 /begin AXIS_DESCR COM_AXIS nmot nmot_ub_q40 8 0.00 10200. FORMAT "%5.0" AXIS_PTS_REF SNM08FEUB /end AXIS_DESCR
/end CHARACTERISTIC
/begin CHARACTERISTIC IMLHS "" VALUE 0x8FD03C KwUb 23.21 m_ub_b23p3 0.00 23.21 FORMAT "%5.2" /end CHARACTERISTIC
/begin CHARACTERISTIC IMSDTEVA "" VALUE 0x8E3914 KwUb 11.32 m_ub_q0p0444 0.00 11.32 FORMAT "%5.2" /end CHARACTERISTIC
/begin CHARACTERISTIC KFABAK "" MAP 0x8E1EF4 GkfWUb 0.9961 fak_ub_b1 0.00 0.9961
 /begin AXIS_DESCR COM_AXIS tmot temp_ub_q0p75_o48 9 -48.00 143.3 FORMAT "%5.1" AXIS_PTS_REF STM09ESUB /end AXIS_DESCR
 /begin AXIS_DESCR COM_AXIS nmot nmot_ub_q40 7 0.00 10200. FORMAT "%5.0" AXIS_PTS_REF SNM07ESUB /end AXIS_DESCR
/end CHARACTERISTIC
/begin CHARACTERISTIC KFAVAK "" MAP 0x8E1F33 GkfWUb 0.9961 fak_ub_b1 0.00 0.9961
 /begin AXIS_DESCR COM_AXIS tmot temp_ub_q0p75_o48 9 -48.00 143.3 FORMAT "%5.1" AXIS_PTS_REF STM09ESUB /end AXIS_DESCR
 /begin AXIS_DESCR COM_AXIS nmot nmot_ub_q40 7 0.00 10200. FORMAT "%5.0" AXIS_PTS_REF SNM07ESUB /end AXIS_DESCR
/end CHARACTERISTIC
/begin CHARACTERISTIC KFBAKL "" MAP 0x8E1F72 GkfWUb 15.94 fak_ub_b16 0.00 15.94 FORMAT "%5.2"
 /begin AXIS_DESCR COM_AXIS tmot temp_ub_q0p75_o48 9 -48.00 143.3 FORMAT "%5.1" AXIS_PTS_REF STM09ESUB /end AXIS_DESCR
 /begin AXIS_DESCR COM_AXIS nmot nmot_ub_q40 7 0.00 10200. FORMAT "%5.0" AXIS_PTS_REF SNM07ESUB /end AXIS_DESCR
/end CHARACTERISTIC
/begin CHARACTERISTIC KFBRAWA "" MAP 0x8E83FC KfAxUwAyUwSstxUwSstyUwWUw 27.78029 bfzg_uw_q4p239Em4 0.00 27.78029 FORMAT "%8.5"
 /begin AXIS_DESCR STD_AXIS vfgr_w vfzg_uw_b512 8 0.00 511.9922 FORMAT "%8.4" DEPOSIT ABSOLUTE /end AXIS_DESCR
 /begin AXIS_DESCR STD_AXIS dvzi_w vfzg_uw_q0p0078125 6 0.00 511.9922 FORMAT "%8.4" DEPOSIT ABSOLUTE /end AXIS_DESCR
/end CHARACTERISTIC
/begin CHARACTERISTIC KFDETATE "" MAP 0x8E3915 KfAxUbAyUbSstxUbSstyUbWUb 127.5 rel_ub_b127p5 0.00 127.5 FORMAT "%5.1"
 /begin AXIS_DESCR STD_AXIS etazwist rel_ub_b127p5 4 0.00 127.5 FORMAT "%5.1" DEPOSIT ABSOLUTE /end AXIS_DESCR
 /begin AXIS_DESCR STD_AXIS dmletanu m_q0p1 6 0.00 25.50 FORMAT "%5.2" DEPOSIT ABSOLUTE /end AXIS_DESCR
/end CHARACTERISTIC
/begin CHARACTERISTIC KFFWL "" MAP 0x8E17CB GkfWUb 1.992 fak_ub_b2 0.00 1.992 FORMAT "%5.3"
 /begin AXIS_DESCR COM_AXIS tmot temp_ub_q0p75_o48 12 -48.00 143.3 FORMAT "%5.1" AXIS_PTS_REF STM12ESUB /end AXIS_DESCR
 /begin AXIS_DESCR COM_AXIS tmst temp_ub_q0p75_o48 12 -48.00 143.3 FORMAT "%5.1" AXIS_PTS_REF STS12ESUB /end AXIS_DESCR
/end CHARACTERISTIC
/begin CHARACTERISTIC KFFWLRL "" MAP 0x8E18DE GkfWUb 1.992 fak_ub_b2 0.00 1.992 FORMAT "%5.3"
 /begin AXIS_DESCR COM_AXIS tmst temp_ub_q0p75_o48 8 -48.00 143.3 FORMAT "%5.1" AXIS_PTS_REF STS08ESUB /end AXIS_DESCR
 /begin AXIS_DESCR COM_AXIS rlp rel_ub_q0p75 6 0.00 191.3 FORMAT "%5.1" AXIS_PTS_REF SRP06ESUB /end AXIS_DESCR
/end CHARACTERISTIC
/begin CHARACTERISTIC KFFWLW "" MAP 0x8E190E GkfWUb 1.992 fak_ub_b2 0.00 1.992 FORMAT "%5.3"
 /begin AXIS_DESCR COM_AXIS nmot nmot_ub_q40 6 0.00 10200. FORMAT "%5.0" AXIS_PTS_REF SNM06ESUB /end AXIS_DESCR
 /begin AXIS_DESCR COM_AXIS rlp rel_ub_q0p75 6 0.00 191.3 FORMAT "%5.1" AXIS_PTS_REF SRP06ESUB /end AXIS_DESCR
/end CHARACTERISTIC
/begin CHARACTERISTIC KFHSTT "" MAP 0x8E1C05 KfAxUbAyUbSstxUbSstyUbWUb 63.75 fak_ub_b64 0.00 63.75 FORMAT "%5.2"
 /begin AXIS_DESCR STD_AXIS tans temp_ub_q0p75_o48 6 -48.00 143.3 FORMAT "%5.1" DEPOSIT ABSOLUTE /end AXIS_DESCR
 /begin AXIS_DESCR STD_AXIS tmst temp_ub_q0p75_o48 3 -48.00 143.3 FORMAT "%5.1" DEPOSIT ABSOLUTE /end AXIS_DESCR
/end CHARACTERISTIC
/begin CHARACTERISTIC KFKATI "" MAP 0x8EA2F6 KfAxUbAyUbSstxUbSstyUwWUw 1.999969 fak_uw_b2 0.00 1.999969 FORMAT "%8.6"
 /begin AXIS_DESCR STD_AXIS tmst temp_ub_q0p75_o48 12 -48.00 143.3 FORMAT "%5.1" DEPOSIT ABSOLUTE /end AXIS_DESCR
 /begin AXIS_DESCR STD_AXIS anztib1_w dez 12 0.00 65535.00 FORMAT "%8.2" DEPOSIT ABSOLUTE /end AXIS_DESCR
/end CHARACTERISTIC
/begin CHARACTERISTIC KFLF "" MAP 0x8E168A KfAxUbAyUbSstxUbSstyUbWUb 1.992 fak_ub_b2 0.00 1.992 FORMAT "%5.3"
 /begin AXIS_DESCR STD_AXIS nmot nmot_ub_q40 12 0.00 10200. FORMAT "%5.0" DEPOSIT ABSOLUTE /end AXIS_DESCR
 /begin AXIS_DESCR STD_AXIS rl rel_ub_q0p75 16 0.00 191.3 FORMAT "%5.1" DEPOSIT ABSOLUTE /end AXIS_DESCR
/end CHARACTERISTIC
/begin CHARACTERISTIC KFMGES "" MAP 0x8E5D5A KfAxUwAyUwSstxUwSstyUwWUw 99.99847 rel_uw_b100 0.00 99.99847 FORMAT "%8.5"
 /begin AXIS_DESCR STD_AXIS nmot_w nmot_uw_q0p25 5 0.00 16383.75 FORMAT "%8.2" DEPOSIT ABSOLUTE /end AXIS_DESCR
 /begin AXIS_DESCR STD_AXIS vfzg_w vfzg_uw_b512 5 0.00 511.9922 FORMAT "%8.4" DEPOSIT ABSOLUTE /end AXIS_DESCR
/end CHARACTERISTIC
/begin CHARACTERISTIC KFNSA "" MAP 0x8E185B KfAxUbAyUbSstxUbSstyUbWUb 1.992 fak_ub_b2 0.00 1.992 FORMAT "%5.3"
 /begin AXIS_DESCR STD_AXIS tans temp_ub_q0p75_o48 6 -48.00 143.3 FORMAT "%5.1" DEPOSIT ABSOLUTE /end AXIS_DESCR
 /begin AXIS_DESCR STD_AXIS tmot temp_ub_q0p75_o48 3 -48.00 143.3 FORMAT "%5.1" DEPOSIT ABSOLUTE /end AXIS_DESCR
/end CHARACTERISTIC
/begin CHARACTERISTIC KFNSWRL "" MAP 0x8E1932 GkfWUb 1.992 fak_ub_b2 0.00 1.992 FORMAT "%5.3"
 /begin AXIS_DESCR COM_AXIS tmst temp_ub_q0p75_o48 8 -48.00 143.3 FORMAT "%5.1" AXIS_PTS_REF STS08ESUB /end AXIS_DESCR
 /begin AXIS_DESCR COM_AXIS rlp rel_ub_q0p75 6 0.00 191.3 FORMAT "%5.1" AXIS_PTS_REF SRP06ESUB /end AXIS_DESCR
/end CHARACTERISTIC
/begin CHARACTERISTIC KFPLMR "" MAP 0x8E9CB0 KfAxUbAyUbSstxSwSstyUbWSw 1535.977 rel_sw_q0p0234 -768.0000 767.9766 FORMAT "%8.4"
 /begin AXIS_DESCR STD_AXIS drlm_w rel_sw_q0p0234 8 -768.0000 767.9766 FORMAT "%8.4" DEPOSIT ABSOLUTE /end AXIS_DESCR
 /begin AXIS_DESCR STD_AXIS nmotll nmot_ub_q10 6 0.00 2550. FORMAT "%5.0" DEPOSIT ABSOLUTE /end AXIS_DESCR
/end CHARACTERISTIC
/begin CHARACTERISTIC KFPLMRMSR "" MAP 0x8E9D28 KfAxUbAyUbSstxSwSstyUbWSw 1535.977 rel_sw_q0p0234 -768.0000 767.9766 FORMAT "%8.4"
 /begin AXIS_DESCR STD_AXIS drlm_w rel_sw_q0p0234 8 -768.0000 767.9766 FORMAT "%8.4" DEPOSIT ABSOLUTE /end AXIS_DESCR
 /begin AXIS_DESCR STD_AXIS nmotll nmot_ub_q10 6 0.00 2550. FORMAT "%5.0" DEPOSIT ABSOLUTE /end AXIS_DESCR
/end CHARACTERISTIC
/begin CHARACTERISTIC KFTVFRR "" MAP 0x8E3939 KfAxUbAyUbSstxUbSstyUbWUb 25.50 t100msxs_ub_b25p5 0.00 25.50 FORMAT "%5.2"
 /begin AXIS_DESCR STD_AXIS tadteazs rel_ub_b99p6 4 0.00 99.61 FORMAT "%5.2" DEPOSIT ABSOLUTE /end AXIS_DESCR
 /begin AXIS_DESCR STD_AXIS ml m_ub_b1020 3 0.00 1020. FORMAT "%5.0" DEPOSIT ABSOLUTE /end AXIS_DESCR
/end CHARACTERISTIC
/begin CHARACTERISTIC KFVAKL "" MAP 0x8E1FB1 GkfWUb 15.94 fak_ub_b16 0.00 15.94 FORMAT "%5.2"
 /begin AXIS_DESCR COM_AXIS tmot temp_ub_q0p75_o48 9 -48.00 143.3 FORMAT "%5.1" AXIS_PTS_REF STM09ESUB /end AXIS_DESCR
 /begin AXIS_DESCR COM_AXIS nmot nmot_ub_q40 7 0.00 10200. FORMAT "%5.0" AXIS_PTS_REF SNM07ESUB /end AXIS_DESCR
/end CHARACTERISTIC
/begin CHARACTERISTIC KFVALDIF "" MAP 0x8E1FF0 GkfWUb 0.9961 fak_ub_b1 0.00 0.9961
 /begin AXIS_DESCR COM_AXIS tmot temp_ub_q0p75_o48 9 -48.00 143.3 FORMAT "%5.1" AXIS_PTS_REF STM09ESUB /end AXIS_DESCR
 /begin AXIS_DESCR COM_AXIS ladiff_w fak_sw_b1 5 -1.000000 0.9999695 FORMAT "%8.6" AXIS_PTS_REF SLA05ESUB /end AXIS_DESCR
/end CHARACTERISTIC
/begin CHARACTERISTIC KFVAWLA "" MAP 0x8E2097 KfAxUbAyUbSstxUbSstyUbWUb 3.984 fak_ub_b4 0.00 3.984 FORMAT "%5.3"
 /begin AXIS_DESCR STD_AXIS tmot temp_ub_q0p75_o48 3 -48.00 143.3 FORMAT "%5.1" DEPOSIT ABSOLUTE /end AXIS_DESCR
 /begin AXIS_DESCR STD_AXIS lamsbguk fak_ub_b4 4 0.00 3.984 FORMAT "%5.3" DEPOSIT ABSOLUTE /end AXIS_DESCR
/end CHARACTERISTIC
/begin CHARACTERISTIC KFVOFFS "" MAP 0x8E849A KfAxUwAyUwSstxUwSstyUwWUw 511.9922 vfzg_uw_q0p0078125 0.00 511.9922 FORMAT "%8.4"
 /begin AXIS_DESCR STD_AXIS vfgro_w vfzg_uw_q0p0078125 6 0.00 511.9922 FORMAT "%8.4" DEPOSIT ABSOLUTE /end AXIS_DESCR
 /begin AXIS_DESCR STD_AXIS uevges_w fak_q0p1 8 0.00 6553.500 FORMAT "%8.3" DEPOSIT ABSOLUTE /end AXIS_DESCR
/end CHARACTERISTIC
/begin CHARACTERISTIC KFWDKMSN "" MAP 0x8E9DA0 KfAxUwAyUwSstxUwSstyUwWUw 99.99847 rel_uw_b100 0.00 99.99847 FORMAT "%8.5"
 /begin AXIS_DESCR STD_AXIS mlwdknf_w m_uw_b6553p5 16 0.00 6553.500 FORMAT "%8.3" DEPOSIT ABSOLUTE /end AXIS_DESCR
 /begin AXIS_DESCR STD_AXIS nmot_w nmot_uw_q0p25 6 0.00 16383.75 FORMAT "%8.2" DEPOSIT ABSOLUTE /end AXIS_DESCR
/end CHARACTERISTIC
/begin CHARACTERISTIC KFWDKSMX "" MAP 0x8E9EF4 KfAxUwAyUwSstxUwSstyUwWUw 99.99847 rel_uw_b100 0.00 99.99847 FORMAT "%8.5"
 /begin AXIS_DESCR STD_AXIS nmot_w nmot_uw_q0p25 10 0.00 16383.75 FORMAT "%8.2" DEPOSIT ABSOLUTE /end AXIS_DESCR
 /begin AXIS_DESCR STD_AXIS fho_w fak_uw_b4 3 0.00 3.999939 FORMAT "%8.6" DEPOSIT ABSOLUTE /end AXIS_DESCR
/end CHARACTERISTIC
/begin CHARACTERISTIC KFWEE "" MAP 0x8E1A93 GkfWUb 1530. zw_ub_q6 0.00 1530. FORMAT "%5.0"
 /begin AXIS_DESCR COM_AXIS nmot_w nmot_uw_q0p25 8 0.00 16383.75 FORMAT "%8.2" AXIS_PTS_REF SNM08GKUW /end AXIS_DESCR
 /begin AXIS_DESCR COM_AXIS rl rel_ub_q0p75 8 0.00 191.3 FORMAT "%5.1" AXIS_PTS_REF SRL08GKUB /end AXIS_DESCR
/end CHARACTERISTIC
/begin CHARACTERISTIC KFWEEK "" MAP 0x8E1AD3 GkfWUb 1530. zw_ub_q6 0.00 1530. FORMAT "%5.0"
 /begin AXIS_DESCR COM_AXIS nmot_w nmot_uw_q0p25 8 0.00 16383.75 FORMAT "%8.2" AXIS_PTS_REF SNM08GKUW /end AXIS_DESCR
 /begin AXIS_DESCR COM_AXIS rl rel_ub_q0p75 8 0.00 191.3 FORMAT "%5.1" AXIS_PTS_REF SRL08GKUB /end AXIS_DESCR
/end CHARACTERISTIC
/begin CHARACTERISTIC KFWEEST "" MAP 0x8E1B13 KfAxUbAyUbSstxUbSstyUbWUb 1530. zw_ub_q6 0.00 1530. FORMAT "%5.0"
 /begin AXIS_DESCR STD_AXIS tmot temp_ub_q0p75_o48 8 -48.00 143.3 FORMAT "%5.1" DEPOSIT ABSOLUTE /end AXIS_DESCR
 /begin AXIS_DESCR STD_AXIS anztib dez 8 0.00 255.0 FORMAT "%5.1" DEPOSIT ABSOLUTE /end AXIS_DESCR
/end CHARACTERISTIC
/begin CHARACTERISTIC KFWEETM "" MAP 0x8EA718 KfAxUbAyUbSstxUbSstyUbWSb 1530. zw_sb_q6 -768.0 762.0 FORMAT "%5.1"
 /begin AXIS_DESCR STD_AXIS tmot temp_ub_q0p75_o48 8 -48.00 143.3 FORMAT "%5.1" DEPOSIT ABSOLUTE /end AXIS_DESCR
 /begin AXIS_DESCR STD_AXIS rl rel_ub_q0p75 6 0.00 191.3 FORMAT "%5.1" DEPOSIT ABSOLUTE /end AXIS_DESCR
/end CHARACTERISTIC
/begin CHARACTERISTIC KFWHSTT "" MAP 0x8E1C22 KfAxUbAyUbSstxUbSstyUbWUb 1.992 fak_ub_b2 0.00 1.992 FORMAT "%5.3"
 /begin AXIS_DESCR STD_AXIS tans temp_ub_q0p75_o48 6 -48.00 143.3 FORMAT "%5.1" DEPOSIT ABSOLUTE /end AXIS_DESCR
 /begin AXIS_DESCR STD_AXIS anztib dez 8 0.00 255.0 FORMAT "%5.1" DEPOSIT ABSOLUTE /end AXIS_DESCR
/end CHARACTERISTIC
/begin CHARACTERISTIC KFWKSTAB "" MAP 0x8EA8E0 KfAxUbAyUbSstxUwSstyUbWUb 1.992 fak_ub_b2 0.00 1.992 FORMAT "%5.3"
 /begin AXIS_DESCR STD_AXIS tabst_w t1sxs_uw_q1 4 0.00 65535.00 FORMAT "%8.2" DEPOSIT ABSOLUTE /end AXIS_DESCR
 /begin AXIS_DESCR STD_AXIS tmst temp_ub_q0p75_o48 4 -48.00 143.3 FORMAT "%5.1" DEPOSIT ABSOLUTE /end AXIS_DESCR
/end CHARACTERISTIC
/begin CHARACTERISTIC KFWKSTN "" MAP 0x8E1C62 KfAxUbAyUbSstxUbSstyUbWUb 0.9961 fak_ub_b1 0.00 0.9961
 /begin AXIS_DESCR STD_AXIS tmst temp_ub_q0p75_o48 4 -48.00 143.3 FORMAT "%5.1" DEPOSIT ABSOLUTE /end AXIS_DESCR
 /begin AXIS_DESCR STD_AXIS nmot nmot_ub_q40 4 0.00 10200. FORMAT "%5.0" DEPOSIT ABSOLUTE /end AXIS_DESCR
/end CHARACTERISTIC
/begin CHARACTERISTIC KFWKSTT "" MAP 0x8E1C7C KfAxUbAyUbSstxUbSstyUbWUb 1.992 fak_ub_b2 0.00 1.992 FORMAT "%5.3"
 /begin AXIS_DESCR STD_AXIS tmst temp_ub_q0p75_o48 12 -48.00 143.3 FORMAT "%5.1" DEPOSIT ABSOLUTE /end AXIS_DESCR
 /begin AXIS_DESCR STD_AXIS anztib dez 12 0.00 255.0 FORMAT "%5.1" DEPOSIT ABSOLUTE /end AXIS_DESCR
/end CHARACTERISTIC
/begin CHARACTERISTIC KFWLHO "" MAP 0x8E1962 GkfWUb 1.992 fak_ub_b2 0.00 1.992 FORMAT "%5.3"
 /begin AXIS_DESCR COM_AXIS fho fak_ub_b4 4 0.00 3.984 FORMAT "%5.3" AXIS_PTS_REF FHO04ESUB /end AXIS_DESCR
 /begin AXIS_DESCR COM_AXIS rlp rel_ub_q0p75 6 0.00 191.3 FORMAT "%5.1" AXIS_PTS_REF SRP06ESUB /end AXIS_DESCR
/end CHARACTERISTIC
/begin CHARACTERISTIC KFWNSNW "" MAP 0x8EA26A KfAxUbAyUbSstxUwSstyUwWUw 1.999969 fak_uw_b2 0.00 1.999969 FORMAT "%8.6"
 /begin AXIS_DESCR STD_AXIS fwnwvs_w fak_uw_b2 3 0.00 1.999969 FORMAT "%8.6" DEPOSIT ABSOLUTE /end AXIS_DESCR
 /begin AXIS_DESCR STD_AXIS wnwue_w kw_q0p0019 5 0.00 127.9980 FORMAT "%8.4" DEPOSIT ABSOLUTE /end AXIS_DESCR
/end CHARACTERISTIC
/begin CHARACTERISTIC KFWSTAARL "" MAP 0x8E1878 GkfWUb 3.984 fak_ub_b4 0.00 3.984 FORMAT "%5.3"
 /begin AXIS_DESCR COM_AXIS kstaa fak_ub_b2 6 0.00 1.992 FORMAT "%5.3" AXIS_PTS_REF SKS06ESUB /end AXIS_DESCR
 /begin AXIS_DESCR COM_AXIS rlp rel_ub_q0p75 6 0.00 191.3 FORMAT "%5.1" AXIS_PTS_REF SRP06ESUB /end AXIS_DESCR
/end CHARACTERISTIC
/begin CHARACTERISTIC KFWWLML "" MAP 0x8E197A GkfWUb 1.992 fak_ub_b2 0.00 1.992 FORMAT "%5.3"
 /begin AXIS_DESCR COM_AXIS imlatm_w m_uw_b23p3 6 0.00 23.30133 FORMAT "%8.5" AXIS_PTS_REF SIM06ESUW /end AXIS_DESCR
 /begin AXIS_DESCR COM_AXIS tmst temp_ub_q0p75_o48 8 -48.00 143.3 FORMAT "%5.1" AXIS_PTS_REF STS08ESUB /end AXIS_DESCR
/end CHARACTERISTIC
/begin CHARACTERISTIC KFWWLNW "" MAP 0x8E189C KfAxUbAyUbSstxUbSstyUbWUb 1.992 fak_ub_b2 0.00 1.992 FORMAT "%5.3"
 /begin AXIS_DESCR STD_AXIS fwnwvs_loc fak_ub_b2 3 0.00 1.992 FORMAT "%5.3" DEPOSIT ABSOLUTE /end AXIS_DESCR
 /begin AXIS_DESCR STD_AXIS wnwue kw_q0p5 5 0.00 127.5 FORMAT "%5.1" DEPOSIT ABSOLUTE /end AXIS_DESCR
/end CHARACTERISTIC
/begin CHARACTERISTIC KFWWNS "" MAP 0x8EA29C KfAxUbAyUbSstxUbSstyUwWUb 1.992 fak_ub_b2 0.00 1.992 FORMAT "%5.3"
 /begin AXIS_DESCR STD_AXIS tmst temp_ub_q0p75_o48 8 -48.00 143.3 FORMAT "%5.1" DEPOSIT ABSOLUTE /end AXIS_DESCR
 /begin AXIS_DESCR STD_AXIS tabst_w t1sxs_uw_q1 8 0.00 65535.00 FORMAT "%8.2" DEPOSIT ABSOLUTE /end AXIS_DESCR
/end CHARACTERISTIC
/begin CHARACTERISTIC KFZVAKM "" MAP 0x8E201D GkfWUb 0.9961 fak_q0p0039 0.00 0.9961
 /begin AXIS_DESCR COM_AXIS tmot temp_ub_q0p75_o48 9 -48.00 143.3 FORMAT "%5.1" AXIS_PTS_REF STM09ESUB /end AXIS_DESCR
 /begin AXIS_DESCR COM_AXIS nmot nmot_ub_q40 7 0.00 10200. FORMAT "%5.0" AXIS_PTS_REF SNM07ESUB /end AXIS_DESCR
/end CHARACTERISTIC
/begin CHARACTERISTIC KIDMSNTE "" VALUE 0x8EEC46 KwUw 127.9980 m_q0p00195 0.00 127.9980 FORMAT "%8.4" /end CHARACTERISTIC
/begin CHARACTERISTIC KIRMSMS "" CURVE 0x8EEC6E KlAUbSstUbWUw 2498.970 fak_q0p03815 0.9918213 2499.962 FORMAT "%8.3"
 /begin AXIS_DESCR STD_AXIS mstedte m_ub_b25p6 4 0.00 25.50 FORMAT "%5.2" DEPOSIT ABSOLUTE /end AXIS_DESCR
/end CHARACTERISTIC
/begin CHARACTERISTIC KKFFGRGA "" CURVE 0x8E851A KlAUwSstUwWUw 3199.951 rel_uw_b3200 0.00 3199.951 FORMAT "%8.3"
 /begin AXIS_DESCR STD_AXIS uevges_w fak_q0p1 8 0.00 6553.500 FORMAT "%8.3" DEPOSIT ABSOLUTE /end AXIS_DESCR
/end CHARACTERISTIC
/begin CHARACTERISTIC KLBAKSTAA "" CURVE 0x8E205C KlAUbSstUbWUb 1.992 fak_ub_b2 0.00 1.992 FORMAT "%5.3"
 /begin AXIS_DESCR STD_AXIS kstaa fak_ub_b2 4 0.00 1.992 FORMAT "%5.3" DEPOSIT ABSOLUTE /end AXIS_DESCR
/end CHARACTERISTIC
/begin CHARACTERISTIC KLDMASRL "" CURVE 0x8E039C KlAUbSstUbWUb 99.61 rel_ub_b99p6 0.00 99.61 FORMAT "%5.2"
 /begin AXIS_DESCR STD_AXIS nmot nmot_ub_q40 5 0.00 10200. FORMAT "%5.0" DEPOSIT ABSOLUTE /end AXIS_DESCR
/end CHARACTERISTIC
/begin CHARACTERISTIC KLFVANST "" CURVE 0x8E2065 KlAUbSstUbWUb 1.992 fak_ub_b2 0.00 1.992 FORMAT "%5.3"
 /begin AXIS_DESCR STD_AXIS tmst temp_ub_q0p75_o48 9 -48.00 143.3 FORMAT "%5.1" DEPOSIT ABSOLUTE /end AXIS_DESCR
/end CHARACTERISTIC
/begin CHARACTERISTIC KLWEESTN "" CURVE 0x8EA78A KlAUwSstUwWUw 1530.000 zw_ub_q6 0.00 1530.000 FORMAT "%8.3"
 /begin AXIS_DESCR STD_AXIS nmot_w nmot_uw_q0p25 4 0.00 16383.75 FORMAT "%8.2" DEPOSIT ABSOLUTE /end AXIS_DESCR
/end CHARACTERISTIC
/begin CHARACTERISTIC KLZANSFHO "" CURVE 0x8E18B5 KlAUbSstUbWUb 3.984 fak_ub_b4 0.00 3.984 FORMAT "%5.3"
 /begin AXIS_DESCR STD_AXIS fho fak_ub_b4 8 0.00 3.984 FORMAT "%5.3" DEPOSIT ABSOLUTE /end AXIS_DESCR
/end CHARACTERISTIC
/begin CHARACTERISTIC KRAFGRGA "" CURVE 0x8E853C KlAUwSstUwWUw 3199.951 rel_uw_b3200 0.00 3199.951 FORMAT "%8.3"
 /begin AXIS_DESCR STD_AXIS uevges_w fak_q0p1 8 0.00 6553.500 FORMAT "%8.3" DEPOSIT ABSOLUTE /end AXIS_DESCR
/end CHARACTERISTIC
/begin CHARACTERISTIC LADIFFVA "" VALUE 0x8FE6D0 KwSw 1.999969 fak_sw_b1 -1.000000 0.9999695 FORMAT "%8.6" /end CHARACTERISTIC
/begin CHARACTERISTIC LAMUKAF "" VALUE 0x8FE718 KwUw 15.99976 fak_uw_b16 0.00 15.99976 FORMAT "%8.5" /end CHARACTERISTIC
/begin CHARACTERISTIC LAMUKAM "" VALUE 0x8FE71A KwUw 15.99976 fak_uw_b16 0.00 15.99976 FORMAT "%8.5" /end CHARACTERISTIC
/begin CHARACTERISTIC MDGRADGES "" VALUE 0x8FD8EE KwUw 99.00055 rel_uw_b100 0.00 99.00055 FORMAT "%8.5" /end CHARACTERISTIC
/begin CHARACTERISTIC MIGESMN "" VALUE 0x8FD8F0 KwUw 99.00055 rel_uw_b100 0.00 99.00055 FORMAT "%8.5" /end CHARACTERISTIC
/begin CHARACTERISTIC MLDTEFPF "" VALUE 0x8EEC48 KwUw 80.00000 m_q0p1 0.00 80.00000 FORMAT "%8.5" /end CHARACTERISTIC
/begin CHARACTERISTIC MLDTEPF "" VALUE 0x8EEC4A KwUw 80.00000 m_q0p1 0.00 80.00000 FORMAT "%8.5" /end CHARACTERISTIC
/begin CHARACTERISTIC MRFABUMX "" VALUE 0x8FE676 KwUw 199.9969 rel_uw_b200 0.00 199.9969 FORMAT "%8.4" /end CHARACTERISTIC
/begin CHARACTERISTIC MRFARUGDN "" CURVE 0x8E9F4E GklWUw 199.9969 rel_uw_b200 0.00 199.9969 FORMAT "%8.4"
 /begin AXIS_DESCR COM_AXIS nmot nmot_ub_q40 12 0.00 10200. FORMAT "%5.0" AXIS_PTS_REF SNM12FEUB /end AXIS_DESCR
/end CHARACTERISTIC
/begin CHARACTERISTIC MRFAVW "" CURVE 0x8EA758 GklWUw 199.9969 rel_uw_b200 0.00 199.9969 FORMAT "%8.4"
 /begin AXIS_DESCR COM_AXIS nmot_w nmot_uw_q0p25 8 0.00 16383.75 FORMAT "%8.2" AXIS_PTS_REF SNM08GKUW /end AXIS_DESCR
/end CHARACTERISTIC
/begin CHARACTERISTIC MRFGRIMX "" CURVE 0x8E0EF7 KlAUbSstUbWUb 199.2 rel_ub_b200 0.00 199.2 FORMAT "%5.1"
 /begin AXIS_DESCR STD_AXIS nmot nmot_ub_q40 6 0.00 10200. FORMAT "%5.0" DEPOSIT ABSOLUTE /end AXIS_DESCR
/end CHARACTERISTIC
/begin CHARACTERISTIC MRFGRLL "" VALUE 0x8E855E KwUw 199.9969 rel_uw_b200 0.00 199.9969 FORMAT "%8.4" /end CHARACTERISTIC
/begin CHARACTERISTIC MRFGRMAX "" VALUE 0x8E8560 KwUw 199.9969 rel_uw_b200 0.00 199.9969 FORMAT "%8.4" /end CHARACTERISTIC
/begin CHARACTERISTIC MRFGRSTA "" VALUE 0x8E8562 KwUw 199.9969 rel_uw_b200 0.00 199.9969 FORMAT "%8.4" /end CHARACTERISTIC
/begin CHARACTERISTIC MSRMDTMX "" VALUE 0x8FD8FC KwSw 5111.922 mdt_sw_b2556 -2556.000 2555.922 FORMAT "%8.3" /end CHARACTERISTIC
/begin CHARACTERISTIC NDV "" VALUE 0x8E0D7B KwUb 10200. nmot_ub_q40 0.00 10200. FORMAT "%5.0" /end CHARACTERISTIC
/begin CHARACTERISTIC NDVO "" VALUE 0x8E0D7C KwUb 10200. nmot_ub_q40 0.00 10200. FORMAT "%5.0" /end CHARACTERISTIC
/begin CHARACTERISTIC NEINSPUR "" VALUE 0x8FD904 KwUw 16383.75 nmot_uw_q0p25 0.00 16383.75 FORMAT "%8.2" /end CHARACTERISTIC
/begin CHARACTERISTIC NFGRMIN "" VALUE 0x8E0ECC KwUb 10120. nmot_ub_q40 0.00 10120. FORMAT "%5.0" /end CHARACTERISTIC
/begin CHARACTERISTIC NLLMNCAUVW "" VALUE 0x8FD906 KwUw 16383.75 nmot_uw_q0p25 0.00 16383.75 FORMAT "%8.2" /end CHARACTERISTIC
/begin CHARACTERISTIC NLLMXCAN "" VALUE 0x8FD908 KwUw 16383.75 nmot_uw_q0p25 0.00 16383.75 FORMAT "%8.2" /end CHARACTERISTIC
/begin CHARACTERISTIC NLLMXCAUVW "" VALUE 0x8FD90A KwUw 16383.75 nmot_uw_q0p25 0.00 16383.75 FORMAT "%8.2" /end CHARACTERISTIC
/begin CHARACTERISTIC NMGETMC "" VALUE 0x8FCD62 KwUb 10200. nmot_ub_q40 0.00 10200. FORMAT "%5.0" /end CHARACTERISTIC
/begin CHARACTERISTIC NMN_DUF "" VALUE 0x8FCCCA KwUb 10200. nmot_ub_q40 0.00 10200. FORMAT "%5.0" /end CHARACTERISTIC
/begin CHARACTERISTIC NMOTDELAY "" VALUE 0x8FD38E KwUb 2.550 t10msxs_ub_b2p55 0.00 2.550 FORMAT "%5.3" /end CHARACTERISTIC
/begin CHARACTERISTIC NOASR "" VALUE 0x8FCD33 KwUb 99.61 rel_ub_b99p6 0.00 99.61 FORMAT "%5.2" /end CHARACTERISTIC
/begin CHARACTERISTIC NSTAW "" CURVE 0x8E5F7C KlAUbSstUbWUw 16383.75 nmot_uw_q0p25 0.00 16383.75 FORMAT "%8.2"
 /begin AXIS_DESCR STD_AXIS tmot temp_ub_q0p75_o48 6 -48.00 143.3 FORMAT "%5.1" DEPOSIT ABSOLUTE /end AXIS_DESCR
/end CHARACTERISTIC
/begin CHARACTERISTIC NUKAO "" VALUE 0x8FD07A KwUb 10200. nmot_ub_q40 0.00 10200. FORMAT "%5.0" /end CHARACTERISTIC
/begin CHARACTERISTIC NUKAU "" VALUE 0x8FD07B KwUb 10200. nmot_ub_q40 0.00 10200. FORMAT "%5.0" /end CHARACTERISTIC
/begin CHARACTERISTIC PSPVDKUGDL "" VALUE 0x8FE678 KwUw 1.999969 fak_uw_b2 0.00 1.999969 FORMAT "%8.6" /end CHARACTERISTIC
/begin CHARACTERISTIC RAMPASR "" VALUE 0x8FD8F8 KwUw 99.99695 rel_uw_b100 0.001525879 99.99847 FORMAT "%8.5" /end CHARACTERISTIC
/begin CHARACTERISTIC RKADTEVO "" VALUE 0x8EEC4C KwSw 9.984375 rel_sw_b1536 0.00 9.984375 FORMAT "%8.6" /end CHARACTERISTIC
/begin CHARACTERISTIC RKADTEVU "" VALUE 0x8EEC4E KwSw 9.984375 rel_sw_b1536 -9.984375 0.00 FORMAT "%8.6" /end CHARACTERISTIC
/begin CHARACTERISTIC RKBAUM "" CURVE 0x8EAB7A GklWSw 1535.953 rel_sw_q0p0468 0.00 1535.953 FORMAT "%8.3"
 /begin AXIS_DESCR COM_AXIS tmot temp_ub_q0p75_o48 9 -48.00 143.3 FORMAT "%5.1" AXIS_PTS_REF STM09ESUB /end AXIS_DESCR
/end CHARACTERISTIC
/begin CHARACTERISTIC RKUKKLU "" VALUE 0x8FE6D2 KwSw 3071.953 rel_sw_q0p0468 -1536.000 1535.953 FORMAT "%8.3" /end CHARACTERISTIC
/begin CHARACTERISTIC RKUKKTUBA "" VALUE 0x8FE71C KwSw 1535.953 rel_sw_q0p0468 0.00 1535.953 FORMAT "%8.3" /end CHARACTERISTIC
/begin CHARACTERISTIC RKUKKTUVA "" VALUE 0x8FE71E KwSw 1536.000 rel_sw_q0p0468 -1536.000 0.00 FORMAT "%8.3" /end CHARACTERISTIC
/begin CHARACTERISTIC RKVAUM "" CURVE 0x8EAB8C GklWSw 1536.000 rel_sw_q0p0468 -1536.000 0.00 FORMAT "%8.3"
 /begin AXIS_DESCR COM_AXIS tmot temp_ub_q0p75_o48 9 -48.00 143.3 FORMAT "%5.1" AXIS_PTS_REF STM09ESUB /end AXIS_DESCR
/end CHARACTERISTIC
/begin CHARACTERISTIC RLUKAO "" VALUE 0x8FD07C KwUb 191.3 rel_ub_q0p75 0.00 191.3 FORMAT "%5.1" /end CHARACTERISTIC
/begin CHARACTERISTIC RLUKAU "" VALUE 0x8FD07D KwUb 191.3 rel_ub_q0p75 0.00 191.3 FORMAT "%5.1" /end CHARACTERISTIC
/begin CHARACTERISTIC RMSTEVIO "" VALUE 0x8EEC50 KwUw 199.9969 rel_uw_b200 0.00 199.9969 FORMAT "%8.4" /end CHARACTERISTIC
/begin CHARACTERISTIC RMSTEVMN "" VALUE 0x8EEC52 KwSw 399.9939 rel_sw_b200 -200.0000 199.9939 FORMAT "%8.4" /end CHARACTERISTIC
/begin CHARACTERISTIC RMSTEVMX "" VALUE 0x8EEC54 KwSw 399.9939 rel_sw_b200 -200.0000 199.9939 FORMAT "%8.4" /end CHARACTERISTIC
/begin AXIS_PTS SIM06ESUW "" 0x8E597C imlatm_w SstAUwSstUw 23.30133 m_uw_b23p3 6 0.00 23.30133 FORMAT "%8.5" DEPOSIT ABSOLUTE /end AXIS_PTS
/begin AXIS_PTS SKS06ESUB "" 0x8E01D2 kstaa SstAUbSstUb 1.992 fak_ub_b2 6 0.00 1.992 FORMAT "%5.3" DEPOSIT ABSOLUTE /end AXIS_PTS
/begin AXIS_PTS SLA05ESUB "" 0x8E5A1E ladiff_w SstAUwSstUw 1.999969 fak_sw_b1 5 -1.000000 0.9999695 FORMAT "%8.6" DEPOSIT ABSOLUTE /end AXIS_PTS
/begin AXIS_PTS SNM06ESUB "" 0x8E00BD nmot SstAUbSstUb 10200. nmot_ub_q40 6 0.00 10200. FORMAT "%5.0" DEPOSIT ABSOLUTE /end AXIS_PTS
/begin AXIS_PTS SNM07ESUB "" 0x8E00CB nmot SstAUbSstUb 10200. nmot_ub_q40 7 0.00 10200. FORMAT "%5.0" DEPOSIT ABSOLUTE /end AXIS_PTS
/begin AXIS_PTS SNM08FEUB "" 0x8E00D3 nmot SstAUbSstUb 10200. nmot_ub_q40 8 0.00 10200. FORMAT "%5.0" DEPOSIT ABSOLUTE /end AXIS_PTS
/begin AXIS_PTS SNM08GKUW "" 0x8EA79C nmot_w SstAUwSstUw 16383.75 nmot_uw_q0p25 8 0.00 16383.75 FORMAT "%8.2" DEPOSIT ABSOLUTE /end AXIS_PTS
/begin AXIS_PTS SNM12FEUB "" 0x8E0201 nmot SstAUbSstUb 10200. nmot_ub_q40 12 0.00 10200. FORMAT "%5.0" DEPOSIT ABSOLUTE /end AXIS_PTS
/begin AXIS_PTS SNM16CIUB "" 0x8E00F9 nmot SstAUbSstUb 10200. nmot_ub_q40 16 0.00 10200. FORMAT "%5.0" DEPOSIT ABSOLUTE /end AXIS_PTS
/begin AXIS_PTS SRL08GKUB "" 0x8E1B65 rl SstAUbSstUb 191.3 rel_ub_q0p75 8 0.00 191.3 FORMAT "%5.1" DEPOSIT ABSOLUTE /end AXIS_PTS
/begin AXIS_PTS SRP06ESUB "" 0x8E023C rlp SstAUbSstUb 191.3 rel_ub_q0p75 6 0.00 191.3 FORMAT "%5.1" DEPOSIT ABSOLUTE /end AXIS_PTS
/begin AXIS_PTS STA06ESUB "" 0x8E0165 tans SstAUbSstUb 191.3 temp_ub_q0p75_o48 6 -48.00 143.3 FORMAT "%5.1" DEPOSIT ABSOLUTE /end AXIS_PTS
/begin AXIS_PTS STM09ESUB "" 0x8E01A0 tmot SstAUbSstUb 191.3 temp_ub_q0p75_o48 9 -48.00 143.3 FORMAT "%5.1" DEPOSIT ABSOLUTE /end AXIS_PTS
/begin AXIS_PTS STM12ESUB "" 0x8E0279 tmot SstAUbSstUb 191.3 temp_ub_q0p75_o48 12 -48.00 143.3 FORMAT "%5.1" DEPOSIT ABSOLUTE /end AXIS_PTS
/begin AXIS_PTS STS08ESUB "" 0x8E0286 tmst SstAUbSstUb 191.3 temp_ub_q0p75_o48 8 -48.00 143.3 FORMAT "%5.1" DEPOSIT ABSOLUTE /end AXIS_PTS
/begin AXIS_PTS STS12ESUB "" 0x8E028F tmst SstAUbSstUb 191.3 temp_ub_q0p75_o48 12 -48.00 143.3 FORMAT "%5.1" DEPOSIT ABSOLUTE /end AXIS_PTS
/begin CHARACTERISTIC SULSULUFT "" VALUE 0x8E8126 KwUw 31.99951 spg_q4p88Em4 0.00 31.99951 FORMAT "%8.5" /end CHARACTERISTIC
/begin CHARACTERISTIC SULSULUFTL "" VALUE 0x8E8128 KwUw 31.99951 spg_q4p88Em4 0.00 31.99951 FORMAT "%8.5" /end CHARACTERISTIC
/begin CHARACTERISTIC SULSUMX "" VALUE 0x8E812A KwUw 31.99951 spg_q4p88Em4 0.00 31.99951 FORMAT "%8.5" /end CHARACTERISTIC
/begin CHARACTERISTIC SULSUMXL "" VALUE 0x8E812C KwUw 31.99951 spg_q4p88Em4 0.00 31.99951 FORMAT "%8.5" /end CHARACTERISTIC
/begin CHARACTERISTIC SZANSSM1 "" CURVE 0x8E18C6 GklWUb 0.9961 fak_ub_b1 0.00 0.9961
 /begin AXIS_DESCR COM_AXIS tmst temp_ub_q0p75_o48 12 -48.00 143.3 FORMAT "%5.1" AXIS_PTS_REF STS12ESUB /end AXIS_DESCR
/end CHARACTERISTIC
/begin CHARACTERISTIC SZANSSM2 "" CURVE 0x8E18D2 GklWUb 0.9961 fak_ub_b1 0.00 0.9961
 /begin AXIS_DESCR COM_AXIS tmst temp_ub_q0p75_o48 12 -48.00 143.3 FORMAT "%5.1" AXIS_PTS_REF STS12ESUB /end AXIS_DESCR
/end CHARACTERISTIC
/begin CHARACTERISTIC TADTEAMX "" CURVE 0x8E394E KlAUbSstUbWUb 99.61 rel_ub_b99p6 0.00 99.61 FORMAT "%5.2"
 /begin AXIS_DESCR STD_AXIS tdtesta t100msxs_ub_b25p5 14 0.00 25.50 FORMAT "%5.2" DEPOSIT ABSOLUTE /end AXIS_DESCR
/end CHARACTERISTIC
/begin CHARACTERISTIC TADTEMX "" VALUE 0x8E396B KwUb 89.84 rel_ub_b99p6 9.766 99.61 FORMAT "%5.2" /end CHARACTERISTIC
/begin CHARACTERISTIC TAIRCMX "" VALUE 0x8FD38F KwUb 255.0 DEZ 0.00 255.0 FORMAT "%5.1" /end CHARACTERISTIC
/begin CHARACTERISTIC TAIRCNU "" VALUE 0x8FD390 KwUb 5.100 t20msxs_ub_b5p1 0.00 5.100 FORMAT "%5.3" /end CHARACTERISTIC
/begin CHARACTERISTIC TAMSRCMX "" VALUE 0x8FCD34 KwUb 2.550 t10msxs_ub_b2p55 0.00 2.550 FORMAT "%5.3" /end CHARACTERISTIC
/begin CHARACTERISTIC TANDT "" CURVE 0x8E1D26 KlAUbSstUbWUb 191.3 temp_ub_b191p25 0.00 191.3 FORMAT "%5.1"
 /begin AXIS_DESCR STD_AXIS tansab temp_ub_q0p75_o48 8 -48.00 143.3 FORMAT "%5.1" DEPOSIT ABSOLUTE /end AXIS_DESCR
/end CHARACTERISTIC
/begin CHARACTERISTIC TANH "" VALUE 0x8FD03D KwUb 191.3 temp_ub_q0p75_o48 -48.00 143.3 FORMAT "%5.1" /end CHARACTERISTIC
/begin CHARACTERISTIC TBPWMCS "" VALUE 0x8E3FDF KwUb 2.550 t10msxs_ub_b2p55 0.00 2.550 FORMAT "%5.3" /end CHARACTERISTIC
/begin CHARACTERISTIC TC6TECL "" VALUE 0x8E396C KwUb 127.0 dez 0.00 127.0 FORMAT "%5.1" /end CHARACTERISTIC
/begin CHARACTERISTIC TC6TECNL "" VALUE 0x8E396D KwUb 127.0 dez 0.00 127.0 FORMAT "%5.1" /end CHARACTERISTIC
/begin CHARACTERISTIC TC6TECP "" VALUE 0x8E396E KwUb 127.0 dez 0.00 127.0 FORMAT "%5.1" /end CHARACTERISTIC
/begin CHARACTERISTIC TC6TECRF "" VALUE 0x8E396F KwUb 127.0 dez 0.00 127.0 FORMAT "%5.1" /end CHARACTERISTIC
/begin CHARACTERISTIC TC6TECRM "" VALUE 0x8E3970 KwUb 127.0 dez 0.00 127.0 FORMAT "%5.1" /end CHARACTERISTIC
/begin CHARACTERISTIC TCONT_HILO "" VALUE 0x8FD391 KwUb 1.270 t10msxs_ub_b2p55 0.00 1.270 FORMAT "%5.3" /end CHARACTERISTIC
/begin CHARACTERISTIC TCRCAN "" VALUE 0x8FD392 KwUb 255.0 DEZ 0.00 255.0 FORMAT "%5.1" /end CHARACTERISTIC
/begin CHARACTERISTIC TCSERC "" VALUE 0x8E3FE0 KwUb 12.75 t50msxs_ub_b12p75 0.00 12.75 FORMAT "%5.2" /end CHARACTERISTIC
/begin CHARACTERISTIC TCSERNPL "" VALUE 0x8E3FE1 KwUb 12.75 t50msxs_ub_b12p75 0.00 12.75 FORMAT "%5.2" /end CHARACTERISTIC
/begin CHARACTERISTIC TCSERP "" VALUE 0x8E3FE2 KwUb 12.75 t50msxs_ub_b12p75 0.00 12.75 FORMAT "%5.2" /end CHARACTERISTIC
/begin CHARACTERISTIC TDGNIOANL "" VALUE 0x8E03D1 KwUb 5.100 t20msxs_ub_b5p1 0.00 5.100 FORMAT "%5.3" /end CHARACTERISTIC
/begin CHARACTERISTIC TDTEFA "" VALUE 0x8EEC56 KwUw 180.0000 t100msxs_uw_b6553p6 20.00000 200.0000 FORMAT "%8.4" /end CHARACTERISTIC
/begin CHARACTERISTIC TDTESZO "" VALUE 0x8EEC58 KwUw 6553.500 t100msxs_uw_b6553p6 0.00 6553.500 FORMAT "%8.3" /end CHARACTERISTIC
/begin CHARACTERISTIC TDTESZU "" VALUE 0x8EEC5A KwUw 6553.500 t100msxs_uw_b6553p6 0.00 6553.500 FORMAT "%8.3" /end CHARACTERISTIC
/begin CHARACTERISTIC TDTEZAM "" VALUE 0x8EEC5C KwUw 6553.500 t100msxs_uw_b6553p6 0.00 6553.500 FORMAT "%8.3" /end CHARACTERISTIC
/begin CHARACTERISTIC TDV "" VALUE 0x8E0D7D KwUb 12.75 t50msxs_ub_b12p75 0.00 12.75 FORMAT "%5.2" /end CHARACTERISTIC
/begin CHARACTERISTIC TDVIVZ "" VALUE 0x8FDD68 KwUw 1310.700 t20msxs_uw_q0p02 0.00 1310.700 FORMAT "%8.3" /end CHARACTERISTIC
/begin CHARACTERISTIC TDVOVR "" VALUE 0x8E837E KwUw 1310.700 t20msxs_uw_q0p02 0.00 1310.700 FORMAT "%8.3" /end CHARACTERISTIC
/begin CHARACTERISTIC TDVZVI "" VALUE 0x8FDD6A KwUw 1310.700 t20msxs_uw_q0p02 0.00 1310.700 FORMAT "%8.3" /end CHARACTERISTIC
/begin CHARACTERISTIC TERRTOLC "" VALUE 0x8E03A7 KwUb 255.0 t_q1 0.00 255.0 FORMAT "%5.1" /end CHARACTERISTIC
/begin CHARACTERISTIC TFALLMIGES "" VALUE 0x8FCD29 KwUb 2.550 t_q0p01 0.00 2.550 FORMAT "%5.3" /end CHARACTERISTIC
/begin CHARACTERISTIC TFGRABS "" VALUE 0x8E0ECD KwUb 0.4000 t20msxs_ub_b5p1 0.00 0.4000 /end CHARACTERISTIC
/begin CHARACTERISTIC TFGRAR "" VALUE 0x8E0F04 KwUb 5.080 t20msxs_ub_b5p1 0.00 5.080 FORMAT "%5.3" /end CHARACTERISTIC
/begin CHARACTERISTIC TFGREPB "" VALUE 0x8FCFB4 KwUb 5.100 t20msxs_ub_b5p1 0.00 5.100 FORMAT "%5.3" /end CHARACTERISTIC
/begin CHARACTERISTIC TFGRFDY "" VALUE 0x8FCFB5 KwUb 5.100 t20msxs_ub_b5p1 0.00 5.100 FORMAT "%5.3" /end CHARACTERISTIC
/begin CHARACTERISTIC TFGRUB "" VALUE 0x8FCFB6 KwUb 5.100 t20msxs_ub_b5p1 0.00 5.100 FORMAT "%5.3" /end CHARACTERISTIC
/begin CHARACTERISTIC TFGRUEOB "" VALUE 0x8FCFB7 KwUb 5.100 t20msxs_ub_b5p1 0.00 5.100 FORMAT "%5.3" /end CHARACTERISTIC
/begin CHARACTERISTIC TFGRUM "" VALUE 0x8FCFB8 KwUb 5.100 t20msxs_ub_b5p1 0.00 5.100 FORMAT "%5.3" /end CHARACTERISTIC
/begin CHARACTERISTIC TFGRUNUB "" VALUE 0x8FCFB9 KwUb 5.100 t20msxs_ub_b5p1 0.00 5.100 FORMAT "%5.3" /end CHARACTERISTIC
/begin CHARACTERISTIC TFRMDTEE "" VALUE 0x8E3971 KwUb 3.000 t100msxs_ub_b25p5 0.00 3.000 FORMAT "%5.3" /end CHARACTERISTIC
/begin CHARACTERISTIC TGENLRC "" VALUE 0x8E5F78 KwUw 655.3500 t10msxs_uw_b655p35 0.00 655.3500 FORMAT "%8.4" /end CHARACTERISTIC
/begin CHARACTERISTIC TGENLRC2 "" VALUE 0x8E5F7A KwUw 655.3500 t10msxs_uw_b655p35 0.00 655.3500 FORMAT "%8.4" /end CHARACTERISTIC
/begin CHARACTERISTIC TGRACMX "" VALUE 0x8FCFBC KwUb 255.0 DEZ 0.00 255.0 FORMAT "%5.1" /end CHARACTERISTIC
/begin CHARACTERISTIC TGRACNU "" VALUE 0x8FCFBD KwUb 5.100 t20msxs_ub_b5p1 0.00 5.100 FORMAT "%5.3" /end CHARACTERISTIC
/begin CHARACTERISTIC TGWHPOSG "" VALUE 0x8FCD2A KwUb 2.550 t10msxs_ub_b2p55 0.00 2.550 FORMAT "%5.3" /end CHARACTERISTIC
/begin CHARACTERISTIC TKRF "" VALUE 0x8E2078 KwUb 25.50 txms_ub_q0p1 0.00 25.50 FORMAT "%5.2" /end CHARACTERISTIC
/begin CHARACTERISTIC TMBAMN "" VALUE 0x8E2079 KwUb 191.3 temp_ub_q0p75_o48 -48.00 143.3 FORMAT "%5.1" /end CHARACTERISTIC
/begin CHARACTERISTIC TMBAMX "" VALUE 0x8E207A KwUb 191.3 temp_ub_q0p75_o48 -48.00 143.3 FORMAT "%5.1" /end CHARACTERISTIC
/begin CHARACTERISTIC TMDTEU "" VALUE 0x8E3972 KwUb 63.75 temp_ub_q0p75_o48 27.00 90.75 FORMAT "%5.2" /end CHARACTERISTIC
/begin CHARACTERISTIC TMDV "" VALUE 0x8E0D7E KwUb 191.3 temp_ub_q0p75_o48 -48.00 143.3 FORMAT "%5.1" /end CHARACTERISTIC
/begin CHARACTERISTIC TMEWDTEU "" VALUE 0x8E3973 KwUb 191.3 temp_ub_q0p75_o48 -48.00 143.3 FORMAT "%5.1" /end CHARACTERISTIC
/begin CHARACTERISTIC TMGESMN "" VALUE 0x8FCD2B KwUb 2.550 t_q0p01 0.00 2.550 FORMAT "%5.3" /end CHARACTERISTIC
/begin CHARACTERISTIC TMH "" VALUE 0x8FD03E KwUb 191.3 temp_ub_q0p75_o48 -48.00 143.3 FORMAT "%5.1" /end CHARACTERISTIC
/begin CHARACTERISTIC TMHLDO "" VALUE 0x8E03D2 KwUb 191.3 temp_ub_q0p75_o48 -48.00 143.3 FORMAT "%5.1" /end CHARACTERISTIC
/begin CHARACTERISTIC TMHLON "" VALUE 0x8E03D3 KwUb 191.3 temp_ub_q0p75_o48 -48.00 143.3 FORMAT "%5.1" /end CHARACTERISTIC
/begin CHARACTERISTIC TMHSG "" VALUE 0x8FD03F KwUb 191.3 temp_ub_q0p75_o48 -48.00 143.3 FORMAT "%5.1" /end CHARACTERISTIC
/begin CHARACTERISTIC TMK "" VALUE 0x8FD040 KwUb 191.3 temp_ub_q0p75_o48 -48.00 143.3 FORMAT "%5.1" /end CHARACTERISTIC
/begin CHARACTERISTIC TMNST "" VALUE 0x8E3974 KwUb 191.3 temp_ub_q0p75_o48 -48.00 143.3 FORMAT "%5.1" /end CHARACTERISTIC
/begin CHARACTERISTIC TMNUUKA "" VALUE 0x8FD07E KwUb 1.850 t10msxs_ub_b2p55 0.7000 2.550 FORMAT "%5.3" /end CHARACTERISTIC
/begin CHARACTERISTIC TMODT "" CURVE 0x8E1D37 KlAUbSstUbWUb 191.3 temp_ub_b191p25 0.00 191.3 FORMAT "%5.1"
 /begin AXIS_DESCR STD_AXIS tmotab temp_ub_q0p75_o48 3 -48.00 143.3 FORMAT "%5.1" DEPOSIT ABSOLUTE /end AXIS_DESCR
/end CHARACTERISTIC
/begin CHARACTERISTIC TMORSTE "" VALUE 0x8FD041 KwUb 191.3 temp_ub_q0p75_o48 -48.00 143.3 FORMAT "%5.1" /end CHARACTERISTIC
/begin CHARACTERISTIC TMSRCERR "" VALUE 0x8FCD35 KwUb 2.550 t10msxs_ub_b2p55 0.00 2.550 FORMAT "%5.3" /end CHARACTERISTIC
/begin CHARACTERISTIC TMSRCNU "" VALUE 0x8FCD36 KwUb 2.550 t10msxs_ub_b2p55 0.00 2.550 FORMAT "%5.3" /end CHARACTERISTIC
/begin CHARACTERISTIC TMUDTEU "" VALUE 0x8E3975 KwUb 191.3 temp_ub_q0p75_o48 -48.00 143.3 FORMAT "%5.1" /end CHARACTERISTIC
/begin CHARACTERISTIC TMUKAK "" VALUE 0x8FD07F KwUb 191.3 temp_ub_q0p75_o48 -48.00 143.3 FORMAT "%5.1" /end CHARACTERISTIC
/begin CHARACTERISTIC TMUKAU "" VALUE 0x8FD080 KwUb 191.3 temp_ub_q0p75_o48 -48.00 143.3 FORMAT "%5.1" /end CHARACTERISTIC
/begin CHARACTERISTIC TMUKAW "" VALUE 0x8FD081 KwUb 191.3 temp_ub_q0p75_o48 -48.00 143.3 FORMAT "%5.1" /end CHARACTERISTIC
/begin CHARACTERISTIC TMURSTE "" VALUE 0x8FD042 KwUb 191.3 temp_ub_q0p75_o48 -48.00 143.3 FORMAT "%5.1" /end CHARACTERISTIC
/begin CHARACTERISTIC TMWUC "" VALUE 0x8FCDFC KwUb 191.3 temp_ub_q0p75_o48 -48.00 143.3 FORMAT "%5.1" /end CHARACTERISTIC
/begin CHARACTERISTIC TMWUCST "" VALUE 0x8FCDFD KwUb 191.3 temp_ub_q0p75_o48 -48.00 143.3 FORMAT "%5.1" /end CHARACTERISTIC
/begin CHARACTERISTIC TN2FGRGA "" CURVE 0x8E8564 KlAUwSstUwWUw 1310.660 t20msxs_uw_q0p02 0.02000000 1310.680 FORMAT "%8.3"
 /begin AXIS_DESCR STD_AXIS uevges_w fak_q0p1 8 0.00 6553.500 FORMAT "%8.3" DEPOSIT ABSOLUTE /end AXIS_DESCR
/end CHARACTERISTIC
/begin CHARACTERISTIC TNSTGES "" VALUE 0x8FD8F2 KwUw 655.3500 t_q0p01 0.00 655.3500 FORMAT "%8.4" /end CHARACTERISTIC
/begin CHARACTERISTIC TNSUUK "" VALUE 0x8FD068 KwUb 25.50 t100msxs_ub_b25p5 0.00 25.50 FORMAT "%5.2" /end CHARACTERISTIC
/begin CHARACTERISTIC TNSUUKA "" VALUE 0x8FE720 KwUw 655.3500 t10msxs_uw_b655p35 0.00 655.3500 FORMAT "%8.4" /end CHARACTERISTIC
/begin CHARACTERISTIC TPERDTE "" VALUE 0x8E3976 KwUb 25.50 t100msxs_ub_b25p5 0.00 25.50 FORMAT "%5.2" /end CHARACTERISTIC
/begin CHARACTERISTIC TPUKUKA "" VALUE 0x8FD082 KwUb 2.550 t10msxs_ub_b2p55 0.00 2.550 FORMAT "%5.3" /end CHARACTERISTIC
/begin CHARACTERISTIC TSPUUKA "" VALUE 0x8FD083 KwUb 24.50 t100msxs_ub_b25p5 1.000 25.50 FORMAT "%5.2" /end CHARACTERISTIC
/begin CHARACTERISTIC TSTAW "" CURVE 0x8E5F90 KlAUbSstUbWUw 1310.700 t20msxs_uw_b1310 0.00 1310.700 FORMAT "%8.3"
 /begin AXIS_DESCR STD_AXIS tmot temp_ub_q0p75_o48 6 -48.00 143.3 FORMAT "%5.1" DEPOSIT ABSOLUTE /end AXIS_DESCR
/end CHARACTERISTIC
/begin CHARACTERISTIC TSTM "" VALUE 0x8E3977 KwUb 25.50 t_q0p1 0.00 25.50 FORMAT "%5.2" /end CHARACTERISTIC
/begin CHARACTERISTIC TSWKNBGA "" CURVE 0x8E0ED4 KlAUbSstUbWUb 5.100 t20msxs_ub_q0p02 0.00 5.100 FORMAT "%5.3"
 /begin AXIS_DESCR STD_AXIS uevges fak_q0p1 8 0.00 25.50 FORMAT "%5.2" DEPOSIT ABSOLUTE /end AXIS_DESCR
/end CHARACTERISTIC
/begin CHARACTERISTIC TSWKNVGA "" CURVE 0x8E0EE5 KlAUbSstUbWUb 5.100 t20msxs_ub_q0p02 0.00 5.100 FORMAT "%5.3"
 /begin AXIS_DESCR STD_AXIS uevges fak_q0p1 8 0.00 25.50 FORMAT "%5.2" DEPOSIT ABSOLUTE /end AXIS_DESCR
/end CHARACTERISTIC
/begin CHARACTERISTIC TTEVAZ "" VALUE 0x8E3978 KwUb 10.00 t100msxs_ub_b25p5 0.00 10.00 FORMAT "%5.2" /end CHARACTERISTIC
/begin CHARACTERISTIC TVAG "" VALUE 0x8E207B KwUb 25.50 t100msxs_ub_b25p5 0.00 25.50 FORMAT "%5.2" /end CHARACTERISTIC
/begin CHARACTERISTIC TVCAMSR "" VALUE 0x8FD8FA KwUw 655.3500 t10msxs_uw_b655p35 0.00 655.3500 FORMAT "%8.4" /end CHARACTERISTIC
/begin CHARACTERISTIC TVDTEABG "" VALUE 0x8E3979 KwUb 2.000 t100msxs_ub_b25p5 0.00 2.000 FORMAT "%5.3" /end CHARACTERISTIC
/begin CHARACTERISTIC TVDTEB "" VALUE 0x8E397A KwUb 10.00 t100msxs_ub_b25p5 0.00 10.00 FORMAT "%5.2" /end CHARACTERISTIC
/begin CHARACTERISTIC TVDTEE "" VALUE 0x8E397B KwUb 12.00 t100msxs_ub_b25p5 3.000 15.00 FORMAT "%5.2" /end CHARACTERISTIC
/begin CHARACTERISTIC TVDTELLA "" VALUE 0x8E397C KwUb 9.500 t100msxs_ub_b25p5 0.5000 10.00 FORMAT "%5.2" /end CHARACTERISTIC
/begin CHARACTERISTIC TVDTEVP "" VALUE 0x8E397D KwUb 19.00 t100msxs_ub_b25p5 1.000 20.00 FORMAT "%5.2" /end CHARACTERISTIC
/begin CHARACTERISTIC TVDTEVPM "" VALUE 0x8E397E KwUb 19.00 t100msxs_ub_b25p5 1.000 20.00 FORMAT "%5.2" /end CHARACTERISTIC
/begin CHARACTERISTIC TVDTEVZ "" VALUE 0x8E397F KwUb 10.00 t100msxs_ub_b25p5 0.00 10.00 FORMAT "%5.2" /end CHARACTERISTIC
/begin CHARACTERISTIC TVFRG "" VALUE 0x8FCFCE KwUb 12.75 t50msxs_ub_b12p75 0.00 12.75 FORMAT "%5.2" /end CHARACTERISTIC
/begin CHARACTERISTIC TVFZSU "" VALUE 0x8FCFD9 KwUb 25.50 t100msxs_ub_b25p5 0.00 25.50 FORMAT "%5.2" /end CHARACTERISTIC
/begin CHARACTERISTIC TVLADV "" CURVE 0x8E8586 KlAUwSstSwWUw 1310.6999997 zk20msxs_uw_b1310 0.020000305180 1310.7200000 FORMAT "%12.7"
 /begin AXIS_DESCR STD_AXIS dvzvi_w vfzg_sw_q0p00781 8 -256.0000 255.9922 FORMAT "%8.4" DEPOSIT ABSOLUTE /end AXIS_DESCR
/end CHARACTERISTIC
/begin CHARACTERISTIC TVLSULUFT "" VALUE 0x8E0D5C KwUb 25.50 t100msxs_ub_b25p5 0.00 25.50 FORMAT "%5.2" /end CHARACTERISTIC
/begin CHARACTERISTIC TVNKL15 "" VALUE 0x8FCD63 KwUb 5.100 t20msxs_ub_b5p1 0.00 5.100 FORMAT "%5.3" /end CHARACTERISTIC
/begin CHARACTERISTIC TVPWMCSR "" VALUE 0x8E3FE3 KwUb 6.350 t50msxs_ub_b12p75 0.00 6.350 FORMAT "%5.3" /end CHARACTERISTIC
/begin CHARACTERISTIC TVPWMCSS "" VALUE 0x8E3FE4 KwUb 6.350 t50msxs_ub_b12p75 0.00 6.350 FORMAT "%5.3" /end CHARACTERISTIC
/begin CHARACTERISTIC TVTANKL "" VALUE 0x8FCE00 KwUb 255.0 t1sxs_ub_b255 0.00 255.0 FORMAT "%5.1" /end CHARACTERISTIC
/begin CHARACTERISTIC TVTKLSU "" VALUE 0x8E812E KwUw 6553.500 t100msxs_uw_b6553p5 0.00 6553.500 FORMAT "%8.3" /end CHARACTERISTIC
/begin CHARACTERISTIC TVTOLC "" VALUE 0x8E5DA8 KwUw 65535.00 t1sxs_uw_b65535 0.00 65535.00 FORMAT "%8.2" /end CHARACTERISTIC
/begin CHARACTERISTIC TVTOLE "" VALUE 0x8E5DAA KwUw 65535.00 t1sxs_uw_b65535 0.00 65535.00 FORMAT "%8.2" /end CHARACTERISTIC
/begin CHARACTERISTIC TVTUMC "" VALUE 0x8E3FFE KwUw 65535.00 t1sxs_uw_b65535 0.00 65535.00 FORMAT "%8.2" /end CHARACTERISTIC
/begin CHARACTERISTIC TVWDKS "" VALUE 0x8FCFD5 KwUb 2.550 t10msxs_ub_b2p55 0.00 2.550 FORMAT "%5.3" /end CHARACTERISTIC
/begin CHARACTERISTIC TWDKSV "" CURVE 0x8E9F66 KlAUwSstUwWUw 655.34999985 zk10msxs_uw_b655 0.010000152590 655.36000000 FORMAT "%12.8"
 /begin AXIS_DESCR STD_AXIS pspvmin_w fak_uw_b2 6 0.00 1.999969 FORMAT "%8.6" DEPOSIT ABSOLUTE /end AXIS_DESCR
/end CHARACTERISTIC
/begin CHARACTERISTIC TWSTT "" CURVE 0x8EA8FE KlAUwSstUwWUw 65535.00 t1sxs_uw_q1 0.00 65535.00 FORMAT "%8.2"
 /begin AXIS_DESCR STD_AXIS tmotab temp_ub_q0p75_o48 12 -48.00 143.3 FORMAT "%5.1" DEPOSIT ABSOLUTE /end AXIS_DESCR
/end CHARACTERISTIC
/begin CHARACTERISTIC TZ2FGRGA "" CURVE 0x8E85A8 KlAUwSstUwWUw 1310.660 t20msxs_uw_q0p02 0.02000000 1310.680 FORMAT "%8.3"
 /begin AXIS_DESCR STD_AXIS uevges_w fak_q0p1 8 0.00 6553.500 FORMAT "%8.3" DEPOSIT ABSOLUTE /end AXIS_DESCR
/end CHARACTERISTIC
/begin CHARACTERISTIC TZGEZWMX "" VALUE 0x8FCD2C KwUb 2.550 t_q0p01 0.00 2.550 FORMAT "%5.3" /end CHARACTERISTIC
/begin CHARACTERISTIC T_ANLEN "" VALUE 0x8FCD64 KwUb 5.100 t20msxs_ub_b5p1 0.00 5.100 FORMAT "%5.3" /end CHARACTERISTIC
/begin CHARACTERISTIC T_ANLEVFZ "" VALUE 0x8FD90C KwUw 1310.700 t20msxs_uw_b1310 0.00 1310.700 FORMAT "%8.3" /end CHARACTERISTIC
/begin CHARACTERISTIC T_ASRFGR "" VALUE 0x8FCD31 KwUb 2.550 t10msxs_ub_b2p55 0.00 2.550 FORMAT "%5.3" /end CHARACTERISTIC
/begin CHARACTERISTIC T_GE3CMX "" VALUE 0x8FCD2E KwUb 2.550 t10msxs_ub_b2p55 0.00 2.550 FORMAT "%5.3" /end CHARACTERISTIC
/begin CHARACTERISTIC T_GE3CNU "" VALUE 0x8FCD2F KwUb 2.550 t10msxs_ub_b2p55 0.00 2.550 FORMAT "%5.3" /end CHARACTERISTIC
/begin CHARACTERISTIC T_NOMGRA "" VALUE 0x8FCFBE KwUb 5.100 t20msxs_ub_b5p1 0.00 5.100 FORMAT "%5.3" /end CHARACTERISTIC
/begin CHARACTERISTIC T_NOMGRAD "" VALUE 0x8FCFBF KwUb 5.100 t20msxs_ub_b5p1 0.00 5.100 FORMAT "%5.3" /end CHARACTERISTIC
/begin CHARACTERISTIC T_NOMGRATA "" VALUE 0x8FCFC0 KwUb 5.100 t20msxs_ub_b5p1 0.00 5.100 FORMAT "%5.3" /end CHARACTERISTIC
/begin CHARACTERISTIC T_SFSEN "" VALUE 0x8FD8F4 KwUw 655.3500 t10msxs_uw_b655p35 0.00 655.3500 FORMAT "%8.4" /end CHARACTERISTIC
/begin CHARACTERISTIC UBFGRMIN "" VALUE 0x8E0ECE KwUb 17.37 spg_ub_b17p37 0.00 17.37 FORMAT "%5.2" /end CHARACTERISTIC
/begin CHARACTERISTIC UKAFRTMO "" CURVE 0x8EAE10 GklWUw 1.999969 fak_uw_b2 0.00 1.999969 FORMAT "%8.6"
 /begin AXIS_DESCR COM_AXIS tmot temp_ub_q0p75_o48 9 -48.00 143.3 FORMAT "%5.1" AXIS_PTS_REF STM09ESUB /end AXIS_DESCR
/end CHARACTERISTIC
/begin CHARACTERISTIC UKAFRTMU "" CURVE 0x8EAE22 GklWUw 1.999969 fak_uw_b2 0.00 1.999969 FORMAT "%8.6"
 /begin AXIS_DESCR COM_AXIS tmot temp_ub_q0p75_o48 9 -48.00 143.3 FORMAT "%5.1" AXIS_PTS_REF STM09ESUB /end AXIS_DESCR
/end CHARACTERISTIC
/begin CHARACTERISTIC UMSRLNMN "" VALUE 0x8FE67A KwUw 32.76750 m_uw_q0p0005 0.00 32.76750 FORMAT "%8.5" /end CHARACTERISTIC
/begin CHARACTERISTIC UPWMCS "" VALUE 0x8E3FE5 KwUb 17.95 spg_ubatt 0.00 17.95 FORMAT "%5.2" /end CHARACTERISTIC
/begin CHARACTERISTIC VDMN "" VALUE 0x8E7FFE KwUw 511.9922 vfzg_uw_b512 0.00 511.9922 FORMAT "%8.4" /end CHARACTERISTIC
/begin CHARACTERISTIC VECDMN "" VALUE 0x8E5DA4 KwUw 511.9922 vfzg_uw_b512 0.00 511.9922 FORMAT "%8.4" /end CHARACTERISTIC
/begin CHARACTERISTIC VECDMX "" VALUE 0x8E5DA6 KwUw 511.9922 vfzg_uw_b512 0.00 511.9922 FORMAT "%8.4" /end CHARACTERISTIC
/begin CHARACTERISTIC VFGREMAX "" VALUE 0x8E8380 KwUw 511.9922 vfzg_uw_b512 0.00 511.9922 FORMAT "%8.4" /end CHARACTERISTIC
/begin CHARACTERISTIC VFGREMIN "" VALUE 0x8E8382 KwUw 511.9922 vfzg_uw_b512 0.00 511.9922 FORMAT "%8.4" /end CHARACTERISTIC
/begin CHARACTERISTIC VFGRMAX "" VALUE 0x8E8384 KwUw 511.9922 vfzg_uw_b512 0.00 511.9922 FORMAT "%8.4" /end CHARACTERISTIC
/begin CHARACTERISTIC VFGRMIN "" VALUE 0x8E8386 KwUw 511.9922 vfzg_uw_b512 0.00 511.9922 FORMAT "%8.4" /end CHARACTERISTIC
/begin CHARACTERISTIC VFZANL "" VALUE 0x8FCD65 KwUb 318.8 vfzg_ub_q1p25 0.00 318.8 FORMAT "%5.1" /end CHARACTERISTIC
/begin CHARACTERISTIC VLMXVZ "" CURVE 0x8E85CA KlAUwSstUwWUw 511.9922 vfzg_uw_q0p0078125 0.00 511.9922 FORMAT "%8.4"
 /begin AXIS_DESCR STD_AXIS vziel_w vfzg_uw_q0p0078125 6 0.00 511.9922 FORMAT "%8.4" DEPOSIT ABSOLUTE /end AXIS_DESCR
/end CHARACTERISTIC
/begin CHARACTERISTIC VMINAMSR "" VALUE 0x8FD8FE KwUw 324.9950 vfzg_uw_b325 0.00 324.9950 FORMAT "%8.4" /end CHARACTERISTIC
/begin CHARACTERISTIC VREGLMAX "" VALUE 0x8E847C KwUw 511.9922 vfzg_uw_q0p0078125 0.00 511.9922 FORMAT "%8.4" /end CHARACTERISTIC
/begin CHARACTERISTIC VREGLMIN "" VALUE 0x8E847E KwUw 511.9922 vfzg_uw_q0p0078125 0.00 511.9922 FORMAT "%8.4" /end CHARACTERISTIC
/begin CHARACTERISTIC WDKSAPP "" VALUE 0x8FE67C KwUw 99.99847 rel_uw_b100 0.00 99.99847 FORMAT "%8.5" /end CHARACTERISTIC
/begin CHARACTERISTIC WDKSOFS "" VALUE 0x8FE67E KwUw 99.99847 rel_uw_b100 0.00 99.99847 FORMAT "%8.5" /end CHARACTERISTIC
/begin CHARACTERISTIC WEAN "" CURVE 0x8E1A83 GklWUb 1530. zw_ub_q6 0.00 1530. FORMAT "%5.0"
 /begin AXIS_DESCR COM_AXIS nmot_w nmot_uw_q0p25 8 0.00 16383.75 FORMAT "%8.2" AXIS_PTS_REF SNM08GKUW /end AXIS_DESCR
/end CHARACTERISTIC
/begin CHARACTERISTIC WEEMRFAN "" CURVE 0x8E1A8B GklWUb 1530. zw_ub_q6 0.00 1530. FORMAT "%5.0"
 /begin AXIS_DESCR COM_AXIS nmot_w nmot_uw_q0p25 8 0.00 16383.75 FORMAT "%8.2" AXIS_PTS_REF SNM08GKUW /end AXIS_DESCR
/end CHARACTERISTIC
/begin CHARACTERISTIC WFRL "" CURVE 0x8FE6D4 FklWUw 3071.953 rel_uw_b3072 0.00 3071.953 FORMAT "%8.3"
 /begin AXIS_DESCR FIX_AXIS rlp_w rel_uw_q0p0234 31 0.00 180.0000 FORMAT "%8.4" FIX_AXIS_PAR 0 8 31 /end AXIS_DESCR
/end CHARACTERISTIC
/begin CHARACTERISTIC WLLPED "" VALUE 0x8FD90E KwUw 99.99847 relPED_uw_b100 0.00 99.99847 FORMAT "%8.5" /end CHARACTERISTIC
/begin CHARACTERISTIC ZBAKM "" CURVE 0x8E207C GklWUb 0.9961 fak_q0p0039 0.00 0.9961
 /begin AXIS_DESCR COM_AXIS tmot temp_ub_q0p75_o48 9 -48.00 143.3 FORMAT "%5.1" AXIS_PTS_REF STM09ESUB /end AXIS_DESCR
/end CHARACTERISTIC
/begin CHARACTERISTIC ZBALM "" CURVE 0x8E2085 GklWUb 0.1245 fak_ub_b0p125 0.00 0.1245 FORMAT "%6.4"
 /begin AXIS_DESCR COM_AXIS tmot temp_ub_q0p75_o48 9 -48.00 143.3 FORMAT "%5.1" AXIS_PTS_REF STM09ESUB /end AXIS_DESCR
/end CHARACTERISTIC
/begin CHARACTERISTIC ZBURNLIM "" VALUE 0x8FD043 KwUb 255.0 dez 0.00 255.0 FORMAT "%5.1" /end CHARACTERISTIC
/begin CHARACTERISTIC ZDFFDTE "" VALUE 0x8EEC5E KwUw 6553.4999985 zk100msxs_uw_b6553 0.10000152590 6553.6000000 FORMAT "%12.7" /end CHARACTERISTIC
/begin CHARACTERISTIC ZDGZA1 "" VALUE 0x8FCFD6 KwUb 255.0 dez 0.00 255.0 FORMAT "%5.1" /end CHARACTERISTIC
/begin CHARACTERISTIC ZDGZA2 "" VALUE 0x8FCFD7 KwUb 255.0 dez 0.00 255.0 FORMAT "%5.1" /end CHARACTERISTIC
/begin CHARACTERISTIC ZDGZA3 "" VALUE 0x8FCFD8 KwUb 255.0 dez 0.00 255.0 FORMAT "%5.1" /end CHARACTERISTIC
/begin CHARACTERISTIC ZFNMOT "" VALUE 0x8EEC60 KwUw 6553.4999985 zk100msxs_uw_b6553 0.10000152590 6553.6000000 FORMAT "%12.7" /end CHARACTERISTIC
/begin CHARACTERISTIC ZFRMFIL "" VALUE 0x8EEC62 KwUw 5.9069645603 zk100msxs_uw_b6553 0.10000152590 6.0069660862 FORMAT "%12.10" /end CHARACTERISTIC
/begin CHARACTERISTIC ZFRMXAF "" VALUE 0x8EEC64 KwUw 6553.4999985 zk100msxs_uw_b6553 0.10000152590 6553.6000000 FORMAT "%12.7" /end CHARACTERISTIC
/begin CHARACTERISTIC ZKPSFIL "" VALUE 0x8FE680 KwUw 655.34999985 zk10msxs_uw_b655 0.010000152590 655.36000000 FORMAT "%12.8" /end CHARACTERISTIC
/begin CHARACTERISTIC ZKRMSTEV "" VALUE 0x8EEC66 KwUw 60.024769116 zk100msxs_uw_b6553 0.10000152590 60.124770642 FORMAT "%12.9" /end CHARACTERISTIC
/begin CHARACTERISTIC ZMLETAN "" VALUE 0x8EEC68 KwUw 9.9054946573 zk100msxs_uw_b6553 0.10000152590 10.005496183 FORMAT "%12.9" /end CHARACTERISTIC
/begin CHARACTERISTIC ZMSTEDTE "" VALUE 0x8EEC6A KwUw 14.931191135 zk100msxs_uw_b6553 0.10000152590 15.031192661 FORMAT "%12.9" /end CHARACTERISTIC
/begin CHARACTERISTIC ZPWMCS "" VALUE 0x8E3FE6 KwUb 255.0 DEZ 0.00 255.0 FORMAT "%5.1" /end CHARACTERISTIC
/begin CHARACTERISTIC ZPWMCSMAX "" VALUE 0x8E3FE7 KwUb 255.0 DEZ 0.00 255.0 FORMAT "%5.1" /end CHARACTERISTIC
/begin CHARACTERISTIC ZRLTEDTE "" VALUE 0x8EEC6C KwUw 6553.4999985 zk100msxs_uw_b6553 0.10000152590 6553.6000000 FORMAT "%12.7" /end CHARACTERISTIC
/begin CHARACTERISTIC ZUKBAE "" VALUE 0x8FE712 KwUw 655.34999985 zk10msxs_uw_b655 0.010000152590 655.36000000 FORMAT "%12.8" /end CHARACTERISTIC
/begin CHARACTERISTIC ZUKNSTM "" CURVE 0x8EAB9E KlAUbSstUbWUw 6553.4999985 zk100msxs_uw_b6553 0.10000152590 6553.6000000 FORMAT "%12.7"
 /begin AXIS_DESCR STD_AXIS tmst temp_ub_q0p75_o48 9 -48.00 143.3 FORMAT "%5.1" DEPOSIT ABSOLUTE /end AXIS_DESCR
/end CHARACTERISTIC
/begin CHARACTERISTIC ZUKVAE "" VALUE 0x8FE714 KwUw 655.34999985 zk10msxs_uw_b655 0.010000152590 655.36000000 FORMAT "%12.8" /end CHARACTERISTIC
/begin CHARACTERISTIC ZVALM "" CURVE 0x8E208E GklWUb 0.1245 fak_ub_b0p125 0.00 0.1245 FORMAT "%6.4"
 /begin AXIS_DESCR COM_AXIS tmot temp_ub_q0p75_o48 9 -48.00 143.3 FORMAT "%5.1" AXIS_PTS_REF STM09ESUB /end AXIS_DESCR
/end CHARACTERISTIC
/begin CHARACTERISTIC ZZWEETM "" CURVE 0x8EA768 KlAUwSstUwWUw 65535.00 dez 0.00 65535.00 FORMAT "%8.2"
 /begin AXIS_DESCR STD_AXIS tmst temp_ub_q0p75_o48 8 -48.00 143.3 FORMAT "%5.1" DEPOSIT ABSOLUTE /end AXIS_DESCR
/end CHARACTERISTIC
/begin MEASUREMENT abak "" UBYTE fak_ub_b1 1 100 0.00 0.9961 ECU_ADDRESS 0xF40EE /end MEASUREMENT
/begin MEASUREMENT abr1_count "" UBYTE dez 1 100 0.00 255.0 FORMAT "%5.1" ECU_ADDRESS 0xF08CE /end MEASUREMENT
/begin MEASUREMENT anzfkuka "" UBYTE dez 1 100 0.00 255.0 FORMAT "%5.1" ECU_ADDRESS 0xF0917 /end MEASUREMENT
/begin MEASUREMENT anzfkuka2 "" UBYTE dez 1 100 0.00 255.0 FORMAT "%5.1" ECU_ADDRESS 0xF0918 /end MEASUREMENT
/begin MEASUREMENT anztip "" UBYTE dez 1 100 0.00 255.0 FORMAT "%5.1" ECU_ADDRESS 0xF089A /end MEASUREMENT
/begin MEASUREMENT anztipud "" SBYTE dez 1 100 -128.0 127.0 FORMAT "%5.1" ECU_ADDRESS 0xF089B /end MEASUREMENT
/begin MEASUREMENT anztis "" UBYTE dez 1 100 0.00 255.0 FORMAT "%5.1" ECU_ADDRESS 0xF0909 /end MEASUREMENT
/begin MEASUREMENT anzwefim "" UBYTE dez 1 100 0.00 255.0 FORMAT "%5.1" ECU_ADDRESS 0xF0900 /end MEASUREMENT
/begin MEASUREMENT apdtev "" UBYTE dez 1 100 0.00 255.0 FORMAT "%5.1" ECU_ADDRESS 0xF4179 /end MEASUREMENT
/begin MEASUREMENT aquer "" SBYTE acc_sb_q0p1 1 100 -12.80 12.70 FORMAT "%5.2" ECU_ADDRESS 0xF0649 /end MEASUREMENT
/begin MEASUREMENT avak "" UBYTE fak_ub_b1 1 100 0.00 0.9961 ECU_ADDRESS 0xF40EF /end MEASUREMENT
/begin MEASUREMENT avdtev "" UBYTE dez 1 100 0.00 255.0 FORMAT "%5.1" ECU_ADDRESS 0xF417A /end MEASUREMENT
/begin MEASUREMENT azpdtefre "" UBYTE dez 1 100 0.00 255.0 FORMAT "%5.1" ECU_ADDRESS 0xF417B /end MEASUREMENT
/begin MEASUREMENT azylwe "" UBYTE dez 1 100 0.00 255.0 FORMAT "%5.1" ECU_ADDRESS 0xF0901 /end MEASUREMENT
/begin MEASUREMENT bbwuc "" UBYTE dez 1 100 0.00 255.0 FORMAT "%5.1" ECU_ADDRESS 0xF06D2 /end MEASUREMENT
/begin MEASUREMENT bfgrsc "" UBYTE bfgrsc_ub_q0p024_o3p984 1 100 -3.984 2.136 FORMAT "%5.3" ECU_ADDRESS 0xF0655 /end MEASUREMENT
/begin MEASUREMENT bfgrs_w "" UWORD bfzg_uw_q4p239Em4 1 100 0.00 27.78029 FORMAT "%8.5" ECU_ADDRESS 0xF1BFC /end MEASUREMENT
/begin MEASUREMENT brafgr_w "" UWORD bfzg_uw_q4p239Em4 1 100 0.00 27.78029 FORMAT "%8.5" ECU_ADDRESS 0xF1BFE /end MEASUREMENT
/begin MEASUREMENT bswk_w "" SWORD nmotg_sw_b13p89 1 100 -13.88998 13.88956 FORMAT "%8.5" ECU_ADDRESS 0xF1C00 /end MEASUREMENT
/begin MEASUREMENT bz_diff "" UBYTE DEZ 1 100 0.00 255.0 FORMAT "%5.1" ECU_ADDRESS 0xF064A /end MEASUREMENT
/begin MEASUREMENT bz_gra "" UBYTE DEZ 1 100 0.00 255.0 FORMAT "%5.1" ECU_ADDRESS 0xF40BD /end MEASUREMENT
/begin MEASUREMENT bz_msr "" UBYTE DEZ 1 100 0.00 255.0 FORMAT "%5.1" ECU_ADDRESS 0xF064B /end MEASUREMENT
/begin MEASUREMENT B_aakuppl "" UBYTE B_TRUE 1 100 0.00 1.00000000000 BIT_MASK 0x4 FORMAT "%13.11" ECU_ADDRESS 0xF062D /end MEASUREMENT
/begin MEASUREMENT B_adrgra "" UWORD B_TRUE 1 100 0.00 1.00000000000 BIT_MASK 0x10 FORMAT "%13.11" ECU_ADDRESS 0xFD68 /end MEASUREMENT
/begin MEASUREMENT B_adrgra_z "" UBYTE B_TRUE 1 100 0.00 1.00000000000 BIT_MASK 0x80 FORMAT "%13.11" ECU_ADDRESS 0xF08A6 /end MEASUREMENT
/begin MEASUREMENT B_afwe "" UWORD B_TRUE 1 100 0.00 1.00000000000 BIT_MASK 0x40 FORMAT "%13.11" ECU_ADDRESS 0xFD7A /end MEASUREMENT
/begin MEASUREMENT B_airbag "" UWORD B_TRUE 1 100 0.00 1.00000000000 BIT_MASK 0x20 FORMAT "%13.11" ECU_ADDRESS 0xFDCE /end MEASUREMENT
/begin MEASUREMENT B_airbz "" UWORD B_TRUE 1 100 0.00 1.00000000000 BIT_MASK 0x40 FORMAT "%13.11" ECU_ADDRESS 0xFDCE /end MEASUREMENT
/begin MEASUREMENT B_airbz1 "" UWORD B_TRUE 1 100 0.00 1.00000000000 BIT_MASK 0x80 FORMAT "%13.11" ECU_ADDRESS 0xFDCE /end MEASUREMENT
/begin MEASUREMENT B_airbz2 "" UWORD B_TRUE 1 100 0.00 1.00000000000 BIT_MASK 0x100 FORMAT "%13.11" ECU_ADDRESS 0xFDCE /end MEASUREMENT
/begin MEASUREMENT B_amsren "" UWORD B_TRUE 1 100 0.00 1.00000000000 BIT_MASK 0x4000 FORMAT "%13.11" ECU_ADDRESS 0xFD1C /end MEASUREMENT
/begin MEASUREMENT B_amsrf "" UWORD B_TRUE 1 100 0.00 1.00000000000 BIT_MASK 0x800 FORMAT "%13.11" ECU_ADDRESS 0xFD1E /end MEASUREMENT
/begin MEASUREMENT B_amsrinpl "" UWORD B_TRUE 1 100 0.00 1.00000000000 BIT_MASK 0x1000 FORMAT "%13.11" ECU_ADDRESS 0xFD1E /end MEASUREMENT
/begin MEASUREMENT B_amsrknpl "" UWORD B_TRUE 1 100 0.00 1.00000000000 BIT_MASK 0x2000 FORMAT "%13.11" ECU_ADDRESS 0xFD1E /end MEASUREMENT
/begin MEASUREMENT B_amsrn "" UWORD B_TRUE 1 100 0.00 1.00000000000 BIT_MASK 0x4000 FORMAT "%13.11" ECU_ADDRESS 0xFD1E /end MEASUREMENT
/begin MEASUREMENT B_amsr_t "" UWORD B_TRUE 1 100 0.00 1.00000000000 BIT_MASK 0x8000 FORMAT "%13.11" ECU_ADDRESS 0xFD1C /end MEASUREMENT
/begin MEASUREMENT B_anlasc "" UWORD B_TRUE 1 100 0.00 1.00000000000 BIT_MASK 0x2000 FORMAT "%13.11" ECU_ADDRESS 0xFD20 /end MEASUREMENT
/begin MEASUREMENT B_anlfr "" UWORD B_TRUE 1 100 0.00 1.00000000000 BIT_MASK 0x4000 FORMAT "%13.11" ECU_ADDRESS 0xFD20 /end MEASUREMENT
/begin MEASUREMENT B_aquer "" UWORD B_TRUE 1 100 0.00 1.00000000000 BIT_MASK 0x8000 FORMAT "%13.11" ECU_ADDRESS 0xFD1E /end MEASUREMENT
/begin MEASUREMENT B_asent "" UWORD B_TRUE 1 100 0.00 1.00000000000 BIT_MASK 0x1 FORMAT "%13.11" ECU_ADDRESS 0x382EB4 /end MEASUREMENT
/begin MEASUREMENT B_asetl "" UWORD B_TRUE 1 100 0.00 1.00000000000 BIT_MASK 0x1 FORMAT "%13.11" ECU_ADDRESS 0x382EB6 /end MEASUREMENT
/begin MEASUREMENT B_asknt "" UWORD B_TRUE 1 100 0.00 1.00000000000 BIT_MASK 0x2 FORMAT "%13.11" ECU_ADDRESS 0x382EB4 /end MEASUREMENT
/begin MEASUREMENT B_asktl "" UWORD B_TRUE 1 100 0.00 1.00000000000 BIT_MASK 0x2 FORMAT "%13.11" ECU_ADDRESS 0x382EB6 /end MEASUREMENT
/begin MEASUREMENT B_asrakt "" UWORD B_TRUE 1 100 0.00 1.00000000000 BIT_MASK 0x1 FORMAT "%13.11" ECU_ADDRESS 0xFD20 /end MEASUREMENT
/begin MEASUREMENT B_atev "" UWORD B_TRUE 1 100 0.00 1.00000000000 BIT_MASK 0x1 FORMAT "%13.11" ECU_ADDRESS 0xFD68 /end MEASUREMENT
/begin MEASUREMENT B_ba "" UWORD B_TRUE 1 100 0.00 1.00000000000 BIT_MASK 0x8000 FORMAT "%13.11" ECU_ADDRESS 0xFD7A /end MEASUREMENT
/begin MEASUREMENT B_bag "" UWORD B_TRUE 1 100 0.00 1.00000000000 BIT_MASK 0x1 FORMAT "%13.11" ECU_ADDRESS 0xFD7C /end MEASUREMENT
/begin MEASUREMENT B_bkvv "" UWORD B_TRUE 1 100 0.00 1.00000000000 BIT_MASK 0x1 FORMAT "%13.11" ECU_ADDRESS 0xFD1E /end MEASUREMENT
/begin MEASUREMENT B_blc "" UBYTE B_TRUE 1 100 0.00 1.00000000000 BIT_MASK 0x2 FORMAT "%13.11" ECU_ADDRESS 0xF0659 /end MEASUREMENT
/begin MEASUREMENT B_br1en "" UWORD B_TRUE 1 100 0.00 1.00000000000 BIT_MASK 0x2 FORMAT "%13.11" ECU_ADDRESS 0xFD1E /end MEASUREMENT
/begin MEASUREMENT B_brc "" UBYTE B_TRUE 1 100 0.00 1.00000000000 BIT_MASK 0x4 FORMAT "%13.11" ECU_ADDRESS 0xF0659 /end MEASUREMENT
/begin MEASUREMENT B_bzge3 "" UBYTE B_TRUE 1 100 0.00 1.00000000000 BIT_MASK 0x1 FORMAT "%13.11" ECU_ADDRESS 0xF062E /end MEASUREMENT
/begin MEASUREMENT B_cdma "" UBYTE B_TRUE 1 100 0.00 1.00000000000 BIT_MASK 0x4 FORMAT "%13.11" ECU_ADDRESS 0xF065A /end MEASUREMENT
/begin MEASUREMENT B_cfgra "" UWORD B_TRUE 1 100 0.00 1.00000000000 BIT_MASK 0x20 FORMAT "%13.11" ECU_ADDRESS 0xFD68 /end MEASUREMENT
/begin MEASUREMENT B_cfkuka "" UWORD B_TRUE 1 100 0.00 1.00000000000 BIT_MASK 0x2000 FORMAT "%13.11" ECU_ADDRESS 0xFD80 /end MEASUREMENT
/begin MEASUREMENT B_cfkuka2 "" UWORD B_TRUE 1 100 0.00 1.00000000000 BIT_MASK 0x4000 FORMAT "%13.11" ECU_ADDRESS 0xFD80 /end MEASUREMENT
/begin MEASUREMENT B_cfuka "" UWORD B_TRUE 1 100 0.00 1.00000000000 BIT_MASK 0x8000 FORMAT "%13.11" ECU_ADDRESS 0xFD80 /end MEASUREMENT
/begin MEASUREMENT B_cfuka2 "" UWORD B_TRUE 1 100 0.00 1.00000000000 BIT_MASK 0x1 FORMAT "%13.11" ECU_ADDRESS 0xFD82 /end MEASUREMENT
/begin MEASUREMENT B_crcan "" UBYTE B_TRUE 1 100 0.00 1.00000000000 BIT_MASK 0x2 FORMAT "%13.11" ECU_ADDRESS 0x38214B /end MEASUREMENT
/begin MEASUREMENT B_crcan_20ms "" UWORD B_TRUE 1 100 0.00 1.00000000000 BIT_MASK 0x200 FORMAT "%13.11" ECU_ADDRESS 0xFDCE /end MEASUREMENT
/begin MEASUREMENT B_crnmn "" UBYTE B_TRUE 1 100 0.00 1.00000000000 BIT_MASK 0x8 FORMAT "%13.11" ECU_ADDRESS 0x38214B /end MEASUREMENT
/begin MEASUREMENT B_crstio "" UBYTE B_TRUE 1 100 0.00 1.00000000000 BIT_MASK 0x4 FORMAT "%13.11" ECU_ADDRESS 0x38214B /end MEASUREMENT
/begin MEASUREMENT B_csernpl "" UBYTE B_TRUE 1 100 0.00 1.00000000000 BIT_MASK 0x1 FORMAT "%13.11" ECU_ADDRESS 0xF0C9C /end MEASUREMENT
/begin MEASUREMENT B_csgra "" UWORD B_TRUE 1 100 0.00 1.00000000000 BIT_MASK 0x40 FORMAT "%13.11" ECU_ADDRESS 0xFD68 /end MEASUREMENT
/begin MEASUREMENT B_ctol "" UBYTE B_TRUE 1 100 0.00 1.00000000000 BIT_MASK 0x1 FORMAT "%13.11" ECU_ADDRESS 0xF064D /end MEASUREMENT
/begin MEASUREMENT B_ctole "" UBYTE B_TRUE 1 100 0.00 1.00000000000 BIT_MASK 0x2 FORMAT "%13.11" ECU_ADDRESS 0xF064D /end MEASUREMENT
/begin MEASUREMENT B_ctum "" UWORD B_TRUE 1 100 0.00 1.00000000000 BIT_MASK 0x800 FORMAT "%13.11" ECU_ADDRESS 0xFD20 /end MEASUREMENT
/begin MEASUREMENT B_ctume "" UWORD B_TRUE 1 100 0.00 1.00000000000 BIT_MASK 0x1000 FORMAT "%13.11" ECU_ADDRESS 0xFD20 /end MEASUREMENT
/begin MEASUREMENT B_cvtad "" UBYTE B_TRUE 1 100 0.00 1.00000000000 BIT_MASK 0x80 FORMAT "%13.11" ECU_ADDRESS 0xF062D /end MEASUREMENT
/begin MEASUREMENT B_dnmcan "" UBYTE B_TRUE 1 100 0.00 1.00000000000 BIT_MASK 0x1 FORMAT "%13.11" ECU_ADDRESS 0xF065A /end MEASUREMENT
/begin MEASUREMENT B_dteaa "" UWORD B_TRUE 1 100 0.00 1.00000000000 BIT_MASK 0x1000 FORMAT "%13.11" ECU_ADDRESS 0xFDBA /end MEASUREMENT
/begin MEASUREMENT B_dteaab "" UWORD B_TRUE 1 100 0.00 1.00000000000 BIT_MASK 0x2000 FORMAT "%13.11" ECU_ADDRESS 0xFDBA /end MEASUREMENT
/begin MEASUREMENT B_dteaam "" UWORD B_TRUE 1 100 0.00 1.00000000000 BIT_MASK 0x4000 FORMAT "%13.11" ECU_ADDRESS 0xFDBA /end MEASUREMENT
/begin MEASUREMENT B_dteabu "" UWORD B_TRUE 1 100 0.00 1.00000000000 BIT_MASK 0x8000 FORMAT "%13.11" ECU_ADDRESS 0xFDBA /end MEASUREMENT
/begin MEASUREMENT B_dteanfl "" UWORD B_TRUE 1 100 0.00 1.00000000000 BIT_MASK 0x1 FORMAT "%13.11" ECU_ADDRESS 0xFDBC /end MEASUREMENT
/begin MEASUREMENT B_dteend "" UWORD B_TRUE 1 100 0.00 1.00000000000 BIT_MASK 0x2 FORMAT "%13.11" ECU_ADDRESS 0xFDBC /end MEASUREMENT
/begin MEASUREMENT B_dteendl "" UWORD B_TRUE 1 100 0.00 1.00000000000 BIT_MASK 0x4 FORMAT "%13.11" ECU_ADDRESS 0xFDBC /end MEASUREMENT
/begin MEASUREMENT B_dteenf "" UWORD B_TRUE 1 100 0.00 1.00000000000 BIT_MASK 0x8 FORMAT "%13.11" ECU_ADDRESS 0xFDBC /end MEASUREMENT
/begin MEASUREMENT B_dtefre "" UWORD B_TRUE 1 100 0.00 1.00000000000 BIT_MASK 0x10 FORMAT "%13.11" ECU_ADDRESS 0xFDBC /end MEASUREMENT
/begin MEASUREMENT B_dtefrr "" UWORD B_TRUE 1 100 0.00 1.00000000000 BIT_MASK 0x20 FORMAT "%13.11" ECU_ADDRESS 0xFDBC /end MEASUREMENT
/begin MEASUREMENT B_dtelab "" UWORD B_TRUE 1 100 0.00 1.00000000000 BIT_MASK 0x40 FORMAT "%13.11" ECU_ADDRESS 0xFDBC /end MEASUREMENT
/begin MEASUREMENT B_dtelbm "" UWORD B_TRUE 1 100 0.00 1.00000000000 BIT_MASK 0x80 FORMAT "%13.11" ECU_ADDRESS 0xFDBC /end MEASUREMENT
/begin MEASUREMENT B_dtelbr "" UWORD B_TRUE 1 100 0.00 1.00000000000 BIT_MASK 0x100 FORMAT "%13.11" ECU_ADDRESS 0xFDBC /end MEASUREMENT
/begin MEASUREMENT B_dtelnm "" UWORD B_TRUE 1 100 0.00 1.00000000000 BIT_MASK 0x200 FORMAT "%13.11" ECU_ADDRESS 0xFDBC /end MEASUREMENT
/begin MEASUREMENT B_dtelnmb "" UWORD B_TRUE 1 100 0.00 1.00000000000 BIT_MASK 0x400 FORMAT "%13.11" ECU_ADDRESS 0xFDBC /end MEASUREMENT
/begin MEASUREMENT B_dtelnmv "" UWORD B_TRUE 1 100 0.00 1.00000000000 BIT_MASK 0x800 FORMAT "%13.11" ECU_ADDRESS 0xFDBC /end MEASUREMENT
/begin MEASUREMENT B_dtenam "" UWORD B_TRUE 1 100 0.00 1.00000000000 BIT_MASK 0x1000 FORMAT "%13.11" ECU_ADDRESS 0xFDBC /end MEASUREMENT
/begin MEASUREMENT B_dtephm "" UWORD B_TRUE 1 100 0.00 1.00000000000 BIT_MASK 0x2000 FORMAT "%13.11" ECU_ADDRESS 0xFDBC /end MEASUREMENT
/begin MEASUREMENT B_dtepm "" UWORD B_TRUE 1 100 0.00 1.00000000000 BIT_MASK 0x4000 FORMAT "%13.11" ECU_ADDRESS 0xFDBC /end MEASUREMENT
/begin MEASUREMENT B_dterab "" UWORD B_TRUE 1 100 0.00 1.00000000000 BIT_MASK 0x8000 FORMAT "%13.11" ECU_ADDRESS 0xFDBC /end MEASUREMENT
/begin MEASUREMENT B_dterap "" UWORD B_TRUE 1 100 0.00 1.00000000000 BIT_MASK 0x1 FORMAT "%13.11" ECU_ADDRESS 0xFDBE /end MEASUREMENT
/begin MEASUREMENT B_dteres "" UWORD B_TRUE 1 100 0.00 1.00000000000 BIT_MASK 0x2 FORMAT "%13.11" ECU_ADDRESS 0xFDBE /end MEASUREMENT
/begin MEASUREMENT B_dternm "" UWORD B_TRUE 1 100 0.00 1.00000000000 BIT_MASK 0x4 FORMAT "%13.11" ECU_ADDRESS 0xFDBE /end MEASUREMENT
/begin MEASUREMENT B_dtes "" UWORD B_TRUE 1 100 0.00 1.00000000000 BIT_MASK 0x8 FORMAT "%13.11" ECU_ADDRESS 0xFDBE /end MEASUREMENT
/begin MEASUREMENT B_dtest "" UWORD B_TRUE 1 100 0.00 1.00000000000 BIT_MASK 0x10 FORMAT "%13.11" ECU_ADDRESS 0xFDBE /end MEASUREMENT
/begin MEASUREMENT B_dtezam "" UWORD B_TRUE 1 100 0.00 1.00000000000 BIT_MASK 0x20 FORMAT "%13.11" ECU_ADDRESS 0xFDBE /end MEASUREMENT
/begin MEASUREMENT B_dufzok "" UBYTE B_TRUE 1 100 0.00 1.00000000000 BIT_MASK 0x1 FORMAT "%13.11" ECU_ADDRESS 0xF05A9 /end MEASUREMENT
/begin MEASUREMENT B_dwdksus "" UBYTE B_TRUE 1 100 0.00 1.00000000000 BIT_MASK 0x1 FORMAT "%13.11" ECU_ADDRESS 0xF08C2 /end MEASUREMENT
/begin MEASUREMENT B_ecfuka "" UWORD B_TRUE 1 100 0.00 1.00000000000 BIT_MASK 0x2 FORMAT "%13.11" ECU_ADDRESS 0xFD82 /end MEASUREMENT
/begin MEASUREMENT B_ecfuka2 "" UWORD B_TRUE 1 100 0.00 1.00000000000 BIT_MASK 0x4 FORMAT "%13.11" ECU_ADDRESS 0xFD82 /end MEASUREMENT
/begin MEASUREMENT B_ecudev "" UWORD B_TRUE 1 100 0.00 1.00000000000 BIT_MASK 0x100 FORMAT "%13.11" ECU_ADDRESS 0xFD8C /end MEASUREMENT
/begin MEASUREMENT B_elsxbb "" UBYTE B_TRUE 1 100 0.00 1.00000000000 BIT_MASK 0x2 FORMAT "%13.11" ECU_ADDRESS 0xF0B72 /end MEASUREMENT
/begin MEASUREMENT B_elsxbb2 "" UBYTE B_TRUE 1 100 0.00 1.00000000000 BIT_MASK 0x8 FORMAT "%13.11" ECU_ADDRESS 0xF0B72 /end MEASUREMENT
/begin MEASUREMENT B_epwmcs "" UBYTE B_TRUE 1 100 0.00 1.00000000000 BIT_MASK 0x8 FORMAT "%13.11" ECU_ADDRESS 0xF0C9C /end MEASUREMENT
/begin MEASUREMENT B_fawsp "" UWORD B_TRUE 1 100 0.00 1.00000000000 BIT_MASK 0x80 FORMAT "%13.11" ECU_ADDRESS 0xFD1A /end MEASUREMENT
/begin MEASUREMENT B_fdyfgr "" UWORD B_TRUE 1 100 0.00 1.00000000000 BIT_MASK 0x4 FORMAT "%13.11" ECU_ADDRESS 0xFD1E /end MEASUREMENT
/begin MEASUREMENT B_fgrab "" UWORD B_TRUE 1 100 0.00 1.00000000000 BIT_MASK 0x8 FORMAT "%13.11" ECU_ADDRESS 0xFD68 /end MEASUREMENT
/begin MEASUREMENT B_fgratc "" UWORD B_TRUE 1 100 0.00 1.00000000000 BIT_MASK 0x80 FORMAT "%13.11" ECU_ADDRESS 0xFD68 /end MEASUREMENT
/begin MEASUREMENT B_fgratc_z "" UBYTE B_TRUE 1 100 0.00 1.00000000000 BIT_MASK 0x2 FORMAT "%13.11" ECU_ADDRESS 0xF08A6 /end MEASUREMENT
/begin MEASUREMENT B_fgrbec "" UWORD B_TRUE 1 100 0.00 1.00000000000 BIT_MASK 0x100 FORMAT "%13.11" ECU_ADDRESS 0xFD68 /end MEASUREMENT
/begin MEASUREMENT B_fgrbec_z "" UBYTE B_TRUE 1 100 0.00 1.00000000000 BIT_MASK 0x20 FORMAT "%13.11" ECU_ADDRESS 0xF08A6 /end MEASUREMENT
/begin MEASUREMENT B_fgrdvi "" UBYTE B_TRUE 1 100 0.00 1.00000000000 BIT_MASK 0x1 FORMAT "%13.11" ECU_ADDRESS 0xF08A4 /end MEASUREMENT
/begin MEASUREMENT B_fgren "" UBYTE B_TRUE 1 100 0.00 1.00000000000 BIT_MASK 0x1 FORMAT "%13.11" ECU_ADDRESS 0xF08A3 /end MEASUREMENT
/begin MEASUREMENT B_fgrhec "" UWORD B_TRUE 1 100 0.00 1.00000000000 BIT_MASK 0x200 FORMAT "%13.11" ECU_ADDRESS 0xFD68 /end MEASUREMENT
/begin MEASUREMENT B_fgrhec_z "" UBYTE B_TRUE 1 100 0.00 1.00000000000 BIT_MASK 0x40 FORMAT "%13.11" ECU_ADDRESS 0xF08A6 /end MEASUREMENT
/begin MEASUREMENT B_fgrhsc "" UWORD B_TRUE 1 100 0.00 1.00000000000 BIT_MASK 0x400 FORMAT "%13.11" ECU_ADDRESS 0xFD68 /end MEASUREMENT
/begin MEASUREMENT B_fgrhsc_z "" UBYTE B_TRUE 1 100 0.00 1.00000000000 BIT_MASK 0x1 FORMAT "%13.11" ECU_ADDRESS 0xF08A6 /end MEASUREMENT
/begin MEASUREMENT B_fgrsec "" UWORD B_TRUE 1 100 0.00 1.00000000000 BIT_MASK 0x800 FORMAT "%13.11" ECU_ADDRESS 0xFD68 /end MEASUREMENT
/begin MEASUREMENT B_fgrsec_z "" UBYTE B_TRUE 1 100 0.00 1.00000000000 BIT_MASK 0x1 FORMAT "%13.11" ECU_ADDRESS 0xF08A7 /end MEASUREMENT
/begin MEASUREMENT B_fgrtdc "" UWORD B_TRUE 1 100 0.00 1.00000000000 BIT_MASK 0x1000 FORMAT "%13.11" ECU_ADDRESS 0xFD68 /end MEASUREMENT
/begin MEASUREMENT B_fgrtdc_z "" UBYTE B_TRUE 1 100 0.00 1.00000000000 BIT_MASK 0x4 FORMAT "%13.11" ECU_ADDRESS 0xF08A6 /end MEASUREMENT
/begin MEASUREMENT B_fgrthsc "" UWORD B_TRUE 1 100 0.00 1.00000000000 BIT_MASK 0x2000 FORMAT "%13.11" ECU_ADDRESS 0xFD68 /end MEASUREMENT
/begin MEASUREMENT B_fgrthsc_z "" UBYTE B_TRUE 1 100 0.00 1.00000000000 BIT_MASK 0x4 FORMAT "%13.11" ECU_ADDRESS 0xF08A7 /end MEASUREMENT
/begin MEASUREMENT B_fgrtuc "" UWORD B_TRUE 1 100 0.00 1.00000000000 BIT_MASK 0x4000 FORMAT "%13.11" ECU_ADDRESS 0xFD68 /end MEASUREMENT
/begin MEASUREMENT B_fgrtuc_z "" UBYTE B_TRUE 1 100 0.00 1.00000000000 BIT_MASK 0x8 FORMAT "%13.11" ECU_ADDRESS 0xF08A6 /end MEASUREMENT
/begin MEASUREMENT B_fgrvec "" UWORD B_TRUE 1 100 0.00 1.00000000000 BIT_MASK 0x8000 FORMAT "%13.11" ECU_ADDRESS 0xFD68 /end MEASUREMENT
/begin MEASUREMENT B_fgrvec_z "" UBYTE B_TRUE 1 100 0.00 1.00000000000 BIT_MASK 0x10 FORMAT "%13.11" ECU_ADDRESS 0xF08A6 /end MEASUREMENT
/begin MEASUREMENT B_fgrwac "" UWORD B_TRUE 1 100 0.00 1.00000000000 BIT_MASK 0x1 FORMAT "%13.11" ECU_ADDRESS 0xFD6A /end MEASUREMENT
/begin MEASUREMENT B_fgrwac_z "" UBYTE B_TRUE 1 100 0.00 1.00000000000 BIT_MASK 0x2 FORMAT "%13.11" ECU_ADDRESS 0xF08A7 /end MEASUREMENT
/begin MEASUREMENT B_first "" UWORD B_TRUE 1 100 0.00 1.00000000000 BIT_MASK 0x2000 FORMAT "%13.11" ECU_ADDRESS 0xF16EA /end MEASUREMENT
/begin MEASUREMENT B_fkmsdks "" UWORD B_TRUE 1 100 0.00 1.00000000000 BIT_MASK 0x20 FORMAT "%13.11" ECU_ADDRESS 0xFD6E /end MEASUREMENT
/begin MEASUREMENT B_fku "" UBYTE B_TRUE 1 100 0.00 1.00000000000 BIT_MASK 0x8 FORMAT "%13.11" ECU_ADDRESS 0xF062D /end MEASUREMENT
/begin MEASUREMENT B_fnsb1 "" UWORD B_TRUE 1 100 0.00 1.00000000000 BIT_MASK 0x1000 FORMAT "%13.11" ECU_ADDRESS 0xFD6E /end MEASUREMENT
/begin MEASUREMENT B_fnsb2 "" UWORD B_TRUE 1 100 0.00 1.00000000000 BIT_MASK 0x2000 FORMAT "%13.11" ECU_ADDRESS 0xFD6E /end MEASUREMENT
/begin MEASUREMENT B_fnsb3 "" UWORD B_TRUE 1 100 0.00 1.00000000000 BIT_MASK 0x4000 FORMAT "%13.11" ECU_ADDRESS 0xFD6E /end MEASUREMENT
/begin MEASUREMENT B_fnsoff "" UBYTE B_TRUE 1 100 0.00 1.00000000000 BIT_MASK 0x1 FORMAT "%13.11" ECU_ADDRESS 0xF08CF /end MEASUREMENT
/begin MEASUREMENT B_frao2nt "" UWORD B_TRUE 1 100 0.00 1.00000000000 BIT_MASK 0x80 FORMAT "%13.11" ECU_ADDRESS 0x382EB4 /end MEASUREMENT
/begin MEASUREMENT B_frao2tl "" UWORD B_TRUE 1 100 0.00 1.00000000000 BIT_MASK 0x80 FORMAT "%13.11" ECU_ADDRESS 0x382EB6 /end MEASUREMENT
/begin MEASUREMENT B_fraont "" UWORD B_TRUE 1 100 0.00 1.00000000000 BIT_MASK 0x40 FORMAT "%13.11" ECU_ADDRESS 0x382EB4 /end MEASUREMENT
/begin MEASUREMENT B_fraotl "" UWORD B_TRUE 1 100 0.00 1.00000000000 BIT_MASK 0x40 FORMAT "%13.11" ECU_ADDRESS 0x382EB6 /end MEASUREMENT
/begin MEASUREMENT B_frau2nt "" UWORD B_TRUE 1 100 0.00 1.00000000000 BIT_MASK 0x20 FORMAT "%13.11" ECU_ADDRESS 0x382EB4 /end MEASUREMENT
/begin MEASUREMENT B_frau2tl "" UWORD B_TRUE 1 100 0.00 1.00000000000 BIT_MASK 0x20 FORMAT "%13.11" ECU_ADDRESS 0x382EB6 /end MEASUREMENT
/begin MEASUREMENT B_fraunt "" UWORD B_TRUE 1 100 0.00 1.00000000000 BIT_MASK 0x10 FORMAT "%13.11" ECU_ADDRESS 0x382EB4 /end MEASUREMENT
/begin MEASUREMENT B_frautl "" UWORD B_TRUE 1 100 0.00 1.00000000000 BIT_MASK 0x10 FORMAT "%13.11" ECU_ADDRESS 0x382EB6 /end MEASUREMENT
/begin MEASUREMENT B_frgbs "" UBYTE B_TRUE 1 100 0.00 1.00000000000 BIT_MASK 0x1 FORMAT "%13.11" ECU_ADDRESS 0xF0899 /end MEASUREMENT
/begin MEASUREMENT B_ftedab "" UWORD B_TRUE 1 100 0.00 1.00000000000 BIT_MASK 0x40 FORMAT "%13.11" ECU_ADDRESS 0xFDBE /end MEASUREMENT
/begin MEASUREMENT B_furena "" UWORD B_TRUE 1 100 0.00 1.00000000000 BIT_MASK 0x4 FORMAT "%13.11" ECU_ADDRESS 0xFD6E /end MEASUREMENT
/begin MEASUREMENT B_furpen "" UWORD B_TRUE 1 100 0.00 1.00000000000 BIT_MASK 0x8 FORMAT "%13.11" ECU_ADDRESS 0xFD6E /end MEASUREMENT
/begin MEASUREMENT B_fwe "" UWORD B_TRUE 1 100 0.00 1.00000000000 BIT_MASK 0x80 FORMAT "%13.11" ECU_ADDRESS 0xFD7A /end MEASUREMENT
/begin MEASUREMENT B_gbst7err "" UWORD B_TRUE 1 100 0.00 1.00000000000 BIT_MASK 0x100 FORMAT "%13.11" ECU_ADDRESS 0xFD1A /end MEASUREMENT
/begin MEASUREMENT B_geco "" UBYTE B_TRUE 1 100 0.00 1.00000000000 BIT_MASK 0x2 FORMAT "%13.11" ECU_ADDRESS 0xF062D /end MEASUREMENT
/begin MEASUREMENT B_gekoa "" UBYTE B_TRUE 1 100 0.00 1.00000000000 BIT_MASK 0x4 FORMAT "%13.11" ECU_ADDRESS 0xF062C /end MEASUREMENT
/begin MEASUREMENT B_genlrc "" UBYTE B_TRUE 1 100 0.00 1.00000000000 BIT_MASK 0x8 FORMAT "%13.11" ECU_ADDRESS 0xF065A /end MEASUREMENT
/begin MEASUREMENT B_genlrc2 "" UBYTE B_TRUE 1 100 0.00 1.00000000000 BIT_MASK 0x10 FORMAT "%13.11" ECU_ADDRESS 0xF065A /end MEASUREMENT
/begin MEASUREMENT B_genot "" UBYTE B_TRUE 1 100 0.00 1.00000000000 BIT_MASK 0x10 FORMAT "%13.11" ECU_ADDRESS 0xF062C /end MEASUREMENT
/begin MEASUREMENT B_ges "" UBYTE B_TRUE 1 100 0.00 1.00000000000 BIT_MASK 0x2 FORMAT "%13.11" ECU_ADDRESS 0xF062C /end MEASUREMENT
/begin MEASUREMENT B_gess "" UWORD B_TRUE 1 100 0.00 1.00000000000 BIT_MASK 0x200 FORMAT "%13.11" ECU_ADDRESS 0xFD1A /end MEASUREMENT
/begin MEASUREMENT B_grabz "" UWORD B_TRUE 1 100 0.00 1.00000000000 BIT_MASK 0x2 FORMAT "%13.11" ECU_ADDRESS 0xFD6A /end MEASUREMENT
/begin MEASUREMENT B_grabz1 "" UWORD B_TRUE 1 100 0.00 1.00000000000 BIT_MASK 0x4 FORMAT "%13.11" ECU_ADDRESS 0xFD6A /end MEASUREMENT
/begin MEASUREMENT B_grabz2 "" UWORD B_TRUE 1 100 0.00 1.00000000000 BIT_MASK 0x8 FORMAT "%13.11" ECU_ADDRESS 0xFD6A /end MEASUREMENT
/begin MEASUREMENT B_gralc "" UBYTE B_TRUE 1 100 0.00 1.00000000000 BIT_MASK 0x2 FORMAT "%13.11" ECU_ADDRESS 0xF065A /end MEASUREMENT
/begin MEASUREMENT B_gsaf "" UWORD B_TRUE 1 100 0.00 1.00000000000 BIT_MASK 0x400 FORMAT "%13.11" ECU_ADDRESS 0xFD1A /end MEASUREMENT
/begin MEASUREMENT B_gsaf1 "" UBYTE B_TRUE 1 100 0.00 1.00000000000 BIT_MASK 0x8 FORMAT "%13.11" ECU_ADDRESS 0xF062C /end MEASUREMENT
/begin MEASUREMENT B_gsaf3 "" UWORD B_TRUE 1 100 0.00 1.00000000000 BIT_MASK 0x1000 FORMAT "%13.11" ECU_ADDRESS 0xFD1C /end MEASUREMENT
/begin MEASUREMENT B_gsala "" UWORD B_TRUE 1 100 0.00 1.00000000000 BIT_MASK 0x8000 FORMAT "%13.11" ECU_ADDRESS 0xFD20 /end MEASUREMENT
/begin MEASUREMENT B_gsch "" UBYTE B_TRUE 1 100 0.00 1.00000000000 BIT_MASK 0x1 FORMAT "%13.11" ECU_ADDRESS 0xF062C /end MEASUREMENT
/begin MEASUREMENT B_gsrzw "" UWORD B_TRUE 1 100 0.00 1.00000000000 BIT_MASK 0x800 FORMAT "%13.11" ECU_ADDRESS 0xFD1A /end MEASUREMENT
/begin MEASUREMENT B_gwhposg "" UWORD B_TRUE 1 100 0.00 1.00000000000 BIT_MASK 0x1000 FORMAT "%13.11" ECU_ADDRESS 0xFD1A /end MEASUREMENT
/begin MEASUREMENT B_heulsu "" UBYTE B_TRUE 1 100 0.00 1.00000000000 BIT_MASK 0x1 FORMAT "%13.11" ECU_ADDRESS 0xF409B /end MEASUREMENT
/begin MEASUREMENT B_heulsu2 "" UBYTE B_TRUE 1 100 0.00 1.00000000000 BIT_MASK 0x10 FORMAT "%13.11" ECU_ADDRESS 0xF409B /end MEASUREMENT
/begin MEASUREMENT B_hpwmcs "" UBYTE B_TRUE 1 100 0.00 1.00000000000 BIT_MASK 0x4 FORMAT "%13.11" ECU_ADDRESS 0xF0C9C /end MEASUREMENT
/begin MEASUREMENT B_hst "" UBYTE B_TRUE 1 100 0.00 1.00000000000 BIT_MASK 0x1 FORMAT "%13.11" ECU_ADDRESS 0x382065 /end MEASUREMENT
/begin MEASUREMENT B_kfvswk "" UBYTE B_TRUE 1 100 0.00 1.00000000000 BIT_MASK 0x1 FORMAT "%13.11" ECU_ADDRESS 0xF089C /end MEASUREMENT
/begin MEASUREMENT B_kfvswkb "" UBYTE B_TRUE 1 100 0.00 1.00000000000 BIT_MASK 0x2 FORMAT "%13.11" ECU_ADDRESS 0xF089C /end MEASUREMENT
/begin MEASUREMENT B_kfvswkv "" UBYTE B_TRUE 1 100 0.00 1.00000000000 BIT_MASK 0x4 FORMAT "%13.11" ECU_ADDRESS 0xF089C /end MEASUREMENT
/begin MEASUREMENT B_kfwee "" UWORD B_TRUE 1 100 0.00 1.00000000000 BIT_MASK 0x2000 FORMAT "%13.11" ECU_ADDRESS 0xFD70 /end MEASUREMENT
/begin MEASUREMENT B_kl15sp "" UWORD B_TRUE 1 100 0.00 1.00000000000 BIT_MASK 0x1 FORMAT "%13.11" ECU_ADDRESS 0xFD22 /end MEASUREMENT
/begin MEASUREMENT B_klafbg "" UBYTE B_TRUE 1 100 0.00 1.00000000000 BIT_MASK 0x2 FORMAT "%13.11" ECU_ADDRESS 0xF08C2 /end MEASUREMENT
/begin MEASUREMENT B_llped "" UBYTE B_TRUE 1 100 0.00 1.00000000000 BIT_MASK 0x1 FORMAT "%13.11" ECU_ADDRESS 0xF0658 /end MEASUREMENT
/begin MEASUREMENT B_llvfgr "" UBYTE B_TRUE 1 100 0.00 1.00000000000 BIT_MASK 0x2 FORMAT "%13.11" ECU_ADDRESS 0xF08A3 /end MEASUREMENT
/begin MEASUREMENT B_luft "" UBYTE B_TRUE 1 100 0.00 1.00000000000 BIT_MASK 0x4 FORMAT "%13.11" ECU_ADDRESS 0xF409B /end MEASUREMENT
/begin MEASUREMENT B_luft2 "" UBYTE B_TRUE 1 100 0.00 1.00000000000 BIT_MASK 0x40 FORMAT "%13.11" ECU_ADDRESS 0xF409B /end MEASUREMENT
/begin MEASUREMENT B_mdmxge "" UWORD B_TRUE 1 100 0.00 1.00000000000 BIT_MASK 0x8000 FORMAT "%13.11" ECU_ADDRESS 0xFD1A /end MEASUREMENT
/begin MEASUREMENT B_mdwaner "" UWORD B_TRUE 1 100 0.00 1.00000000000 BIT_MASK 0x1 FORMAT "%13.11" ECU_ADDRESS 0xFD1C /end MEASUREMENT
/begin MEASUREMENT B_mfact "" UBYTE B_TRUE 1 100 0.00 1.00000000000 BIT_MASK 0x4 FORMAT "%13.11" ECU_ADDRESS 0xF08C2 /end MEASUREMENT
/begin MEASUREMENT B_mgbget "" UWORD B_TRUE 1 100 0.00 1.00000000000 BIT_MASK 0x2 FORMAT "%13.11" ECU_ADDRESS 0xFD1C /end MEASUREMENT
/begin MEASUREMENT B_miecges "" UWORD B_TRUE 1 100 0.00 1.00000000000 BIT_MASK 0x4 FORMAT "%13.11" ECU_ADDRESS 0xFD1C /end MEASUREMENT
/begin MEASUREMENT B_milfb "" UBYTE B_TRUE 1 100 0.00 1.00000000000 BIT_MASK 0x1 FORMAT "%13.11" ECU_ADDRESS 0x38201E /end MEASUREMENT
/begin MEASUREMENT B_milfbg "" UBYTE B_TRUE 1 100 0.00 1.00000000000 BIT_MASK 0x20 FORMAT "%13.11" ECU_ADDRESS 0xF062C /end MEASUREMENT
/begin MEASUREMENT B_motaus "" UBYTE B_TRUE 1 100 0.00 1.00000000000 BIT_MASK 0x40 FORMAT "%13.11" ECU_ADDRESS 0xF062C /end MEASUREMENT
/begin MEASUREMENT B_mrfamx "" UWORD B_TRUE 1 100 0.00 1.00000000000 BIT_MASK 0x4000 FORMAT "%13.11" ECU_ADDRESS 0xFD70 /end MEASUREMENT
/begin MEASUREMENT B_mshlon "" UWORD B_TRUE 1 100 0.00 1.00000000000 BIT_MASK 0x2 FORMAT "%13.11" ECU_ADDRESS 0xFD22 /end MEASUREMENT
/begin MEASUREMENT B_msrakt "" UWORD B_TRUE 1 100 0.00 1.00000000000 BIT_MASK 0x2 FORMAT "%13.11" ECU_ADDRESS 0xFD20 /end MEASUREMENT
/begin MEASUREMENT B_msrdis "" UWORD B_TRUE 1 100 0.00 1.00000000000 BIT_MASK 0x8 FORMAT "%13.11" ECU_ADDRESS 0xFD1E /end MEASUREMENT
/begin MEASUREMENT B_msrphnpl "" UWORD B_TRUE 1 100 0.00 1.00000000000 BIT_MASK 0x4 FORMAT "%13.11" ECU_ADDRESS 0xFD20 /end MEASUREMENT
/begin MEASUREMENT B_msrtnpl "" UWORD B_TRUE 1 100 0.00 1.00000000000 BIT_MASK 0x8 FORMAT "%13.11" ECU_ADDRESS 0xFD20 /end MEASUREMENT
/begin MEASUREMENT B_msrvnpl "" UWORD B_TRUE 1 100 0.00 1.00000000000 BIT_MASK 0x10 FORMAT "%13.11" ECU_ADDRESS 0xFD20 /end MEASUREMENT
/begin MEASUREMENT B_negra "" UWORD B_TRUE 1 100 0.00 1.00000000000 BIT_MASK 0x10 FORMAT "%13.11" ECU_ADDRESS 0xFD6A /end MEASUREMENT
/begin MEASUREMENT B_nlebem1 "" UBYTE B_TRUE 1 100 0.00 1.00000000000 BIT_MASK 0x20 FORMAT "%13.11" ECU_ADDRESS 0xF065A /end MEASUREMENT
/begin MEASUREMENT B_nlebem2 "" UBYTE B_TRUE 1 100 0.00 1.00000000000 BIT_MASK 0x40 FORMAT "%13.11" ECU_ADDRESS 0xF065A /end MEASUREMENT
/begin MEASUREMENT B_nmaxge "" UWORD B_TRUE 1 100 0.00 1.00000000000 BIT_MASK 0x8 FORMAT "%13.11" ECU_ADDRESS 0xFD1C /end MEASUREMENT
/begin MEASUREMENT B_nomsr_fr "" UWORD B_TRUE 1 100 0.00 1.00000000000 BIT_MASK 0x20 FORMAT "%13.11" ECU_ADDRESS 0xFD20 /end MEASUREMENT
/begin MEASUREMENT B_nomsr_t "" UWORD B_TRUE 1 100 0.00 1.00000000000 BIT_MASK 0x40 FORMAT "%13.11" ECU_ADDRESS 0xFD20 /end MEASUREMENT
/begin MEASUREMENT B_nowuc "" UWORD B_TRUE 1 100 0.00 1.00000000000 BIT_MASK 0x2000 FORMAT "%13.11" ECU_ADDRESS 0xFD3C /end MEASUREMENT
/begin MEASUREMENT B_ntal "" UWORD B_TRUE 1 100 0.00 1.00000000000 BIT_MASK 0x800 FORMAT "%13.11" ECU_ADDRESS 0xFD3E /end MEASUREMENT
/begin MEASUREMENT B_nugra "" UWORD B_TRUE 1 100 0.00 1.00000000000 BIT_MASK 0x20 FORMAT "%13.11" ECU_ADDRESS 0xFD6A /end MEASUREMENT
/begin MEASUREMENT B_pwmcs "" UBYTE B_TRUE 1 100 0.00 1.00000000000 BIT_MASK 0x1 FORMAT "%13.11" ECU_ADDRESS 0x38214B /end MEASUREMENT
/begin MEASUREMENT B_pwmcs_50ms "" UWORD B_TRUE 1 100 0.00 1.00000000000 BIT_MASK 0x400 FORMAT "%13.11" ECU_ADDRESS 0xFDCE /end MEASUREMENT
/begin MEASUREMENT B_pwmfcs "" UWORD B_TRUE 1 100 0.00 1.00000000000 BIT_MASK 0x800 FORMAT "%13.11" ECU_ADDRESS 0xFDCE /end MEASUREMENT
/begin MEASUREMENT B_redkl "" UWORD B_TRUE 1 100 0.00 1.00000000000 BIT_MASK 0x2 FORMAT "%13.11" ECU_ADDRESS 0xFD7C /end MEASUREMENT
/begin MEASUREMENT B_rengra "" UWORD B_TRUE 1 100 0.00 1.00000000000 BIT_MASK 0x40 FORMAT "%13.11" ECU_ADDRESS 0xFD6A /end MEASUREMENT
/begin MEASUREMENT B_rfkuka "" UWORD B_TRUE 1 100 0.00 1.00000000000 BIT_MASK 0x8 FORMAT "%13.11" ECU_ADDRESS 0xFD82 /end MEASUREMENT
/begin MEASUREMENT B_rfkuka2 "" UWORD B_TRUE 1 100 0.00 1.00000000000 BIT_MASK 0x10 FORMAT "%13.11" ECU_ADDRESS 0xFD82 /end MEASUREMENT
/begin MEASUREMENT B_rkat2nt "" UWORD B_TRUE 1 100 0.00 1.00000000000 BIT_MASK 0x8 FORMAT "%13.11" ECU_ADDRESS 0x382EB4 /end MEASUREMENT
/begin MEASUREMENT B_rkat2tl "" UWORD B_TRUE 1 100 0.00 1.00000000000 BIT_MASK 0x8 FORMAT "%13.11" ECU_ADDRESS 0x382EB6 /end MEASUREMENT
/begin MEASUREMENT B_rkatnt "" UWORD B_TRUE 1 100 0.00 1.00000000000 BIT_MASK 0x4 FORMAT "%13.11" ECU_ADDRESS 0x382EB4 /end MEASUREMENT
/begin MEASUREMENT B_rkattl "" UWORD B_TRUE 1 100 0.00 1.00000000000 BIT_MASK 0x4 FORMAT "%13.11" ECU_ADDRESS 0x382EB6 /end MEASUREMENT
/begin MEASUREMENT B_rkaz2nt "" UWORD B_TRUE 1 100 0.00 1.00000000000 BIT_MASK 0x200 FORMAT "%13.11" ECU_ADDRESS 0x382EB4 /end MEASUREMENT
/begin MEASUREMENT B_rkaz2tl "" UWORD B_TRUE 1 100 0.00 1.00000000000 BIT_MASK 0x200 FORMAT "%13.11" ECU_ADDRESS 0x382EB6 /end MEASUREMENT
/begin MEASUREMENT B_rkaznt "" UWORD B_TRUE 1 100 0.00 1.00000000000 BIT_MASK 0x100 FORMAT "%13.11" ECU_ADDRESS 0x382EB4 /end MEASUREMENT
/begin MEASUREMENT B_rkaztl "" UWORD B_TRUE 1 100 0.00 1.00000000000 BIT_MASK 0x100 FORMAT "%13.11" ECU_ADDRESS 0x382EB6 /end MEASUREMENT
/begin MEASUREMENT B_rmsval "" UBYTE B_TRUE 1 100 0.00 1.00000000000 BIT_MASK 0x1 FORMAT "%13.11" ECU_ADDRESS 0x382148 /end MEASUREMENT
/begin MEASUREMENT B_sacvt "" UBYTE B_TRUE 1 100 0.00 1.00000000000 BIT_MASK 0x1 FORMAT "%13.11" ECU_ADDRESS 0xF062D /end MEASUREMENT
/begin MEASUREMENT B_savfgr "" UBYTE B_TRUE 1 100 0.00 1.00000000000 BIT_MASK 0x4 FORMAT "%13.11" ECU_ADDRESS 0xF08A3 /end MEASUREMENT
/begin MEASUREMENT B_savmsr "" UWORD B_TRUE 1 100 0.00 1.00000000000 BIT_MASK 0x80 FORMAT "%13.11" ECU_ADDRESS 0xFD20 /end MEASUREMENT
/begin MEASUREMENT B_sbblsu "" UBYTE B_TRUE 1 100 0.00 1.00000000000 BIT_MASK 0x1 FORMAT "%13.11" ECU_ADDRESS 0xF0B72 /end MEASUREMENT
/begin MEASUREMENT B_sbblsu2 "" UBYTE B_TRUE 1 100 0.00 1.00000000000 BIT_MASK 0x4 FORMAT "%13.11" ECU_ADDRESS 0xF0B72 /end MEASUREMENT
/begin MEASUREMENT B_second "" UWORD B_TRUE 1 100 0.00 1.00000000000 BIT_MASK 0x4000 FORMAT "%13.11" ECU_ADDRESS 0xF16EA /end MEASUREMENT
/begin MEASUREMENT B_sp1_old "" UWORD B_TRUE 1 100 0.00 1.00000000000 BIT_MASK 0x8000 FORMAT "%13.11" ECU_ADDRESS 0xF16EA /end MEASUREMENT
/begin MEASUREMENT B_statbr "" UBYTE B_TRUE 1 100 0.00 1.00000000000 BIT_MASK 0x80 FORMAT "%13.11" ECU_ADDRESS 0xF0658 /end MEASUREMENT
/begin MEASUREMENT B_statge "" UBYTE B_TRUE 1 100 0.00 1.00000000000 BIT_MASK 0x8 FORMAT "%13.11" ECU_ADDRESS 0xF0658 /end MEASUREMENT
/begin MEASUREMENT B_statgec "" UBYTE B_TRUE 1 100 0.00 1.00000000000 BIT_MASK 0x8 FORMAT "%13.11" ECU_ADDRESS 0xF0659 /end MEASUREMENT
/begin MEASUREMENT B_statmd "" UBYTE B_TRUE 1 100 0.00 1.00000000000 BIT_MASK 0x2 FORMAT "%13.11" ECU_ADDRESS 0xF0658 /end MEASUREMENT
/begin MEASUREMENT B_statmdc "" UBYTE B_TRUE 1 100 0.00 1.00000000000 BIT_MASK 0x4 FORMAT "%13.11" ECU_ADDRESS 0xF0658 /end MEASUREMENT
/begin MEASUREMENT B_statme "" UBYTE B_TRUE 1 100 0.00 1.00000000000 BIT_MASK 0x20 FORMAT "%13.11" ECU_ADDRESS 0xF0658 /end MEASUREMENT
/begin MEASUREMENT B_statme_t "" UBYTE B_TRUE 1 100 0.00 1.00000000000 BIT_MASK 0x40 FORMAT "%13.11" ECU_ADDRESS 0xF0658 /end MEASUREMENT
/begin MEASUREMENT B_statnb "" UBYTE B_TRUE 1 100 0.00 1.00000000000 BIT_MASK 0x1 FORMAT "%13.11" ECU_ADDRESS 0xF0659 /end MEASUREMENT
/begin MEASUREMENT B_statto "" UBYTE B_TRUE 1 100 0.00 1.00000000000 BIT_MASK 0x1 FORMAT "%13.11" ECU_ADDRESS 0xF065B /end MEASUREMENT
/begin MEASUREMENT B_stattoc "" UBYTE B_TRUE 1 100 0.00 1.00000000000 BIT_MASK 0x10 FORMAT "%13.11" ECU_ADDRESS 0xF0658 /end MEASUREMENT
/begin MEASUREMENT B_stendes "" UWORD B_TRUE 1 100 0.00 1.00000000000 BIT_MASK 0x200 FORMAT "%13.11" ECU_ADDRESS 0xFD76 /end MEASUREMENT
/begin MEASUREMENT B_stndfr "" UWORD B_TRUE 1 100 0.00 1.00000000000 BIT_MASK 0x10 FORMAT "%13.11" ECU_ADDRESS 0xFD6E /end MEASUREMENT
/begin MEASUREMENT B_swe_b "" UWORD B_TRUE 1 100 0.00 1.00000000000 BIT_MASK 0x10 FORMAT "%13.11" ECU_ADDRESS 0xFD1E /end MEASUREMENT
/begin MEASUREMENT B_tairmx "" UWORD B_TRUE 1 100 0.00 1.00000000000 BIT_MASK 0x1000 FORMAT "%13.11" ECU_ADDRESS 0xFDCE /end MEASUREMENT
/begin MEASUREMENT B_tairnu "" UWORD B_TRUE 1 100 0.00 1.00000000000 BIT_MASK 0x2000 FORMAT "%13.11" ECU_ADDRESS 0xFDCE /end MEASUREMENT
/begin MEASUREMENT B_tal01 "" UWORD B_TRUE 1 100 0.00 1.00000000000 BIT_MASK 0x1000 FORMAT "%13.11" ECU_ADDRESS 0xF16EA /end MEASUREMENT
/begin MEASUREMENT B_tal_old "" UWORD B_TRUE 1 100 0.00 1.00000000000 BIT_MASK 0x800 FORMAT "%13.11" ECU_ADDRESS 0xF16EA /end MEASUREMENT
/begin MEASUREMENT B_tcrcan "" UWORD B_TRUE 1 100 0.00 1.00000000000 BIT_MASK 0x4000 FORMAT "%13.11" ECU_ADDRESS 0xFDCE /end MEASUREMENT
/begin MEASUREMENT B_teviol "" UWORD B_TRUE 1 100 0.00 1.00000000000 BIT_MASK 0x80 FORMAT "%13.11" ECU_ADDRESS 0xFDBE /end MEASUREMENT
/begin MEASUREMENT B_teviolm "" UWORD B_TRUE 1 100 0.00 1.00000000000 BIT_MASK 0x100 FORMAT "%13.11" ECU_ADDRESS 0xFDBE /end MEASUREMENT
/begin MEASUREMENT B_teviop "" UWORD B_TRUE 1 100 0.00 1.00000000000 BIT_MASK 0x200 FORMAT "%13.11" ECU_ADDRESS 0xFDBE /end MEASUREMENT
/begin MEASUREMENT B_tevior "" UWORD B_TRUE 1 100 0.00 1.00000000000 BIT_MASK 0x400 FORMAT "%13.11" ECU_ADDRESS 0xFDBE /end MEASUREMENT
/begin MEASUREMENT B_tevnio "" UWORD B_TRUE 1 100 0.00 1.00000000000 BIT_MASK 0x800 FORMAT "%13.11" ECU_ADDRESS 0xFDBE /end MEASUREMENT
/begin MEASUREMENT B_tevniom "" UWORD B_TRUE 1 100 0.00 1.00000000000 BIT_MASK 0x1000 FORMAT "%13.11" ECU_ADDRESS 0xFDBE /end MEASUREMENT
/begin MEASUREMENT B_tgramx "" UWORD B_TRUE 1 100 0.00 1.00000000000 BIT_MASK 0x80 FORMAT "%13.11" ECU_ADDRESS 0xFD6A /end MEASUREMENT
/begin MEASUREMENT B_tgranu "" UWORD B_TRUE 1 100 0.00 1.00000000000 BIT_MASK 0x100 FORMAT "%13.11" ECU_ADDRESS 0xFD6A /end MEASUREMENT
/begin MEASUREMENT B_tippg "" UWORD B_TRUE 1 100 0.00 1.00000000000 BIT_MASK 0x10 FORMAT "%13.11" ECU_ADDRESS 0xFD1C /end MEASUREMENT
/begin MEASUREMENT B_tmnuka "" UWORD B_TRUE 1 100 0.00 1.00000000000 BIT_MASK 0x20 FORMAT "%13.11" ECU_ADDRESS 0xFD82 /end MEASUREMENT
/begin MEASUREMENT B_tolueb "" UBYTE B_TRUE 1 100 0.00 1.00000000000 BIT_MASK 0x2 FORMAT "%13.11" ECU_ADDRESS 0xF065B /end MEASUREMENT
/begin MEASUREMENT B_tpderl "" UBYTE B_TRUE 1 100 0.00 1.00000000000 BIT_MASK 0x8 FORMAT "%13.11" ECU_ADDRESS 0xF089C /end MEASUREMENT
/begin MEASUREMENT B_tpuerl "" UBYTE B_TRUE 1 100 0.00 1.00000000000 BIT_MASK 0x10 FORMAT "%13.11" ECU_ADDRESS 0xF089C /end MEASUREMENT
/begin MEASUREMENT B_trqmin "" UWORD B_TRUE 1 100 0.00 1.00000000000 BIT_MASK 0x20 FORMAT "%13.11" ECU_ADDRESS 0xFD1C /end MEASUREMENT
/begin MEASUREMENT B_tspuuka "" UWORD B_TRUE 1 100 0.00 1.00000000000 BIT_MASK 0x40 FORMAT "%13.11" ECU_ADDRESS 0xFD82 /end MEASUREMENT
/begin MEASUREMENT B_tspuuka2 "" UWORD B_TRUE 1 100 0.00 1.00000000000 BIT_MASK 0x80 FORMAT "%13.11" ECU_ADDRESS 0xFD82 /end MEASUREMENT
/begin MEASUREMENT B_tumanst "" UBYTE B_TRUE 1 100 0.00 1.00000000000 BIT_MASK 0x1 FORMAT "%13.11" ECU_ADDRESS 0xF0BBA /end MEASUREMENT
/begin MEASUREMENT B_uefge3 "" UBYTE B_TRUE 1 100 0.00 1.00000000000 BIT_MASK 0x2 FORMAT "%13.11" ECU_ADDRESS 0xF062E /end MEASUREMENT
/begin MEASUREMENT B_ugds "" UBYTE B_TRUE 1 100 0.00 1.00000000000 BIT_MASK 0x8 FORMAT "%13.11" ECU_ADDRESS 0xF08C2 /end MEASUREMENT
/begin MEASUREMENT B_uk1 "" UWORD B_TRUE 1 100 0.00 1.00000000000 BIT_MASK 0x4 FORMAT "%13.11" ECU_ADDRESS 0xFD7C /end MEASUREMENT
/begin MEASUREMENT B_uka "" UWORD B_TRUE 1 100 0.00 1.00000000000 BIT_MASK 0x100 FORMAT "%13.11" ECU_ADDRESS 0xFD82 /end MEASUREMENT
/begin MEASUREMENT B_uka2 "" UWORD B_TRUE 1 100 0.00 1.00000000000 BIT_MASK 0x200 FORMAT "%13.11" ECU_ADDRESS 0xFD82 /end MEASUREMENT
/begin MEASUREMENT B_ukab "" UWORD B_TRUE 1 100 0.00 1.00000000000 BIT_MASK 0x400 FORMAT "%13.11" ECU_ADDRESS 0xFD82 /end MEASUREMENT
/begin MEASUREMENT B_ukabat "" UWORD B_TRUE 1 100 0.00 1.00000000000 BIT_MASK 0x800 FORMAT "%13.11" ECU_ADDRESS 0xFD82 /end MEASUREMENT
/begin MEASUREMENT B_ukaukat "" UWORD B_TRUE 1 100 0.00 1.00000000000 BIT_MASK 0x1000 FORMAT "%13.11" ECU_ADDRESS 0xFD82 /end MEASUREMENT
/begin MEASUREMENT B_ukauket "" UWORD B_TRUE 1 100 0.00 1.00000000000 BIT_MASK 0x2000 FORMAT "%13.11" ECU_ADDRESS 0xFD82 /end MEASUREMENT
/begin MEASUREMENT B_ukavat "" UWORD B_TRUE 1 100 0.00 1.00000000000 BIT_MASK 0x4000 FORMAT "%13.11" ECU_ADDRESS 0xFD82 /end MEASUREMENT
/begin MEASUREMENT B_uke "" UWORD B_TRUE 1 100 0.00 1.00000000000 BIT_MASK 0x8 FORMAT "%13.11" ECU_ADDRESS 0xFD7C /end MEASUREMENT
/begin MEASUREMENT B_ukg "" UWORD B_TRUE 1 100 0.00 1.00000000000 BIT_MASK 0x10 FORMAT "%13.11" ECU_ADDRESS 0xFD7C /end MEASUREMENT
/begin MEASUREMENT B_ukk "" UWORD B_TRUE 1 100 0.00 1.00000000000 BIT_MASK 0x20 FORMAT "%13.11" ECU_ADDRESS 0xFD7C /end MEASUREMENT
/begin MEASUREMENT B_ukns "" UWORD B_TRUE 1 100 0.00 1.00000000000 BIT_MASK 0x40 FORMAT "%13.11" ECU_ADDRESS 0xFD7C /end MEASUREMENT
/begin MEASUREMENT B_va "" UWORD B_TRUE 1 100 0.00 1.00000000000 BIT_MASK 0x80 FORMAT "%13.11" ECU_ADDRESS 0xFD7C /end MEASUREMENT
/begin MEASUREMENT B_vaau "" UWORD B_TRUE 1 100 0.00 1.00000000000 BIT_MASK 0x100 FORMAT "%13.11" ECU_ADDRESS 0xFD7C /end MEASUREMENT
/begin MEASUREMENT B_vabsff "" UWORD B_TRUE 1 100 0.00 1.00000000000 BIT_MASK 0x20 FORMAT "%13.11" ECU_ADDRESS 0xFD1E /end MEASUREMENT
/begin MEASUREMENT B_vag "" UWORD B_TRUE 1 100 0.00 1.00000000000 BIT_MASK 0x200 FORMAT "%13.11" ECU_ADDRESS 0xFD7C /end MEASUREMENT
/begin MEASUREMENT B_vagsl "" UWORD B_TRUE 1 100 0.00 1.00000000000 BIT_MASK 0x40 FORMAT "%13.11" ECU_ADDRESS 0xFD1C /end MEASUREMENT
/begin MEASUREMENT B_vak "" UWORD B_TRUE 1 100 0.00 1.00000000000 BIT_MASK 0x400 FORMAT "%13.11" ECU_ADDRESS 0xFD7C /end MEASUREMENT
/begin MEASUREMENT B_vakl "" UWORD B_TRUE 1 100 0.00 1.00000000000 BIT_MASK 0x800 FORMAT "%13.11" ECU_ADDRESS 0xFD7C /end MEASUREMENT
/begin MEASUREMENT B_val "" UWORD B_TRUE 1 100 0.00 1.00000000000 BIT_MASK 0x1000 FORMAT "%13.11" ECU_ADDRESS 0xFD7C /end MEASUREMENT
/begin MEASUREMENT B_vbemg "" UWORD B_TRUE 1 100 0.00 1.00000000000 BIT_MASK 0x400 FORMAT "%13.11" ECU_ADDRESS 0xFD76 /end MEASUREMENT
/begin MEASUREMENT B_vbmg "" UWORD B_TRUE 1 100 0.00 1.00000000000 BIT_MASK 0x800 FORMAT "%13.11" ECU_ADDRESS 0xFD76 /end MEASUREMENT
/begin MEASUREMENT B_vluft "" UBYTE B_TRUE 1 100 0.00 1.00000000000 BIT_MASK 0x2 FORMAT "%13.11" ECU_ADDRESS 0xF409B /end MEASUREMENT
/begin MEASUREMENT B_vluft2 "" UBYTE B_TRUE 1 100 0.00 1.00000000000 BIT_MASK 0x20 FORMAT "%13.11" ECU_ADDRESS 0xF409B /end MEASUREMENT
/begin MEASUREMENT B_vradhlff "" UWORD B_TRUE 1 100 0.00 1.00000000000 BIT_MASK 0x40 FORMAT "%13.11" ECU_ADDRESS 0xFD1E /end MEASUREMENT
/begin MEASUREMENT B_vradhrff "" UWORD B_TRUE 1 100 0.00 1.00000000000 BIT_MASK 0x80 FORMAT "%13.11" ECU_ADDRESS 0xFD1E /end MEASUREMENT
/begin MEASUREMENT B_vradvlff "" UWORD B_TRUE 1 100 0.00 1.00000000000 BIT_MASK 0x100 FORMAT "%13.11" ECU_ADDRESS 0xFD1E /end MEASUREMENT
/begin MEASUREMENT B_vradvrff "" UWORD B_TRUE 1 100 0.00 1.00000000000 BIT_MASK 0x200 FORMAT "%13.11" ECU_ADDRESS 0xFD1E /end MEASUREMENT
/begin MEASUREMENT B_wdkap "" UBYTE B_TRUE 1 100 0.00 1.00000000000 BIT_MASK 0x10 FORMAT "%13.11" ECU_ADDRESS 0xF08C2 /end MEASUREMENT
/begin MEASUREMENT B_wf "" UWORD B_TRUE 1 100 0.00 1.00000000000 BIT_MASK 0x2000 FORMAT "%13.11" ECU_ADDRESS 0xFD7C /end MEASUREMENT
/begin MEASUREMENT B_wk "" UWORD B_TRUE 1 100 0.00 1.00000000000 BIT_MASK 0x80 FORMAT "%13.11" ECU_ADDRESS 0xFD1C /end MEASUREMENT
/begin MEASUREMENT B_wkauf "" UWORD B_TRUE 1 100 0.00 1.00000000000 BIT_MASK 0x100 FORMAT "%13.11" ECU_ADDRESS 0xFD1C /end MEASUREMENT
/begin MEASUREMENT B_wkr "" UWORD B_TRUE 1 100 0.00 1.00000000000 BIT_MASK 0x200 FORMAT "%13.11" ECU_ADDRESS 0xFD1C /end MEASUREMENT
/begin MEASUREMENT B_wks "" UWORD B_TRUE 1 100 0.00 1.00000000000 BIT_MASK 0x1000 FORMAT "%13.11" ECU_ADDRESS 0xFD76 /end MEASUREMENT
/begin MEASUREMENT B_wst "" UWORD B_TRUE 1 100 0.00 1.00000000000 BIT_MASK 0x2000 FORMAT "%13.11" ECU_ADDRESS 0xFD76 /end MEASUREMENT
/begin MEASUREMENT B_wst0 "" UBYTE B_TRUE 1 100 0.00 1.00000000000 BIT_MASK 0x2 FORMAT "%13.11" ECU_ADDRESS 0x382065 /end MEASUREMENT
/begin MEASUREMENT B_wst1 "" UWORD B_TRUE 1 100 0.00 1.00000000000 BIT_MASK 0x4000 FORMAT "%13.11" ECU_ADDRESS 0xFD76 /end MEASUREMENT
/begin MEASUREMENT B_wst2 "" UWORD B_TRUE 1 100 0.00 1.00000000000 BIT_MASK 0x8000 FORMAT "%13.11" ECU_ADDRESS 0xFD76 /end MEASUREMENT
/begin MEASUREMENT B_wuc "" UBYTE B_TRUE 1 100 0.00 1.00000000000 BIT_MASK 0x1 FORMAT "%13.11" ECU_ADDRESS 0xF06D2 /end MEASUREMENT
/begin MEASUREMENT B_zges "" UWORD B_TRUE 1 100 0.00 1.00000000000 BIT_MASK 0x2000 FORMAT "%13.11" ECU_ADDRESS 0xFD1C /end MEASUREMENT
/begin MEASUREMENT B_zgezw "" UWORD B_TRUE 1 100 0.00 1.00000000000 BIT_MASK 0x400 FORMAT "%13.11" ECU_ADDRESS 0xFD1C /end MEASUREMENT
/begin MEASUREMENT B_ztev "" UWORD B_TRUE 1 100 0.00 1.00000000000 BIT_MASK 0x2 FORMAT "%13.11" ECU_ADDRESS 0xFD68 /end MEASUREMENT
/begin MEASUREMENT crshDetect "" UBYTE DEZ 1 100 0.00 255.0 FORMAT "%5.1" ECU_ADDRESS 0xF0C9B /end MEASUREMENT
/begin MEASUREMENT cserk "" UBYTE DEZ 1 100 0.00 255.0 FORMAT "%5.1" ECU_ADDRESS 0x38214A /end MEASUREMENT
/begin MEASUREMENT cs_gra "" UBYTE DEZ 1 100 0.00 255.0 FORMAT "%5.1" ECU_ADDRESS 0xF40BE /end MEASUREMENT
/begin MEASUREMENT ctfgrab "" UBYTE t20msxs_ub_b5p1 1 100 0.00 5.100 FORMAT "%5.3" ECU_ADDRESS 0xF08A2 /end MEASUREMENT
/begin MEASUREMENT ctol "" UBYTE temp_ub_q1_o60 1 100 -60.00 195.0 FORMAT "%5.1" ECU_ADDRESS 0xF064C /end MEASUREMENT
/begin MEASUREMENT ctum "" UBYTE temp_ub_q0p75_o48 1 100 -48.00 143.3 FORMAT "%5.1" ECU_ADDRESS 0xF4021 /end MEASUREMENT
/begin MEASUREMENT detazwte "" UBYTE rel_ub_b127p5 1 100 0.00 127.5 FORMAT "%5.1" ECU_ADDRESS 0xF417C /end MEASUREMENT
/begin MEASUREMENT dkldfpwm_w "" SWORD rel_sw_b100 1 100 -100.0000 99.99695 FORMAT "%8.4" ECU_ADDRESS 0xF4F0C /end MEASUREMENT
/begin MEASUREMENT dmletanf_w "" SWORD m_q0p0031 1 100 -102.4000 102.3969 FORMAT "%8.4" ECU_ADDRESS 0xF4F0E /end MEASUREMENT
/begin MEASUREMENT dmletanu "" UBYTE m_q0p1 1 100 0.00 25.50 FORMAT "%5.2" ECU_ADDRESS 0xF417D /end MEASUREMENT
/begin MEASUREMENT dmletan_w "" SWORD m_q0p0031 1 100 -102.4000 102.3969 FORMAT "%8.4" ECU_ADDRESS 0xF4F10 /end MEASUREMENT
/begin MEASUREMENT dmrar_w "" UWORD rel_uw_b200 1 100 0.00 199.9969 FORMAT "%8.4" ECU_ADDRESS 0xF1C0A /end MEASUREMENT
/begin MEASUREMENT dmsnte_w "" SWORD m_q0p1 1 100 -3276.800 3276.700 FORMAT "%8.3" ECU_ADDRESS 0xF4F12 /end MEASUREMENT
/begin MEASUREMENT dnmcan "" UBYTE dez 1 100 0.00 255.0 FORMAT "%5.1" ECU_ADDRESS 0xF0656 /end MEASUREMENT
/begin MEASUREMENT drkuke_w "" UWORD rel_uw_q0p0234 1 100 0.00 1535.977 FORMAT "%8.3" ECU_ADDRESS 0xF2006 /end MEASUREMENT
/begin MEASUREMENT drlfuei_w "" SWORD rel_sw_q0p0234 1 100 -768.0000 767.9766 FORMAT "%8.4" ECU_ADDRESS 0xF1D50 /end MEASUREMENT
/begin MEASUREMENT drlfuep_w "" SWORD rel_sw_q0p0234 1 100 -768.0000 767.9766 FORMAT "%8.4" ECU_ADDRESS 0xF1D52 /end MEASUREMENT
/begin MEASUREMENT drlfue_w "" SWORD rel_sw_q0p0234 1 100 -768.0000 767.9766 FORMAT "%8.4" ECU_ADDRESS 0xF1D54 /end MEASUREMENT
/begin MEASUREMENT drlm_w "" SWORD rel_sw_q0p0234 1 100 -768.0000 767.9766 FORMAT "%8.4" ECU_ADDRESS 0xF1D56 /end MEASUREMENT
/begin MEASUREMENT drlsolmf_w "" UWORD rel_uw_q0p0234 1 100 0.00 1535.977 FORMAT "%8.3" ECU_ADDRESS 0xF1D60 /end MEASUREMENT
/begin MEASUREMENT DTEVNonVolbits "" UBYTE dez 1 100 0.00 255.0 FORMAT "%5.1" ECU_ADDRESS 0x382148 /end MEASUREMENT
/begin MEASUREMENT dufLokBits1 "" UBYTE dez 1 100 0.00 255.0 FORMAT "%5.1" ECU_ADDRESS 0xF05A9 /end MEASUREMENT
/begin MEASUREMENT duf_c "" UBYTE t100msxs_ub_b25p5 1 100 0.00 25.50 FORMAT "%5.2" ECU_ADDRESS 0xF05AA /end MEASUREMENT
/begin MEASUREMENT durnprst_c "" UBYTE dez 1 100 0.00 255.0 FORMAT "%5.1" ECU_ADDRESS 0x382014 /end MEASUREMENT
/begin MEASUREMENT dvfgr_w "" SWORD vfzg_sw_q0p00781 1 100 -256.0000 255.9922 FORMAT "%8.4" ECU_ADDRESS 0xF1C0C /end MEASUREMENT
/begin MEASUREMENT dvivr_w "" UWORD vfzg_uw_q0p00781 1 100 0.00 511.9922 FORMAT "%8.4" ECU_ADDRESS 0xF1C0E /end MEASUREMENT
/begin MEASUREMENT dvzi_w "" UWORD vfzg_uw_q0p0078125 1 100 0.00 511.9922 FORMAT "%8.4" ECU_ADDRESS 0xF1C02 /end MEASUREMENT
/begin MEASUREMENT dvzvi_w "" SWORD vfzg_sw_q0p00781 1 100 -256.0000 255.9922 FORMAT "%8.4" ECU_ADDRESS 0xF1C10 /end MEASUREMENT
/begin MEASUREMENT dwdksumx_w "" UWORD rel_uw_b100 1 100 0.00 99.99847 FORMAT "%8.5" ECU_ADDRESS 0xF4614 /end MEASUREMENT
/begin MEASUREMENT dwdksus_w "" UWORD rel_uw_b100 1 100 0.00 99.99847 FORMAT "%8.5" ECU_ADDRESS 0xF1D62 /end MEASUREMENT
/begin MEASUREMENT dwdks_w "" UWORD relDK_uw_b100 1 100 0.00 100.0000 FORMAT "%8.4" ECU_ADDRESS 0xF1DE4 /end MEASUREMENT
/begin MEASUREMENT dwfk_w "" SWORD rel_q0p09375 1 100 -3072.000 3071.906 FORMAT "%8.3" ECU_ADDRESS 0xF2008 /end MEASUREMENT
/begin MEASUREMENT dwfl_w "" SWORD rel_q0p09375 1 100 -3072.000 3071.906 FORMAT "%8.3" ECU_ADDRESS 0xF200A /end MEASUREMENT
/begin MEASUREMENT dwf_w "" SWORD rel_q0p09375 1 100 -3072.000 3071.906 FORMAT "%8.3" ECU_ADDRESS 0xF200C /end MEASUREMENT
/begin MEASUREMENT dzuhlzl "" UBYTE dez 1 100 0.00 255.0 FORMAT "%5.1" ARRAY_SIZE 8 ECU_ADDRESS 0xF0859 /end MEASUREMENT
/begin MEASUREMENT dzuksmszl "" UBYTE dez 1 100 0.00 255.0 FORMAT "%5.1" ARRAY_SIZE 8 ECU_ADDRESS 0xF0861 /end MEASUREMENT
/begin MEASUREMENT dzuksubzl "" UBYTE dez 1 100 0.00 255.0 FORMAT "%5.1" ARRAY_SIZE 8 ECU_ADDRESS 0xF0869 /end MEASUREMENT
/begin MEASUREMENT dzusigzl "" UBYTE dez 1 100 0.00 255.0 FORMAT "%5.1" ARRAY_SIZE 8 ECU_ADDRESS 0xF0871 /end MEASUREMENT
/begin MEASUREMENT egaspfad "" UBYTE dez 1 100 0.00 255.0 FORMAT "%5.1" ECU_ADDRESS 0xF05AB /end MEASUREMENT
/begin MEASUREMENT ESSTTbits "" UBYTE dez 1 100 0.00 255.0 FORMAT "%5.1" ECU_ADDRESS 0x382065 /end MEASUREMENT
/begin MEASUREMENT esst_snm08gkuw "" UWORD dez 1 100 0.00 65535.00 FORMAT "%8.2" ECU_ADDRESS 0xF1E8C /end MEASUREMENT
/begin MEASUREMENT esst_srl08gkub "" UWORD dez 1 100 0.00 65535.00 FORMAT "%8.2" ECU_ADDRESS 0xF1E8E /end MEASUREMENT
/begin MEASUREMENT etazwif "" UBYTE rel_ub_b127p5 1 100 0.00 127.5 FORMAT "%5.1" ECU_ADDRESS 0xF417E /end MEASUREMENT
/begin MEASUREMENT etazwkte "" UBYTE rel_ub_b127p5 1 100 0.00 127.5 FORMAT "%5.1" ECU_ADDRESS 0xF417F /end MEASUREMENT
/begin MEASUREMENT E_ase_fsp "" UWORD B_TRUE 1 100 0.00 1.00000000000 BIT_MASK 0x2 FORMAT "%13.11" ECU_ADDRESS 0xF16EC /end MEASUREMENT
/begin MEASUREMENT E_ase_old "" UWORD B_TRUE 1 100 0.00 1.00000000000 BIT_MASK 0x2 FORMAT "%13.11" ECU_ADDRESS 0xF16EA /end MEASUREMENT
/begin MEASUREMENT E_ask_fsp "" UWORD B_TRUE 1 100 0.00 1.00000000000 BIT_MASK 0x1 FORMAT "%13.11" ECU_ADDRESS 0xF16EC /end MEASUREMENT
/begin MEASUREMENT E_ask_old "" UWORD B_TRUE 1 100 0.00 1.00000000000 BIT_MASK 0x1 FORMAT "%13.11" ECU_ADDRESS 0xF16EA /end MEASUREMENT
/begin MEASUREMENT E_frao2_fsp "" UWORD B_TRUE 1 100 0.00 1.00000000000 BIT_MASK 0x80 FORMAT "%13.11" ECU_ADDRESS 0xF16EC /end MEASUREMENT
/begin MEASUREMENT E_frao2_old "" UWORD B_TRUE 1 100 0.00 1.00000000000 BIT_MASK 0x80 FORMAT "%13.11" ECU_ADDRESS 0xF16EA /end MEASUREMENT
/begin MEASUREMENT E_frao_fsp "" UWORD B_TRUE 1 100 0.00 1.00000000000 BIT_MASK 0x40 FORMAT "%13.11" ECU_ADDRESS 0xF16EC /end MEASUREMENT
/begin MEASUREMENT E_frao_old "" UWORD B_TRUE 1 100 0.00 1.00000000000 BIT_MASK 0x40 FORMAT "%13.11" ECU_ADDRESS 0xF16EA /end MEASUREMENT
/begin MEASUREMENT E_frau2_fsp "" UWORD B_TRUE 1 100 0.00 1.00000000000 BIT_MASK 0x20 FORMAT "%13.11" ECU_ADDRESS 0xF16EC /end MEASUREMENT
/begin MEASUREMENT E_frau2_old "" UWORD B_TRUE 1 100 0.00 1.00000000000 BIT_MASK 0x20 FORMAT "%13.11" ECU_ADDRESS 0xF16EA /end MEASUREMENT
/begin MEASUREMENT E_frau_fsp "" UWORD B_TRUE 1 100 0.00 1.00000000000 BIT_MASK 0x10 FORMAT "%13.11" ECU_ADDRESS 0xF16EC /end MEASUREMENT
/begin MEASUREMENT E_frau_old "" UWORD B_TRUE 1 100 0.00 1.00000000000 BIT_MASK 0x10 FORMAT "%13.11" ECU_ADDRESS 0xF16EA /end MEASUREMENT
/begin MEASUREMENT E_rkat2_fsp "" UWORD B_TRUE 1 100 0.00 1.00000000000 BIT_MASK 0x8 FORMAT "%13.11" ECU_ADDRESS 0xF16EC /end MEASUREMENT
/begin MEASUREMENT E_rkat2_old "" UWORD B_TRUE 1 100 0.00 1.00000000000 BIT_MASK 0x8 FORMAT "%13.11" ECU_ADDRESS 0xF16EA /end MEASUREMENT
/begin MEASUREMENT E_rkat_fsp "" UWORD B_TRUE 1 100 0.00 1.00000000000 BIT_MASK 0x4 FORMAT "%13.11" ECU_ADDRESS 0xF16EC /end MEASUREMENT
/begin MEASUREMENT E_rkat_old "" UWORD B_TRUE 1 100 0.00 1.00000000000 BIT_MASK 0x4 FORMAT "%13.11" ECU_ADDRESS 0xF16EA /end MEASUREMENT
/begin MEASUREMENT E_rkaz2_fsp "" UWORD B_TRUE 1 100 0.00 1.00000000000 BIT_MASK 0x200 FORMAT "%13.11" ECU_ADDRESS 0xF16EC /end MEASUREMENT
/begin MEASUREMENT E_rkaz2_old "" UWORD B_TRUE 1 100 0.00 1.00000000000 BIT_MASK 0x200 FORMAT "%13.11" ECU_ADDRESS 0xF16EA /end MEASUREMENT
/begin MEASUREMENT E_rkaz_fsp "" UWORD B_TRUE 1 100 0.00 1.00000000000 BIT_MASK 0x100 FORMAT "%13.11" ECU_ADDRESS 0xF16EC /end MEASUREMENT
/begin MEASUREMENT E_rkaz_old "" UWORD B_TRUE 1 100 0.00 1.00000000000 BIT_MASK 0x100 FORMAT "%13.11" ECU_ADDRESS 0xF16EA /end MEASUREMENT
/begin MEASUREMENT E_tankl_old "" UWORD B_TRUE 1 100 0.00 1.00000000000 BIT_MASK 0x400 FORMAT "%13.11" ECU_ADDRESS 0xF16EA /end MEASUREMENT
/begin MEASUREMENT fbakl_w "" SWORD fak_sw_b256 1 100 -256.0000 255.9922 FORMAT "%8.4" ECU_ADDRESS 0xF467E /end MEASUREMENT
/begin MEASUREMENT fbakstaa "" UBYTE fak_ub_b2 1 100 0.00 1.992 FORMAT "%5.3" ECU_ADDRESS 0xF40F0 /end MEASUREMENT
/begin MEASUREMENT fbans "" UBYTE fak_ub_b8 1 100 0.00 7.969 FORMAT "%5.3" ECU_ADDRESS 0xF40F1 /end MEASUREMENT
/begin MEASUREMENT fbansini_w "" UWORD fak_uw_b8 1 100 0.00 7.999878 FORMAT "%8.6" ECU_ADDRESS 0xF4680 /end MEASUREMENT
/begin MEASUREMENT fbavst_w "" SWORD fak_sw_b256 1 100 -256.0000 255.9922 FORMAT "%8.4" ECU_ADDRESS 0xF4682 /end MEASUREMENT
/begin MEASUREMENT ffzdfp "" UBYTE dez 1 100 0.00 255.0 FORMAT "%5.1" ECU_ADDRESS 0xF06D1 /end MEASUREMENT
/begin MEASUREMENT fgrbesilokbits "" UBYTE dez 1 100 0.00 255.0 FORMAT "%5.1" ECU_ADDRESS 0xF0899 /end MEASUREMENT
/begin MEASUREMENT fgrfulolokbits "" UBYTE dez 1 100 0.00 255.0 FORMAT "%5.1" ECU_ADDRESS 0xF089C /end MEASUREMENT
/begin MEASUREMENT fgrreglausbits "" UBYTE dez 1 100 0.00 255.0 FORMAT "%5.1" ECU_ADDRESS 0xF08A3 /end MEASUREMENT
/begin MEASUREMENT fgrregllokbits "" UBYTE dez 1 100 0.00 255.0 FORMAT "%5.1" ECU_ADDRESS 0xF08A4 /end MEASUREMENT
/begin MEASUREMENT fgrscodc "" UBYTE DEZ 1 100 0.00 255.0 FORMAT "%5.1" ECU_ADDRESS 0xF08A5 /end MEASUREMENT
/begin MEASUREMENT fgru "" UBYTE fak_ub_b2 1 100 0.00 1.992 FORMAT "%5.3" ECU_ADDRESS 0xF40DE /end MEASUREMENT
/begin MEASUREMENT fklafs_w "" UWORD fak_uw_b1 1 100 0.00 0.9999847 FORMAT "%9.7" ECU_ADDRESS 0xF1D64 /end MEASUREMENT
/begin MEASUREMENT fktns_w "" UWORD fak_uw_b16 1 100 0.00 15.99976 FORMAT "%8.5" ECU_ADDRESS 0xF1E14 /end MEASUREMENT
/begin MEASUREMENT fkukaba2_w "" UWORD fak_uw_b4 1 100 0.00 3.999939 FORMAT "%8.6" ECU_ADDRESS 0xF2076 /end MEASUREMENT
/begin MEASUREMENT fkukaba_w "" UWORD fak_uw_b4 1 100 0.00 3.999939 FORMAT "%8.6" ECU_ADDRESS 0xF2078 /end MEASUREMENT
/begin MEASUREMENT fkukas2_w "" UWORD fak_q0p0625 1 100 0.00 4095.938 FORMAT "%8.3" ECU_ADDRESS 0xF207A /end MEASUREMENT
/begin MEASUREMENT fkukas_w "" UWORD fak_q0p0625 1 100 0.00 4095.938 FORMAT "%8.3" ECU_ADDRESS 0xF207C /end MEASUREMENT
/begin MEASUREMENT fkukava2_w "" UWORD fak_uw_b4 1 100 0.00 3.999939 FORMAT "%8.6" ECU_ADDRESS 0xF207E /end MEASUREMENT
/begin MEASUREMENT fkukava_w "" UWORD fak_uw_b4 1 100 0.00 3.999939 FORMAT "%8.6" ECU_ADDRESS 0xF2080 /end MEASUREMENT
/begin MEASUREMENT flamrua2_w "" UWORD fak_uw_b16 1 100 0.00 15.99976 FORMAT "%8.5" ECU_ADDRESS 0xF2082 /end MEASUREMENT
/begin MEASUREMENT flamrua_w "" UWORD fak_uw_b16 1 100 0.00 15.99976 FORMAT "%8.5" ECU_ADDRESS 0xF2084 /end MEASUREMENT
/begin MEASUREMENT flamsba_w "" UWORD fak_uw_b16 1 100 0.00 15.99976 FORMAT "%8.5" ECU_ADDRESS 0xF46D4 /end MEASUREMENT
/begin MEASUREMENT flamsbg_w "" UWORD fak_uw_b2 1 100 0.00 1.999969 FORMAT "%8.6" ECU_ADDRESS 0xF200E /end MEASUREMENT
/begin MEASUREMENT flamsva_w "" UWORD fak_uw_b16 1 100 0.00 15.99976 FORMAT "%8.5" ECU_ADDRESS 0xF46D6 /end MEASUREMENT
/begin MEASUREMENT fnmes0 "" UBYTE fak_ub_b2 1 100 0.00 1.992 FORMAT "%5.3" ECU_ADDRESS 0xE180 /end MEASUREMENT
/begin MEASUREMENT fnmes1 "" UBYTE fak_ub_b2 1 100 0.00 1.992 FORMAT "%5.3" ECU_ADDRESS 0xE181 /end MEASUREMENT
/begin MEASUREMENT fnmes2 "" UBYTE fak_ub_b2 1 100 0.00 1.992 FORMAT "%5.3" ECU_ADDRESS 0xE182 /end MEASUREMENT
/begin MEASUREMENT fnmes3 "" UBYTE fak_ub_b2 1 100 0.00 1.992 FORMAT "%5.3" ECU_ADDRESS 0xE183 /end MEASUREMENT
/begin MEASUREMENT fnmes4 "" UBYTE fak_ub_b2 1 100 0.00 1.992 FORMAT "%5.3" ECU_ADDRESS 0xE184 /end MEASUREMENT
/begin MEASUREMENT fnmes5 "" UBYTE fak_ub_b2 1 100 0.00 1.992 FORMAT "%5.3" ECU_ADDRESS 0xE185 /end MEASUREMENT
/begin MEASUREMENT fnswlst_w "" UWORD fak_uw_b16 1 100 0.00 15.99976 FORMAT "%8.5" ECU_ADDRESS 0xF1E16 /end MEASUREMENT
/begin MEASUREMENT fnswl_w "" UWORD fak_uw_b16 1 100 0.00 15.99976 FORMAT "%8.5" ECU_ADDRESS 0xF1E18 /end MEASUREMENT
/begin MEASUREMENT fns_w "" UWORD fak_uw_b16 1 100 0.00 15.99976 FORMAT "%8.5" ECU_ADDRESS 0xF1E1A /end MEASUREMENT
/begin MEASUREMENT frdter_w "" UWORD fak_uw_b2 1 100 0.00 1.999969 FORMAT "%8.6" ECU_ADDRESS 0xF4F14 /end MEASUREMENT
/begin MEASUREMENT frmfdif_w "" SWORD fak_sw_b1 1 100 -1.000000 0.9999695 FORMAT "%8.6" ECU_ADDRESS 0xF4F16 /end MEASUREMENT
/begin MEASUREMENT frmfref_w "" UWORD fak_uw_b2 1 100 0.00 1.999969 FORMAT "%8.6" ECU_ADDRESS 0xF4F18 /end MEASUREMENT
/begin MEASUREMENT frmitf_w "" UWORD fak_uw_b2 1 100 0.00 1.999969 FORMAT "%8.6" ECU_ADDRESS 0xF4F1A /end MEASUREMENT
/begin MEASUREMENT frmxaf_w "" UWORD fak_uw_b2 1 100 0.00 1.999969 FORMAT "%8.6" ECU_ADDRESS 0xF4F1C /end MEASUREMENT
/begin MEASUREMENT fst0_w "" UWORD fak_uw_b64 1 100 0.00 63.99902 FORMAT "%8.5" ECU_ADDRESS 0xF1FBA /end MEASUREMENT
/begin MEASUREMENT fst_w "" UWORD fak_uw_b64 1 100 0.00 63.99902 FORMAT "%8.5" ECU_ADDRESS 0xF1FBC /end MEASUREMENT
/begin MEASUREMENT fthozs_w "" UWORD fak_uw_b2 1 100 0.00 1.999969 FORMAT "%8.6" ECU_ADDRESS 0xF4F1E /end MEASUREMENT
/begin MEASUREMENT ftineo_w "" UWORD fak_uw_b2 1 100 0.00 1.999969 FORMAT "%8.6" ECU_ADDRESS 0xF2010 /end MEASUREMENT
/begin MEASUREMENT fuedkLocalBits "" UBYTE dez 1 100 0.00 255.0 FORMAT "%5.1" ECU_ADDRESS 0xF08C2 /end MEASUREMENT
/begin MEASUREMENT fukabak_w "" UWORD fak_uw_b4 1 100 0.00 3.999939 FORMAT "%8.6" ECU_ADDRESS 0x382F1A /end MEASUREMENT
/begin MEASUREMENT fukabaw_w "" UWORD fak_uw_b4 1 100 0.00 3.999939 FORMAT "%8.6" ECU_ADDRESS 0x382F1C /end MEASUREMENT
/begin MEASUREMENT fukaba_w "" UWORD fak_uw_b4 1 100 0.00 3.999939 FORMAT "%8.6" ECU_ADDRESS 0xF46D8 /end MEASUREMENT
/begin MEASUREMENT fukavak_w "" UWORD fak_uw_b4 1 100 0.00 3.999939 FORMAT "%8.6" ECU_ADDRESS 0x382F1E /end MEASUREMENT
/begin MEASUREMENT fukavaw_w "" UWORD fak_uw_b4 1 100 0.00 3.999939 FORMAT "%8.6" ECU_ADDRESS 0x382F20 /end MEASUREMENT
/begin MEASUREMENT fukava_w "" UWORD fak_uw_b4 1 100 0.00 3.999939 FORMAT "%8.6" ECU_ADDRESS 0xF46DA /end MEASUREMENT
/begin MEASUREMENT fvaklw_w "" SWORD fak_sw_b256 1 100 -256.0000 255.9922 FORMAT "%8.4" ECU_ADDRESS 0xF2012 /end MEASUREMENT
/begin MEASUREMENT fvakl_w "" SWORD fak_sw_b256 1 100 -256.0000 255.9922 FORMAT "%8.4" ECU_ADDRESS 0xF4684 /end MEASUREMENT
/begin MEASUREMENT fvaladif "" UBYTE fak_ub_b1 1 100 0.00 0.9961 ECU_ADDRESS 0xF090A /end MEASUREMENT
/begin MEASUREMENT fvans "" UBYTE fak_ub_b8 1 100 0.00 7.969 FORMAT "%5.3" ECU_ADDRESS 0xF40F2 /end MEASUREMENT
/begin MEASUREMENT fvavst_w "" SWORD fak_sw_b256 1 100 -256.0000 255.9922 FORMAT "%8.4" ECU_ADDRESS 0xF4686 /end MEASUREMENT
/begin MEASUREMENT fwe "" UBYTE fak_ub_b2 1 100 0.00 1.992 FORMAT "%5.3" ECU_ADDRESS 0xF0902 /end MEASUREMENT
/begin MEASUREMENT fweemrfa "" UBYTE fak_ub_b2 1 100 0.00 1.000 FORMAT "%5.3" ECU_ADDRESS 0xF40E5 /end MEASUREMENT
/begin MEASUREMENT fweemrfah "" UBYTE fak_ub_b2 1 100 0.00 1.000 FORMAT "%5.3" ECU_ADDRESS 0xF40E6 /end MEASUREMENT
/begin MEASUREMENT fwfkorr_w "" UWORD fak_uw_b2 1 100 0.00 1.999969 FORMAT "%8.6" ECU_ADDRESS 0xF2014 /end MEASUREMENT
/begin MEASUREMENT fwkati_w "" UWORD fak_uw_b2 1 100 0.00 1.999969 FORMAT "%8.6" ECU_ADDRESS 0xF1E1C /end MEASUREMENT
/begin MEASUREMENT fwl "" UBYTE fak_ub_b2 1 100 0.00 1.992 FORMAT "%5.3" ECU_ADDRESS 0xF08D0 /end MEASUREMENT
/begin MEASUREMENT fwlrl "" UBYTE fak_ub_b2 1 100 0.00 1.992 FORMAT "%5.3" ECU_ADDRESS 0xF08D1 /end MEASUREMENT
/begin MEASUREMENT fwnsnw_w "" UWORD fak_uw_b2 1 100 0.00 1.999969 FORMAT "%8.6" ECU_ADDRESS 0xF461E /end MEASUREMENT
/begin MEASUREMENT fwnwvs_loc "" UBYTE fak_ub_b2 1 100 0.00 1.992 FORMAT "%5.3" ECU_ADDRESS 0xF40DF /end MEASUREMENT
/begin MEASUREMENT fwwlnw "" UBYTE fak_ub_b2 1 100 0.00 1.992 FORMAT "%5.3" ECU_ADDRESS 0xF40E0 /end MEASUREMENT
/begin MEASUREMENT fzans1_w "" UWORD fak_uw_b1 1 100 0.00 0.9999847 FORMAT "%9.7" ECU_ADDRESS 0xF1E1E /end MEASUREMENT
/begin MEASUREMENT gangauti "" UBYTE dez 1 100 0.00 255.0 FORMAT "%5.1" ECU_ADDRESS 0xF0622 /end MEASUREMENT
/begin MEASUREMENT gangautic "" UBYTE dez 1 100 0.00 255.0 FORMAT "%5.1" ECU_ADDRESS 0xF062B /end MEASUREMENT
/begin MEASUREMENT genlrc "" UBYTE t1sxs_q3 1 100 0.00 765.0 FORMAT "%5.1" ECU_ADDRESS 0xF0657 /end MEASUREMENT
/begin MEASUREMENT ggcegsNvBits "" UBYTE dez 1 100 0.00 255.0 FORMAT "%5.1" ECU_ADDRESS 0x38201E /end MEASUREMENT
/begin MEASUREMENT gwhpos "" UBYTE dez 1 100 0.00 255.0 FORMAT "%5.1" ECU_ADDRESS 0xF0637 /end MEASUREMENT
/begin MEASUREMENT kfgr_w "" UWORD rel_uw_b3200 1 100 0.00 3199.951 FORMAT "%8.3" ECU_ADDRESS 0xF1C12 /end MEASUREMENT
/begin MEASUREMENT klahc "" UBYTE dez 1 100 0.00 255.0 FORMAT "%5.1" ECU_ADDRESS 0xF0638 /end MEASUREMENT
/begin MEASUREMENT kl_twstt_w "" UWORD t1sxs_uw_q1 1 100 0.00 65535.00 FORMAT "%8.2" ECU_ADDRESS 0xF4664 /end MEASUREMENT
/begin MEASUREMENT lamruka2_w "" UWORD fak_uw_b16 1 100 0.00 15.99976 FORMAT "%8.5" ECU_ADDRESS 0xF2086 /end MEASUREMENT
/begin MEASUREMENT lamruka_w "" UWORD fak_uw_b16 1 100 0.00 15.99976 FORMAT "%8.5" ECU_ADDRESS 0xF2088 /end MEASUREMENT
/begin MEASUREMENT lamsbguk "" UBYTE fak_ub_b4 1 100 0.00 3.984 FORMAT "%5.3" ECU_ADDRESS 0xF090B /end MEASUREMENT
/begin MEASUREMENT mdgbeg "" UBYTE md_ub_q10 1 100 0.00 2550. FORMAT "%5.0" ECU_ADDRESS 0xF0639 /end MEASUREMENT
/begin MEASUREMENT mdgrad_w "" UWORD rel_uw_b100 1 100 0.00 99.99847 FORMAT "%8.5" ECU_ADDRESS 0xF13DE /end MEASUREMENT
/begin MEASUREMENT mdverlc "" UBYTE rel_ub_b99p6 1 100 0.00 99.61 FORMAT "%5.2" ECU_ADDRESS 0xF065F /end MEASUREMENT
/begin MEASUREMENT mdwancan "" UBYTE rel_ub_b99p6 1 100 0.00 99.61 FORMAT "%5.2" ECU_ADDRESS 0xF0624 /end MEASUREMENT
/begin MEASUREMENT mdwange1 "" UBYTE rel_ub_b99p6 1 100 0.00 99.61 FORMAT "%5.2" ECU_ADDRESS 0xF063A /end MEASUREMENT
/begin MEASUREMENT mdwange3 "" UBYTE rel_ub_b100 1 100 0.00 99.61 FORMAT "%5.2" ECU_ADDRESS 0xF063B /end MEASUREMENT
/begin MEASUREMENT miasrllk "" UBYTE rel_ub_b99p6 1 100 0.00 99.61 FORMAT "%5.2" ECU_ADDRESS 0xF0646 /end MEASUREMENT
/begin MEASUREMENT miasrl_w "" UWORD rel_uw_b100 1 100 0.00 99.99847 FORMAT "%8.5" ECU_ADDRESS 0xF1404 /end MEASUREMENT
/begin MEASUREMENT miasrslk "" UBYTE rel_ub_b99p6 1 100 0.00 99.61 FORMAT "%5.2" ECU_ADDRESS 0xF0647 /end MEASUREMENT
/begin MEASUREMENT miasrs_w "" UWORD rel_uw_b100 1 100 0.00 99.99847 FORMAT "%8.5" ECU_ADDRESS 0xF1406 /end MEASUREMENT
/begin MEASUREMENT miautgetc "" UBYTE rel_ub_b99p6 1 100 0.00 99.61 FORMAT "%5.2" ECU_ADDRESS 0xF0660 /end MEASUREMENT
/begin MEASUREMENT miautgsc "" UBYTE rel_ub_b99p6 1 100 0.00 99.61 FORMAT "%5.2" ECU_ADDRESS 0xF0661 /end MEASUREMENT
/begin MEASUREMENT miecges_w "" UWORD rel_uw_b100 1 100 0.00 99.99847 FORMAT "%8.5" ECU_ADDRESS 0xF13E0 /end MEASUREMENT
/begin MEASUREMENT miecgmx_w "" UWORD rel_uw_b100 1 100 0.00 99.99847 FORMAT "%8.5" ECU_ADDRESS 0xF13E2 /end MEASUREMENT
/begin MEASUREMENT mierrcan_w "" UWORD rel_uw_b100 1 100 0.00 99.99847 FORMAT "%8.5" ECU_ADDRESS 0xF13E4 /end MEASUREMENT
/begin MEASUREMENT mifroz_w "" UWORD rel_uw_b100 1 100 0.00 99.99847 FORMAT "%8.5" ECU_ADDRESS 0xF13E6 /end MEASUREMENT
/begin MEASUREMENT miges_w "" UWORD rel_uw_b100 1 100 0.00 99.99847 FORMAT "%8.5" ECU_ADDRESS 0xF13E8 /end MEASUREMENT
/begin MEASUREMENT migsc_w "" UWORD rel_uw_b100 1 100 0.00 99.99847 FORMAT "%8.5" ECU_ADDRESS 0xF13EA /end MEASUREMENT
/begin MEASUREMENT migsleg_w "" UWORD rel_uw_b100 1 100 0.00 99.99847 FORMAT "%8.5" ECU_ADDRESS 0xF13EC /end MEASUREMENT
/begin MEASUREMENT migssc_w "" UWORD rel_uw_b100 1 100 0.00 99.99847 FORMAT "%8.5" ECU_ADDRESS 0xF1400 /end MEASUREMENT
/begin MEASUREMENT migszc_w "" UWORD rel_uw_b100 1 100 0.00 99.99847 FORMAT "%8.5" ECU_ADDRESS 0xF1402 /end MEASUREMENT
/begin MEASUREMENT migs_can "" UBYTE rel_ub_b100 1 100 0.00 99.61 FORMAT "%5.2" ECU_ADDRESS 0xF063C /end MEASUREMENT
/begin MEASUREMENT migs_w "" UWORD rel_uw_b100 1 100 0.00 99.99847 FORMAT "%8.5" ECU_ADDRESS 0xF13EE /end MEASUREMENT
/begin MEASUREMENT miistc "" UBYTE rel_ub_b99p6 1 100 0.00 99.61 FORMAT "%5.2" ECU_ADDRESS 0xF0662 /end MEASUREMENT
/begin MEASUREMENT mimsrlk "" UBYTE rel_ub_b99p6 1 100 0.00 99.61 FORMAT "%5.2" ECU_ADDRESS 0xF0648 /end MEASUREMENT
/begin MEASUREMENT mimsr_w "" UWORD rel_uw_b100 1 100 0.00 99.99847 FORMAT "%8.5" ECU_ADDRESS 0xF1408 /end MEASUREMENT
/begin MEASUREMENT misgelok_w "" UWORD rel_uw_b100 1 100 0.00 99.99847 FORMAT "%8.5" ECU_ADDRESS 0xF13F0 /end MEASUREMENT
/begin MEASUREMENT misgseg_w "" UWORD rel_uw_b100 1 100 0.00 99.99847 FORMAT "%8.5" ECU_ADDRESS 0xF13F2 /end MEASUREMENT
/begin MEASUREMENT misgsleg_w "" UWORD rel_uw_b100 1 100 0.00 99.99847 FORMAT "%8.5" ECU_ADDRESS 0xF13F4 /end MEASUREMENT
/begin MEASUREMENT mizwmnc "" UBYTE rel_ub_b99p6 1 100 0.00 99.61 FORMAT "%5.2" ECU_ADDRESS 0xF0663 /end MEASUREMENT
/begin MEASUREMENT mi_duf "" UBYTE rel_ub_b99p6 1 100 0.00 99.61 FORMAT "%5.2" ECU_ADDRESS 0xF05AC /end MEASUREMENT
/begin MEASUREMENT mletanzs_w "" UWORD m_q0p004 1 100 0.00 262.1400 FORMAT "%8.4" ECU_ADDRESS 0xF4F20 /end MEASUREMENT
/begin MEASUREMENT mletan_w "" UWORD m_q0p004 1 100 0.00 262.1400 FORMAT "%8.4" ECU_ADDRESS 0xF4F22 /end MEASUREMENT
/begin MEASUREMENT mlsol_w "" UWORD m_uw_b6553p5 1 100 0.00 6553.500 FORMAT "%8.3" ECU_ADDRESS 0xF1D66 /end MEASUREMENT
/begin MEASUREMENT mlwdknf_w "" UWORD m_uw_b6553p5 1 100 0.00 6553.500 FORMAT "%8.3" ECU_ADDRESS 0xF1D68 /end MEASUREMENT
/begin MEASUREMENT mpfad "" UBYTE dez 1 100 0.00 255.0 FORMAT "%5.1" ECU_ADDRESS 0xF05AD /end MEASUREMENT
/begin MEASUREMENT mrfabugd_w "" UWORD rel_uw_b200 1 100 0.00 199.9969 FORMAT "%8.4" ECU_ADDRESS 0xF1D6A /end MEASUREMENT
/begin MEASUREMENT mrfaugd_w "" UWORD rel_uw_b200 1 100 0.00 199.9969 FORMAT "%8.4" ECU_ADDRESS 0xF1D6C /end MEASUREMENT
/begin MEASUREMENT mrfgri_w "" UWORD rel_uw_b200 1 100 0.00 199.9969 FORMAT "%8.4" ECU_ADDRESS 0xF1C14 /end MEASUREMENT
/begin MEASUREMENT mrfgr_w "" UWORD rel_uw_b200 1 100 0.00 199.9969 FORMAT "%8.4" ECU_ADDRESS 0xF1C16 /end MEASUREMENT
/begin MEASUREMENT msdkoo_w "" UWORD m_q0p1 1 100 0.00 6553.500 FORMAT "%8.3" ECU_ADDRESS 0xF4F24 /end MEASUREMENT
/begin MEASUREMENT msdks_w "" UWORD m_uw_b6553p5 1 100 0.00 6553.500 FORMAT "%8.3" ECU_ADDRESS 0xF1D6E /end MEASUREMENT
/begin MEASUREMENT msndkoos_w "" UWORD m_uw_b6553p5 1 100 0.00 6553.500 FORMAT "%8.3" ECU_ADDRESS 0xF1D70 /end MEASUREMENT
/begin MEASUREMENT msndks_w "" UWORD m_uw_b6553p5 1 100 0.00 6553.500 FORMAT "%8.3" ECU_ADDRESS 0xF1D72 /end MEASUREMENT
/begin MEASUREMENT msrmdt_w "" SWORD mdt_sw_b2556 1 100 -2556.000 2555.922 FORMAT "%8.3" ECU_ADDRESS 0xF1414 /end MEASUREMENT
/begin MEASUREMENT mstedtef_w "" UWORD m_q0p0031 1 100 0.00 204.7969 FORMAT "%8.4" ECU_ADDRESS 0xF4F26 /end MEASUREMENT
/begin MEASUREMENT nllcvt1 "" UBYTE nmot_ub_q10 1 100 0.00 2550. FORMAT "%5.0" ECU_ADDRESS 0xF063D /end MEASUREMENT
/begin MEASUREMENT nmotdtf_w "" UWORD nmot_uw_q0p25 1 100 0.00 16383.75 FORMAT "%8.2" ECU_ADDRESS 0xF4F28 /end MEASUREMENT
/begin MEASUREMENT nmot_c "" UWORD nmot_uw_q0p25 1 100 0.00 16383.75 FORMAT "%8.2" ECU_ADDRESS 0xF1422 /end MEASUREMENT
/begin MEASUREMENT nsactr "" UBYTE fak_ub_b2 1 100 0.00 1.992 FORMAT "%5.3" ECU_ADDRESS 0xF08D2 /end MEASUREMENT
/begin MEASUREMENT nstaw_w "" UWORD nmot_uw_q0p25 1 100 0.00 16383.75 FORMAT "%8.2" ECU_ADDRESS 0xF1424 /end MEASUREMENT
/begin MEASUREMENT nswrl "" UBYTE fak_ub_b2 1 100 0.00 1.992 FORMAT "%5.3" ECU_ADDRESS 0xF08D3 /end MEASUREMENT
/begin MEASUREMENT nsyw "" UBYTE nmot_ub_q25 1 100 0.00 6375. FORMAT "%5.0" ECU_ADDRESS 0xF063E /end MEASUREMENT
/begin MEASUREMENT nsywin "" UBYTE dez 1 100 0.00 255.0 FORMAT "%5.1" ECU_ADDRESS 0xF063F /end MEASUREMENT
/begin MEASUREMENT psfil_w "" UWORD p_uw_q0p039 1 100 0.00 2559.961 FORMAT "%8.3" ECU_ADDRESS 0xF1D74 /end MEASUREMENT
/begin MEASUREMENT pspvmin_w "" UWORD fak_uw_b2 1 100 0.00 1.999969 FORMAT "%8.6" ECU_ADDRESS 0xF1D76 /end MEASUREMENT
/begin MEASUREMENT pssol_w "" UWORD p_uw_q0p039 1 100 0.00 2559.961 FORMAT "%8.3" ECU_ADDRESS 0xF1D78 /end MEASUREMENT
/begin MEASUREMENT psspvdkb_w "" UWORD fak_uw_b2 1 100 0.00 1.999969 FORMAT "%8.6" ECU_ADDRESS 0xF1D7A /end MEASUREMENT
/begin MEASUREMENT psspvdk_w "" UWORD fak_uw_b2 1 100 0.00 1.999969 FORMAT "%8.6" ECU_ADDRESS 0xF1D7C /end MEASUREMENT
/begin MEASUREMENT pvdkr_w "" UWORD p_uw_q0p039 1 100 0.00 2559.961 FORMAT "%8.3" ECU_ADDRESS 0xF1D7E /end MEASUREMENT
/begin MEASUREMENT rkuke_w "" SWORD rel_sw_q0p0468 1 100 -1536.000 1535.953 FORMAT "%8.3" ECU_ADDRESS 0xF2016 /end MEASUREMENT
/begin MEASUREMENT rkukg_w "" SWORD rel_sw_q0p0468 1 100 -1536.000 1535.953 FORMAT "%8.3" ECU_ADDRESS 0xF2018 /end MEASUREMENT
/begin MEASUREMENT rkukkl_w "" SWORD rel_sw_q0p0468 1 100 -1536.000 1535.953 FORMAT "%8.3" ECU_ADDRESS 0xF201A /end MEASUREMENT
/begin MEASUREMENT rkukkt_w "" SWORD rel_sw_q0p0468 1 100 -1536.000 1535.953 FORMAT "%8.3" ECU_ADDRESS 0xF208A /end MEASUREMENT
/begin MEASUREMENT rkukkxn_w "" SWORD rel_sw_q0p0468 1 100 -1536.000 1535.953 FORMAT "%8.3" ECU_ADDRESS 0xF208C /end MEASUREMENT
/begin MEASUREMENT rkukk_w "" SWORD rel_sw_q0p0468 1 100 -1536.000 1535.953 FORMAT "%8.3" ECU_ADDRESS 0xF201C /end MEASUREMENT
/begin MEASUREMENT rkukl_w "" SWORD rel_sw_q0p0468 1 100 -1536.000 1535.953 FORMAT "%8.3" ECU_ADDRESS 0xF201E /end MEASUREMENT
/begin MEASUREMENT rkuk_w "" SWORD rel_sw_q0p0468 1 100 -1536.000 1535.953 FORMAT "%8.3" ECU_ADDRESS 0xF2020 /end MEASUREMENT
/begin MEASUREMENT rlfgks_w "" UWORD rel_uw_q0p0234 1 100 0.00 1535.977 FORMAT "%8.3" ECU_ADDRESS 0xF1D80 /end MEASUREMENT
/begin MEASUREMENT rltedte_w "" UWORD rel_uw_q0p0234 1 100 0.00 1535.977 FORMAT "%8.3" ECU_ADDRESS 0xF4F2A /end MEASUREMENT
/begin MEASUREMENT rmstevf_w "" SWORD rel_sw_b200 1 100 -200.0000 199.9939 FORMAT "%8.4" ECU_ADDRESS 0xF4F2C /end MEASUREMENT
/begin MEASUREMENT rmstevuf_w "" UWORD rel_uw_b200 1 100 0.00 199.9969 FORMAT "%8.4" ECU_ADDRESS 0xF4F2E /end MEASUREMENT
/begin MEASUREMENT rmstev_w "" UWORD rel_uw_b200 1 100 0.00 199.9969 FORMAT "%8.4" ECU_ADDRESS 0x38408C /end MEASUREMENT
/begin MEASUREMENT rstMon_um "" UWORD dez 1 100 0.00 65535.00 FORMAT "%8.2" ECU_ADDRESS 0xF1124 /end MEASUREMENT
/begin MEASUREMENT rstpfad "" UBYTE dez 1 100 0.00 255.0 FORMAT "%5.1" ECU_ADDRESS 0xF05AF /end MEASUREMENT
/begin MEASUREMENT sdwfk_w "" SWORD rel_q0p09375 1 100 -3072.000 3071.906 FORMAT "%8.3" ECU_ADDRESS 0xF2022 /end MEASUREMENT
/begin MEASUREMENT sdwfl_w "" SWORD rel_q0p09375 1 100 -3072.000 3071.906 FORMAT "%8.3" ECU_ADDRESS 0xF2024 /end MEASUREMENT
/begin MEASUREMENT skapfad "" UBYTE dez 1 100 0.00 255.0 FORMAT "%5.1" ECU_ADDRESS 0xF05AE /end MEASUREMENT
/begin MEASUREMENT statgesc "" UBYTE dez 1 100 0.00 255.0 FORMAT "%5.1" ECU_ADDRESS 0xF0640 /end MEASUREMENT
/begin MEASUREMENT statgezc "" UBYTE dez 1 100 0.00 255.0 FORMAT "%5.1" ECU_ADDRESS 0xF0641 /end MEASUREMENT
/begin MEASUREMENT statgra "" UBYTE dez 1 100 0.00 255.0 FORMAT "%5.1" ECU_ADDRESS 0xF0664 /end MEASUREMENT
/begin MEASUREMENT statwkc "" UBYTE dez 1 100 0.00 255.0 FORMAT "%5.1" ECU_ADDRESS 0xF0642 /end MEASUREMENT
/begin MEASUREMENT stfgrab_w "" UWORD dez 1 100 0.00 65535.00 FORMAT "%8.2" ECU_ADDRESS 0xF1BF0 /end MEASUREMENT
/begin MEASUREMENT stfgrbs_w "" UWORD dez 1 100 0.00 65535.00 FORMAT "%8.2" ECU_ADDRESS 0xF1BF8 /end MEASUREMENT
/begin MEASUREMENT stfgrfl "" UBYTE dez 1 100 0.00 255.0 FORMAT "%5.1" ECU_ADDRESS 0xF089D /end MEASUREMENT
/begin MEASUREMENT S_fs "" UWORD B_TRUE 1 100 0.00 1.00000000000 BIT_MASK 0x800 FORMAT "%13.11" ECU_ADDRESS 0xFD1C /end MEASUREMENT
/begin MEASUREMENT tadtea "" UBYTE rel_ub_b99p6 1 100 0.00 99.61 FORMAT "%5.2" ECU_ADDRESS 0xF4180 /end MEASUREMENT
/begin MEASUREMENT tadteazs "" UBYTE rel_ub_b99p6 1 100 0.00 99.61 FORMAT "%5.2" ECU_ADDRESS 0xF4181 /end MEASUREMENT
/begin MEASUREMENT tankl_E_w "" UWORD dez 1 100 0.00 65535.00 FORMAT "%8.2" ECU_ADDRESS 0xF16EA /end MEASUREMENT
/begin MEASUREMENT tankl_fsp_w "" UWORD dez 1 100 0.00 65535.00 FORMAT "%8.2" ECU_ADDRESS 0xF16EC /end MEASUREMENT
/begin MEASUREMENT tankl_nt_w "" UWORD dez 1 100 0.00 65535.00 FORMAT "%8.2" ECU_ADDRESS 0x382EB4 /end MEASUREMENT
/begin MEASUREMENT tankl_tl_w "" UWORD dez 1 100 0.00 65535.00 FORMAT "%8.2" ECU_ADDRESS 0x382EB6 /end MEASUREMENT
/begin MEASUREMENT tankl_Z_w "" UWORD dez 1 100 0.00 65535.00 FORMAT "%8.2" ECU_ADDRESS 0xF16EE /end MEASUREMENT
/begin MEASUREMENT tc6tesc "" UBYTE dez 1 100 0.00 255.0 FORMAT "%5.1" ECU_ADDRESS 0x384029 /end MEASUREMENT
/begin MEASUREMENT tc6tess "" UWORD dez 1 100 0.00 65535.00 FORMAT "%8.2" ECU_ADDRESS 0x38408E /end MEASUREMENT
/begin MEASUREMENT tc6tesw "" UWORD dez 1 100 0.00 65535.00 FORMAT "%8.2" ECU_ADDRESS 0x384090 /end MEASUREMENT
/begin MEASUREMENT tdtesta "" UBYTE t100msxs_ub_b25p5 1 100 0.00 25.50 FORMAT "%5.2" ECU_ADDRESS 0xF4182 /end MEASUREMENT
/begin MEASUREMENT tdtetevo "" UBYTE t100msxs_ub_b25p5 1 100 0.00 25.50 FORMAT "%5.2" ECU_ADDRESS 0xF4183 /end MEASUREMENT
/begin MEASUREMENT tfwdks_w "" UWORD zk10msxs_uw_b655 1 100 0.010000152590 655.36000000 FORMAT "%12.8" ECU_ADDRESS 0xF1D82 /end MEASUREMENT
/begin MEASUREMENT tmnuka "" UWORD t10msxs_ub_b2p55 1 100 0.00 655.3500 FORMAT "%8.4" ECU_ADDRESS 0xF208E /end MEASUREMENT
/begin MEASUREMENT tmstem "" UBYTE temp_ub_q0p75_o48 1 100 -48.00 143.3 FORMAT "%5.1" ECU_ADDRESS 0xF4042 /end MEASUREMENT
/begin MEASUREMENT tn2fgr_w "" UWORD t20msxs_uw_q0p02 1 100 0.00 1310.700 FORMAT "%8.3" ECU_ADDRESS 0xF1C18 /end MEASUREMENT
/begin MEASUREMENT tnkl50 "" UWORD t20msxs_uw_b1310 1 100 0.00 1310.700 FORMAT "%8.3" ECU_ADDRESS 0xF1426 /end MEASUREMENT
/begin MEASUREMENT tntevzu "" UBYTE t100msxs_ub_b25p5 1 100 0.00 25.50 FORMAT "%5.2" ECU_ADDRESS 0xF4184 /end MEASUREMENT
/begin MEASUREMENT topl_w "" UWORD t6minxh_b6553p5 1 100 0.00 6553.500 FORMAT "%8.3" ECU_ADDRESS 0x384054 /end MEASUREMENT
/begin MEASUREMENT topsec_w "" UWORD t100msxs_uw_b6553p5 1 100 0.00 6553.500 FORMAT "%8.3" ECU_ADDRESS 0x384056 /end MEASUREMENT
/begin MEASUREMENT top_w "" UWORD t6minxh_b6553p5 1 100 0.00 6553.500 FORMAT "%8.3" ECU_ADDRESS 0x384058 /end MEASUREMENT
/begin MEASUREMENT tpbauka "" UBYTE t10msxs_ub_b2p55 1 100 0.00 2.550 FORMAT "%5.3" ECU_ADDRESS 0xF0919 /end MEASUREMENT
/begin MEASUREMENT tpvauka "" UBYTE t10msxs_ub_b2p55 1 100 0.00 2.550 FORMAT "%5.3" ECU_ADDRESS 0xF091A /end MEASUREMENT
/begin MEASUREMENT tpwmcs "" UBYTE t10msxs_ub_b2p55 1 100 0.00 2.550 FORMAT "%5.3" ECU_ADDRESS 0xF0C9D /end MEASUREMENT
/begin MEASUREMENT tstawk "" UWORD t20msxs_uw_b1310 1 100 0.00 1310.700 FORMAT "%8.3" ECU_ADDRESS 0xF1428 /end MEASUREMENT
/begin MEASUREMENT tswk "" UBYTE t20msxs_ub_b5p1 1 100 0.00 5.100 FORMAT "%5.3" ECU_ADDRESS 0xF089E /end MEASUREMENT
/begin MEASUREMENT tsyn "" UBYTE t_q20_ms 1 100 0.00 5100. FORMAT "%5.0" ECU_ADDRESS 0xF0643 /end MEASUREMENT
/begin MEASUREMENT tumanst "" UBYTE temp_ub_q0p75_o48 1 100 -48.00 143.3 FORMAT "%5.1" ECU_ADDRESS 0xF4185 /end MEASUREMENT
/begin MEASUREMENT tvfrrdte "" UBYTE t100msxs_ub_b25p5 1 100 0.00 25.50 FORMAT "%5.2" ECU_ADDRESS 0xF4186 /end MEASUREMENT
/begin MEASUREMENT tvfzsu_t "" UBYTE t100msxs_ub_b25p5 1 100 0.00 25.50 FORMAT "%5.2" ECU_ADDRESS 0xE186 /end MEASUREMENT
/begin MEASUREMENT tz "" UBYTE dez 1 100 0.00 255.0 FORMAT "%5.1" ECU_ADDRESS 0xF06E6 /end MEASUREMENT
/begin MEASUREMENT tz2fgr_w "" UWORD t20msxs_uw_q0p02 1 100 0.00 1310.700 FORMAT "%8.3" ECU_ADDRESS 0xF1C1A /end MEASUREMENT
/begin MEASUREMENT uefktge1 "" UBYTE fak_q0p1 1 100 0.00 25.50 FORMAT "%5.2" ECU_ADDRESS 0xF0644 /end MEASUREMENT
/begin MEASUREMENT uefktget "" UBYTE uefktget_ub_b25p4 1 100 0.00 25.50 FORMAT "%5.2" ECU_ADDRESS 0xF0625 /end MEASUREMENT
/begin MEASUREMENT uefktget_w "" UWORD fak_q0p02 1 100 0.00 1310.700 FORMAT "%8.3" ECU_ADDRESS 0xF13F6 /end MEASUREMENT
/begin MEASUREMENT uevges_w "" UWORD fak_q0p1 1 100 0.00 6553.500 FORMAT "%8.3" ECU_ADDRESS 0xF1C1C /end MEASUREMENT
/begin MEASUREMENT ukafrtmo_w "" UWORD fak_uw_b2 1 100 0.00 1.999969 FORMAT "%8.6" ECU_ADDRESS 0xF46DC /end MEASUREMENT
/begin MEASUREMENT ukafrtmu_w "" UWORD fak_uw_b2 1 100 0.00 1.999969 FORMAT "%8.6" ECU_ADDRESS 0xF46DE /end MEASUREMENT
/begin MEASUREMENT vamsr_w "" UWORD vfzg_uw_b325 1 100 0.00 324.9950 FORMAT "%8.4" ECU_ADDRESS 0xF140A /end MEASUREMENT
/begin MEASUREMENT vfgrlim_w "" UWORD vfzg_uw_q0p0078125 1 100 0.00 511.9922 FORMAT "%8.4" ECU_ADDRESS 0xF1C04 /end MEASUREMENT
/begin MEASUREMENT vfgro_w "" UWORD vfzg_uw_q0p0078125 1 100 0.00 511.9922 FORMAT "%8.4" ECU_ADDRESS 0xF1C1E /end MEASUREMENT
/begin MEASUREMENT vlast_w "" UWORD vfzg_uw_q0p0078125 1 100 0.00 511.9922 FORMAT "%8.4" ECU_ADDRESS 0xF1C20 /end MEASUREMENT
/begin MEASUREMENT voffs_w "" UWORD vfzg_uw_q0p0078125 1 100 0.00 511.9922 FORMAT "%8.4" ECU_ADDRESS 0xF1C22 /end MEASUREMENT
/begin MEASUREMENT vrad_hl_w "" UWORD vrad_uw_b655 1 100 0.00 654.9900 FORMAT "%8.4" ECU_ADDRESS 0xF140C /end MEASUREMENT
/begin MEASUREMENT vrad_hr_w "" UWORD vrad_uw_b655 1 100 0.00 654.9900 FORMAT "%8.4" ECU_ADDRESS 0xF140E /end MEASUREMENT
/begin MEASUREMENT vrad_vl_w "" UWORD vrad_uw_b655 1 100 0.00 654.9900 FORMAT "%8.4" ECU_ADDRESS 0xF1410 /end MEASUREMENT
/begin MEASUREMENT vrad_vr_w "" UWORD vrad_uw_b655 1 100 0.00 654.9900 FORMAT "%8.4" ECU_ADDRESS 0xF1412 /end MEASUREMENT
/begin MEASUREMENT vregl_w "" UWORD vfzg_uw_q0p0078125 1 100 0.00 511.9922 FORMAT "%8.4" ECU_ADDRESS 0xF1C06 /end MEASUREMENT
/begin MEASUREMENT vti_w "" UWORD fak_uw_b2 1 100 0.00 1.999969 FORMAT "%8.6" ECU_ADDRESS 0xF2026 /end MEASUREMENT
/begin MEASUREMENT vziel_w "" UWORD vfzg_uw_q0p0078125 1 100 0.00 511.9922 FORMAT "%8.4" ECU_ADDRESS 0xF1C08 /end MEASUREMENT
/begin MEASUREMENT wdkink_w "" UWORD relDK_uw_b100 1 100 0.00 100.0000 FORMAT "%8.4" ECU_ADDRESS 0xF1DE6 /end MEASUREMENT
/begin MEASUREMENT wdks "" UBYTE relDK_ub_b100 1 100 0.00 100.0 FORMAT "%5.1" ECU_ADDRESS 0xF08CB /end MEASUREMENT
/begin MEASUREMENT wdksap_w "" UWORD rel_uw_b100 1 100 0.00 99.99847 FORMAT "%8.5" ECU_ADDRESS 0xF1D84 /end MEASUREMENT
/begin MEASUREMENT wdksba2_w "" UWORD relDK_uw_b100 1 100 0.00 100.0000 FORMAT "%8.4" ECU_ADDRESS 0xF1DE8 /end MEASUREMENT
/begin MEASUREMENT wdksba_w "" UWORD relDK_uw_b100 1 100 0.00 100.0000 FORMAT "%8.4" ECU_ADDRESS 0xF1DEA /end MEASUREMENT
/begin MEASUREMENT wdksbugd_w "" UWORD rel_uw_b100 1 100 0.00 99.99847 FORMAT "%8.5" ECU_ADDRESS 0xF1D86 /end MEASUREMENT
/begin MEASUREMENT wdksb_w "" UWORD relDK_uw_b100 1 100 0.00 100.0000 FORMAT "%8.4" ECU_ADDRESS 0xF1DEC /end MEASUREMENT
/begin MEASUREMENT wdksfl "" SBYTE fak_sb_b1 1 100 -1.000 0.9922 FORMAT "%5.3" ECU_ADDRESS 0xF08CC /end MEASUREMENT
/begin MEASUREMENT wdksgv_w "" UWORD rel_uw_b100 1 100 0.00 99.99847 FORMAT "%8.5" ECU_ADDRESS 0xF1D88 /end MEASUREMENT
/begin MEASUREMENT wdksmx_w "" UWORD rel_uw_b100 1 100 0.00 99.99847 FORMAT "%8.5" ECU_ADDRESS 0xF1D8A /end MEASUREMENT
/begin MEASUREMENT wdkspa_w "" UWORD relDK_uw_b100 1 100 0.00 100.0000 FORMAT "%8.4" ECU_ADDRESS 0xF1DEE /end MEASUREMENT
/begin MEASUREMENT wdksp_w "" UWORD relDK_uw_b100 1 100 0.00 100.0000 FORMAT "%8.4" ECU_ADDRESS 0xF1DF0 /end MEASUREMENT
/begin MEASUREMENT wdksvfl "" SBYTE fak_sb_b1 1 100 -1.000 0.9922 FORMAT "%5.3" ECU_ADDRESS 0xF08CD /end MEASUREMENT
/begin MEASUREMENT wdksv_w "" UWORD rel_uw_b100 1 100 0.00 99.99847 FORMAT "%8.5" ECU_ADDRESS 0xF1D8C /end MEASUREMENT
/begin MEASUREMENT wdkswe_w "" UWORD relDK_uw_b100 1 100 0.00 100.0000 FORMAT "%8.4" ECU_ADDRESS 0xF1DF2 /end MEASUREMENT
/begin MEASUREMENT wdks_w "" UWORD relDK_uw_b100 1 100 0.00 100.0000 FORMAT "%8.4" ECU_ADDRESS 0xF1DF4 /end MEASUREMENT
/begin MEASUREMENT wea "" UBYTE zw_ub_q6 1 100 0.00 1530. FORMAT "%5.0" ECU_ADDRESS 0xF40E7 /end MEASUREMENT
/begin MEASUREMENT wee "" UBYTE zw_ub_q6 1 100 0.00 1530. FORMAT "%5.0" ECU_ADDRESS 0xF08E4 /end MEASUREMENT
/begin MEASUREMENT weemrfa "" UBYTE zw_ub_q6 1 100 0.00 1530. FORMAT "%5.0" ECU_ADDRESS 0xF08E5 /end MEASUREMENT
/begin MEASUREMENT weenst "" UBYTE zw_ub_q6 1 100 0.00 1530. FORMAT "%5.0" ECU_ADDRESS 0xF08E6 /end MEASUREMENT
/begin MEASUREMENT weeotkrf_w "" UWORD kw_q0p0234 1 100 0.00 1535.977 FORMAT "%8.3" ECU_ADDRESS 0xF4688 /end MEASUREMENT
/begin MEASUREMENT weer "" UBYTE kw_q2p8125 1 100 0.00 717.2 FORMAT "%5.1" ECU_ADDRESS 0xF08E7 /end MEASUREMENT
/begin MEASUREMENT weest "" UBYTE zw_ub_q6 1 100 0.00 1530. FORMAT "%5.0" ECU_ADDRESS 0xF08E8 /end MEASUREMENT
/begin MEASUREMENT weetm "" SBYTE zw_sb_q6 1 100 -768.0 762.0 FORMAT "%5.1" ECU_ADDRESS 0xF08E9 /end MEASUREMENT
/begin MEASUREMENT wf_w "" SWORD rel_q0p09375 1 100 -3072.000 3071.906 FORMAT "%8.3" ECU_ADDRESS 0xF2028 /end MEASUREMENT
/begin MEASUREMENT woe_w "" UWORD kw_q0p0234 1 100 0.00 1535.977 FORMAT "%8.3" ECU_ADDRESS 0xF202A /end MEASUREMENT
/begin MEASUREMENT wpedc "" UBYTE rel_ub_b99p6 1 100 0.00 99.61 FORMAT "%5.2" ECU_ADDRESS 0xF0666 /end MEASUREMENT
/begin MEASUREMENT wuccnt "" UBYTE dez 1 100 0.00 255.0 FORMAT "%5.1" ECU_ADDRESS 0x382039 /end MEASUREMENT
/begin MEASUREMENT zbake "" UBYTE fak_q0p0039 1 100 0.00 0.9961 ECU_ADDRESS 0xF40F3 /end MEASUREMENT
/begin MEASUREMENT zbale "" UBYTE fak_ub_b0p125 1 100 0.00 0.1245 FORMAT "%6.4" ECU_ADDRESS 0xF40F4 /end MEASUREMENT
/begin MEASUREMENT zburnsum "" UBYTE dez 1 100 0.00 255.0 FORMAT "%5.1" ECU_ADDRESS 0xF08FB /end MEASUREMENT
/begin MEASUREMENT zstfgr "" UBYTE dez 1 100 0.00 255.0 FORMAT "%5.1" ECU_ADDRESS 0xF089F /end MEASUREMENT
/begin MEASUREMENT zuknstm_w "" UWORD zk100msxs_uw_b6553 1 100 0.10000152590 6553.6000000 FORMAT "%12.7" ECU_ADDRESS 0xF468A /end MEASUREMENT
/begin MEASUREMENT zvake "" UBYTE fak_q0p0039 1 100 0.00 0.9961 ECU_ADDRESS 0xF40F5 /end MEASUREMENT
/begin MEASUREMENT zvale "" UBYTE fak_ub_b0p125 1 100 0.00 0.1245 FORMAT "%6.4" ECU_ADDRESS 0xF40F6 /end MEASUREMENT
/begin MEASUREMENT Z_ase_old "" UWORD B_TRUE 1 100 0.00 1.00000000000 BIT_MASK 0x2 FORMAT "%13.11" ECU_ADDRESS 0xF16EE /end MEASUREMENT
/begin MEASUREMENT Z_ask_old "" UWORD B_TRUE 1 100 0.00 1.00000000000 BIT_MASK 0x1 FORMAT "%13.11" ECU_ADDRESS 0xF16EE /end MEASUREMENT
/begin MEASUREMENT Z_frao2_old "" UWORD B_TRUE 1 100 0.00 1.00000000000 BIT_MASK 0x80 FORMAT "%13.11" ECU_ADDRESS 0xF16EE /end MEASUREMENT
/begin MEASUREMENT Z_frao_old "" UWORD B_TRUE 1 100 0.00 1.00000000000 BIT_MASK 0x40 FORMAT "%13.11" ECU_ADDRESS 0xF16EE /end MEASUREMENT
/begin MEASUREMENT Z_frau2_old "" UWORD B_TRUE 1 100 0.00 1.00000000000 BIT_MASK 0x20 FORMAT "%13.11" ECU_ADDRESS 0xF16EE /end MEASUREMENT
/begin MEASUREMENT Z_frau_old "" UWORD B_TRUE 1 100 0.00 1.00000000000 BIT_MASK 0x10 FORMAT "%13.11" ECU_ADDRESS 0xF16EE /end MEASUREMENT
/begin MEASUREMENT Z_rkat2_old "" UWORD B_TRUE 1 100 0.00 1.00000000000 BIT_MASK 0x8 FORMAT "%13.11" ECU_ADDRESS 0xF16EE /end MEASUREMENT
/begin MEASUREMENT Z_rkat_old "" UWORD B_TRUE 1 100 0.00 1.00000000000 BIT_MASK 0x4 FORMAT "%13.11" ECU_ADDRESS 0xF16EE /end MEASUREMENT
/begin MEASUREMENT Z_rkaz2_old "" UWORD B_TRUE 1 100 0.00 1.00000000000 BIT_MASK 0x200 FORMAT "%13.11" ECU_ADDRESS 0xF16EE /end MEASUREMENT
/begin MEASUREMENT Z_rkaz_old "" UWORD B_TRUE 1 100 0.00 1.00000000000 BIT_MASK 0x100 FORMAT "%13.11" ECU_ADDRESS 0xF16EE /end MEASUREMENT
/begin FUNCTION DTANKL "3.20" /begin DEF_CHARACTERISTIC TVTANKL /end DEF_CHARACTERISTIC /begin IN_MEASUREMENT B_cdtankl B_sp1 B_tal cd_bits1_w /end IN_MEASUREMENT
 /begin OUT_MEASUREMENT B_asent B_asetl B_asknt B_asktl B_first B_frao2nt B_frao2tl B_fraont B_fraotl B_frau2nt B_frau2tl B_fraunt B_frautl B_ntal B_rkat2nt B_rkat2tl B_rkatnt B_rkattl B_rkaz2nt B_rkaz2tl B_rkaznt B_rkaztl B_second B_sp1_old B_tal01 B_tal_old E_ase_fsp E_ase_old E_ask_fsp E_ask_old E_frao2_fsp E_frao2_old E_frao_fsp E_frao_old E_frau2_fsp E_frau2_old E_frau_fsp E_frau_old E_rkat2_fsp E_rkat2_old E_rkat_fsp E_rkat_old E_rkaz2_fsp E_rkaz2_old E_rkaz_fsp E_rkaz_old E_tankl_old tankl_E_w tankl_fsp_w tankl_nt_w tankl_tl_w tankl_Z_w tz Z_ase_old Z_ask_old Z_frao2_old Z_frao_old Z_frau2_old Z_frau_old Z_rkat2_old Z_rkat_old Z_rkaz2_old Z_rkaz_old /end OUT_MEASUREMENT
/end FUNCTION
/begin FUNCTION DTEV "32.220"
 /begin DEF_CHARACTERISTIC APDTEFRE APDTEVX AVDTEVX CLDPTVC CWDTEAPP CWDTEV CWUTEKU DDFDTEAB DFRMDTEE DFRMDTEF DFRMDTEM DMLDTEFN DMLDTEFX DMLDTEMN DMLDTEMX DMSNTEMN DMSNTEMX DMVTEVDO DNDTEO DNDTEU DNNSOL ETAZWTEN FHODTEA FKADPMN FRMDPMO FRMDPMU FRMDTEVO FRMDTEVU FTEADDPO FTEADDPU FTEADSZ IMSDTEVA KFDETATE KFTVFRR KIDMSNTE KIRMSMS MLDTEFPF MLDTEPF RKADTEVO RKADTEVU RMSTEVIO RMSTEVMN RMSTEVMX TADTEAMX TADTEMX TC6TECL TC6TECNL TC6TECP TC6TECRF TC6TECRM TDTEFA TDTESZO TDTESZU TDTEZAM TFRMDTEE TMDTEU TMEWDTEU TMNST TMUDTEU TPERDTE TSTM TTEVAZ TVDTEABG TVDTEB TVDTEE TVDTELLA TVDTEVP TVDTEVPM TVDTEVZ ZDFFDTE ZFNMOT ZFRMFIL ZFRMXAF ZKRMSTEV ZMLETAN ZMSTEDTE ZRLTEDTE /end DEF_CHARACTERISTIC
 /begin IN_MEASUREMENT B_cdtes B_dllra B_dsls B_edkvs B_edkvs2 B_enws B_fa B_fates B_fs B_gae B_gap B_grdst B_hag B_koe B_ll B_llr B_lr B_lr2 B_m8te B_mdarv B_nldg B_nmot B_nswo1 B_pwf B_sls dfuelsan_w dmvad_w etazwist fho_w fkatei fklaf_w frmit_w frmn_w frmxa_w frmx_w ftead_w ftefsoll_w ftvdk imsteini kldfpwm ml ml_w msndkoo_w mstedte nmot_w nsol rkat_w rkaz_w tans tateout tmew tmot tnse_w tumg umsrln_w vfzg /end IN_MEASUREMENT
 /begin OUT_MEASUREMENT apdtev avdtev azpdtefre B_dteaa B_dteaam B_dtefrr B_dtes B_dtest B_ftedab B_rmsval dmsnte_w DTEVNonVolbits frdter_w rltedte_w rmstev_w tadtea tadteazs tc6tesc tc6tess tc6tesw /end OUT_MEASUREMENT
 /begin LOC_MEASUREMENT B_dteaab B_dteabu B_dteanfl B_dteend B_dteendl B_dteenf B_dtefre B_dtelab B_dtelbm B_dtelbr B_dtelnm B_dtelnmb B_dtelnmv B_dtenam B_dtephm B_dtepm B_dterab B_dterap B_dteres B_dternm B_dtezam B_teviol B_teviolm B_teviop B_tevior B_tevnio B_tevniom B_tumanst detazwte dkldfpwm_w dmletanf_w dmletanu dmletan_w etazwif etazwkte frmfdif_w frmfref_w frmitf_w frmxaf_w fthozs_w mletanzs_w mletan_w msdkoo_w mstedtef_w nmotdtf_w rmstevf_w rmstevuf_w tdtesta tdtetevo tntevzu tumanst tvfrrdte /end LOC_MEASUREMENT
/end FUNCTION
/begin FUNCTION DTEVE "9.30" /begin IN_MEASUREMENT B_desee tateout /end IN_MEASUREMENT /begin OUT_MEASUREMENT B_atev B_ztev /end OUT_MEASUREMENT /end FUNCTION
/begin FUNCTION DTIP "1.30" /begin IN_MEASUREMENT cw_erfil fcmEnd FCMTab /end IN_MEASUREMENT /begin OUT_MEASUREMENT ffzdfp /end OUT_MEASUREMENT /end FUNCTION
/begin FUNCTION DTOP "2.10" /begin IN_MEASUREMENT B_nmot B_pwf /end IN_MEASUREMENT /begin OUT_MEASUREMENT topl_w topsec_w top_w /end OUT_MEASUREMENT /end FUNCTION
/begin FUNCTION DTRIG "1.10" /begin IN_MEASUREMENT bbdcy bbno bbsp1 bbsp2 bbsp3 bbtim bbwuc /end IN_MEASUREMENT /end FUNCTION
/begin FUNCTION DUF "6.110" /begin DEF_CHARACTERISTIC DUF_T NMN_DUF /end DEF_CHARACTERISTIC
 /begin IN_MEASUREMENT B_dknolu B_ehfs B_fgr B_fgr_um B_i_ska_um B_mibeg B_msr B_nomsr_um B_nosgs_um B_pwgnotfr B_sgs B_sp1s B_sp2s B_spsmin B_ub_ok B_wdk2sel ei_adcc_um ei_ipa_um ei_mver_um ei_nc_um ei_reac_um ei_rlc_um ei_rlip_um ei_spsc_um ei_ubr_um ei_varc_um ei_zwc_um mi_um nmot_um /end IN_MEASUREMENT
 /begin OUT_MEASUREMENT duf_c egaspfad mi_duf mpfad skapfad /end OUT_MEASUREMENT
 /begin LOC_MEASUREMENT B_dufzok dufLokBits1 /end LOC_MEASUREMENT
/end FUNCTION
/begin FUNCTION DULSU "1.90" /begin DEF_CHARACTERISTIC SULSULUFT SULSULUFTL SULSUMX SULSUMXL TVLSULUFT TVTKLSU /end DEF_CHARACTERISTIC
 /begin IN_MEASUREMENT B_cdulsu B_evloc B_fa B_fklanf B_fklanf2 B_hstlsua B_hstlsua2 B_sls B_stend B_tal B_talval lamsons2_w lamsons_w ua10mo2_w ua10mo_w /end IN_MEASUREMENT
 /begin LOC_MEASUREMENT B_heulsu B_heulsu2 B_luft B_luft2 B_vluft B_vluft2 /end LOC_MEASUREMENT
/end FUNCTION
/begin FUNCTION DUMWEX "4.10" /begin IN_MEASUREMENT kmstand_w top_w /end IN_MEASUREMENT /end FUNCTION
/begin FUNCTION DUR "1.30" /begin DEF_CHARACTERISTIC DURNPRST_A /end DEF_CHARACTERISTIC /begin OUT_MEASUREMENT rstpfad /end OUT_MEASUREMENT /begin LOC_MEASUREMENT durnprst_c rstMon_um /end LOC_MEASUREMENT /end FUNCTION
/begin FUNCTION DVFZ "17.10" /begin DEF_CHARACTERISTIC NDV NDVO TDV TMDV VDMN /end DEF_CHARACTERISTIC /begin IN_MEASUREMENT B_sa nmot tmot vfzroh_w /end IN_MEASUREMENT /end FUNCTION
/begin FUNCTION DWUC "14.20" /begin DEF_CHARACTERISTIC DTMWUC TMWUC TMWUCST /end DEF_CHARACTERISTIC /begin IN_MEASUREMENT B_pwf B_stend tmot /end IN_MEASUREMENT /begin OUT_MEASUREMENT bbwuc B_nowuc B_wuc wuccnt /end OUT_MEASUREMENT /begin LOC_MEASUREMENT tmstem /end LOC_MEASUREMENT /end FUNCTION
/begin FUNCTION DZUEET "1.30" /begin DEF_CHARACTERISTIC DZUPHL DZUPKSMS DZUPKSUB DZUPSIG /end DEF_CHARACTERISTIC /begin REF_CHARACTERISTIC ESKONF /end REF_CHARACTERISTIC /begin IN_MEASUREMENT B_desee zndact zndsucc /end IN_MEASUREMENT /begin OUT_MEASUREMENT dzuhlzl dzuksmszl dzuksubzl dzusigzl /end OUT_MEASUREMENT /end FUNCTION
/begin FUNCTION DZWPE "1.10" /begin IN_MEASUREMENT B_desee B_zwp /end IN_MEASUREMENT /end FUNCTION
/begin FUNCTION ECUDEV "1.10" /begin OUT_MEASUREMENT B_ecudev /end OUT_MEASUREMENT /end FUNCTION
/begin FUNCTION _EEPROM "11.30" /end FUNCTION
/begin FUNCTION ESFAK "5.10"
 /begin DEF_CHARACTERISTIC FZASUN0 FZASUN1 FZASUN2 FZASUN3 FZASUN4 FZASUN5 FZNASUN0 FZNASUN1 FZNASUN2 FZNASUN3 FZNASUN4 FZNASUN5 TVFZSU /end DEF_CHARACTERISTIC
 /begin REF_CHARACTERISTIC SNM16CIUB /end REF_CHARACTERISTIC
 /begin IN_MEASUREMENT esst_snm16ciub nmot /end IN_MEASUREMENT
 /begin OUT_MEASUREMENT fnmes0 fnmes1 fnmes2 fnmes3 fnmes4 fnmes5 tvfzsu_t /end OUT_MEASUREMENT
/end FUNCTION
/begin FUNCTION ESGRU "23.30" /begin DEF_CHARACTERISTIC FRKAP KFLF /end DEF_CHARACTERISTIC /begin IN_MEASUREMENT nmot rl vsfrk vstfrk /end IN_MEASUREMENT /begin OUT_MEASUREMENT fgru /end OUT_MEASUREMENT /end FUNCTION
/begin FUNCTION ESNSWL "3.50"
 /begin DEF_CHARACTERISTIC FNSHO FNSSM FWSTAB1 FWSTAB2 FWSTAB3 FWSTAS1 FWSTAS2 FZANSSA1 FZANSSA2 FZANSSM1 FZANSSM2 FZANSSM3 KFFWL KFFWLRL KFFWLW KFKATI KFNSA KFNSWRL KFWLHO KFWNSNW KFWSTAARL KFWWLML KFWWLNW KFWWNS KLZANSFHO SZANSSM1 SZANSSM2 ZDGZA1 ZDGZA2 ZDGZA3 /end DEF_CHARACTERISTIC
 /begin REF_CHARACTERISTIC FHO04ESUB SIM06ESUW SKS06ESUB SNM06ESUB SRP06ESUB STA06ESUB STM12ESUB STS08ESUB STS12ESUB /end REF_CHARACTERISTIC
 /begin IN_MEASUREMENT anztib1_w B_hst B_staa B_stendes B_wks esst_fho04esub esst_sim06esuw esst_sks06esub esst_snm06esub esst_srp06esub esst_sta06esub esst_stm12esub esst_sts08esub esst_sts12esub fho fwnwvs_w imlatm_w kstaa nmot rlp tabst_w tans tmot tmst vstfns vstfwl wnwue wnwue_w /end IN_MEASUREMENT
 /begin OUT_MEASUREMENT fnswlst_w fnswl_w fns_w fwkati_w fwl fwnsnw_w fwwlnw /end OUT_MEASUREMENT
 /begin LOC_MEASUREMENT abr1_count B_fnsb1 B_fnsb2 B_fnsb3 B_fnsoff fktns_w fwlrl fwnwvs_loc fzans1_w nsactr nswrl /end LOC_MEASUREMENT
/end FUNCTION
/begin FUNCTION ESSTT "22.50"
 /begin DEF_CHARACTERISTIC DN10BURN FKSTT FSTHO IMLHS KFHSTT KFWHSTT KFWKSTAB KFWKSTN KFWKSTT TANDT TANH TMH TMHSG TMK TMODT TMORSTE TMURSTE TWSTT ZBURNLIM /end DEF_CHARACTERISTIC
 /begin REF_CHARACTERISTIC CWWL /end REF_CHARACTERISTIC
 /begin IN_MEASUREMENT anztib B_nmin B_pwf B_stend B_zesync dnmot_w fho imlatm kstaa nmot tabst_w tans tansab tmot tmotab tmst vstfst /end IN_MEASUREMENT
 /begin OUT_MEASUREMENT B_hst B_stendes B_vbemg B_wks B_wst ESSTTbits fst_w /end OUT_MEASUREMENT
 /begin LOC_MEASUREMENT B_vbmg B_wst0 B_wst1 B_wst2 fst0_w kl_twstt_w zburnsum /end LOC_MEASUREMENT
/end FUNCTION
/begin FUNCTION ESUK "9.170"
 /begin DEF_CHARACTERISTIC DUKK FUKBAE FUKLAMSBG FUKNSTHO FUKNSTM FUKTINEO FUKVAE FWFN KFABAK KFAVAK KFBAKL KFVAKL KFVALDIF KFVAWLA KFZVAKM KLBAKSTAA KLFVANST LADIFFVA RKBAUM RKUKKLU RKVAUM TKRF TMBAMN TMBAMX TNSUUK TVAG WFRL ZBAKM ZBALM ZUKBAE ZUKNSTM ZUKVAE ZVALM /end DEF_CHARACTERISTIC
 /begin REF_CHARACTERISTIC SLA05ESUB SNM07ESUB STM09ESUB WESSOT WNWREO /end REF_CHARACTERISTIC
 /begin IN_MEASUREMENT anzti B_ll B_nswo2 B_sa B_sbblsu B_sls B_slsoff B_st B_staa B_stend drlp_w esst_sla05esub esst_snm07esub esst_stm09esub fho fukaba_w fukava_w gangi kstaa ladiff_w lamsbg_w nmot nmot_w rlp rlp_w tef_w tmot tmst vstfba vstfva vwkw wee /end IN_MEASUREMENT
 /begin OUT_MEASUREMENT B_ba B_bag B_ukg B_va B_vag B_vak dwf_w fvaklw_w fvakl_w fvaladif lamsbguk rkukg_w rkukk_w weeotkrf_w zuknstm_w /end OUT_MEASUREMENT
 /begin LOC_MEASUREMENT abak anztis avak B_redkl B_uk1 B_uke B_ukk B_ukns B_vaau B_vakl B_val B_wf drkuke_w dwfk_w dwfl_w fbakl_w fbakstaa fbans fbansini_w fbavst_w flamsbg_w ftineo_w fvans fvavst_w fwfkorr_w rkuke_w rkukkl_w rkukl_w rkuk_w sdwfk_w sdwfl_w vti_w wf_w woe_w zbake zbale zvake zvale /end LOC_MEASUREMENT
/end FUNCTION
/begin FUNCTION ESUKAS "5.90"
 /begin DEF_CHARACTERISTIC CUKA FKUKAO FKUKAU FLAMRUKA FLAMSBATM FLAMSVATM FUKABAKI FUKABAKO FUKABAKU FUKABAWI FUKABAWO FUKABAWU FUKAVAKI FUKAVAKO FUKAVAKU FUKAVAWI FUKAVAWO FUKAVAWU FVFKUKA LAMUKAF LAMUKAM NUKAO NUKAU RKUKKTUBA RKUKKTUVA RLUKAO RLUKAU TMNUUKA TMUKAK TMUKAU TMUKAW TNSUUKA TPUKUKA TSPUUKA UKAFRTMO UKAFRTMU /end DEF_CHARACTERISTIC
 /begin REF_CHARACTERISTIC STM09ESUB /end REF_CHARACTERISTIC
 /begin IN_MEASUREMENT B_ba B_dktlp B_enws B_frmax B_frmax2 B_frmin B_frmin2 B_lrs B_lrs2 B_mdarv B_nldg B_nswo1 B_pwf B_slp B_te B_tehb B_va esst_stm09esub fr2_w fra2_w fra_w fr_w lamsons2_w lamsons_w lamzak2_w lamzak_w nmot rkg2_w rkg_w rkukg_w rkukk_w rl tlrs_w tmot tnst_w /end IN_MEASUREMENT
 /begin OUT_MEASUREMENT fukaba_w fukava_w /end OUT_MEASUREMENT
 /begin LOC_MEASUREMENT anzfkuka anzfkuka2 B_cfkuka B_cfkuka2 B_cfuka B_cfuka2 B_ecfuka B_ecfuka2 B_rfkuka B_rfkuka2 B_tmnuka B_tspuuka B_tspuuka2 B_uka B_uka2 B_ukab B_ukabat B_ukaukat B_ukauket B_ukavat fkukaba2_w fkukaba_w fkukas2_w fkukas_w fkukava2_w fkukava_w flamrua2_w flamrua_w flamsba_w flamsva_w fukabak_w fukabaw_w fukavak_w fukavaw_w lamruka2_w lamruka_w rkukkt_w rkukkxn_w tmnuka tpbauka tpvauka ukafrtmo_w ukafrtmu_w /end LOC_MEASUREMENT
/end FUNCTION
/begin FUNCTION ESVW "3.92"
 /begin DEF_CHARACTERISTIC DWEEAMX DWEEMX FWEEMRFAHO FWEEMRFAM KFWEE KFWEEK KFWEEST KFWEETM KLWEESTN MRFAVW SNM08GKUW SRL08GKUB WEAN WEEMRFAN ZZWEETM /end DEF_CHARACTERISTIC
 /begin IN_MEASUREMENT anztib B_stend fho mrfa_w nmot_w rl tmot tmst uzkw_w wnwve_w /end IN_MEASUREMENT
 /begin OUT_MEASUREMENT esst_snm08gkuw esst_srl08gkub wea wee weer /end OUT_MEASUREMENT
 /begin LOC_MEASUREMENT B_kfwee B_mrfamx fweemrfa fweemrfah weemrfa weenst weest weetm /end LOC_MEASUREMENT
/end FUNCTION
/begin FUNCTION ESWE "1.120" /begin DEF_CHARACTERISTIC FIMHU FIMWU FWEHT FWEMRFA FWET /end DEF_CHARACTERISTIC /begin IN_MEASUREMENT anzti B_ll B_sa mrfa_w tmot /end IN_MEASUREMENT /begin OUT_MEASUREMENT fwe /end OUT_MEASUREMENT /begin LOC_MEASUREMENT anzwefim azylwe B_afwe B_fwe /end LOC_MEASUREMENT /end FUNCTION
/begin FUNCTION EVI "1.20"
 /begin IN_MEASUREMENT B_spontan0 B_spontan1 B_spontan2 B_spontan3 B_spontan4 B_spontan5 B_ti_cha0 B_ti_cha1 B_ti_cha2 B_ti_cha3 B_ti_cha4 B_ti_cha5 B_ti_out0 B_ti_out1 B_ti_out2 B_ti_out3 B_ti_out4 B_ti_out5 B_ti_wai0 B_ti_wai1 B_ti_wai2 B_ti_wai3 B_ti_wai4 B_ti_wai5 cc_cha_0 cc_cha_1 cc_cha_2 cc_cha_3 cc_cha_4 cc_cha_5 ti_ev0 ti_ev1 ti_ev2 ti_ev3 ti_ev4 ti_ev5 ti_tvu_w /end IN_MEASUREMENT
/end FUNCTION
/begin FUNCTION FGRABED "1.120"
 /begin DEF_CHARACTERISTIC BFGRO BFGRU CWFGRABED CWFGRGA DNFGRMX DVIVZMX DVOVRMX DVZVIMX NFGRMIN TDVIVZ TDVOVR TDVZVI TFGRABS TFGREPB TFGRFDY TFGRUB TFGRUEOB TFGRUM TFGRUNUB UBFGRMIN VFGREMAX VFGREMIN VFGRMAX VFGRMIN /end DEF_CHARACTERISTIC
 /begin IN_MEASUREMENT bfzgl_w B_absfgr B_acc B_airbag B_brems B_dknolu B_dkpu B_dksbeg B_fdyfgr B_fgr B_fgrat B_fgren B_fgrhe B_fgrhsa B_fgr_um B_gwhs B_kuppl B_nldg B_pwgnotfr gangi nmot_w nsber_w ub vfgr_w vziel_w zstfgr /end IN_MEASUREMENT
 /begin OUT_MEASUREMENT stfgrab_w /end OUT_MEASUREMENT
/end FUNCTION
/begin FUNCTION FGRBESI "1.50" /begin DEF_CHARACTERISTIC CWFGRBESI /end DEF_CHARACTERISTIC
 /begin IN_MEASUREMENT B_acc B_fgr6p B_fgrtbe B_fgrtbh B_fgrtse B_fgrtve B_fgrtvh B_fgrtwa stfgrab_w /end IN_MEASUREMENT
 /begin OUT_MEASUREMENT stfgrbs_w /end OUT_MEASUREMENT
 /begin LOC_MEASUREMENT B_frgbs fgrbesilokbits /end LOC_MEASUREMENT
/end FUNCTION
/begin FUNCTION FGRFULO "1.130"
 /begin DEF_CHARACTERISTIC ANZTPMX ANZTPUD BRABEVI BRATD BRATU BSWKB BSWKV CWFGRFULO CWFGRFULO2 CWFGRLVZ DVIVZTMX DVMAXFGR DVRAMPMX DVSKNBGA DVSKNVGA DVSWKB DVSWKV DVTIPUD DVZVITMX DVZVIWA FSWKB FSWKV KFBRAWA TSWKNBGA TSWKNVGA VREGLMAX VREGLMIN /end DEF_CHARACTERISTIC
 /begin REF_CHARACTERISTIC MRFGRMAX VFGRMAX VFGRMIN /end REF_CHARACTERISTIC
 /begin IN_MEASUREMENT bfzgl_w B_acc B_fgr mrfgr_w stfgrab_w stfgrbs_w uevges vfgr_w /end IN_MEASUREMENT
 /begin OUT_MEASUREMENT bfgrs_w stfgrfl vregl_w vziel_w zstfgr /end OUT_MEASUREMENT
 /begin LOC_MEASUREMENT anztip anztipud brafgr_w bswk_w B_kfvswk B_kfvswkb B_kfvswkv B_tpderl B_tpuerl dvzi_w fgrfulolokbits tswk vfgrlim_w /end LOC_MEASUREMENT
/end FUNCTION
/begin FUNCTION FGRREGL "1.40"
 /begin DEF_CHARACTERISTIC CWFGRREGL DVLLVO DVLLVU DVSAVO DVSAVU FGMRIDV KFVOFFS KKFFGRGA KRAFGRGA MRFGRIMX MRFGRLL MRFGRMAX MRFGRSTA TFGRAR TN2FGRGA TVLADV TZ2FGRGA VLMXVZ /end DEF_CHARACTERISTIC
 /begin IN_MEASUREMENT B_acc B_fgr B_savacc mracc_w mrped_w nmot stfgrab_w stfgrfl uevges vfgr_w vregl_w vziel_w zstfgr /end IN_MEASUREMENT
 /begin OUT_MEASUREMENT B_fgrab B_fgren B_llvfgr B_savfgr fgrreglausbits mrfgr_w /end OUT_MEASUREMENT
 /begin LOC_MEASUREMENT B_fgrdvi ctfgrab dmrar_w dvfgr_w dvivr_w dvzvi_w fgrregllokbits kfgr_w mrfgri_w tn2fgr_w tz2fgr_w uevges_w vfgro_w vlast_w voffs_w /end LOC_MEASUREMENT
/end FUNCTION
/begin FUNCTION FLSUBB "1.90" /begin DEF_CHARACTERISTIC CWFLSUBB /end DEF_CHARACTERISTIC
 /begin IN_MEASUREMENT B_hstlsua B_hstlsua2 B_nmot B_ricalf B_ricalf2 B_rinnp B_rinnp2 B_stend ubsq_w /end IN_MEASUREMENT
 /begin OUT_MEASUREMENT B_elsxbb B_elsxbb2 B_sbblsu B_sbblsu2 /end OUT_MEASUREMENT
/end FUNCTION
/begin FUNCTION FUEDK "23.50"
 /begin DEF_CHARACTERISTIC CWFUEDK DRLSOLMF EVTMODMNDK FMIUGDSN FPWDKAPP KFWDKMSN KFWDKSMX MRFABUMX MRFARUGDN PSPVDKUGDL TWDKSV UMSRLNMN WDKSAPP WDKSOFS ZKPSFIL /end DEF_CHARACTERISTIC
 /begin REF_CHARACTERISTIC CWRLAPPL KLAF PSPVDKUG SNM12FEUB /end REF_CHARACTERISTIC
 /begin IN_MEASUREMENT B_fpwdkap B_ll B_llrein B_lsd B_mgbget B_nmin B_stend B_tfwdksom B_wdksap B_wdksom drlfue_w esst_snm12feub evtmod fho_w fkmsdk_w fpbrkds_w frhodk_w ftvdk fupsrl_w mifafu_w milsol_w mimax_w ml_w mrfamx_w mrfa_w msndko_w mste nmot nmot_w pbrint_w pspvdk_w ps_w pu_w pvdk_w rlsol_w tfwdksom_w umsrln_w vfzg wdksom_w wdkugd_w wped_w /end IN_MEASUREMENT
 /begin OUT_MEASUREMENT B_fkmsdks mlsol_w psfil_w pssol_w wdksap_w /end OUT_MEASUREMENT
 /begin LOC_MEASUREMENT B_dwdksus B_klafbg B_mfact B_ugds B_wdkap drlsolmf_w dwdksumx_w dwdksus_w fklafs_w fuedkLocalBits mlwdknf_w mrfabugd_w mrfaugd_w msdks_w msndkoos_w msndks_w pspvmin_w psspvdkb_w psspvdk_w pvdkr_w rlfgks_w tfwdks_w wdksbugd_w wdksgv_w wdksmx_w wdksv_w /end LOC_MEASUREMENT
/end FUNCTION
/begin FUNCTION FUEDKSA "1.21" /begin DEF_CHARACTERISTIC CWWDKSPE DKNOTBEGR ENTDKLL ENTDKNLL TVWDKS /end DEF_CHARACTERISTIC
 /begin IN_MEASUREMENT B_dknolu B_dkpiu B_dksbeg B_i_ska_um B_ll B_wdk1v nmot wdknlp_w wdksap_w /end IN_MEASUREMENT
 /begin OUT_MEASUREMENT dwdks_w wdks wdksp_w wdks_w /end OUT_MEASUREMENT
 /begin LOC_MEASUREMENT wdkink_w wdksba2_w wdksba_w wdksb_w wdksfl wdkspa_w wdksvfl wdkswe_w /end LOC_MEASUREMENT
/end FUNCTION
/begin FUNCTION FUEREG "4.80"
 /begin DEF_CHARACTERISTIC CWFUEREG DFAFRG FPLMRM ILMRMN ILMRMX ILMRN KFPLMR KFPLMRMSR TVFRG /end DEF_CHARACTERISTIC
 /begin REF_CHARACTERISTIC CWRLAPPL SNM08FEUB /end REF_CHARACTERISTIC
 /begin IN_MEASUREMENT B_asr B_fkmsdks B_llrpd B_msr B_nswo1 B_stend esst_snm08feub nmot nmotll rlsol_w rl_w tmot /end IN_MEASUREMENT
 /begin OUT_MEASUREMENT drlfuei_w drlfuep_w drlfue_w /end OUT_MEASUREMENT
 /begin LOC_MEASUREMENT B_furena B_furpen B_stndfr drlm_w /end LOC_MEASUREMENT
/end FUNCTION
/begin FUNCTION GGCANECU "4.20"
 /begin DEF_CHARACTERISTIC ANZ_ZRPH CWANLEN CWCANMD CWKL15SP DNLLCAUVW DWLLPED FWTMUEBO FWTMUEBU FWTOUEBO FWTOUEBU NEINSPUR NLLMNCAUVW NLLMXCAN NLLMXCAUVW NMGETMC NSTAW TDGNIOANL TGENLRC TGENLRC2 TMHLDO TMHLON TSTAW TVNKL15 T_ANLEN T_ANLEVFZ VFZANL WLLPED /end DEF_CHARACTERISTIC
 /begin REF_CHARACTERISTIC CWCAUVW CW_CAN_R_0___A CW_CAN_R_1___A CW_CAN_R_2___A CW_CAN_R_3___A CW_CAN_R_4___A CW_CAN_R_5___A CW_CAN_R_6___A CW_CAN_R_7___A CW_CAN_RA MDNORM NSLBZFS NSLBZFS1 NSLBZFS2 NSLBZLL NSLBZLL1 NSLBZLL2 /end REF_CHARACTERISTIC
 /begin IN_MEASUREMENT bfgrsbr bfgrs_w B_accen B_adrbot B_bl B_br B_dknolu B_eculock B_fgr B_fgrbr B_fgren B_fgrhsa B_fgrte B_fs B_hlonkmtr B_i_ska_fr B_kl15 B_kl50 B_ll B_nlbzanf B_nlbzanf2 B_nldg B_nmin B_pwf B_st mdverl_w miautget_w miautgs_w miges_w migsl_w migs_w miist_w milsol_w misgsl_w misol_w mizwmn_w mrfamx_w mrfgr_w mrped_w nmot nmot_w nsol nstat S_bls S_brs tmot tnst_w toelk_w vfzg vregl_w vzgrac vziel_w wpedv_w wpfgr_w zrph zrph2 zstfgr /end IN_MEASUREMENT
 /begin OUT_MEASUREMENT bfgrsc B_anlasc B_anlfr B_blc B_brc B_cdma B_dnmcan B_genlrc B_genlrc2 B_gralc B_gsala B_kl15sp B_llped B_mshlon B_nlebem1 B_nlebem2 B_statbr B_statge B_statgec B_statmd B_statmdc B_statme B_statme_t B_statnb B_statto B_stattoc B_tolueb dnmcan genlrc mdverlc miautgetc miautgsc miistc mizwmnc nmot_c statgra wpedc /end OUT_MEASUREMENT
 /begin LOC_MEASUREMENT nstaw_w tnkl50 tstawk /end LOC_MEASUREMENT
/end FUNCTION
/begin FUNCTION GGCASR "1.180" /begin DEF_CHARACTERISTIC CWMSRCAN KLDMASRL RAMPASR TVCAMSR T_ASRFGR VECDMN VECDMX /end DEF_CHARACTERISTIC
 /begin REF_CHARACTERISTIC CW_CAN_R_0___A CW_CAN_R_1___A CW_CAN_R_2___A CW_CAN_R_3___A CW_CAN_R_4___A CW_CAN_R_5___A CW_CAN_R_6___A CW_CAN_R_7___A NOASR /end REF_CHARACTERISTIC
 /begin IN_MEASUREMENT B_amsrbot B_amsrf B_asrakt B_asr_can B_bkvvc B_edsfgr B_fgrabz B_msrakt B_msr_can B_nomsr_fr B_nomsr_um B_npcanswe B_nuamsr B_statbr B_statmd B_swecan miasrl_can miasrs_can mimsr_can nmot vamsr_c vfgr_w vrad_hl_c vrad_hr_c vrad_vl_c vrad_vr_c /end IN_MEASUREMENT
 /begin OUT_MEASUREMENT B_amsren B_amsr_t B_bkvv B_br1en B_fdyfgr B_msrdis B_swe_b B_vabsff B_vradhlff B_vradhrff B_vradvlff B_vradvrff miasrllk miasrl_w miasrslk miasrs_w mimsrlk mimsr_w vamsr_w vrad_hl_w vrad_hr_w vrad_vl_w vrad_vr_w /end OUT_MEASUREMENT
/end FUNCTION
/begin FUNCTION GGCASRPL "1.50" /begin DEF_CHARACTERISTIC DBZ_MX MSRMDTMX NOASR TAMSRCMX TMSRCERR TMSRCNU VMINAMSR /end DEF_CHARACTERISTIC
 /begin REF_CHARACTERISTIC CW_CAN_C_0___A CW_CAN_C_1___A CW_CAN_C_2___A CW_CAN_C_3___A CW_CAN_R_0___A CW_CAN_R_1___A CW_CAN_R_2___A CW_CAN_R_3___A CW_CAN_R_4___A CW_CAN_R_5___A CW_CAN_R_6___A CW_CAN_R_7___A CW_CAN_RA MDNORM /end REF_CHARACTERISTIC
 /begin IN_MEASUREMENT aquerc bz_can B_amsrbot B_aquerc B_asr_can B_ctout B_msr_can B_neamsr B_nebr3 B_nomsr_um B_nuamsr B_terrbr1 B_terrbr2 B_terrbr3 mdverl_w miasrl_can miasrs_can mimsr_can vamsr_w /end IN_MEASUREMENT
 /begin OUT_MEASUREMENT aquer bz_msr B_amsrf B_amsrinpl B_amsrn B_aquer B_asrakt B_msrakt B_msrphnpl B_nomsr_fr B_nomsr_t B_savmsr msrmdt_w /end OUT_MEASUREMENT
 /begin LOC_MEASUREMENT bz_diff B_amsrknpl B_msrtnpl B_msrvnpl /end LOC_MEASUREMENT
/end FUNCTION
/begin FUNCTION GGCEGS "8.30"
 /begin DEF_CHARACTERISTIC CWFS CWGEMD CWGGCEGS DNMZGEZW DRLZGEZW GANGNOT KFMGES MDGRADGES MIGESMN TFALLMIGES TGWHPOSG TMGESMN TNSTGES TZGEZWMX T_SFSEN /end DEF_CHARACTERISTIC
 /begin REF_CHARACTERISTIC CW_CAN_R_0___A CW_CAN_R_1___A CW_CAN_R_2___A CW_CAN_R_3___A CW_CAN_R_4___A CW_CAN_R_5___A CW_CAN_R_6___A CW_CAN_R_7___A CW_CAN_RA MDNORM /end REF_CHARACTERISTIC
 /begin IN_MEASUREMENT B_autget B_bus_off B_ge1bot B_genot B_ges B_gsaf1 B_kl15 B_ll B_milfbg B_nege B_nuge B_zges B_zwnget gangautic gwhpos mdgbeg mdwange1 mibas_w mifa_w migssc_w migszc_w migs_can miist_w mizwmn_w nmot_w rlsol_w rl_w statgesc statwkc tnst_w uefktge1 vfzg_w /end IN_MEASUREMENT
 /begin OUT_MEASUREMENT B_fawsp B_gess B_gsaf B_gsrzw B_gwhposg B_mdmxge B_mdwaner B_mgbget B_miecges B_milfb B_nmaxge B_tippg B_vagsl B_wk B_wkauf B_wkr B_zgezw gangauti ggcegsNvBits mdgrad_w mdwancan miecges_w miecgmx_w miges_w migsc_w migsleg_w migs_w misgseg_w misgsleg_w S_fs uefktget uefktget_w /end OUT_MEASUREMENT
 /begin LOC_MEASUREMENT B_gbst7err B_trqmin mierrcan_w mifroz_w misgelok_w /end LOC_MEASUREMENT
/end FUNCTION
/begin FUNCTION GGCEGSPL "3.30" /begin DEF_CHARACTERISTIC DBZ_GE3 GE3MDTMX T_GE3CMX T_GE3CNU /end DEF_CHARACTERISTIC
 /begin REF_CHARACTERISTIC CW_CAN_R_0___A CW_CAN_R_1___A CW_CAN_R_2___A CW_CAN_R_3___A CW_CAN_R_4___A CW_CAN_R_5___A CW_CAN_R_6___A CW_CAN_R_7___A CW_CAN_RA MDNORM /end REF_CHARACTERISTIC
 /begin IN_MEASUREMENT B_aakupplc B_cvtad_c B_fku_c B_geco_c B_gekoa_c B_genot_c B_ges_c B_gsaf1_c B_gsch_c B_milfbg_c B_motaus_c B_nege B_nosgs_um B_nuge B_sacvt_c B_terrge B_zges_c gangauti_c gwhpos_c klah_c mdgbeg_c mdverl_w mdwange1_c migs_c nllcvt1_c nsywin_c nsyw_c statwk_c tsyn_c uefktge1_c /end IN_MEASUREMENT
 /begin OUT_MEASUREMENT B_aakuppl B_bzge3 B_cvtad B_fku B_geco B_gekoa B_genot B_ges B_gsaf1 B_gsaf3 B_gsch B_milfbg B_motaus B_sacvt B_uefge3 B_zges gangautic gwhpos klahc mdgbeg mdwange1 mdwange3 migssc_w migszc_w migs_can nllcvt1 nsyw nsywin statgesc statgezc statwkc tsyn uefktge1 /end OUT_MEASUREMENT
/end FUNCTION
/begin FUNCTION GGCGRA "1.90"
 /begin DEF_CHARACTERISTIC CSGRA DBZ_GRA TGRACMX TGRACNU T_NOMGRA T_NOMGRAD T_NOMGRATA /end DEF_CHARACTERISTIC
 /begin REF_CHARACTERISTIC CW_CAN_R_0___A CW_CAN_R_1___A CW_CAN_R_2___A CW_CAN_R_3___A CW_CAN_R_4___A CW_CAN_R_5___A CW_CAN_R_6___A CW_CAN_R_7___A CW_CAN_S_0___A CW_CAN_S_1___A /end REF_CHARACTERISTIC
 /begin IN_MEASUREMENT B_ctout B_fgrat B_fgrhsa B_fgrtbe B_fgrtbh B_fgrte B_fgrtse B_fgrtve B_fgrtvh B_fgrtwa B_grabot B_gracan /end IN_MEASUREMENT
 /begin OUT_MEASUREMENT bz_gra B_adrgra B_cfgra B_csgra B_fgratc B_fgrbec B_fgrhec B_fgrhsc B_fgrsec B_fgrtdc B_fgrthsc B_fgrtuc B_fgrvec B_fgrwac B_grabz B_grabz1 B_grabz2 B_negra B_nugra B_rengra B_tgramx B_tgranu cs_gra fgrscodc /end OUT_MEASUREMENT
 /begin LOC_MEASUREMENT B_adrgra_z B_fgratc_z B_fgrbec_z B_fgrhec_z B_fgrhsc_z B_fgrsec_z B_fgrtdc_z B_fgrthsc_z B_fgrtuc_z B_fgrvec_z B_fgrwac_z /end LOC_MEASUREMENT
/end FUNCTION
/begin FUNCTION GGCS "4.20"
 /begin DEF_CHARACTERISTIC ACSZNBM ACSZRPH CWCS_0_A CWCS_1_A DBZ_AIR NMOTDELAY TAIRCMX TAIRCNU TBPWMCS TCONT_HILO TCRCAN TCSERC TCSERNPL TCSERP TVPWMCSR TVPWMCSS UPWMCS ZPWMCS ZPWMCSMAX /end DEF_CHARACTERISTIC
 /begin REF_CHARACTERISTIC NSTNM /end REF_CHARACTERISTIC
 /begin IN_MEASUREMENT bz_air B_aircan B_airnbot B_csair B_csairio B_ctout B_kl15 B_nmin B_nmot B_nuair B_stend nmot nmot_w P_crsh tmot ub zrph /end IN_MEASUREMENT
 /begin OUT_MEASUREMENT B_airbag B_airbz B_airbz1 B_airbz2 B_crcan B_crnmn B_crstio B_csernpl B_epwmcs B_hpwmcs B_pwmcs B_tairmx B_tairnu B_tcrcan crshDetect cserk /end OUT_MEASUREMENT
 /begin LOC_MEASUREMENT B_crcan_20ms B_pwmcs_50ms B_pwmfcs tpwmcs /end LOC_MEASUREMENT
/end FUNCTION
/begin FUNCTION GGCTOL "1.60" /begin DEF_CHARACTERISTIC TERRTOLC TVTOLC TVTOLE /end DEF_CHARACTERISTIC /begin IN_MEASUREMENT B_ckien B_ctout B_nucins2 B_nutog B_tolcb tolc /end IN_MEASUREMENT /begin OUT_MEASUREMENT B_ctol B_ctole ctol /end OUT_MEASUREMENT /end FUNCTION
/begin FUNCTION GGCTUM "1.10" /begin DEF_CHARACTERISTIC TVTUMC /end DEF_CHARACTERISTIC /begin IN_MEASUREMENT B_ckien B_ctout B_tumcb tumc /end IN_MEASUREMENT /begin OUT_MEASUREMENT B_ctum B_ctume ctum /end OUT_MEASUREMENT /end FUNCTION
/begin COMPU_METHOD acc_sb_q0p1 "" RAT_FUNC "%6.3" "m/(s^2)" COEFFS 0 10 0 0 0 1 /end COMPU_METHOD
/begin COMPU_METHOD bfgrsc_ub_q0p024_o3p984 "" RAT_FUNC "%6.3" "m/(s^2)" COEFFS 0 1 3.984 0 0 0.024 /end COMPU_METHOD
/begin COMPU_METHOD bfzg_sw_q4p239Em4 "" RAT_FUNC "%10.7" "m/s^2" COEFFS 0 1 0 0 0 0.0004239 /end COMPU_METHOD
/begin COMPU_METHOD bfzg_uw_q4p239Em4 "" RAT_FUNC "%6.5" "" COEFFS 0 1 0 0 0 0.0004239 /end COMPU_METHOD
/begin COMPU_METHOD B_TRUE "" TAB_VERB "%6.3" "" COMPU_TAB_REF B_TRUE /end COMPU_METHOD
/begin COMPU_VTAB B_TRUE "" TAB_VERB 2 0 "----" 1 "TRUE" /end COMPU_VTAB
/begin COMPU_METHOD DEZ "" RAT_FUNC "%6.2" "" COEFFS 0 1 0 0 0 1 /end COMPU_METHOD
/begin COMPU_METHOD dez "" RAT_FUNC "%6.2" "" COEFFS 0 1 0 0 0 1 /end COMPU_METHOD
/begin COMPU_METHOD fak_q0p0039 "" RAT_FUNC "%6.4" "-" COEFFS 0 256 0 0 0 1 /end COMPU_METHOD
/begin COMPU_METHOD fak_q0p02 "" RAT_FUNC "%6.4" "" COEFFS 0 50 0 0 0 1 /end COMPU_METHOD
/begin COMPU_METHOD fak_q0p03815 "" RAT_FUNC "%6.4" "%/(s*kg/h)" COEFFS 0 65536 0 0 0 2500 /end COMPU_METHOD
/begin COMPU_METHOD fak_q0p0625 "" RAT_FUNC "%6.4" "-" COEFFS 0 16 0 0 0 1 /end COMPU_METHOD
/begin COMPU_METHOD fak_q0p1 "" RAT_FUNC "%6.3" "-" COEFFS 0 1 0 0 0 0.1 /end COMPU_METHOD
/begin COMPU_METHOD fak_sb_b1 "" RAT_FUNC "%6.4" "-" COEFFS 0 256 0 0 0 2 /end COMPU_METHOD
/begin COMPU_METHOD fak_sw_b1 "" RAT_FUNC "%7.6" "-" COEFFS 0 65536 0 0 0 2 /end COMPU_METHOD
/begin COMPU_METHOD fak_sw_b2 "" RAT_FUNC "%7.6" "-" COEFFS 0 65536 0 0 0 4 /end COMPU_METHOD
/begin COMPU_METHOD fak_sw_b256 "" RAT_FUNC "%6.4" "-" COEFFS 0 65536 0 0 0 512 /end COMPU_METHOD
/begin COMPU_METHOD fak_sw_b64 "" RAT_FUNC "%6.4" "-" COEFFS 0 65536 0 0 0 128 /end COMPU_METHOD
/begin COMPU_METHOD fak_ub_b0p125 "" RAT_FUNC "%6.5" "-" COEFFS 0 256 0 0 0 0.125 /end COMPU_METHOD
/begin COMPU_METHOD fak_ub_b0p25 "" RAT_FUNC "%10.7" "-" COEFFS 0 256 0 0 0 0.25 /end COMPU_METHOD
/begin COMPU_METHOD fak_ub_b1 "" RAT_FUNC "%6.4" "-" COEFFS 0 256 0 0 0 1 /end COMPU_METHOD
/begin COMPU_METHOD fak_ub_b16 "" RAT_FUNC "%6.4" "-" COEFFS 0 256 0 0 0 16 /end COMPU_METHOD
/begin COMPU_METHOD fak_ub_b2 "" RAT_FUNC "%6.4" "-" COEFFS 0 256 0 0 0 2 /end COMPU_METHOD
/begin COMPU_METHOD fak_ub_b4 "" RAT_FUNC "%6.4" "-" COEFFS 0 256 0 0 0 4 /end COMPU_METHOD
/begin COMPU_METHOD fak_ub_b64 "" RAT_FUNC "%6.3" "-" COEFFS 0 256 0 0 0 64 /end COMPU_METHOD
/begin COMPU_METHOD fak_ub_b8 "" RAT_FUNC "%6.4" "-" COEFFS 0 256 0 0 0 8 /end COMPU_METHOD
/begin COMPU_METHOD fak_uw_b1 "" RAT_FUNC "%7.6" "-" COEFFS 0 65536 0 0 0 1 /end COMPU_METHOD
/begin COMPU_METHOD fak_uw_b16 "" RAT_FUNC "%6.5" "-" COEFFS 0 65536 0 0 0 16 /end COMPU_METHOD
/begin COMPU_METHOD fak_uw_b2 "" RAT_FUNC "%7.6" "-" COEFFS 0 65536 0 0 0 2 /end COMPU_METHOD
/begin COMPU_METHOD fak_uw_b4 "" RAT_FUNC "%7.6" "-" COEFFS 0 65536 0 0 0 4 /end COMPU_METHOD
/begin COMPU_METHOD fak_uw_b64 "" RAT_FUNC "%6.5" "-" COEFFS 0 65536 0 0 0 64 /end COMPU_METHOD
/begin COMPU_METHOD fak_uw_b8 "" RAT_FUNC "%6.5" "-" COEFFS 0 65536 0 0 0 8 /end COMPU_METHOD
/begin COMPU_METHOD kw_q0p0019 "" RAT_FUNC "%6.4" "Grad KW" COEFFS 0 512 0 0 0 1 /end COMPU_METHOD
/begin COMPU_METHOD kw_q0p0234 "" RAT_FUNC "%6.4" "Grad KW" COEFFS 0 32768 0 0 0 768 /end COMPU_METHOD
/begin COMPU_METHOD kw_q0p5 "" RAT_FUNC "%6.3" "Grad KW" COEFFS 0 2 0 0 0 1 /end COMPU_METHOD
/begin COMPU_METHOD kw_q2p8125 "" RAT_FUNC "%6.2" "°KW" COEFFS 0 1 0 0 0 2.8125 /end COMPU_METHOD
/begin COMPU_METHOD mdt_sw_b2556 "" RAT_FUNC "%6.4" "Nms" COEFFS 0 65536 0 0 0 5112 /end COMPU_METHOD
/begin COMPU_METHOD md_ub_q10 "" RAT_FUNC "%6.1" "Nm" COEFFS 0 1 0 0 0 10 /end COMPU_METHOD
/begin COMPU_METHOD m_q0p00195 "" RAT_FUNC "%6.4" "kg/(h*s)" COEFFS 0 65536 0 0 0 128 /end COMPU_METHOD
/begin COMPU_METHOD m_q0p0031 "" RAT_FUNC "%6.4" "kg/h" COEFFS 0 320 0 0 0 1 /end COMPU_METHOD
/begin COMPU_METHOD m_q0p004 "" RAT_FUNC "%6.4" "kg/h" COEFFS 0 250 0 0 0 1 /end COMPU_METHOD
/begin COMPU_METHOD m_q0p1 "" RAT_FUNC "%6.3" "kg/h" COEFFS 0 10 0 0 0 1 /end COMPU_METHOD
/begin COMPU_METHOD m_ub_b1020 "" RAT_FUNC "%6.2" "kg/h" COEFFS 0 1 0 0 0 4 /end COMPU_METHOD
/begin COMPU_METHOD m_ub_b23p3 "" RAT_FUNC "%6.3" "kg" COEFFS 0 2812.5 0 0 0 256 /end COMPU_METHOD
/begin COMPU_METHOD m_ub_b25p6 "" RAT_FUNC "%6.3" "kg/h" COEFFS 0 256 0 0 0 25.6 /end COMPU_METHOD
/begin COMPU_METHOD m_ub_q0p0444 "" RAT_FUNC "%6.4" "g" COEFFS 0 1 0 0 0 0.0444 /end COMPU_METHOD
/begin COMPU_METHOD m_uw_b23p3 "" RAT_FUNC "%6.5" "kg" COEFFS 0 2812.5 0 0 0 1 /end COMPU_METHOD
/begin COMPU_METHOD m_uw_b6553p5 "" RAT_FUNC "%6.3" "kg/h" COEFFS 0 1 0 0 0 0.1 /end COMPU_METHOD
/begin COMPU_METHOD m_uw_q0p0005 "" RAT_FUNC "%6.5" "kg/h" COEFFS 0 1 0 0 0 0.0005 /end COMPU_METHOD
/begin COMPU_METHOD nmotg_sw_b13p89 "" RAT_FUNC "%6.5" "m/(s**2)" COEFFS 0 2359.11 0 0 0 1 /end COMPU_METHOD
/begin COMPU_METHOD nmot_ub_q10 "" RAT_FUNC "%6.1" "1/min" COEFFS 0 1 0 0 0 10 /end COMPU_METHOD
/begin COMPU_METHOD nmot_ub_q25 "" RAT_FUNC "%6.1" "Upm" COEFFS 0 1 0 0 0 25 /end COMPU_METHOD
/begin COMPU_METHOD nmot_ub_q40 "" RAT_FUNC "%6.1" "1/min" COEFFS 0 1 0 0 0 40 /end COMPU_METHOD
/begin COMPU_METHOD nmot_uw_q0p25 "" RAT_FUNC "%6.3" "1/min" COEFFS 0 1 0 0 0 0.25 /end COMPU_METHOD
/begin COMPU_METHOD p_uw_q0p039 "" RAT_FUNC "%6.4" "hPa" COEFFS 0 256 0 0 0 10 /end COMPU_METHOD
/begin COMPU_METHOD relDK_ub_b100 "" RAT_FUNC "%6.3" "%DK" COEFFS 0 255 0 0 0 100 /end COMPU_METHOD
/begin COMPU_METHOD relDK_uw_b100 "" RAT_FUNC "%6.4" "%DK" COEFFS 0 65535 0 0 0 100 /end COMPU_METHOD
/begin COMPU_METHOD relPED_q0p00153 "" RAT_FUNC "%6.4" "% PED" COEFFS 0 65535 0 0 0 100 /end COMPU_METHOD
/begin COMPU_METHOD relPED_uw_b100 "" RAT_FUNC "%6.4" "%PED" COEFFS 0 65535 0 0 0 100 /end COMPU_METHOD
/begin COMPU_METHOD rel_q0p09375 "" RAT_FUNC "%6.3" "%" COEFFS 0 1 0 0 0 0.09375 /end COMPU_METHOD
/begin COMPU_METHOD rel_sw_b100 "" RAT_FUNC "%6.4" "%" COEFFS 0 32768 0 0 0 100 /end COMPU_METHOD
/begin COMPU_METHOD rel_sw_b1536 "" RAT_FUNC "%6.4" "%" COEFFS 0 65536 0 0 0 3072 /end COMPU_METHOD
/begin COMPU_METHOD rel_sw_b1p5 "" RAT_FUNC "%7.6" "%" COEFFS 0 32768 0 0 0 1.5 /end COMPU_METHOD
/begin COMPU_METHOD rel_sw_b200 "" RAT_FUNC "%6.4" "%" COEFFS 0 65536 0 0 0 400 /end COMPU_METHOD
/begin COMPU_METHOD rel_sw_q0p0234 "" RAT_FUNC "%6.4" "%/seg" COEFFS 0 32 0 0 0 0.75 /end COMPU_METHOD
/begin COMPU_METHOD rel_sw_q0p0468 "" RAT_FUNC "%6.4" "%" COEFFS 0 65536 0 0 0 3072 /end COMPU_METHOD
/begin COMPU_METHOD rel_ub_b100 "" RAT_FUNC "%6.3" "%" COEFFS 0 256 0 0 0 100 /end COMPU_METHOD
/begin COMPU_METHOD rel_ub_b127p5 "" RAT_FUNC "%6.3" "%" COEFFS 0 2 0 0 0 1 /end COMPU_METHOD
/begin COMPU_METHOD rel_ub_b200 "" RAT_FUNC "%6.3" "%" COEFFS 0 256 0 0 0 200 /end COMPU_METHOD
/begin COMPU_METHOD rel_ub_b99p6 "" RAT_FUNC "%6.3" "%" COEFFS 0 256 0 0 0 100 /end COMPU_METHOD
/begin COMPU_METHOD rel_ub_q0p75 "" RAT_FUNC "%6.3" "%" COEFFS 0 1 0 0 0 0.75 /end COMPU_METHOD
/begin COMPU_METHOD rel_uw_b100 "" RAT_FUNC "%6.4" "%" COEFFS 0 65536 0 0 0 100 /end COMPU_METHOD
/begin COMPU_METHOD rel_uw_b20 "" RAT_FUNC "%6.5" "km/h" COEFFS 0 65536 0 0 0 20 /end COMPU_METHOD
/begin COMPU_METHOD rel_uw_b200 "" RAT_FUNC "%6.4" "%" COEFFS 0 65536 0 0 0 200 /end COMPU_METHOD
/begin COMPU_METHOD rel_uw_b3072 "" RAT_FUNC "%6.4" "%" COEFFS 0 65536 0 0 0 3072 /end COMPU_METHOD
/begin COMPU_METHOD rel_uw_b3200 "" RAT_FUNC "%6.4" "%" COEFFS 0 65536 0 0 0 3200 /end COMPU_METHOD
/begin COMPU_METHOD rel_uw_q0p0234 "" RAT_FUNC "%6.4" "%" COEFFS 0 32 0 0 0 0.75 /end COMPU_METHOD
/begin COMPU_METHOD spg_q4p88Em4 "" RAT_FUNC "%6.5" "V" COEFFS 0 2048 0 0 0 1 /end COMPU_METHOD
/begin COMPU_METHOD spg_ubatt "" RAT_FUNC "%6.4" "V" COEFFS 0 1 0 0 0 0.0704 /end COMPU_METHOD
/begin COMPU_METHOD spg_ub_b17p37 "" RAT_FUNC "%6.4" "V" COEFFS 0 255 0 0 0 17.37 /end COMPU_METHOD
/begin COMPU_METHOD t100msxs_ub_b25p5 "" RAT_FUNC "%6.3" "s" COEFFS 0 1 0 0 0 0.1 /end COMPU_METHOD
/begin COMPU_METHOD t100msxs_uw_b6553p5 "" RAT_FUNC "%6.3" "s" COEFFS 0 1 0 0 0 0.1 /end COMPU_METHOD
/begin COMPU_METHOD t100msxs_uw_b6553p6 "" RAT_FUNC "%6.3" "s" COEFFS 0 10 0 0 0 1 /end COMPU_METHOD
/begin COMPU_METHOD t10msxs_ub_b2p55 "" RAT_FUNC "%6.4" "s" COEFFS 0 1 0 0 0 0.01 /end COMPU_METHOD
/begin COMPU_METHOD t10msxs_uw_b655p35 "" RAT_FUNC "%6.4" "s" COEFFS 0 1 0 0 0 0.01 /end COMPU_METHOD
/begin COMPU_METHOD t1sxs_q3 "" RAT_FUNC "%6.2" "s" COEFFS 0 1 0 0 0 3 /end COMPU_METHOD
/begin COMPU_METHOD t1sxs_ub_b255 "" RAT_FUNC "%6.2" "s" COEFFS 0 1 0 0 0 1 /end COMPU_METHOD
/begin COMPU_METHOD t1sxs_uw_b65535 "" RAT_FUNC "%6.2" "s" COEFFS 0 1 0 0 0 1 /end COMPU_METHOD
/begin COMPU_METHOD t1sxs_uw_q1 "" RAT_FUNC "%6.2" "s" COEFFS 0 1 0 0 0 1 /end COMPU_METHOD
/begin COMPU_METHOD t20msxs_ub_b5p1 "" RAT_FUNC "%6.4" "s" COEFFS 0 1 0 0 0 0.02 /end COMPU_METHOD
/begin COMPU_METHOD t20msxs_ub_q0p02 "" RAT_FUNC "%6.4" "s" COEFFS 0 50 0 0 0 1 /end COMPU_METHOD
/begin COMPU_METHOD t20msxs_uw_b1310 "" RAT_FUNC "%6.4" "s" COEFFS 0 1 0 0 0 0.02 /end COMPU_METHOD
/begin COMPU_METHOD t20msxs_uw_q0p02 "" RAT_FUNC "%6.4" "s" COEFFS 0 1 0 0 0 0.02 /end COMPU_METHOD
/begin COMPU_METHOD t50msxs_ub_b12p75 "" RAT_FUNC "%6.4" "s" COEFFS 0 1 0 0 0 0.05 /end COMPU_METHOD
/begin COMPU_METHOD t6minxh_b6553p5 "" RAT_FUNC "%6.3" "h" COEFFS 0 10 0 0 0 1 /end COMPU_METHOD
/begin COMPU_METHOD temp_q0p0234_o273 "" RAT_FUNC "%6.1" "Grad C" COEFFS 0 1 273.15 0 0 0.0234375 /end COMPU_METHOD
/begin COMPU_METHOD temp_ub_b191p25 "" RAT_FUNC "%6.3" "Grad C" COEFFS 0 1 0 0 0 0.75 /end COMPU_METHOD
/begin COMPU_METHOD temp_ub_q0p75_o48 "" RAT_FUNC "%6.2" "Grad C" COEFFS 0 1 48 0 0 0.75 /end COMPU_METHOD
/begin COMPU_METHOD temp_ub_q1_o60 "" RAT_FUNC "%6.2" "Grad C" COEFFS 0 1 60 0 0 1 /end COMPU_METHOD
/begin COMPU_METHOD txms_ub_q0p1 "" RAT_FUNC "%6.3" "ms" COEFFS 0 10 0 0 0 1 /end COMPU_METHOD
/begin COMPU_METHOD t_q0p01 "" RAT_FUNC "%6.4" "s" COEFFS 0 100 0 0 0 1 /end COMPU_METHOD
/begin COMPU_METHOD t_q0p1 "" RAT_FUNC "%6.3" "s" COEFFS 0 10 0 0 0 1 /end COMPU_METHOD
/begin COMPU_METHOD t_q1 "" RAT_FUNC "%6.2" "s" COEFFS 0 1 0 0 0 1 /end COMPU_METHOD
/begin COMPU_METHOD t_q20_ms "" RAT_FUNC "%6.1" "ms" COEFFS 0 1 0 0 0 20 /end COMPU_METHOD
/begin COMPU_METHOD uefktget_ub_b25p4 "" RAT_FUNC "%6.3" "" COEFFS 0 10 0 0 0 1 /end COMPU_METHOD
/begin COMPU_METHOD vfzg_sw_q0p00781 "" RAT_FUNC "%6.4" "km/h" COEFFS 0 1 0 0 0 0.0078125 /end COMPU_METHOD
/begin COMPU_METHOD vfzg_ub_q1p25 "" RAT_FUNC "%6.2" "km/h" COEFFS 0 1 0 0 0 1.25 /end COMPU_METHOD
/begin COMPU_METHOD vfzg_uw_b325 "" RAT_FUNC "%6.4" "km/h" COEFFS 0 65536 0 0 0 325 /end COMPU_METHOD
/begin COMPU_METHOD vfzg_uw_b512 "" RAT_FUNC "%6.4" "km/h" COEFFS 0 65536 0 0 0 512 /end COMPU_METHOD
/begin COMPU_METHOD vfzg_uw_q0p00781 "" RAT_FUNC "%6.4" "km/h" COEFFS 0 1 0 0 0 0.0078125 /end COMPU_METHOD
/begin COMPU_METHOD vfzg_uw_q0p0078125 "" RAT_FUNC "%6.4" "km/h" COEFFS 0 1 0 0 0 0.0078125 /end COMPU_METHOD
/begin COMPU_METHOD vrad_uw_b655 "" RAT_FUNC "%6.4" "km/h" COEFFS 0 65536 0 0 0 655 /end COMPU_METHOD
/begin COMPU_METHOD zk100msxs_uw_b6553 "" RAT_FUNC "%6.1" "s" COEFFS 0 0 65536 0 10 0 /end COMPU_METHOD
/begin COMPU_METHOD zk10msxs_uw_b655 "" RAT_FUNC "%6.2" "s" COEFFS 0 0 65536 0 100 0 /end COMPU_METHOD
/begin COMPU_METHOD zk20msxs_uw_b1310 "" RAT_FUNC "%12.4" "s" COEFFS 0 0 65536 0 50 0 /end COMPU_METHOD
/begin COMPU_METHOD zw_sb_q6 "" RAT_FUNC "%6.2" "Grad KW" COEFFS 0 1 0 0 0 6 /end COMPU_METHOD
/begin COMPU_METHOD zw_ub_q6 "" RAT_FUNC "%6.2" "Grad KW" COEFFS 0 255 0 0 0 1530 /end COMPU_METHOD
/begin RECORD_LAYOUT FklWUb FNC_VALUES 1 UBYTE COLUMN_DIR DIRECT /end RECORD_LAYOUT
/begin RECORD_LAYOUT FklWUw FNC_VALUES 1 UWORD COLUMN_DIR DIRECT /end RECORD_LAYOUT
/begin RECORD_LAYOUT GkfWUb FNC_VALUES 1 UBYTE COLUMN_DIR DIRECT /end RECORD_LAYOUT
/begin RECORD_LAYOUT GklWSw FNC_VALUES 1 SWORD COLUMN_DIR DIRECT /end RECORD_LAYOUT
/begin RECORD_LAYOUT GklWUb FNC_VALUES 1 UBYTE COLUMN_DIR DIRECT /end RECORD_LAYOUT
/begin RECORD_LAYOUT GklWUw FNC_VALUES 1 UWORD COLUMN_DIR DIRECT /end RECORD_LAYOUT
/begin RECORD_LAYOUT KfAxUbAyUbSstxSwSstyUbWSw NO_AXIS_PTS_X 1 UBYTE NO_AXIS_PTS_Y 2 UBYTE AXIS_PTS_X 3 SWORD INDEX_INCR DIRECT AXIS_PTS_Y 4 UBYTE INDEX_INCR DIRECT FNC_VALUES 5 SWORD COLUMN_DIR DIRECT /end RECORD_LAYOUT
/begin RECORD_LAYOUT KfAxUbAyUbSstxUbSstyUbWSb NO_AXIS_PTS_X 1 UBYTE NO_AXIS_PTS_Y 2 UBYTE AXIS_PTS_X 3 UBYTE INDEX_INCR DIRECT AXIS_PTS_Y 4 UBYTE INDEX_INCR DIRECT FNC_VALUES 5 SBYTE COLUMN_DIR DIRECT /end RECORD_LAYOUT
/begin RECORD_LAYOUT KfAxUbAyUbSstxUbSstyUbWUb NO_AXIS_PTS_X 1 UBYTE NO_AXIS_PTS_Y 2 UBYTE AXIS_PTS_X 3 UBYTE INDEX_INCR DIRECT AXIS_PTS_Y 4 UBYTE INDEX_INCR DIRECT FNC_VALUES 5 UBYTE COLUMN_DIR DIRECT /end RECORD_LAYOUT
/begin RECORD_LAYOUT KfAxUbAyUbSstxUbSstyUwWUb NO_AXIS_PTS_X 1 UBYTE NO_AXIS_PTS_Y 2 UBYTE AXIS_PTS_X 3 UBYTE INDEX_INCR DIRECT AXIS_PTS_Y 4 UWORD INDEX_INCR DIRECT FNC_VALUES 5 UBYTE COLUMN_DIR DIRECT /end RECORD_LAYOUT
/begin RECORD_LAYOUT KfAxUbAyUbSstxUbSstyUwWUw NO_AXIS_PTS_X 1 UBYTE NO_AXIS_PTS_Y 2 UBYTE AXIS_PTS_X 3 UBYTE INDEX_INCR DIRECT AXIS_PTS_Y 4 UWORD INDEX_INCR DIRECT FNC_VALUES 5 UWORD COLUMN_DIR DIRECT /end RECORD_LAYOUT
/begin RECORD_LAYOUT KfAxUbAyUbSstxUwSstyUbWUb NO_AXIS_PTS_X 1 UBYTE NO_AXIS_PTS_Y 2 UBYTE AXIS_PTS_X 3 UWORD INDEX_INCR DIRECT AXIS_PTS_Y 4 UBYTE INDEX_INCR DIRECT FNC_VALUES 5 UBYTE COLUMN_DIR DIRECT /end RECORD_LAYOUT
/begin RECORD_LAYOUT KfAxUbAyUbSstxUwSstyUwWUw NO_AXIS_PTS_X 1 UWORD NO_AXIS_PTS_Y 2 UWORD AXIS_PTS_X 3 UWORD INDEX_INCR DIRECT AXIS_PTS_Y 4 UWORD INDEX_INCR DIRECT FNC_VALUES 5 UWORD COLUMN_DIR DIRECT /end RECORD_LAYOUT
/begin RECORD_LAYOUT KfAxUwAyUwSstxUwSstyUwWUw NO_AXIS_PTS_X 1 UWORD NO_AXIS_PTS_Y 2 UWORD AXIS_PTS_X 3 UWORD INDEX_INCR DIRECT AXIS_PTS_Y 4 UWORD INDEX_INCR DIRECT FNC_VALUES 5 UWORD COLUMN_DIR DIRECT /end RECORD_LAYOUT
/begin RECORD_LAYOUT KlASwSstSwWSw NO_AXIS_PTS_X 1 SWORD AXIS_PTS_X 2 SWORD INDEX_INCR DIRECT FNC_VALUES 3 SWORD COLUMN_DIR DIRECT /end RECORD_LAYOUT
/begin RECORD_LAYOUT KlAUbSstUbWUb NO_AXIS_PTS_X 1 UBYTE AXIS_PTS_X 2 UBYTE INDEX_INCR DIRECT FNC_VALUES 3 UBYTE COLUMN_DIR DIRECT /end RECORD_LAYOUT
/begin RECORD_LAYOUT KlAUbSstUbWUw NO_AXIS_PTS_X 1 UBYTE AXIS_PTS_X 2 UBYTE INDEX_INCR DIRECT FNC_VALUES 3 UWORD COLUMN_DIR DIRECT /end RECORD_LAYOUT
/begin RECORD_LAYOUT KlAUwSstSwWUw NO_AXIS_PTS_X 1 UWORD AXIS_PTS_X 2 SWORD INDEX_INCR DIRECT FNC_VALUES 3 UWORD COLUMN_DIR DIRECT /end RECORD_LAYOUT
/begin RECORD_LAYOUT KlAUwSstUwWUb NO_AXIS_PTS_X 1 UWORD AXIS_PTS_X 2 UWORD INDEX_INCR DIRECT FNC_VALUES 3 UBYTE COLUMN_DIR DIRECT /end RECORD_LAYOUT
/begin RECORD_LAYOUT KlAUwSstUwWUw NO_AXIS_PTS_X 1 UWORD AXIS_PTS_X 2 UWORD INDEX_INCR DIRECT FNC_VALUES 3 UWORD COLUMN_DIR DIRECT /end RECORD_LAYOUT
/begin RECORD_LAYOUT KwSb FNC_VALUES 1 SBYTE COLUMN_DIR DIRECT /end RECORD_LAYOUT
/begin RECORD_LAYOUT KwSw FNC_VALUES 1 SWORD COLUMN_DIR DIRECT /end RECORD_LAYOUT
/begin RECORD_LAYOUT KwUb FNC_VALUES 1 UBYTE COLUMN_DIR DIRECT /end RECORD_LAYOUT
/begin RECORD_LAYOUT KwUw FNC_VALUES 1 UWORD COLUMN_DIR DIRECT /end RECORD_LAYOUT
/begin RECORD_LAYOUT SstAUbSstUb NO_AXIS_PTS_X 1 UBYTE AXIS_PTS_X 2 UBYTE INDEX_INCR DIRECT /end RECORD_LAYOUT
/begin RECORD_LAYOUT SstAUwSstUw NO_AXIS_PTS_X 1 UWORD AXIS_PTS_X 2 UWORD INDEX_INCR DIRECT /end RECORD_LAYOUT
/end MODULE
/end PROJECT
