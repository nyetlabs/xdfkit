ASAP2_VERSION 1 3
/begin PROJECT X505P_24HG_1 "X505P"
/begin HEADER "" VERSION "X505P_24HG_1" PROJECT_NO X505P_24HG_1 /end HEADER
/begin MODULE DIM ""
/begin MOD_COMMON "" BYTE_ORDER MSB_LAST ALIGNMENT_BYTE 1 ALIGNMENT_WORD 2 ALIGNMENT_LONG 2 /end MOD_COMMON
/begin CHARACTERISTIC AGRRMAX "maximal mögliche AGR-Rate" VALUE 0x8118AF KwUb 99.61 rel_ub_b99p6 0.00 99.61 FORMAT "%5.2" /end CHARACTERISTIC
/begin CHARACTERISTIC CLRS "Codewort für Betriebsmodi Lambdaregelung" VALUE 0x811FDD KwUb 255.0 dez 0.00 255.0 FORMAT "%5.1" /end CHARACTERISTIC
/begin CHARACTERISTIC CLRSHK "Codewort für Freigabe LRSHK und Auswahl Initialisierung" VALUE 0x812069 KwUb 255.0 dez 0.00 255.0 FORMAT "%5.1" /end CHARACTERISTIC
/begin CHARACTERISTIC CLRSHKA "Codewort II für Freigabe LRSHK und Auswahl Initialisierung" VALUE 0x81206A KwUb 255.0 dez 0.00 255.0 FORMAT "%5.1" /end CHARACTERISTIC
/begin CHARACTERISTIC CLRSHKEB "Codewort für Konfigurieren Freigabe LRSHKEB" VALUE 0x81206B KwUb 255.0 dez 0.00 255.0 FORMAT "%5.1" /end CHARACTERISTIC
/begin CHARACTERISTIC CLRSKA "Code-Wort Funktionsart Kat-Ausräumen" VALUE 0x81211D KwUb 255.0 dez 0.00 255.0 FORMAT "%5.1" /end CHARACTERISTIC
/begin CHARACTERISTIC CLRZWTMS "Codewort Zwangseinschaltung LR gemäß CARB-Forderung" VALUE 0x81A237 KwUb 255.0 dez 0.00 255.0 FORMAT "%5.1" /end CHARACTERISTIC
/begin CHARACTERISTIC CNFLLRNS "Configurationsbyte für die LL-Solldrehzahlfreigabe" VALUE 0x819E0B KwUb 255.0 dez 0.00 255.0 FORMAT "%5.1" /end CHARACTERISTIC
/begin CHARACTERISTIC CREDSTU "Codewort für Reduzierstufe ein/aus" VALUE 0x811AB0 KwUb 255.0 dez 0.00 255.0 FORMAT "%5.1" /end CHARACTERISTIC
/begin CHARACTERISTIC CWDMFAB_0_A "Codewort Sw-Schalter für Änderungsbegrenzung" VALUE 0x816A0A KwUb 255.0 DEZ 0.00 255.0 FORMAT "%5.1" /end CHARACTERISTIC
/begin CHARACTERISTIC CWDMFAB_1_A "Codewort Sw-Schalter für Änderungsbegrenzung" VALUE 0x816A0B KwUb 255.0 DEZ 0.00 255.0 FORMAT "%5.1" /end CHARACTERISTIC
/begin CHARACTERISTIC CWFAN "Codewort Drehzahlanforderung für Bandendetest" VALUE 0x81A085 KwUb 255.0 dez 0.00 255.0 FORMAT "%5.1" /end CHARACTERISTIC
/begin CHARACTERISTIC CWGALSV "Codewort für zurücksetzen von Adaptionswerte bei Error E_LSV" VALUE 0x818F8B KwUb 255.0 dez 0.00 255.0 FORMAT "%5.1" /end CHARACTERISTIC
/begin CHARACTERISTIC CWKUPPL "Codewort für Kupplung" VALUE 0x811764 KwUb 255.0 dez 0.00 255.0 FORMAT "%5.1" /end CHARACTERISTIC
/begin CHARACTERISTIC CWLLRPA "Codewort zur Auswahl des Parametersatzes des P-Anteils" VALUE 0x819F4C KwUb 255.0 dez 0.00 255.0 FORMAT "%5.1" /end CHARACTERISTIC
/begin CHARACTERISTIC CWMDBAS "Codewort Einrechnung der ZW-Korrektur für AGR-Betrieb" VALUE 0x8118B0 KwUb 255.0 dez 0.00 255.0 FORMAT "%5.1" /end CHARACTERISTIC
/begin CHARACTERISTIC CWMDFAW "Codewort für %MDFAW" VALUE 0x81184C KwUb 255.0 DEZ 0.00 255.0 FORMAT "%5.1" /end CHARACTERISTIC
/begin CHARACTERISTIC CWMDKOG "Codewort MDKOG: Zündwinkelspätverstellung bei Unterdruckbegrenzung" VALUE 0x8118A8 KwUb 255.0 dez 0.00 255.0 FORMAT "%5.1" /end CHARACTERISTIC
/begin CHARACTERISTIC CWMDKOL "Codewort MDKOL: Momentenbegrenzung" VALUE 0x8118AE KwUb 255.0 dez 0.00 255.0 FORMAT "%5.1" /end CHARACTERISTIC
/begin CHARACTERISTIC CWMDMIN "Codewort MDMIN" VALUE 0x811807 KwUb 255.0 dez 0.00 255.0 FORMAT "%5.1" /end CHARACTERISTIC
/begin CHARACTERISTIC CWNSTAT "Codewort zur nstat-Filterung" VALUE 0x819E0C KwUb 255.0 dez 0.00 255.0 FORMAT "%5.1" /end CHARACTERISTIC
/begin CHARACTERISTIC CWRLAPPL "Codewort Vorgabe rlsol_w während Applikationsphase" VALUE 0x810EBB KwUb 255.0 dez 0.00 255.0 FORMAT "%5.1" /end CHARACTERISTIC
/begin CHARACTERISTIC CWTEZW "Codewort Zündwinkeleingriff bei TEV-Prüfung" VALUE 0x8118A9 KwUb 255.0 dez 0.00 255.0 FORMAT "%5.1" /end CHARACTERISTIC
/begin CHARACTERISTIC CWZWVMX "Codewort Zündwinkeleingriff bei VMAX-Begrenzung" VALUE 0x8118AA KwUb 255.0 dez 0.00 255.0 FORMAT "%5.1" /end CHARACTERISTIC
/begin CHARACTERISTIC DELRL "Delta relative Luftfüllung für Freigabe ZW-Eingriff" VALUE 0x8118AB KwUb 5.977 rel_uw_q0p0234 0.00 5.977 FORMAT "%5.3" /end CHARACTERISTIC
/begin CHARACTERISTIC DLAHINI "Initwert Integrator dlahi der stetigen LRHK" VALUE 0x8173D4 KwSw 1.999969 fak_sw_b1 -1.000000 0.9999695 FORMAT "%8.6" /end CHARACTERISTIC
/begin CHARACTERISTIC DLAMXSA "max Regeldifferenz, für die nach SA die LRS gesperrt bleibt" VALUE 0x81739A KwUw 15.99976 fak_uw_b16 0.00 15.99976 FORMAT "%8.5" /end CHARACTERISTIC
/begin CHARACTERISTIC DMDPUG "delta Moment Dashpotende" CURVE 0x81627E KlAUwSstSwWUw 99.99847 rel_uw_b100 0.00 99.99847 FORMAT "%8.5"
 /begin AXIS_DESCR STD_AXIS mkfanb_w rel_sw_b100 8 -100.0000 99.99695 FORMAT "%8.4" DEPOSIT ABSOLUTE /end AXIS_DESCR
/end CHARACTERISTIC
/begin CHARACTERISTIC DMIFLSD_0_A "Delta-Moment für Initialisierung Filter Lastschlagdämpfung" VALUE 0x8169BE KwUw 99.99847 rel_uw_b100 0.00 99.99847 FORMAT "%8.5" /end CHARACTERISTIC
/begin CHARACTERISTIC DMIFLSD_1_A "Delta-Moment für Initialisierung Filter Lastschlagdämpfung" VALUE 0x8169C0 KwUw 99.99847 rel_uw_b100 0.00 99.99847 FORMAT "%8.5" /end CHARACTERISTIC
/begin CHARACTERISTIC DMIZWMN "Offset auf indiziertes Motormoment bei spätestem Zündwinkel und ASR-Eingriff" VALUE 0x811AB1 KwUb 99.61 rel_ub_b99p6 0.00 99.61 FORMAT "%5.2" /end CHARACTERISTIC
/begin CHARACTERISTIC DMLLNGEZ "LLR: D-Verstärkung abh. von ngasf für Luftpfad" MAP 0x81611C KfAxUbAyUbSstxSwSstyUbWSw 199.9841 rel_q0p00305 -99.99360 99.99055 FORMAT "%8.5"
 /begin AXIS_DESCR STD_AXIS ngasf_w nmotg_sw_q0p39 6 -12800.16 12799.77 FORMAT "%8.2" DEPOSIT ABSOLUTE /end AXIS_DESCR
 /begin AXIS_DESCR STD_AXIS etazws rel_ub_b127p5 4 0.00 127.5 FORMAT "%5.1" DEPOSIT ABSOLUTE /end AXIS_DESCR
/end CHARACTERISTIC
/begin CHARACTERISTIC DMLLNGEZV "LLR: D-Verstärkung abh. von ngasf für Luftpfad" MAP 0x81615E KfAxUbAyUbSstxSwSstyUbWSw 199.9841 rel_q0p00305 -99.99360 99.99055 FORMAT "%8.5"
 /begin AXIS_DESCR STD_AXIS ngasf_w nmotg_sw_q0p39 6 -12800.16 12799.77 FORMAT "%8.2" DEPOSIT ABSOLUTE /end AXIS_DESCR
 /begin AXIS_DESCR STD_AXIS etazws rel_ub_b127p5 4 0.00 127.5 FORMAT "%5.1" DEPOSIT ABSOLUTE /end AXIS_DESCR
/end CHARACTERISTIC
/begin CHARACTERISTIC DMLLRLMNN "Untere Begrenzung für dmllrl" CURVE 0x811614 GklWSb 50.00 rel_sb_q0p39 -50.00 0.00 FORMAT "%5.2"
 /begin AXIS_DESCR COM_AXIS nmot_w nmot_uw_q0p25 6 0.00 16383.75 AXIS_PTS_REF SNM06LLUB /end AXIS_DESCR
/end CHARACTERISTIC
/begin CHARACTERISTIC DMLLRLMXN "Sicherheitskonzept: obere Begrenzung für dmllrl" CURVE 0x81161A GklWUb 99.61 rel_ub_b99p6 0.00 99.61 FORMAT "%5.2"
 /begin AXIS_DESCR COM_AXIS nmot_w nmot_uw_q0p25 6 0.00 16383.75 AXIS_PTS_REF SNM06LLUB /end AXIS_DESCR
/end CHARACTERISTIC
/begin CHARACTERISTIC DMLLRMNN "Untere Begrenzung für dmllr_w" CURVE 0x811620 GklWSb 50.00 rel_sb_q0p39 -50.00 0.00 FORMAT "%5.2"
 /begin AXIS_DESCR COM_AXIS nmot_w nmot_uw_q0p25 6 0.00 16383.75 AXIS_PTS_REF SNM06LLUB /end AXIS_DESCR
/end CHARACTERISTIC
/begin CHARACTERISTIC DMLLRMNNK "Untere Begrenzung für dmllr_w im Kurztrip" CURVE 0x811626 GklWSb 50.00 rel_sb_q0p39 -50.00 0.00 FORMAT "%5.2"
 /begin AXIS_DESCR COM_AXIS nmot_w nmot_uw_q0p25 6 0.00 16383.75 AXIS_PTS_REF SNM06LLUB /end AXIS_DESCR
/end CHARACTERISTIC
/begin CHARACTERISTIC DMLLRMXN "Sicherheitskonzept: obere Begrenzung für dmllr" CURVE 0x81162C GklWUb 99.61 rel_ub_b99p6 0.00 99.61 FORMAT "%5.2"
 /begin AXIS_DESCR COM_AXIS nmot_w nmot_uw_q0p25 6 0.00 16383.75 AXIS_PTS_REF SNM06LLUB /end AXIS_DESCR
/end CHARACTERISTIC
/begin CHARACTERISTIC DMLLRMXNK "Sicherheitskonzept: obere Begrenzung für dmllr im Kurztrip" CURVE 0x811632 GklWUb 99.61 rel_ub_b99p6 0.00 99.61 FORMAT "%5.2"
 /begin AXIS_DESCR COM_AXIS nmot_w nmot_uw_q0p25 6 0.00 16383.75 AXIS_PTS_REF SNM06LLUB /end AXIS_DESCR
/end CHARACTERISTIC
/begin CHARACTERISTIC DMLSDUG "Delta Moment Ende Lastschlagdämpfung" CURVE 0x8162A0 KlAUwSstSwWUw 99.99847 rel_uw_b100 0.00 99.99847 FORMAT "%8.5"
 /begin AXIS_DESCR STD_AXIS mkfanb_w rel_sw_b100 8 -100.0000 99.99695 FORMAT "%8.4" DEPOSIT ABSOLUTE /end AXIS_DESCR
/end CHARACTERISTIC
/begin CHARACTERISTIC DMRAA "allgemeine Momentenreserve Kurztrip" VALUE 0x81FBD8 KwUw 99.99847 rel_uw_b100 0.00 99.99847 FORMAT "%8.5" /end CHARACTERISTIC
/begin CHARACTERISTIC DMRESLL "LLR: Abbaugeschwindigkeit der erhöhten Drehmomentreserve" VALUE 0x811765 KwUb 0.3891 rel_ub_q0p00153 0.00 0.3891 /end CHARACTERISTIC
/begin CHARACTERISTIC DMRESNW "Schrittweite zum Reduzieren der Momentenreserve bei Nockenwellenverststellung" VALUE 0x811766 KwUb 0.3891 rel_ub_q0p00153 0.00 0.3891 /end CHARACTERISTIC
/begin CHARACTERISTIC DMRESTM "Schrittweite zur Reduzierung der Momentenreserve nach Start" VALUE 0x811767 KwUb 0.3891 rel_ub_q0p00153 0.00 0.3891 /end CHARACTERISTIC
/begin CHARACTERISTIC DMRFAWEN "Schwelle mrfa-Gradient für Deaktivierung PT1-Filter beim Wiedereinsetzen" CURVE 0x8273F2 KlAUwSstUwWUw 199.9969 rel_uw_b200 0.00 199.9969 FORMAT "%8.4"
 /begin AXIS_DESCR STD_AXIS nmot_w nmot_uw_q0p25 4 0.00 16383.75 FORMAT "%8.2" DEPOSIT ABSOLUTE /end AXIS_DESCR
/end CHARACTERISTIC
/begin CHARACTERISTIC DMRTMKI "Inkrement für Regelfaktor Momentenbegrenzung über Motortemperatur" VALUE 0x81A1D4 KwUb 1.992 fak_ub_b2 0.00 1.992 FORMAT "%5.3" /end CHARACTERISTIC
/begin CHARACTERISTIC DNLLRES "LLR: Unterdrehzahlschwelle zur Erhöhung der Momentenreserve im LL" VALUE 0x811768 KwSb 2550. nmotd_sb_q10 -1280. 1270. FORMAT "%5.0" /end CHARACTERISTIC
/begin CHARACTERISTIC DNLLRIST "Überdrehzahlschwelle für Integratorreset" VALUE 0x811638 KwSb 2550. nmotd_sb_q10 -1280. 1270. FORMAT "%5.0" /end CHARACTERISTIC
/begin CHARACTERISTIC DNLLST "Drehzahlschwelle zum Deaktivieren der P-Verstärkung im Start" VALUE 0x811639 KwUb 255.0 nmot_q1 0.00 255.0 FORMAT "%5.1" /end CHARACTERISTIC
/begin CHARACTERISTIC DNMNI "Kleinstmöglicher Wert für dn beim I-Anteil" VALUE 0x81163A KwSb 2550. nmotd_sb_q10 -1280. 1270. FORMAT "%5.0" /end CHARACTERISTIC
/begin CHARACTERISTIC DNSNFST "Drehzahlschwelle für nsol-Begrenzung im Start" VALUE 0x819E0D KwUb 2550. nmot_ub_q10 0.00 2550. FORMAT "%5.0" /end CHARACTERISTIC
/begin CHARACTERISTIC DNSNFX "Offset zur Bestimmung der oberen Grenze für die Solldrehzahlnachführung" VALUE 0x819E0E KwUb 2550. nmot_ub_q10 0.00 2550. FORMAT "%5.0" /end CHARACTERISTIC
/begin CHARACTERISTIC DRLMINDP "Offset auf rlmin für Abschaltung Dashpot" VALUE 0x8162C2 KwSw 1535.977 rel_sw_q0p0234 -768.0000 767.9766 FORMAT "%8.4" /end CHARACTERISTIC
/begin CHARACTERISTIC DTAHLL "Delta Ansauglufttemperatur für Abbruch erhöhte Solldrehzahl im Heiß-Leerlauf" VALUE 0x819E0F KwUb 191.3 temp_ub_b191p25 0.00 191.3 FORMAT "%5.1" /end CHARACTERISTIC
/begin CHARACTERISTIC DTMHLL "Delta Motortemperatur für Abbruch erhöhte Solldrehzahl im Heiß-Leerlauf" VALUE 0x819E10 KwUb 191.3 temp_ub_b191p25 0.00 191.3 FORMAT "%5.1" /end CHARACTERISTIC
/begin CHARACTERISTIC DTMR "Hysterese für Einschaltschwelle" VALUE 0x812046 KwUb 191.3 temp_ub_b191p25 0.00 191.3 FORMAT "%5.1" /end CHARACTERISTIC
/begin CHARACTERISTIC DTMTMRW "Temperaturdiff.-Schwelle für die Prüfung, ob Zwangseinschaltung LR nötig (CARB)" VALUE 0x81A238 KwSb 191.3 temp_sb_q0p75 -96.00 95.25 FORMAT "%5.2" /end CHARACTERISTIC
/begin CHARACTERISTIC DVNG "LLR: D-Verstärkung abh. von ngfil bei stehendem Fahrzeug" CURVE 0x81163B GklWUb 0.1245 rel_qn0p000488 -0.1245 0.00 FORMAT "%6.4"
 /begin AXIS_DESCR COM_AXIS ngfil nmotg_sb_q100 6 -12800. 12700. AXIS_PTS_REF SNG06LLSB /end AXIS_DESCR
/end CHARACTERISTIC
/begin CHARACTERISTIC DVNGV "LLR: D-Verstärkung abh. von ngfil bei rollendem Fahrzeug" CURVE 0x811641 GklWUb 0.1245 rel_qn0p000488 -0.1245 0.00 FORMAT "%6.4"
 /begin AXIS_DESCR COM_AXIS ngfil nmotg_sb_q100 6 -12800. 12700. AXIS_PTS_REF SNG06LLSB /end AXIS_DESCR
/end CHARACTERISTIC
/begin CHARACTERISTIC DZWOLA "Lambda-Abhängigkeit des optimalen Zündwinkels bezogen auf Lambda 1" CURVE 0x816A14 KlAUbSstUbWSb 191.3 zw_sb_q0p75 -96.00 95.25 FORMAT "%5.2"
 /begin AXIS_DESCR STD_AXIS lambas fak_ub_b2 10 0.00 1.992 FORMAT "%5.3" DEPOSIT ABSOLUTE /end AXIS_DESCR
/end CHARACTERISTIC
/begin CHARACTERISTIC DZWOM "temperaturabhängiger Offset des optimalen ZW" CURVE 0x816A2A KlAUbSstUbWSb 191.3 zw_sb_q0p75 -96.00 95.25 FORMAT "%5.2"
 /begin AXIS_DESCR STD_AXIS tmot temp_ub_q0p75_o48 5 -48.00 143.3 FORMAT "%5.1" DEPOSIT ABSOLUTE /end AXIS_DESCR
/end CHARACTERISTIC
/begin CHARACTERISTIC ETADZW "ZW-Wirkungsgrad in Abhängigkeit von delta ZW" CURVE 0x8118B1 FklWUb 127.5 rel_ub_b127p5 0.00 127.5 FORMAT "%5.1"
 /begin AXIS_DESCR FIX_AXIS dzw_kge zw_sb_q0p75 120 0.00 89.25 FORMAT "%5.2" FIX_AXIS_PAR 0 0 120 /end AXIS_DESCR
/end CHARACTERISTIC
/begin CHARACTERISTIC ETALAM "Lambda-Wirkungsgrad" CURVE 0x811929 KlAUbSstUbWUb 127.5 rel_ub_b127p5 0.00 127.5 FORMAT "%5.1"
 /begin AXIS_DESCR STD_AXIS lambas fak_ub_b2 10 0.00 1.992 FORMAT "%5.3" DEPOSIT ABSOLUTE /end AXIS_DESCR
/end CHARACTERISTIC
/begin CHARACTERISTIC FBZFRAT "Bewertungsfaktor für Integrationsgeschwindigkeit KFFRAT als f(abo)" CURVE 0x818F8C KlAUbSstUbWUb 0.9961 fak_ub_b1 0.00 0.9961
 /begin AXIS_DESCR STD_AXIS abo dez 5 0.00 255.0 FORMAT "%5.1" DEPOSIT ABSOLUTE /end AXIS_DESCR
/end CHARACTERISTIC
/begin CHARACTERISTIC FDDN "LLR: Gewichtungsfaktor für D-Verstärkung" CURVE 0x811647 GklWUb 0.9961 fak_ub_b1 0.00 0.9961
 /begin AXIS_DESCR COM_AXIS dns nmotd_sb_q10 6 -1280. 1270. AXIS_PTS_REF SNS06LLSB /end AXIS_DESCR
/end CHARACTERISTIC
/begin CHARACTERISTIC FDFRMIN "Default-Wert untere Schranke dfr_w" VALUE 0x811FDE KwSb 1.992 fak_sb_b1 -1.000 0.9922 FORMAT "%5.3" /end CHARACTERISTIC
/begin CHARACTERISTIC FDNIKOR "Faktor für Korrektur auf I-Anteil" VALUE 0x81164D KwUb 1.992 fak_ub_b2 0.00 1.992 FORMAT "%5.3" /end CHARACTERISTIC
/begin CHARACTERISTIC FGMIFAL_0_A "Gewichtungsfaktor für Überhöhung über KFWMIFAL" CURVE 0x81184D FklWUb 1.992 fak_ub_b2 0.00 1.992 FORMAT "%5.3"
 /begin AXIS_DESCR FIX_AXIS gangi dez 8 0.00 7.000 FORMAT "%5.3" FIX_AXIS_PAR 0 0 8 /end AXIS_DESCR
/end CHARACTERISTIC
/begin CHARACTERISTIC FGMIFAL_1_A "Gewichtungsfaktor für Überhöhung über KFWMIFAL" CURVE 0x811855 FklWUb 1.992 fak_ub_b2 0.00 1.992 FORMAT "%5.3"
 /begin AXIS_DESCR FIX_AXIS gangi dez 8 0.00 7.000 FORMAT "%5.3" FIX_AXIS_PAR 0 0 8 /end AXIS_DESCR
/end CHARACTERISTIC
/begin CHARACTERISTIC FGZLSD_0_A "Gewichtungsfaktor für Reduktion über KFZLSD" CURVE 0x81185D FklWUb 1.992 fak_ub_b2 0.00 1.992 FORMAT "%5.3"
 /begin AXIS_DESCR FIX_AXIS gangi dez 8 0.00 7.000 FORMAT "%5.3" FIX_AXIS_PAR 0 0 8 /end AXIS_DESCR
/end CHARACTERISTIC
/begin CHARACTERISTIC FGZLSD_1_A "Gewichtungsfaktor für Reduktion über KFZLSD" CURVE 0x811865 FklWUb 1.992 fak_ub_b2 0.00 1.992 FORMAT "%5.3"
 /begin AXIS_DESCR FIX_AXIS gangi dez 8 0.00 7.000 FORMAT "%5.3" FIX_AXIS_PAR 0 0 8 /end AXIS_DESCR
/end CHARACTERISTIC
/begin CHARACTERISTIC FKAXAVKAT "Gewichtungsfaktor Sauerstoffspeicher in Abhängigkeit von avkatf" CURVE 0x827EBE KlAUbSstUbWUb 0.9961 fak_ub_b1 0.00 0.9961 /begin AXIS_DESCR STD_AXIS avkatf fak_ub_b1 3 0.00 0.9961 DEPOSIT ABSOLUTE /end AXIS_DESCR /end CHARACTERISTIC
/begin CHARACTERISTIC FKFPEDV "Faktor für Interpolation zwischen den beiden Pedalkennfeldern" CURVE 0x81A0E7 KlAUbSstUbWUb 1.000 fak_ub_b2 0.00 1.000 FORMAT "%5.3"
 /begin AXIS_DESCR STD_AXIS vfzg vfzg_ub_q1p25 2 0.00 318.8 FORMAT "%5.1" DEPOSIT ABSOLUTE /end AXIS_DESCR
/end CHARACTERISTIC
/begin CHARACTERISTIC FKZDPTM "Korrekturfaktor Zeitkonstante Dashpot" CURVE 0x81A0EC KlAUbSstUbWUb 1.49804 rfak_q0p5 0.501961 2.00000 FORMAT "%7.5"
 /begin AXIS_DESCR STD_AXIS tmot temp_ub_q0p75_o48 6 -48.00 143.3 FORMAT "%5.1" DEPOSIT ABSOLUTE /end AXIS_DESCR
/end CHARACTERISTIC
/begin CHARACTERISTIC FLMLKAMA "Faktor zur Bewertung Schwellwert integr. Fettfl. f. Abbruch Kat-Ausr. Pre/Main" VALUE 0x81211E KwUb 7.969 fak_ub_b8 0.00 7.969 FORMAT "%5.3" /end CHARACTERISTIC
/begin CHARACTERISTIC FLRMIFAL "Faktor für Fahrerwunschmoment Füllungspfad im Low Range" VALUE 0x81186D KwUb 3.984 fak_ub_b4 0.00 3.984 FORMAT "%5.3" /end CHARACTERISTIC
/begin CHARACTERISTIC FLRSG2K "Korrekturfaktor für Reglerparameter G2 bei temperaturabhängiger Reglereinstellug" VALUE 0x81A229 KwUb 1.992 fak_ub_b2 0.00 1.992 FORMAT "%5.3" /end CHARACTERISTIC
/begin CHARACTERISTIC FLRZDASH "Faktor für Dashpot-Zeitkonstante im Low Range" VALUE 0x81186E KwUb 3.49804 rfak_q0p5 0.501961 4.00000 FORMAT "%7.5" /end CHARACTERISTIC
/begin CHARACTERISTIC FLRZLSD "Faktor für LSD-Zeitkonstante im Low Range" VALUE 0x81A0F9 KwUb 3.984 fak_ub_b4 0.00 3.984 FORMAT "%5.3" /end CHARACTERISTIC
/begin CHARACTERISTIC FMIVL "Faktor Korrektur maximales Moment bei VL" VALUE 0x81A112 KwUb 1.992 fak_ub_b2 0.00 1.992 FORMAT "%5.3" /end CHARACTERISTIC
/begin CHARACTERISTIC FNSNF "Faktor für Solldrehzahlnachführung" VALUE 0x819E11 KwUb 0.9961 fak_ub_b1 0.00 0.9961 /end CHARACTERISTIC
/begin CHARACTERISTIC FNSSTKM "Faktor zur Wichtung der Solldrehzahl im Start bei Kat-Heizen" CURVE 0x819E12 KlAUbSstUbWUb 1.992 fak_ub_b2 0.00 1.992 FORMAT "%5.3"
 /begin AXIS_DESCR STD_AXIS tmot temp_ub_q0p75_o48 6 -48.00 143.3 FORMAT "%5.1" DEPOSIT ABSOLUTE /end AXIS_DESCR
/end CHARACTERISTIC
/begin CHARACTERISTIC FNSSTM "Faktor zur Wichtung der Solldrehzahl im Start" CURVE 0x819E1F KlAUbSstUbWUb 1.992 fak_ub_b2 0.00 1.992 FORMAT "%5.3"
 /begin AXIS_DESCR STD_AXIS tmot temp_ub_q0p75_o48 6 -48.00 143.3 FORMAT "%5.1" DEPOSIT ABSOLUTE /end AXIS_DESCR
/end CHARACTERISTIC
/begin CHARACTERISTIC FNSTABNV "Faktor zur Drehzahlstabilisierung durch Drehmoment" CURVE 0x81FBBC KlAUwSstUwWUw 7.999878 fak_uw_b8 0.00 7.999878 FORMAT "%8.6"
 /begin AXIS_DESCR STD_AXIS nver_w fak_uw_b8 6 0.00 7.999878 FORMAT "%8.6" DEPOSIT ABSOLUTE /end AXIS_DESCR
/end CHARACTERISTIC
/begin CHARACTERISTIC FRAOMN "untere Begrenzung des Korrekturfaktors frao" VALUE 0x818F97 KwUb 1.992 fak_ub_b2 0.00 1.992 FORMAT "%5.3" /end CHARACTERISTIC
/begin CHARACTERISTIC FRAOMX "obere Begrenzung des Korrekturfaktors frao" VALUE 0x818F98 KwUb 1.992 fak_ub_b2 0.00 1.992 FORMAT "%5.3" /end CHARACTERISTIC
/begin CHARACTERISTIC FRAORN "untere reduzierte Schwelle des Korrekturfaktors frao" VALUE 0x818F99 KwUb 1.992 fak_ub_b2 0.00 1.992 FORMAT "%5.3" /end CHARACTERISTIC
/begin CHARACTERISTIC FRAORX "obere reduzierte Schwelle des Korrekturfaktors frao" VALUE 0x818F9A KwUb 1.992 fak_ub_b2 0.00 1.992 FORMAT "%5.3" /end CHARACTERISTIC
/begin CHARACTERISTIC FRATMN "untere Begrenzung des Korrekturfaktors frat" VALUE 0x818F9B KwUb 1.992 fak_ub_b2 0.00 1.992 FORMAT "%5.3" /end CHARACTERISTIC
/begin CHARACTERISTIC FRATMX "obere Begrenzung des Korrekturfaktors frat" VALUE 0x818F9C KwUb 1.992 fak_ub_b2 0.00 1.992 FORMAT "%5.3" /end CHARACTERISTIC
/begin CHARACTERISTIC FRAUMN "untere Begrenzung des Korrekturfaktors frau" VALUE 0x818F9D KwUb 1.992 fak_ub_b2 0.00 1.992 FORMAT "%5.3" /end CHARACTERISTIC
/begin CHARACTERISTIC FRAUMX "obere Begrenzung des Korrekturfaktors frau" VALUE 0x818F9E KwUb 1.992 fak_ub_b2 0.00 1.992 FORMAT "%5.3" /end CHARACTERISTIC
/begin CHARACTERISTIC FRAURN "untere reduzierte Schwelle des Korrekturfaktors frau" VALUE 0x818F9F KwUb 1.992 fak_ub_b2 0.00 1.992 FORMAT "%5.3" /end CHARACTERISTIC
/begin CHARACTERISTIC FRAURX "obere reduzierte Schwelle des Korrekturfaktors frau" VALUE 0x818FA0 KwUb 1.992 fak_ub_b2 0.00 1.992 FORMAT "%5.3" /end CHARACTERISTIC
/begin CHARACTERISTIC FRLMNHO "Korrekturfaktor rlmin über Höhe" CURVE 0x810EBC KlAUbSstUbWUb 1.992 fak_ub_b2 0.00 1.992 FORMAT "%5.3"
 /begin AXIS_DESCR STD_AXIS fho fak_ub_b4 5 0.00 3.984 FORMAT "%5.3" DEPOSIT ABSOLUTE /end AXIS_DESCR
/end CHARACTERISTIC
/begin CHARACTERISTIC FRMAX "obere Regelbereichsgrenze" VALUE 0x816EFE KwUw 1.999969 fak_uw_b2 0.00 1.999969 FORMAT "%8.6" /end CHARACTERISTIC
/begin CHARACTERISTIC FRMINKH "Magerbegrenzung Lambdaregelung bei KH mit SL" VALUE 0x816F00 KwUw 1.999969 fak_uw_b2 0.00 1.999969 FORMAT "%8.6" /end CHARACTERISTIC
/begin CHARACTERISTIC FWDMVAD_0_A "Faktor zur Wichtung von dmvad_w in %MDMIN" CURVE 0x827032 KlAUwSstUwWUw 0.9999847 fak_uw_b1 0.00 0.9999847 FORMAT "%9.7"
 /begin AXIS_DESCR STD_AXIS nver_w fak_uw_b8 8 0.00 7.999878 FORMAT "%8.6" DEPOSIT ABSOLUTE /end AXIS_DESCR
/end CHARACTERISTIC
/begin CHARACTERISTIC FWDMVAD_1_A "Faktor zur Wichtung von dmvad_w in %MDMIN" CURVE 0x827054 KlAUwSstUwWUw 0.9999847 fak_uw_b1 0.00 0.9999847 FORMAT "%9.7"
 /begin AXIS_DESCR STD_AXIS nver_w fak_uw_b8 8 0.00 7.999878 FORMAT "%8.6" DEPOSIT ABSOLUTE /end AXIS_DESCR
/end CHARACTERISTIC
/begin CHARACTERISTIC FWPEDRLS "Faktor zur direkten rlsol-Vorgabe aus wped (Applikation)" VALUE 0x815552 KwUw 3.999939 fak_uw_b4 0.00 3.999939 FORMAT "%8.6" /end CHARACTERISTIC
/begin CHARACTERISTIC FZAB2 "Verstärkungsfaktor für Zwangsamplitude auf Bank 2 gegenüber Bank 1" VALUE 0x811FDF KwSb 15.94 fak_q0p0625 -8.000 7.938 FORMAT "%5.3" /end CHARACTERISTIC
/begin CHARACTERISTIC FZDA1SCH "Korrekturfaktor Dashpot-Zeitkonstante im Schichtbetrieb" VALUE 0x81186F KwUb 3.00000 rfak_q0p5 1.00000 4.00000 FORMAT "%7.5" /end CHARACTERISTIC
/begin CHARACTERISTIC FZDA2SCH "Korrekturfaktor Dashpot-Zeitkonstante bei kl. Kupplungsmoment im Schichtbetr." VALUE 0x811870 KwUb 3.00000 rfak_q0p5 1.00000 4.00000 FORMAT "%7.5" /end CHARACTERISTIC
/begin CHARACTERISTIC GFDLDN "LLR: Gewichtungsfaktor für D-Verstärkung auf Luftpfad" CURVE 0x81164E GklWUb 0.9961 rel_ub_b1p0 0.00 0.9961
 /begin AXIS_DESCR COM_AXIS dns nmotd_sb_q10 6 -1280. 1270. AXIS_PTS_REF SNS06LLSB /end AXIS_DESCR
/end CHARACTERISTIC
/begin CHARACTERISTIC ILMLKAXTK "Schwelle Fettfläche Kat-Ausräumen nach SA, Funktion der Kat-Temperatur" CURVE 0x827EC6 KlAUbSstUwWUw 291.2667 m_uw_b291p25 0.00 291.2667 FORMAT "%8.4"
 /begin AXIS_DESCR STD_AXIS tikatm_w temp_uw_q0p0195_o50 5 -50.00000 1229.980 FORMAT "%8.3" DEPOSIT ABSOLUTE /end AXIS_DESCR
/end CHARACTERISTIC
/begin CHARACTERISTIC IMLEVABS "Schwelle Luftmassenintegral vor Freigabe Lambdaregelung nach Zylinderausblendung" VALUE 0x81739C KwUw 4660.267 m_uw_b4660 0.00 4660.267 FORMAT "%8.3" /end CHARACTERISTIC
/begin CHARACTERISTIC IMLKAMN "Schwellwert integr. Luftmasse f. Mindestdauer Katalysator-Ausräumen" VALUE 0x81746C KwUw 291.2667 m_uw_b291p25 0.00 291.2667 FORMAT "%8.4" /end CHARACTERISTIC
/begin CHARACTERISTIC IMLSALR "Schwellwert integr. Luftmasse f. Einschaltverzögerung LR nach SA" VALUE 0x81739E KwUw 4660.267 m_uw_b4660 0.00 4660.267 FORMAT "%8.3" /end CHARACTERISTIC
/begin CHARACTERISTIC IVDNDTEH "I-Reglerparameter bei aktiver DTEV im Homogenbetrieb" CURVE 0x819F4D GklWUb 0.6076 rel_q0p002383 0.00 0.6076
 /begin AXIS_DESCR COM_AXIS dn_w nmot_sw_q0p25 10 -8192.000 8191.750 AXIS_PTS_REF SDN10LLSW /end AXIS_DESCR
/end CHARACTERISTIC
/begin CHARACTERISTIC IVDNHOM "I-Reglerparameter bei Homogenbetrieb" CURVE 0x819F57 GklWUb 0.6076 rel_q0p002383 0.00 0.6076
 /begin AXIS_DESCR COM_AXIS dn_w nmot_sw_q0p25 10 -8192.000 8191.750 AXIS_PTS_REF SDN10LLSW /end AXIS_DESCR
/end CHARACTERISTIC
/begin CHARACTERISTIC IVDNHOMV "I-Reglerparameter bei Homogenbetrieb und Kraftschluß" CURVE 0x819F61 GklWUb 0.6076 rel_q0p002383 0.00 0.6076
 /begin AXIS_DESCR COM_AXIS dn_w nmot_sw_q0p25 10 -8192.000 8191.750 AXIS_PTS_REF SDN10LLSW /end AXIS_DESCR
/end CHARACTERISTIC
/begin CHARACTERISTIC KDLASHKI "Kennlinie über dlashkm, Bewertungsfaktor für I-Anteil in der LRHK" CURVE 0x8173D6 GklWSw 1.999969 fak_sw_b1 -1.000000 0.9999695 FORMAT "%8.6"
 /begin AXIS_DESCR COM_AXIS dlashkm_w fak_sw_b1 8 -1.000000 0.9999695 AXIS_PTS_REF SM108LHSW /end AXIS_DESCR
/end CHARACTERISTIC
/begin CHARACTERISTIC KDLASHKP "Kennlinie über dlashkm_w, Bewertungsfaktor für P-Anteil in der LRHK" CURVE 0x8173E6 GklWSw 1.999969 fak_sw_b1 -1.000000 0.9999695 FORMAT "%8.6"
 /begin AXIS_DESCR COM_AXIS dlashkm_w fak_sw_b1 8 -1.000000 0.9999695 AXIS_PTS_REF SM108LHSW /end AXIS_DESCR
/end CHARACTERISTIC
/begin CHARACTERISTIC KFDLASO "Kennfeld Lambdasollwert-Korrektur für stetigen Lambdaregler" MAP 0x811FE0 GkfWSb 0.06226 fak_sb_b0p03125 -0.03125 0.03101 FORMAT "%7.5"
 /begin AXIS_DESCR COM_AXIS nmot nmot_ub_q40 10 0.00 10200. AXIS_PTS_REF SNM10LSUB /end AXIS_DESCR
 /begin AXIS_DESCR COM_AXIS rl rel_ub_q0p75 10 0.00 191.3 AXIS_PTS_REF SRL10LSUB /end AXIS_DESCR
/end CHARACTERISTIC
/begin CHARACTERISTIC KFDLSD "Dämpfung PT2-Filter Lastschlagdämpfung" MAP 0x827404 GkfWUw 1.999969 fak_uw_b2 0.00 1.999969 FORMAT "%8.6" /begin AXIS_DESCR COM_AXIS gangi dez 8 0.00 255.0 AXIS_PTS_REF SGA08MDUB /end AXIS_DESCR
 /begin AXIS_DESCR COM_AXIS nmot_w nmot_uw_q0p25 6 0.00 16383.75 AXIS_PTS_REF SNM06MDUW /end AXIS_DESCR
/end CHARACTERISTIC
/begin CHARACTERISTIC KFDMDPO_0_A "Delta Moment Dashpotauslösung" MAP 0x8162C4 KfAxUbAyUbSstxSwSstyUbWUw 99.99847 rel_uw_b100 0.00 99.99847 FORMAT "%8.5"
 /begin AXIS_DESCR STD_AXIS mkfanb_w rel_sw_b100 6 -100.0000 99.99695 FORMAT "%8.4" DEPOSIT ABSOLUTE /end AXIS_DESCR
 /begin AXIS_DESCR STD_AXIS gangi dez 8 0.00 255.0 FORMAT "%5.1" DEPOSIT ABSOLUTE /end AXIS_DESCR
/end CHARACTERISTIC
/begin CHARACTERISTIC KFDMDPO_1_A "Delta Moment Dashpotauslösung" MAP 0x81633A KfAxUbAyUbSstxSwSstyUbWUw 99.99847 rel_uw_b100 0.00 99.99847 FORMAT "%8.5"
 /begin AXIS_DESCR STD_AXIS mkfanb_w rel_sw_b100 6 -100.0000 99.99695 FORMAT "%8.4" DEPOSIT ABSOLUTE /end AXIS_DESCR
 /begin AXIS_DESCR STD_AXIS gangi dez 8 0.00 255.0 FORMAT "%5.1" DEPOSIT ABSOLUTE /end AXIS_DESCR
/end CHARACTERISTIC
/begin CHARACTERISTIC KFDMLSDO_0_A "Delta Moment Auslösung Lastschlagdämpfung" MAP 0x8163B0 KfAxUwAyUwSstxSwSstyUwWUw 99.99847 rel_uw_b100 0.00 99.99847 FORMAT "%8.5"
 /begin AXIS_DESCR STD_AXIS mkfanb_w rel_sw_b100 8 -100.0000 99.99695 FORMAT "%8.4" DEPOSIT ABSOLUTE /end AXIS_DESCR
 /begin AXIS_DESCR STD_AXIS nmot_w nmot_uw_q0p25 6 0.00 16383.75 FORMAT "%8.2" DEPOSIT ABSOLUTE /end AXIS_DESCR
/end CHARACTERISTIC
/begin CHARACTERISTIC KFDMLSDO_1_A "Delta Moment Auslösung Lastschlagdämpfung" MAP 0x816430 KfAxUwAyUwSstxSwSstyUwWUw 99.99847 rel_uw_b100 0.00 99.99847 FORMAT "%8.5"
 /begin AXIS_DESCR STD_AXIS mkfanb_w rel_sw_b100 8 -100.0000 99.99695 FORMAT "%8.4" DEPOSIT ABSOLUTE /end AXIS_DESCR
 /begin AXIS_DESCR STD_AXIS nmot_w nmot_uw_q0p25 6 0.00 16383.75 FORMAT "%8.2" DEPOSIT ABSOLUTE /end AXIS_DESCR
/end CHARACTERISTIC
/begin CHARACTERISTIC KFDMLSDS "Delta Moment Auslösung Lastschlagdämpfung nach Schaltvorgang" MAP 0x827464 GkfWUw 99.99847 rel_uw_b100 0.00 99.99847 FORMAT "%8.5" /begin AXIS_DESCR COM_AXIS gangi dez 8 0.00 255.0 AXIS_PTS_REF SGA08MDUB /end AXIS_DESCR
 /begin AXIS_DESCR COM_AXIS nmot_w nmot_uw_q0p25 6 0.00 16383.75 AXIS_PTS_REF SNM06MDUW /end AXIS_DESCR
/end CHARACTERISTIC
/begin CHARACTERISTIC KFDZWOAGR "Offset des optimalen ZW bei AGR-Betrieb" MAP 0x816A36 KfAxUwAyUwSstxUwSstyUwWUw 49151.25 zw_uw_q0p75 0.00 49151.25 FORMAT "%8.2"
 /begin AXIS_DESCR STD_AXIS nmot_w nmot_uw_q0p25 16 0.00 16383.75 FORMAT "%8.2" DEPOSIT ABSOLUTE /end AXIS_DESCR
 /begin AXIS_DESCR STD_AXIS rl_w rel_uw_q0p0234 11 0.00 1535.977 FORMAT "%8.3" DEPOSIT ABSOLUTE /end AXIS_DESCR
/end CHARACTERISTIC
/begin CHARACTERISTIC KFFRMIN "untere Regelbereichsgrenze" MAP 0x816F02 KfAxUwAyUwSstxUwSstyUwWUw 1.999969 fak_uw_b2 0.00 1.999969 FORMAT "%8.6"
 /begin AXIS_DESCR STD_AXIS tmot temp_ub_q0p75_o48 5 -48.00000 49103.25 FORMAT "%8.2" DEPOSIT ABSOLUTE /end AXIS_DESCR
 /begin AXIS_DESCR STD_AXIS tnst_w t10msxs_uw_b655p35 4 0.00 655.3500 FORMAT "%8.4" DEPOSIT ABSOLUTE /end AXIS_DESCR
/end CHARACTERISTIC
/begin CHARACTERISTIC KFLRSG1 "Kennfeld Reglerparameter g1 stetiger Lambdaregler" MAP 0x816F40 GkfWSw 63.99902 fak_sw_b32 -32.00000 31.99902 FORMAT "%8.5"
 /begin AXIS_DESCR COM_AXIS nmot_w nmot_uw_q0p25 7 0.00 16383.75 AXIS_PTS_REF SNM07LSUW /end AXIS_DESCR
 /begin AXIS_DESCR COM_AXIS rl_w rel_uw_q0p0234 8 0.00 1535.977 AXIS_PTS_REF SRL08LSUW /end AXIS_DESCR
/end CHARACTERISTIC
/begin CHARACTERISTIC KFLRSG2 "Kennfeld Reglerparameter g2 stetiger Lambdaregler" MAP 0x816FB0 GkfWUw 63.99902 fak_uw_b64 0.00 63.99902 FORMAT "%8.5"
 /begin AXIS_DESCR COM_AXIS nmot_w nmot_uw_q0p25 7 0.00 16383.75 AXIS_PTS_REF SNM07LSUW /end AXIS_DESCR
 /begin AXIS_DESCR COM_AXIS rl_w rel_uw_q0p0234 8 0.00 1535.977 AXIS_PTS_REF SRL08LSUW /end AXIS_DESCR
/end CHARACTERISTIC
/begin CHARACTERISTIC KFLRSG4 "Kennfeld Reglerparameter g4 stetiger Lambdaregler" MAP 0x817020 GkfWSw 3.999939 fak_sw_b2 -2.000000 1.999939 FORMAT "%8.6"
 /begin AXIS_DESCR COM_AXIS nmot_w nmot_uw_q0p25 7 0.00 16383.75 AXIS_PTS_REF SNM07LSUW /end AXIS_DESCR
 /begin AXIS_DESCR COM_AXIS rl_w rel_uw_q0p0234 8 0.00 1535.977 AXIS_PTS_REF SRL08LSUW /end AXIS_DESCR
/end CHARACTERISTIC
/begin CHARACTERISTIC KFLRSP1 "Kennfeld Reglerparameter p1 stetiger Lambdaregler" MAP 0x817090 GkfWUw 127.9980 fak_uw_b128 0.00 127.9980 FORMAT "%8.4"
 /begin AXIS_DESCR COM_AXIS nmot_w nmot_uw_q0p25 7 0.00 16383.75 AXIS_PTS_REF SNM07LSUW /end AXIS_DESCR
 /begin AXIS_DESCR COM_AXIS rl_w rel_uw_q0p0234 8 0.00 1535.977 AXIS_PTS_REF SRL08LSUW /end AXIS_DESCR
/end CHARACTERISTIC
/begin CHARACTERISTIC KFLRSP2 "Kennfeld Reglerparameter p2 stetiger Lambdaregler" MAP 0x817100 GkfWUw 127.9980 fak_uw_b128 0.00 127.9980 FORMAT "%8.4"
 /begin AXIS_DESCR COM_AXIS nmot_w nmot_uw_q0p25 7 0.00 16383.75 AXIS_PTS_REF SNM07LSUW /end AXIS_DESCR
 /begin AXIS_DESCR COM_AXIS rl_w rel_uw_q0p0234 8 0.00 1535.977 AXIS_PTS_REF SRL08LSUW /end AXIS_DESCR
/end CHARACTERISTIC
/begin CHARACTERISTIC KFLRSP3 "Kennfeld Reglerparameter p3 stetiger Lambdaregler" MAP 0x817170 GkfWUw 127.9980 fak_uw_b128 0.00 127.9980 FORMAT "%8.4"
 /begin AXIS_DESCR COM_AXIS nmot_w nmot_uw_q0p25 7 0.00 16383.75 AXIS_PTS_REF SNM07LSUW /end AXIS_DESCR
 /begin AXIS_DESCR COM_AXIS rl_w rel_uw_q0p0234 8 0.00 1535.977 AXIS_PTS_REF SRL08LSUW /end AXIS_DESCR
/end CHARACTERISTIC
/begin CHARACTERISTIC KFLRSP4 "Kennfeld Reglerparameter p4 stetiger Lambdaregler" MAP 0x8171E0 GkfWSw 127.9980 fak_sw_b64 -64.00000 63.99805 FORMAT "%8.5"
 /begin AXIS_DESCR COM_AXIS nmot_w nmot_uw_q0p25 7 0.00 16383.75 AXIS_PTS_REF SNM07LSUW /end AXIS_DESCR
 /begin AXIS_DESCR COM_AXIS rl_w rel_uw_q0p0234 8 0.00 1535.977 AXIS_PTS_REF SRL08LSUW /end AXIS_DESCR
/end CHARACTERISTIC
/begin CHARACTERISTIC KFLRST "Kennfeld Streckentotzeit" MAP 0x817250 KfAxUwAyUwSstxUwSstyUwWUw 327.67000000 tz10msxs_uw_b327p68 0.010000000000 327.68000000 FORMAT "%12.8"
 /begin AXIS_DESCR STD_AXIS nmot_w nmot_uw_q0p25 7 0.00 16383.75 FORMAT "%8.2" DEPOSIT ABSOLUTE /end AXIS_DESCR
 /begin AXIS_DESCR STD_AXIS rl_w rel_uw_q0p0234 8 0.00 1535.977 FORMAT "%8.3" DEPOSIT ABSOLUTE /end AXIS_DESCR
/end CHARACTERISTIC
/begin CHARACTERISTIC KFLRSZ "Kennfeld Streckenzeitkonstante der LRS, 16-Bit" MAP 0x8172E2 KfAxUwAyUwSstxUwSstyUwWUw 327.67000000 zk10msxs_uw_b655 0.010000000000 327.68000000 FORMAT "%12.8"
 /begin AXIS_DESCR STD_AXIS nmot_w nmot_uw_q0p25 7 0.00 16383.75 FORMAT "%8.2" DEPOSIT ABSOLUTE /end AXIS_DESCR
 /begin AXIS_DESCR STD_AXIS rl_w rel_uw_q0p0234 8 0.00 1535.977 FORMAT "%8.3" DEPOSIT ABSOLUTE /end AXIS_DESCR
/end CHARACTERISTIC
/begin CHARACTERISTIC KFMDBGRG "Kennfeld mit dem Wert der Momentenbegrenzung" MAP 0x827C52 KfAxUwAyUwSstxUwSstyUwWUw 99.99847 rel_uw_b100 0.00 99.99847 FORMAT "%8.5"
 /begin AXIS_DESCR STD_AXIS nmot nmot_ub_q40 4 0.00 2621400. FORMAT "%8.0" DEPOSIT ABSOLUTE /end AXIS_DESCR
 /begin AXIS_DESCR STD_AXIS gangi dez 7 0.00 65535.00 FORMAT "%8.2" DEPOSIT ABSOLUTE /end AXIS_DESCR
/end CHARACTERISTIC
/begin CHARACTERISTIC KFMIFABG_0_A "Delta-Moment für Gradientenbegrenzung" MAP 0x8274C4 KfAxUwAyUwSstxSwSstyUwWUw 99.99847 rel_uw_b100 0.00 99.99847 FORMAT "%8.5"
 /begin AXIS_DESCR STD_AXIS mkfa_w rel_sw_b50 8 -50.00000 49.99847 FORMAT "%8.5" DEPOSIT ABSOLUTE /end AXIS_DESCR
 /begin AXIS_DESCR STD_AXIS nmot_w nmot_uw_q0p25 8 0.00 16383.75 FORMAT "%8.2" DEPOSIT ABSOLUTE /end AXIS_DESCR
/end CHARACTERISTIC
/begin CHARACTERISTIC KFMIFABG_1_A "Delta-Moment für Gradientenbegrenzung" MAP 0x827568 KfAxUwAyUwSstxSwSstyUwWUw 99.99847 rel_uw_b100 0.00 99.99847 FORMAT "%8.5"
 /begin AXIS_DESCR STD_AXIS mkfa_w rel_sw_b50 8 -50.00000 49.99847 FORMAT "%8.5" DEPOSIT ABSOLUTE /end AXIS_DESCR
 /begin AXIS_DESCR STD_AXIS nmot_w nmot_uw_q0p25 8 0.00 16383.75 FORMAT "%8.2" DEPOSIT ABSOLUTE /end AXIS_DESCR
/end CHARACTERISTIC
/begin CHARACTERISTIC KFMIFALS_0_A "Indiziertes Fahrerwunschmoment für Füllungspfad bei Lastschlagdämpfung" MAP 0x82760C KfAxUbAyUbSstxUbSstyUwWUw 99.99847 rel_uw_b100 0.00 99.99847 FORMAT "%8.5"
 /begin AXIS_DESCR STD_AXIS gangi dez 8 0.00 255.0 FORMAT "%5.1" DEPOSIT ABSOLUTE /end AXIS_DESCR
 /begin AXIS_DESCR STD_AXIS mifa_w rel_uw_b100 8 0.00 99.99847 FORMAT "%8.5" DEPOSIT ABSOLUTE /end AXIS_DESCR
/end CHARACTERISTIC
/begin CHARACTERISTIC KFMIFALS_1_A "Indiziertes Fahrerwunschmoment für Füllungspfad bei Lastschlagdämpfung" MAP 0x8276A6 KfAxUbAyUbSstxUbSstyUwWUw 99.99847 rel_uw_b100 0.00 99.99847 FORMAT "%8.5"
 /begin AXIS_DESCR STD_AXIS gangi dez 8 0.00 255.0 FORMAT "%5.1" DEPOSIT ABSOLUTE /end AXIS_DESCR
 /begin AXIS_DESCR STD_AXIS mifa_w rel_uw_b100 8 0.00 99.99847 FORMAT "%8.5" DEPOSIT ABSOLUTE /end AXIS_DESCR
/end CHARACTERISTIC
/begin CHARACTERISTIC KFMILSD "Startwert indiziertes Moment für Lastschlagdämpfung" MAP 0x827740 KfAxUwAyUwSstxUwSstyUwWUw 99.99847 rel_uw_b100 0.00 99.99847 FORMAT "%8.5"
 /begin AXIS_DESCR STD_AXIS mivbeb_w rel_uw_b100 6 0.00 99.99847 FORMAT "%8.5" DEPOSIT ABSOLUTE /end AXIS_DESCR
 /begin AXIS_DESCR STD_AXIS nmot_w nmot_uw_q0p25 8 0.00 16383.75 FORMAT "%8.2" DEPOSIT ABSOLUTE /end AXIS_DESCR
/end CHARACTERISTIC
/begin CHARACTERISTIC KFMIMN_0_A "Minimales Schubmoment" MAP 0x827076 KfAxUbAyUbSstxUbSstyUwWUw 99.99847 rel_uw_b100 0.00 99.99847 FORMAT "%8.5"
 /begin AXIS_DESCR STD_AXIS gangi dez 8 0.00 255.0 FORMAT "%5.1" DEPOSIT ABSOLUTE /end AXIS_DESCR
 /begin AXIS_DESCR STD_AXIS nmot_w nmot_uw_q0p25 8 0.00 16383.75 FORMAT "%8.2" DEPOSIT ABSOLUTE /end AXIS_DESCR
/end CHARACTERISTIC
/begin CHARACTERISTIC KFMIMN_1_A "Minimales Schubmoment" MAP 0x827110 KfAxUbAyUbSstxUbSstyUwWUw 99.99847 rel_uw_b100 0.00 99.99847 FORMAT "%8.5"
 /begin AXIS_DESCR STD_AXIS gangi dez 8 0.00 255.0 FORMAT "%5.1" DEPOSIT ABSOLUTE /end AXIS_DESCR
 /begin AXIS_DESCR STD_AXIS nmot_w nmot_uw_q0p25 8 0.00 16383.75 FORMAT "%8.2" DEPOSIT ABSOLUTE /end AXIS_DESCR
/end CHARACTERISTIC
/begin CHARACTERISTIC KFMIOP "Kennfeld optimales Motormoment" MAP 0x816BD0 GkfWUw 99.99847 rel_uw_b100 0.00 99.99847 FORMAT "%8.5"
 /begin AXIS_DESCR COM_AXIS nmot_w nmot_uw_q0p25 16 0.00 16383.75 AXIS_PTS_REF SNM16OPUW /end AXIS_DESCR
 /begin AXIS_DESCR COM_AXIS rl_w rel_uw_q0p0234 11 0.00 1535.977 AXIS_PTS_REF SRL11OPUW /end AXIS_DESCR
/end CHARACTERISTIC
/begin CHARACTERISTIC KFMIRL "Kennfeld für Berechnung Sollfüllung" MAP 0x815554 KfAxUwAyUwSstxUwSstyUwWUw 1535.977 rel_uw_q0p0234 0.00 1535.977 FORMAT "%8.3"
 /begin AXIS_DESCR STD_AXIS nmot_w nmot_uw_q0p25 16 0.00 16383.75 FORMAT "%8.2" DEPOSIT ABSOLUTE /end AXIS_DESCR
 /begin AXIS_DESCR STD_AXIS misopl1_w rel_uw_b100 16 0.00 99.99847 FORMAT "%8.5" DEPOSIT ABSOLUTE /end AXIS_DESCR
/end CHARACTERISTIC
/begin CHARACTERISTIC KFMRES "LLR: Basis Momentenreserve im LL und ll-nahem Bereich" MAP 0x811769 GkfWUb 24.90 rel_ub_b24p9 0.00 24.90 FORMAT "%5.2"
 /begin AXIS_DESCR COM_AXIS nmot_w nmot_uw_q0p25 6 0.00 16383.75 AXIS_PTS_REF SNM06LLUB /end AXIS_DESCR
 /begin AXIS_DESCR COM_AXIS mifa_w rel_uw_b100 4 0.00 99.99847 AXIS_PTS_REF SMI04LLUB /end AXIS_DESCR
/end CHARACTERISTIC
/begin CHARACTERISTIC KFMRESK "LLR: Basis Momentenreserve im LL und ll-nahem Bereich,ausgekuppelt" MAP 0x811781 GkfWUb 24.90 rel_ub_b24p9 0.00 24.90 FORMAT "%5.2"
 /begin AXIS_DESCR COM_AXIS nmot_w nmot_uw_q0p25 6 0.00 16383.75 AXIS_PTS_REF SNM06LLUB /end AXIS_DESCR
 /begin AXIS_DESCR COM_AXIS mifa_w rel_uw_b100 4 0.00 99.99847 AXIS_PTS_REF SMI04LLUB /end AXIS_DESCR
/end CHARACTERISTIC
/begin CHARACTERISTIC KFMRESKH "Momentenreserve bei Kat.heizen" MAP 0x811799 GkfWUb 24.90 rel_ub_b24p9 0.00 24.90 FORMAT "%5.2"
 /begin AXIS_DESCR COM_AXIS dns nmotd_sb_q10 6 -1280. 1270. AXIS_PTS_REF SNS06LLSB /end AXIS_DESCR
 /begin AXIS_DESCR COM_AXIS tmot temp_ub_q0p75_o48 4 -48.00 143.3 AXIS_PTS_REF STM04SAUB /end AXIS_DESCR
/end CHARACTERISTIC
/begin CHARACTERISTIC KFMRESNL "Momentenreserve im nicht Leerlauf" MAP 0x8117B1 GkfWUb 24.90 rel_ub_b24p9 0.00 24.90 FORMAT "%5.2"
 /begin AXIS_DESCR COM_AXIS nmot_w nmot_uw_q0p25 6 0.00 16383.75 AXIS_PTS_REF SNM06LLUB /end AXIS_DESCR
 /begin AXIS_DESCR COM_AXIS mifa_w rel_uw_b100 4 0.00 99.99847 AXIS_PTS_REF SMI04LLUB /end AXIS_DESCR
/end CHARACTERISTIC
/begin CHARACTERISTIC KFMRESTA "Momentreserve abhängig von tans" MAP 0x8117C9 GkfWUb 24.90 rel_ub_b24p9 0.00 24.90 FORMAT "%5.2"
 /begin AXIS_DESCR COM_AXIS tans temp_ub_q0p75_o48 4 -48.00000 49103.25 AXIS_PTS_REF STA04LLUB /end AXIS_DESCR
 /begin AXIS_DESCR COM_AXIS mifa_w rel_uw_b100 4 0.00 99.99847 AXIS_PTS_REF SMI04LLUB /end AXIS_DESCR
/end CHARACTERISTIC
/begin CHARACTERISTIC KFNLLNST "Drehzahlverlauf nach Start" MAP 0x819E2C GkfWUb 2550. nmot_ub_q10 0.00 2550. FORMAT "%5.0"
 /begin AXIS_DESCR COM_AXIS tnst t1sxs_ub_b255 6 0.00 255.0 AXIS_PTS_REF STN06LLUB /end AXIS_DESCR
 /begin AXIS_DESCR COM_AXIS tmot temp_ub_q0p75_o48 6 -48.00 143.3 AXIS_PTS_REF STM06LLUB /end AXIS_DESCR
/end CHARACTERISTIC
/begin CHARACTERISTIC KFPED "Relatives Fahrerwunschmoment aus Fahrpedal" MAP 0x8164B0 GkfWUw 199.9969 rel_uw_b200 0.00 199.9969 FORMAT "%8.4"
 /begin AXIS_DESCR COM_AXIS wped_w relPED_uw_b100 16 0.00 100.0000 AXIS_PTS_REF SWP16MDUW /end AXIS_DESCR
 /begin AXIS_DESCR COM_AXIS nmot_w nmot_uw_q0p25 12 0.00 16383.75 AXIS_PTS_REF SNM12MDUW /end AXIS_DESCR
/end CHARACTERISTIC
/begin CHARACTERISTIC KFPEDL "Relatives Fahrerwunschmoment aus Fahrpedal für kleine Geschwindigkeiten" MAP 0x816630 GkfWUw 199.9969 rel_uw_b200 0.00 199.9969 FORMAT "%8.4"
 /begin AXIS_DESCR COM_AXIS wped_w relPED_uw_b100 16 0.00 100.0000 AXIS_PTS_REF SWP16MDUW /end AXIS_DESCR
 /begin AXIS_DESCR COM_AXIS nmot_w nmot_uw_q0p25 12 0.00 16383.75 AXIS_PTS_REF SNM12MDUW /end AXIS_DESCR
/end CHARACTERISTIC
/begin CHARACTERISTIC KFPEDR "Relatives Fahrerwunschmoment aus Fahrpedal für Rückwärtsgang" MAP 0x8167B0 GkfWUw 199.9969 rel_uw_b200 0.00 199.9969 FORMAT "%8.4"
 /begin AXIS_DESCR COM_AXIS wped_w relPED_uw_b100 16 0.00 100.0000 AXIS_PTS_REF SWP16MDUW /end AXIS_DESCR
 /begin AXIS_DESCR COM_AXIS nmot_w nmot_uw_q0p25 12 0.00 16383.75 AXIS_PTS_REF SNM12MDUW /end AXIS_DESCR
/end CHARACTERISTIC
/begin CHARACTERISTIC KFRAT "Füllungabhängige Integrationsteigung für FRAT" CURVE 0x81DA12 KlAUbSstUbWUw 0.1999664 fak_uw_b5 0.00 0.1999664 FORMAT "%9.7"
 /begin AXIS_DESCR STD_AXIS dlrfrat fak_q0p0625 5 0.00 15.94 FORMAT "%5.2" DEPOSIT ABSOLUTE /end AXIS_DESCR
/end CHARACTERISTIC
/begin CHARACTERISTIC KFRLMN "minimale Füllung im befeuerten Betrieb" MAP 0x818942 GkfWUb 191.3 rel_ub_q0p75 0.00 191.3 FORMAT "%5.1"
 /begin AXIS_DESCR COM_AXIS nmot nmot_ub_q40 12 0.00 10200. AXIS_PTS_REF SNM12FEUB /end AXIS_DESCR
 /begin AXIS_DESCR COM_AXIS tmot temp_ub_q0p75_o48 4 -48.00 143.3 AXIS_PTS_REF STM04FEUB /end AXIS_DESCR
/end CHARACTERISTIC
/begin CHARACTERISTIC KFRLMNSA "minimales rl bei Schubabschalten" MAP 0x818972 GkfWUb 191.3 rel_ub_q0p75 0.00 191.3 FORMAT "%5.1"
 /begin AXIS_DESCR COM_AXIS nmot nmot_ub_q40 12 0.00 10200. AXIS_PTS_REF SNM12FEUB /end AXIS_DESCR
 /begin AXIS_DESCR COM_AXIS tmot temp_ub_q0p75_o48 4 -48.00 143.3 AXIS_PTS_REF STM04FEUB /end AXIS_DESCR
/end CHARACTERISTIC
/begin CHARACTERISTIC KFUSHK "Sondenspannungssollwert für Regelung hinter Kat. (statt KFUSRHK für Variantenk.)" MAP 0x81206C KfAxUbAyUbSstxUbSstyUbWUb 1.330 spg_ub_q0p0052_o0p2 -0.2000 1.130 FORMAT "%5.3"
 /begin AXIS_DESCR STD_AXIS nmot nmot_ub_q40 10 0.00 10200. FORMAT "%5.0" DEPOSIT ABSOLUTE /end AXIS_DESCR
 /begin AXIS_DESCR STD_AXIS rl rel_ub_q0p75 10 0.00 191.3 FORMAT "%5.1" DEPOSIT ABSOLUTE /end AXIS_DESCR
/end CHARACTERISTIC
/begin CHARACTERISTIC KFVERST "Gewichtungskennfeld für Reibmomentenaufsteuerung" MAP 0x8271AA KfAxUwAyUwSstxUwSstyUwWUw 7.999878 fak_uw_b8 0.00 7.999878 FORMAT "%8.6"
 /begin AXIS_DESCR STD_AXIS wped_w relPED_uw_b100 3 0.00 100.0000 FORMAT "%8.4" DEPOSIT ABSOLUTE /end AXIS_DESCR
 /begin AXIS_DESCR STD_AXIS nmot_w nmot_uw_q0p25 3 0.00 16383.75 FORMAT "%8.2" DEPOSIT ABSOLUTE /end AXIS_DESCR
/end CHARACTERISTIC
/begin CHARACTERISTIC KFWMIFAL "Überhöhungsfaktor für Füllungspfad bei Lastschlagdämpfung" MAP 0x811871 KfAxUbAyUbSstxUbSstyUbWUb 0.9922 fak_ub_b2 1.000 1.992 FORMAT "%5.3"
 /begin AXIS_DESCR STD_AXIS wped relPED_ub_b100 4 0.00 100.0 FORMAT "%5.1" DEPOSIT ABSOLUTE /end AXIS_DESCR
 /begin AXIS_DESCR STD_AXIS nmot nmot_ub_q40 4 0.00 10200. FORMAT "%5.0" DEPOSIT ABSOLUTE /end AXIS_DESCR
/end CHARACTERISTIC
/begin CHARACTERISTIC KFWZLSD "Reduktionsfaktor für Zeitkonstante Lastschlagdämpfung" MAP 0x81188B KfAxUbAyUbSstxUbSstyUbWUb 0.9961 fak_ub_b1 0.00 0.9961
 /begin AXIS_DESCR STD_AXIS wped relPED_ub_b100 4 0.00 100.0 FORMAT "%5.1" DEPOSIT ABSOLUTE /end AXIS_DESCR
 /begin AXIS_DESCR STD_AXIS nmot nmot_ub_q40 4 0.00 10200. FORMAT "%5.0" DEPOSIT ABSOLUTE /end AXIS_DESCR
/end CHARACTERISTIC
/begin CHARACTERISTIC KFZDASH_0_A "Zeitkonstante PT1-Filter Dashpot" MAP 0x8277C0 GkfWUw 81.880000000 zk10msxs_uw_b655 0.040000000000 81.920000000 FORMAT "%12.9" /begin AXIS_DESCR COM_AXIS gangi dez 8 0.00 255.0 AXIS_PTS_REF SGA08MDUB /end AXIS_DESCR
 /begin AXIS_DESCR COM_AXIS nmot_w nmot_uw_q0p25 6 0.00 16383.75 AXIS_PTS_REF SNM06MDUW /end AXIS_DESCR
/end CHARACTERISTIC
/begin CHARACTERISTIC KFZDASH_1_A "Zeitkonstante PT1-Filter Dashpot" MAP 0x827820 GkfWUw 81.880000000 zk10msxs_uw_b655 0.040000000000 81.920000000 FORMAT "%12.9" /begin AXIS_DESCR COM_AXIS gangi dez 8 0.00 255.0 AXIS_PTS_REF SGA08MDUB /end AXIS_DESCR
 /begin AXIS_DESCR COM_AXIS nmot_w nmot_uw_q0p25 6 0.00 16383.75 AXIS_PTS_REF SNM06MDUW /end AXIS_DESCR
/end CHARACTERISTIC
/begin CHARACTERISTIC KFZDASH2_0_A "Zeitkonstante PT1-Filter Dashpot bei kleinem Kupplungsmoment" MAP 0x827880 GkfWUw 81.880000000 zk10msxs_uw_b655 0.040000000000 81.920000000 FORMAT "%12.9" /begin AXIS_DESCR COM_AXIS gangi dez 8 0.00 255.0 AXIS_PTS_REF SGA08MDUB /end AXIS_DESCR
 /begin AXIS_DESCR COM_AXIS nmot_w nmot_uw_q0p25 6 0.00 16383.75 AXIS_PTS_REF SNM06MDUW /end AXIS_DESCR
/end CHARACTERISTIC
/begin CHARACTERISTIC KFZDASH2_1_A "Zeitkonstante PT1-Filter Dashpot bei kleinem Kupplungsmoment" MAP 0x8278E0 GkfWUw 81.880000000 zk10msxs_uw_b655 0.040000000000 81.920000000 FORMAT "%12.9" /begin AXIS_DESCR COM_AXIS gangi dez 8 0.00 255.0 AXIS_PTS_REF SGA08MDUB /end AXIS_DESCR
 /begin AXIS_DESCR COM_AXIS nmot_w nmot_uw_q0p25 6 0.00 16383.75 AXIS_PTS_REF SNM06MDUW /end AXIS_DESCR
/end CHARACTERISTIC
/begin CHARACTERISTIC KFZLSD_0_A "Zeitkonstante PT2-Filter Lastschlagdämpfung" MAP 0x827940 GkfWUw 655.34999985 zk10msxs_uw_b655 0.010000152590 655.36000000 FORMAT "%12.8" /begin AXIS_DESCR COM_AXIS gangi dez 8 0.00 255.0 AXIS_PTS_REF SGA08MDUB /end AXIS_DESCR
 /begin AXIS_DESCR COM_AXIS nmot_w nmot_uw_q0p25 6 0.00 16383.75 AXIS_PTS_REF SNM06MDUW /end AXIS_DESCR
/end CHARACTERISTIC
/begin CHARACTERISTIC KFZLSD_1_A "Zeitkonstante PT2-Filter Lastschlagdämpfung" MAP 0x8279A0 GkfWUw 655.34999985 zk10msxs_uw_b655 0.010000152590 655.36000000 FORMAT "%12.8" /begin AXIS_DESCR COM_AXIS gangi dez 8 0.00 255.0 AXIS_PTS_REF SGA08MDUB /end AXIS_DESCR
 /begin AXIS_DESCR COM_AXIS nmot_w nmot_uw_q0p25 6 0.00 16383.75 AXIS_PTS_REF SNM06MDUW /end AXIS_DESCR
/end CHARACTERISTIC
/begin CHARACTERISTIC KFZNSM "Zeitkonstante für Solldrehzahlabregelung" MAP 0x819E50 GkfWUb 5.08000 zk20msxs_ub_b5p1 0.0200000 5.10000 FORMAT "%7.5"
 /begin AXIS_DESCR COM_AXIS tmot temp_ub_q0p75_o48 6 -48.00 143.3 AXIS_PTS_REF STM06LLUB /end AXIS_DESCR
 /begin AXIS_DESCR COM_AXIS dns nmotd_sb_q10 6 -1280. 1270. AXIS_PTS_REF SNS06LLSB /end AXIS_DESCR
/end CHARACTERISTIC
/begin CHARACTERISTIC KFZWOP "optimaler Zündwinkel" MAP 0x81193E GkfWSb 191.3 zw_sb_q0p75 -96.00 95.25 FORMAT "%5.2"
 /begin AXIS_DESCR COM_AXIS nmot_w nmot_uw_q0p25 16 0.00 16383.75 AXIS_PTS_REF SNM16OPUW /end AXIS_DESCR
 /begin AXIS_DESCR COM_AXIS rl_w rel_uw_q0p0234 11 0.00 1535.977 AXIS_PTS_REF SRL11OPUW /end AXIS_DESCR
/end CHARACTERISTIC
/begin CHARACTERISTIC KFZWOP2 "optimaler Zündwinkel Variante 2" MAP 0x8119EE GkfWSb 191.3 zw_sb_q0p75 -96.00 95.25 FORMAT "%5.2"
 /begin AXIS_DESCR COM_AXIS nmot_w nmot_uw_q0p25 16 0.00 16383.75 AXIS_PTS_REF SNM16OPUW /end AXIS_DESCR
 /begin AXIS_DESCR COM_AXIS rl_w rel_uw_q0p0234 11 0.00 1535.977 AXIS_PTS_REF SRL11OPUW /end AXIS_DESCR
/end CHARACTERISTIC
/begin CHARACTERISTIC KILRHML "I-Anteil fuer stetige LRHK" CURVE 0x8120E6 GklWUb 0.04980 freq_ub_b0p05 0.00 0.04980 FORMAT "%7.5" /begin AXIS_DESCR COM_AXIS ml m_ub_b1020 8 0.00 1020. AXIS_PTS_REF SML08LHUB /end AXIS_DESCR /end CHARACTERISTIC
/begin CHARACTERISTIC KLFRTMKI "Kennlinie Regelfaktor aus Motortemperatur" CURVE 0x81A1D5 KlAUbSstUbWUb 1.992 fak_ub_b2 0.00 1.992 FORMAT "%5.3"
 /begin AXIS_DESCR STD_AXIS tmki temp_ub_q0p75_o48 4 -48.00 143.3 FORMAT "%5.1" DEPOSIT ABSOLUTE /end AXIS_DESCR
/end CHARACTERISTIC
/begin CHARACTERISTIC KLMIMNH "höhenabhängige Korrektur des minimalen  Moments" CURVE 0x8271CC KlAUbSstUbWSb 49.80 rel_sb_b25 -25.00 24.80 FORMAT "%5.2"
 /begin AXIS_DESCR STD_AXIS fho fak_ub_b4 6 0.00 3.984 FORMAT "%5.3" DEPOSIT ABSOLUTE /end AXIS_DESCR
/end CHARACTERISTIC
/begin CHARACTERISTIC KLMRESTM "Kennlinie für Momentenreserve im Nachstart" CURVE 0x8117D9 KlAUbSstUbWUb 24.90 rel_ub_b24p9 0.00 24.90 FORMAT "%5.2"
 /begin AXIS_DESCR STD_AXIS tmot temp_ub_q0p75_o48 10 -48.00 143.3 FORMAT "%5.1" DEPOSIT ABSOLUTE /end AXIS_DESCR
/end CHARACTERISTIC
/begin CHARACTERISTIC KLMRHO "Kennlinie: Drehmomentreserve höhenabhängig" CURVE 0x8117EE KlAUbSstUbWUb 24.90 rel_ub_b24p9 0.00 24.90 FORMAT "%5.2"
 /begin AXIS_DESCR STD_AXIS fho fak_ub_b4 10 0.00 3.984 FORMAT "%5.3" DEPOSIT ABSOLUTE /end AXIS_DESCR
/end CHARACTERISTIC
/begin CHARACTERISTIC KNSNF "Sperrband für Solldrehzahlnachführung" VALUE 0x819E74 KwUb 2550. nmot_ub_q10 0.00 2550. FORMAT "%5.0" /end CHARACTERISTIC
/begin CHARACTERISTIC KPLRHML "P-Anteil fuer stetige LRHK" CURVE 0x8120EE GklWUb 3.984 fak_ub_b4 0.00 3.984 FORMAT "%5.3" /begin AXIS_DESCR COM_AXIS ml m_ub_b1020 8 0.00 1020. AXIS_PTS_REF SML08LHUB /end AXIS_DESCR /end CHARACTERISTIC
/begin CHARACTERISTIC KVZAF "Verstärkungsfaktor Zusatzamplitudenfilter" VALUE 0x812044 KwSb 3.984 fak_sb_b2 -2.000 1.984 FORMAT "%5.3" /end CHARACTERISTIC
/begin CHARACTERISTIC LALIUSH "Lambdalinearisierung, Sonde hinter Katalysator" CURVE 0x8173F6 KlAUwSstUwWUw 15.99976 fak_uw_b16 0.00 15.99976 FORMAT "%8.5"
 /begin AXIS_DESCR STD_AXIS ushk_w spg_uw_q0p00488_o1 10 -1.000000 318.9951 FORMAT "%8.4" DEPOSIT ABSOLUTE /end AXIS_DESCR
/end CHARACTERISTIC
/begin CHARACTERISTIC LALIUSMN "minimales messbares Lambda" VALUE 0x817374 KwUw 15.99976 fak_uw_b16 0.00 15.99976 FORMAT "%8.5" /end CHARACTERISTIC
/begin CHARACTERISTIC LALIUSRH "Lambdalinearisierung, Sonde hinter Katalysator, Sollwert" CURVE 0x817420 KlAUbSstUbWUw 15.99976 fak_uw_b16 0.00 15.99976 FORMAT "%8.5"
 /begin AXIS_DESCR STD_AXIS usrhk spg_ub_q0p0052_o0p2 10 -0.2000 1.130 FORMAT "%5.3" DEPOSIT ABSOLUTE /end AXIS_DESCR
/end CHARACTERISTIC
/begin CHARACTERISTIC LAMKADEF "Defaultwert Lambda für Katausräumen inaktiv" VALUE 0x81746E KwUw 15.99976 fak_uw_b16 0.00 15.99976 FORMAT "%8.5" /end CHARACTERISTIC
/begin CHARACTERISTIC LAMKAML "Lambdasollwert für Katalysator-Ausräumen (luftmassenabhängig)" CURVE 0x817470 KlAUbSstUbWUw 15.99976 fak_uw_b16 0.00 15.99976 FORMAT "%8.5"
 /begin AXIS_DESCR STD_AXIS ml m_ub_b1020 5 0.00 1020. FORMAT "%5.0" DEPOSIT ABSOLUTE /end AXIS_DESCR
/end CHARACTERISTIC
/begin CHARACTERISTIC LAMLRAMN "minimale Lambda-Schwelle, bei der die Gemischadaption aktiv sein kann" VALUE 0x81DB7E KwUw 15.99976 fak_uw_b16 0.00 15.99976 FORMAT "%8.5" /end CHARACTERISTIC
/begin CHARACTERISTIC LAMLRAMX "maximale Lambda-Schwelle, bei der die Gemischadaption aktiv sein kann" VALUE 0x81DB80 KwUw 15.99976 fak_uw_b16 0.00 15.99976 FORMAT "%8.5" /end CHARACTERISTIC
/begin CHARACTERISTIC LAMSKAMX "Lambda-Ist vor Kat für Erkennung Magerbedingung Kat-Ausräumen" VALUE 0x817480 KwUw 15.99976 fak_uw_b16 0.00 15.99976 FORMAT "%8.5" /end CHARACTERISTIC
/begin CHARACTERISTIC LASHKAB "Startwert für dynamische Sollwertanhebung (lamsolh) in der LRHK" VALUE 0x817440 KwSw 0.9999695 fak_sw_b1 0.00 0.9999695 FORMAT "%9.7" /end CHARACTERISTIC
/begin CHARACTERISTIC LBZO1 "Schwelle für lbz zur Solldrehzahlanhebung beim Verlassen des LL" VALUE 0x819E75 KwUb 99.61 rel_ub_b99p6 0.00 99.61 FORMAT "%5.2" /end CHARACTERISTIC
/begin CHARACTERISTIC LBZO2 "Schwelle für lbz zur Solldrehzahlanhebung im Leerlauf" VALUE 0x819E76 KwUb 99.61 rel_ub_b99p6 0.00 99.61 FORMAT "%5.2" /end CHARACTERISTIC
/begin CHARACTERISTIC LBZU "Schwelle für lbz zur Solldrehzahlabsenkung beim Verlassen des Leerlaufs" VALUE 0x819E77 KwUb 99.61 rel_ub_b99p6 0.00 99.61 FORMAT "%5.2" /end CHARACTERISTIC
/begin CHARACTERISTIC LIMN "Untere Integratorbegrenzung bei stehendem Fahrzeug" VALUE 0x811654 KwUb 24.90 rel_ub_bn24p9 -24.90 0.00 FORMAT "%5.2" /end CHARACTERISTIC
/begin CHARACTERISTIC LIMNDLLR "Untere Integratorbegrenzung bei Diagnose Leerlaufregelung" VALUE 0x811655 KwUb 24.90 rel_ub_bn24p9 -24.90 0.00 FORMAT "%5.2" /end CHARACTERISTIC
/begin CHARACTERISTIC LIMNDTES "Untere Integratorbegrenzung bei DTES" VALUE 0x811656 KwUb 24.90 rel_ub_bn24p9 -24.90 0.00 FORMAT "%5.2" /end CHARACTERISTIC
/begin CHARACTERISTIC LIMNV "Untere Integratorbegrenzung bei rollendem Fahrzeug" VALUE 0x811657 KwUb 24.90 rel_ub_bn24p9 -24.90 0.00 FORMAT "%5.2" /end CHARACTERISTIC
/begin CHARACTERISTIC LIMXDNS "Obere Integratorbegrenzung bei stehendem Fahrzeug" CURVE 0x819F6B GklWUb 24.90 rel_ub_b24p9 0.00 24.90 FORMAT "%5.2"
 /begin AXIS_DESCR COM_AXIS dns nmotd_sb_q10 6 -1280. 1270. AXIS_PTS_REF SNS206LLSB /end AXIS_DESCR
/end CHARACTERISTIC
/begin CHARACTERISTIC LIMXVDNS "Obere Integratorbegrenzung bei rollendem Fahrzeug" CURVE 0x819F71 GklWUb 24.90 rel_ub_b24p9 0.00 24.90 FORMAT "%5.2"
 /begin AXIS_DESCR COM_AXIS dns nmotd_sb_q10 6 -1280. 1270. AXIS_PTS_REF SNS206LLSB /end AXIS_DESCR
/end CHARACTERISTIC
/begin CHARACTERISTIC LISTM_0_A "Wert des Leerlaufintegrators im Start" CURVE 0x819F77 GklWUb 24.90 rel_ub_b24p9 0.00 24.90 FORMAT "%5.2"
 /begin AXIS_DESCR COM_AXIS tmot temp_ub_q0p75_o48 6 -48.00 143.3 AXIS_PTS_REF STM06LLUB /end AXIS_DESCR
/end CHARACTERISTIC
/begin CHARACTERISTIC LISTM_1_A "Wert des Leerlaufintegrators im Start" CURVE 0x819F7D GklWUb 24.90 rel_ub_b24p9 0.00 24.90 FORMAT "%5.2"
 /begin AXIS_DESCR COM_AXIS tmot temp_ub_q0p75_o48 6 -48.00 143.3 AXIS_PTS_REF STM06LLUB /end AXIS_DESCR
/end CHARACTERISTIC
/begin CHARACTERISTIC LLRICNF "Configurationsbyte für LLR Integrator" VALUE 0x811658 KwUb 255.0 dez 0.00 255.0 FORMAT "%5.1" /end CHARACTERISTIC
/begin CHARACTERISTIC LRHIMN "minimale Integratorgrenze der stetigen LRHK" VALUE 0x817442 KwSw 1.999969 fak_sw_b1 -1.000000 0.9999695 FORMAT "%8.6" /end CHARACTERISTIC
/begin CHARACTERISTIC LRHIMX "maximale Integratorgrenze der stetigen LRHK" VALUE 0x817444 KwSw 1.999969 fak_sw_b1 -1.000000 0.9999695 FORMAT "%8.6" /end CHARACTERISTIC
/begin CHARACTERISTIC LRSGKTM "Korrekturkennlinie der Reglerparameter bei tiefen Motortemperaturen" CURVE 0x81A22A KlAUbSstUbWUb 1.992 fak_ub_b2 0.00 1.992 FORMAT "%5.3"
 /begin AXIS_DESCR STD_AXIS tmot temp_ub_q0p75_o48 6 -48.00 143.3 FORMAT "%5.1" DEPOSIT ABSOLUTE /end AXIS_DESCR
/end CHARACTERISTIC
/begin CHARACTERISTIC LRSTPZA "Periodendauer der LRS-Zwangsamplitude" VALUE 0x817376 KwUw 655.3500 t10msxs_uw_b655p35 0.00 655.3500 FORMAT "%8.4" /end CHARACTERISTIC
/begin CHARACTERISTIC LRSZAWML "Kennlinie Amplitude der LRS-Zwangsamplitude" CURVE 0x817378 KlAUwSstUwWUb 0.249023438 fak_ub_b0p25 0.00 0.249023438 FORMAT "%11.9"
 /begin AXIS_DESCR STD_AXIS ml_w m_uw_b6553p5 6 0.00 6553.500 FORMAT "%8.3" DEPOSIT ABSOLUTE /end AXIS_DESCR
/end CHARACTERISTIC
/begin CHARACTERISTIC MDBGRGA "Momentenbegrenzung für Luftpfad" CURVE 0x827CA4 FklWUw 99.99847 rel_uw_b100 0.00 99.99847 FORMAT "%8.5"
 /begin AXIS_DESCR FIX_AXIS gangi dez 8 0.00 7.000 FORMAT "%5.3" FIX_AXIS_PAR 0 0 8 /end AXIS_DESCR
/end CHARACTERISTIC
/begin CHARACTERISTIC MDHYEZ "Momenten-Hysterese bei Entscheidung der Zylinderausblendung" VALUE 0x811AB2 KwUb 99.61 rel_ub_b99p6 0.00 99.61 FORMAT "%5.2" /end CHARACTERISTIC
/begin CHARACTERISTIC MIFABGMX_0_A "Maximalwert mifa_w für Momentenänderungsbegrenzung" VALUE 0x8169CA KwUw 99.99847 rel_uw_b100 0.00 99.99847 FORMAT "%8.5" /end CHARACTERISTIC
/begin CHARACTERISTIC MIFABGMX_1_A "Maximalwert mifa_w für Momentenänderungsbegrenzung" VALUE 0x8169CC KwUw 99.99847 rel_uw_b100 0.00 99.99847 FORMAT "%8.5" /end CHARACTERISTIC
/begin CHARACTERISTIC MIFALMF "Indiziertes Fahrerwunschmoment für Füllungspfad bei aktiver Gradientenbegrenzung" CURVE 0x816930 KlAUwSstUwWUw 99.99847 rel_uw_b100 0.00 99.99847 FORMAT "%8.5"
 /begin AXIS_DESCR STD_AXIS mifa_w rel_uw_b100 8 0.00 99.99847 FORMAT "%8.5" DEPOSIT ABSOLUTE /end AXIS_DESCR
/end CHARACTERISTIC
/begin CHARACTERISTIC MKBRMXWP "Maximal zulässiges Kupplungsmoment bei betätigter Bremse" CURVE 0x827CB4 KlAUwSstUwWUw 99.99847 rel_uw_b100 0.00 99.99847 FORMAT "%8.5"
 /begin AXIS_DESCR STD_AXIS wped_w relPED_uw_b100 8 0.00 100.0000 FORMAT "%8.4" DEPOSIT ABSOLUTE /end AXIS_DESCR
/end CHARACTERISTIC
/begin CHARACTERISTIC MKFADPN_0_A "Kupplungsmoment für Umschaltung Dashpot-Filterzeit" CURVE 0x81A0FA GklWSb 99.60 rel_sb_q0p39 -50.00 49.61 FORMAT "%5.2"
 /begin AXIS_DESCR COM_AXIS nmot_w nmot_uw_q0p25 6 0.00 16383.75 AXIS_PTS_REF SNM06MDUW /end AXIS_DESCR
/end CHARACTERISTIC
/begin CHARACTERISTIC MKFADPN_1_A "Kupplungsmoment für Umschaltung Dashpot-Filterzeit" CURVE 0x81A100 GklWSb 99.60 rel_sb_q0p39 -50.00 49.61 FORMAT "%5.2"
 /begin AXIS_DESCR COM_AXIS nmot_w nmot_uw_q0p25 6 0.00 16383.75 AXIS_PTS_REF SNM06MDUW /end AXIS_DESCR
/end CHARACTERISTIC
/begin CHARACTERISTIC MKFADPN1_0_A "Kupplungsmoment für Umschaltung Dashpot-Filterzeit bei Klimakompressor" CURVE 0x81A106 GklWSb 99.60 rel_sb_q0p39 -50.00 49.61 FORMAT "%5.2"
 /begin AXIS_DESCR COM_AXIS nmot_w nmot_uw_q0p25 6 0.00 16383.75 AXIS_PTS_REF SNM06MDUW /end AXIS_DESCR
/end CHARACTERISTIC
/begin CHARACTERISTIC MKFADPN1_1_A "Kupplungsmoment für Umschaltung Dashpot-Filterzeit bei Klimakompressor" CURVE 0x81A10C GklWSb 99.60 rel_sb_q0p39 -50.00 49.61 FORMAT "%5.2"
 /begin AXIS_DESCR COM_AXIS nmot_w nmot_uw_q0p25 6 0.00 16383.75 AXIS_PTS_REF SNM06MDUW /end AXIS_DESCR
/end CHARACTERISTIC
/begin CHARACTERISTIC MKMIFABG_0_A "Kupplungsmoment für Aktivierung der Momentenänderungsbegrenzung" VALUE 0x8169CE KwSw 199.9969 rel_sw_b100 -100.0000 99.99695 FORMAT "%8.4" /end CHARACTERISTIC
/begin CHARACTERISTIC MKMIFABG_1_A "Kupplungsmoment für Aktivierung der Momentenänderungsbegrenzung" VALUE 0x8169D0 KwSw 199.9969 rel_sw_b100 -100.0000 99.99695 FORMAT "%8.4" /end CHARACTERISTIC
/begin CHARACTERISTIC MLNKAX "Luftmassenschwelle für Einschaltbereitschaft LRSHK I-Anteil" VALUE 0x817446 KwUw 7281.667 m_uw_b7281 0.00 7281.667 FORMAT "%8.3" /end CHARACTERISTIC
/begin CHARACTERISTIC MLO1 "obere Luftmengenschwelle Bereich 1" VALUE 0x81DA22 KwUw 6553.500 m_uw_b6553p5 0.00 6553.500 FORMAT "%8.3" /end CHARACTERISTIC
/begin CHARACTERISTIC MLO1AC "obere Luftmengenschwelle Bereich 1 mit Kompressor" VALUE 0x81DA24 KwUw 6553.500 m_uw_b6553p5 0.00 6553.500 FORMAT "%8.3" /end CHARACTERISTIC
/begin CHARACTERISTIC MLO2 "obere Luftmengenschwelle Bereich 2" VALUE 0x813FEA KwUw 6553.500 m_uw_b6553p5 0.00 6553.500 FORMAT "%8.3" /end CHARACTERISTIC
/begin CHARACTERISTIC MLO3 "obere Luftmengenschwelle Bereich 3" VALUE 0x81DA26 KwUw 6553.500 m_uw_b6553p5 0.00 6553.500 FORMAT "%8.3" /end CHARACTERISTIC
/begin CHARACTERISTIC MLO3AC "obere Luftmengenschwelle Bereich 3 mit Kompressor" VALUE 0x81DA28 KwUw 6553.500 m_uw_b6553p5 0.00 6553.500 FORMAT "%8.3" /end CHARACTERISTIC
/begin CHARACTERISTIC MLU2 "untere Luftmengenschwelle Bereich 2" VALUE 0x81DA2A KwUw 6553.500 m_uw_b6553p5 0.00 6553.500 FORMAT "%8.3" /end CHARACTERISTIC
/begin CHARACTERISTIC MLU2AC "untere Luftmengenschwelle Bereich 2 mit Kompressor" VALUE 0x81DA2C KwUw 6553.500 m_uw_b6553p5 0.00 6553.500 FORMAT "%8.3" /end CHARACTERISTIC
/begin CHARACTERISTIC MLU2FA "untere Luftmengenschwelle bei Funktionsanforderung B_faan Bereich 2" VALUE 0x81DA2E KwUw 6553.500 m_uw_b6553p5 0.00 6553.500 FORMAT "%8.3" /end CHARACTERISTIC
/begin CHARACTERISTIC MLU4 "untere Luftmengenschwelle Bereich 4" VALUE 0x813FEC KwUw 6553.500 m_uw_b6553p5 0.00 6553.500 FORMAT "%8.3" /end CHARACTERISTIC
/begin CHARACTERISTIC MLU4AC "untere Luftmengenschwelle Bereich 4 mit Kompressor" VALUE 0x813FEE KwUw 6553.500 m_uw_b6553p5 0.00 6553.500 FORMAT "%8.3" /end CHARACTERISTIC
/begin CHARACTERISTIC MRESKH "Momentenreserve bei Kat.heizen" VALUE 0x8161D6 KwUw 99.99847 rel_uw_b100 0.00 99.99847 FORMAT "%8.5" /end CHARACTERISTIC
/begin CHARACTERISTIC MRESLL "LLR: Erhöhte Momentenreserve im LL nach Drehzahleinbruch" VALUE 0x811803 KwUb 24.90 rel_ub_b24p9 0.00 24.90 FORMAT "%5.2" /end CHARACTERISTIC
/begin CHARACTERISTIC MRESNW "Momentenreserve bei Nockenwellenverstellung" VALUE 0x811804 KwUb 99.61 rel_ub_b99p6 0.00 99.61 FORMAT "%5.2" /end CHARACTERISTIC
/begin CHARACTERISTIC MRESSL "Momentenreserve bei Servolenkung" VALUE 0x8161D8 KwUw 99.99847 rel_uw_b100 0.00 99.99847 FORMAT "%8.5" /end CHARACTERISTIC
/begin CHARACTERISTIC MRFALLO "Obere Leerlaufschwelle des relativen Fahrerwunschmoments" VALUE 0x816952 KwUw 199.9969 rel_uw_b200 0.00 199.9969 FORMAT "%8.4" /end CHARACTERISTIC
/begin CHARACTERISTIC MRFALLU "Untere Leerlaufschwelle des relativen Fahrerwunschmoments" VALUE 0x816954 KwUw 199.9969 rel_uw_b200 0.00 199.9969 FORMAT "%8.4" /end CHARACTERISTIC
/begin CHARACTERISTIC MRFAVLN "Vollasterkennungsschwelle des relativen Fahrerwunsches" CURVE 0x827A00 KlAUwSstUwWUw 199.9969 rel_uw_b200 0.00 199.9969 FORMAT "%8.4"
 /begin AXIS_DESCR STD_AXIS nmot_w nmot_uw_q0p25 14 0.00 16383.75 FORMAT "%8.2" DEPOSIT ABSOLUTE /end AXIS_DESCR
/end CHARACTERISTIC
/begin CHARACTERISTIC N0 "Umrechnungskonstante für Einrechnung Gemischkorrektur rkat" VALUE 0x8110A6 KwUb 10200. nmot_ub_q40 0.00 10200. FORMAT "%5.0" /end CHARACTERISTIC
/begin CHARACTERISTIC NASNOTKL "Kennlinie für Drehzahlschwelle für Abwürgeschutz" CURVE 0x81A113 KlAUbSstUbWUb 10200. nmot_ub_q40 0.00 10200. FORMAT "%5.0"
 /begin AXIS_DESCR STD_AXIS tmot temp_ub_q0p75_o48 4 -48.00 143.3 FORMAT "%5.1" DEPOSIT ABSOLUTE /end AXIS_DESCR
/end CHARACTERISTIC
/begin CHARACTERISTIC NFHZ "Solldrehzahl bei eingeschalteter Frontscheibenheizung" VALUE 0x819E78 KwUb 2550. nmot_ub_q10 0.00 2550. FORMAT "%5.0" /end CHARACTERISTIC
/begin CHARACTERISTIC NFHZFS "Solldrehzahl bei eingeschalteter Frontscheibenheizung und B_fs=1" VALUE 0x819E79 KwUb 2550. nmot_ub_q10 0.00 2550. FORMAT "%5.0" /end CHARACTERISTIC
/begin CHARACTERISTIC NFS2M "Solldrehzahl 2 Fahrstufenschalter ein" CURVE 0x819E7A GklWUb 2550. nmot_ub_q10 0.00 2550. FORMAT "%5.0"
 /begin AXIS_DESCR COM_AXIS tmot temp_ub_q0p75_o48 6 -48.00 143.3 AXIS_PTS_REF STM06LLUB /end AXIS_DESCR
/end CHARACTERISTIC
/begin CHARACTERISTIC NFSKO_0_A "Solldrehzahl für Klimaanlage bei B_fs=1" VALUE 0x81FBA0 KwUb 2550. nmot_ub_q10 0.00 2550. FORMAT "%5.0" /end CHARACTERISTIC
/begin CHARACTERISTIC NFSKO_1_A "Solldrehzahl für Klimaanlage bei B_fs=1" VALUE 0x81FBA1 KwUb 2550. nmot_ub_q10 0.00 2550. FORMAT "%5.0" /end CHARACTERISTIC
/begin CHARACTERISTIC NFSKO_2_A "Solldrehzahl für Klimaanlage bei B_fs=1" VALUE 0x81FBA2 KwUb 2550. nmot_ub_q10 0.00 2550. FORMAT "%5.0" /end CHARACTERISTIC
/begin CHARACTERISTIC NFSKO_3_A "Solldrehzahl für Klimaanlage bei B_fs=1" VALUE 0x81FBA3 KwUb 2550. nmot_ub_q10 0.00 2550. FORMAT "%5.0" /end CHARACTERISTIC
/begin CHARACTERISTIC NFSKS "Solldrehzahl für Kochschutz (Fahrstufe eingelegt)" VALUE 0x819E80 KwUb 2550. nmot_ub_q10 0.00 2550. FORMAT "%5.0" /end CHARACTERISTIC
/begin CHARACTERISTIC NFSLPWG "Solldrehzahl bei Ausfall PWG-Signal bei B_fs=1" VALUE 0x819E81 KwUb 2550. nmot_ub_q10 0.00 2550. FORMAT "%5.0" /end CHARACTERISTIC
/begin CHARACTERISTIC NFSMIN_0_A "Minimale zulässige Solldrehzahl bei eingelegter Fahrstufe" VALUE 0x81FBA4 KwUb 2550. nmot_ub_q10 0.00 2550. FORMAT "%5.0" /end CHARACTERISTIC
/begin CHARACTERISTIC NFSMIN_1_A "Minimale zulässige Solldrehzahl bei eingelegter Fahrstufe" VALUE 0x81FBA5 KwUb 2550. nmot_ub_q10 0.00 2550. FORMAT "%5.0" /end CHARACTERISTIC
/begin CHARACTERISTIC NFSMIN_2_A "Minimale zulässige Solldrehzahl bei eingelegter Fahrstufe" VALUE 0x81FBA6 KwUb 2550. nmot_ub_q10 0.00 2550. FORMAT "%5.0" /end CHARACTERISTIC
/begin CHARACTERISTIC NFSMIN_3_A "Minimale zulässige Solldrehzahl bei eingelegter Fahrstufe" VALUE 0x81FBA7 KwUb 2550. nmot_ub_q10 0.00 2550. FORMAT "%5.0" /end CHARACTERISTIC
/begin CHARACTERISTIC NFSNLDG "Soll-Drehzahlerhöhung bei Drehzahlgeber-Notlauf" VALUE 0x819E82 KwUb 2550. nmot_ub_q10 0.00 2550. FORMAT "%5.0" /end CHARACTERISTIC
/begin CHARACTERISTIC NFSNWLL "Solldrehzahlanhebung bei Nockenwellenfehler (B_fs = true)" VALUE 0x819E83 KwUb 2550. nmot_ub_q10 0.00 2550. FORMAT "%5.0" /end CHARACTERISTIC
/begin CHARACTERISTIC NFSSBC "Leerlaufsolldrehzahl bei Standabkopplung" VALUE 0x819E84 KwUb 2550. nmot_ub_q10 0.00 2550. FORMAT "%5.0" /end CHARACTERISTIC
/begin CHARACTERISTIC NFSSL "Soll-Drehzahl bei Servolenkungsschalter aktiv und B_fs=1" VALUE 0x819E85 KwUb 2550. nmot_ub_q10 0.00 2550. FORMAT "%5.0" /end CHARACTERISTIC
/begin CHARACTERISTIC NGFSAWE "Schwelle Drehzahlgradient für Sperrung Filter SA/WE" VALUE 0x816956 KwSw 25599.94 nmotg_sw_q0p39 -12800.16 12799.77 FORMAT "%8.2" /end CHARACTERISTIC
/begin CHARACTERISTIC NGNSNF "Drehzahlgradientenschwelle zur Auslösung der Drehzahlnachführung" VALUE 0x819E86 KwUb 25500. nmotg_ub_q100 0.00 25500. FORMAT "%5.0" /end CHARACTERISTIC
/begin CHARACTERISTIC NLL2M "Solldrehzahl 2" CURVE 0x819E87 GklWUb 2550. nmot_ub_q10 0.00 2550. FORMAT "%5.0"
 /begin AXIS_DESCR COM_AXIS tmot temp_ub_q0p75_o48 6 -48.00 143.3 AXIS_PTS_REF STM06LLUB /end AXIS_DESCR
/end CHARACTERISTIC
/begin CHARACTERISTIC NLLCVTMXV "Begrenzung der Drehzahlvorgabe (CVT-Getriebe)" CURVE 0x819E8D KlAUbSstUbWUb 2550. nmot_ub_q10 0.00 2550. FORMAT "%5.0"
 /begin AXIS_DESCR STD_AXIS vfzg vfzg_ub_q1p25 8 0.00 318.8 FORMAT "%5.1" DEPOSIT ABSOLUTE /end AXIS_DESCR
/end CHARACTERISTIC
/begin CHARACTERISTIC NLLMG "Solldrehzahl" MAP 0x819E9E GkfWUb 2550. nmot_ub_q10 0.00 2550. FORMAT "%5.0"
 /begin AXIS_DESCR COM_AXIS tmot temp_ub_q0p75_o48 6 -48.00 143.3 AXIS_PTS_REF STM06LLUB /end AXIS_DESCR
 /begin AXIS_DESCR COM_AXIS gangllr dez 8 0.00 255.0 AXIS_PTS_REF SGA08LLUB /end AXIS_DESCR
/end CHARACTERISTIC
/begin CHARACTERISTIC NLLMGFS "Solldrehzahl bei eingel. Fahrstufe für Automatikfahrzeuge" MAP 0x819ECE GkfWUb 2550. nmot_ub_q10 0.00 2550. FORMAT "%5.0"
 /begin AXIS_DESCR COM_AXIS tmot temp_ub_q0p75_o48 6 -48.00 143.3 AXIS_PTS_REF STM06LLUB /end AXIS_DESCR
 /begin AXIS_DESCR COM_AXIS gangllr dez 8 0.00 255.0 AXIS_PTS_REF SGA08LLUB /end AXIS_DESCR
/end CHARACTERISTIC
/begin CHARACTERISTIC NLLMIN_0_A "Minimale zulässige Solldrehzahl" VALUE 0x81FBA8 KwUb 2550. nmot_ub_q10 0.00 2550. FORMAT "%5.0" /end CHARACTERISTIC
/begin CHARACTERISTIC NLLMIN_1_A "Minimale zulässige Solldrehzahl" VALUE 0x81FBA9 KwUb 2550. nmot_ub_q10 0.00 2550. FORMAT "%5.0" /end CHARACTERISTIC
/begin CHARACTERISTIC NLLMIN_2_A "Minimale zulässige Solldrehzahl" VALUE 0x81FBAA KwUb 2550. nmot_ub_q10 0.00 2550. FORMAT "%5.0" /end CHARACTERISTIC
/begin CHARACTERISTIC NLLMIN_3_A "Minimale zulässige Solldrehzahl" VALUE 0x81FBAB KwUb 2550. nmot_ub_q10 0.00 2550. FORMAT "%5.0" /end CHARACTERISTIC
/begin CHARACTERISTIC NLRHO "obere Drehzahlgrenze für Regelung hinter Kat" VALUE 0x8120F6 KwUb 10200. nmot_ub_q40 0.00 10200. FORMAT "%5.0" /end CHARACTERISTIC
/begin CHARACTERISTIC NLRHU "untere Drehzahlgrenze für Regelung hinter Kat" VALUE 0x8120F7 KwUb 10200. nmot_ub_q40 0.00 10200. FORMAT "%5.0" /end CHARACTERISTIC
/begin CHARACTERISTIC NLRKA "Drehzahlschwelle für Unterdrücken gesteuertes Kat-Ausräumen" VALUE 0x81211F KwUb 10200. nmot_ub_q40 0.00 10200. FORMAT "%5.0" /end CHARACTERISTIC
/begin CHARACTERISTIC NLRSHB "Drehzahlschwelle, Abschalten LR bei Schub, in Verbindung mit LL und TLLRSHB" VALUE 0x812047 KwUb 10200. nmot_ub_q40 0.00 10200. FORMAT "%5.0" /end CHARACTERISTIC
/begin CHARACTERISTIC NO1 "obere Drehzahlschwelle Bereich 1" VALUE 0x818FA1 KwUb 10200. nmot_ub_q40 0.00 10200. FORMAT "%5.0" /end CHARACTERISTIC
/begin CHARACTERISTIC NO2 "obere Drehzahlschwelle Bereich 2" VALUE 0x818FA2 KwUb 10200. nmot_ub_q40 0.00 10200. FORMAT "%5.0" /end CHARACTERISTIC
/begin CHARACTERISTIC NOLRA "Codewort für Adaptionsfreigabe" VALUE 0x818FA3 KwUb 255.0 dez 0.00 255.0 FORMAT "%5.1" /end CHARACTERISTIC
/begin CHARACTERISTIC NRKAB "Mindestdrehzahl für Begrenzung Stelleingriff rkat bei niedrigen Drehzahlen" VALUE 0x8110A7 KwUb 10200. nmot_ub_q40 0.00 10200. FORMAT "%5.0" /end CHARACTERISTIC
/begin CHARACTERISTIC NSAC_0_A "Solldrehzahl bei Klimaanlage ein (S_AC = 1)" VALUE 0x81FBAC KwUb 2550. nmot_ub_q10 0.00 2550. FORMAT "%5.0" /end CHARACTERISTIC
/begin CHARACTERISTIC NSAC_1_A "Solldrehzahl bei Klimaanlage ein (S_AC = 1)" VALUE 0x81FBAD KwUb 2550. nmot_ub_q10 0.00 2550. FORMAT "%5.0" /end CHARACTERISTIC
/begin CHARACTERISTIC NSACFS_0_A "Solldrehzahl bei Klimaanlage ein (S_AC = 1) und eingelegter Fahrstufe (S_fs=1)" VALUE 0x81FBAE KwUb 2550. nmot_ub_q10 0.00 2550. FORMAT "%5.0" /end CHARACTERISTIC
/begin CHARACTERISTIC NSACFS_1_A "Solldrehzahl bei Klimaanlage ein (S_AC = 1) und eingelegter Fahrstufe (S_fs=1)" VALUE 0x81FBAF KwUb 2550. nmot_ub_q10 0.00 2550. FORMAT "%5.0" /end CHARACTERISTIC
/begin CHARACTERISTIC NSHLL "Mindestsolldrehzahl bei Heiß-Leerlauf" VALUE 0x819EFE KwUb 2550. nmot_ub_q10 0.00 2550. FORMAT "%5.0" /end CHARACTERISTIC
/begin CHARACTERISTIC NSKO_0_A "Solldrehzahl für Klimaanlage" VALUE 0x81FBB0 KwUb 2550. nmot_ub_q10 0.00 2550. FORMAT "%5.0" /end CHARACTERISTIC
/begin CHARACTERISTIC NSKO_1_A "Solldrehzahl für Klimaanlage" VALUE 0x81FBB1 KwUb 2550. nmot_ub_q10 0.00 2550. FORMAT "%5.0" /end CHARACTERISTIC
/begin CHARACTERISTIC NSKO_2_A "Solldrehzahl für Klimaanlage" VALUE 0x81FBB2 KwUb 2550. nmot_ub_q10 0.00 2550. FORMAT "%5.0" /end CHARACTERISTIC
/begin CHARACTERISTIC NSKO_3_A "Solldrehzahl für Klimaanlage" VALUE 0x81FBB3 KwUb 2550. nmot_ub_q10 0.00 2550. FORMAT "%5.0" /end CHARACTERISTIC
/begin CHARACTERISTIC NSKS "Solldrehzahl für Kochschutz" VALUE 0x819EFF KwUb 2550. nmot_ub_q10 0.00 2550. FORMAT "%5.0" /end CHARACTERISTIC
/begin CHARACTERISTIC NSL "Solldrehzahl bei Servolenkung aktiv" VALUE 0x819F00 KwUb 2550. nmot_ub_q10 0.00 2550. FORMAT "%5.0" /end CHARACTERISTIC
/begin CHARACTERISTIC NSLBZFS "Solldrehzahl bei entladener Batterie bei B_fs=1" VALUE 0x819F01 KwUb 2550. nmot_ub_q10 0.00 2550. FORMAT "%5.0" /end CHARACTERISTIC
/begin CHARACTERISTIC NSLBZLL "Solldrehzahl bei entladener Batterie" VALUE 0x819F02 KwUb 2550. nmot_ub_q10 0.00 2550. FORMAT "%5.0" /end CHARACTERISTIC
/begin CHARACTERISTIC NSLBZS "Drehzahlschwelle zur Umschaltung der Solldrehzahl durch lbz" VALUE 0x819F03 KwUb 10200. nmot_ub_q40 0.00 10200. FORMAT "%5.0" /end CHARACTERISTIC
/begin CHARACTERISTIC NSLFAA "Leerlaufdrehzahl bei Bandendetest (bei allgemeiner Anforderung)" VALUE 0x81A086 KwUb 2550. nmot_ub_q10 0.00 2550. FORMAT "%5.0" /end CHARACTERISTIC
/begin CHARACTERISTIC NSLFAEZLA "Solldrehzahl bei Kurztrip Einzelzylinder-Lambda-Regelung" VALUE 0x81A087 KwUb 2550. nmot_ub_q10 0.00 2550. FORMAT "%5.0" /end CHARACTERISTIC
/begin CHARACTERISTIC NSLFAKAT "Solldrehzahl bei Kurztrip Katdiagnose" VALUE 0x81A088 KwUb 2550. nmot_ub_q10 0.00 2550. FORMAT "%5.0" /end CHARACTERISTIC
/begin CHARACTERISTIC NSLFAKRS "Solldrehzahl bei Kurztrip Klopfsensor" VALUE 0x81A089 KwUb 2550. nmot_ub_q10 0.00 2550. FORMAT "%5.0" /end CHARACTERISTIC
/begin CHARACTERISTIC NSLFALDP "Solldrehzahl bei Kurztrip Tankleckdiagnose" VALUE 0x81A08A KwUb 2550. nmot_ub_q10 0.00 2550. FORMAT "%5.0" /end CHARACTERISTIC
/begin CHARACTERISTIC NSLFALSV "Solldrehzahl bei Kurztrip Lambdasonde vor Kat" VALUE 0x81A08B KwUb 2550. nmot_ub_q10 0.00 2550. FORMAT "%5.0" /end CHARACTERISTIC
/begin CHARACTERISTIC NSLFASH "Solldrehzahl bei Kurztrip Schwingungsprüfung" VALUE 0x81A08C KwUb 2550. nmot_ub_q10 0.00 2550. FORMAT "%5.0" /end CHARACTERISTIC
/begin CHARACTERISTIC NSLFASHV "Solldrehzahl bei Kurztrip Sodenvertauscherkennung" VALUE 0x81A08D KwUb 2550. nmot_ub_q10 0.00 2550. FORMAT "%5.0" /end CHARACTERISTIC
/begin CHARACTERISTIC NSLFASKNO "Drehzahlanforderung für Kurztrip: Diagnose Speicherkat" VALUE 0x81A08E KwUb 2550. nmot_ub_q10 0.00 2550. FORMAT "%5.0" /end CHARACTERISTIC
/begin CHARACTERISTIC NSLFASLS "Solldrehzahl bei Kurztrip Sekundärluft" VALUE 0x81A08F KwUb 2550. nmot_ub_q10 0.00 2550. FORMAT "%5.0" /end CHARACTERISTIC
/begin CHARACTERISTIC NSLFATES "Solldrehzahl bei Kurztrip Tankentlüftung" VALUE 0x81A090 KwUb 2550. nmot_ub_q10 0.00 2550. FORMAT "%5.0" /end CHARACTERISTIC
/begin CHARACTERISTIC NSLFAWSA "Leerlaufdrehzahl bei Kurztrip Auslaß-NW" VALUE 0x81A091 KwUb 2550. nmot_ub_q10 0.00 2550. FORMAT "%5.0" /end CHARACTERISTIC
/begin CHARACTERISTIC NSLFAWSE "Leerlaufdrehzahl bei Kurztrip Einlaß-NW" VALUE 0x81A092 KwUb 2550. nmot_ub_q10 0.00 2550. FORMAT "%5.0" /end CHARACTERISTIC
/begin CHARACTERISTIC NSLKVS "Solldrehzahl bei Kurztrip Diagnose Kraftstoffversorgung" VALUE 0x81A093 KwUb 2550. nmot_ub_q10 0.00 2550. FORMAT "%5.0" /end CHARACTERISTIC
/begin CHARACTERISTIC NSLLSH "Solldrehzahl bei Kurztrip Lambdasonde hinter Kat" VALUE 0x81A094 KwUb 2550. nmot_ub_q10 0.00 2550. FORMAT "%5.0" /end CHARACTERISTIC
/begin CHARACTERISTIC NSLPP "Solldrehzahl abhängig vom Pumpendruck der Servolenkung" CURVE 0x819F04 KlAUbSstUbWUb 2550. nmot_ub_q10 0.00 2550. FORMAT "%5.0"
 /begin AXIS_DESCR STD_AXIS psl dez 4 0.00 255.0 FORMAT "%5.1" DEPOSIT ABSOLUTE /end AXIS_DESCR
/end CHARACTERISTIC
/begin CHARACTERISTIC NSLPPFS "Solldrehzahl abhängig vom Pumpendruck der Servolenkung bei B_fs = 1" CURVE 0x819F0D KlAUbSstUbWUb 2550. nmot_ub_q10 0.00 2550. FORMAT "%5.0"
 /begin AXIS_DESCR STD_AXIS psl dez 4 0.00 255.0 FORMAT "%5.1" DEPOSIT ABSOLUTE /end AXIS_DESCR
/end CHARACTERISTIC
/begin CHARACTERISTIC NSLPWG "Solldrehzahl bei Ausfall PWG-Signale" VALUE 0x819F16 KwUb 2550. nmot_ub_q10 0.00 2550. FORMAT "%5.0" /end CHARACTERISTIC
/begin CHARACTERISTIC NSNLDG "Soll-Drehzahlerhöhung bei Drehzahlgeber-Notlauf" VALUE 0x819F17 KwUb 2550. nmot_ub_q10 0.00 2550. FORMAT "%5.0" /end CHARACTERISTIC
/begin CHARACTERISTIC NSNOT "Solldrehzahlanhebung bei Drosselklappenfehler" VALUE 0x819F18 KwUb 2550. nmot_ub_q10 0.00 2550. FORMAT "%5.0" /end CHARACTERISTIC
/begin CHARACTERISTIC NSNWLL "Solldrehzahlanhebung bei Nockenwellenfehler (B_fs = false)" VALUE 0x819F19 KwUb 2550. nmot_ub_q10 0.00 2550. FORMAT "%5.0" /end CHARACTERISTIC
/begin CHARACTERISTIC NSOLMX "Maximalbegrenzung der Solldrehzahl" VALUE 0x819F1A KwUb 2550. nmot_ub_q10 0.00 2550. FORMAT "%5.0" /end CHARACTERISTIC
/begin CHARACTERISTIC NSTOEL "Leerlaufsolldrehzahl: Erhöhung bei Heißleerlauf" CURVE 0x81FB80 KlAUbSstUwWUb 2550. nmot_ub_q10 0.00 2550. FORMAT "%5.0"
 /begin AXIS_DESCR STD_AXIS toelk_w temp_q0p0234_o273 8 -273.1500 1262.827 FORMAT "%8.3" DEPOSIT ABSOLUTE /end AXIS_DESCR
/end CHARACTERISTIC
/begin CHARACTERISTIC NU2 "untere Drehzahlschwelle Bereich 2" VALUE 0x818FA4 KwUb 10200. nmot_ub_q40 0.00 10200. FORMAT "%5.0" /end CHARACTERISTIC
/begin CHARACTERISTIC NU3 "untere Drehzahlschwelle Bereich 3" VALUE 0x818FA5 KwUb 10200. nmot_ub_q40 0.00 10200. FORMAT "%5.0" /end CHARACTERISTIC
/begin CHARACTERISTIC NZHDTL "Drehzahlschwelle für Zeitzähler Heiß-Leerlauf dekrementieren abh. von TL" CURVE 0x819F1B KlAUbSstUbWUb 10200. nmot_ub_q40 0.00 10200. FORMAT "%5.0"
 /begin AXIS_DESCR STD_AXIS rl rel_ub_q0p75 6 0.00 191.3 FORMAT "%5.1" DEPOSIT ABSOLUTE /end AXIS_DESCR
/end CHARACTERISTIC
/begin CHARACTERISTIC NZHITL "Drehzahlschwelle für Zeitzähler Heiß-Leerlauf inkrementieren abh. von TL" CURVE 0x819F28 KlAUbSstUbWUb 10200. nmot_ub_q40 0.00 10200. FORMAT "%5.0"
 /begin AXIS_DESCR STD_AXIS rl rel_ub_q0p75 6 0.00 191.3 FORMAT "%5.1" DEPOSIT ABSOLUTE /end AXIS_DESCR
/end CHARACTERISTIC
/begin CHARACTERISTIC PLRHAV "Wichtungsfaktor des P-Anteils in der LRHK über KAT-Alterung" CURVE 0x8120F8 KlAUbSstUbWUb 0.9961 fak_ub_b1 0.00 0.9961 /begin AXIS_DESCR STD_AXIS avkatf fak_ub_b1 8 0.00 0.9961 DEPOSIT ABSOLUTE /end AXIS_DESCR /end CHARACTERISTIC
/begin CHARACTERISTIC PVDNHOM "P-Reglerparameter bei Homogenbetrieb" CURVE 0x811659 GklWUb 0.3891 fak_q0p00153 0.00 0.3891
 /begin AXIS_DESCR COM_AXIS dn_w nmot_sw_q0p25 10 -8192.000 8191.750 AXIS_PTS_REF SDN10LLSW /end AXIS_DESCR
/end CHARACTERISTIC
/begin CHARACTERISTIC PVDNHOMV "P-Reglerparamter bei Homogenbetrieb und Kraftschluß" CURVE 0x811663 GklWUb 0.3891 fak_q0p00153 0.00 0.3891
 /begin AXIS_DESCR COM_AXIS dn_w nmot_sw_q0p25 10 -8192.000 8191.750 AXIS_PTS_REF SDN10LLSW /end AXIS_DESCR
/end CHARACTERISTIC
/begin CHARACTERISTIC PVDNKH "Kennlinie P-Verstärkung bei Thermoreaktor" CURVE 0x8161A0 KlAUbSstSbWUb 0.3891 fak_q0p00153 0.00 0.3891
 /begin AXIS_DESCR STD_AXIS dns nmotd_sb_q10 10 -1280. 1270. FORMAT "%5.0" DEPOSIT ABSOLUTE /end AXIS_DESCR
/end CHARACTERISTIC
/begin CHARACTERISTIC PVDNST "Kennlinie P-Verstärkung bei Start" CURVE 0x81166D GklWUb 0.3891 fak_q0p00153 0.00 0.3891
 /begin AXIS_DESCR COM_AXIS dn_w nmot_sw_q0p25 10 -8192.000 8191.750 AXIS_PTS_REF SDN10LLSW /end AXIS_DESCR
/end CHARACTERISTIC
/begin CHARACTERISTIC PVLDNEZ "LLR: P-Verstärkung bei stehendem Fahrzeug (Luftanteil)" MAP 0x811677 GkfWUb 0.3891 fak_q0p00153 0.00 0.3891
 /begin AXIS_DESCR COM_AXIS dn_w nmot_sw_q0p25 10 -8192.000 8191.750 AXIS_PTS_REF SDN10LLSW /end AXIS_DESCR
 /begin AXIS_DESCR COM_AXIS etazws rel_ub_b127p5 4 0.00 127.5 AXIS_PTS_REF SEZ04LLUB /end AXIS_DESCR
/end CHARACTERISTIC
/begin CHARACTERISTIC PVLDNEZKH "P-Anteil der LLR auf dem Luftpfad bei Katheizen" MAP 0x81169F GkfWUb 0.3891 fak_q0p00153 0.00 0.3891
 /begin AXIS_DESCR COM_AXIS dn_w nmot_sw_q0p25 10 -8192.000 8191.750 AXIS_PTS_REF SDN10LLSW /end AXIS_DESCR
 /begin AXIS_DESCR COM_AXIS etazws rel_ub_b127p5 4 0.00 127.5 AXIS_PTS_REF SEZ04LLUB /end AXIS_DESCR
/end CHARACTERISTIC
/begin CHARACTERISTIC PVLDNEZV "LLR: P-Verstärkung bei rollendem Fahrzeug (Luftanteil)" MAP 0x8116C7 GkfWUb 0.3891 fak_q0p00153 0.00 0.3891
 /begin AXIS_DESCR COM_AXIS dn_w nmot_sw_q0p25 10 -8192.000 8191.750 AXIS_PTS_REF SDN10LLSW /end AXIS_DESCR
 /begin AXIS_DESCR COM_AXIS etazws rel_ub_b127p5 4 0.00 127.5 AXIS_PTS_REF SEZ04LLUB /end AXIS_DESCR
/end CHARACTERISTIC
/begin CHARACTERISTIC REDHYOC "Hysterese der Reduzierstufe bei größerer Soll-Reduzierstufe als Ist-Wert" VALUE 0x811AB3 KwSb 5.100 rel_sb_q0p02 -2.560 2.540 FORMAT "%5.3" /end CHARACTERISTIC
/begin CHARACTERISTIC REDHYUC "Hysterese der Reduzierstufe bei kleinerer Soll-Reduzierstufe als Ist-Wert" VALUE 0x811AB4 KwSb 5.100 rel_sb_q0p02 -2.560 2.540 FORMAT "%5.3" /end CHARACTERISTIC
/begin CHARACTERISTIC REDMXSA "maximale Reduzierstufe bei sequentieller Schubabschaltung" VALUE 0x811AB5 KwUb 255.0 dez 0.00 255.0 FORMAT "%5.1" /end CHARACTERISTIC
/begin CHARACTERISTIC REDZEM "Schwelle zwischen Zündeingriff und Einspritzausblendung" CURVE 0x81A1B9 KlAUbSstUbWUb 255.0 dez 0.00 255.0 FORMAT "%5.1"
 /begin AXIS_DESCR STD_AXIS tmot temp_ub_q0p75_o48 5 -48.00 143.3 FORMAT "%5.1" DEPOSIT ABSOLUTE /end AXIS_DESCR
/end CHARACTERISTIC
/begin CHARACTERISTIC RKATMN "untere Schwelle additive Korrektur pro Zeit" VALUE 0x81DA30 KwSw 383.9941 rel_sw_b192 -192.0000 191.9941 FORMAT "%8.4" /end CHARACTERISTIC
/begin CHARACTERISTIC RKATMX "obere Schwelle additive Korrektur pro Zeit" VALUE 0x81DA32 KwSw 383.9941 rel_sw_b192 -192.0000 191.9941 FORMAT "%8.4" /end CHARACTERISTIC
/begin CHARACTERISTIC RKATRN "reduzierte untere Schwelle additive Korrektur pro Zeit" VALUE 0x81DA34 KwSw 383.9941 rel_sw_b192 -192.0000 191.9941 FORMAT "%8.4" /end CHARACTERISTIC
/begin CHARACTERISTIC RKATRX "reduzierte obere Schwelle additive Korrektur pro Zeit" VALUE 0x81DA36 KwSw 383.9941 rel_sw_b192 -192.0000 191.9941 FORMAT "%8.4" /end CHARACTERISTIC
/begin CHARACTERISTIC RKAZMN "untere Schwelle additive Korrektur pro Zündung" VALUE 0x81DA38 KwSw 383.9941 rel_sw_b192 -192.0000 191.9941 FORMAT "%8.4" /end CHARACTERISTIC
/begin CHARACTERISTIC RKAZMX "obere Schwelle additive Korrektur pro Zündung" VALUE 0x81DA3A KwSw 383.9941 rel_sw_b192 -192.0000 191.9941 FORMAT "%8.4" /end CHARACTERISTIC
/begin CHARACTERISTIC RKAZRN "reduzierte untere Schwelle additive Korrektur pro Zündung" VALUE 0x81DA3C KwSw 383.9941 rel_sw_b192 -192.0000 191.9941 FORMAT "%8.4" /end CHARACTERISTIC
/begin CHARACTERISTIC RKAZRX "reduzierte obere Schwelle additive Korrektur pro Zündung" VALUE 0x81DA3E KwSw 383.9941 rel_sw_b192 -192.0000 191.9941 FORMAT "%8.4" /end CHARACTERISTIC
/begin CHARACTERISTIC RLLRHON "Kennlinie über nmot, obere rL Regelgrenze für Regler hinter KAT" CURVE 0x812109 GklWUb 191.3 rel_ub_q0p75 0.00 191.3 FORMAT "%5.1"
 /begin AXIS_DESCR COM_AXIS nmot nmot_ub_q40 8 0.00 10200. AXIS_PTS_REF SNM08LHUB /end AXIS_DESCR
/end CHARACTERISTIC
/begin CHARACTERISTIC RLLRHUFA "rL Regelgrenze für Regler hinter KAT bei Funktionsanforderung B_fakat" VALUE 0x812111 KwUb 191.3 rel_ub_q0p75 0.00 191.3 FORMAT "%5.1" /end CHARACTERISTIC
/begin CHARACTERISTIC RLLRHUN "Kennlinie über nmot, untere rL Regelgrenze für Regler hinter KAT" CURVE 0x812112 GklWUb 191.3 rel_ub_q0p75 0.00 191.3 FORMAT "%5.1"
 /begin AXIS_DESCR COM_AXIS nmot nmot_ub_q40 8 0.00 10200. AXIS_PTS_REF SNM08LHUB /end AXIS_DESCR
/end CHARACTERISTIC
/begin CHARACTERISTIC RLLRSHB "relative Lastschwelle, Abschalten LR bei SLS, in Verbindung mit LL und NLRSHB" VALUE 0x812048 KwUb 191.3 rel_ub_q0p75 0.00 191.3 FORMAT "%5.1" /end CHARACTERISTIC
/begin CHARACTERISTIC RLLRUN "Kennlinie über nmot, untere rL Regelgrenze für Regler vor KAT" CURVE 0x812049 KlAUbSstUbWUb 191.3 rel_ub_q0p75 0.00 191.3 FORMAT "%5.1"
 /begin AXIS_DESCR STD_AXIS nmot nmot_ub_q40 8 0.00 10200. FORMAT "%5.0" DEPOSIT ABSOLUTE /end AXIS_DESCR
/end CHARACTERISTIC
/begin CHARACTERISTIC RLO2 "obere Lastschwelle Bereich 2" VALUE 0x818FA6 KwUb 191.3 rel_ub_q0p75 0.00 191.3 FORMAT "%5.1" /end CHARACTERISTIC
/begin CHARACTERISTIC RLO3 "obere rl - Schwelle Bereich 3" VALUE 0x818FA7 KwUb 191.3 rel_ub_q0p75 0.00 191.3 FORMAT "%5.1" /end CHARACTERISTIC
/begin CHARACTERISTIC RLO3AC "obere rl - Schwelle Bereich 3 mit kompressor" VALUE 0x818FA8 KwUb 191.3 rel_ub_q0p75 0.00 191.3 FORMAT "%5.1" /end CHARACTERISTIC
/begin CHARACTERISTIC RLSLSMN "min. rl für Freigabe Regelung während Sekundärluft" CURVE 0x81205A KlAUbSstUbWUb 191.3 rel_ub_q0p75 0.00 191.3 FORMAT "%5.1"
 /begin AXIS_DESCR STD_AXIS nmot nmot_ub_q40 4 0.00 10200. FORMAT "%5.0" DEPOSIT ABSOLUTE /end AXIS_DESCR
/end CHARACTERISTIC
/begin CHARACTERISTIC RLSOLAP "Sollfüllung für Applikationszwecke" VALUE 0x815798 KwUw 1535.977 rel_uw_q0p0234 0.00 1535.977 FORMAT "%8.3" /end CHARACTERISTIC
/begin CHARACTERISTIC RLU2 "untere rl - Schwelle Bereich 2" VALUE 0x818FA9 KwUb 191.3 rel_ub_q0p75 0.00 191.3 FORMAT "%5.1" /end CHARACTERISTIC
/begin CHARACTERISTIC RLU2AC "untere rl - Schwelle Bereich 2 mit Kompressor" VALUE 0x818FAA KwUb 191.3 rel_ub_q0p75 0.00 191.3 FORMAT "%5.1" /end CHARACTERISTIC
/begin CHARACTERISTIC RLU3 "untere rl - Schwelle Bereich 3" VALUE 0x818FAB KwUb 191.3 rel_ub_q0p75 0.00 191.3 FORMAT "%5.1" /end CHARACTERISTIC
/begin CHARACTERISTIC RLU4 "untere rl -Schwelle oberer multiplikativer Bereich" VALUE 0x818FAC KwUb 191.3 rel_ub_q0p75 0.00 191.3 FORMAT "%5.1" /end CHARACTERISTIC
/begin CHARACTERISTIC RLU4AC "untere rl -Schwelle oberer multiplikativer Bereich mit Kompressor" VALUE 0x818FAD KwUb 191.3 rel_ub_q0p75 0.00 191.3 FORMAT "%5.1" /end CHARACTERISTIC
/begin AXIS_PTS SDN10LLSW "Stützstellenverteilung Addressierung Leerlaufregelparameter" 0x8161B6 dn_w SstASwSstSw 16383.75 nmot_sw_q0p25 10 -8192.000 8191.750 FORMAT "%8.3" DEPOSIT ABSOLUTE /end AXIS_PTS
/begin AXIS_PTS SEZ04LLUB "Stützstellenverteilung Zündwinkelwirkungsgrad für PD-Regler" 0x8116EF etazws SstAUbSstUb 127.5 rel_ub_b127p5 4 0.00 127.5 FORMAT "%5.1" DEPOSIT ABSOLUTE /end AXIS_PTS
/begin AXIS_PTS SGA08LLUB "Stützstellenverteilung für Ganginformation in Leerlaufregelung" 0x819F35 gangllr SstAUbSstUb 255.0 dez 8 0.00 255.0 FORMAT "%5.1" DEPOSIT ABSOLUTE /end AXIS_PTS
/begin AXIS_PTS SGA08MDUB "Stützstellenverteilung Ist Gang 8 Sst." 0x81005F gangi SstAUbSstUb 255.0 dez 8 0.00 255.0 FORMAT "%5.1" DEPOSIT ABSOLUTE /end AXIS_PTS
/begin AXIS_PTS SM108LHSW "dlashk_w abhängige Stützstellen (Anzahl 8)" 0x81AE90 dlashkm_w SstASwSstSw 1.999969 fak_sw_b1 8 -1.000000 0.9999695 FORMAT "%8.6" DEPOSIT ABSOLUTE /end AXIS_PTS
/begin AXIS_PTS SMI04LLUB "Stützstellenverteilung: ind. Moment für Momentenreserve" 0x81341A mifa_w SstAUwSstUw 99.99847 rel_uw_b100 4 0.00 99.99847 FORMAT "%8.5" DEPOSIT ABSOLUTE /end AXIS_PTS
/begin AXIS_PTS SML08LHUB "ml abhängige Stützstellen (Anzahl 8)" 0x8181E5 ml SstAUbSstUb 1020. m_ub_b1020 8 0.00 1020. FORMAT "%5.0" DEPOSIT ABSOLUTE /end AXIS_PTS
/begin AXIS_PTS SNG06LLSB "Stützstellenverteilung Drehzahlgradient, 6 Sst." 0x810074 ngfil SstAUbSstSb 25500. nmotg_sb_q100 6 -12800. 12700. FORMAT "%5.0" DEPOSIT ABSOLUTE /end AXIS_PTS
/begin AXIS_PTS SNM06LLUB "Sützstellenverteilung für Motordrehzahl" 0x813430 nmot_w SstAUwSstUw 16383.75 nmot_uw_q0p25 6 0.00 16383.75 FORMAT "%8.2" DEPOSIT ABSOLUTE /end AXIS_PTS
/begin AXIS_PTS SNM06MDUW "Stützstellenverteilung Motordrehzahl (nmot_w), 6 Stützstellen" 0x81AECE nmot_w SstAUwSstUw 16383.75 nmot_uw_q0p25 6 0.00 16383.75 FORMAT "%8.2" DEPOSIT ABSOLUTE /end AXIS_PTS
/begin AXIS_PTS SNM07LSUW "Stützstellenverteilung Reglerparameter LRS" 0x81343E nmot_w SstAUwSstUw 16383.75 nmot_uw_q0p25 7 0.00 16383.75 FORMAT "%8.2" DEPOSIT ABSOLUTE /end AXIS_PTS
/begin AXIS_PTS SNM08LHUB "nmot abhängige Stützstellen (Anzahl 8)" 0x818213 nmot SstAUbSstUb 10200. nmot_ub_q40 8 0.00 10200. FORMAT "%5.0" DEPOSIT ABSOLUTE /end AXIS_PTS
/begin AXIS_PTS SNM10LSUB "Stützstellenverteilung Kat-Vorsteuerwert LRS" 0x810096 nmot SstAUbSstUb 10200. nmot_ub_q40 10 0.00 10200. FORMAT "%5.0" DEPOSIT ABSOLUTE /end AXIS_PTS
/begin AXIS_PTS SNM12FEUB "Stützstellen für WDKSMX, WDKUGDN" 0x8100AE nmot SstAUbSstUb 10200. nmot_ub_q40 12 0.00 10200. FORMAT "%5.0" DEPOSIT ABSOLUTE /end AXIS_PTS
/begin AXIS_PTS SNM12MDUW "Stützstellenverteilung nmot_w" 0x816958 nmot_w SstAUwSstUw 16383.75 nmot_uw_q0p25 12 0.00 16383.75 FORMAT "%8.2" DEPOSIT ABSOLUTE /end AXIS_PTS
/begin AXIS_PTS SNM16OPUW "Stützstellenverteilung Drehzahl" 0x8134BE nmot_w SstAUwSstUw 16383.75 nmot_uw_q0p25 16 0.00 16383.75 FORMAT "%8.2" DEPOSIT ABSOLUTE /end AXIS_PTS
/begin AXIS_PTS SNS06LLSB "Stützstellenvert., Solldrehzahlabw., 06 Sst., LL-Regel." 0x819F3E dns SstAUbSstSb 2550. nmotd_sb_q10 6 -1280. 1270. FORMAT "%5.0" DEPOSIT ABSOLUTE /end AXIS_PTS
/begin AXIS_PTS SNS206LLSB "Stützstellenvert., Solldrehzahlabw., 06 Sst., LL-Regel." 0x8116F4 dns SstAUbSstSb 2550. nmotd_sb_q10 6 -1280. 1270. FORMAT "%5.0" DEPOSIT ABSOLUTE /end AXIS_PTS
/begin CHARACTERISTIC SRKTEVS "Saugrohrkonstante bei Schließen des Tankentlüftungsventil" VALUE 0x8116FB KwUb 5.080 t20msxs_ub_b5p1 0.02000 5.100 FORMAT "%5.3" /end CHARACTERISTIC
/begin AXIS_PTS SRL08LSUW "Stützstellenverteilung Reglerparameter" 0x81350E rl_w SstAUwSstUw 1535.977 rel_uw_q0p0234 8 0.00 1535.977 FORMAT "%8.3" DEPOSIT ABSOLUTE /end AXIS_PTS
/begin AXIS_PTS SRL10LSUB "Stützstellenverteilung Kat-Vorsteuerwert LRS" 0x8100EB rl SstAUbSstUb 191.3 rel_ub_q0p75 10 0.00 191.3 FORMAT "%5.1" DEPOSIT ABSOLUTE /end AXIS_PTS
/begin AXIS_PTS SRL11OPUW "Stützstellenverteilung relative Luftfüllung" 0x816D30 rl_w SstAUwSstUw 1535.977 rel_uw_q0p0234 11 0.00 1535.977 FORMAT "%8.3" DEPOSIT ABSOLUTE /end AXIS_PTS
/begin AXIS_PTS STA04LLUB "Stützstellenverteilung: tans für Momentenreserve" 0x81354C tans SstAUwSstUw 49151.25 temp_ub_q0p75_o48 4 -48.00000 49103.25 FORMAT "%8.2" DEPOSIT ABSOLUTE /end AXIS_PTS
/begin AXIS_PTS STM04FEUB "Stützstellenverteilung Motortemperatur" 0x810113 tmot SstAUbSstUb 191.3 temp_ub_q0p75_o48 4 -48.00 143.3 FORMAT "%5.1" DEPOSIT ABSOLUTE /end AXIS_PTS
/begin AXIS_PTS STM04SAUB "Stützstellenverteilung Motortemperatur, 4 Sst." 0x810118 tmot SstAUbSstUb 191.3 temp_ub_q0p75_o48 4 -48.00 143.3 FORMAT "%5.1" DEPOSIT ABSOLUTE /end AXIS_PTS
/begin AXIS_PTS STM06LLUB "Stützstellenverteilung Motortemperatur, 6 Sst." 0x8182AB tmot SstAUbSstUb 191.3 temp_ub_q0p75_o48 6 -48.00 143.3 FORMAT "%5.1" DEPOSIT ABSOLUTE /end AXIS_PTS
/begin AXIS_PTS STN06LLUB "Stützstellenverteilung: Zeit nach Start; für Drehzahlverlauf nach Start" 0x8182D7 tnst SstAUbSstUb 255.0 t1sxs_ub_b255 6 0.00 255.0 FORMAT "%5.1" DEPOSIT ABSOLUTE /end AXIS_PTS
/begin AXIS_PTS SWP16MDUW "Stützstellenverteilung wped_w" 0x816972 wped_w SstAUwSstUw 100.0000 relPED_uw_b100 16 0.00 100.0000 FORMAT "%8.4" DEPOSIT ABSOLUTE /end AXIS_PTS
/begin CHARACTERISTIC TAHLL "Ansauglufttemperaturschwelle für erhöhte Solldrehzahl im Heiß-Leerlauf" VALUE 0x819F45 KwUb 191.3 temp_ub_q0p75_o48 -48.00 143.3 FORMAT "%5.1" /end CHARACTERISTIC
/begin CHARACTERISTIC TARA "Temperaturschwelle Ansaugluft" VALUE 0x81152C KwUb 191.3 temp_ub_q0p75_o48 -48.00 143.3 FORMAT "%5.1" /end CHARACTERISTIC
/begin CHARACTERISTIC TARAU "Ansauglufttemperaturschwelle für Einschalten der Lambda - Regelung" VALUE 0x812063 KwUb 191.3 temp_ub_q0p75_o48 -48.00 143.3 FORMAT "%5.1" /end CHARACTERISTIC
/begin CHARACTERISTIC TASHS "Schwelle Ansauglufttemp. für Auslösung TLRHS - Sperrzeit LR bei Heißstart" VALUE 0x812064 KwUb 191.3 temp_ub_q0p75_o48 -48.00 143.3 FORMAT "%5.1" /end CHARACTERISTIC
/begin CHARACTERISTIC TAUIDEC "Zeitkonstante Absteuern Integralanteil bei Grenzwertregelung LRS" VALUE 0x81738C KwUw 655.34999985 zk10msxs_uw_b655 0.010000152590 655.36000000 FORMAT "%12.8" /end CHARACTERISTIC
/begin CHARACTERISTIC TBLRH "Sperrzeit für Regelung hinter Kat nach Freigabe durch Regelung vor Kat" VALUE 0x81211A KwUb 25.50 t100msxs_ub_b25p5 0.00 25.50 FORMAT "%5.2" /end CHARACTERISTIC
/begin CHARACTERISTIC TDMFBSA "Zeitkonstante PT1-Filter beim Schubabschalten" VALUE 0x816994 KwUw 655.34999985 zk10msxs_uw_b655 0.010000152590 655.36000000 FORMAT "%12.8" /end CHARACTERISTIC
/begin CHARACTERISTIC TDMFBWE "Zeitkonstante PT1-Filter beim weichen Wiedereinsetzen" VALUE 0x816996 KwUw 655.34999985 zk10msxs_uw_b655 0.010000152590 655.36000000 FORMAT "%12.8" /end CHARACTERISTIC
/begin CHARACTERISTIC TDMFNSG "Filterzeitkonstante bei Solldrehzahlanhebung CVT" VALUE 0x816998 KwUw 655.34999985 zk10msxs_uw_b655 0.010000152590 655.36000000 FORMAT "%12.8" /end CHARACTERISTIC
/begin CHARACTERISTIC TDMFWEMI "Filterzeitkonstante beim harten Wiedereinsetzen" CURVE 0x81699A KlAUwSstUwWUw 655.34999908 zk10msxs_uw_b655 0.010000915611 655.36000000 FORMAT "%12.8"
 /begin AXIS_DESCR STD_AXIS mivbeb_w rel_uw_b100 8 0.00 99.99847 FORMAT "%8.5" DEPOSIT ABSOLUTE /end AXIS_DESCR
/end CHARACTERISTIC
/begin CHARACTERISTIC TDMLSDS "Zeit nach Kupplungsbetätigung mit veränderter LSD-Auslösung" VALUE 0x8118A5 KwUb 5.100 t20msxs_ub_b5p1 0.00 5.100 FORMAT "%5.3" /end CHARACTERISTIC
/begin CHARACTERISTIC TDMRESLL "Sperrzeit für die erhöhte Momentenreserve nach dem Start" VALUE 0x811805 KwUb 51.00 t200msxs_ub_b51 0.00 51.00 FORMAT "%5.2" /end CHARACTERISTIC
/begin CHARACTERISTIC TGAALTWR "Zeit Zeitkonstante fürs Rücksetzen  der Gemischkorrektur auf letzten Tripwert" VALUE 0x81DA40 KwUw 4.999924 zk200msxs_uw_b5 0.00 4.999924 FORMAT "%8.6" /end CHARACTERISTIC
/begin CHARACTERISTIC THDMB "Heilungs-Entprellzeit des Fehleintrags für dauerhafte Momentbegrenzung" VALUE 0x81A11C KwUb 255.0 t1sxs_ub_b255 0.00 255.0 FORMAT "%5.1" /end CHARACTERISTIC
/begin CHARACTERISTIC TKATMLRH "Einschaltschwelle Kat-Modelltemperatur für Lambdaregelung hinter Kat" VALUE 0x81211B KwUb 1275. temp_ub_q5_o50 -50.00 1225. FORMAT "%5.0" /end CHARACTERISTIC
/begin CHARACTERISTIC TKATSZA "Kat-Temperaturschwelle für Freigabe der Zwangsamplitude" VALUE 0x81738E KwUw 1279.980 temp_uw_q0p0195_o50 -50.00000 1229.980 FORMAT "%8.3" /end CHARACTERISTIC
/begin CHARACTERISTIC TLAKAMN "Mindestdauer Bed. lamsbrs_w oder lamsons_w > 1.0 für Funktion Kat.-Ausräumen" VALUE 0x812120 KwUb 5.100 t20msxs_ub_b5p1 0.00 5.100 FORMAT "%5.3" /end CHARACTERISTIC
/begin CHARACTERISTIC TLRBAM "Sperrzeit für Einschalten LR nach BA" CURVE 0x8173A0 KlAUbSstUbWUw 655.3500 t10msxs_uw_b655p35 0.00 655.3500 FORMAT "%8.4"
 /begin AXIS_DESCR STD_AXIS tmot temp_ub_q0p75_o48 8 -48.00 143.3 FORMAT "%5.1" DEPOSIT ABSOLUTE /end AXIS_DESCR
/end CHARACTERISTIC
/begin CHARACTERISTIC TLRHS "Sperrzeit LR bei Heißstart, ausgelöst über Schwellen TASHS und TMSHS" VALUE 0x81A239 KwUb 25.50 t100msxs_ub_b25p5 0.00 25.50 FORMAT "%5.2" /end CHARACTERISTIC
/begin CHARACTERISTIC TLRSZWSA "Zeitdauer für LRS-Zwangseinschaltung nach Schubabschneiden" VALUE 0x827E9E KwUw 6553.500 t100msxs_uw_b6553p5 0.00 6553.500 FORMAT "%8.3" /end CHARACTERISTIC
/begin CHARACTERISTIC TLRTMS "Sperrzeit LR nach Start, abhängig von der Motortemperatur bei Start" CURVE 0x827EA0 KlAUbSstUbWUw 6553.500 t100msxs_uw_b6553p5 0.00 6553.500 FORMAT "%8.3"
 /begin AXIS_DESCR STD_AXIS tmst temp_ub_q0p75_o48 5 -48.00 143.3 FORMAT "%5.1" DEPOSIT ABSOLUTE /end AXIS_DESCR
/end CHARACTERISTIC
/begin CHARACTERISTIC TLRVAM "Sperrzeit für Einschalten LR nach VA" CURVE 0x8173BA KlAUbSstUbWUw 655.3500 t10msxs_uw_b655p35 0.00 655.3500 FORMAT "%8.4"
 /begin AXIS_DESCR STD_AXIS tmot temp_ub_q0p75_o48 8 -48.00 143.3 FORMAT "%5.1" DEPOSIT ABSOLUTE /end AXIS_DESCR
/end CHARACTERISTIC
/begin CHARACTERISTIC TLRZWTMS "Zeit für Zwangseinschaltung LR (CARB-Forderung) nach Start" CURVE 0x827EB0 KlAUbSstUbWUw 6553.500 t100msxs_uw_b6553p5 0.00 6553.500 FORMAT "%8.3"
 /begin AXIS_DESCR STD_AXIS tmst temp_ub_q0p75_o48 4 -48.00 143.3 FORMAT "%5.1" DEPOSIT ABSOLUTE /end AXIS_DESCR
/end CHARACTERISTIC
/begin CHARACTERISTIC TMEWRAA "Einschalttemperatur LRA bezogen auf die modellierte Motortemperatur" VALUE 0x81924C KwUb 191.3 temp_ub_q0p75_o48 -48.00 143.3 FORMAT "%5.1" /end CHARACTERISTIC
/begin CHARACTERISTIC TMFRATMN "minimale Temperatur bei der ftklra_w = 1 ist" VALUE 0x818FAE KwUb 191.3 temp_ub_q0p75_o48 -48.00 143.3 FORMAT "%5.1" /end CHARACTERISTIC
/begin CHARACTERISTIC TMFRATUB "untere Temperaturschwelle  bei der ftklra_w Konstant bleibt" VALUE 0x818FAF KwUb 191.3 temp_ub_q0p75_o48 -48.00 143.3 FORMAT "%5.1" /end CHARACTERISTIC
/begin CHARACTERISTIC TMHLL "Motortemperaturschwelle für erhöhte Solldrehzahl im Heiß-Leerlauf" VALUE 0x819F46 KwUb 191.3 temp_ub_q0p75_o48 -48.00 143.3 FORMAT "%5.1" /end CHARACTERISTIC
/begin CHARACTERISTIC TMLLAMN "Entprellzeit für Erkennung  Bedingung lamsons_w > 1" VALUE 0x81A24C KwUb 25.50 t100msxs_ub_b25p5 0.00 25.50 FORMAT "%5.2" /end CHARACTERISTIC
/begin CHARACTERISTIC TMLLX "Kochschutzschwelle" VALUE 0x819F47 KwUb 191.3 temp_ub_q0p75_o48 -48.00 143.3 FORMAT "%5.1" /end CHARACTERISTIC
/begin CHARACTERISTIC TMLRZAMN "Minimale Motortemperatur für Zusatzamplitude" VALUE 0x812045 KwUb 191.3 temp_ub_q0p75_o48 -48.00 143.3 FORMAT "%5.1" /end CHARACTERISTIC
/begin CHARACTERISTIC TMMIBGR "tmot-Schwelle für Freigabe Momentenbegrenzung" VALUE 0x81A1DE KwUb 191.3 temp_ub_q0p75_o48 -48.00 143.3 FORMAT "%5.1" /end CHARACTERISTIC
/begin CHARACTERISTIC TMRA1 "Ausschaltbedingung (S_LL = 0)" VALUE 0x812065 KwUb 191.3 temp_ub_q0p75_o48 -48.00 143.3 FORMAT "%5.1" /end CHARACTERISTIC
/begin CHARACTERISTIC TMRA2 "Ausschaltbedingung (S_LL = 1)" VALUE 0x812066 KwUb 191.3 temp_ub_q0p75_o48 -48.00 143.3 FORMAT "%5.1" /end CHARACTERISTIC
/begin CHARACTERISTIC TMRAA "Einschalttemperatur LRA" VALUE 0x81924D KwUb 191.3 temp_ub_q0p75_o48 -48.00 143.3 FORMAT "%5.1" /end CHARACTERISTIC
/begin CHARACTERISTIC TMRAK "Ausschaltschwelle der Lambda - Regelung bei niedriger Starttemperatur" VALUE 0x812067 KwUb 191.3 temp_ub_q0p75_o48 -48.00 143.3 FORMAT "%5.1" /end CHARACTERISTIC
/begin CHARACTERISTIC TMRZHLL "Motortemperaturschwelle für Reset des Zeitzählers für Heiß-Leerlauf" VALUE 0x819F48 KwUb 191.3 temp_ub_q0p75_o48 -48.00 143.3 FORMAT "%5.1" /end CHARACTERISTIC
/begin CHARACTERISTIC TMSHS "Schwelle Motortemp. für Auslösung TLRHS - Sperrzeit LR bei Heißstart" VALUE 0x812068 KwUb 191.3 temp_ub_q0p75_o48 -48.00 143.3 FORMAT "%5.1" /end CHARACTERISTIC
/begin CHARACTERISTIC TMVER "Entprellzeit zur Erkennung einer dauerhaften Momentenbegrenzung" VALUE 0x81FBD6 KwUw 65535.00 t1sxs_uw_b65535 0.00 65535.00 FORMAT "%8.2" /end CHARACTERISTIC
/begin CHARACTERISTIC TNSLFA "Filterzeitkonstante für nslfa" VALUE 0x81A095 KwUb 5.08000 zk20msxs_ub_b5p1 0.0200000 5.10000 FORMAT "%7.5" /end CHARACTERISTIC
/begin CHARACTERISTIC TRAU "Überwachungszeit für untere Lastschwelle der Lambdaregelung" VALUE 0x81A23A KwUb 25.50 t100msxs_ub_b25p5 0.00 25.50 FORMAT "%5.2" /end CHARACTERISTIC
/begin CHARACTERISTIC TSAKAMN "Mindestdauer SA für Funktion Katalysator-Ausräumen" VALUE 0x812121 KwUb 5.100 t20msxs_ub_b5p1 0.00 5.100 FORMAT "%5.3" /end CHARACTERISTIC
/begin CHARACTERISTIC TVFSAWE "Verzögerungszeit für Rücksetzen von B_fil" VALUE 0x8169BC KwUw 655.3500 t10msxs_uw_b655p35 0.00 655.3500 FORMAT "%8.4" /end CHARACTERISTIC
/begin CHARACTERISTIC TVLDSZW "Einschaltdauer Zündwinkelfreigabe bei Nachladeeffekt" VALUE 0x8118AC KwUb 2.550 t10msxs_ub_b2p55 0.00 2.550 FORMAT "%5.3" /end CHARACTERISTIC
/begin CHARACTERISTIC TVLISTU "Verbotszeit für negativen Integratoranteil nach Start" VALUE 0x8116FC KwUb 5.100 t20msxs_ub_b5p1 0.00 5.100 FORMAT "%5.3" /end CHARACTERISTIC
/begin CHARACTERISTIC TVLLNWDIF "Zeitverzögerung bei NW-Differenzerkennung" VALUE 0x819F49 KwUb 5.100 t_q0p02 0.00 5.100 FORMAT "%5.3" /end CHARACTERISTIC
/begin CHARACTERISTIC TVLLRPST "Zeitverzögerung nach Start zum Deaktivieren der P-Verstärkung im Start" VALUE 0x8116FD KwUb 51.00 t200msxs_ub_b51 0.00 51.00 FORMAT "%5.2" /end CHARACTERISTIC
/begin CHARACTERISTIC TVLRA "Verzögerungszeit für Aktivierung Gemischadaption nach Lambdaregelung aktiv" VALUE 0x81924E KwUb 25.40 t100msxs_ub_b25p5 0.1000 25.50 FORMAT "%5.2" /end CHARACTERISTIC
/begin CHARACTERISTIC TVMIBEG "Entprellzeit für Zündwinkelfreigabe bei Momentenbegrenzung" VALUE 0x8118AD KwUb 2.550 t10msxs_ub_b2p55 0.00 2.550 FORMAT "%5.3" /end CHARACTERISTIC
/begin CHARACTERISTIC TVPKH "Zeitverzögerung: P-Verstärkung bei Katheizen aktiv" VALUE 0x8161CC KwUw 13107.00 t200msxs_uw_q0p2 0.00 13107.00 FORMAT "%8.2" /end CHARACTERISTIC
/begin CHARACTERISTIC TVRESLL "Haltezeit für die erhöhte Momentenrerserve nach Drehzahleinbruch" VALUE 0x8161DA KwUw 1310.700 t20msxs_uw_q0p02 0.00 1310.700 FORMAT "%8.3" /end CHARACTERISTIC
/begin CHARACTERISTIC TVRESTM "Initialisierungsdauer: Momentenreserve nach Start" VALUE 0x819FCA KwUb 5.100 t20msxs_ub_b5p1 0.00 5.100 FORMAT "%5.3" /end CHARACTERISTIC
/begin CHARACTERISTIC TVSLR "Dauer LRS-Ausschaltung über Ventilhubsteuerung" CURVE 0x81A23B KlAUbSstUbWUb 2.550 t10msxs_ub_b2p55 0.00 2.550 FORMAT "%5.3"
 /begin AXIS_DESCR STD_AXIS nmot nmot_ub_q40 8 0.00 10200. FORMAT "%5.0" DEPOSIT ABSOLUTE /end AXIS_DESCR
/end CHARACTERISTIC
/begin CHARACTERISTIC USHKAMNW "Sondenspannung hinter Kat für Erkennung Kat ist mit O2 gefüllt (Word)" VALUE 0x817482 KwUw 319.9951 spg_uw_q0p00488_o1 -1.000000 318.9951 FORMAT "%8.4" /end CHARACTERISTIC
/begin CHARACTERISTIC USHKAMXW "Sondenspannung hinter Kat für Abbruch Kat-Ausräumen (Word)" VALUE 0x817484 KwUw 319.9951 spg_uw_q0p00488_o1 -1.000000 318.9951 FORMAT "%8.4" /end CHARACTERISTIC
/begin CHARACTERISTIC USRHKFA "Sondenspannungssollwert für Regelung hinter Kat. bei Funktionsanf. B_fakat" VALUE 0x81211C KwUb 1.330 spg_ub_q0p0052_o0p2 -0.2000 1.130 FORMAT "%5.3" /end CHARACTERISTIC
/begin CHARACTERISTIC VANF "Geschwindigkeitsschwelle für Anfahrhilfe" VALUE 0x811806 KwUb 318.8 vfzg_ub_q1p25 0.00 318.8 FORMAT "%5.1" /end CHARACTERISTIC
/begin CHARACTERISTIC VDASH "Mindestgeschwindigkeit für Dashpot" VALUE 0x8118A6 KwUb 318.8 vfzg_ub_q1p25 0.00 318.8 FORMAT "%5.1" /end CHARACTERISTIC
/begin CHARACTERISTIC VLSD "Mindestgeschwindigkeit für Lastschlagdämpfung" VALUE 0x8118A7 KwUb 318.8 vfzg_ub_q1p25 0.00 318.8 FORMAT "%5.1" /end CHARACTERISTIC
/begin CHARACTERISTIC VMIBGR "v-Schwelle für Freigabe Momentenbegrenzung" VALUE 0x81A1DF KwUb 318.8 vfzg_ub_q1p25 0.00 318.8 FORMAT "%5.1" /end CHARACTERISTIC
/begin CHARACTERISTIC VMKBRMX "Geschwindigkeitsschwelle für Kupplungsmomentbegrenzung bei betätigter Bremse" VALUE 0x81A1E0 KwUb 318.8 vfzg_ub_q1p25 0.00 318.8 FORMAT "%5.1" /end CHARACTERISTIC
/begin CHARACTERISTIC VSL "Fahrzeuggeschwindigkeitsschwelle für Kompensation Servolenkung" VALUE 0x819F4A KwUb 318.8 vfzg_ub_q1p25 0.00 318.8 FORMAT "%5.1" /end CHARACTERISTIC
/begin CHARACTERISTIC WDKARN "DK-Winkel-Schwelle für Gemischadaption aktiv" CURVE 0x81924F KlAUbSstUbWUb 100.0 relDK_ub_b100 0.00 100.0 FORMAT "%5.1"
 /begin AXIS_DESCR STD_AXIS nmot nmot_ub_q40 10 0.00 10200. FORMAT "%5.0" DEPOSIT ABSOLUTE /end AXIS_DESCR
/end CHARACTERISTIC
/begin CHARACTERISTIC WFAN "Schwellwert für Fahrpedalwinkel bei Bandendetest" VALUE 0x81A096 KwUb 100.0 relPED_ub_b100 0.00 100.0 FORMAT "%5.1" /end CHARACTERISTIC
/begin CHARACTERISTIC WIMAX "ObererSchranke interne Reglerzustände stetige Lambdaregelung" VALUE 0x817390 KwSw 7.999878 fak_sw_b4 -4.000000 3.999878 FORMAT "%8.6" /end CHARACTERISTIC
/begin CHARACTERISTIC WIMIN "Untere Schranke interne Reglerzustaende stetige Lambdaregelung" VALUE 0x817392 KwSw 7.999878 fak_sw_b4 -4.000000 3.999878 FORMAT "%8.6" /end CHARACTERISTIC
/begin CHARACTERISTIC XIMAX "Oberer Schranke interne Reglerzustände stetige Lambdaregelung" VALUE 0x817394 KwSw 1.999969 fak_sw_b1 -1.000000 0.9999695 FORMAT "%8.6" /end CHARACTERISTIC
/begin CHARACTERISTIC XIMIN "Untere Schranke interne Reglerzustaende stetige Lambdaregelung" VALUE 0x817396 KwSw 1.999969 fak_sw_b1 -1.000000 0.9999695 FORMAT "%8.6" /end CHARACTERISTIC
/begin CHARACTERISTIC Y2MAX "Obere Schranke Integralanteil LRS" VALUE 0x817398 KwSw 1.999969 fak_sw_b1 -1.000000 0.9999695 FORMAT "%8.6" /end CHARACTERISTIC
/begin CHARACTERISTIC ZFLLRPL "Zeitkonstante: Aufregeln des P-Anteils auf dem Luftpfad" VALUE 0x8116FE KwUb 5.08000 zk20msxs_ub_b5p1 0.0200000 5.10000 FORMAT "%7.5" /end CHARACTERISTIC
/begin CHARACTERISTIC ZHLLA "Zeitzähler-Schwelle für Abbruch erhöhte Solldrehzahl im Heiß-Leerlauf" VALUE 0x81FB9A KwUw 13107.00 t200msxs_uw_q0p2 0.00 13107.00 FORMAT "%8.2" /end CHARACTERISTIC
/begin CHARACTERISTIC ZHLLE "Zeitzähler-Schwelle für erhöhte Solldrehzahl im Heiß-Leerlauf" VALUE 0x81FB9C KwUw 13107.00 t200msxs_uw_q0p2 0.00 13107.00 FORMAT "%8.2" /end CHARACTERISTIC
/begin CHARACTERISTIC ZKDRLSOL "Zeitkonstante für drlsol-Filterung" VALUE 0x81579A KwUw 655.34999985 zk10msxs_uw_b655 0.010000152590 655.36000000 FORMAT "%12.8" /end CHARACTERISTIC
/begin CHARACTERISTIC ZKFRAOA "Zeitkonstante für frao-Integrator, f(Anzahl Starts mit Ölverdünnung)" CURVE 0x81DA42 KlAUwSstUwWUw 4.999924 zk200msxs_uw_b5 0.00 4.999924 FORMAT "%8.6"
 /begin AXIS_DESCR STD_AXIS abo dez 3 0.00 65535.00 FORMAT "%8.2" DEPOSIT ABSOLUTE /end AXIS_DESCR
/end CHARACTERISTIC
/begin CHARACTERISTIC ZKFRAUA "Zeitkonstante für frau-Integrator, f(Anzahl Stats mit Ölverdünnung)" CURVE 0x81DA50 KlAUwSstUwWUw 4.999924 zk200msxs_uw_b5 0.00 4.999924 FORMAT "%8.6"
 /begin AXIS_DESCR STD_AXIS abo dez 3 0.00 65535.00 FORMAT "%8.2" DEPOSIT ABSOLUTE /end AXIS_DESCR
/end CHARACTERISTIC
/begin CHARACTERISTIC ZKLLRD "Zeitkonstante für die Abregelung des D-Anteils" VALUE 0x8116FF KwUb 5.08000 zk20msxs_ub_b5p1 0.0200000 5.10000 FORMAT "%7.5" /end CHARACTERISTIC
/begin CHARACTERISTIC ZKNS "Zeitkonstante für Solldrehzahl bei Umschaltung" VALUE 0x81FB9E KwUw 1310.6999997 zk20msxs_uw_b1310p72 0.020000305180 1310.7200000 FORMAT "%12.7" /end CHARACTERISTIC
/begin CHARACTERISTIC ZKRKATA "Integrationsgeschwindigkeit Integrator rkat, f(abo)" CURVE 0x81DA5E KlAUwSstUwWUw 959.9854 zk200msxs_uw_b960 0.00 959.9854 FORMAT "%8.4"
 /begin AXIS_DESCR STD_AXIS abo dez 3 0.00 65535.00 FORMAT "%8.2" DEPOSIT ABSOLUTE /end AXIS_DESCR
/end CHARACTERISTIC
/begin CHARACTERISTIC ZKRKAZA "Integrationsgeschwindigkeit Integrator rkaz, f(abo)" CURVE 0x81DA6C KlAUwSstUwWUw 959.9854 zk200msxs_uw_b960 0.00 959.9854 FORMAT "%8.4"
 /begin AXIS_DESCR STD_AXIS abo dez 3 0.00 65535.00 FORMAT "%8.2" DEPOSIT ABSOLUTE /end AXIS_DESCR
/end CHARACTERISTIC
/begin CHARACTERISTIC ZLASHKAB "Zeitkonstante für Abregelung der dyn. Sollwertanhebung (dlasohkab) rin der LRHK" VALUE 0x817448 KwUw 655.34999985 zk10msxs_uw_b655 0.010000152590 655.36000000 FORMAT "%12.8" /end CHARACTERISTIC
/begin CHARACTERISTIC ZLASOHML "Zeitkonstante für PT1-Filter des Pseudo-Lambda hinter Kat" CURVE 0x81744A KlAUwSstUwWUw 655.34999985 zk10msxs_uw_b655 0.010000152590 655.36000000 FORMAT "%12.8"
 /begin AXIS_DESCR STD_AXIS ml_w m_uw_b6553p5 8 0.00 6553.500 FORMAT "%8.3" DEPOSIT ABSOLUTE /end AXIS_DESCR
/end CHARACTERISTIC
/begin CHARACTERISTIC ZLIBG "Filterzeitkonstante für die Nachführung der Integratorgrenzen" VALUE 0x811700 KwUb 5.08000 zk20msxs_ub_b5p1 0.0200000 5.10000 FORMAT "%7.5" /end CHARACTERISTIC
/begin CHARACTERISTIC ZNFNGLL "Filterzeitkonstante für Drehzahlgradient auf Luftpfad (LLR)" VALUE 0x811701 KwUb 5.08000 zk20msxs_ub_b5p1 0.0200000 5.10000 FORMAT "%7.5" /end CHARACTERISTIC
/begin CHARACTERISTIC ZNSUB "Zeitkonstante für Mindestsolldrehzahl bei Unterspannung" VALUE 0x819F4B KwUb 50.8000 zk200msxs_ub_b51p2 0.200000 51.0000 FORMAT "%7.4" /end CHARACTERISTIC
/begin CHARACTERISTIC ZRLFRAT "Filterzeitkonstante für die Berechnung der Zeitkonstante der FRAT-Adaption" VALUE 0x818FB0 KwUb 3.72308 zk200msxs_ub_b51p2 0.200000 3.92308 FORMAT "%7.5" /end CHARACTERISTIC
/begin MEASUREMENT B_asr "Bedingung für ASR aktiv" UWORD B_TRUE 1 100 0 1 BIT_MASK 0x20 FORMAT "%13.11" ECU_ADDRESS 0xFD8C /end MEASUREMENT
/begin MEASUREMENT B_blrka "Bedingung gesteuertes Katalysator-Ausräumen angefordert" UBYTE B_TRUE 1 100 0 1 BIT_MASK 0x1 FORMAT "%13.11" ECU_ADDRESS 0x380B2F /end MEASUREMENT
/begin MEASUREMENT B_brvfp "Bedingung Bremse betätigt vor Fahrpedal" UBYTE B_TRUE 1 100 0 1 BIT_MASK 0x1 FORMAT "%13.11" ECU_ADDRESS 0x380AE4 /end MEASUREMENT
/begin MEASUREMENT B_dash "Bedingung: Dashpot-Änderungsbegrenzung aktiv" UWORD B_TRUE 1 100 0 1 BIT_MASK 0x4000 FORMAT "%13.11" ECU_ADDRESS 0xFD88 /end MEASUREMENT
/begin MEASUREMENT B_dashv "Bedingung Dashpot verzögert" UWORD B_TRUE 1 100 0 1 BIT_MASK 0x8000 FORMAT "%13.11" ECU_ADDRESS 0xFD88 /end MEASUREMENT
/begin MEASUREMENT B_dlahini "Bedingung Initialisierung Integralanteil LRSHK" UBYTE B_TRUE 1 100 0 1 BIT_MASK 0x1 FORMAT "%13.11" ECU_ADDRESS 0x380B2C /end MEASUREMENT
/begin MEASUREMENT B_dp "Bedingung: Dashpotwert größer Fahrerwunsch (=1)" UWORD B_TRUE 1 100 0 1 BIT_MASK 0x4 FORMAT "%13.11" ECU_ADDRESS 0xFD8A /end MEASUREMENT
/begin MEASUREMENT B_edp "Bedingung Erlaubnis Dashpot" UWORD B_TRUE 1 100 0 1 BIT_MASK 0x8 FORMAT "%13.11" ECU_ADDRESS 0xFD8A /end MEASUREMENT
/begin MEASUREMENT B_elsd "Bedingung Erlaubnis Lastschlagdämpfung" UWORD B_TRUE 1 100 0 1 BIT_MASK 0x10 FORMAT "%13.11" ECU_ADDRESS 0xFD8A /end MEASUREMENT
/begin MEASUREMENT B_eobdlr "OBDII-Summenfehler. sperrt die LR" UWORD B_TRUE 1 100 0 1 BIT_MASK 0x20 FORMAT "%13.11" ECU_ADDRESS 0xFD98 /end MEASUREMENT
/begin MEASUREMENT B_fanfg "Freigabebit für Drehzahlanforderung bei Bandendetest" UBYTE B_TRUE 1 100 0 1 BIT_MASK 0x1 FORMAT "%13.11" ECU_ADDRESS 0x380AC0 /end MEASUREMENT
/begin MEASUREMENT B_fgr "Bedingung FGR (Tempomat) aktiv" UWORD B_TRUE 1 100 0 1 BIT_MASK 0x20 FORMAT "%13.11" ECU_ADDRESS 0xFD8A /end MEASUREMENT
/begin MEASUREMENT B_fil "Bedingung PT1-Filter für SAWE aktiv" UWORD B_TRUE 1 100 0 1 BIT_MASK 0x40 FORMAT "%13.11" ECU_ADDRESS 0xFD8A /end MEASUREMENT
/begin MEASUREMENT B_flrsres "Bedingung Regler-Resetierung in Abhängigkeit von B_lrsresf" UWORD B_TRUE 1 100 0 1 BIT_MASK 0x1000 FORMAT "%13.11" ECU_ADDRESS 0xFD96 /end MEASUREMENT
/begin MEASUREMENT B_frao "Einschaltbedingung für Adaption von frao" UWORD B_TRUE 1 100 0 1 BIT_MASK 0x4000 FORMAT "%13.11" ECU_ADDRESS 0xFD58 /end MEASUREMENT
/begin MEASUREMENT B_fraor "Bedingung frao-Integrator außerhalb reduzierter Bereich" UWORD B_TRUE 1 100 0 1 BIT_MASK 0x8000 FORMAT "%13.11" ECU_ADDRESS 0xFD58 /end MEASUREMENT
/begin MEASUREMENT B_frat "Einschaltbedingung für Adaption von frat" UWORD B_TRUE 1 100 0 1 BIT_MASK 0x1 FORMAT "%13.11" ECU_ADDRESS 0xFD5A /end MEASUREMENT
/begin MEASUREMENT B_frau "Einschaltbedingung für Adaption von frau" UWORD B_TRUE 1 100 0 1 BIT_MASK 0x2 FORMAT "%13.11" ECU_ADDRESS 0xFD5A /end MEASUREMENT
/begin MEASUREMENT B_fraur "Bedingung frau-Integrator außerhalb reduzierter Bereich" UWORD B_TRUE 1 100 0 1 BIT_MASK 0x4 FORMAT "%13.11" ECU_ADDRESS 0xFD5A /end MEASUREMENT
/begin MEASUREMENT B_frini "Bedingung Regelfaktor fr initialisieren" UWORD B_TRUE 1 100 0 1 BIT_MASK 0x80 FORMAT "%13.11" ECU_ADDRESS 0xFD9A /end MEASUREMENT
/begin MEASUREMENT B_frini2 "Bedingung Regelfaktor fr initialisieren, Bank 2" UWORD B_TRUE 1 100 0 1 BIT_MASK 0x100 FORMAT "%13.11" ECU_ADDRESS 0xFD9A /end MEASUREMENT
/begin MEASUREMENT B_frmax "Lambda-Regelung setzt Bit sobald FR am Anschlag FRMAX" UWORD B_TRUE 1 100 0 1 BIT_MASK 0x2000 FORMAT "%13.11" ECU_ADDRESS 0xFD96 /end MEASUREMENT
/begin MEASUREMENT B_frmin "Lambda-Regelung setzt Bit sobald FR am Anschlag FRMIN" UWORD B_TRUE 1 100 0 1 BIT_MASK 0x4000 FORMAT "%13.11" ECU_ADDRESS 0xFD96 /end MEASUREMENT
/begin MEASUREMENT B_gasp "Bedingung Grundadaption gesperrt" UWORD B_TRUE 1 100 0 1 BIT_MASK 0x2 FORMAT "%13.11" ECU_ADDRESS 0xFD60 /end MEASUREMENT
/begin MEASUREMENT B_hll "Bedingung Heißleerlauf" UWORD B_TRUE 1 100 0 1 BIT_MASK 0x20 FORMAT "%13.11" ECU_ADDRESS 0xFD82 /end MEASUREMENT
/begin MEASUREMENT B_idecay "Bedingung Grenzwertreg. auf fettes Soll-Lambda mit Absteuern Integralanteil LRS" UWORD B_TRUE 1 100 0 1 BIT_MASK 0x8000 FORMAT "%13.11" ECU_ADDRESS 0xFD96 /end MEASUREMENT
/begin MEASUREMENT B_iflsd "Bedingung Initialisierung Filter Lastschlagdämpfung" UWORD B_TRUE 1 100 0 1 BIT_MASK 0x80 FORMAT "%13.11" ECU_ADDRESS 0xFD8A /end MEASUREMENT
/begin MEASUREMENT B_kuplaus "Motor ist ausgekuppelt; Kupllung ist getreten" UWORD B_TRUE 1 100 0 1 BIT_MASK 0x1000 FORMAT "%13.11" ECU_ADDRESS 0xFD84 /end MEASUREMENT
/begin MEASUREMENT B_ll "Bedingung Leerlauf aus Fahrersicht" UWORD B_TRUE 1 100 0 1 BIT_MASK 0x200 FORMAT "%13.11" ECU_ADDRESS 0xFD8A /end MEASUREMENT
/begin MEASUREMENT B_llrpkh "P-Verstärkung für Katheizen aktiv" UWORD B_TRUE 1 100 0 1 BIT_MASK 0x20 FORMAT "%13.11" ECU_ADDRESS 0xFD84 /end MEASUREMENT
/begin MEASUREMENT B_llrpst "P-Anteil: Parameter für Start aktiv" UWORD B_TRUE 1 100 0 1 BIT_MASK 0x40 FORMAT "%13.11" ECU_ADDRESS 0xFD84 /end MEASUREMENT
/begin MEASUREMENT B_llrst "Drehzahl erreicht nstat im Nachstart" UWORD B_TRUE 1 100 0 1 BIT_MASK 0x80 FORMAT "%13.11" ECU_ADDRESS 0xFD84 /end MEASUREMENT
/begin MEASUREMENT B_lr "LREB: Bedingung Lambdaregelung (vor Kat); (Bank 1)" UWORD B_TRUE 1 100 0 1 BIT_MASK 0x40 FORMAT "%13.11" ECU_ADDRESS 0xFD98 /end MEASUREMENT
/begin MEASUREMENT B_lr2s "CARB FREEZE FRAME, Bank1 bit 1, LR: Regelbetrieb mit zwei Sonden" UBYTE B_TRUE 1 100 0 1 BIT_MASK 0x2 FORMAT "%13.11" ECU_ADDRESS 0x380B29 /end MEASUREMENT
/begin MEASUREMENT B_lra "Bedingung Gemischadaption freigegeben" UWORD B_TRUE 1 100 0 1 BIT_MASK 0x4 FORMAT "%13.11" ECU_ADDRESS 0xFD60 /end MEASUREMENT
/begin MEASUREMENT B_lraen "Bedingung Gemischadaption freigegeben" UWORD B_TRUE 1 100 0 1 BIT_MASK 0x8 FORMAT "%13.11" ECU_ADDRESS 0xFD60 /end MEASUREMENT
/begin MEASUREMENT B_lrare "Bedingung Reset LRA" UWORD B_TRUE 1 100 0 1 BIT_MASK 0x8 FORMAT "%13.11" ECU_ADDRESS 0xFD5A /end MEASUREMENT
/begin MEASUREMENT B_lrare2 "Bedingung Reset LRA Bank 2" UWORD B_TRUE 1 100 0 1 BIT_MASK 0x10 FORMAT "%13.11" ECU_ADDRESS 0xFD5A /end MEASUREMENT
/begin MEASUREMENT B_lrareb "Bedingung Resetbereitschaft LRA" UWORD B_TRUE 1 100 0 1 BIT_MASK 0x20 FORMAT "%13.11" ECU_ADDRESS 0xFD5A /end MEASUREMENT
/begin MEASUREMENT B_lrat "Bedingung Gemischadaption temperaturabhängig freigegeben" UWORD B_TRUE 1 100 0 1 BIT_MASK 0x10 FORMAT "%13.11" ECU_ADDRESS 0xFD60 /end MEASUREMENT
/begin MEASUREMENT B_lrhk "Bedingung Lambdaregelung hinter Kat" UWORD B_TRUE 1 100 0 1 BIT_MASK 0x40 FORMAT "%13.11" ECU_ADDRESS 0xFD9A /end MEASUREMENT
/begin MEASUREMENT B_lrhkb "Bedingung Lambdaregelung h. Kat, bankspez. Parameter Bank 1" UBYTE B_TRUE 1 100 0 1 BIT_MASK 0x2 FORMAT "%13.11" ECU_ADDRESS 0x380B2C /end MEASUREMENT
/begin MEASUREMENT B_lrhkg "bankunabhängige Bedingung Lambdaregelung hinter Kat" UBYTE B_TRUE 1 100 0 1 BIT_MASK 0x4 FORMAT "%13.11" ECU_ADDRESS 0x380B2C /end MEASUREMENT
/begin MEASUREMENT B_lrhkp "LRHK: Freigabebedingung P-Anteil Lambdaregelung hinter Kat" UBYTE B_TRUE 1 100 0 1 BIT_MASK 0x8 FORMAT "%13.11" ECU_ADDRESS 0x380B2C /end MEASUREMENT
/begin MEASUREMENT B_lrka "Bedingung Katalysator-Ausräumen" UBYTE B_TRUE 1 100 0 1 BIT_MASK 0x1 FORMAT "%13.11" ECU_ADDRESS 0x380B2E /end MEASUREMENT
/begin MEASUREMENT B_lrkae "Bedingung gesteuertes Katalysator-Ausräumen möglich" UBYTE B_TRUE 1 100 0 1 BIT_MASK 0x4 FORMAT "%13.11" ECU_ADDRESS 0x380B2F /end MEASUREMENT
/begin MEASUREMENT B_lrmsbs "Bedingung Abmagerungsverbot für stetige Regelung, Bank 1" UWORD B_TRUE 1 100 0 1 BIT_MASK 0x80 FORMAT "%13.11" ECU_ADDRESS 0xFD98 /end MEASUREMENT
/begin MEASUREMENT B_lrnda "LR Bank1 aktiv, eventuell eingeschränkt" UWORD B_TRUE 1 100 0 1 BIT_MASK 0x100 FORMAT "%13.11" ECU_ADDRESS 0xFD98 /end MEASUREMENT
/begin MEASUREMENT B_lrrl "LREB: Von Last abhängige Bedingung Lambdaregelung (vor Kat)" UWORD B_TRUE 1 100 0 1 BIT_MASK 0x200 FORMAT "%13.11" ECU_ADDRESS 0xFD98 /end MEASUREMENT
/begin MEASUREMENT B_lrs "LRSEB: Bedingung Lambdaregelung intern (vor Kat), Bank 1" UWORD B_TRUE 1 100 0 1 BIT_MASK 0x400 FORMAT "%13.11" ECU_ADDRESS 0xFD98 /end MEASUREMENT
/begin MEASUREMENT B_lrsrems "Bedingung fr-reset bei Abmagerungsverbot für Bank 1" UWORD B_TRUE 1 100 0 1 BIT_MASK 0x800 FORMAT "%13.11" ECU_ADDRESS 0xFD98 /end MEASUREMENT
/begin MEASUREMENT B_lrsresf "Bedingung Fr-Reset bei lamsons<LALIUSMN" UWORD B_TRUE 1 100 0 1 BIT_MASK 0x1000 FORMAT "%13.11" ECU_ADDRESS 0xFD98 /end MEASUREMENT
/begin MEASUREMENT B_lrssa "LRSEB: Einschaltbed. für Lambdareg. nach Schub bei langsamer Sonde" UWORD B_TRUE 1 100 0 1 BIT_MASK 0x2000 FORMAT "%13.11" ECU_ADDRESS 0xFD98 /end MEASUREMENT
/begin MEASUREMENT B_lrssp "Lambda-Regelung setzt Bit, wenn Zusatzamplitude Vorzeichenwechsel" UWORD B_TRUE 1 100 0 1 BIT_MASK 0x1 FORMAT "%13.11" ECU_ADDRESS 0xFD98 /end MEASUREMENT
/begin MEASUREMENT B_lrvk "CARB FREEZE FRAME, Bank1 Bit 4, LR: Regelung nur mit einer Sonde (vor KAT)" UBYTE B_TRUE 1 100 0 1 BIT_MASK 0x10 FORMAT "%13.11" ECU_ADDRESS 0x380B29 /end MEASUREMENT
/begin MEASUREMENT B_ls "Bedingung: Lastschlagbegrenzung kleiner Fahrerwunsch (=1)" UWORD B_TRUE 1 100 0 1 BIT_MASK 0x1000 FORMAT "%13.11" ECU_ADDRESS 0xFD8A /end MEASUREMENT
/begin MEASUREMENT B_lsd "Bedingung: Pos. Lastschlagdämpfung aktiv" UWORD B_TRUE 1 100 0 1 BIT_MASK 0x2000 FORMAT "%13.11" ECU_ADDRESS 0xFD8A /end MEASUREMENT
/begin MEASUREMENT B_mdee "Bedingung Momentenreduzierung über Einspritzausblendung erlaubt" UWORD B_TRUE 1 100 0 1 BIT_MASK 0x40 FORMAT "%13.11" ECU_ADDRESS 0xFD8E /end MEASUREMENT
/begin MEASUREMENT B_mdein "Bedingung Momenteneingriff aktiv" UWORD B_TRUE 1 100 0 1 BIT_MASK 0x40 FORMAT "%13.11" ECU_ADDRESS 0xFD8C /end MEASUREMENT
/begin MEASUREMENT B_mdmin "Bedingung minimal erreichbares indiziertes Moment erreicht" UWORD B_TRUE 1 100 0 1 BIT_MASK 0x100 FORMAT "%13.11" ECU_ADDRESS 0xFD56 /end MEASUREMENT
/begin MEASUREMENT B_mdnstab "Bedingung Drehzahlstabilisierung aktiv" UWORD B_TRUE 1 100 0 1 BIT_MASK 0x4000 FORMAT "%13.11" ECU_ADDRESS 0xFD84 /end MEASUREMENT
/begin MEASUREMENT B_mdredhyein "" UWORD B_TRUE 1 100 0 1 BIT_MASK 0x80 FORMAT "%13.11" ECU_ADDRESS 0xFD8E /end MEASUREMENT
/begin MEASUREMENT B_mgbgakt "Bedingung Momentengradientenbegrenzung aktiv" UWORD B_TRUE 1 100 0 1 BIT_MASK 0x8000 FORMAT "%13.11" ECU_ADDRESS 0xFD8A /end MEASUREMENT
/begin MEASUREMENT B_mibeg "Bedingung Momentenbegrenzung ist aktiv" UWORD B_TRUE 1 100 0 1 BIT_MASK 0x80 FORMAT "%13.11" ECU_ADDRESS 0xFD8C /end MEASUREMENT
/begin MEASUREMENT B_mibegl "Bedingung Momentenbegrenzung Füllungspfad aktiv" UWORD B_TRUE 1 100 0 1 BIT_MASK 0x8000 FORMAT "%13.11" ECU_ADDRESS 0xFD8C /end MEASUREMENT
/begin MEASUREMENT B_mifabg "Bedingung Begrenzung mifa" UWORD B_TRUE 1 100 0 1 BIT_MASK 0x1 FORMAT "%13.11" ECU_ADDRESS 0xFD8C /end MEASUREMENT
/begin MEASUREMENT B_mkbrmx "Bedingung Kupplungsmomentbegrenzung bei betätigter Bremse aktiv" UBYTE B_TRUE 1 100 0 1 BIT_MASK 0x2 FORMAT "%13.11" ECU_ADDRESS 0x380AE4 /end MEASUREMENT
/begin MEASUREMENT B_mlevab "Bit Lambdaregelung bei/nach Zylinderausblendung" UWORD B_TRUE 1 100 0 1 BIT_MASK 0x4000 FORMAT "%13.11" ECU_ADDRESS 0xFD98 /end MEASUREMENT
/begin MEASUREMENT B_mlnka "Bedingung Luftmassenschwelle nach Kat-Ausräumen überschritten; (Bank 1)" UBYTE B_TRUE 1 100 0 1 BIT_MASK 0x20 FORMAT "%13.11" ECU_ADDRESS 0x380B2C /end MEASUREMENT
/begin MEASUREMENT B_mlrsa "LRSEB: Ausschaltbed. für Lambdareg. auf bei und nach Schub über Luftmassenschw." UWORD B_TRUE 1 100 0 1 BIT_MASK 0x8000 FORMAT "%13.11" ECU_ADDRESS 0xFD98 /end MEASUREMENT
/begin MEASUREMENT B_mrakt "Bedingung: Momentenreserve aktiv" UWORD B_TRUE 1 100 0 1 BIT_MASK 0x1 FORMAT "%13.11" ECU_ADDRESS 0xFD8E /end MEASUREMENT
/begin MEASUREMENT B_mrpfa "Bedingung Nullsetzen von mrped_w wegen allgemeiner Drehzahlanhebung" UBYTE B_TRUE 1 100 0 1 BIT_MASK 0x1 FORMAT "%13.11" ECU_ADDRESS 0x380ACA /end MEASUREMENT
/begin MEASUREMENT B_msr "Bedingung für Momentenschlupfregelung" UWORD B_TRUE 1 100 0 1 BIT_MASK 0x100 FORMAT "%13.11" ECU_ADDRESS 0xFD8C /end MEASUREMENT
/begin MEASUREMENT B_nekati "lokales Flag für  Sperre  I-Anteil durch DKAT-Fehler gemäß CLRSHKEB" UBYTE B_TRUE 1 100 0 1 BIT_MASK 0x10 FORMAT "%13.11" ECU_ADDRESS 0x380B2C /end MEASUREMENT
/begin MEASUREMENT B_nofra "Bedingung Sperren der multiplikativen Gemischkorrektur" UWORD B_TRUE 1 100 0 1 BIT_MASK 0x40 FORMAT "%13.11" ECU_ADDRESS 0xFD5A /end MEASUREMENT
/begin MEASUREMENT B_nofrat "Bedingung Sperren der temperaturabhängigen Gemischkorrektur" UWORD B_TRUE 1 100 0 1 BIT_MASK 0x80 FORMAT "%13.11" ECU_ADDRESS 0xFD5A /end MEASUREMENT
/begin MEASUREMENT B_nolrb "CARB FREEZE FRAME, Bank1 Bit 2, LR: Steuerbetrieb durch Betriebsbedingungen" UBYTE B_TRUE 1 100 0 1 BIT_MASK 0x4 FORMAT "%13.11" ECU_ADDRESS 0x380B29 /end MEASUREMENT
/begin MEASUREMENT B_nolre "CARB FREEZE FRAME, Bank1 Bit 3, LR: Steuerung nach Systemfehler" UBYTE B_TRUE 1 100 0 1 BIT_MASK 0x8 FORMAT "%13.11" ECU_ADDRESS 0x380B29 /end MEASUREMENT
/begin MEASUREMENT B_nolrw "CARB FREEZE FRAME, Bank1 Bit 0, LR: Steuerbetrieb, Startbed. noch nicht erfüllt" UBYTE B_TRUE 1 100 0 1 BIT_MASK 0x1 FORMAT "%13.11" ECU_ADDRESS 0x380B29 /end MEASUREMENT
/begin MEASUREMENT B_norkat "Bedingung additive Korrektur der Gemischadaption pro Zeit abgeschaltet" UWORD B_TRUE 1 100 0 1 BIT_MASK 0x100 FORMAT "%13.11" ECU_ADDRESS 0xFD5A /end MEASUREMENT
/begin MEASUREMENT B_norkaz "Bedingung additive Korrektur der Gemischadaption pro Zündung abgeschaltet" UWORD B_TRUE 1 100 0 1 BIT_MASK 0x200 FORMAT "%13.11" ECU_ADDRESS 0xFD5A /end MEASUREMENT
/begin MEASUREMENT B_ns2 "Bedingung Solldrehzahl 2 aktiv" UWORD B_TRUE 1 100 0 1 BIT_MASK 0x40 FORMAT "%13.11" ECU_ADDRESS 0xFD82 /end MEASUREMENT
/begin MEASUREMENT B_ns2a "Bedingung Solldrehzahl 2 angefordert" UWORD B_TRUE 1 100 0 1 BIT_MASK 0x80 FORMAT "%13.11" ECU_ADDRESS 0xFD82 /end MEASUREMENT
/begin MEASUREMENT B_nsget "Momentenanforderung für CVT: Stellen der Kegelscheibe" UWORD B_TRUE 1 100 0 1 BIT_MASK 0x100 FORMAT "%13.11" ECU_ADDRESS 0xFD82 /end MEASUREMENT
/begin MEASUREMENT B_nsks "Bedingung für Solldrehzahlanhebung (Kochschutz)" UWORD B_TRUE 1 100 0 1 BIT_MASK 0x200 FORMAT "%13.11" ECU_ADDRESS 0xFD82 /end MEASUREMENT
/begin MEASUREMENT B_nssl "Bedingung Soll-Drehzahlanhebung bei Servo-Lenkung" UWORD B_TRUE 1 100 0 1 BIT_MASK 0x400 FORMAT "%13.11" ECU_ADDRESS 0xFD82 /end MEASUREMENT
/begin MEASUREMENT B_nstabk "Bedingung Standabkopplung" UWORD B_TRUE 1 100 0 1 BIT_MASK 0x800 FORMAT "%13.11" ECU_ADDRESS 0xFD82 /end MEASUREMENT
/begin MEASUREMENT B_nwll "Fehler : Nockenwellensteuerung (Einlaß oder Auslaß))" UWORD B_TRUE 1 100 0 1 BIT_MASK 0x1000 FORMAT "%13.11" ECU_ADDRESS 0xFD82 /end MEASUREMENT
/begin MEASUREMENT B_pspaus "Bedingung LR inaktiv bei projektspez. AUS-Bedingungen" UWORD B_TRUE 1 100 0 1 BIT_MASK 0x1 FORMAT "%13.11" ECU_ADDRESS 0xFD9A /end MEASUREMENT
/begin MEASUREMENT B_pspwl "Bedingung LR möglich da Warmlauf beendet" UWORD B_TRUE 1 100 0 1 BIT_MASK 0x2 FORMAT "%13.11" ECU_ADDRESS 0xFD9A /end MEASUREMENT
/begin MEASUREMENT B_rkat "Bedingung Lernbereich additive Korrektur pro Zeit aktiv" UWORD B_TRUE 1 100 0 1 BIT_MASK 0x400 FORMAT "%13.11" ECU_ADDRESS 0xFD5A /end MEASUREMENT
/begin MEASUREMENT B_rkatr "Bedingung rkat-Integrator außerhalb reduzierten Bereich" UWORD B_TRUE 1 100 0 1 BIT_MASK 0x800 FORMAT "%13.11" ECU_ADDRESS 0xFD5A /end MEASUREMENT
/begin MEASUREMENT B_rkaz "Bedingung Lernbereich additive Korrektur pro Zündung aktiv" UWORD B_TRUE 1 100 0 1 BIT_MASK 0x1000 FORMAT "%13.11" ECU_ADDRESS 0xFD5A /end MEASUREMENT
/begin MEASUREMENT B_rkazr "Bedingung rkaz-Integrator außerhalb reduzierten Bereich" UWORD B_TRUE 1 100 0 1 BIT_MASK 0x2000 FORMAT "%13.11" ECU_ADDRESS 0xFD5A /end MEASUREMENT
/begin MEASUREMENT B_sa "Bedingung Schubabschalten" UWORD B_TRUE 1 100 0 1 BIT_MASK 0x100 FORMAT "%13.11" ECU_ADDRESS 0xFD8E /end MEASUREMENT
/begin MEASUREMENT B_sbbhktmp "lokale Bedingung Sonde betriebsbereit hinter Kat, Y-Konfiguration" UBYTE B_TRUE 1 100 0 1 BIT_MASK 0x10 FORMAT "%13.11" ECU_ADDRESS 0x380B2F /end MEASUREMENT
/begin MEASUREMENT B_slspaus "Sekundärluft-spezifisches Sperrbit für Lambdaregelung" UWORD B_TRUE 1 100 0 1 BIT_MASK 0x4 FORMAT "%13.11" ECU_ADDRESS 0xFD9A /end MEASUREMENT
/begin MEASUREMENT B_tarau "LREB: Bedingung Start bei niedrigen Ansauglufttemperaturen" UWORD B_TRUE 1 100 0 1 BIT_MASK 0x8 FORMAT "%13.11" ECU_ADDRESS 0xFD9A /end MEASUREMENT
/begin MEASUREMENT B_tdmlsds "Bedingung Zeit nach Kupplungsbetätigung mit veränderter LSD-Auslösung" UWORD B_TRUE 1 100 0 1 BIT_MASK 0x8 FORMAT "%13.11" ECU_ADDRESS 0xFD8C /end MEASUREMENT
/begin MEASUREMENT B_tmlr "LREB: Von Motortemp. abhängige Bedingungen Lambdaregelung (vor Kat)" UWORD B_TRUE 1 100 0 1 BIT_MASK 0x10 FORMAT "%13.11" ECU_ADDRESS 0xFD9A /end MEASUREMENT
/begin MEASUREMENT B_update "B_update = false    kein Update der Zustandsgroessen in der LRS" UWORD B_TRUE 1 100 0 1 BIT_MASK 0x2 FORMAT "%13.11" ECU_ADDRESS 0xFD98 /end MEASUREMENT
/begin MEASUREMENT B_vl "Bedingung Vollast" UWORD B_TRUE 1 100 0 1 BIT_MASK 0x10 FORMAT "%13.11" ECU_ADDRESS 0xFD8C /end MEASUREMENT
/begin MEASUREMENT B_vsspaus "Ventilverstellung-spezifisches Sperrbit für Lambdaregelung" UWORD B_TRUE 1 100 0 1 BIT_MASK 0x20 FORMAT "%13.11" ECU_ADDRESS 0xFD9A /end MEASUREMENT
/begin MEASUREMENT B_y2max "Integralanteil der LRS hat obere Schranke erreicht" UWORD B_TRUE 1 100 0 1 BIT_MASK 0x4 FORMAT "%13.11" ECU_ADDRESS 0xFD98 /end MEASUREMENT
/begin MEASUREMENT B_y2min "Integralanteil der LRS hat untere Schranke erreicht" UWORD B_TRUE 1 100 0 1 BIT_MASK 0x8 FORMAT "%13.11" ECU_ADDRESS 0xFD98 /end MEASUREMENT
/begin MEASUREMENT B_za "Bedingung Zwangsamplitude" UWORD B_TRUE 1 100 0 1 BIT_MASK 0x10 FORMAT "%13.11" ECU_ADDRESS 0xFD98 /end MEASUREMENT
/begin MEASUREMENT B_zwafh "Zündwinkelfreigabe zur Anfahrhilfe" UWORD B_TRUE 1 100 0 1 BIT_MASK 0x2000 FORMAT "%13.11" ECU_ADDRESS 0xFD84 /end MEASUREMENT
/begin MEASUREMENT B_zwget "Zündwinkeleingriff durch Getriebeeingriff" UWORD B_TRUE 1 100 0 1 BIT_MASK 0x200 FORMAT "%13.11" ECU_ADDRESS 0xFD8C /end MEASUREMENT
/begin MEASUREMENT B_zwnget "Zündwinkeleingriff nicht durch Getriebeeingriff" UWORD B_TRUE 1 100 0 1 BIT_MASK 0x400 FORMAT "%13.11" ECU_ADDRESS 0xFD8C /end MEASUREMENT
/begin MEASUREMENT B_zwvs "Bedingung für schnellen äußeren ZW-Eingriff der Momentenschnittstelle" UWORD B_TRUE 1 100 0 1 BIT_MASK 0x800 FORMAT "%13.11" ECU_ADDRESS 0xFD8C /end MEASUREMENT
/begin MEASUREMENT B_zwvz "Bedingung für Zündwinkeleingriff der Momentenschnittstelle" UWORD B_TRUE 1 100 0 1 BIT_MASK 0x1000 FORMAT "%13.11" ECU_ADDRESS 0xFD8C /end MEASUREMENT
/begin MEASUREMENT B_zwvzvb "Bedingung für Zündwinkeleingriff der Momentenschnittstelle vor Begrenzung" UWORD B_TRUE 1 100 0 1 BIT_MASK 0x2000 FORMAT "%13.11" ECU_ADDRESS 0xFD8C /end MEASUREMENT
/begin MEASUREMENT cmibeg_w "Zähler aktiver Begrenzungen des inneren Moments" UWORD dez 1 100 0 65535 FORMAT "%8.2" ECU_ADDRESS 0x383CC8 /end MEASUREMENT
/begin MEASUREMENT dfrmin_w "Untergrenze von dfr_w bei Magerschutz" SWORD fak_sw_b1 1 100 -1 0.999969 FORMAT "%8.6" ECU_ADDRESS 0x38290A /end MEASUREMENT
/begin MEASUREMENT dfrmt_w "Abweichung schneller Mittelwert des Lambdareglers von 1.0 (Word)" SWORD fak_sw_b1 1 100 -1 0.999969 FORMAT "%8.6" ECU_ADDRESS 0x384B02 /end MEASUREMENT
/begin MEASUREMENT dfrm_w "Abweichung schneller Mittelwert des Lambdareglers von 1.0 (Word)" SWORD fak_sw_b1 1 100 -1 0.999969 FORMAT "%8.6" ECU_ADDRESS 0x384B04 /end MEASUREMENT
/begin MEASUREMENT dfrpr_w "Delta Lambdaregler (Faktor); vorläufiger Wert vor Abfrage auf Magerschutz" SWORD fak_sw_b1 1 100 -1 0.999969 FORMAT "%8.6" ECU_ADDRESS 0x38290C /end MEASUREMENT
/begin MEASUREMENT dfrzaf_w "LRS-Zwangsamplitude, gefiltert" SWORD fak_sw_b1 1 100 -1 0.999969 FORMAT "%8.6" ECU_ADDRESS 0x38290E /end MEASUREMENT
/begin MEASUREMENT dfrza_w "LRS-Zwangsamplitude" SWORD fak_sw_b1 1 100 -1 0.999969 FORMAT "%8.6" ECU_ADDRESS 0x382910 /end MEASUREMENT
/begin MEASUREMENT dfr_w "Delta Lambdaregler (Faktor )" SWORD fak_sw_b1 1 100 -1 0.999969 FORMAT "%8.6" ECU_ADDRESS 0x382912 /end MEASUREMENT
/begin MEASUREMENT dlahini_w "Intialisierungswert für Integralanteil LRSHK" SWORD fak_sw_b1 1 100 -1 0.999969 FORMAT "%8.6" ECU_ADDRESS 0x3829C0 /end MEASUREMENT
/begin MEASUREMENT dlahist_w "I-Anteil der stetigen LRHK bei Motorstart" SWORD fak_sw_b1 1 100 -1 0.999969 FORMAT "%8.6" ECU_ADDRESS 0x3829C2 /end MEASUREMENT
/begin MEASUREMENT dlahi_w "I-Anteil der stetigen LRHK" SWORD fak_sw_b1 1 100 -1 0.999969 FORMAT "%8.6" ECU_ADDRESS 0x383CE4 /end MEASUREMENT
/begin MEASUREMENT dlahkab_w "Dynamische Überhöhung des Pseudo Lambda-Sollwertes hinter Kat" SWORD fak_sw_b1 1 100 -1 0.999969 FORMAT "%8.6" ECU_ADDRESS 0x3829C4 /end MEASUREMENT
/begin MEASUREMENT dlahp_w "P-Anteil der stetigen LRHK" SWORD fak_sw_b1 1 100 -1 0.999969 FORMAT "%8.6" ECU_ADDRESS 0x3829C6 /end MEASUREMENT
/begin MEASUREMENT dlashki_w "Delta-Lambda gewichtet für I-Anteil LRSHK" SWORD fak_sw_b1 1 100 -1 0.999969 FORMAT "%8.6" ECU_ADDRESS 0x3829C8 /end MEASUREMENT
/begin MEASUREMENT dlashkm_w "Delta-Lambda aus Lambdaregelung hinter Kat (Ist-Wert fr-synchron gemittelt)" SWORD fak_sw_b1 1 100 -1 0.999969 FORMAT "%8.6" ECU_ADDRESS 0x3829CA /end MEASUREMENT
/begin MEASUREMENT dlashkp_w "Delta-Lambda gewichtet für P-Anteil LRSHK5.30" SWORD fak_sw_b1 1 100 -1 0.999969 FORMAT "%8.6" ECU_ADDRESS 0x3829CC /end MEASUREMENT
/begin MEASUREMENT dlaso "Korrekturwert Lambda-Sollwert für stetigen Lambdaregler, 8 Bit" SBYTE fak_sb_b0p03125 1 100 -0.03125 0.0310059 FORMAT "%7.5" ECU_ADDRESS 0x380B26 /end MEASUREMENT
/begin MEASUREMENT dlrfrat "Delta rl für die Berechnug der Zeitkonstante der FRAT-Adaption" UBYTE fak_q0p0625 1 100 0 15.9375 FORMAT "%5.2" ECU_ADDRESS 0x38488A /end MEASUREMENT
/begin MEASUREMENT dlsd_w "Dämpfung PT2-Filter in Lastschlagdämpfung" UWORD fak_uw_b2 1 100 0 1.99997 FORMAT "%8.6" ECU_ADDRESS 0x382628 /end MEASUREMENT
/begin MEASUREMENT dmbebl_w "Delta-Moment für Auslösung Lastschlagdämpfung" UWORD rel_uw_b100 1 100 0 99.9985 FORMAT "%8.5" ECU_ADDRESS 0x38262A /end MEASUREMENT
/begin MEASUREMENT dmdpo_w "Delta Moment Dashpot-Auslösung" UWORD rel_uw_b100 1 100 0 99.9985 FORMAT "%8.5" ECU_ADDRESS 0x38262C /end MEASUREMENT
/begin MEASUREMENT dmdpu_w "delta Moment Dashpot-Ende" UWORD rel_uw_b100 1 100 0 99.9985 FORMAT "%8.5" ECU_ADDRESS 0x38262E /end MEASUREMENT
/begin MEASUREMENT dmgbeg_w "Delta-Moment für Gradientenbegrenzung" UWORD rel_uw_b100 1 100 0 99.9985 FORMAT "%8.5" ECU_ADDRESS 0x382630 /end MEASUREMENT
/begin MEASUREMENT dmllrdl_w "geforderte Drehmomentänderung von der LLR (D-Anteil Luftpfad)" SWORD rel_sw_b100 1 100 -100 99.9969 FORMAT "%8.4" ECU_ADDRESS 0x3824FE /end MEASUREMENT
/begin MEASUREMENT dmllrd_w "geforderte Drehmomentänderung von der LLR (D-Anteil)" SWORD rel_sw_b100 1 100 -100 99.9969 FORMAT "%8.4" ECU_ADDRESS 0x382500 /end MEASUREMENT
/begin MEASUREMENT dmllrib_w "I-Anteil des Masters" SWORD rel_sw_b100 1 100 -100 99.9969 FORMAT "%8.4" ECU_ADDRESS 0x382502 /end MEASUREMENT
/begin MEASUREMENT dmllrii_w "I-Anteil bei Betrieb ohne DTEV" SWORD rel_sw_b100 1 100 -100 99.9969 FORMAT "%8.4" ECU_ADDRESS 0x382504 /end MEASUREMENT
/begin MEASUREMENT dmllriz_w "I-Anteil bei Beginn der DTEV" SWORD rel_sw_b100 1 100 -100 99.9969 FORMAT "%8.4" ECU_ADDRESS 0x382506 /end MEASUREMENT
/begin MEASUREMENT dmllri_w "geforderte Drehmomentänderung von der LLR (I-Anteil)" SWORD rel_sw_b100 1 100 -100 99.9969 FORMAT "%8.4" ECU_ADDRESS 0x382508 /end MEASUREMENT
/begin MEASUREMENT dmllrl_w "geforderte Drehmomentänderung von der LLR (Anteil Luftpfad)" SWORD rel_sw_b100 1 100 -100 99.9969 FORMAT "%8.4" ECU_ADDRESS 0x38250A /end MEASUREMENT
/begin MEASUREMENT dmllrpl_w "geforderte Drehmomentänderung von der LLR (P-Anteil Luftpfad)" SWORD rel_sw_b100 1 100 -100 99.9969 FORMAT "%8.4" ECU_ADDRESS 0x38250C /end MEASUREMENT
/begin MEASUREMENT dmllrp_w "geforderte Drehmomentänderung von der LLR (P-Anteil)" SWORD rel_sw_b100 1 100 -100 99.9969 FORMAT "%8.4" ECU_ADDRESS 0x38250E /end MEASUREMENT
/begin MEASUREMENT dmllr_w "geforderte Drehmomentänderung von der LLR (PD-Anteil)" SWORD rel_sw_b100 1 100 -100 99.9969 FORMAT "%8.4" ECU_ADDRESS 0x382510 /end MEASUREMENT
/begin MEASUREMENT dmlms_w "Abstand des Sollmoments vom zulässigen Moment für Füllungspfad" SWORD rel_sw_b100 1 100 -100 99.9969 FORMAT "%8.4" ECU_ADDRESS 0x38269C /end MEASUREMENT
/begin MEASUREMENT dmlsdo_w "Delta Moment Auslösung Lastschlagdämpfung" UWORD rel_uw_b100 1 100 0 99.9985 FORMAT "%8.5" ECU_ADDRESS 0x382632 /end MEASUREMENT
/begin MEASUREMENT dmlsdu_w "Delta Moment Ende Lastschlagdämpfung" UWORD rel_uw_b100 1 100 0 99.9985 FORMAT "%8.5" ECU_ADDRESS 0x382634 /end MEASUREMENT
/begin MEASUREMENT dmresll_w "erhöhte Momentenreserve im LL nach Drehzahleinbruch" UWORD rel_uw_b100 1 100 0 99.9985 FORMAT "%8.5" ECU_ADDRESS 0x382582 /end MEASUREMENT
/begin MEASUREMENT dmrfawe_w "Schwelle mrfa-Gradient für Deaktivierung PT1-Filter beim Wiedereinsetzen" UWORD rel_uw_b200 1 100 0 199.997 FORMAT "%8.4" ECU_ADDRESS 0x382636 /end MEASUREMENT
/begin MEASUREMENT dmrkt_w "Momentenreserve im Kurztrip" UWORD rel_uw_b100 1 100 0 99.9985 FORMAT "%8.5" ECU_ADDRESS 0x384C5C /end MEASUREMENT
/begin MEASUREMENT dmrllr_w "Momenten-Reserve für Leerlaufregelung" UWORD rel_uw_b100 1 100 0 99.9985 FORMAT "%8.5" ECU_ADDRESS 0x382584 /end MEASUREMENT
/begin MEASUREMENT dmrmx_w "Delta-Moment Füllung durch Momentenreserve" UWORD rel_uw_b100 1 100 0 99.9985 FORMAT "%8.5" ECU_ADDRESS 0x38269E /end MEASUREMENT
/begin MEASUREMENT dmrnwa_w "Momentenreserve zum Umschalten der Auslaßnockenwelle" UWORD rel_uw_b100 1 100 0 99.9985 FORMAT "%8.5" ECU_ADDRESS 0x382586 /end MEASUREMENT
/begin MEASUREMENT dmrnwe_w "Momentenreserve zum Umschalten der Einlaßnockenwelle" UWORD rel_uw_b100 1 100 0 99.9985 FORMAT "%8.5" ECU_ADDRESS 0x382588 /end MEASUREMENT
/begin MEASUREMENT dmrnw_w "Momentenreserve zum Umschalten der Nockenwelle" UWORD rel_uw_b100 1 100 0 99.9985 FORMAT "%8.5" ECU_ADDRESS 0x38258A /end MEASUREMENT
/begin MEASUREMENT dmvllrsu_w "Momentenreserve im Nachstart" UWORD rel_uw_b100 1 100 0 99.9985 FORMAT "%8.5" ECU_ADDRESS 0x38258C /end MEASUREMENT
/begin MEASUREMENT dmzms_w "Abstand des indizierten Sollmoments vom zulässigen Sollmoment" SWORD rel_sw_b100 1 100 -100 99.9969 FORMAT "%8.4" ECU_ADDRESS 0x382686 /end MEASUREMENT
/begin MEASUREMENT dn "Drehzahlabweichung bei Leerlaufregelung" SBYTE nmotd_sb_q10 1 100 -1280 1270 FORMAT "%5.0" ECU_ADDRESS 0x380AB7 /end MEASUREMENT
/begin MEASUREMENT dnbi_w "Verhältnis nsol_w / nmotbi_w" SWORD nmot_sw_q0p25 1 100 -8192 8191.75 FORMAT "%8.3" ECU_ADDRESS 0x382512 /end MEASUREMENT
/begin MEASUREMENT dnikorr_w "Korrekturwert auf den Integrator nach Diagnose" UWORD nmot_uw_q0p25 1 100 0 16383.8 FORMAT "%8.2" ECU_ADDRESS 0x382514 /end MEASUREMENT
/begin MEASUREMENT dns "LLR: Drehzahlabweichung zur stationären Solldrehzahl" SBYTE nmotd_sb_q10 1 100 -1280 1270 FORMAT "%5.0" ECU_ADDRESS 0x380AA8 /end MEASUREMENT
/begin MEASUREMENT dn_w "Drehzahlabweichung bei Leerlaufregelung" SWORD nmot_sw_q0p25 1 100 -8192 8191.75 FORMAT "%8.3" ECU_ADDRESS 0x382516 /end MEASUREMENT
/begin MEASUREMENT drlsolf_w "gefilterte Änderung Sollfüllung" SWORD rel_sw_q0p0234 1 100 -768 767.977 FORMAT "%8.4" ECU_ADDRESS 0x38202E /end MEASUREMENT
/begin MEASUREMENT drlsol_w "Änderung Sollfüllung" SWORD rel_sw_q0p0234 1 100 -768 767.977 FORMAT "%8.4" ECU_ADDRESS 0x382030 /end MEASUREMENT
/begin MEASUREMENT dzwb "Differenz BasisZW optimaler Zündwinkel" SBYTE zw_sb_q0p75 1 100 -96 95.25 FORMAT "%5.2" ECU_ADDRESS 0x380ACE /end MEASUREMENT
/begin MEASUREMENT dzwi "Delta Zündwinkel zwischen zwopt und zwout" SBYTE zw_sb_q0p75 1 100 -96 95.25 FORMAT "%5.2" ECU_ADDRESS 0x380ADA /end MEASUREMENT
/begin MEASUREMENT dzwoag "abgasrückführratenabh. Zündwinkelkorrektur des optimalen ZW" SBYTE zw_sb_q0p75 1 100 -96 95.25 FORMAT "%5.2" ECU_ADDRESS 0x380ACF /end MEASUREMENT
/begin MEASUREMENT dzwol "lambdaabh. Zündwinkelkorrektur des optimalen ZW" SBYTE zw_sb_q0p75 1 100 -96 95.25 FORMAT "%5.2" ECU_ADDRESS 0x380AD0 /end MEASUREMENT
/begin MEASUREMENT dzwotm "temperaturabhängige Zündwinkelkorrektur des optimalen ZW" SBYTE zw_sb_q0p75 1 100 -96 95.25 FORMAT "%5.2" ECU_ADDRESS 0x380AD1 /end MEASUREMENT
/begin MEASUREMENT dzw_kge "Eingang Delta-Zündwinkel für mehrfach verwendete Kenngrößen" SBYTE zw_sb_q0p75 1 100 -96 95.25 FORMAT "%5.2" ECU_ADDRESS 0x380AD2 /end MEASUREMENT
/begin MEASUREMENT esst_sdn10llsw "" UWORD dez 1 100 0 65535 FORMAT "%8.2" ECU_ADDRESS 0x382518 /end MEASUREMENT
/begin MEASUREMENT esst_sez04llub "" UWORD dez 1 100 0 65535 FORMAT "%8.2" ECU_ADDRESS 0x38251A /end MEASUREMENT
/begin MEASUREMENT esst_sga08llub "" UWORD dez 1 100 0 65535 FORMAT "%8.2" ECU_ADDRESS 0x384C0C /end MEASUREMENT
/begin MEASUREMENT esst_snm12mduw "" UWORD dez 1 100 0 65535 FORMAT "%8.2" ECU_ADDRESS 0x382638 /end MEASUREMENT
/begin MEASUREMENT esst_sns06llsb "" UWORD dez 1 100 0 65535 FORMAT "%8.2" ECU_ADDRESS 0x3824E0 /end MEASUREMENT
/begin MEASUREMENT esst_sns206llsb "" UWORD dez 1 100 0 65535 FORMAT "%8.2" ECU_ADDRESS 0x38251C /end MEASUREMENT
/begin MEASUREMENT esst_srl11opuw "" UWORD dez 1 100 0 65535 FORMAT "%8.2" ECU_ADDRESS 0x3826A8 /end MEASUREMENT
/begin MEASUREMENT esst_swp16mduw "" UWORD dez 1 100 0 65535 FORMAT "%8.2" ECU_ADDRESS 0x38263A /end MEASUREMENT
/begin MEASUREMENT etalab "Lambda-Wirkungsgrad ohne Eingriff bezogen auf optimales Moment bei Lambda=1" UBYTE rel_ub_b127p5 1 100 0 127.5 FORMAT "%5.1" ECU_ADDRESS 0x380AD3 /end MEASUREMENT
/begin MEASUREMENT etatrmn "minimaler Wert in der Wirkungsgradtrommel" UBYTE rel_ub_b127p5 1 100 0 127.5 FORMAT "%5.1" ECU_ADDRESS 0x380AD4 /end MEASUREMENT
/begin MEASUREMENT etazaist "Ist-Zylinderausblendungswirkungsgrad" UBYTE rel_ub_b127p5 1 100 0 127.5 FORMAT "%5.1" ECU_ADDRESS 0x380ADB /end MEASUREMENT
/begin MEASUREMENT etazwb "Zündwinkelwirkungsgrad des Basiszündwinkels" UBYTE rel_ub_b127p5 1 100 0 127.5 FORMAT "%5.1" ECU_ADDRESS 0x380AD5 /end MEASUREMENT
/begin MEASUREMENT etazwbm "gemittelter Zündwinkelwirkungsgrad des Basiszündwinkels" UBYTE rel_ub_b127p5 1 100 0 127.5 FORMAT "%5.1" ECU_ADDRESS 0x380AD6 /end MEASUREMENT
/begin MEASUREMENT etazwist "Ist-Zündwinkelwirkungsgrad" UBYTE rel_ub_b127p5 1 100 0 127.5 FORMAT "%5.1" ECU_ADDRESS 0x380ADC /end MEASUREMENT
/begin MEASUREMENT favkatmx "Gewichtungsfaktor Sauerstoffspeicher über avkatf" UBYTE fak_ub_b1 1 100 0 0.996094 ECU_ADDRESS 0x3848EE /end MEASUREMENT
/begin MEASUREMENT fkfped "Faktor für Interpolation zwischen den beiden Pedalkennfeldern" UBYTE fak_ub_b2 1 100 0 1.99219 FORMAT "%5.3" ECU_ADDRESS 0x380AC9 /end MEASUREMENT
/begin MEASUREMENT flglrs "CARB FREEZE FRAME Byte, Bank 1, für LR" UBYTE dez 1 100 0 255 FORMAT "%5.1" ECU_ADDRESS 0x380B29 /end MEASUREMENT
/begin MEASUREMENT fnstab_w "Faktor zur Stabilisierung mittels Drehzahlquotient" UWORD fak_uw_b8 1 100 0 7.99988 FORMAT "%8.6" ECU_ADDRESS 0x384C22 /end MEASUREMENT
/begin MEASUREMENT frao2_w "multipl. Gemischadaptionsfaktor oberer Lastbereich Bank 2 (Word)" UWORD fak_uw_b2 1 100 0 1.99997 FORMAT "%8.6" ECU_ADDRESS 0x384B06 /end MEASUREMENT
/begin MEASUREMENT fraolt_w "multiplikative Gemischkorrektur  frao von dem letzten Trip" UWORD fak_uw_b2 1 100 0 1.99997 FORMAT "%8.6" ECU_ADDRESS 0x384B08 /end MEASUREMENT
/begin MEASUREMENT frao_w "multiplikativer Gemischadaptionsfaktor oberer Lastbereich (Word)" UWORD fak_uw_b2 1 100 0 1.99997 FORMAT "%8.6" ECU_ADDRESS 0x384B0A /end MEASUREMENT
/begin MEASUREMENT frat2_w "temperaturabhängiger Gemischadaptionsfaktor (2. Bank)" UWORD fak_uw_b2 1 100 0 1.99997 FORMAT "%8.6" ECU_ADDRESS 0x384B0C /end MEASUREMENT
/begin MEASUREMENT frati_w "temperaturabhängiger Gemischadaptionsfaktor Integralwert" UWORD fak_uw_b2 1 100 0 1.99997 FORMAT "%8.6" ECU_ADDRESS 0x384B0E /end MEASUREMENT
/begin MEASUREMENT frat_w "temperaturabhängiger Gemischadaptionsfaktor" UWORD fak_uw_b2 1 100 0 1.99997 FORMAT "%8.6" ECU_ADDRESS 0x384B10 /end MEASUREMENT
/begin MEASUREMENT frau2_w "multipl. Gemischadaptionsfaktor unterer mult. Bereich der Bank 2 (Word)" UWORD fak_uw_b2 1 100 0 1.99997 FORMAT "%8.6" ECU_ADDRESS 0x384B12 /end MEASUREMENT
/begin MEASUREMENT frault_w "multiplikative Gemischkorrektur  frau von dem letzten Trip" UWORD fak_uw_b2 1 100 0 1.99997 FORMAT "%8.6" ECU_ADDRESS 0x384B14 /end MEASUREMENT
/begin MEASUREMENT frau_w "multiplikativer Gemischadaptionsfaktor unterer mult. Bereich (Word)" UWORD fak_uw_b2 1 100 0 1.99997 FORMAT "%8.6" ECU_ADDRESS 0x384B16 /end MEASUREMENT
/begin MEASUREMENT fra_w "multiplikative Gemischkorrektur der Gemischadaption (Word)" UWORD fak_uw_b2 1 100 0 1.99997 FORMAT "%8.6" ECU_ADDRESS 0x3820EA /end MEASUREMENT
/begin MEASUREMENT frini2_w "Initialisierungswert für Regelfaktor Lambdaregelung, Bank 2" UWORD fak_uw_b2 1 100 0 1.99997 FORMAT "%8.6" ECU_ADDRESS 0x3829EC /end MEASUREMENT
/begin MEASUREMENT frini_w "Initialisierungswert für Regelfaktor Lambdaregelung" UWORD fak_uw_b2 1 100 0 1.99997 FORMAT "%8.6" ECU_ADDRESS 0x3829EE /end MEASUREMENT
/begin MEASUREMENT frmn_w "Lambda-Regler-Ausgang Minimalwert" UWORD fak_uw_b2 1 100 0 1.99997 FORMAT "%8.6" ECU_ADDRESS 0x382914 /end MEASUREMENT
/begin MEASUREMENT frmx_w "LR mit Integratorstop : Max. Begrenzung Integrator fr,; FRMAX / angehoben d.DSLS" UWORD fak_uw_b2 1 100 0 1.99997 FORMAT "%8.6" ECU_ADDRESS 0x382916 /end MEASUREMENT
/begin MEASUREMENT frm_w "schneller Mittelwert des Lambdaregelfaktors (Word)" UWORD fak_uw_b2 1 100 0 1.99997 FORMAT "%8.6" ECU_ADDRESS 0x382918 /end MEASUREMENT
/begin MEASUREMENT froza_w "Lambda-Regler-Ausgang ohne Zwangsanregung" UWORD fak_uw_b2 1 100 0 1.99997 FORMAT "%8.6" ECU_ADDRESS 0x38291A /end MEASUREMENT
/begin MEASUREMENT frtmki "Regelfaktor für Momentenbegrenzung aus Motortemperatur" UBYTE fak_ub_b2 1 100 0 1.99219 FORMAT "%5.3" ECU_ADDRESS 0x3848EB /end MEASUREMENT
/begin MEASUREMENT fr_w "Lambda-Regler-Ausgang (Word)" UWORD fak_uw_b2 1 100 0 1.99997 FORMAT "%8.6" ECU_ADDRESS 0x38291C /end MEASUREMENT
/begin MEASUREMENT ftklra_w "Korrekturfaktor für temperaturabhängigen Adaptionsfaktor" UWORD fak_uw_b2 1 100 0 1.99997 FORMAT "%8.6" ECU_ADDRESS 0x384B18 /end MEASUREMENT
/begin MEASUREMENT fwmifal "Überhöhungsfaktor Füllungspfad bei Lastschlagdämpfung" UBYTE fak_ub_b4 1 100 0 3.98438 FORMAT "%5.3" ECU_ADDRESS 0x3848E5 /end MEASUREMENT
/begin MEASUREMENT fwzlsd "Reduktionsfaktor Zeitkonstante Lastschlagdämpfung" UBYTE fak_ub_b4 1 100 0 3.98438 FORMAT "%5.3" ECU_ADDRESS 0x3848E6 /end MEASUREMENT
/begin MEASUREMENT fzdash "Faktor Zeitkonstante Dashpot" UBYTE rfak_q0p5 1 100 0.501961 128 FORMAT "%5.1" ECU_ADDRESS 0x3848E7 /end MEASUREMENT
/begin MEASUREMENT g1korr "Korrekturfaktor für Reglerparameter G1" UBYTE fak_ub_b2 1 100 0 1.99219 FORMAT "%5.3" ECU_ADDRESS 0x380B27 /end MEASUREMENT
/begin MEASUREMENT g2korr "Korrekturfaktor für Reglerparameter G2" UBYTE fak_ub_b2 1 100 0 1.99219 FORMAT "%5.3" ECU_ADDRESS 0x3848EC /end MEASUREMENT
/begin MEASUREMENT gangllr "Ganginformation zur Berechnung der Leerlaufdrehzahl" UBYTE dez 1 100 0 255 FORMAT "%5.1" ECU_ADDRESS 0x3848DC /end MEASUREMENT
/begin MEASUREMENT iftkavx_w "Fettflächenschwelle = f(tkivkm_w,Alterungsfaktor, [tkihkm_w])" UWORD m_uw_b291p25 1 100 0 291.267 FORMAT "%8.4" ECU_ADDRESS 0x385320 /end MEASUREMENT
/begin MEASUREMENT ilmlka_w "Integrator Fettfläche für Katalysator-Ausräumen" UWORD m_uw_b4660 1 100 0 4660.27 FORMAT "%8.3" ECU_ADDRESS 0xFA0A /end MEASUREMENT
/begin MEASUREMENT ilmltkx_w "Ausgang Kennlinie ILMLKAXTK" UWORD m_uw_b291p25 1 100 0 291.267 FORMAT "%8.4" ECU_ADDRESS 0x385322 /end MEASUREMENT
/begin MEASUREMENT imlevab_w "Luftmasse nach Zylinderausblendung für stetige Lambdaregelung" UWORD m_uw_b4660 1 100 0 4660.27 FORMAT "%8.3" ECU_ADDRESS 0x3829A2 /end MEASUREMENT
/begin MEASUREMENT imlka_w "Integrator Luftmasse für Katalysator-Ausräumen" UWORD m_uw_b291p25 1 100 0 291.267 FORMAT "%8.4" ECU_ADDRESS 0xFA0C /end MEASUREMENT
/begin MEASUREMENT imllaka_w "Integrator Fettfläche für Katalysator-Ausräumen" UWORD m_uw_b291p25 1 100 0 291.267 FORMAT "%8.4" ECU_ADDRESS 0xFA0E /end MEASUREMENT
/begin MEASUREMENT imlrsa_w "Luftmasse nach SA für stetige Lambdaregelung" UWORD m_uw_b4660 1 100 0 4660.27 FORMAT "%8.3" ECU_ADDRESS 0x3829A4 /end MEASUREMENT
/begin MEASUREMENT iver "Integratorverstärkung" UBYTE rel_q0p002383 1 100 0 0.607617 ECU_ADDRESS 0x380AB8 /end MEASUREMENT
/begin MEASUREMENT ladiff_w "Regelabweichung Lambda" SWORD fak_sw_b1 1 100 -1 0.999969 FORMAT "%8.6" ECU_ADDRESS 0x38291E /end MEASUREMENT
/begin MEASUREMENT lahkmz "Zustandsbyte des Automaten: fr-synchrone Mittelung Pseodo-Lambda hinter Kat" UBYTE dez 1 100 0 255 FORMAT "%5.1" ECU_ADDRESS 0x380B2B /end MEASUREMENT
/begin MEASUREMENT lamhf_w "Pseudolinearisietes Lambda hinter Kat, PT1-gefiltert, Word" UWORD fak_uw_b16 1 100 0 15.9998 FORMAT "%8.5" ECU_ADDRESS 0x3829CE /end MEASUREMENT
/begin MEASUREMENT lamhm_w "fr-synchron gemittelter Pseudo Lambda-Istwert gem. mit Nernst-Sonde h.Kat, Word" UWORD fak_uw_b16 1 100 0 15.9998 FORMAT "%8.5" ECU_ADDRESS 0x3829D0 /end MEASUREMENT
/begin MEASUREMENT lamka_w "Lambdasollwert Katausräumen" UWORD fak_uw_b16 1 100 0 15.9998 FORMAT "%8.5" ECU_ADDRESS 0xFA10 /end MEASUREMENT
/begin MEASUREMENT lamsbgt_w "Lambdasoll bezogen auf Brennraum, totzeitverschoben" UWORD fak_uw_b16 1 100 0 15.9998 FORMAT "%8.5" ECU_ADDRESS 0x382920 /end MEASUREMENT
/begin MEASUREMENT lamsbpr_w "Lambda-Soll-Wert vor Begrenzung nach unten" UWORD fak_uw_b16 1 100 0 15.9998 FORMAT "%8.5" ECU_ADDRESS 0x382922 /end MEASUREMENT
/begin MEASUREMENT lamsolh_w "Pseudo Lambda-Sollwert hinter Kat" UWORD fak_uw_b16 1 100 0 15.9998 FORMAT "%8.5" ECU_ADDRESS 0x3829D2 /end MEASUREMENT
/begin MEASUREMENT lamsonh_w "Pseudo Lambda-Istwert gemessen mit Nernst-Sonde hinter Kat (word)" UWORD fak_uw_b16 1 100 0 15.9998 FORMAT "%8.5" ECU_ADDRESS 0x3829D4 /end MEASUREMENT
/begin MEASUREMENT lamzak_w "Lambdasondenistwert, korrigiert um Zusatzamplitude" UWORD fak_uw_b16 1 100 0 15.9998 FORMAT "%8.5" ECU_ADDRESS 0x382924 /end MEASUREMENT
/begin MEASUREMENT lamzapr_w "Lambda-Ist-Wert bereinigt um Zwangsamplitude vor Begrenzung nach unten" UWORD fak_uw_b16 1 100 0 15.9998 FORMAT "%8.5" ECU_ADDRESS 0x382926 /end MEASUREMENT
/begin MEASUREMENT limax_w "LLR-Integrator-Maximalwert" SWORD rel_sw_b100 1 100 -100 99.9969 FORMAT "%8.4" ECU_ADDRESS 0x38251E /end MEASUREMENT
/begin MEASUREMENT limin_w "LLR-Integrator-Minimalwert" SWORD rel_sw_b100 1 100 -100 99.9969 FORMAT "%8.4" ECU_ADDRESS 0x382520 /end MEASUREMENT
/begin MEASUREMENT limnst "LLR-Integrator-Minimalwert während Nachstart" UBYTE rel_ub_b24p9 1 100 0 24.9 FORMAT "%5.2" ECU_ADDRESS 0x380AB9 /end MEASUREMENT
/begin MEASUREMENT llrnfalokbits "" UBYTE dez 1 100 0 255 FORMAT "%5.1" ECU_ADDRESS 0x380AC0 /end MEASUREMENT
/begin MEASUREMENT lrkaz "Zustandsbyte des Automaten Kat-Ausräumen" UBYTE dez 1 100 0 255 FORMAT "%5.1" ECU_ADDRESS 0xFA08 /end MEASUREMENT
/begin MEASUREMENT lrsg1_w "Interner Reglerkoeffizient stetige Lambdaregelung" SWORD fak_sw_b32 1 100 -32 31.999 FORMAT "%8.5" ECU_ADDRESS 0x382928 /end MEASUREMENT
/begin MEASUREMENT lrsg2_w "Interner Reglerkoeffizient stetige Lambdaregelung" UWORD fak_uw_b64 1 100 0 63.999 FORMAT "%8.5" ECU_ADDRESS 0x38292A /end MEASUREMENT
/begin MEASUREMENT lrsg4_w "Interner Reglerkoeffizient stetige Lambdaregelung" SWORD fak_sw_b2 1 100 -2 1.99994 FORMAT "%8.6" ECU_ADDRESS 0x38292C /end MEASUREMENT
/begin MEASUREMENT LRSHKlokbits1 "" UBYTE dez 1 100 0 255 FORMAT "%5.1" ECU_ADDRESS 0x380B2C /end MEASUREMENT
/begin MEASUREMENT lrskaBits1_20ms "" UBYTE dez 1 100 0 255 FORMAT "%5.1" ECU_ADDRESS 0x380B2E /end MEASUREMENT
/begin MEASUREMENT lrskaBits_20ms "" UBYTE dez 1 100 0 255 FORMAT "%5.1" ECU_ADDRESS 0x380B2F /end MEASUREMENT
/begin MEASUREMENT lrsp1_w "Interner Reglerkoeffizient stetige Lambdaregelung" UWORD fak_uw_b128 1 100 0 127.998 FORMAT "%8.4" ECU_ADDRESS 0x38292E /end MEASUREMENT
/begin MEASUREMENT lrsp2_w "Interner Reglerkoeffizient stetige Lambdaregelung" UWORD fak_uw_b128 1 100 0 127.998 FORMAT "%8.4" ECU_ADDRESS 0x382930 /end MEASUREMENT
/begin MEASUREMENT lrsp3_w "Interner Reglerkoeffizient stetige Lambdaregelung" UWORD fak_uw_b128 1 100 0 127.998 FORMAT "%8.4" ECU_ADDRESS 0x382932 /end MEASUREMENT
/begin MEASUREMENT lrsp4_w "Interner Reglerkoeffizient stetige Lambdaregelung" SWORD fak_sw_b64 1 100 -64 63.998 FORMAT "%8.5" ECU_ADDRESS 0x382934 /end MEASUREMENT
/begin MEASUREMENT lrsw1_w "Interner Reglerzustand stetige Lambdaregelung" SWORD fak_sw_b4 1 100 -4 3.99988 FORMAT "%8.6" ECU_ADDRESS 0x382936 /end MEASUREMENT
/begin MEASUREMENT lrsw2_w "Interner Reglerzustand stetige Lambdaregelung" SWORD fak_sw_b4 1 100 -4 3.99988 FORMAT "%8.6" ECU_ADDRESS 0x382938 /end MEASUREMENT
/begin MEASUREMENT lrsxk1_w "Interner Reglerzustand stetige Lambdaregelung" SWORD fak_sw_b1 1 100 -1 0.999969 FORMAT "%8.6" ECU_ADDRESS 0x38293A /end MEASUREMENT
/begin MEASUREMENT lrsxk3_w "Interner Reglerzustand stetige Lambdaregelung" SWORD fak_sw_b1 1 100 -1 0.999969 FORMAT "%8.6" ECU_ADDRESS 0x38293C /end MEASUREMENT
/begin MEASUREMENT lrsxk4_w "Interner Reglerzustand stetige Lambdaregelung" SWORD fak_sw_b1 1 100 -1 0.999969 FORMAT "%8.6" ECU_ADDRESS 0x38293E /end MEASUREMENT
/begin MEASUREMENT lrsy2_w "Interner Reglerzustand stetige Lambdaregelung" SWORD fak_sw_b1 1 100 -1 0.999969 FORMAT "%8.6" ECU_ADDRESS 0x382940 /end MEASUREMENT
/begin MEASUREMENT lrsy4_w "Interner Reglerzustand stetige Lambdaregelung" SWORD fak_sw_b8 1 100 -8 7.99976 FORMAT "%8.6" ECU_ADDRESS 0x382942 /end MEASUREMENT
/begin MEASUREMENT lrsza "Amplitude erzwungener Lambdamodulation" UBYTE fak_ub_b0p25 1 100 0 0.249023 FORMAT "%11.9" ECU_ADDRESS 0x3848ED /end MEASUREMENT
/begin MEASUREMENT MDBGRGlokbits "" UBYTE dez 1 100 0 255 FORMAT "%5.1" ECU_ADDRESS 0x380AE4 /end MEASUREMENT
/begin MEASUREMENT MDFAWlokbits "" UBYTE dez 1 100 0 255 FORMAT "%5.1" ECU_ADDRESS 0x380ACA /end MEASUREMENT
/begin MEASUREMENT mdfaw_bits "Flagbyte für %MDFAW" UBYTE dez 1 100 0 255 FORMAT "%5.1" ECU_ADDRESS 0x380ACB /end MEASUREMENT
/begin MEASUREMENT mdindg_w "indiziertes Motormoment Hochdruckphase wenn alle Zylinder befeuert" UWORD rel_uw_b100 1 100 0 99.9985 FORMAT "%8.5" ECU_ADDRESS 0x3826D0 /end MEASUREMENT
/begin MEASUREMENT miautget_w "Motormoment ohne Getriebeeingriff" UWORD rel_uw_b100 1 100 0 99.9985 FORMAT "%8.5" ECU_ADDRESS 0x38270E /end MEASUREMENT
/begin MEASUREMENT miautgs_w "Motorsollmoment ohne Getriebeeingriff" UWORD rel_uw_b100 1 100 0 99.9985 FORMAT "%8.5" ECU_ADDRESS 0x382710 /end MEASUREMENT
/begin MEASUREMENT mibas_w "indiziertes Basis-Moment" UWORD rel_uw_b100 1 100 0 99.9985 FORMAT "%8.5" ECU_ADDRESS 0x3826AA /end MEASUREMENT
/begin MEASUREMENT mibdp_w "indiziertes Soll-Motormoment Dashpot" UWORD rel_uw_b100 1 100 0 99.9985 FORMAT "%8.5" ECU_ADDRESS 0x38263C /end MEASUREMENT
/begin MEASUREMENT mibeg_w "Begrenzungsmoment" UWORD rel_uw_b100 1 100 0 99.9985 FORMAT "%8.5" ECU_ADDRESS 0x382688 /end MEASUREMENT
/begin MEASUREMENT mibgrl_w "indiziertes soll-Moment für Momentbegrenzung Luftpfad" UWORD rel_uw_b100 1 100 0 99.9985 FORMAT "%8.5" ECU_ADDRESS 0x384C54 /end MEASUREMENT
/begin MEASUREMENT mibgr_w "begrenztes soll-Moment" UWORD rel_uw_b100 1 100 0 99.9985 FORMAT "%8.5" ECU_ADDRESS 0x384C56 /end MEASUREMENT
/begin MEASUREMENT miblsd_w "Begrenztes indiziertes Moment aus Lastschlagdämpfung" UWORD rel_uw_b100 1 100 0 99.9985 FORMAT "%8.5" ECU_ADDRESS 0x38263E /end MEASUREMENT
/begin MEASUREMENT mibrmx_w "Maximal zulässiges Moment bei betätigter Bremse" UWORD rel_uw_b100 1 100 0 99.9985 FORMAT "%8.5" ECU_ADDRESS 0x384C58 /end MEASUREMENT
/begin MEASUREMENT miextv_w "von extern gefordertes Moment vor Abwürgeschutz" UWORD rel_uw_b100 1 100 0 99.9985 FORMAT "%8.5" ECU_ADDRESS 0x38268A /end MEASUREMENT
/begin MEASUREMENT miext_w "von außen (ASR, GS, usw.) angefordertes indiziertes Motormoment" UWORD rel_uw_b100 1 100 0 99.9985 FORMAT "%8.5" ECU_ADDRESS 0x38268C /end MEASUREMENT
/begin MEASUREMENT mifa "indiziertes Motormoment Fahrerwunsch" UBYTE rel_ub_b99p6 1 100 0 99.6094 FORMAT "%5.2" ECU_ADDRESS 0x380ACC /end MEASUREMENT
/begin MEASUREMENT mifabg_w "Gradientenbegrenztes Fahrerwunschmoment" UWORD rel_uw_b100 1 100 0 99.9985 FORMAT "%8.5" ECU_ADDRESS 0x382640 /end MEASUREMENT
/begin MEASUREMENT mifab_w "Begrenztes indiziertes Fahrerwunschmoment" UWORD rel_uw_b100 1 100 0 99.9985 FORMAT "%8.5" ECU_ADDRESS 0x38268E /end MEASUREMENT
/begin MEASUREMENT mifafu_w "Fahrermomentenwunsch für Füllung" UWORD rel_uw_b100 1 100 0 99.9985 FORMAT "%8.5" ECU_ADDRESS 0x3826A0 /end MEASUREMENT
/begin MEASUREMENT mifal_w "Indiziertes Fahrerwunschmoment für Momentenkoordination Füllung" UWORD rel_uw_b100 1 100 0 99.9985 FORMAT "%8.5" ECU_ADDRESS 0x382642 /end MEASUREMENT
/begin MEASUREMENT mifa_w "indiziertes Motormoment Fahrerwunsch" UWORD rel_uw_b100 1 100 0 99.9985 FORMAT "%8.5" ECU_ADDRESS 0x382644 /end MEASUREMENT
/begin MEASUREMENT migef_w "Gefiltertes indiziertes Fahrerwunschmoment" UWORD rel_uw_b100 1 100 0 99.9985 FORMAT "%8.5" ECU_ADDRESS 0x382646 /end MEASUREMENT
/begin MEASUREMENT miistoar_w "Istmoment ohne Antiruckel-Anteil" UWORD rel_uw_b100 1 100 0 99.9985 FORMAT "%8.5" ECU_ADDRESS 0x382712 /end MEASUREMENT
/begin MEASUREMENT miist_w "indiziertes Motormoment Hochdruckphase Istwert" UWORD rel_uw_b100 1 100 0 99.9985 FORMAT "%8.5" ECU_ADDRESS 0x3826D2 /end MEASUREMENT
/begin MEASUREMENT mill_w "Indiziertes Motormoment im Leerlauf" UWORD rel_uw_b100 1 100 0 99.9985 FORMAT "%8.5" ECU_ADDRESS 0x382594 /end MEASUREMENT
/begin MEASUREMENT milres_w "Momentenanforderung für Luftpfad mit allen Reserven" UWORD rel_uw_b100 1 100 0 99.9985 FORMAT "%8.5" ECU_ADDRESS 0x3826A2 /end MEASUREMENT
/begin MEASUREMENT milsolv_w "Sollmoment für Füllungspfad vor Momentenbegrenzung" UWORD rel_uw_b100 1 100 0 99.9985 FORMAT "%8.5" ECU_ADDRESS 0x3826A4 /end MEASUREMENT
/begin MEASUREMENT milsol_w "koordiniertes Moment für Füllung" UWORD rel_uw_b100 1 100 0 99.9985 FORMAT "%8.5" ECU_ADDRESS 0x3826A6 /end MEASUREMENT
/begin MEASUREMENT mimax_w "maximal erreichbares indiziertes Moment" UWORD rel_uw_b100 1 100 0 99.9985 FORMAT "%8.5" ECU_ADDRESS 0x384C30 /end MEASUREMENT
/begin MEASUREMENT miminds_w "gewichtetes Verlustmoment bei ASG" UWORD rel_uw_b100 1 100 0 99.9985 FORMAT "%8.5" ECU_ADDRESS 0x382596 /end MEASUREMENT
/begin MEASUREMENT mimins_w "minimales Schubmoment" UWORD rel_uw_b100 1 100 0 99.9985 FORMAT "%8.5" ECU_ADDRESS 0x382598 /end MEASUREMENT
/begin MEASUREMENT mimin_w "Minimales Motor-Moment" UWORD rel_uw_b100 1 100 0 99.9985 FORMAT "%8.5" ECU_ADDRESS 0x38259A /end MEASUREMENT
/begin MEASUREMENT mimxl1_w "Maximales optimales Moment bei Lambda = 1" UWORD rel_uw_b100 1 100 0 99.9985 FORMAT "%8.5" ECU_ADDRESS 0x384C32 /end MEASUREMENT
/begin MEASUREMENT minbeg_w "Indiziertes Fahrerwunschmoment nach Änderungsbegrenzung" UWORD rel_uw_b100 1 100 0 99.9985 FORMAT "%8.5" ECU_ADDRESS 0x382648 /end MEASUREMENT
/begin MEASUREMENT mioptl1_w "optimales indiziertes Motormoment bei Lambda = 1" UWORD rel_uw_b100 1 100 0 99.9985 FORMAT "%8.5" ECU_ADDRESS 0x3826AC /end MEASUREMENT
/begin MEASUREMENT miopt_w "optimales indiziertes Moment" UWORD rel_uw_b100 1 100 0 99.9985 FORMAT "%8.5" ECU_ADDRESS 0x3826AE /end MEASUREMENT
/begin MEASUREMENT misolv_w "Indiziertes resultierendes Sollmoment vor Momentenbegrenzung" UWORD rel_uw_b100 1 100 0 99.9985 FORMAT "%8.5" ECU_ADDRESS 0x382690 /end MEASUREMENT
/begin MEASUREMENT misol_w "Indiziertes resultierendes Sollmoment" UWORD rel_uw_b100 1 100 0 99.9985 FORMAT "%8.5" ECU_ADDRESS 0xF9E4 /end MEASUREMENT
/begin MEASUREMENT misopl1_w "Solluftmoment, rückgerechnet auf Lambda=1 und zwopt" UWORD rel_uw_b100 1 100 0 99.9985 FORMAT "%8.5" ECU_ADDRESS 0x382032 /end MEASUREMENT
/begin MEASUREMENT mitmbgr_w "Momentenbegrenzung durch erhöhte Motortemperatur" UWORD rel_uw_b100 1 100 0 99.9985 FORMAT "%8.5" ECU_ADDRESS 0x384C5A /end MEASUREMENT
/begin MEASUREMENT mivbeb_w "Indiziertes Moment vor Änderungsbegrenzung, nach oben auf mimax_w begrenzt" UWORD rel_uw_b100 1 100 0 99.9985 FORMAT "%8.5" ECU_ADDRESS 0x38264A /end MEASUREMENT
/begin MEASUREMENT mivbegv_w "Indiziertes Fahrerwunschmoment vor Maximalbegrenzung" UWORD rel_uw_b100 1 100 0 99.9985 FORMAT "%8.5" ECU_ADDRESS 0x38264C /end MEASUREMENT
/begin MEASUREMENT mivbeg_w "inidziertes Fahrerwunschmoment vor Änderungsbegrenzung" UWORD rel_uw_b100 1 100 0 99.9985 FORMAT "%8.5" ECU_ADDRESS 0x38264E /end MEASUREMENT
/begin MEASUREMENT mizsolv_w "Indiziertes resultierendes Sollmoment für ZW-Eingriff vor Momentenbegrenzung" UWORD rel_uw_b100 1 100 0 99.9985 FORMAT "%8.5" ECU_ADDRESS 0x382692 /end MEASUREMENT
/begin MEASUREMENT mizsol_w "Indiziertes resultierendes Sollmoment für ZW-Eingriff" UWORD rel_uw_b100 1 100 0 99.9985 FORMAT "%8.5" ECU_ADDRESS 0x382694 /end MEASUREMENT
/begin MEASUREMENT mizwmn_w "indiziertes Motormoment beim spätesten Zündwinkel" UWORD rel_uw_b100 1 100 0 99.9985 FORMAT "%8.5" ECU_ADDRESS 0x3826F8 /end MEASUREMENT
/begin MEASUREMENT mkfadpn_w "Kupplungsmoment für Umschaltung Dashpot-Filterzeit" SWORD rel_sw_b100 1 100 -100 99.9969 FORMAT "%8.4" ECU_ADDRESS 0x382650 /end MEASUREMENT
/begin MEASUREMENT mkfanb_w "Kupplungsmoment aus begrenztem Fahrerwunsch" SWORD rel_sw_b100 1 100 -100 99.9969 FORMAT "%8.4" ECU_ADDRESS 0x382652 /end MEASUREMENT
/begin MEASUREMENT mkfa_w "Fahrerwunschmoment (Kupplung) nach Änderungsbegrenzung" SWORD rel_sw_b50 1 100 -50 49.9985 FORMAT "%8.5" ECU_ADDRESS 0x382654 /end MEASUREMENT
/begin MEASUREMENT mlnka_w "Luftmasse nach Kat-Ausräumen" UWORD m_uw_b7281 1 100 0 7281.67 FORMAT "%8.3" ECU_ADDRESS 0x3829D6 /end MEASUREMENT
/begin MEASUREMENT mrfamx_w "Relatives Fahrerwunschmoment Maximalwert" UWORD rel_uw_b200 1 100 0 199.997 FORMAT "%8.4" ECU_ADDRESS 0x384C2E /end MEASUREMENT
/begin MEASUREMENT mrfa_w "Relatives Fahrerwunschmoment aus FGR und Pedal" UWORD rel_uw_b200 1 100 0 199.997 FORMAT "%8.4" ECU_ADDRESS 0x382656 /end MEASUREMENT
/begin MEASUREMENT mrpedl_w "Relatives Fahrerwunschmoment aus Fahrpedal für kleine Geschwindigkeiten" UWORD rel_uw_b200 1 100 0 199.997 FORMAT "%8.4" ECU_ADDRESS 0x382658 /end MEASUREMENT
/begin MEASUREMENT mrpeds_w "Relatives Fahrerwunschmoment aus Fahrpedal für größere Geschwindigkeiten" UWORD rel_uw_b200 1 100 0 199.997 FORMAT "%8.4" ECU_ADDRESS 0x38265A /end MEASUREMENT
/begin MEASUREMENT mrped_w "relatives Fahrerwunschmoment aus Fahrpedal" UWORD rel_uw_b200 1 100 0 199.997 FORMAT "%8.4" ECU_ADDRESS 0x38265C /end MEASUREMENT
/begin MEASUREMENT nasnottm "Drehzahlschwelle wegen Abwürgeschutz als Funktion von tmot" UBYTE nmot_ub_q40 1 100 0 10200 FORMAT "%5.0" ECU_ADDRESS 0x380ACD /end MEASUREMENT
/begin MEASUREMENT ngasf_w "Drehzahlgradient über ein Arbeitsspiel (gefiltert)" SWORD nmotg_sw_q0p39 1 100 -12800.2 12799.8 FORMAT "%8.2" ECU_ADDRESS 0x382522 /end MEASUREMENT
/begin MEASUREMENT nllcvt2 "Drehzahlvorgabe aus CVT-Getriebe nach Begrenzung" UBYTE nmot_ub_q10 1 100 0 2550 FORMAT "%5.0" ECU_ADDRESS 0x380AA9 /end MEASUREMENT
/begin MEASUREMENT nsfsm "LLR: Motortemperaturabhängige Solldrehzahl im LL bei B_fs = 1" UBYTE nmot_ub_q10 1 100 0 2550 FORMAT "%5.0" ECU_ADDRESS 0x3848DD /end MEASUREMENT
/begin MEASUREMENT nsfsmn "LLR: Minimale Solldrehzahl bei eingelegter Fahrstufe" UBYTE nmot_ub_q10 1 100 0 2550 FORMAT "%5.0" ECU_ADDRESS 0x380AAA /end MEASUREMENT
/begin MEASUREMENT nslbz "Solldrehzahl abhängig von lbz" UBYTE nmot_ub_q10 1 100 0 2550 FORMAT "%5.0" ECU_ADDRESS 0x3848DE /end MEASUREMENT
/begin MEASUREMENT nslfa "Solldrehzahl bei Kurztrip" UBYTE nmot_ub_q10 1 100 0 2550 FORMAT "%5.0" ECU_ADDRESS 0x380AC1 /end MEASUREMENT
/begin MEASUREMENT nsllm "LLR: Motortemperaturabhängige Solldrehzahl im LL" UBYTE nmot_ub_q10 1 100 0 2550 FORMAT "%5.0" ECU_ADDRESS 0x3848DF /end MEASUREMENT
/begin MEASUREMENT nsllmn "LLR: Minimale Solldrehzahl im LL" UBYTE nmot_ub_q10 1 100 0 2550 FORMAT "%5.0" ECU_ADDRESS 0x380AAB /end MEASUREMENT
/begin MEASUREMENT nsnf "LLR: Nachgeführte Solldrehzahl" UBYTE nmot_ub_q10 1 100 0 2550 FORMAT "%5.0" ECU_ADDRESS 0x380AAC /end MEASUREMENT
/begin MEASUREMENT nsol "Leerlaufsolldrehzahl" UBYTE nmot_ub_q10 1 100 0 2550 FORMAT "%5.0" ECU_ADDRESS 0x380AAD /end MEASUREMENT
/begin MEASUREMENT nsol_w "Leerlaufsolldrehzahl" UWORD nmot_uw_q0p25 1 100 0 16383.8 FORMAT "%8.2" ECU_ADDRESS 0x3824E2 /end MEASUREMENT
/begin MEASUREMENT nsst "Initialisierungswert der Solldrehzahl im Start" UBYTE nmot_ub_q10 1 100 0 2550 FORMAT "%5.0" ECU_ADDRESS 0x380AAE /end MEASUREMENT
/begin MEASUREMENT nstat "Solldrehzahl stationär" UBYTE nmot_ub_q10 1 100 0 2550 FORMAT "%5.0" ECU_ADDRESS 0x380AAF /end MEASUREMENT
/begin MEASUREMENT nstat2 "Stationnäre Solldrehzahl nach Begrenzung" UBYTE nmot_ub_q10 1 100 0 2550 FORMAT "%5.0" ECU_ADDRESS 0x380AB0 /end MEASUREMENT
/begin MEASUREMENT nstat3 "Stationnäre Solldrehzahl vor Filterung" UBYTE nmot_ub_q10 1 100 0 2550 FORMAT "%5.0" ECU_ADDRESS 0x380AB1 /end MEASUREMENT
/begin MEASUREMENT nstatd "Solldrehzahl stationär nach Auswahl nstat/nstatc" UBYTE nmot_ub_q10 1 100 0 2550 FORMAT "%5.0" ECU_ADDRESS 0x380AB2 /end MEASUREMENT
/begin MEASUREMENT nstate "effektive stationäre Solldrehzahl" UBYTE nmot_ub_q10 1 100 0 2550 FORMAT "%5.0" ECU_ADDRESS 0x380AB3 /end MEASUREMENT
/begin MEASUREMENT nstatfil "Solldrehzahl stationär gefiltert" UBYTE nmot_ub_q10 1 100 0 2550 FORMAT "%5.0" ECU_ADDRESS 0x380AB4 /end MEASUREMENT
/begin MEASUREMENT nstatfilv "Solldrehzahl stationaär gefiltert nach Verstellung über Tester" UBYTE nmot_ub_q10 1 100 0 2550 FORMAT "%5.0" ECU_ADDRESS 0x380AB5 /end MEASUREMENT
/begin MEASUREMENT nver_w "Drehzahlverhältnis" UWORD fak_uw_b8 1 100 0 7.99988 FORMAT "%8.6" ECU_ADDRESS 0x384C24 /end MEASUREMENT
/begin MEASUREMENT percnt_w "Zähler 10-ms-Schritte für fr-synchrone lamsolh-Mittelung" UWORD dez 1 100 0 65535 FORMAT "%8.2" ECU_ADDRESS 0x3829D8 /end MEASUREMENT
/begin MEASUREMENT redhyst "Reduzierstufenhysterese" SBYTE rel_sb_q0p02 1 100 -2.56 2.54 FORMAT "%5.3" ECU_ADDRESS 0x380ADD /end MEASUREMENT
/begin MEASUREMENT redneu "neu berechnete Reduzierstufe" UBYTE dez 1 100 0 255 FORMAT "%5.1" ECU_ADDRESS 0x380ADE /end MEASUREMENT
/begin MEASUREMENT redsol "berechnete Soll-Reduzierstufe" UBYTE dez 1 100 0 255 FORMAT "%5.1" ECU_ADDRESS 0x380ADF /end MEASUREMENT
/begin MEASUREMENT redze "Schwelle in Reduzierstufe zwischen Zünd- und Einspritzeingriff" UBYTE dez 1 100 0 255 FORMAT "%5.1" ECU_ADDRESS 0x380AE0 /end MEASUREMENT
/begin MEASUREMENT redzst_w "Reduzierstufe ohne Hysterese und Rundung" UWORD rel_uw_q0p001 1 100 0 65.535 FORMAT "%8.5" ECU_ADDRESS 0x3826FA /end MEASUREMENT
/begin MEASUREMENT rkat2_w "additive Gemischkorrektur (pro Zeit) der Gemischadaption Bank 2 (Word)" SWORD rel_sw_b1536 1 100 -1536 1535.95 FORMAT "%8.3" ECU_ADDRESS 0x384B1A /end MEASUREMENT
/begin MEASUREMENT rkatlt_w "additive Gemischkorrektur von der letzten Trip (HFM)" SWORD rel_sw_b1536 1 100 -1536 1535.95 FORMAT "%8.3" ECU_ADDRESS 0x384B1C /end MEASUREMENT
/begin MEASUREMENT rkat_w "additive Gemischkorrektur (pro Zeit) der Gemischdaption (Word)" SWORD rel_sw_b1536 1 100 -1536 1535.95 FORMAT "%8.3" ECU_ADDRESS 0x384B1E /end MEASUREMENT
/begin MEASUREMENT rkaz2_w "additive Gemischkorrektur (pro Zündung) der Gemischadaption Bank2 (Word)" SWORD rel_sw_b1536 1 100 -1536 1535.95 FORMAT "%8.3" ECU_ADDRESS 0x384B20 /end MEASUREMENT
/begin MEASUREMENT rkazlt_w "additive Gemischkorrektur von der letzten Trip (P-System)" SWORD rel_sw_b1536 1 100 -1536 1535.95 FORMAT "%8.3" ECU_ADDRESS 0x384B22 /end MEASUREMENT
/begin MEASUREMENT rkaz_w "additive Gemischkorrektur (pro Zündung) der Gemischadaption" SWORD rel_sw_b1536 1 100 -1536 1535.95 FORMAT "%8.3" ECU_ADDRESS 0x384B24 /end MEASUREMENT
/begin MEASUREMENT rka_w "Additive adaptive Korrektur der relativen Kraftstoffmasse" SWORD rel_sw_b1536 1 100 -1536 1535.95 FORMAT "%8.3" ECU_ADDRESS 0x3820EC /end MEASUREMENT
/begin MEASUREMENT rlmindp_w "Minimale relative Füllung für Dashpot-Abschaltung" UWORD rel_uw_q0p0234 1 100 0 1535.98 FORMAT "%8.3" ECU_ADDRESS 0x38265E /end MEASUREMENT
/begin MEASUREMENT rlmin_w "minimal zulässiges rl" UWORD rel_uw_q0p0234 1 100 0 1535.98 FORMAT "%8.3" ECU_ADDRESS 0x382034 /end MEASUREMENT
/begin MEASUREMENT rlsol_w "Soll-Füllung" UWORD rel_uw_q0p0234 1 100 0 1535.98 FORMAT "%8.3" ECU_ADDRESS 0x382036 /end MEASUREMENT
/begin MEASUREMENT rlugd_w "Füllung im ungedrosselten Zustand" UWORD rel_uw_q0p0234 1 100 0 1535.98 FORMAT "%8.3" ECU_ADDRESS 0x384C34 /end MEASUREMENT
/begin MEASUREMENT tansst "Ansaugluft-Temperatur bei Start" UBYTE temp_ub_q0p75_o48 1 100 -48 143.25 FORMAT "%5.1" ECU_ADDRESS 0x380B2A /end MEASUREMENT
/begin MEASUREMENT tlrbamo_w "Ausgang der Kennlinie TLRBAM" UWORD t10msxs_uw_b655p35 1 100 0 655.35 FORMAT "%8.4" ECU_ADDRESS 0x38531C /end MEASUREMENT
/begin MEASUREMENT tlrs_w "Totzeit der Lambdaregelstrecke" UWORD tz10msxs_uw_b327p68 1 100 0.00500008 327.68 FORMAT "%8.4" ECU_ADDRESS 0x382944 /end MEASUREMENT
/begin MEASUREMENT tlrvamo_w "Ausgang der Kennlinie TLRVAM" UWORD t10msxs_uw_b655p35 1 100 0 655.35 FORMAT "%8.4" ECU_ADDRESS 0x38531E /end MEASUREMENT
/begin MEASUREMENT tnst "Zeit nach Startende" UBYTE t1sxs_ub_b255 1 100 0 255 FORMAT "%5.1" ECU_ADDRESS 0x380AB6 /end MEASUREMENT
/begin MEASUREMENT toellrns "Motoröltemperatur" UBYTE temp_ub_q1_o60 1 100 -60 195 FORMAT "%5.1" ECU_ADDRESS 0x3848E0 /end MEASUREMENT
/begin MEASUREMENT tsaka "Timer Schubdauer für Katalysator-Ausräumen" UBYTE t20msxs_ub_b5p1 1 100 0 5.1 FORMAT "%5.3" ECU_ADDRESS 0xFA09 /end MEASUREMENT
/begin MEASUREMENT usrhk "aktuelle Regelschwelle Lambdasignal h.K." UBYTE spg_ub_q0p0052_o0p2 1 100 -0.2 1.13 FORMAT "%5.3" ECU_ADDRESS 0x380B2D /end MEASUREMENT
/begin MEASUREMENT ustmp "lokale Spannung Lambdasonde hinter Katalysator, Y-Konfiguration" UWORD spg_uw_q0p00488_o1 1 100 -1 318.995 FORMAT "%8.4" ECU_ADDRESS 0xFA12 /end MEASUREMENT
/begin MEASUREMENT zdash1_w "Zeitkonstante PT1-Filter Dashpot" UWORD zk10msxs_uw_b655 1 100 0.0100002 655.36 FORMAT "%12.8" ECU_ADDRESS 0x382660 /end MEASUREMENT
/begin MEASUREMENT zdash2_w "Zeitkonstante PT1-Filter Dashpot bei kleinem Kupplungsmoment" UWORD zk10msxs_uw_b655 1 100 0.0100002 655.36 FORMAT "%12.8" ECU_ADDRESS 0x382662 /end MEASUREMENT
/begin MEASUREMENT zdash_w "Zeitkonstante Dashpot" UWORD zk10msxs_uw_b655 1 100 0.0100002 655.36 FORMAT "%12.8" ECU_ADDRESS 0x382664 /end MEASUREMENT
/begin MEASUREMENT zhll_w "Zeitzähler für Heißleerlauf" UWORD t200msxs_uw_q0p2 1 100 0 13107 FORMAT "%8.2" ECU_ADDRESS 0x383CB6 /end MEASUREMENT
/begin MEASUREMENT zkfrat_w "Zeitkonstante der FRAT-Adaption" UWORD fak_uw_b5 1 100 0 4.99992 FORMAT "%8.6" ECU_ADDRESS 0x384B26 /end MEASUREMENT
/begin MEASUREMENT zlrs "Verzögerungszeitkonstante der Lambdaregelstrecke" UBYTE zk10msxs_ub_b2p55 1 100 0.01 2.55 FORMAT "%5.3" ECU_ADDRESS 0x380B28 /end MEASUREMENT
/begin MEASUREMENT zlrs_w "Verzögerungszeitkonstante der Lambdaregelstrecke, 16 bit" UWORD zk10msxs_uw_b655 1 100 0.01 655.36 FORMAT "%12.8" ECU_ADDRESS 0x382946 /end MEASUREMENT
/begin MEASUREMENT zlsdv_w "Zeitkonstante PT2-Filter Lastschlagdämpfung vor Reduktion" UWORD zk10msxs_uw_b655 1 100 0.0100002 655.36 FORMAT "%12.8" ECU_ADDRESS 0x382666 /end MEASUREMENT
/begin MEASUREMENT zlsd_w "Zeitkonstante PT2-Filter Lastschlagdämpfung" UWORD zk10msxs_uw_b655 1 100 0.0100002 655.36 FORMAT "%12.8" ECU_ADDRESS 0x382668 /end MEASUREMENT
/begin MEASUREMENT zwopt "optimaler Zündwinkel" SBYTE zw_sb_q0p75 1 100 -96 95.25 FORMAT "%5.2" ECU_ADDRESS 0x380AD7 /end MEASUREMENT
/begin MEASUREMENT zwoptl1 "optimaler Zündwinkel bei Lambda=1" SBYTE zw_sb_q0p75 1 100 -96 95.25 FORMAT "%5.2" ECU_ADDRESS 0x380AD8 /end MEASUREMENT
/begin FUNCTION LLRMR "12.110    Momentenreserve Leerlaufregelung"
 /begin DEF_CHARACTERISTIC CWKUPPL DMRESLL DMRESNW DMRESTM DNLLRES KFMRES KFMRESK KFMRESKH KFMRESNL KFMRESTA KLMRESTM KLMRHO MRESKH MRESLL MRESNW MRESSL TDMRESLL TVRESLL TVRESTM VANF /end DEF_CHARACTERISTIC
 /begin REF_CHARACTERISTIC SMI04LLUB SNM06LLUB SNS06LLSB STA04LLUB STM04SAUB /end REF_CHARACTERISTIC
 /begin IN_MEASUREMENT B_bkvleer B_kh B_kuppl B_ll B_mrnwe B_sl B_st B_stend dmrac dmrlf dmrwan dn dns esst_smi04llub esst_snm06llub esst_sns06llsb esst_sta04llub esst_stm04saub fho mifa_w nmot_w tans tmot vfzg vstmdr /end IN_MEASUREMENT
 /begin OUT_MEASUREMENT B_zwafh dmrllr_w dmrnwa_w dmrnwe_w dmrnw_w /end OUT_MEASUREMENT
 /begin LOC_MEASUREMENT B_kuplaus dmresll_w dmvllrsu_w /end LOC_MEASUREMENT
 /begin SUB_FUNCTION /end SUB_FUNCTION
/end FUNCTION
/begin FUNCTION LLRNFA "1.140     Solldrehzahlanhebung bei Kurztrip"
 /begin DEF_CHARACTERISTIC CWFAN NSLFAA NSLFAEZLA NSLFAKAT NSLFAKRS NSLFALDP NSLFALSV NSLFASH NSLFASHV NSLFASKNO NSLFASLS NSLFATES NSLFAWSA NSLFAWSE NSLKVS NSLLSH TNSLFA WFAN /end DEF_CHARACTERISTIC
 /begin REF_CHARACTERISTIC /end REF_CHARACTERISTIC
 /begin IN_MEASUREMENT B_autget B_brems B_faagr B_faan B_faezla B_fakat B_fakrs B_fakvs B_faldp B_falsh B_falshv B_falsv B_fanwsa B_fanwse B_fash B_faskno B_fasls B_fates B_fs B_ll vfzg wped /end IN_MEASUREMENT
 /begin OUT_MEASUREMENT nslfa /end OUT_MEASUREMENT
 /begin LOC_MEASUREMENT B_fanfg llrnfalokbits /end LOC_MEASUREMENT
 /begin SUB_FUNCTION /end SUB_FUNCTION
/end FUNCTION
/begin FUNCTION LLRNS "541.130   Leerlaufregelung-Solldrehzahl"
 /begin DEF_CHARACTERISTIC CNFLLRNS CWNSTAT DNSNFST DNSNFX DTAHLL DTMHLL FNSNF FNSSTKM FNSSTM KFNLLNST KFZNSM KNSNF LBZO1 LBZO2 LBZU NFHZ NFHZFS NFS2M NFSKO_0_A NFSKO_1_A NFSKO_2_A NFSKO_3_A NFSKS NFSLPWG NFSMIN_0_A NFSMIN_1_A NFSMIN_2_A NFSMIN_3_A NFSNLDG NFSNWLL NFSSBC NFSSL NGNSNF NLL2M NLLCVTMXV NLLMG NLLMGFS NLLMIN_0_A NLLMIN_1_A NLLMIN_2_A NLLMIN_3_A NSAC_0_A NSAC_1_A NSACFS_0_A NSACFS_1_A NSHLL NSKO_0_A NSKO_1_A NSKO_2_A NSKO_3_A NSKS NSL NSLBZFS NSLBZLL NSLBZS NSLPP NSLPPFS NSLPWG NSNLDG NSNOT NSNWLL NSOLMX NSTOEL NZHDTL NZHITL SGA08LLUB SNS06LLSB TAHLL TMHLL TMLLX TMRZHLL TVLLNWDIF VSL ZHLLA ZHLLE ZKNS ZNSUB /end DEF_CHARACTERISTIC
 /begin REF_CHARACTERISTIC STM06LLUB STN06LLUB /end REF_CHARACTERISTIC
 /begin IN_MEASUREMENT B_autget B_cvt B_cvtad B_dknolu B_dkpu B_fanfg B_fhz B_fs B_khn B_ko B_ll B_llrein B_llrst B_nac B_nldg B_nswo1 B_pwf B_sacc B_skoc B_sl B_spsmin B_st B_stend B_tolcb B_vllr B_wkauf esst_stm06llub esst_stn06llub gangi lbz nfskh ngfil nllcvt1 nllkh nmot nmotll nslfa psl rl S_ac S_ko tans tmot tmst tnst_w toelk_w tolc vfzg vsns vstcns vstnls /end IN_MEASUREMENT
 /begin OUT_MEASUREMENT B_nsget dns esst_sga08llub esst_sns06llsb nsol nsol_w nsst nstat nstat2 nstat3 nstate nstatfil /end OUT_MEASUREMENT
 /begin LOC_MEASUREMENT B_hll B_ns2 B_ns2a B_nsks B_nssl B_nstabk B_nwll gangllr nllcvt2 nsfsm nsfsmn nslbz nsllm nsllmn nsnf nstatd nstatfilv tnst toellrns zhll_w /end LOC_MEASUREMENT
 /begin SUB_FUNCTION /end SUB_FUNCTION
/end FUNCTION
/begin FUNCTION LLRRM "11.110    Leerlaufregelung Reglereingriff Drehmoment"
 /begin DEF_CHARACTERISTIC CWLLRPA DMLLNGEZ DMLLNGEZV DMLLRLMNN DMLLRLMXN DMLLRMNN DMLLRMNNK DMLLRMXN DMLLRMXNK DNLLRIST DNLLST DNMNI DVNG DVNGV FDDN FDNIKOR GFDLDN IVDNDTEH IVDNHOM IVDNHOMV LIMN LIMNDLLR LIMNDTES LIMNV LIMXDNS LIMXVDNS LISTM_0_A LISTM_1_A LLRICNF PVDNHOM PVDNHOMV PVDNKH PVDNST PVLDNEZ PVLDNEZKH PVLDNEZV SDN10LLSW SEZ04LLUB SNS206LLSB SRKTEVS TVLISTU TVLLRPST TVPKH ZFLLRPL ZKLLRD ZLIBG ZNFNGLL /end DEF_CHARACTERISTIC
 /begin REF_CHARACTERISTIC SNG06LLSB SNM06LLUB SNS06LLSB STM06LLUB /end REF_CHARACTERISTIC
 /begin IN_MEASUREMENT B_dllr B_dteaam B_dtes B_dtest B_faan B_kh B_kha B_llr B_llrein B_llri B_llrpd B_mdmin B_nswo1 B_st B_stend B_temin B_trkh B_vllr dns esst_sng06llsb esst_snm06llub esst_sns06llsb esst_stm06llub etazws ngas_w ngfil nmot_w nsol_w nstat tmot /end IN_MEASUREMENT
 /begin OUT_MEASUREMENT B_llrst dmllrdl_w dmllrd_w dmllri_w dmllrl_w dmllrpl_w dmllrp_w dmllr_w dn dn_w esst_sdn10llsw esst_sez04llub esst_sns206llsb /end OUT_MEASUREMENT
 /begin LOC_MEASUREMENT B_llrpkh B_llrpst dmllrib_w dmllrii_w dmllriz_w dnbi_w dnikorr_w iver limax_w limin_w limnst ngasf_w /end LOC_MEASUREMENT
 /begin SUB_FUNCTION /end SUB_FUNCTION
/end FUNCTION
/begin FUNCTION LRA "Adaptive Vorsteuerung für Lambdaregelung"
 /begin DEF_CHARACTERISTIC CWGALSV FBZFRAT FRAOMN FRAOMX FRAORN FRAORX FRATMN FRATMX FRAUMN FRAUMX FRAURN FRAURX KFRAT MLO1 MLO1AC MLO2 MLO3 MLO3AC MLU2 MLU2AC MLU2FA MLU4 MLU4AC N0 NO1 NO2 NOLRA NRKAB NU2 NU3 RKATMN RKATMX RKATRN RKATRX RKAZMN RKAZMX RKAZRN RKAZRX RLO2 RLO3 RLO3AC RLU2 RLU2AC RLU3 RLU4 RLU4AC TGAALTWR TMFRATMN TMFRATUB ZKFRAOA ZKFRAUA ZKRKATA ZKRKAZA ZRLFRAT /end DEF_CHARACTERISTIC
 /begin REF_CHARACTERISTIC TMRAA /end REF_CHARACTERISTIC
 /begin IN_MEASUREMENT abo B_abor B_edkvs B_fa B_faan B_fakvs B_koe B_lr B_lra B_lrat B_lsvvsp B_pwf B_stend frm_w ml_w nmot rl tmot /end IN_MEASUREMENT
 /begin OUT_MEASUREMENT B_frao B_fraor B_frat B_frau B_fraur B_lrare B_lrare2 B_nofra B_nofrat B_norkat B_norkaz B_rkat B_rkatr B_rkaz B_rkazr frao2_w frao_w frat2_w frati_w frat_w frau2_w frau_w fra_w ftklra_w rkat2_w rkat_w rkaz2_w rkaz_w rka_w /end OUT_MEASUREMENT
 /begin LOC_MEASUREMENT B_lrareb dfrmt_w dfrm_w dlrfrat fraolt_w frault_w rkatlt_w rkazlt_w zkfrat_w /end LOC_MEASUREMENT
 /begin SUB_FUNCTION /end SUB_FUNCTION
/end FUNCTION
/begin FUNCTION LRAEB "4.120     Einschaltbedingungen Gemischadaption" /begin DEF_CHARACTERISTIC LAMLRAMN LAMLRAMX TARA TMEWRAA TMRAA TVLRA WDKARN /end DEF_CHARACTERISTIC /begin REF_CHARACTERISTIC /end REF_CHARACTERISTIC
 /begin IN_MEASUREMENT B_agrlrasp B_brems B_dsls B_dteaa B_dtest B_enws B_fa B_falra B_fates B_gap B_lr B_lrasp B_mdarv B_sls B_te B_ukg B_vl lamsons_w nmot tans tmew tmot wdkba /end IN_MEASUREMENT
 /begin OUT_MEASUREMENT B_gasp B_lra B_lrat /end OUT_MEASUREMENT
 /begin LOC_MEASUREMENT B_lraen /end LOC_MEASUREMENT
 /begin SUB_FUNCTION /end SUB_FUNCTION
/end FUNCTION
/begin FUNCTION LRS "15.80     Stetige Lambdaregelung"
 /begin DEF_CHARACTERISTIC CLRS FDFRMIN FLRSG2K FRMAX FRMINKH FZAB2 KFDLASO KFFRMIN KFLRSG1 KFLRSG2 KFLRSG4 KFLRSP1 KFLRSP2 KFLRSP3 KFLRSP4 KFLRST KFLRSZ KVZAF LALIUSMN LRSGKTM LRSTPZA LRSZAWML TAUIDEC TKATSZA TMLRZAMN WIMAX WIMIN XIMAX XIMIN Y2MAX /end DEF_CHARACTERISTIC
 /begin REF_CHARACTERISTIC SNM07LSUW SNM10LSUB SRL08LSUW SRL10LSUB /end REF_CHARACTERISTIC
 /begin IN_MEASUREMENT azlrdkt B_dktlp B_frini B_kh B_lrka B_lrmsbs B_lrs B_lrsrems B_lrsresf B_nswo1 B_sls dlahi_w dlahp_w esst_snm07lsuw esst_snm10lsub esst_srl08lsuw esst_srl10lsub frini_w lamsbg_w lamsoni_w lamsons_w mlbb_w ml_w msl nmot nmot_w rl rl_w tkatm_w tmot tnst_w tzlrdkt_w /end IN_MEASUREMENT
 /begin OUT_MEASUREMENT B_frmax B_frmin B_lrssp B_za frmn_w frmx_w frm_w fr_w ladiff_w lamsbgt_w lamsbpr_w lamzak_w lamzapr_w tlrs_w zlrs zlrs_w /end OUT_MEASUREMENT
 /begin LOC_MEASUREMENT B_flrsres B_idecay B_update B_y2max B_y2min dfrmin_w dfrpr_w dfrzaf_w dfrza_w dfr_w dlaso froza_w g1korr g2korr lrsg1_w lrsg2_w lrsg4_w lrsp1_w lrsp2_w lrsp3_w lrsp4_w lrsw1_w lrsw2_w lrsxk1_w lrsxk3_w lrsxk4_w lrsy2_w lrsy4_w lrsza /end LOC_MEASUREMENT
 /begin SUB_FUNCTION /end SUB_FUNCTION
/end FUNCTION
/begin FUNCTION LRSEB "10.150    Einschaltbedingungen stetige Lambdaregelung"
 /begin DEF_CHARACTERISTIC CLRZWTMS DLAMXSA DTMR DTMTMRW IMLEVABS IMLSALR NLRSHB RLLRSHB RLLRUN RLSLSMN TARAU TASHS TLRBAM TLRHS TLRSZWSA TLRTMS TLRVAM TLRZWTMS TMRA1 TMRA2 TMRAK TMSHS TRAU TVSLR /end DEF_CHARACTERISTIC
 /begin REF_CHARACTERISTIC CLRS LALIUSMN /end REF_CHARACTERISTIC
 /begin IN_MEASUREMENT B_bag B_bevab B_craus B_dsla B_dslsk B_eev B_esls B_falr B_ll B_mdarv B_mdkat B_nwse B_sa B_sbblsu B_slsoff B_st B_stend B_temin B_vag B_vlsuftb lamsoni_w lamsons_w ml_w nmot rl tans tmot tmotlin tmrw tmst /end IN_MEASUREMENT
 /begin OUT_MEASUREMENT B_eobdlr B_lr B_lr2s B_lrmsbs B_lrnda B_lrs B_lrsrems B_lrsresf B_lrssa B_lrvk B_mlevab B_mlrsa B_nolrb B_nolre B_nolrw B_tmlr flglrs /end OUT_MEASUREMENT
 /begin LOC_MEASUREMENT B_lrrl B_pspaus B_pspwl B_slspaus B_tarau B_vsspaus imlevab_w imlrsa_w tansst tlrbamo_w tlrvamo_w /end LOC_MEASUREMENT
 /begin SUB_FUNCTION /end SUB_FUNCTION
/end FUNCTION
/begin FUNCTION LRSHK "9.60      Lambdaregelung (stetig) hinter Katalysator"
 /begin DEF_CHARACTERISTIC CLRSHK CLRSHKA CLRSHKEB DLAHINI KDLASHKI KDLASHKP KFUSHK KILRHML KPLRHML LALIUSH LALIUSRH LASHKAB LRHIMN LRHIMX MLNKAX NLRHO NLRHU PLRHAV RLLRHON RLLRHUFA RLLRHUN TBLRH TKATMLRH TMLLAMN USRHKFA ZLASHKAB ZLASOHML /end DEF_CHARACTERISTIC
 /begin REF_CHARACTERISTIC SM108LHSW SML08LHUB SNM08LHUB /end REF_CHARACTERISTIC
 /begin IN_MEASUREMENT avkatf B_edkvs B_enws B_esls B_fakat B_falsh B_lr B_lrka B_lrssp B_mdarv B_pwf B_sbbhk B_st B_tehb esst_sm108lhsw esst_sml08lhub esst_snm08lhub lamsons_w ml ml_w nmot rl tikatm ushk_w /end IN_MEASUREMENT
 /begin OUT_MEASUREMENT B_lrhk dlahi_w dlahp_w lamsolh_w lamsonh_w usrhk /end OUT_MEASUREMENT
 /begin LOC_MEASUREMENT B_dlahini B_lrhkb B_lrhkg B_lrhkp B_mlnka B_nekati dlahini_w dlahist_w dlahkab_w dlashki_w dlashkm_w dlashkp_w lahkmz lamhf_w lamhm_w LRSHKlokbits1 mlnka_w percnt_w /end LOC_MEASUREMENT
 /begin SUB_FUNCTION /end SUB_FUNCTION
/end FUNCTION
/begin FUNCTION LRSINI "1.10      Stetige Lambdaregelung, Koordination der Initialisierung" /begin DEF_CHARACTERISTIC /end DEF_CHARACTERISTIC /begin REF_CHARACTERISTIC /end REF_CHARACTERISTIC /begin IN_MEASUREMENT B_dtefrr frdter_w /end IN_MEASUREMENT /begin OUT_MEASUREMENT B_frini B_frini2 frini2_w frini_w /end OUT_MEASUREMENT /begin LOC_MEASUREMENT /end LOC_MEASUREMENT /begin SUB_FUNCTION /end SUB_FUNCTION /end FUNCTION
/begin FUNCTION LRSKA "6.50      Stetige Lambdaregelung Zusatzfunktion Katalysator-Ausräumen"
 /begin DEF_CHARACTERISTIC CLRSKA FKAXAVKAT FLMLKAMA ILMLKAXTK IMLKAMN LAMKADEF LAMKAML LAMSKAMX NLRKA TLAKAMN TSAKAMN USHKAMNW USHKAMXW /end DEF_CHARACTERISTIC
 /begin REF_CHARACTERISTIC /end REF_CHARACTERISTIC
 /begin IN_MEASUREMENT avkatf B_bevab B_lamdkt B_sbbhk B_sbbvk lamsoni_w lamsons_w ml ml_w nmot tikatm_w ushk_w /end IN_MEASUREMENT
 /begin OUT_MEASUREMENT B_lrka ilmlka_w ilmltkx_w imllaka_w lamka_w lrskaBits1_20ms lrskaBits_20ms /end OUT_MEASUREMENT
 /begin LOC_MEASUREMENT B_blrka B_lrkae B_sbbhktmp favkatmx iftkavx_w imlka_w lrkaz tsaka ustmp /end LOC_MEASUREMENT
 /begin SUB_FUNCTION /end SUB_FUNCTION
/end FUNCTION
/begin FUNCTION MCMESS_PROT "" /begin DEF_CHARACTERISTIC /end DEF_CHARACTERISTIC /begin REF_CHARACTERISTIC CWVSV /end REF_CHARACTERISTIC /begin IN_MEASUREMENT /end IN_MEASUREMENT /begin OUT_MEASUREMENT /end OUT_MEASUREMENT /begin LOC_MEASUREMENT /end LOC_MEASUREMENT /begin SUB_FUNCTION /end SUB_FUNCTION /end FUNCTION
/begin FUNCTION MDAUTG "Berechnung des Istmomentes für die Getriebesteuerung" /begin DEF_CHARACTERISTIC /end DEF_CHARACTERISTIC /begin REF_CHARACTERISTIC /end REF_CHARACTERISTIC
 /begin IN_MEASUREMENT B_dash B_fil B_kh B_kw B_ll B_lsd B_mibeg B_sab B_zwvz dmaufr_w dmllr_w miasrs_w mibas_w mibgr_w mifa_w mimsr_w minmx_w miszul_w mivbeb_w mivmx_w mizwmn_w /end IN_MEASUREMENT
 /begin OUT_MEASUREMENT miautget_w miautgs_w miistoar_w /end OUT_MEASUREMENT
 /begin LOC_MEASUREMENT /end LOC_MEASUREMENT
 /begin SUB_FUNCTION /end SUB_FUNCTION
/end FUNCTION
/begin FUNCTION MDBAS "8.30      Berechnung der Basisgrößen für Momentenschnittstelle"
 /begin DEF_CHARACTERISTIC AGRRMAX CWMDBAS DZWOLA DZWOM ETADZW ETALAM KFDZWOAGR KFMIOP KFZWOP KFZWOP2 SRL11OPUW /end DEF_CHARACTERISTIC
 /begin REF_CHARACTERISTIC SNM16OPUW /end REF_CHARACTERISTIC
 /begin IN_MEASUREMENT agrr esst_snm16opuw fnwue lambas nmot nmot_w rl_w tmot zwbas /end IN_MEASUREMENT
 /begin OUT_MEASUREMENT dzwoag dzwol dzw_kge esst_srl11opuw etalab etatrmn etazwb etazwbm mibas_w miopt_w zwopt zwoptl1 /end OUT_MEASUREMENT
 /begin LOC_MEASUREMENT dzwb dzwotm mioptl1_w /end LOC_MEASUREMENT
 /begin SUB_FUNCTION /end SUB_FUNCTION
/end FUNCTION
/begin FUNCTION MDBGRG "5.40      Momentenbegrenzung nach oben"
 /begin DEF_CHARACTERISTIC DMRTMKI KFMDBGRG KLFRTMKI MDBGRGA MKBRMXWP TMMIBGR VMIBGR VMKBRMX /end DEF_CHARACTERISTIC
 /begin REF_CHARACTERISTIC /end REF_CHARACTERISTIC
 /begin IN_MEASUREMENT B_autget B_brems gangi mdverl_w mifafu_w mifamx_w mimax_w mitibgr_w nmot tmki tmot vfzg wped_w /end IN_MEASUREMENT
 /begin OUT_MEASUREMENT mibgrl_w mibgr_w mitmbgr_w /end OUT_MEASUREMENT
 /begin LOC_MEASUREMENT B_brvfp B_mkbrmx frtmki MDBGRGlokbits mibrmx_w /end LOC_MEASUREMENT
 /begin SUB_FUNCTION /end SUB_FUNCTION
/end FUNCTION
/begin FUNCTION MDFAW "12.260    Fahrerwunschmoment"
 /begin DEF_CHARACTERISTIC CWDMFAB_0_A CWDMFAB_1_A CWMDFAW DMDPUG DMIFLSD_0_A DMIFLSD_1_A DMLSDUG DMRFAWEN DRLMINDP FGMIFAL_0_A FGMIFAL_1_A FGZLSD_0_A FGZLSD_1_A FKFPEDV FKZDPTM FLRMIFAL FLRZDASH FLRZLSD FZDA1SCH FZDA2SCH KFDLSD KFDMDPO_0_A KFDMDPO_1_A KFDMLSDO_0_A KFDMLSDO_1_A KFDMLSDS KFMIFABG_0_A KFMIFABG_1_A KFMIFALS_0_A KFMIFALS_1_A KFMILSD KFPED KFPEDL KFPEDR KFWMIFAL KFWZLSD KFZDASH_0_A KFZDASH_1_A KFZDASH2_0_A KFZDASH2_1_A KFZLSD_0_A KFZLSD_1_A MIFABGMX_0_A MIFABGMX_1_A MIFALMF MKFADPN_0_A MKFADPN_1_A MKFADPN1_0_A MKFADPN1_1_A MKMIFABG_0_A MKMIFABG_1_A MRFALLO MRFALLU MRFAVLN NGFSAWE SNM12MDUW SWP16MDUW TDMFBSA TDMFBWE TDMFNSG TDMFWEMI TDMLSDS TVFSAWE VDASH VLSD /end DEF_CHARACTERISTIC
 /begin REF_CHARACTERISTIC MDIMX SGA08MDUB SNM06MDUW /end REF_CHARACTERISTIC
 /begin IN_MEASUREMENT B_asr B_cvt B_faan B_gwhs B_ko B_kuppl B_kupplv B_llvfgr B_lowra B_mgbget B_nmax B_nmot B_nsget B_sa B_sab B_sabfg B_stend B_vmax B_vnull B_wkauf dmllri_w dmverl_w esst_sga08mdub esst_snm06mduw gangi mdgrad_w mdverl_w miasrs_w mibas_w mifamx_w miistoar_w mimax_w mimin_w mizwmn_w mrfgr_w ngfil_w nmot nmot_w rlmin_w rl_w tmot vfzg wped wped_w /end IN_MEASUREMENT
 /begin OUT_MEASUREMENT B_dash B_fgr B_fil B_ll B_lsd B_vl esst_snm12mduw esst_swp16mduw mifa mifal_w mifa_w mivbeb_w mkfanb_w mrfamx_w mrfa_w /end OUT_MEASUREMENT
 /begin LOC_MEASUREMENT B_dashv B_dp B_edp B_elsd B_iflsd B_ls B_mgbgakt B_mifabg B_mrpfa B_tdmlsds dlsd_w dmbebl_w dmdpo_w dmdpu_w dmgbeg_w dmlsdo_w dmlsdu_w dmrfawe_w fkfped fwmifal fwzlsd fzdash MDFAWlokbits mdfaw_bits mibdp_w miblsd_w mifabg_w migef_w minbeg_w mivbegv_w mivbeg_w mkfadpn_w mkfa_w mrpedl_w mrpeds_w mrped_w rlmindp_w zdash1_w zdash2_w zdash_w zlsdv_w zlsd_w /end LOC_MEASUREMENT
 /begin SUB_FUNCTION /end SUB_FUNCTION
/end FUNCTION
/begin FUNCTION MDFUE "8.60      Sollwertvorgabe für Luftmasse aus Sollmoment"
 /begin DEF_CHARACTERISTIC CWRLAPPL FRLMNHO FWPEDRLS KFMIRL KFRLMN KFRLMNSA RLSOLAP ZKDRLSOL /end DEF_CHARACTERISTIC
 /begin REF_CHARACTERISTIC SNM12FEUB STM04FEUB /end REF_CHARACTERISTIC
 /begin IN_MEASUREMENT B_sa esst_snm12feub esst_stm04feub etalab etazwbm fho milsol_w nmot nmot_w rlmax_w rltedte_w tmot wped_w /end IN_MEASUREMENT
 /begin OUT_MEASUREMENT B_mdmin drlsolf_w drlsol_w rlsol_w /end OUT_MEASUREMENT
 /begin LOC_MEASUREMENT misopl1_w rlmin_w /end LOC_MEASUREMENT
 /begin SUB_FUNCTION /end SUB_FUNCTION
/end FUNCTION
/begin FUNCTION MDIST "10.21     Motormomentenberechnung" /begin DEF_CHARACTERISTIC /end DEF_CHARACTERISTIC /begin REF_CHARACTERISTIC ETADZW /end REF_CHARACTERISTIC /begin IN_MEASUREMENT dzw_kge miopt_w redist zwist zwopt /end IN_MEASUREMENT /begin OUT_MEASUREMENT etazaist etazwist miist_w /end OUT_MEASUREMENT /begin LOC_MEASUREMENT dzwi mdindg_w /end LOC_MEASUREMENT /begin SUB_FUNCTION /end SUB_FUNCTION /end FUNCTION
/begin FUNCTION MDKOG "14.70     Drehmomentenkoordination für Gesamteingriffe"
 /begin DEF_CHARACTERISTIC CWMDKOG CWTEZW CWZWVMX DELRL NASNOTKL THDMB TMVER TVLDSZW TVMIBEG /end DEF_CHARACTERISTIC
 /begin REF_CHARACTERISTIC MDIMX /end REF_CHARACTERISTIC
 /begin IN_MEASUREMENT B_dash B_fil B_kh B_kupplv B_kw B_ldsua B_ll B_llrein B_lsd B_mdmin B_mgbget B_mibegl B_pwf B_sa B_stend dmar_w dmllr_w dmrkh dmrkt_w dmrllr_w etazwb miasrl_w miasrs_w mibas_w mibgr_w mifa_w migs_w milres_w mimax_w mimsr_w minmx_w miopt_w miszul_w mitebg_w mivmx_w nmot rlmin_w rlsol_w rl_w tmot wped_w /end IN_MEASUREMENT
 /begin OUT_MEASUREMENT B_asr B_mdein B_mibeg B_msr B_zwvs B_zwvz cmibeg_w dmzms_w mifab_w misolv_w misol_w mizsol_w nasnottm /end OUT_MEASUREMENT
 /begin LOC_MEASUREMENT B_zwget B_zwnget B_zwvzvb mibeg_w miextv_w miext_w mizsolv_w /end LOC_MEASUREMENT
 /begin SUB_FUNCTION /end SUB_FUNCTION
/end FUNCTION
/begin FUNCTION MDKOL "10.130    Momentenkoordination auf Füllungsebene" /begin DEF_CHARACTERISTIC CWMDKOL /end DEF_CHARACTERISTIC /begin REF_CHARACTERISTIC MDIMX /end REF_CHARACTERISTIC
 /begin IN_MEASUREMENT B_dashv B_llrein B_lsd B_mibeg B_mifabg dmllrl_w dmrkh dmrkt_w dmrllr_w etazwbm etazwmn miasrl_w mibgrl_w mifal_w mifa_w miges_w migsl_w mimsr_w minmx_w misgsl_w miszull_w mitebg_w mivmx_w nasnottm nmot vsdmr /end IN_MEASUREMENT
 /begin OUT_MEASUREMENT B_mrakt dmrmx_w mifafu_w milres_w milsol_w /end OUT_MEASUREMENT
 /begin LOC_MEASUREMENT B_mibegl dmlms_w milsolv_w /end LOC_MEASUREMENT
 /begin SUB_FUNCTION /end SUB_FUNCTION
/end FUNCTION
/begin FUNCTION MDMAX "1.40      Berechnung maximales indiziertes Motormoment" /begin DEF_CHARACTERISTIC FMIVL /end DEF_CHARACTERISTIC /begin REF_CHARACTERISTIC KFMIOP SNM16OPUW SRL11OPUW /end REF_CHARACTERISTIC /begin IN_MEASUREMENT esst_snm16opuw esst_srl11opuw nmot_w rlmax_w rl_w /end IN_MEASUREMENT /begin OUT_MEASUREMENT mimax_w /end OUT_MEASUREMENT /begin LOC_MEASUREMENT mimxl1_w rlugd_w /end LOC_MEASUREMENT /begin SUB_FUNCTION /end SUB_FUNCTION /end FUNCTION
/begin FUNCTION MDMIN "10.40     Minimales Motormoment Koordination"
 /begin DEF_CHARACTERISTIC CWMDMIN FWDMVAD_0_A FWDMVAD_1_A KFMIMN_0_A KFMIMN_1_A KFVERST KLMIMNH /end DEF_CHARACTERISTIC
 /begin REF_CHARACTERISTIC /end REF_CHARACTERISTIC
 /begin IN_MEASUREMENT B_kupplv B_sab dmvad_w fho fnstab_w gangi mdverf_w nmot_w nver_w wped_w /end IN_MEASUREMENT
 /begin OUT_MEASUREMENT mill_w miminds_w mimins_w mimin_w /end OUT_MEASUREMENT
 /begin LOC_MEASUREMENT /end LOC_MEASUREMENT
 /begin SUB_FUNCTION /end SUB_FUNCTION
/end FUNCTION
/begin FUNCTION MDNSTAB "1.41      Drehmoment: Drehzahlstabilisierung" /begin DEF_CHARACTERISTIC FNSTABNV /end DEF_CHARACTERISTIC /begin REF_CHARACTERISTIC /end REF_CHARACTERISTIC /begin IN_MEASUREMENT nmot_w nstat /end IN_MEASUREMENT /begin OUT_MEASUREMENT fnstab_w nver_w /end OUT_MEASUREMENT /begin LOC_MEASUREMENT B_mdnstab /end LOC_MEASUREMENT /begin SUB_FUNCTION /end SUB_FUNCTION /end FUNCTION
/begin FUNCTION MDRED "4.50      Berechnung Reduzierstufe aus Momentenanforderung" /begin DEF_CHARACTERISTIC CREDSTU DMIZWMN MDHYEZ REDHYOC REDHYUC REDMXSA REDZEM /end DEF_CHARACTERISTIC /begin REF_CHARACTERISTIC /end REF_CHARACTERISTIC
 /begin IN_MEASUREMENT B_asr B_dknolu B_dkpu B_msr B_nmax B_sab B_stend B_zmsoff etazwmn mibas_w miopt_w misol_w redist tmot /end IN_MEASUREMENT
 /begin OUT_MEASUREMENT B_sa mizwmn_w redsol /end OUT_MEASUREMENT
 /begin LOC_MEASUREMENT B_mdee B_mdredhyein redhyst redneu redze redzst_w /end LOC_MEASUREMENT
 /begin SUB_FUNCTION /end SUB_FUNCTION
/end FUNCTION
/begin FUNCTION MDTRIP "1.30      Berechnung der Momentenreserve im Kurztrip" /begin DEF_CHARACTERISTIC DMRAA /end DEF_CHARACTERISTIC /begin REF_CHARACTERISTIC /end REF_CHARACTERISTIC
 /begin IN_MEASUREMENT B_faam dmrdagr_w dmrdkt_w dmrdsls_w dmrlash_w dmrlsh_w dmrlsv_w /end IN_MEASUREMENT
 /begin OUT_MEASUREMENT dmrkt_w /end OUT_MEASUREMENT
 /begin LOC_MEASUREMENT /end LOC_MEASUREMENT
 /begin SUB_FUNCTION /end SUB_FUNCTION
/end FUNCTION
/begin COMPU_METHOD B_TRUE "boolsche Zustände, positive Logik" TAB_VERB "%6.3" "" COMPU_TAB_REF B_TRUE /end COMPU_METHOD
/begin COMPU_VTAB B_TRUE "boolsche Zustände, positive Logik" TAB_VERB 2 0 "----" 1 "TRUE" /end COMPU_VTAB
/begin COMPU_METHOD DEZ "1 : 1 Umrechnug (dez/hex)" RAT_FUNC "%6.2" "" COEFFS 0 1 0 0 0 1 /end COMPU_METHOD
/begin COMPU_METHOD dez "1 : 1 Umrechnug (dez/hex)" RAT_FUNC "%6.2" "" COEFFS 0 1 0 0 0 1 /end COMPU_METHOD
/begin COMPU_METHOD fak_q0p00153 "" RAT_FUNC "%6.4" "-" COEFFS 0 256 0 0 0 0.390625 /end COMPU_METHOD
/begin COMPU_METHOD fak_q0p0625 "" RAT_FUNC "%6.4" "-" COEFFS 0 16 0 0 0 1 /end COMPU_METHOD
/begin COMPU_METHOD fak_sb_b0p03125 "" RAT_FUNC "%6.5" "-" COEFFS 0 256 0 0 0 0.0625 /end COMPU_METHOD
/begin COMPU_METHOD fak_sb_b1 "" RAT_FUNC "%6.4" "-" COEFFS 0 256 0 0 0 2 /end COMPU_METHOD
/begin COMPU_METHOD fak_sb_b2 "" RAT_FUNC "%6.4" "-" COEFFS 0 256 0 0 0 4 /end COMPU_METHOD
/begin COMPU_METHOD fak_sw_b1 "" RAT_FUNC "%7.6" "-" COEFFS 0 65536 0 0 0 2 /end COMPU_METHOD
/begin COMPU_METHOD fak_sw_b2 "" RAT_FUNC "%7.6" "-" COEFFS 0 65536 0 0 0 4 /end COMPU_METHOD
/begin COMPU_METHOD fak_sw_b32 "" RAT_FUNC "%6.5" "-" COEFFS 0 65536 0 0 0 64 /end COMPU_METHOD
/begin COMPU_METHOD fak_sw_b4 "" RAT_FUNC "%6.5" "-" COEFFS 0 65536 0 0 0 8 /end COMPU_METHOD
/begin COMPU_METHOD fak_sw_b64 "" RAT_FUNC "%6.4" "-" COEFFS 0 65536 0 0 0 128 /end COMPU_METHOD
/begin COMPU_METHOD fak_sw_b8 "" RAT_FUNC "%6.5" "-" COEFFS 0 65536 0 0 0 16 /end COMPU_METHOD
/begin COMPU_METHOD fak_ub_b0p25 "" RAT_FUNC "%10.7" "-" COEFFS 0 256 0 0 0 0.25 /end COMPU_METHOD
/begin COMPU_METHOD fak_ub_b1 "" RAT_FUNC "%6.4" "-" COEFFS 0 256 0 0 0 1 /end COMPU_METHOD
/begin COMPU_METHOD fak_ub_b2 "" RAT_FUNC "%6.4" "-" COEFFS 0 256 0 0 0 2 /end COMPU_METHOD
/begin COMPU_METHOD fak_ub_b4 "" RAT_FUNC "%6.4" "-" COEFFS 0 256 0 0 0 4 /end COMPU_METHOD
/begin COMPU_METHOD fak_ub_b8 "" RAT_FUNC "%6.4" "-" COEFFS 0 256 0 0 0 8 /end COMPU_METHOD
/begin COMPU_METHOD fak_uw_b1 "" RAT_FUNC "%7.6" "-" COEFFS 0 65536 0 0 0 1 /end COMPU_METHOD
/begin COMPU_METHOD fak_uw_b128 "" RAT_FUNC "%6.4" "-" COEFFS 0 65536 0 0 0 128 /end COMPU_METHOD
/begin COMPU_METHOD fak_uw_b16 "" RAT_FUNC "%6.5" "-" COEFFS 0 65536 0 0 0 16 /end COMPU_METHOD
/begin COMPU_METHOD fak_uw_b2 "" RAT_FUNC "%7.6" "-" COEFFS 0 65536 0 0 0 2 /end COMPU_METHOD
/begin COMPU_METHOD fak_uw_b4 "" RAT_FUNC "%7.6" "-" COEFFS 0 65536 0 0 0 4 /end COMPU_METHOD
/begin COMPU_METHOD fak_uw_b5 "" RAT_FUNC "%7.6" "-" COEFFS 0 65536 0 0 0 5 /end COMPU_METHOD
/begin COMPU_METHOD fak_uw_b64 "" RAT_FUNC "%6.5" "-" COEFFS 0 65536 0 0 0 64 /end COMPU_METHOD
/begin COMPU_METHOD fak_uw_b8 "" RAT_FUNC "%6.5" "-" COEFFS 0 65536 0 0 0 8 /end COMPU_METHOD
/begin COMPU_METHOD freq_ub_b0p05 "" RAT_FUNC "%6.5" "1/s" COEFFS 0 256 0 0 0 0.05 /end COMPU_METHOD
/begin COMPU_METHOD m_ub_b1020 "" RAT_FUNC "%6.2" "kg/h" COEFFS 0 1 0 0 0 4 /end COMPU_METHOD
/begin COMPU_METHOD m_uw_b291p25 "" RAT_FUNC "%6.4" "g" COEFFS 0 225 0 0 0 1 /end COMPU_METHOD
/begin COMPU_METHOD m_uw_b4660 "" RAT_FUNC "%6.4" "g" COEFFS 0 3600 0 0 0 256 /end COMPU_METHOD
/begin COMPU_METHOD m_uw_b6553p5 "" RAT_FUNC "%6.3" "kg/h" COEFFS 0 1 0 0 0 0.1 /end COMPU_METHOD
/begin COMPU_METHOD m_uw_b7281 "" RAT_FUNC "%6.3" "g" COEFFS 0 9 0 0 0 1 /end COMPU_METHOD
/begin COMPU_METHOD nmotd_sb_q10 "" RAT_FUNC "%6.1" "U/min" COEFFS 0 1 0 0 0 10 /end COMPU_METHOD
/begin COMPU_METHOD nmotg_sb_q100 "" RAT_FUNC "%6.0" "U/min/s" COEFFS 0 1 0 0 0 100 /end COMPU_METHOD
/begin COMPU_METHOD nmotg_sw_q0p39 "" RAT_FUNC "%6.3" "U/min/s" COEFFS 0 1 0 0 0 0.39063 /end COMPU_METHOD
/begin COMPU_METHOD nmotg_ub_q100 "" RAT_FUNC "%6.0" "U/min/s" COEFFS 0 1 0 0 0 100 /end COMPU_METHOD
/begin COMPU_METHOD nmot_q1 "" RAT_FUNC "%6.2" "U/min" COEFFS 0 1 0 0 0 1 /end COMPU_METHOD
/begin COMPU_METHOD nmot_sw_q0p25 "" RAT_FUNC "%6.3" "U/min" COEFFS 0 1 0 0 0 0.25 /end COMPU_METHOD
/begin COMPU_METHOD nmot_ub_q10 "" RAT_FUNC "%6.1" "U/min" COEFFS 0 1 0 0 0 10 /end COMPU_METHOD
/begin COMPU_METHOD nmot_ub_q40 "" RAT_FUNC "%6.1" "Upm" COEFFS 0 1 0 0 0 40 /end COMPU_METHOD
/begin COMPU_METHOD nmot_uw_q0p25 "" RAT_FUNC "%6.3" "U/min" COEFFS 0 1 0 0 0 0.25 /end COMPU_METHOD
/begin COMPU_METHOD relDK_ub_b100 "" RAT_FUNC "%6.3" "% DK" COEFFS 0 255 0 0 0 100 /end COMPU_METHOD
/begin COMPU_METHOD relPED_ub_b100 "" RAT_FUNC "%6.3" "% PED" COEFFS 0 255 0 0 0 100 /end COMPU_METHOD
/begin COMPU_METHOD relPED_uw_b100 "" RAT_FUNC "%6.4" "% PED" COEFFS 0 65535 0 0 0 100 /end COMPU_METHOD
/begin COMPU_METHOD rel_q0p002383 "" RAT_FUNC "%6.4" "%/(s*U/min)" COEFFS 0 256 0 0 0 0.61 /end COMPU_METHOD
/begin COMPU_METHOD rel_q0p00305 "" RAT_FUNC "%6.4" "%/(U/min)" COEFFS 0 256 0 0 0 0.7812 /end COMPU_METHOD
/begin COMPU_METHOD rel_qn0p000488 "" RAT_FUNC "%8.7" "(%*s)/(U/min)" COEFFS 0 -256 0 0 0 0.125 /end COMPU_METHOD
/begin COMPU_METHOD rel_sb_b25 "" RAT_FUNC "%6.3" "%" COEFFS 0 128 0 0 0 25 /end COMPU_METHOD
/begin COMPU_METHOD rel_sb_q0p02 "" RAT_FUNC "%6.4" "%" COEFFS 0 50 0 0 0 1 /end COMPU_METHOD
/begin COMPU_METHOD rel_sb_q0p39 "" RAT_FUNC "%6.3" "%" COEFFS 0 1 0 0 0 0.3906 /end COMPU_METHOD
/begin COMPU_METHOD rel_sw_b100 "" RAT_FUNC "%6.4" "%" COEFFS 0 32768 0 0 0 100 /end COMPU_METHOD
/begin COMPU_METHOD rel_sw_b1536 "" RAT_FUNC "%6.4" "%" COEFFS 0 65536 0 0 0 3072 /end COMPU_METHOD
/begin COMPU_METHOD rel_sw_b192 "" RAT_FUNC "%6.4" "%" COEFFS 0 65536 0 0 0 384 /end COMPU_METHOD
/begin COMPU_METHOD rel_sw_b50 "" RAT_FUNC "%6.4" "%" COEFFS 0 65536 0 0 0 100 /end COMPU_METHOD
/begin COMPU_METHOD rel_sw_q0p0234 "" RAT_FUNC "%6.4" "%/seg" COEFFS 0 32 0 0 0 0.75 /end COMPU_METHOD
/begin COMPU_METHOD rel_ub_b127p5 "" RAT_FUNC "%6.3" "%" COEFFS 0 2 0 0 0 1 /end COMPU_METHOD
/begin COMPU_METHOD rel_ub_b1p0 "" RAT_FUNC "%6.4" "%" COEFFS 0 256 0 0 0 1 /end COMPU_METHOD
/begin COMPU_METHOD rel_ub_b24p9 "" RAT_FUNC "%6.3" "%" COEFFS 0 255 0 0 0 24.9 /end COMPU_METHOD
/begin COMPU_METHOD rel_ub_b99p6 "" RAT_FUNC "%6.3" "%" COEFFS 0 256 0 0 0 100 /end COMPU_METHOD
/begin COMPU_METHOD rel_ub_bn24p9 "" RAT_FUNC "%6.5" "%" COEFFS 0 -255 0 0 0 24.9 /end COMPU_METHOD
/begin COMPU_METHOD rel_ub_q0p00153 "" RAT_FUNC "%6.4" "%" COEFFS 0 256 0 0 0 0.3906 /end COMPU_METHOD
/begin COMPU_METHOD rel_ub_q0p75 "" RAT_FUNC "%6.3" "%" COEFFS 0 1 0 0 0 0.75 /end COMPU_METHOD
/begin COMPU_METHOD rel_uw_b100 "" RAT_FUNC "%6.4" "%" COEFFS 0 65536 0 0 0 100 /end COMPU_METHOD
/begin COMPU_METHOD rel_uw_b200 "" RAT_FUNC "%6.4" "%" COEFFS 0 65536 0 0 0 200 /end COMPU_METHOD
/begin COMPU_METHOD rel_uw_q0p001 "" RAT_FUNC "%6.5" "%" COEFFS 0 1000 0 0 0 1 /end COMPU_METHOD
/begin COMPU_METHOD rel_uw_q0p0234 "" RAT_FUNC "%6.4" "%" COEFFS 0 32 0 0 0 0.75 /end COMPU_METHOD
/begin COMPU_METHOD rfak_q0p5 "" RAT_FUNC "%6.2" "-" COEFFS 0 0 128 0 1 0 /end COMPU_METHOD
/begin COMPU_METHOD spg_ub_q0p0052_o0p2 "" RAT_FUNC "%6.3" "V" COEFFS 0 255 51 0 0 1.33 /end COMPU_METHOD
/begin COMPU_METHOD spg_uw_q0p00488_o1 "" RAT_FUNC "%6.3" "V" COEFFS 0 1024 1024 0 0 5 /end COMPU_METHOD
/begin COMPU_METHOD t100msxs_ub_b25p5 "" RAT_FUNC "%6.3" "s" COEFFS 0 1 0 0 0 0.1 /end COMPU_METHOD
/begin COMPU_METHOD t100msxs_uw_b6553p5 "" RAT_FUNC "%6.3" "s" COEFFS 0 1 0 0 0 0.1 /end COMPU_METHOD
/begin COMPU_METHOD t10msxs_ub_b2p55 "" RAT_FUNC "%6.4" "s" COEFFS 0 1 0 0 0 0.01 /end COMPU_METHOD
/begin COMPU_METHOD t10msxs_uw_b655p35 "" RAT_FUNC "%6.4" "s" COEFFS 0 1 0 0 0 0.01 /end COMPU_METHOD
/begin COMPU_METHOD t1sxs_ub_b255 "" RAT_FUNC "%6.2" "s" COEFFS 0 1 0 0 0 1 /end COMPU_METHOD
/begin COMPU_METHOD t1sxs_uw_b65535 "" RAT_FUNC "%6.2" "s" COEFFS 0 1 0 0 0 1 /end COMPU_METHOD
/begin COMPU_METHOD t200msxs_ub_b51 "" RAT_FUNC "%6.3" "s" COEFFS 0 1 0 0 0 0.2 /end COMPU_METHOD
/begin COMPU_METHOD t200msxs_uw_q0p2 "" RAT_FUNC "%6.3" "s" COEFFS 0 1 0 0 0 0.2 /end COMPU_METHOD
/begin COMPU_METHOD t20msxs_ub_b5p1 "" RAT_FUNC "%6.4" "s" COEFFS 0 1 0 0 0 0.02 /end COMPU_METHOD
/begin COMPU_METHOD t20msxs_uw_q0p02 "" RAT_FUNC "%6.4" "s" COEFFS 0 1 0 0 0 0.02 /end COMPU_METHOD
/begin COMPU_METHOD temp_q0p0234_o273 "" RAT_FUNC "%6.1" "Grad C" COEFFS 0 1 273.15 0 0 0.0234375 /end COMPU_METHOD
/begin COMPU_METHOD temp_sb_q0p75 "" RAT_FUNC "%6.3" "Grad C" COEFFS 0 1 0 0 0 0.75 /end COMPU_METHOD
/begin COMPU_METHOD temp_ub_b191p25 "" RAT_FUNC "%6.3" "Grad C" COEFFS 0 1 0 0 0 0.75 /end COMPU_METHOD
/begin COMPU_METHOD temp_ub_q0p75_o48 "" RAT_FUNC "%6.2" "Grad C" COEFFS 0 1 48 0 0 0.75 /end COMPU_METHOD
/begin COMPU_METHOD temp_ub_q1_o60 "" RAT_FUNC "%6.2" "Grad C" COEFFS 0 1 60 0 0 1 /end COMPU_METHOD
/begin COMPU_METHOD temp_ub_q5_o50 "" RAT_FUNC "%6.2" "Grad C" COEFFS 0 1 50 0 0 5 /end COMPU_METHOD
/begin COMPU_METHOD temp_uw_q0p0195_o50 "" RAT_FUNC "%6.2" "Grad C" COEFFS 0 256 12800 0 0 5 /end COMPU_METHOD
/begin COMPU_METHOD tz10msxs_uw_b327p68 "" RAT_FUNC "%6.2" "s" COEFFS 0 0 327.68 0 1 0 /end COMPU_METHOD
/begin COMPU_METHOD t_q0p02 "" RAT_FUNC "%6.4" "s" COEFFS 0 100 0 0 0 2 /end COMPU_METHOD
/begin COMPU_METHOD vfzg_ub_q1p25 "" RAT_FUNC "%6.2" "km/h" COEFFS 0 1 0 0 0 1.25 /end COMPU_METHOD
/begin COMPU_METHOD zk10msxs_ub_b2p55 "" RAT_FUNC "%6.4" "s" COEFFS 0 0 255 0 100 0 /end COMPU_METHOD
/begin COMPU_METHOD zk10msxs_uw_b655 "" RAT_FUNC "%12.5" "s" COEFFS 0 0 65536 0 100 0 /end COMPU_METHOD
/begin COMPU_METHOD zk200msxs_ub_b51p2 "" RAT_FUNC "%6.3" "s" COEFFS 0 0 255 0 5 0 /end COMPU_METHOD
/begin COMPU_METHOD zk200msxs_uw_b5 "" RAT_FUNC "%7.6" "1/s" COEFFS 0 65536 0 0 0 5 /end COMPU_METHOD
/begin COMPU_METHOD zk200msxs_uw_b960 "" RAT_FUNC "%6.4" "%/s" COEFFS 0 65536 0 0 0 960 /end COMPU_METHOD
/begin COMPU_METHOD zk20msxs_ub_b5p1 "" RAT_FUNC "%6.4" "s" COEFFS 0 0 5.1 0 1 0 /end COMPU_METHOD
/begin COMPU_METHOD zk20msxs_uw_b1310p72 "" RAT_FUNC "%12.4" "s" COEFFS 0 0 32768 0 25 0 /end COMPU_METHOD
/begin COMPU_METHOD zw_sb_q0p75 "" RAT_FUNC "%6.3" "grad KW" COEFFS 0 255 0 0 0 191.25 /end COMPU_METHOD
/begin COMPU_METHOD zw_uw_q0p75 "" RAT_FUNC "%6.3" "Grad KW" COEFFS 0 1 0 0 0 0.75 /end COMPU_METHOD
/begin RECORD_LAYOUT FklWUb FNC_VALUES 1 UBYTE COLUMN_DIR DIRECT /end RECORD_LAYOUT
/begin RECORD_LAYOUT FklWUw FNC_VALUES 1 UWORD COLUMN_DIR DIRECT /end RECORD_LAYOUT
/begin RECORD_LAYOUT GkfWSb FNC_VALUES 1 SBYTE COLUMN_DIR DIRECT /end RECORD_LAYOUT
/begin RECORD_LAYOUT GkfWSw FNC_VALUES 1 SWORD COLUMN_DIR DIRECT /end RECORD_LAYOUT
/begin RECORD_LAYOUT GkfWUb FNC_VALUES 1 UBYTE COLUMN_DIR DIRECT /end RECORD_LAYOUT
/begin RECORD_LAYOUT GkfWUw FNC_VALUES 1 UWORD COLUMN_DIR DIRECT /end RECORD_LAYOUT
/begin RECORD_LAYOUT GklWSb FNC_VALUES 1 SBYTE COLUMN_DIR DIRECT /end RECORD_LAYOUT
/begin RECORD_LAYOUT GklWSw FNC_VALUES 1 SWORD COLUMN_DIR DIRECT /end RECORD_LAYOUT
/begin RECORD_LAYOUT GklWUb FNC_VALUES 1 UBYTE COLUMN_DIR DIRECT /end RECORD_LAYOUT
/begin RECORD_LAYOUT KfAxUbAyUbSstxSwSstyUbWSw NO_AXIS_PTS_X 1 UBYTE NO_AXIS_PTS_Y 2 UBYTE AXIS_PTS_X 3 SWORD INDEX_INCR DIRECT AXIS_PTS_Y 4 UBYTE INDEX_INCR DIRECT FNC_VALUES 5 SWORD COLUMN_DIR DIRECT /end RECORD_LAYOUT
/begin RECORD_LAYOUT KfAxUbAyUbSstxSwSstyUbWUw NO_AXIS_PTS_X 1 UBYTE NO_AXIS_PTS_Y 2 UBYTE AXIS_PTS_X 3 SWORD INDEX_INCR DIRECT AXIS_PTS_Y 4 UBYTE INDEX_INCR DIRECT FNC_VALUES 5 UWORD COLUMN_DIR DIRECT /end RECORD_LAYOUT
/begin RECORD_LAYOUT KfAxUbAyUbSstxUbSstyUbWUb NO_AXIS_PTS_X 1 UBYTE NO_AXIS_PTS_Y 2 UBYTE AXIS_PTS_X 3 UBYTE INDEX_INCR DIRECT AXIS_PTS_Y 4 UBYTE INDEX_INCR DIRECT FNC_VALUES 5 UBYTE COLUMN_DIR DIRECT /end RECORD_LAYOUT
/begin RECORD_LAYOUT KfAxUbAyUbSstxUbSstyUwWUw NO_AXIS_PTS_X 1 UBYTE NO_AXIS_PTS_Y 2 UBYTE AXIS_PTS_X 3 UBYTE INDEX_INCR DIRECT AXIS_PTS_Y 4 UWORD INDEX_INCR DIRECT FNC_VALUES 5 UWORD COLUMN_DIR DIRECT /end RECORD_LAYOUT
/begin RECORD_LAYOUT KfAxUwAyUwSstxSwSstyUwWUw NO_AXIS_PTS_X 1 UWORD NO_AXIS_PTS_Y 2 UWORD AXIS_PTS_X 3 SWORD INDEX_INCR DIRECT AXIS_PTS_Y 4 UWORD INDEX_INCR DIRECT FNC_VALUES 5 UWORD COLUMN_DIR DIRECT /end RECORD_LAYOUT
/begin RECORD_LAYOUT KfAxUwAyUwSstxUwSstyUwWUw NO_AXIS_PTS_X 1 UWORD NO_AXIS_PTS_Y 2 UWORD AXIS_PTS_X 3 UWORD INDEX_INCR DIRECT AXIS_PTS_Y 4 UWORD INDEX_INCR DIRECT FNC_VALUES 5 UWORD COLUMN_DIR DIRECT /end RECORD_LAYOUT
/begin RECORD_LAYOUT KlAUbSstSbWUb NO_AXIS_PTS_X 1 UBYTE AXIS_PTS_X 2 SBYTE INDEX_INCR DIRECT FNC_VALUES 3 UBYTE COLUMN_DIR DIRECT /end RECORD_LAYOUT
/begin RECORD_LAYOUT KlAUbSstUbWSb NO_AXIS_PTS_X 1 UBYTE AXIS_PTS_X 2 UBYTE INDEX_INCR DIRECT FNC_VALUES 3 SBYTE COLUMN_DIR DIRECT /end RECORD_LAYOUT
/begin RECORD_LAYOUT KlAUbSstUbWUb NO_AXIS_PTS_X 1 UBYTE AXIS_PTS_X 2 UBYTE INDEX_INCR DIRECT FNC_VALUES 3 UBYTE COLUMN_DIR DIRECT /end RECORD_LAYOUT
/begin RECORD_LAYOUT KlAUbSstUbWUw NO_AXIS_PTS_X 1 UBYTE AXIS_PTS_X 2 UBYTE INDEX_INCR DIRECT FNC_VALUES 3 UWORD COLUMN_DIR DIRECT /end RECORD_LAYOUT
/begin RECORD_LAYOUT KlAUbSstUwWUb NO_AXIS_PTS_X 1 UWORD AXIS_PTS_X 2 UWORD INDEX_INCR DIRECT FNC_VALUES 3 UBYTE COLUMN_DIR DIRECT /end RECORD_LAYOUT
/begin RECORD_LAYOUT KlAUbSstUwWUw NO_AXIS_PTS_X 1 UWORD AXIS_PTS_X 2 UWORD INDEX_INCR DIRECT FNC_VALUES 3 UWORD COLUMN_DIR DIRECT /end RECORD_LAYOUT
/begin RECORD_LAYOUT KlAUwSstSwWUw NO_AXIS_PTS_X 1 UWORD AXIS_PTS_X 2 SWORD INDEX_INCR DIRECT FNC_VALUES 3 UWORD COLUMN_DIR DIRECT /end RECORD_LAYOUT
/begin RECORD_LAYOUT KlAUwSstUwWUb NO_AXIS_PTS_X 1 UWORD AXIS_PTS_X 2 UWORD INDEX_INCR DIRECT FNC_VALUES 3 UBYTE COLUMN_DIR DIRECT /end RECORD_LAYOUT
/begin RECORD_LAYOUT KlAUwSstUwWUw NO_AXIS_PTS_X 1 UWORD AXIS_PTS_X 2 UWORD INDEX_INCR DIRECT FNC_VALUES 3 UWORD COLUMN_DIR DIRECT /end RECORD_LAYOUT
/begin RECORD_LAYOUT KwSb FNC_VALUES 1 SBYTE COLUMN_DIR DIRECT /end RECORD_LAYOUT
/begin RECORD_LAYOUT KwSw FNC_VALUES 1 SWORD COLUMN_DIR DIRECT /end RECORD_LAYOUT
/begin RECORD_LAYOUT KwUb FNC_VALUES 1 UBYTE COLUMN_DIR DIRECT /end RECORD_LAYOUT
/begin RECORD_LAYOUT KwUw FNC_VALUES 1 UWORD COLUMN_DIR DIRECT /end RECORD_LAYOUT
/begin RECORD_LAYOUT SstASwSstSw NO_AXIS_PTS_X 1 SWORD AXIS_PTS_X 2 SWORD INDEX_INCR DIRECT /end RECORD_LAYOUT
/begin RECORD_LAYOUT SstAUbSstSb NO_AXIS_PTS_X 1 UBYTE AXIS_PTS_X 2 SBYTE INDEX_INCR DIRECT /end RECORD_LAYOUT
/begin RECORD_LAYOUT SstAUbSstUb NO_AXIS_PTS_X 1 UBYTE AXIS_PTS_X 2 UBYTE INDEX_INCR DIRECT /end RECORD_LAYOUT
/begin RECORD_LAYOUT SstAUwSstUw NO_AXIS_PTS_X 1 UWORD AXIS_PTS_X 2 UWORD INDEX_INCR DIRECT /end RECORD_LAYOUT
/end MODULE
/end PROJECT
