ASAP2_VERSION 1 3
/begin PROJECT X505P_24HG_1 "X505P"
/begin HEADER "" VERSION "X505P_24HG_1" PROJECT_NO X505P_24HG_1 /end HEADER
/begin MODULE DIM ""
/begin MOD_COMMON "" BYTE_ORDER MSB_LAST ALIGNMENT_BYTE 1 ALIGNMENT_WORD 2 ALIGNMENT_LONG 2 /end MOD_COMMON
/begin CHARACTERISTIC ADCC_T_UM "Fehlerzeit bei zueinander unplausiblen ADC-Werten für sp1s" VALUE 0x814212 KwUb 2.550 t10msxs_ub_b2p55 0.00 2.550 FORMAT "%5.3" /end CHARACTERISTIC
/begin CHARACTERISTIC ASRL_DAT_UC "" VAL_BLK 0x811B97 KwbUb 99.61 rel_ub_q0p3906 0.00 99.61 FORMAT "%5.2" NUMBER 16 /end CHARACTERISTIC
/begin CHARACTERISTIC ASRS_DAT_UC "" VAL_BLK 0x811BA7 KwbUb 99.61 rel_ub_q0p3906 0.00 99.61 FORMAT "%5.2" NUMBER 16 /end CHARACTERISTIC
/begin CHARACTERISTIC AUSGH_T_UM "Heilungszeit für Fehler in der zyklischen RAM-Prüfung der Funktionsüberwachung" VALUE 0x814216 KwUb 10200.0 t40ms_ub_b10200 0.00 10200.0 FORMAT "%7.1" /end CHARACTERISTIC
/begin CHARACTERISTIC AUSG_T_UM "Fehlertoleranzschwelle für zyklische RAM-Prüfung in der Funktionsüberwachung" VALUE 0x814217 KwUb 255.0 dezsub1 1.000 256.0 FORMAT "%5.1" /end CHARACTERISTIC
/begin CHARACTERISTIC AUSZH_T_UM "Heilungszeit für Fehler in der zyklischen ROM-Prüfung der Funktionsüberwachung" VALUE 0x814218 KwUb 10200.0 t40ms_ub_b10200 0.00 10200.0 FORMAT "%7.1" /end CHARACTERISTIC
/begin CHARACTERISTIC AUSZ_T_UM "Fehlertoleranzschwelle für zyklische ROM-Prüfung in der Funktionsüberwachung" VALUE 0x814219 KwUb 255.0 dezsub1 1.000 256.0 FORMAT "%5.1" /end CHARACTERISTIC
/begin CHARACTERISTIC BFGR_DAT_UC "" VAL_BLK 0x811BB7 KwbUb 255.0 dez 0.00 255.0 FORMAT "%5.1" NUMBER 16 /end CHARACTERISTIC
/begin CHARACTERISTIC BNOMSR_DAT_UC "" VAL_BLK 0x811BC7 KwbUb 255.0 dez 0.00 255.0 FORMAT "%5.1" NUMBER 16 /end CHARACTERISTIC
/begin CHARACTERISTIC BZMSRA_DAT_UC "" VAL_BLK 0x811BD7 KwbUb 255.0 dez 0.00 255.0 FORMAT "%5.1" NUMBER 16 /end CHARACTERISTIC
/begin CHARACTERISTIC BZMSR_DAT_UC "" VAL_BLK 0x811BE7 KwbUb 255.0 dez 0.00 255.0 FORMAT "%5.1" NUMBER 16 /end CHARACTERISTIC
/begin CHARACTERISTIC BZ_MSR_UC "" VALUE 0x811E38 KwUb 255.0 dez 0.00 255.0 FORMAT "%5.1" /end CHARACTERISTIC
/begin CHARACTERISTIC BZ_ST_DAT_UC "" VAL_BLK 0x811BF7 KwbUb 255.0 dez 0.00 255.0 FORMAT "%5.1" NUMBER 16 /end CHARACTERISTIC
/begin CHARACTERISTIC CBIT_DAT_UC "" VAL_BLK 0x811C07 KwbUb 255.0 dez 0.00 255.0 FORMAT "%5.1" NUMBER 16 /end CHARACTERISTIC
/begin CHARACTERISTIC CMSR_DAT_UC "" VAL_BLK 0x811C17 KwbUb 99.61 rel_ub_q0p3906 0.00 99.61 FORMAT "%5.2" NUMBER 16 /end CHARACTERISTIC
/begin CHARACTERISTIC CNOKT "Codewort Niederoktan-Kraftstoff" VALUE 0x81A61B KwUb 255.0 dez 0.00 255.0 FORMAT "%5.1" /end CHARACTERISTIC
/begin CHARACTERISTIC CWKHZW "Codewort für spätesten Zündwinkel bei Katheizen" VALUE 0x812243 KwUb 255.0 dez 0.00 255.0 FORMAT "%5.1" /end CHARACTERISTIC
/begin CHARACTERISTIC CWVSV "Codewort für Deaktivierung VS_VERST (CWVSV = 0: VS_VERST nicht aktiv)" VALUE 0x810167 KwUb 255.0 dez 0.00 255.0 FORMAT "%5.1" /end CHARACTERISTIC
/begin CHARACTERISTIC CWWDKSOM "Codewort WDKSOM (Winkel DK ohne Momentenstruktur)" VALUE 0x810ECB KwUb 255.0 dez 0.00 255.0 FORMAT "%5.1" /end CHARACTERISTIC
/begin CHARACTERISTIC CW_FUBND "Codewort für Funkenbandzündung" VALUE 0x81A79C KwUb 255.0 dez 0.00 255.0 FORMAT "%5.1" /end CHARACTERISTIC
/begin CHARACTERISTIC CW_NOROMCHKRESET "" VALUE 0x811FD3 KwUb 255.0 dez 0.00 255.0 FORMAT "%5.1" /end CHARACTERISTIC
/begin CHARACTERISTIC DBZ_MN_UC "kleinstes zulässiges Delta des Botschaftszählers f. Befehlstest" VALUE 0x811E39 KwUb 255.0 dez 0.00 255.0 FORMAT "%5.1" /end CHARACTERISTIC
/begin CHARACTERISTIC DBZ_MX_UC "größtes zulässiges Delta des Botschaftszählers f. Befehlstest" VALUE 0x811E3A KwUb 255.0 dez 0.00 255.0 FORMAT "%5.1" /end CHARACTERISTIC
/begin CHARACTERISTIC DNTIPDYN "Einschaltschwelle Drehzahdynamik für Tip-In Offset auf spätesten Zündwinkel" VALUE 0x812244 KwSb 25500. nmotg_sb_q100 -12800. 12700. FORMAT "%5.0" /end CHARACTERISTIC
/begin CHARACTERISTIC DNZWMN "Drehzahloffset auf nstat für Abschalten des Tip-In ZW-Offsets" VALUE 0x812245 KwUb 10200. nmot_ub_q40 0.00 10200. FORMAT "%5.0" /end CHARACTERISTIC
/begin CHARACTERISTIC DTSDRL "Laständerungsgradientenschwelle für Lastdynamikauslösung" VALUE 0x817A5E KwSw 1535.977 rel_sw_q0p0234 -768.0000 767.9766 FORMAT "%8.4" /end CHARACTERISTIC
/begin CHARACTERISTIC DUBZS "Spannungsversatz zwischen SG und ZS" VALUE 0x81A79D KwUb 17.95 spg_ubatt 0.00 17.95 FORMAT "%5.2" /end CHARACTERISTIC
/begin CHARACTERISTIC DZWAML "Auf/Abregelgeschwindigkeit zwischen den Begrenzungskennfeldern" CURVE 0x828DB0 KlAUbSstUbWSb 94.50 zw_sb_q0p75 0.7500 95.25 FORMAT "%5.2"
 /begin AXIS_DESCR STD_AXIS ml m_ub_b1020 12 0.00 1020. FORMAT "%5.0" DEPOSIT ABSOLUTE /end AXIS_DESCR
/end CHARACTERISTIC
/begin CHARACTERISTIC DZWDYN "Frühverschiebung des Brenngrenzenzündwinkels bei Tip-In" CURVE 0x81A60F GklWSb 191.3 zw_sb_q0p75 -96.00 95.25 FORMAT "%5.2"
 /begin AXIS_DESCR COM_AXIS tmot temp_ub_q0p75_o48 6 -48.00 143.3 AXIS_PTS_REF STM06__UB /end AXIS_DESCR
/end CHARACTERISTIC
/begin CHARACTERISTIC DZWNWSUE "Delta Zündwinkel abhängig von Nockenwellenüberschneidung" CURVE 0x817A16 KlAUbSstUbWSb 191.3 zw_sb_q0p75 -96.00 95.25 FORMAT "%5.2"
 /begin AXIS_DESCR STD_AXIS wnwue kw_q0p5 10 0.00 127.5 FORMAT "%5.1" DEPOSIT ABSOLUTE /end AXIS_DESCR
/end CHARACTERISTIC
/begin CHARACTERISTIC DZWSPM "Delta spätester Zündwinkel abhängig von Motortemperatur" CURVE 0x81A615 GklWSb 191.3 zw_sb_q0p75 -96.00 95.25 FORMAT "%5.2"
 /begin AXIS_DESCR COM_AXIS tmot temp_ub_q0p75_o48 6 -48.00 143.3 AXIS_PTS_REF STM06__UB /end AXIS_DESCR
/end CHARACTERISTIC
/begin CHARACTERISTIC DZWSTTA "Delta Zündwinkel im Start (VVT)" CURVE 0x828E52 KlAUbSstUbWSb 191.3 zw_sb_q0p75 -96.00 95.25 FORMAT "%5.2"
 /begin AXIS_DESCR STD_AXIS tans temp_ub_q0p75_o48 6 -48.00 143.3 FORMAT "%5.1" DEPOSIT ABSOLUTE /end AXIS_DESCR
/end CHARACTERISTIC
/begin CHARACTERISTIC EVZ_DAT_UC "" VAL_BLK 0x811C27 KwbUb 255.0 dez 0.00 255.0 FORMAT "%5.1" NUMBER 16 /end CHARACTERISTIC
/begin CHARACTERISTIC FFLDZ "Folgefunkenladezeit" CURVE 0x828E60 KlAUbSstUbWUw 43.69000 tsegment_sy 0.00 43.69000 FORMAT "%8.5"
 /begin AXIS_DESCR STD_AXIS ub spg_ubatt 8 0.00 17.95 FORMAT "%5.2" DEPOSIT ABSOLUTE /end AXIS_DESCR
/end CHARACTERISTIC
/begin CHARACTERISTIC FSWTM "Faktor Schließwinkelkorrektur tmot-abhängig" CURVE 0x81A79E KlAUbSstUbWUb 1.992 fak_ub_b2 0.00 1.992 FORMAT "%5.3"
 /begin AXIS_DESCR STD_AXIS tmot temp_ub_q0p75_o48 5 -48.00 143.3 FORMAT "%5.1" DEPOSIT ABSOLUTE /end AXIS_DESCR
/end CHARACTERISTIC
/begin CHARACTERISTIC FSZTM "Faktor Schließzeitkorrektur tmot-abhängig" CURVE 0x81A7A9 KlAUbSstUbWUb 1.992 fak_ub_b2 0.00 1.992 FORMAT "%5.3"
 /begin AXIS_DESCR STD_AXIS tmot temp_ub_q0p75_o48 5 -48.00 143.3 FORMAT "%5.1" DEPOSIT ABSOLUTE /end AXIS_DESCR
/end CHARACTERISTIC
/begin CHARACTERISTIC FTOMN "minimale Öffnungszeit" VALUE 0x81A7B4 KwUb 25.50 txms_ub_q0p1 0.00 25.50 FORMAT "%5.2" /end CHARACTERISTIC
/begin CHARACTERISTIC FTSDRLW "Faktor Schließzeit bei Lastdynamik" CURVE 0x817A60 KlAUwSstSwWUw 7.999878 fak_uw_b8 0.00 7.999878 FORMAT "%8.6"
 /begin AXIS_DESCR STD_AXIS tsdrlmx_w rel_sw_q0p0234 6 -768.0000 767.9766 FORMAT "%8.4" DEPOSIT ABSOLUTE /end AXIS_DESCR
/end CHARACTERISTIC
/begin CHARACTERISTIC FUBAOF "Offenzeit für Funkenbandzündung" VALUE 0x828E7A KwUw 43.69000 tsegment_sy 0.00 43.69000 FORMAT "%8.5" /end CHARACTERISTIC
/begin CHARACTERISTIC FWNMOT "Einschaltschwelle nmot für Funkenbandzündung" VALUE 0x81A7B5 KwUb 10200. nmot_ub_q40 0.00 10200. FORMAT "%5.0" /end CHARACTERISTIC
/begin CHARACTERISTIC FZWKHMX "Normierung für Faktor Momentenreserve Katheizen" VALUE 0x812246 KwUb 0.9961 fak_ub_b1 0.00 0.9961 /end CHARACTERISTIC
/begin CHARACTERISTIC FZWWLRLN "Wichtung Delta-Zündwinkel im Warmlauf" MAP 0x812621 GkfWUb 1.992 fak_ub_b2 0.00 1.992 FORMAT "%5.3"
 /begin AXIS_DESCR COM_AXIS nmot nmot_ub_q40 12 0.00 10200. AXIS_PTS_REF SNM12ESUB /end AXIS_DESCR
 /begin AXIS_DESCR COM_AXIS rl rel_ub_q0p75 6 0.00 191.3 AXIS_PTS_REF SRL06ESUB /end AXIS_DESCR
/end CHARACTERISTIC
/begin CHARACTERISTIC IP1A_MX_UM "max. Spannung für DK-Istwert-Poti 1 am unteren Anschlag für die Funktionsüberw." VALUE 0x814016 KwUb 4.9805 spg_ub_q0p019 0.00 4.9805 /end CHARACTERISTIC
/begin CHARACTERISTIC IP2A_MN_UM "min. Spannung für DK-Istwert-Poti 2 am unteren Anschlag für die Funktionsüberw." VALUE 0x814017 KwUb 4.9805 spg_ub_q0p019 0.00 4.9805 /end CHARACTERISTIC
/begin CHARACTERISTIC IPA_T_UM "Fehlertoleranzzeit für unteren DK-Anschlag im ungültigen Bereich f. d. Fktüberw." VALUE 0x814018 KwUb 10200.0 t40ms_ub_b10200 0.00 10200.0 FORMAT "%7.1" /end CHARACTERISTIC
/begin CHARACTERISTIC KFDZK "delta Zündwinkel bei Dauerklopfen" MAP 0x81A61C GkfWSb 191.3 zw_sb_q0p75 -96.00 95.25 FORMAT "%5.2"
 /begin AXIS_DESCR COM_AXIS nmot_w nmot_uw_q0p25 16 0.00 16383.75 AXIS_PTS_REF SNM16ZUUW /end AXIS_DESCR
 /begin AXIS_DESCR COM_AXIS rl_w rel_uw_q0p0234 12 0.00 1535.977 AXIS_PTS_REF SRL12ZUUW /end AXIS_DESCR
/end CHARACTERISTIC
/begin CHARACTERISTIC KFDZMNST "Min-Zündwinkeloffset im Nachstart - Regelung des Startüberschwingers" MAP 0x812247 GkfWSb 191.3 zw_sb_q0p75 -96.00 95.25 FORMAT "%5.2"
 /begin AXIS_DESCR COM_AXIS nmot_w nmot_uw_q0p25 4 0.00 16383.75 AXIS_PTS_REF SNM04ZUUW /end AXIS_DESCR
 /begin AXIS_DESCR COM_AXIS dns nmotd_sb_q10 4 -1280. 1270. AXIS_PTS_REF SNS04ZUSB /end AXIS_DESCR
/end CHARACTERISTIC
/begin CHARACTERISTIC KFDZWKG "Zündwinkelkorrektur durch Verschieben der Klopfgrenze" MAP 0x828E1A KfAxUbAyUbSstxUbSstyUbWSb 191.3 zw_sb_q0p75 -96.00 95.25 FORMAT "%5.2"
 /begin AXIS_DESCR STD_AXIS nmot nmot_ub_q40 8 0.00 10200. FORMAT "%5.0" DEPOSIT ABSOLUTE /end AXIS_DESCR
 /begin AXIS_DESCR STD_AXIS lambas fak_ub_b2 5 0.00 1.992 FORMAT "%5.3" DEPOSIT ABSOLUTE /end AXIS_DESCR
/end CHARACTERISTIC
/begin CHARACTERISTIC KFDZWOB "Delta Zündwinkel Zündwinkeloverboost" MAP 0x828D5A KfAxUbAyUbSstxUbSstyUbWSb 191.3 zw_sb_q0p75 -96.00 95.25 FORMAT "%5.2"
 /begin AXIS_DESCR STD_AXIS nmot nmot_ub_q40 4 0.00 10200. FORMAT "%5.0" DEPOSIT ABSOLUTE /end AXIS_DESCR
 /begin AXIS_DESCR STD_AXIS rl rel_ub_q0p75 4 0.00 191.3 FORMAT "%5.1" DEPOSIT ABSOLUTE /end AXIS_DESCR
/end CHARACTERISTIC
/begin CHARACTERISTIC KFFFANZ "Anzahl Folgefunken" MAP 0x81A7B6 KfAxUbAyUbSstxUbSstyUbWUb 255.0 dez 0.00 255.0 FORMAT "%5.1"
 /begin AXIS_DESCR STD_AXIS tmot temp_ub_q0p75_o48 8 -48.00 143.3 FORMAT "%5.1" DEPOSIT ABSOLUTE /end AXIS_DESCR
 /begin AXIS_DESCR STD_AXIS nmot nmot_ub_q40 5 0.00 10200. FORMAT "%5.0" DEPOSIT ABSOLUTE /end AXIS_DESCR
/end CHARACTERISTIC
/begin CHARACTERISTIC KFMDZOF_UC "Kennfeld für Offset-Toleranz in Abhängigkeit vom zul. Moment im Befehlstest" MAP 0x811EF2 GkfWUb 99.61 rel_ub_b99p6 0.00 99.61 FORMAT "%5.2"
 /begin AXIS_DESCR COM_AXIS mz_uc rel_ub_b99p6 8 0.00 99.61 AXIS_PTS_REF MDV08_UC /end AXIS_DESCR
 /begin AXIS_DESCR COM_AXIS nmot_uc nmot_ub_q40 8 0.00 10200. AXIS_PTS_REF NMV08_UC /end AXIS_DESCR
/end CHARACTERISTIC
/begin CHARACTERISTIC KFMDZOF_UM "Kennfeld für Offset-Toleranz in Abhängigkeit vom zulässigen Moment" MAP 0x814131 GkfWUb 99.61 rel_ub_b99p6 0.00 99.61 FORMAT "%5.2"
 /begin AXIS_DESCR COM_AXIS mz_um rel_ub_b99p6 8 0.00 99.61 AXIS_PTS_REF MDV08_UM /end AXIS_DESCR
 /begin AXIS_DESCR COM_AXIS nmot_um nmot_ub_q40 8 0.00 10200. AXIS_PTS_REF NMV08_UM /end AXIS_DESCR
/end CHARACTERISTIC
/begin CHARACTERISTIC KFMI_UC "Kennfeld optimales Motormoment im Befehlstest" MAP 0x811E61 GkfWUb 99.61 rel_ub_b99p6 0.00 99.61 FORMAT "%5.2"
 /begin AXIS_DESCR COM_AXIS rl_uc rel_ub_q0p75 8 0.00 191.3 AXIS_PTS_REF RLV08_UC /end AXIS_DESCR
 /begin AXIS_DESCR COM_AXIS nmot_uc nmot_ub_q40 8 0.00 10200. AXIS_PTS_REF NZWV08_UC /end AXIS_DESCR
/end CHARACTERISTIC
/begin CHARACTERISTIC KFMPED_UC "Kennfeld für zulässiges Moment aus der Pedalstellung im Befehlstest" MAP 0x811F32 GkfWUb 99.61 rel_ub_b99p6 0.00 99.61 FORMAT "%5.2"
 /begin AXIS_DESCR COM_AXIS spsn_uc spg_ub_q0p019 8 0.00 4.9805 AXIS_PTS_REF SPSNV08_UC /end AXIS_DESCR
 /begin AXIS_DESCR COM_AXIS nmot_uc nmot_ub_q40 8 0.00 10200. AXIS_PTS_REF NMV08_UC /end AXIS_DESCR
/end CHARACTERISTIC
/begin CHARACTERISTIC KFMPED_UM "Kennfeld für zulässiges Moment aus der Pedalstellung in der Funktionsüberwachg" MAP 0x814171 GkfWUb 99.61 rel_ub_b99p6 0.00 99.61 FORMAT "%5.2"
 /begin AXIS_DESCR COM_AXIS spsn_um spg_ub_q0p019 8 0.00 4.9805 AXIS_PTS_REF SPSNV08_UM /end AXIS_DESCR
 /begin AXIS_DESCR COM_AXIS nmot_um nmot_ub_q40 8 0.00 10200. AXIS_PTS_REF NMV08_UM /end AXIS_DESCR
/end CHARACTERISTIC
/begin CHARACTERISTIC KFMPNS_UC "Kennfeld für zul. Moment aus Pedalstellung bei kaltem Motor im Befehlstest" MAP 0x811F72 GkfWUb 99.61 rel_ub_b99p6 0.00 99.61 FORMAT "%5.2"
 /begin AXIS_DESCR COM_AXIS spsn_uc spg_ub_q0p019 8 0.00 4.9805 AXIS_PTS_REF SPSNV08_UC /end AXIS_DESCR
 /begin AXIS_DESCR COM_AXIS nmot_uc nmot_ub_q40 8 0.00 10200. AXIS_PTS_REF NMV08_UC /end AXIS_DESCR
/end CHARACTERISTIC
/begin CHARACTERISTIC KFMPNS_UM "Kennfeld für zul. Moment aus Pedalstellung bei kaltem Motor" MAP 0x8141B1 GkfWUb 99.61 rel_ub_b99p6 0.00 99.61 FORMAT "%5.2"
 /begin AXIS_DESCR COM_AXIS spsn_um spg_ub_q0p019 8 0.00 4.9805 AXIS_PTS_REF SPSNV08_UM /end AXIS_DESCR
 /begin AXIS_DESCR COM_AXIS nmot_um nmot_ub_q40 8 0.00 10200. AXIS_PTS_REF NMV08_UM /end AXIS_DESCR
/end CHARACTERISTIC
/begin CHARACTERISTIC KFRLIP_UM "Kennfeld für rl - Berechnung aus Drosselklappenwinkel in der Funktionsüberwachg" MAP 0x814019 KfAxUbAyUbSstxUbSstyUbWUb 191.3 rel_ub_q0p75 0.00 191.3 FORMAT "%5.1"
 /begin AXIS_DESCR STD_AXIS ipsn_um spg_ub_q0p019 8 0.00 4.9805 DEPOSIT ABSOLUTE /end AXIS_DESCR
 /begin AXIS_DESCR STD_AXIS nmot_um nmot_ub_q40 8 0.00 10200. FORMAT "%5.0" DEPOSIT ABSOLUTE /end AXIS_DESCR
/end CHARACTERISTIC
/begin CHARACTERISTIC KFSWKFZK "Schwelle der ZW-Spätverstellungen für ZW-Kennfeldumschaltung" MAP 0x81A6DC GkfWUb 191.3 zw_ub_qn0p75 -191.3 0.00 FORMAT "%5.1"
 /begin AXIS_DESCR COM_AXIS nmot_w nmot_uw_q0p25 16 0.00 16383.75 AXIS_PTS_REF SNM16ZUUW /end AXIS_DESCR
 /begin AXIS_DESCR COM_AXIS rl_w rel_uw_q0p0234 12 0.00 1535.977 AXIS_PTS_REF SRL12ZUUW /end AXIS_DESCR
/end CHARACTERISTIC
/begin CHARACTERISTIC KFSZDUB "Schließzeitkorrektur in Abhängigkeit von UB" MAP 0x81A7ED KfAxUbAyUbSstxUbSstyUbWUb 7.969 fak_ub_b8 0.00 7.969 FORMAT "%5.3"
 /begin AXIS_DESCR STD_AXIS uzue spg_ubatt 7 0.00 17.95 FORMAT "%5.2" DEPOSIT ABSOLUTE /end AXIS_DESCR
 /begin AXIS_DESCR STD_AXIS tsrldyn txms_ub_q0p1 16 0.00 25.50 FORMAT "%5.2" DEPOSIT ABSOLUTE /end AXIS_DESCR
/end CHARACTERISTIC
/begin CHARACTERISTIC KFSZT "Schließzeit-Kennfeld" MAP 0x81A876 KfAxUbAyUbSstxUbSstyUbWUb 25.50 txms_ub_q0p1 0.00 25.50 FORMAT "%5.2"
 /begin AXIS_DESCR STD_AXIS ub spg_ubatt 8 0.00 17.95 FORMAT "%5.2" DEPOSIT ABSOLUTE /end AXIS_DESCR
 /begin AXIS_DESCR STD_AXIS nmot nmot_ub_q40 8 0.00 10200. FORMAT "%5.0" DEPOSIT ABSOLUTE /end AXIS_DESCR
/end CHARACTERISTIC
/begin CHARACTERISTIC KFTSDYN "Schließzeitkorrektur in Abhängigkeit des Drehzahlgradienten" MAP 0x828E7C KfAxUbAyUbSstxSwSstyUbWUw 7.999878 fak_uw_b8 0.00 7.999878 FORMAT "%8.6"
 /begin AXIS_DESCR STD_AXIS ngfil_w nmotg_sw_q0p39 3 -12800.16 12799.77 FORMAT "%8.2" DEPOSIT ABSOLUTE /end AXIS_DESCR
 /begin AXIS_DESCR STD_AXIS nmot nmot_ub_q40 8 0.00 10200. FORMAT "%5.0" DEPOSIT ABSOLUTE /end AXIS_DESCR
/end CHARACTERISTIC
/begin CHARACTERISTIC KFTSRL "Schließzeitkennfeld" MAP 0x81A8C8 KfAxUbAyUbSstxUbSstyUbWUb 25.50 txms_ub_q0p1 0.00 25.50 FORMAT "%5.2"
 /begin AXIS_DESCR STD_AXIS nmot nmot_ub_q40 9 0.00 10200. FORMAT "%5.0" DEPOSIT ABSOLUTE /end AXIS_DESCR
 /begin AXIS_DESCR STD_AXIS rl rel_ub_q0p75 10 0.00 191.3 FORMAT "%5.1" DEPOSIT ABSOLUTE /end AXIS_DESCR
/end CHARACTERISTIC
/begin CHARACTERISTIC KFTZWOB "Zeitkonstante Zündwinkeloverboost" MAP 0x828D74 KfAxUbAyUbSstxUbSstyUbWSb 51.00 t200msxs_sb_b25p5 -25.60 25.40 FORMAT "%5.2"
 /begin AXIS_DESCR STD_AXIS nmot nmot_ub_q40 4 0.00 10200. FORMAT "%5.0" DEPOSIT ABSOLUTE /end AXIS_DESCR
 /begin AXIS_DESCR STD_AXIS rl rel_ub_q0p75 4 0.00 191.3 FORMAT "%5.1" DEPOSIT ABSOLUTE /end AXIS_DESCR
/end CHARACTERISTIC
/begin CHARACTERISTIC KFWDKOFST "Offset Drosselklappenwinkel im Start aus Offsetmassenstrom" MAP 0x813ED0 KfAxUbAyUbSstxUwSstySbWSb 99.61 relDK_q0p390631 -50.00 49.61 FORMAT "%5.2"
 /begin AXIS_DESCR STD_AXIS tmst temp_ub_q0p75_o48 7 -48.00000 144.0000 FORMAT "%8.4" DEPOSIT ABSOLUTE /end AXIS_DESCR
 /begin AXIS_DESCR STD_AXIS ofmnstbg m_q0p1 6 -12.80 12.70 FORMAT "%5.2" DEPOSIT ABSOLUTE /end AXIS_DESCR
/end CHARACTERISTIC
/begin CHARACTERISTIC KFWDKSST "Sollwert Drosselklappenwinkel im Start" MAP 0x81D4A2 KfAxUbAyUbSstxUbSstyUbWUb 99.61 relDK_q0p390631 0.00 99.61 FORMAT "%5.2"
 /begin AXIS_DESCR STD_AXIS tmst temp_ub_q0p75_o48 12 -48.00 143.3 FORMAT "%5.1" DEPOSIT ABSOLUTE /end AXIS_DESCR
 /begin AXIS_DESCR STD_AXIS nmot nmot_ub_q40 4 0.00 10200. FORMAT "%5.0" DEPOSIT ABSOLUTE /end AXIS_DESCR
/end CHARACTERISTIC
/begin CHARACTERISTIC KFWDKTHO_0_A "Sollwert Drosselklappenwinkel im Start - f (Höhe, Motorstarttemperatur)" MAP 0x81D4E4 KfAxUbAyUbSstxUbSstyUwWUw 100.0000 relDK_uw_b100 0.00 100.0000 FORMAT "%8.4"
 /begin AXIS_DESCR STD_AXIS tmst temp_ub_q0p75_o48 12 -48.00 143.3 FORMAT "%5.1" DEPOSIT ABSOLUTE /end AXIS_DESCR
 /begin AXIS_DESCR STD_AXIS fho_w fak_uw_b4 4 0.00 3.999939 FORMAT "%8.6" DEPOSIT ABSOLUTE /end AXIS_DESCR
/end CHARACTERISTIC
/begin CHARACTERISTIC KFWDKTHO_1_A "Sollwert Drosselklappenwinkel im Start - f (Höhe, Motorstarttemperatur)" MAP 0x81D55A KfAxUbAyUbSstxUbSstyUwWUw 100.0000 relDK_uw_b100 0.00 100.0000 FORMAT "%8.4"
 /begin AXIS_DESCR STD_AXIS tmst temp_ub_q0p75_o48 12 -48.00 143.3 FORMAT "%5.1" DEPOSIT ABSOLUTE /end AXIS_DESCR
 /begin AXIS_DESCR STD_AXIS fho_w fak_uw_b4 4 0.00 3.999939 FORMAT "%8.6" DEPOSIT ABSOLUTE /end AXIS_DESCR
/end CHARACTERISTIC
/begin CHARACTERISTIC KFWDKTHOKH "Drosselklappenwinkel im Start bei angefordertem Katheizen-" MAP 0x81D5D0 KfAxUbAyUbSstxUbSstyUwWUw 100.0000 relDK_uw_b100 0.00 100.0000 FORMAT "%8.4"
 /begin AXIS_DESCR STD_AXIS tmst temp_ub_q0p75_o48 12 -48.00 143.3 FORMAT "%5.1" DEPOSIT ABSOLUTE /end AXIS_DESCR
 /begin AXIS_DESCR STD_AXIS fho_w fak_uw_b4 4 0.00 3.999939 FORMAT "%8.6" DEPOSIT ABSOLUTE /end AXIS_DESCR
/end CHARACTERISTIC
/begin CHARACTERISTIC KFZW "Zündwinkelkennfeld" MAP 0x8124A0 GkfWSb 191.3 zw_sb_q0p75 -96.00 95.25 FORMAT "%5.2"
 /begin AXIS_DESCR COM_AXIS nmot_w nmot_uw_q0p25 16 0.00 16383.75 AXIS_PTS_REF SNM16ZUUW /end AXIS_DESCR
 /begin AXIS_DESCR COM_AXIS rl_w rel_uw_q0p0234 12 0.00 1535.977 AXIS_PTS_REF SRL12ZUUW /end AXIS_DESCR
/end CHARACTERISTIC
/begin CHARACTERISTIC KFZW2 "Zündwinkelkennfeld Variante 2" MAP 0x812560 GkfWSb 191.3 zw_sb_q0p75 -96.00 95.25 FORMAT "%5.2"
 /begin AXIS_DESCR COM_AXIS nmot_w nmot_uw_q0p25 16 0.00 16383.75 AXIS_PTS_REF SNM16ZUUW /end AXIS_DESCR
 /begin AXIS_DESCR COM_AXIS rl_w rel_uw_q0p0234 12 0.00 1535.977 AXIS_PTS_REF SRL12ZUUW /end AXIS_DESCR
/end CHARACTERISTIC
/begin CHARACTERISTIC KFZWMN_0_A "Min-Zündwinkel" MAP 0x812257 GkfWSb 191.3 zw_sb_q0p75 -96.00 95.25 FORMAT "%5.2"
 /begin AXIS_DESCR COM_AXIS nmot_w nmot_uw_q0p25 16 0.00 16383.75 AXIS_PTS_REF SNM16ZUUW /end AXIS_DESCR
 /begin AXIS_DESCR COM_AXIS rl_w rel_uw_q0p0234 12 0.00 1535.977 AXIS_PTS_REF SRL12ZUUW /end AXIS_DESCR
/end CHARACTERISTIC
/begin CHARACTERISTIC KFZWMN_1_A "Min-Zündwinkel" MAP 0x812317 GkfWSb 191.3 zw_sb_q0p75 -96.00 95.25 FORMAT "%5.2"
 /begin AXIS_DESCR COM_AXIS nmot_w nmot_uw_q0p25 16 0.00 16383.75 AXIS_PTS_REF SNM16ZUUW /end AXIS_DESCR
 /begin AXIS_DESCR COM_AXIS rl_w rel_uw_q0p0234 12 0.00 1535.977 AXIS_PTS_REF SRL12ZUUW /end AXIS_DESCR
/end CHARACTERISTIC
/begin CHARACTERISTIC KFZWMNKH "Min-Zündwinkel Katheizen" MAP 0x81783A KfAxUbAyUbSstxUbSstyUbWSb 191.3 zw_sb_q0p75 -96.00 95.25 FORMAT "%5.2"
 /begin AXIS_DESCR STD_AXIS nmot nmot_ub_q40 16 0.00 10200. FORMAT "%5.0" DEPOSIT ABSOLUTE /end AXIS_DESCR
 /begin AXIS_DESCR STD_AXIS rl rel_ub_q0p75 12 0.00 191.3 FORMAT "%5.1" DEPOSIT ABSOLUTE /end AXIS_DESCR
/end CHARACTERISTIC
/begin CHARACTERISTIC KFZWMNST "Min-Zündwinkel für Start und Nachstart" MAP 0x817918 KfAxUbAyUbSstxUbSstyUbWSb 191.3 zw_sb_q0p75 -96.00 95.25 FORMAT "%5.2"
 /begin AXIS_DESCR STD_AXIS nmot nmot_ub_q40 16 0.00 10200. FORMAT "%5.0" DEPOSIT ABSOLUTE /end AXIS_DESCR
 /begin AXIS_DESCR STD_AXIS rl rel_ub_q0p75 12 0.00 191.3 FORMAT "%5.1" DEPOSIT ABSOLUTE /end AXIS_DESCR
/end CHARACTERISTIC
/begin CHARACTERISTIC KFZWMS "Kennfeld mit dauerhaft spätest möglichem Zündwinkel" MAP 0x8123D7 GkfWSb 191.3 zw_sb_q0p75 -96.00 95.25 FORMAT "%5.2"
 /begin AXIS_DESCR COM_AXIS nmot_w nmot_uw_q0p25 16 0.00 16383.75 AXIS_PTS_REF SNM16ZUUW /end AXIS_DESCR
 /begin AXIS_DESCR COM_AXIS rl_w rel_uw_q0p0234 12 0.00 1535.977 AXIS_PTS_REF SRL12ZUUW /end AXIS_DESCR
/end CHARACTERISTIC
/begin CHARACTERISTIC KFZWSTTM "Zündwinkel im Start" MAP 0x817A2C KfAxUbAyUbSstxUbSstyUbWSb 191.3 zw_sb_q0p75 -96.00 95.25 FORMAT "%5.2"
 /begin AXIS_DESCR STD_AXIS nmot nmot_ub_q40 6 0.00 10200. FORMAT "%5.0" DEPOSIT ABSOLUTE /end AXIS_DESCR
 /begin AXIS_DESCR STD_AXIS tmst temp_ub_q0p75_o48 6 -48.00 143.3 FORMAT "%5.1" DEPOSIT ABSOLUTE /end AXIS_DESCR
/end CHARACTERISTIC
/begin CHARACTERISTIC KFZWWLNM "Delta Zündwinkel im Warmlauf" MAP 0x812669 GkfWSb 191.3 zw_sb_q0p75 -96.00 95.25 FORMAT "%5.2"
 /begin AXIS_DESCR COM_AXIS nmot nmot_ub_q40 12 0.00 10200. AXIS_PTS_REF SNM12ESUB /end AXIS_DESCR
 /begin AXIS_DESCR COM_AXIS tans temp_ub_q0p75_o48 12 -48.00 143.3 AXIS_PTS_REF STA12WLUB /end AXIS_DESCR
/end CHARACTERISTIC
/begin CHARACTERISTIC KFZWWLRL "Delta Zündwinkel im Warmlauf" MAP 0x8126F9 GkfWSb 191.3 zw_sb_q0p75 -96.00 95.25 FORMAT "%5.2"
 /begin AXIS_DESCR COM_AXIS tmot temp_ub_q0p75_o48 12 -48.00 143.3 AXIS_PTS_REF STM12ESUB /end AXIS_DESCR
 /begin AXIS_DESCR COM_AXIS rl rel_ub_q0p75 6 0.00 191.3 AXIS_PTS_REF SRL06ESUB /end AXIS_DESCR
/end CHARACTERISTIC
/begin CHARACTERISTIC KFZW_UC "Kennfeld für optimalen Zündwinkel im Befehlstest" MAP 0x811EA1 GkfWSb 191.3 zw_sb_q0p75 -96.00 95.25 FORMAT "%5.2"
 /begin AXIS_DESCR COM_AXIS rl_uc rel_ub_q0p75 8 0.00 191.3 AXIS_PTS_REF RLV08_UC /end AXIS_DESCR
 /begin AXIS_DESCR COM_AXIS nmot_uc nmot_ub_q40 8 0.00 10200. AXIS_PTS_REF NZWV08_UC /end AXIS_DESCR
/end CHARACTERISTIC
/begin CHARACTERISTIC KIVMXG "Verstärkungsfaktor I-Anteil der VMAX-Regelung" CURVE 0x827C42 FklWUw 499.984741 rel_q0p007629 0.00762939453 499.992371
 /begin AXIS_DESCR FIX_AXIS gangi dez 8 0.00 7.000 FORMAT "%5.3" FIX_AXIS_PAR 0 0 8 /end AXIS_DESCR
/end CHARACTERISTIC
/begin CHARACTERISTIC KLETAZW_UC "ZW-Wirkungsgrad in Abhängigkeit von delta ZW im Befehlstest" CURVE 0x811EE1 KlAUbSstUbWUb 127.5 rel_ub_b127p5 0.00 127.5 FORMAT "%5.1"
 /begin AXIS_DESCR STD_AXIS dzw_uc zw_ub_q0p75 8 0.00 191.3 FORMAT "%5.1" DEPOSIT ABSOLUTE /end AXIS_DESCR
/end CHARACTERISTIC
/begin CHARACTERISTIC KLFZWMNKH_0_A "Abregelsteilheit der Brenngrenze im Nachstart bei Katheizen" CURVE 0x828DCA KlAUbSstUbWUw 655.34999985 zk10msxs_uw_b655 0.010000152590 655.36000000 FORMAT "%12.8"
 /begin AXIS_DESCR STD_AXIS tmot temp_ub_q0p75_o48 6 -48.00 143.3 FORMAT "%5.1" DEPOSIT ABSOLUTE /end AXIS_DESCR
/end CHARACTERISTIC
/begin CHARACTERISTIC KLFZWMNKH_1_A "Abregelsteilheit der Brenngrenze im Nachstart bei Katheizen" CURVE 0x828DDE KlAUbSstUbWUw 655.34999985 zk10msxs_uw_b655 0.010000152590 655.36000000 FORMAT "%12.8"
 /begin AXIS_DESCR STD_AXIS tmot temp_ub_q0p75_o48 6 -48.00 143.3 FORMAT "%5.1" DEPOSIT ABSOLUTE /end AXIS_DESCR
/end CHARACTERISTIC
/begin CHARACTERISTIC KLFZWMNST_0_A "Abregelsteilheit der Brenngrenze im Nachstart" CURVE 0x828DF2 KlAUbSstUbWUw 655.34999985 zk10msxs_uw_b655 0.010000152590 655.36000000 FORMAT "%12.8"
 /begin AXIS_DESCR STD_AXIS tmot temp_ub_q0p75_o48 6 -48.00 143.3 FORMAT "%5.1" DEPOSIT ABSOLUTE /end AXIS_DESCR
/end CHARACTERISTIC
/begin CHARACTERISTIC KLFZWMNST_1_A "Abregelsteilheit der Brenngrenze im Nachstart" CURVE 0x828E06 KlAUbSstUbWUw 655.34999985 zk10msxs_uw_b655 0.010000152590 655.36000000 FORMAT "%12.8"
 /begin AXIS_DESCR STD_AXIS tmot temp_ub_q0p75_o48 6 -48.00 143.3 FORMAT "%5.1" DEPOSIT ABSOLUTE /end AXIS_DESCR
/end CHARACTERISTIC
/begin CHARACTERISTIC KLNPED_UC "pedalsollwertabh. Drehzahlbegr. in der DK-Antrieb-Ersatzfunktion; Befehlstest" CURVE 0x811FBE KlAUbSstUbWUb 10200. nmot_ub_q40 0.00 10200. FORMAT "%5.0"
 /begin AXIS_DESCR STD_AXIS spsn_uc spg_ub_q0p019 8 0.00 4.9805 DEPOSIT ABSOLUTE /end AXIS_DESCR
/end CHARACTERISTIC
/begin CHARACTERISTIC KLNPED_UM "pedalsollwertabh. Drehzahlbegrenzung in der DK-Antrieb-Ersatzfunktion, Fktsüberw" CURVE 0x8141FD KlAUbSstUbWUb 10200. nmot_ub_q40 0.00 10200. FORMAT "%5.0"
 /begin AXIS_DESCR STD_AXIS spsn_um spg_ub_q0p019 8 0.00 4.9805 DEPOSIT ABSOLUTE /end AXIS_DESCR
/end CHARACTERISTIC
/begin CHARACTERISTIC KLWDKABST_0_A "Wichtung Sollwert Drosselklappenwinkel im Start" CURVE 0x81D646 KlAUbSstUwWUb 1.992 fak_ub_b2 0.00 1.992 FORMAT "%5.3"
 /begin AXIS_DESCR STD_AXIS tabst_w t1sxs_uw_q1 4 0.00 65535.00 FORMAT "%8.2" DEPOSIT ABSOLUTE /end AXIS_DESCR
/end CHARACTERISTIC
/begin CHARACTERISTIC KLWDKABST_1_A "Wichtung Sollwert Drosselklappenwinkel im Start" CURVE 0x81D654 KlAUbSstUwWUb 1.992 fak_ub_b2 0.00 1.992 FORMAT "%5.3"
 /begin AXIS_DESCR STD_AXIS tabst_w t1sxs_uw_q1 4 0.00 65535.00 FORMAT "%8.2" DEPOSIT ABSOLUTE /end AXIS_DESCR
/end CHARACTERISTIC
/begin CHARACTERISTIC KLWDKPED "Offset Sollwert Drosselklappenwinkel im Start" CURVE 0x81D662 KlAUbSstUbWUb 99.61 relDK_q0p390631 0.00 99.61 FORMAT "%5.2"
 /begin AXIS_DESCR STD_AXIS wped relPED_ub_b100 3 0.00 100.0 FORMAT "%5.1" DEPOSIT ABSOLUTE /end AXIS_DESCR
/end CHARACTERISTIC
/begin CHARACTERISTIC KLWDKTAN "Wichtung der Drosselklappenposition im Start mit Ansauglufttemperatur" CURVE 0x81D669 KlAUbSstUbWUb 7.969 fak_ub_b8 0.00 7.969 FORMAT "%5.3"
 /begin AXIS_DESCR STD_AXIS tans temp_ub_q0p75_o48 4 -48.00 143.3 FORMAT "%5.1" DEPOSIT ABSOLUTE /end AXIS_DESCR
/end CHARACTERISTIC
/begin CHARACTERISTIC KLZWBSMN "spätest möglicher Basiszündwinkel" CURVE 0x828D48 KlAUbSstUbWSb 191.3 zw_sb_q0p75 -96.00 95.25 FORMAT "%5.2"
 /begin AXIS_DESCR STD_AXIS nmot nmot_ub_q40 8 0.00 10200. FORMAT "%5.0" DEPOSIT ABSOLUTE /end AXIS_DESCR
/end CHARACTERISTIC
/begin CHARACTERISTIC KPVMXG "Verstärkungsfaktor P-Anteil der VMAX-Regelung" CURVE 0x81A1C4 FklWUb 99.70 rel_ub_q0p391 0.00 99.70 FORMAT "%5.2"
 /begin AXIS_DESCR FIX_AXIS gangi dez 8 0.00 7.000 FORMAT "%5.3" FIX_AXIS_PAR 0 0 8 /end AXIS_DESCR
/end CHARACTERISTIC
/begin AXIS_PTS MDV08_UC "Stützstellenverteilung für Moment im Befehlstest" 0x811FB2 mz_uc SstAUbSstUb 99.61 rel_ub_b99p6 8 0.00 99.61 FORMAT "%5.2" DEPOSIT ABSOLUTE /end AXIS_PTS
/begin AXIS_PTS MDV08_UM "Stützstellenverteilung für Moment in der Funktionsüberwachung" 0x8141F1 mz_um SstAUbSstUb 99.61 rel_ub_b99p6 8 0.00 99.61 FORMAT "%5.2" DEPOSIT ABSOLUTE /end AXIS_PTS
/begin CHARACTERISTIC MEBZA_DAT_UC "" VAL_BLK 0x811C37 KwbUb 255.0 dez 0.00 255.0 FORMAT "%5.1" NUMBER 16 /end CHARACTERISTIC
/begin CHARACTERISTIC MECS_DAT_UC "" VAL_BLK 0x811C47 KwbUb 255.0 dez 0.00 255.0 FORMAT "%5.1" NUMBER 16 /end CHARACTERISTIC
/begin CHARACTERISTIC MER_D1_UC "" VAL_BLK 0x811C57 KwbUb 255.0 dez 0.00 255.0 FORMAT "%5.1" NUMBER 16 /end CHARACTERISTIC
/begin CHARACTERISTIC MER_D2_UC "" VAL_BLK 0x811C67 KwbUb 255.0 dez 0.00 255.0 FORMAT "%5.1" NUMBER 16 /end CHARACTERISTIC
/begin CHARACTERISTIC MIFA_DAT_UC "" VAL_BLK 0x811C77 KwbUb 99.61 rel_ub_q0p3906 0.00 99.61 FORMAT "%5.2" NUMBER 16 /end CHARACTERISTIC
/begin CHARACTERISTIC MSGS_DAT_UC "" VAL_BLK 0x811C87 KwbUb 99.61 rel_ub_q0p3906 0.00 99.61 FORMAT "%5.2" NUMBER 16 /end CHARACTERISTIC
/begin CHARACTERISTIC MSPSN_DAT_UC "" VAL_BLK 0x811C97 KwbUb 4.9805 spg_ub_q0p019 0.00 4.9805 NUMBER 16 /end CHARACTERISTIC
/begin CHARACTERISTIC MSRC_D_UC "" VAL_BLK 0x811CA7 KwbUb 255.0 dez 0.00 255.0 FORMAT "%5.1" NUMBER 16 /end CHARACTERISTIC
/begin CHARACTERISTIC MSRC_T_UC "Fehlerzeit für MSR-Eingriff-Überwachung des Befehlstests" VALUE 0x811E3B KwUb 10200.0 t40ms_ub_b10200 0.00 10200.0 FORMAT "%7.1" /end CHARACTERISTIC
/begin CHARACTERISTIC MVER_D_UC "" VAL_BLK 0x811CB7 KwbUb 255.0 dez 0.00 255.0 FORMAT "%5.1" NUMBER 16 /end CHARACTERISTIC
/begin CHARACTERISTIC MVER_T_UC "Fehlerzeit beim Momentenvergleich im Befehlstest" VALUE 0x811FBD KwUb 10200.0 t40ms_ub_b10200 0.00 10200.0 FORMAT "%7.1" /end CHARACTERISTIC
/begin CHARACTERISTIC MZFFIL_UC "Filter-Zeitkonstante für verzögertes Moment im Befehlstest" VALUE 0x811FBB KwUb 10159.4 zk40ms_ub_b10200 40.6299 10200.0 FORMAT "%7.1" /end CHARACTERISTIC
/begin CHARACTERISTIC MZFPTR_DAT_UC "" VAL_BLK 0x811CC7 KwbUb 255.0 dez 0.00 255.0 FORMAT "%5.1" NUMBER 16 /end CHARACTERISTIC
/begin CHARACTERISTIC MZFREG_DAT_UC "" MAP 0x811CD7 KfWUb 255.0 dez 0.00 255.0 FORMAT "%5.1"
 /begin AXIS_DESCR FIX_AXIS x_uc dez 16 0.00 15.00 FORMAT "%5.2" FIX_AXIS_PAR 0 0 16 /end AXIS_DESCR
 /begin AXIS_DESCR FIX_AXIS y_uc dez 8 0.00 7.000 FORMAT "%5.3" FIX_AXIS_PAR 0 0 8 /end AXIS_DESCR
/end CHARACTERISTIC
/begin CHARACTERISTIC MZFTV_UC "Verzugszeit für zulässiges Moment mz_um im Befehlstest" VALUE 0x811FBC KwUb 280.000 t40ms_ub_b10200 40.0000 320.000 FORMAT "%7.3" /end CHARACTERISTIC
/begin CHARACTERISTIC MZF_DAT_UC "" VAL_BLK 0x811D57 KwbUb 99.61 rel_ub_q0p3906 0.00 99.61 FORMAT "%5.2" NUMBER 16 /end CHARACTERISTIC
/begin CHARACTERISTIC MZL_DAT_UC "" VAL_BLK 0x811D67 KwbUb 0.3891 rel_ub_q0p00153 0.00 0.3891 NUMBER 16 /end CHARACTERISTIC
/begin CHARACTERISTIC NACHANZ "" VALUE 0x812178 KwUb 255.0 dez 0.00 255.0 FORMAT "%5.1" /end CHARACTERISTIC
/begin CHARACTERISTIC NC_T_UM "Fehlertoleranzzeit für Motordrehzahlüberwachung für Funktionsüberwachung" VALUE 0x81400C KwUb 10200.0 t40ms_ub_b10200 0.00 10200.0 FORMAT "%7.1" /end CHARACTERISTIC
/begin CHARACTERISTIC NDIF_UM "erlaubte Differenz zwischen nmot und nz_um in der Funktionsüberwachung" VALUE 0x81400D KwUb 10200. nmot_ub_q40 0.00 10200. FORMAT "%5.0" /end CHARACTERISTIC
/begin CHARACTERISTIC NFLAGS_D_UC "" VAL_BLK 0x811D77 KwbUb 255.0 dez 0.00 255.0 FORMAT "%5.1" NUMBER 16 /end CHARACTERISTIC
/begin CHARACTERISTIC NMIN_UM "minimale Drehzahl für Motordrehzahlüberwachung der Funktionsüberwachung" VALUE 0x81400E KwUb 9680. nmot_ub_q40 520.0 10200. FORMAT "%5.0" /end CHARACTERISTIC
/begin CHARACTERISTIC NMNZUESA "untere nmot-Schwelle für Ausgabe TSMNSA" VALUE 0x81A937 KwUb 10200. nmot_ub_q40 0.00 10200. FORMAT "%5.0" /end CHARACTERISTIC
/begin CHARACTERISTIC NMOT_DAT_UC "" VAL_BLK 0x811D87 KwbUb 10200. nmot_ub_q40 0.00 10200. FORMAT "%5.0" NUMBER 16 /end CHARACTERISTIC
/begin AXIS_PTS NMV08_UC "Stützstellenverteilung für Motordrehzahl im Befehlstest" 0x811E3D nmot_uc SstAUbSstUb 10200. nmot_ub_q40 8 0.00 10200. FORMAT "%5.0" DEPOSIT ABSOLUTE /end AXIS_PTS
/begin AXIS_PTS NMV08_UM "Stützstellenverteilung für Motordrehzahl in der Funktionsüberwachung" 0x81407C nmot_um SstAUbSstUb 10200. nmot_ub_q40 8 0.00 10200. FORMAT "%5.0" DEPOSIT ABSOLUTE /end AXIS_PTS
/begin CHARACTERISTIC NMXZUESA "obere nmot-Schwelle für Ausgabe TSMNSA" VALUE 0x81A938 KwUb 10200. nmot_ub_q40 0.00 10200. FORMAT "%5.0" /end CHARACTERISTIC
/begin CHARACTERISTIC NOASR_UC "Inaktivmaske für ASR im Befehlstest" VALUE 0x811E3C KwUb 99.61 rel_ub_q0p3906 0.00 99.61 FORMAT "%5.2" /end CHARACTERISTIC
/begin CHARACTERISTIC NOREA_UC "" VALUE 0x811FCF KwUb 255.0 dez 0.00 255.0 FORMAT "%5.1" /end CHARACTERISTIC
/begin CHARACTERISTIC NOREA_UM "Kennung zur Anforderung kein Motorbetrieb möglich aus %UFREAC der Funktionsüberw" VALUE 0x81420E KwUb 255.0 dez 0.00 255.0 FORMAT "%5.1" /end CHARACTERISTIC
/begin CHARACTERISTIC NRLIP_UM "Motordrehzahl-Schwelle für den rl/rlip-Vergleich in der Funktionsüberwachg" VALUE 0x81406B KwUb 10200. nmot_ub_q40 0.00 10200. FORMAT "%5.0" /end CHARACTERISTIC
/begin CHARACTERISTIC NSC_T_UM "Nachstartüberwachungszeit für die Funktionsüberwachung" VALUE 0x814220 KwUw 2621.400 t40msxs_uw_q0p04 0.00 2621.400 FORMAT "%8.3" /end CHARACTERISTIC
/begin CHARACTERISTIC NSOF_T_UM "Entprellzeit für Abschaltung der Nachstartaufweitung" VALUE 0x81400F KwUb 10200.0 t40ms_ub_b10200 0.00 10200.0 FORMAT "%7.1" /end CHARACTERISTIC
/begin CHARACTERISTIC NWDKSST_0_A "Drehzahlschwelle Abschaltung Solldrosselklappenwinkel ohne Momentenstruktur" CURVE 0x81D672 KlAUbSstUbWUb 10200. nmot_ub_q40 0.00 10200. FORMAT "%5.0"
 /begin AXIS_DESCR STD_AXIS tmst temp_ub_q0p75_o48 6 -48.00 143.3 FORMAT "%5.1" DEPOSIT ABSOLUTE /end AXIS_DESCR
/end CHARACTERISTIC
/begin CHARACTERISTIC NWDKSST_1_A "Drehzahlschwelle Abschaltung Solldrosselklappenwinkel ohne Momentenstruktur" CURVE 0x81D67F KlAUbSstUbWUb 10200. nmot_ub_q40 0.00 10200. FORMAT "%5.0"
 /begin AXIS_DESCR STD_AXIS tmst temp_ub_q0p75_o48 6 -48.00 143.3 FORMAT "%5.1" DEPOSIT ABSOLUTE /end AXIS_DESCR
/end CHARACTERISTIC
/begin AXIS_PTS NZWV08_UC "" 0x811E46 nmot_uc SstAUbSstUb 10200. nmot_ub_q40 8 0.00 10200. FORMAT "%5.0" DEPOSIT ABSOLUTE /end AXIS_PTS
/begin CHARACTERISTIC N_START_UM "Motordrehzahlschwelle für Unterdrehzahl-Ausstieg für die Fkt.-Überwachung" VALUE 0x814010 KwUb 10200. nmot_ub_q40 0.00 10200. FORMAT "%5.0" /end CHARACTERISTIC
/begin CHARACTERISTIC N_STEND_UM "Motordrehzahlschwelle für Startende in der Fkt.-Überwachung" VALUE 0x814011 KwUb 10200. nmot_ub_q40 0.00 10200. FORMAT "%5.0" /end CHARACTERISTIC
/begin CHARACTERISTIC OFMNSTO "obere Begrenzung für Offset des nomierten Massenstrom über DK bei Start" VALUE 0x8189A2 KwSb 25.50 m_q0p1 -12.80 12.70 FORMAT "%5.2" /end CHARACTERISTIC
/begin CHARACTERISTIC OFMNSTU "untere Begrenzung für Offset des nomierten Massenstrom über DK bei Start" VALUE 0x8189A3 KwSb 25.50 m_q0p1 -12.80 12.70 FORMAT "%5.2" /end CHARACTERISTIC
/begin CHARACTERISTIC REAC_D1_UC "" VAL_BLK 0x811D97 KwbUb 255.0 dez 0.00 255.0 FORMAT "%5.1" NUMBER 16 /end CHARACTERISTIC
/begin CHARACTERISTIC REAC_D2_UC "" VAL_BLK 0x811DA7 KwbUb 255.0 dez 0.00 255.0 FORMAT "%5.1" NUMBER 16 /end CHARACTERISTIC
/begin CHARACTERISTIC REAC_T1_UC "Fehlerzeit bei der Funktions-Fehlerreaktionsüberwachung im Befehlstest" VALUE 0x811FD0 KwUb 10200.0 t40ms_ub_b10200 0.00 10200.0 FORMAT "%7.1" /end CHARACTERISTIC
/begin CHARACTERISTIC REAC_T1_UM "Fehlerzeit bei der Funktions-Fehlerreaktionsüberwachung in der Funktionsüberw." VALUE 0x81420F KwUb 10200.0 t40ms_ub_b10200 0.00 10200.0 FORMAT "%7.1" /end CHARACTERISTIC
/begin CHARACTERISTIC REAC_T2_UC "Fehlerzeit bei der Funktionsüberwachungs-Fehlerreaktionsüberw. im Befehlstest" VALUE 0x811FD1 KwUb 10200.0 t40ms_ub_b10200 0.00 10200.0 FORMAT "%7.1" /end CHARACTERISTIC
/begin CHARACTERISTIC REAC_T2_UM "Fehlerzeit bei der Funktionsüberwachungs-Fehlerreaktionsüberwachung" VALUE 0x814210 KwUb 10200.0 t40ms_ub_b10200 0.00 10200.0 FORMAT "%7.1" /end CHARACTERISTIC
/begin CHARACTERISTIC RFLAGS_D_UC "" VAL_BLK 0x811DB7 KwbUb 255.0 dez 0.00 255.0 FORMAT "%5.1" NUMBER 16 /end CHARACTERISTIC
/begin CHARACTERISTIC RLC_T_UM "Fehlertoleranzzeit für den rl-Vergleich mit der Funktion in der Funktionsüberw." VALUE 0x81406C KwUb 10200.0 t40ms_ub_b10200 0.00 10200.0 FORMAT "%7.1" /end CHARACTERISTIC
/begin CHARACTERISTIC RLIPFIL_UM "Filter-Zeitkonstante für verzögerte Lastinfo rlipt_um in d. Funktionsüberwachung" VALUE 0x81406D KwUb 10159.4 zk40ms_ub_b10200 40.6299 10200.0 FORMAT "%7.1" /end CHARACTERISTIC
/begin CHARACTERISTIC RLIPTV_UM "Verzugszeit für Lastinformation rlip_um in der Funktionsüberwachung" VALUE 0x81406E KwUb 320.000 t40ms_ub_b10200 0.00 320.000 FORMAT "%7.3" /end CHARACTERISTIC
/begin CHARACTERISTIC RLIP_T_UM "Fehlertoleranzzeit für den rl/rlip-Vergleich in der Funktionsüberwachg" VALUE 0x81406F KwUb 10200.0 t40ms_ub_b10200 0.00 10200.0 FORMAT "%7.1" /end CHARACTERISTIC
/begin AXIS_PTS RLV08_UC "Stutzstellenverteilung für Lastinfo im Befehlstest" 0x811E4F rl_uc SstAUbSstUb 191.3 rel_ub_q0p75 8 0.00 191.3 FORMAT "%5.1" DEPOSIT ABSOLUTE /end AXIS_PTS
/begin CHARACTERISTIC RL_BO_UM "Offset für Toleranzgerade f(rl_um) für rlipf_um in der Funktionsüberwachung" VALUE 0x814070 KwUb 191.3 rel_ub_q0p75 0.00 191.3 FORMAT "%5.1" /end CHARACTERISTIC
/begin CHARACTERISTIC RL_DAT_UC "" VAL_BLK 0x811DC7 KwbUb 191.3 rel_ub_q0p75 0.00 191.3 FORMAT "%5.1" NUMBER 16 /end CHARACTERISTIC
/begin CHARACTERISTIC RL_MO_UM "Steigung für Toleranzgerade f(rl_um) für rlipf_um in der Funktionsüberwachung" VALUE 0x814071 KwUb 255.0 dez 0.00 255.0 FORMAT "%5.1" /end CHARACTERISTIC
/begin CHARACTERISTIC ROMRSTA_UM "maximale Anzahl Resets bei Fehlererkennung im ROM-Check in der Initialisierung" VALUE 0x81421A KwUb 255.0 dez 0.00 255.0 FORMAT "%5.1" /end CHARACTERISTIC
/begin CHARACTERISTIC RST_TV_UM "Kennung zur Anforderung eines Reset-Tastverhältnisses aus der Funktionsüberwach." VALUE 0x814000 KwUb 255.0 dez 0.00 255.0 FORMAT "%5.1" /end CHARACTERISTIC
/begin CHARACTERISTIC SFLAGS_D_UC "" VAL_BLK 0x811DD7 KwbUb 255.0 dez 0.00 255.0 FORMAT "%5.1" NUMBER 16 /end CHARACTERISTIC
/begin CHARACTERISTIC SGSC_D_UC "" VAL_BLK 0x811DE7 KwbUb 255.0 dez 0.00 255.0 FORMAT "%5.1" NUMBER 16 /end CHARACTERISTIC
/begin CHARACTERISTIC SKA_DRHZ_UC "" VALUE 0x811FD2 KwUb 10200. nmot_ub_q40 0.00 10200. FORMAT "%5.0" /end CHARACTERISTIC
/begin CHARACTERISTIC SKA_DRHZ_UM "" VALUE 0x814211 KwUb 10200. nmot_ub_q40 0.00 10200. FORMAT "%5.0" /end CHARACTERISTIC
/begin AXIS_PTS SNM04ZUUW "Stützstellenverteilung Drehzahl" 0x8179F6 nmot_w SstAUwSstUw 16383.75 nmot_uw_q0p25 4 0.00 16383.75 FORMAT "%8.2" DEPOSIT ABSOLUTE /end AXIS_PTS
/begin AXIS_PTS SNM08__UB "Stützstellenverteilung Drehzahl, 8 Sst." 0x81821C nmot SstAUbSstUb 10200. nmot_ub_q40 8 0.00 10200. FORMAT "%5.0" DEPOSIT ABSOLUTE /end AXIS_PTS
/begin AXIS_PTS SNM12ESUB "SST-Verteilung für die Motordrehzahl nmot" 0x8100A1 nmot SstAUbSstUb 10200. nmot_ub_q40 12 0.00 10200. FORMAT "%5.0" DEPOSIT ABSOLUTE /end AXIS_PTS
/begin AXIS_PTS SNM16ZUUW "Stützstellenverteilung Drehzahl, 16 Sst." 0x8134E0 nmot_w SstAUwSstUw 16383.75 nmot_uw_q0p25 16 0.00 16383.75 FORMAT "%8.2" DEPOSIT ABSOLUTE /end AXIS_PTS
/begin AXIS_PTS SNS04ZUSB "Stützstellenverteilung Drehzahlgradient" 0x812497 dns SstAUbSstSb 2550. nmotd_sb_q10 4 -1280. 1270. FORMAT "%5.0" DEPOSIT ABSOLUTE /end AXIS_PTS
/begin CHARACTERISTIC SP12LL_UM "maximale Differenz zwischen SP1S und SP2S unterhalb der Vollgas-Schwelle" VALUE 0x814072 KwUb 4.9805 spg_ub_q0p019 0.00 4.9805 /end CHARACTERISTIC
/begin CHARACTERISTIC SP12VG_UM "maximale Differenz zwischen SP1S und SP2S oberhalb der Vollgas-Schwelle" VALUE 0x814073 KwUb 4.9805 spg_ub_q0p019 0.00 4.9805 /end CHARACTERISTIC
/begin CHARACTERISTIC SP1ADC_DIF "max. Diff. zw. Sollwertpoti1 & Sollwertpoti1 vom Überw.Modul im stationären Fall" VALUE 0x814213 KwUb 4.9805 spg_ub_q0p019 0.00 4.9805 /end CHARACTERISTIC
/begin CHARACTERISTIC SP1_STAT "Bandbreite für die Erkennung auf sp1s stationär" VALUE 0x814214 KwUb 4.9805 spg_ub_q0p019 0.00 4.9805 /end CHARACTERISTIC
/begin CHARACTERISTIC SP1_STAT_T "Zeit für die Erkennung auf sp1s stationär" VALUE 0x814215 KwUb 2.550 t10msxs_ub_b2p55 0.00 2.550 FORMAT "%5.3" /end CHARACTERISTIC
/begin CHARACTERISTIC SPSC_MINUC "" VALUE 0x811DF7 KwUb 4.9805 spg_ub_q0p019 0.00 4.9805 /end CHARACTERISTIC
/begin CHARACTERISTIC SPSC_MIN_UM "" VALUE 0x814074 KwUb 4.9805 spg_ub_q0p019 0.00 4.9805 /end CHARACTERISTIC
/begin CHARACTERISTIC SPSC_T_UM "Fehlerzeit bei zueinander unplausiblen Sollwerten in der Funktionsüberwachung" VALUE 0x814075 KwUb 10200.0 t40ms_ub_b10200 0.00 10200.0 FORMAT "%7.1" /end CHARACTERISTIC
/begin AXIS_PTS SPSNV08_UC "Stützstellenverteilung für Pedalwert im Befehlstest" 0x811E58 spsn_uc SstAUbSstUb 4.9805 spg_ub_q0p019 8 0.00 4.9805 DEPOSIT ABSOLUTE /end AXIS_PTS
/begin AXIS_PTS SPSNV08_UM "Stützstellenverteilung für Pedalwert in der Funktionsüberwachung" 0x814097 spsn_um SstAUbSstUb 4.9805 spg_ub_q0p019 8 0.00 4.9805 DEPOSIT ABSOLUTE /end AXIS_PTS
/begin CHARACTERISTIC SPSN_DAT_UC "" VAL_BLK 0x811DF8 KwbUb 4.9805 spg_ub_q0p019 0.00 4.9805 NUMBER 16 /end CHARACTERISTIC
/begin CHARACTERISTIC SPSVG_UM "Vollgas-Sollwert-Schwelle zur Umschaltung der maximalen Differenz SP1S-SP2S" VALUE 0x814076 KwUb 4.9805 spg_ub_q0p019 0.00 4.9805 /end CHARACTERISTIC
/begin AXIS_PTS SRL06ESUB "Sst-Verteilung für die relative Füllung rl" 0x8100DB rl SstAUbSstUb 191.3 rel_ub_q0p75 6 0.00 191.3 FORMAT "%5.1" DEPOSIT ABSOLUTE /end AXIS_PTS
/begin AXIS_PTS SRL12ZUUW "Stützstellenverteilung relative Luftfüllung, 12 St." 0x813532 rl_w SstAUwSstUw 1535.977 rel_uw_q0p0234 12 0.00 1535.977 FORMAT "%8.3" DEPOSIT ABSOLUTE /end AXIS_PTS
/begin AXIS_PTS STA12WLUB "SST-Verteilung für die Ansauglufttemperatur" 0x810106 tans SstAUbSstUb 191.3 temp_ub_q0p75_o48 12 -48.00 143.3 FORMAT "%5.1" DEPOSIT ABSOLUTE /end AXIS_PTS
/begin AXIS_PTS STM06__UB "Stützstellenverteilung Motortemperatur, 6 Sst." 0x8182B2 tmot SstAUbSstUb 191.3 temp_ub_q0p75_o48 6 -48.00 143.3 FORMAT "%5.1" DEPOSIT ABSOLUTE /end AXIS_PTS
/begin AXIS_PTS STM12ESUB "SST-Verteilung für die Motortemperatur tmot" 0x810126 tmot SstAUbSstUb 191.3 temp_ub_q0p75_o48 12 -48.00 143.3 FORMAT "%5.1" DEPOSIT ABSOLUTE /end AXIS_PTS
/begin CHARACTERISTIC SVFDKSRF "Schwelle Erkennung Fahrzeugstillstand für DK-Selbst-Reinigungsfunktion" VALUE 0x8189A4 KwUb 318.8 vfzg_ub_q1p25 0.00 318.8 FORMAT "%5.1" /end CHARACTERISTIC
/begin CHARACTERISTIC TANSMN_UM "Ansauglufttemperaturschwelle zur Nachstartaufweitung in der Fkt.-Überwachung" VALUE 0x814012 KwUb 191.3 temp_ub_q0p75_o48 -48.00 143.3 FORMAT "%5.1" /end CHARACTERISTIC
/begin CHARACTERISTIC TFLAGS_D_UC "" VAL_BLK 0x811E08 KwbUb 255.0 dez 0.00 255.0 FORMAT "%5.1" NUMBER 16 /end CHARACTERISTIC
/begin CHARACTERISTIC TFWDKSOM "Zeitkonstante für Drosselklappensollwinkelfilterung bei Kl15 aus" VALUE 0x81D68C KwUw 655.34999985 zk10msxs_uw_b655 0.010000152590 655.36000000 FORMAT "%12.8" /end CHARACTERISTIC
/begin CHARACTERISTIC TMNSMN_UM "Motortemperaturschwelle für die Nachstartaufweitung in der FKT.-Überwachung" VALUE 0x814013 KwUb 191.3 temp_ub_q0p75_o48 -48.00 143.3 FORMAT "%5.1" /end CHARACTERISTIC
/begin CHARACTERISTIC TSMNSA "Ladezeit bei SA" VALUE 0x81A939 KwUb 25.50 txms_ub_q0p1 0.00 25.50 FORMAT "%5.2" /end CHARACTERISTIC
/begin CHARACTERISTIC TSMX "Ladezeitbegrenzung" VALUE 0x81A93A KwUb 25.50 txms_ub_q0p1 0.00 25.50 FORMAT "%5.2" /end CHARACTERISTIC
/begin CHARACTERISTIC TSMXNL "Ladezeitbegrenzung im Fehlerfall" VALUE 0x81A93B KwUb 25.50 txms_ub_q0p1 0.00 25.50 FORMAT "%5.2" /end CHARACTERISTIC
/begin CHARACTERISTIC TSRFDKO "Zeitdauer für obere Stopposition (DK-Selbst-Reinigungsfunktion)" VALUE 0x8189A5 KwUb 2.550 t10msxs_ub_b2p55 0.00 2.550 FORMAT "%5.3" /end CHARACTERISTIC
/begin CHARACTERISTIC TSRFDKU "Zeitdauer für untere Stopposition (DK-Selbst-Reinigungsfunktion)" VALUE 0x8189A6 KwUb 2.550 t10msxs_ub_b2p55 0.00 2.550 FORMAT "%5.3" /end CHARACTERISTIC
/begin CHARACTERISTIC TSWKR "Totzeit für Summen-ZW-Spätverstellabfrage" VALUE 0x812620 KwUb 25.50 t100msxs_ub_b25p5 0.00 25.50 FORMAT "%5.2" /end CHARACTERISTIC
/begin CHARACTERISTIC TTIPINEN "Zeit bis zur Abfrage auf Kraftschluß bei Drehzahldynamik" VALUE 0x81249C KwUb 2.550 t10msxs_ub_b2p55 0.00 2.550 FORMAT "%5.3" /end CHARACTERISTIC
/begin CHARACTERISTIC TTIPINON "Einschaltzeit Tip-In Offset auf spätesten Zündwinkel" VALUE 0x81249D KwUb 12.75 t50msxs_ub_b12p75 0.00 12.75 FORMAT "%5.2" /end CHARACTERISTIC
/begin CHARACTERISTIC TVMXPRG "Geschwindigkeits-Prädiktionszeit für VMAX-Regelung" CURVE 0x81A1CC FklWUb 5.100 t20msxs_ub_q0p02 0.00 5.100 FORMAT "%5.3"
 /begin AXIS_DESCR FIX_AXIS gangi dez 8 0.00 7.000 FORMAT "%5.3" FIX_AXIS_PAR 0 0 8 /end AXIS_DESCR
/end CHARACTERISTIC
/begin CHARACTERISTIC TVZWMSA "Zeit bis zum Übergehen auf Dauerspätbegrenzung" VALUE 0x81249E KwUb 2.550 t10msxs_ub_b2p55 0.00 2.550 FORMAT "%5.3" /end CHARACTERISTIC
/begin CHARACTERISTIC TVZWMSE "Zeit bis zum Übergehen auf Dynamikspätbegrenzung" VALUE 0x81249F KwUb 2.550 t10msxs_ub_b2p55 0.00 2.550 FORMAT "%5.3" /end CHARACTERISTIC
/begin CHARACTERISTIC TWDKRED "Wichtung Zeitkonstante für Drosselklappensollwinkelfilterung im Start" VALUE 0x813F30 KwUw 655.34999985 zk10msxs_uw_b655 0.010000152590 655.36000000 FORMAT "%12.8" /end CHARACTERISTIC
/begin CHARACTERISTIC TWDKSNST_0_A "Zeitkonstante für Drosselklappensollwinkelfilterung im Start" CURVE 0x81D68E KlAUbSstUbWUw 655.3500 t10msxs_uw_b655p35 0.00 655.3500 FORMAT "%8.4"
 /begin AXIS_DESCR STD_AXIS tmst temp_ub_q0p75_o48 6 -48.00 143.3 FORMAT "%5.1" DEPOSIT ABSOLUTE /end AXIS_DESCR
/end CHARACTERISTIC
/begin CHARACTERISTIC TWDKSNST_1_A "Zeitkonstante für Drosselklappensollwinkelfilterung im Start" CURVE 0x81D6A2 KlAUbSstUbWUw 655.3500 t10msxs_uw_b655p35 0.00 655.3500 FORMAT "%8.4"
 /begin AXIS_DESCR STD_AXIS tmst temp_ub_q0p75_o48 6 -48.00 143.3 FORMAT "%5.1" DEPOSIT ABSOLUTE /end AXIS_DESCR
/end CHARACTERISTIC
/begin CHARACTERISTIC TZSUDYN "Dauer des Dynamikvorhalts" CURVE 0x812741 KlAUbSstUbWUb 2.550 t10msxs_ub_b2p55 0.00 2.550 FORMAT "%5.3"
 /begin AXIS_DESCR STD_AXIS nmot nmot_ub_q40 6 0.00 10200. FORMAT "%5.0" DEPOSIT ABSOLUTE /end AXIS_DESCR
/end CHARACTERISTIC
/begin CHARACTERISTIC TZTOL_UM "Toleranz zwischen Zeit- und Zahnzählererfassung in Timerinkrementen" VALUE 0x81421E KwUw 65535.00 dez 0.00 65535.00 FORMAT "%8.2" /end CHARACTERISTIC
/begin CHARACTERISTIC UMECRST_TV_UM "" VALUE 0x814001 KwUb 255.0 dez 0.00 255.0 FORMAT "%5.1" /end CHARACTERISTIC
/begin CHARACTERISTIC UMRST_TV_UM "" VALUE 0x814002 KwUb 255.0 dez 0.00 255.0 FORMAT "%5.1" /end CHARACTERISTIC
/begin CHARACTERISTIC VARTAB "Tabelle der zuläßigen Varianten" VAL_BLK 0x8287A8 KwbUw 32767.00 dez 0.00 32767.00 FORMAT "%8.2" NUMBER 120 /end CHARACTERISTIC
/begin CHARACTERISTIC VFZG_DAT_UC "" VAL_BLK 0x816EC8 KwbUw 511.9922 vfzg_uw_q0p00781 0.00 511.9922 FORMAT "%8.4" NUMBER 16 /end CHARACTERISTIC
/begin CHARACTERISTIC VMIN_UC "Minimalgeschwindigkeit für FGR-Betrieb im Befehlstest" VALUE 0x816EE8 KwUw 511.9922 vfzg_uw_q0p00781 0.00 511.9922 FORMAT "%8.4" /end CHARACTERISTIC
/begin CHARACTERISTIC WAIT_T_UM "Wartezeit für Reset-Tastverhältnis aus der Funktionsüberwachung" VALUE 0x81421C KwUw 8332.629 t_wdt_high 0.00 8332.629 FORMAT "%8.3" /end CHARACTERISTIC
/begin CHARACTERISTIC WDKSNLN "Sollwinkel für Drosselklappe bei Kl15 aus" CURVE 0x81D6B6 KlAUbSstUbWUb 99.61 relDK_q0p390631 0.00 99.61 FORMAT "%5.2"
 /begin AXIS_DESCR STD_AXIS nmot nmot_ub_q40 8 0.00 10200. FORMAT "%5.0" DEPOSIT ABSOLUTE /end AXIS_DESCR
/end CHARACTERISTIC
/begin CHARACTERISTIC WDKSRFE "Winkel Drosselklappe Endposition (Selbst-Reinigungsfunktion)" VALUE 0x8189A7 KwUb 99.61 relDK_q0p390631 0.00 99.61 FORMAT "%5.2" /end CHARACTERISTIC
/begin CHARACTERISTIC WDKSRFO "Winkel Drosselklappe obere Stopposition (Selbst-Reinigungsfunktion)" VALUE 0x8189A8 KwUb 99.61 relDK_q0p390631 0.00 99.61 FORMAT "%5.2" /end CHARACTERISTIC
/begin CHARACTERISTIC WDKSRFU "Winkel Drosselklappe untere Stopposition (Selbst-Reinigungsfunktion)" VALUE 0x8189A9 KwUb 99.61 relDK_q0p390631 0.00 99.61 FORMAT "%5.2" /end CHARACTERISTIC
/begin CHARACTERISTIC WDZWOBT "Wichtung DZWOB über evtmod" CURVE 0x81A606 KlAUbSstUbWUb 1.992 fak_ub_b2 0.00 1.992 FORMAT "%5.3"
 /begin AXIS_DESCR STD_AXIS evtmod temp_ub_q0p75_o48 4 -48.00 143.3 FORMAT "%5.1" DEPOSIT ABSOLUTE /end AXIS_DESCR
/end CHARACTERISTIC
/begin CHARACTERISTIC WPHN "Phasengang" CURVE 0x81A5FE GklWSb 191.3 zw_sb_q0p75 -96.00 95.25 FORMAT "%5.2"
 /begin AXIS_DESCR COM_AXIS nmot nmot_ub_q40 8 0.00 10200. AXIS_PTS_REF SNM08__UB /end AXIS_DESCR
/end CHARACTERISTIC
/begin CHARACTERISTIC ZFLAGS_D_UC "" VAL_BLK 0x811E18 KwbUb 255.0 dez 0.00 255.0 FORMAT "%5.1" NUMBER 16 /end CHARACTERISTIC
/begin CHARACTERISTIC ZWAPPL "Applikationsschnittstelle Zündwinkelverstellung" VALUE 0x812179 KwSb 191.3 zw_sb_q0p75 -96.00 95.25 FORMAT "%5.2" /end CHARACTERISTIC
/begin CHARACTERISTIC ZWC_T_UM "Fehlertoleranzzeit der Zündwinkelüberwachung in der Funktionsüberw." VALUE 0x814014 KwUb 255.0 dez 0.00 255.0 FORMAT "%5.1" /end CHARACTERISTIC
/begin CHARACTERISTIC ZWOUT_DAT_UC "" VAL_BLK 0x811E28 KwbUb 191.3 zw_sb_q0p75 0.00 191.3 FORMAT "%5.1" NUMBER 16 /end CHARACTERISTIC
/begin CHARACTERISTIC ZWSPTIP "Zeit für Freischalten des TIPIN-Offsets auf den spätesten Zündwinkel" VALUE 0x817A00 KwUw 655.3500 t10msxs_uw_b655p35 0.00 655.3500 FORMAT "%8.4" /end CHARACTERISTIC
/begin CHARACTERISTIC ZYLANZ_UM "Zylinderzahl für die Zündwinkelüberwachung in der Funktionsüberw." VALUE 0x814015 KwUb 255.0 dez 0.00 255.0 FORMAT "%5.1" /end CHARACTERISTIC
/begin MEASUREMENT adcc_c_um "Fehlerzähler bei zueinander unplausiblen ADC-Werten für sp1s" UBYTE t10msxs_ub_b2p55 1 100 0 2.55 FORMAT "%5.3" ECU_ADDRESS 0x38084F /end MEASUREMENT
/begin MEASUREMENT auscf_c_um "Fehlerzähler im DauerRAM für nicht angezogenes Hauptrelais (Diagnose) in %UMAUSC" UBYTE dez 1 100 0 255 FORMAT "%5.1" ECU_ADDRESS 0x3833EF /end MEASUREMENT
/begin MEASUREMENT ausc_c_um "Prüfungszähler im DauerRAM für nicht angezogenes Hauptrelais im Abschaltpfadtest" UBYTE dez 1 100 0 255 FORMAT "%5.1" ECU_ADDRESS 0x3833F0 /end MEASUREMENT
/begin MEASUREMENT ausgh_c_um "Heilungszähler für Fehler in der zyklischen RAM-Prüfung der Funktionsüberwachung" UBYTE t40ms_ub_b10200 1 100 0 10200 FORMAT "%7.1" ECU_ADDRESS 0x380854 /end MEASUREMENT
/begin MEASUREMENT ausg_c_um "Fehlerzähler für zyklische RAM-Prüfung in der Funktionsüberwachung" UBYTE dezsub1 1 100 1 256 FORMAT "%5.1" ECU_ADDRESS 0x380855 /end MEASUREMENT
/begin MEASUREMENT auszh_c_um "Heilungszähler für Fehler in der zyklischen ROM-Prüfung der Funktionsüberwachung" UBYTE t40ms_ub_b10200 1 100 0 10200 FORMAT "%7.1" ECU_ADDRESS 0x380856 /end MEASUREMENT
/begin MEASUREMENT ausz_c_um "Fehlerzähler für zyklische ROM-Prüfung in der Funktionsüberwachung" UBYTE dezsub1 1 100 1 256 FORMAT "%5.1" ECU_ADDRESS 0x380857 /end MEASUREMENT
/begin MEASUREMENT bzmsr_a_uc "alter MSR-Botschaftszähler fuer Befehlstest" UBYTE dez 1 100 0 255 FORMAT "%5.1" ECU_ADDRESS 0x380AF6 /end MEASUREMENT
/begin MEASUREMENT bz_msr_uc "Befehlstest : MSR-Botschaftszähler für die Funktionsüberwachung" UBYTE dez 1 100 0 255 FORMAT "%5.1" ECU_ADDRESS 0x380AF7 /end MEASUREMENT
/begin MEASUREMENT B_accen_um "ACC-Einschaltung gültig in der Funktionsüberwachung" UBYTE B_TRUE 1 100 0 1 BIT_MASK 0x80 FORMAT "%13.11" ECU_ADDRESS 0x380806 /end MEASUREMENT
/begin MEASUREMENT B_accof_um "" UBYTE B_TRUE 1 100 0 1 BIT_MASK 0x40 FORMAT "%13.11" ECU_ADDRESS 0x380806 /end MEASUREMENT
/begin MEASUREMENT B_bboak_um "Bedingung ""brake booster aktiv"" (CAN) für die Funktionsüberwachung" UBYTE B_TRUE 1 100 0 1 BIT_MASK 0x2 FORMAT "%13.11" ECU_ADDRESS 0x380801 /end MEASUREMENT
/begin MEASUREMENT B_bboe_um "Fehlerhafte Botschaft ""Bremsbooster"" in der Funktionsüberwachung" UBYTE B_TRUE 1 100 0 1 BIT_MASK 0x8 FORMAT "%13.11" ECU_ADDRESS 0x380801 /end MEASUREMENT
/begin MEASUREMENT B_bbovf_um "Bedingung ""brake booster verfügbar"" (CAN) für die Funktionsüberwachung" UBYTE B_TRUE 1 100 0 1 BIT_MASK 0x4 FORMAT "%13.11" ECU_ADDRESS 0x380801 /end MEASUREMENT
/begin MEASUREMENT B_brems_um "Bedingung Bremse getreten für die Funktionsüberwachung" UBYTE B_TRUE 1 100 0 1 BIT_MASK 0x1 FORMAT "%13.11" ECU_ADDRESS 0x380805 /end MEASUREMENT
/begin MEASUREMENT B_brfgr_um "Bedingung Bremse getreten für die Funktionsüberwachung" UBYTE B_TRUE 1 100 0 1 BIT_MASK 0x2 FORMAT "%13.11" ECU_ADDRESS 0x380806 /end MEASUREMENT
/begin MEASUREMENT B_bsl_um "erkannter Low-Pegel am FGR-Bedienhebelschalter Beschleunigen in Funktionsüberw." UBYTE B_TRUE 1 100 0 1 BIT_MASK 0x10 FORMAT "%13.11" ECU_ADDRESS 0x380805 /end MEASUREMENT
/begin MEASUREMENT B_dcdis_c_um "" UBYTE B_TRUE 1 100 0 1 BIT_MASK 0x1 FORMAT "%13.11" ECU_ADDRESS 0x380807 /end MEASUREMENT
/begin MEASUREMENT B_dcdis_um "Fehlerreaktions-Info der Funktionsüberwachung (Abschaltung der DK-Steller-ES)" UBYTE B_TRUE 1 100 0 1 BIT_MASK 0x1 FORMAT "%13.11" ECU_ADDRESS 0x380804 /end MEASUREMENT
/begin MEASUREMENT B_engoff "Bedingung Fahrzeugstillstang und Motor aus (DK-Selbst-Reinigungsfunktion)" UBYTE B_TRUE 1 100 0 1 BIT_MASK 0x40 FORMAT "%13.11" ECU_ADDRESS 0x3809D6 /end MEASUREMENT
/begin MEASUREMENT B_fabr_um "Bedingung ""Fahrer bremst"" (CAN) für die Funktionsüberwachung" UBYTE B_TRUE 1 100 0 1 BIT_MASK 0x1 FORMAT "%13.11" ECU_ADDRESS 0x380801 /end MEASUREMENT
/begin MEASUREMENT B_ff "Bedingung Folgefunkenzündung" UWORD B_TRUE 1 100 0 1 BIT_MASK 0x40 FORMAT "%13.11" ECU_ADDRESS 0xFDA4 /end MEASUREMENT
/begin MEASUREMENT B_fgrca_um "" UBYTE B_TRUE 1 100 0 1 BIT_MASK 0x1 FORMAT "%13.11" ECU_ADDRESS 0x380802 /end MEASUREMENT
/begin MEASUREMENT B_fgrenold_um "" UBYTE B_TRUE 1 100 0 1 BIT_MASK 0x80 FORMAT "%13.11" ECU_ADDRESS 0x380805 /end MEASUREMENT
/begin MEASUREMENT B_fgren_um "FGR-/ACC-Einschaltung aus Bedienhebel gültig in der Funktionsüberwachung" UBYTE B_TRUE 1 100 0 1 BIT_MASK 0x4 FORMAT "%13.11" ECU_ADDRESS 0x380805 /end MEASUREMENT
/begin MEASUREMENT B_fgrfr_uc "FGR-/ACC-Momenteneingriff erlaubt im Befehlstest" UWORD B_TRUE 1 100 0 1 BIT_MASK 0x1000 FORMAT "%13.11" ECU_ADDRESS 0xFD94 /end MEASUREMENT
/begin MEASUREMENT B_fgron_um "Info FGR-Eingriff innerhalb Funktionsüberwachung erlaubt" UBYTE B_TRUE 1 100 0 1 BIT_MASK 0x4 FORMAT "%13.11" ECU_ADDRESS 0x380806 /end MEASUREMENT
/begin MEASUREMENT B_fgr_uc "FGR-/ACC-Momenteneingriff im Befehlstest erlaubt" UWORD B_TRUE 1 100 0 1 BIT_MASK 0x1 FORMAT "%13.11" ECU_ADDRESS 0xFD96 /end MEASUREMENT
/begin MEASUREMENT B_fgr_um_c "" UBYTE B_TRUE 1 100 0 1 BIT_MASK 0x2 FORMAT "%13.11" ECU_ADDRESS 0x380807 /end MEASUREMENT
/begin MEASUREMENT b_flags_uc "Ebene 3 Byte für Botschaftüberwachung (alte Toggle Bits)" UBYTE dez 1 100 0 255 FORMAT "%5.1" ECU_ADDRESS 0x380AF0 /end MEASUREMENT
/begin MEASUREMENT b_flags_um "Flag für Bitinformationen in der Funktionsüberwachung" UBYTE dez 1 100 0 255 FORMAT "%5.1" ECU_ADDRESS 0x380800 /end MEASUREMENT
/begin MEASUREMENT B_i_ska "Funktions-Fehlerreaktion irreversible SKA (Sicherheits-Kraftstoffabschaltung)" UBYTE B_TRUE 1 100 0 1 BIT_MASK 0x4 FORMAT "%13.11" ECU_ADDRESS 0x380804 /end MEASUREMENT
/begin MEASUREMENT B_i_ska_uc "Ebene 3 irreversibles Fehlerbit fuer BT" UWORD B_TRUE 1 100 0 1 BIT_MASK 0x10 FORMAT "%13.11" ECU_ADDRESS 0xFD96 /end MEASUREMENT
/begin MEASUREMENT B_i_ska_um "Fehlerreaktion irrev. SKA (Sicherheitskraftstoffabschaltung) aus Fkt-Überwachung" UWORD B_TRUE 1 100 0 1 BIT_MASK 0x10 FORMAT "%13.11" ECU_ADDRESS 0xFD92 /end MEASUREMENT
/begin MEASUREMENT B_kfzk "Bedingung Kennfeld Klopfschutz" UWORD B_TRUE 1 100 0 1 BIT_MASK 0x20 FORMAT "%13.11" ECU_ADDRESS 0xFDA4 /end MEASUREMENT
/begin MEASUREMENT B_kkl_um "erkannter Low-Pegel am FGR-Bedienhebelschalter Kontrollkontakt in Funktionsüberw" UBYTE B_TRUE 1 100 0 1 BIT_MASK 0x40 FORMAT "%13.11" ECU_ADDRESS 0x380805 /end MEASUREMENT
/begin MEASUREMENT B_ll_um "Bedingung Leerlauf für Ebene II" UBYTE B_TRUE 1 100 0 1 BIT_MASK 0x1 FORMAT "%13.11" ECU_ADDRESS 0x380800 /end MEASUREMENT
/begin MEASUREMENT B_mcacti "Bedingung McMESS aktiv" UWORD B_TRUE 1 100 0 1 BIT_MASK 0x10 FORMAT "%13.11" ECU_ADDRESS 0xFD10 /end MEASUREMENT
/begin MEASUREMENT B_msthw_um "Bedingung Master-SG gemäß Codier-Pin für die Funktionsüberwachung" UBYTE B_TRUE 1 100 0 1 BIT_MASK 0x80 FORMAT "%13.11" ECU_ADDRESS 0x380807 /end MEASUREMENT
/begin MEASUREMENT B_munst "Bedingung Eingriff Momentenüberwachung zulassen" UBYTE B_TRUE 1 100 0 1 BIT_MASK 0x1 FORMAT "%13.11" ECU_ADDRESS 0x3809D6 /end MEASUREMENT
/begin MEASUREMENT B_mzns_c_um "" UBYTE B_TRUE 1 100 0 1 BIT_MASK 0x20 FORMAT "%13.11" ECU_ADDRESS 0x380807 /end MEASUREMENT
/begin MEASUREMENT B_mzns_um "Nachstartaufweitung des zuläsigen Moments in der Funktonsüberwachung aktiv" UWORD B_TRUE 1 100 0 1 BIT_MASK 0x800 FORMAT "%13.11" ECU_ADDRESS 0xFD92 /end MEASUREMENT
/begin MEASUREMENT B_nkons_uc "" UWORD B_TRUE 1 100 0 1 BIT_MASK 0x2 FORMAT "%13.11" ECU_ADDRESS 0xFD96 /end MEASUREMENT
/begin MEASUREMENT B_nlh_um "Anforderung Notlauf mit Lambda 1 aus Funktionsüberwachung" UBYTE B_TRUE 1 100 0 1 BIT_MASK 0x4 FORMAT "%13.11" ECU_ADDRESS 0x380800 /end MEASUREMENT
/begin MEASUREMENT B_nobrs_um "Bremsenbotschaft in der Funktionsüberwachung nicht übernommen" UBYTE B_TRUE 1 100 0 1 BIT_MASK 0x80 FORMAT "%13.11" ECU_ADDRESS 0x380800 /end MEASUREMENT
/begin MEASUREMENT B_nome_c_um "" UBYTE B_TRUE 1 100 0 1 BIT_MASK 0x8 FORMAT "%13.11" ECU_ADDRESS 0x380807 /end MEASUREMENT
/begin MEASUREMENT B_nomsrfr_uc "" UWORD B_TRUE 1 100 0 1 BIT_MASK 0x2000 FORMAT "%13.11" ECU_ADDRESS 0xFD94 /end MEASUREMENT
/begin MEASUREMENT B_nomsr_uc "MSR-Momentenvorgabe im Befehlstest nicht übernommen" UWORD B_TRUE 1 100 0 1 BIT_MASK 0x4 FORMAT "%13.11" ECU_ADDRESS 0xFD96 /end MEASUREMENT
/begin MEASUREMENT B_nosgs_uc "SGS-Momentenvorgabe im Befehlstest nicht übernommen" UWORD B_TRUE 1 100 0 1 BIT_MASK 0x4000 FORMAT "%13.11" ECU_ADDRESS 0xFD94 /end MEASUREMENT
/begin MEASUREMENT B_nosgs_um "SGS-Momentenvorgabe in der Funktionsüberwachung nicht übernommen" UWORD B_TRUE 1 100 0 1 BIT_MASK 0x1000 FORMAT "%13.11" ECU_ADDRESS 0xFD92 /end MEASUREMENT
/begin MEASUREMENT B_notlu "Anforderung Notluftfahren aus der Funktion" UBYTE B_TRUE 1 100 0 1 BIT_MASK 0x8 FORMAT "%13.11" ECU_ADDRESS 0x380804 /end MEASUREMENT
/begin MEASUREMENT B_notst_um "" UBYTE B_TRUE 1 100 0 1 BIT_MASK 0x8 FORMAT "%13.11" ECU_ADDRESS 0x380800 /end MEASUREMENT
/begin MEASUREMENT B_nsakt_um "Nachstart aktiv für die Fkt.-Überwachung" UBYTE B_TRUE 1 100 0 1 BIT_MASK 0x4 FORMAT "%13.11" ECU_ADDRESS 0x380803 /end MEASUREMENT
/begin MEASUREMENT B_nsend_um "Nachstartüberwachungszeit abgelaufen für die Fkt.-Überwachung" UBYTE B_TRUE 1 100 0 1 BIT_MASK 0x1 FORMAT "%13.11" ECU_ADDRESS 0x380803 /end MEASUREMENT
/begin MEASUREMENT B_pwgnotum "= b_pwgnot_um Funktionsüberwachungs-Fehlerreaktion PWG-Leerlauf (= b_pwgnot_sr)" UWORD B_TRUE 1 100 0 1 BIT_MASK 0x4 FORMAT "%13.11" ECU_ADDRESS 0xFD94 /end MEASUREMENT
/begin MEASUREMENT B_res_um "" UBYTE B_TRUE 1 100 0 1 BIT_MASK 0x2 FORMAT "%13.11" ECU_ADDRESS 0x380805 /end MEASUREMENT
/begin MEASUREMENT B_rlini_um "" UBYTE B_TRUE 1 100 0 1 BIT_MASK 0x20 FORMAT "%13.11" ECU_ADDRESS 0x380800 /end MEASUREMENT
/begin MEASUREMENT B_rluf_um "" UBYTE B_TRUE 1 100 0 1 BIT_MASK 0x2 FORMAT "%13.11" ECU_ADDRESS 0x380800 /end MEASUREMENT
/begin MEASUREMENT B_sgsmx_um "" UBYTE B_TRUE 1 100 0 1 BIT_MASK 0x10 FORMAT "%13.11" ECU_ADDRESS 0x380800 /end MEASUREMENT
/begin MEASUREMENT B_srfdke "Bedingung DK in Endposition (Selbst-Reinigungsfunktion)" UBYTE B_TRUE 1 100 0 1 BIT_MASK 0x20 FORMAT "%13.11" ECU_ADDRESS 0x3809D6 /end MEASUREMENT
/begin MEASUREMENT B_srfdko "Bedingung DK in oberer Stopposition (Selbst-Reinigungsfunktion)" UBYTE B_TRUE 1 100 0 1 BIT_MASK 0x8 FORMAT "%13.11" ECU_ADDRESS 0x3809D6 /end MEASUREMENT
/begin MEASUREMENT B_srfdku "Bedingung DK in unterer Stopposition (Selbst-Reinigungsfunktion)" UBYTE B_TRUE 1 100 0 1 BIT_MASK 0x10 FORMAT "%13.11" ECU_ADDRESS 0x3809D6 /end MEASUREMENT
/begin MEASUREMENT B_swdy "Dynamikeinfluß bei Schließzeitberechnung" UWORD B_TRUE 1 100 0 1 BIT_MASK 0x80 FORMAT "%13.11" ECU_ADDRESS 0xFDA4 /end MEASUREMENT
/begin MEASUREMENT B_tfwdksom "Zeitkonstante für Filterung Drosselklappenwinkel ohne Momentenstruktur aktiv" UBYTE B_TRUE 1 100 0 1 BIT_MASK 0x2 FORMAT "%13.11" ECU_ADDRESS 0x3809D6 /end MEASUREMENT
/begin MEASUREMENT B_ubska_c_um "" UBYTE B_TRUE 1 100 0 1 BIT_MASK 0x10 FORMAT "%13.11" ECU_ADDRESS 0x380807 /end MEASUREMENT
/begin MEASUREMENT B_ub_ska "Batteriespannung nicht o.k., Unterspannungsabschaltung aktiv" UBYTE B_TRUE 1 100 0 1 BIT_MASK 0x2 FORMAT "%13.11" ECU_ADDRESS 0x380804 /end MEASUREMENT
/begin MEASUREMENT B_vbmag_um "Verbot Magerbetrieb aus Überwachung" UWORD B_TRUE 1 100 0 1 BIT_MASK 0x100 FORMAT "%13.11" ECU_ADDRESS 0xFD94 /end MEASUREMENT
/begin MEASUREMENT B_vmax "Bedingung VMAX-Regelung aktiv" UWORD B_TRUE 1 100 0 1 BIT_MASK 0x2000 FORMAT "%13.11" ECU_ADDRESS 0xFD8E /end MEASUREMENT
/begin MEASUREMENT B_vzl_um "erkannter Low-Pegel am FGR-Bedienhebelschalter Verzögern in der Funktionsüberw." UBYTE B_TRUE 1 100 0 1 BIT_MASK 0x8 FORMAT "%13.11" ECU_ADDRESS 0x380805 /end MEASUREMENT
/begin MEASUREMENT B_wal_um "erkannter Low-Pegel am FGR-Bedienhebelschalter Wiederaufnahme in Funktionsüberw." UBYTE B_TRUE 1 100 0 1 BIT_MASK 0x20 FORMAT "%13.11" ECU_ADDRESS 0x380805 /end MEASUREMENT
/begin MEASUREMENT B_wdksom "Drosselklappensollwinkel ohne Momentenstruktur aktiv" UBYTE B_TRUE 1 100 0 1 BIT_MASK 0x4 FORMAT "%13.11" ECU_ADDRESS 0x3809D6 /end MEASUREMENT
/begin MEASUREMENT B_zb "Bedingung Schließzeitausgabe" UWORD B_TRUE 1 100 0 1 BIT_MASK 0x100 FORMAT "%13.11" ECU_ADDRESS 0xFDA4 /end MEASUREMENT
/begin MEASUREMENT B_zuesa "Bedingung Schließwinkelausgabe bei SA" UWORD B_TRUE 1 100 0 1 BIT_MASK 0x200 FORMAT "%13.11" ECU_ADDRESS 0xFDA4 /end MEASUREMENT
/begin MEASUREMENT B_zwkra "Bedingung: Zündwinkel der KR wird ausgegeben" UWORD B_TRUE 1 100 0 1 BIT_MASK 0x1000 FORMAT "%13.11" ECU_ADDRESS 0xFDA2 /end MEASUREMENT
/begin MEASUREMENT B_zwmnpst "Bedingung Nachstartphase bzgl. Zündwinkelspätgrenze erreicht" UWORD B_TRUE 1 100 0 1 BIT_MASK 0x1 FORMAT "%13.11" ECU_ADDRESS 0xFDA4 /end MEASUREMENT
/begin MEASUREMENT B_zwms "Bedingung Motorschutz-Zündwinkelbegrenzung" UWORD B_TRUE 1 100 0 1 BIT_MASK 0x2 FORMAT "%13.11" ECU_ADDRESS 0xFDA4 /end MEASUREMENT
/begin MEASUREMENT B_zwspae "Bedingung: Zündwinkel zwspae bei Schubabschaltung wird ausgegeben" UWORD B_TRUE 1 100 0 1 BIT_MASK 0x2000 FORMAT "%13.11" ECU_ADDRESS 0xFDA2 /end MEASUREMENT
/begin MEASUREMENT delayedTime_w "" UWORD t_wdt_high 1 100 0 89477.1 FORMAT "%8.2" ECU_ADDRESS 0x383CD8 /end MEASUREMENT
/begin MEASUREMENT dvsi_w "Abweichung zwischen Soll- und Istgeschwindigkeit der VMAX-Regelung" SWORD vfzg_sw_q0p00781 1 100 -256 255.992 FORMAT "%8.4" ECU_ADDRESS 0x384C48 /end MEASUREMENT
/begin MEASUREMENT dzwdyn "" SBYTE zw_sb_q0p75 1 100 -96 95.25 FORMAT "%5.2" ECU_ADDRESS 0x380B6F /end MEASUREMENT
/begin MEASUREMENT dzwdyntp "Tip-In Korrektur spätester Zündwinkel" SBYTE zw_sb_q0p75 1 100 -96 95.25 FORMAT "%5.2" ECU_ADDRESS 0x380B70 /end MEASUREMENT
/begin MEASUREMENT dzwkg "Delta-Zündwinkel Verschiebung Klopfgrenze" SBYTE zw_sb_q0p75 1 100 -96 95.25 FORMAT "%5.2" ECU_ADDRESS 0x380B79 /end MEASUREMENT
/begin MEASUREMENT dzwmna "Min-Zündwinkel Änderungsgeschwindigeit zw. Brenngrenze und Motorschutz" SBYTE zw_sb_q0p75 1 100 -96 95.25 FORMAT "%5.2" ECU_ADDRESS 0x380B71 /end MEASUREMENT
/begin MEASUREMENT dzwnwsu "Delta ZW aus KFZWNWSUE" SBYTE zw_sb_q0p75 1 100 -96 95.25 FORMAT "%5.2" ECU_ADDRESS 0x380B7A /end MEASUREMENT
/begin MEASUREMENT dzwob "Delta Zündwinkel Zündwinkeloverboost" SBYTE zw_sb_q0p75 1 100 -96 95.25 FORMAT "%5.2" ECU_ADDRESS 0x38492E /end MEASUREMENT
/begin MEASUREMENT dzwspae "Korrektur-Zündwinkel für den spätest erlaubten Zündwinkel" SBYTE zw_sb_q0p75 1 100 -96 95.25 FORMAT "%5.2" ECU_ADDRESS 0x380B72 /end MEASUREMENT
/begin MEASUREMENT dzwwl "Delta Zuendwinkel aus Warmlauf" SBYTE zw_sb_q0p75 1 100 -96 95.25 FORMAT "%5.2" ECU_ADDRESS 0x380B7E /end MEASUREMENT
/begin MEASUREMENT dzwzk "delta Zündwinkel bei Dauerklopfen" SBYTE zw_sb_q0p75 1 100 -96 95.25 FORMAT "%5.2" ECU_ADDRESS 0x380B7B /end MEASUREMENT
/begin MEASUREMENT dzw_uc "Delta Zündwinkel zwischen zwopt und zwout im Befehlstest" UBYTE zw_ub_q0p75 1 100 0 191.25 FORMAT "%5.1" ECU_ADDRESS 0x380B04 /end MEASUREMENT
/begin MEASUREMENT d_flags_um "Byte für ACC-Informations-Bits der Funktionsüberwachung" UBYTE dez 1 100 0 255 FORMAT "%5.1" ECU_ADDRESS 0x380801 /end MEASUREMENT
/begin MEASUREMENT ei_adcc_um "irreversibles Fehlerbit bei der AD-Wandler-Überwachung" UWORD B_TRUE 1 100 0 1 BIT_MASK 0x800 FORMAT "%13.11" ECU_ADDRESS 0xFD94 /end MEASUREMENT
/begin MEASUREMENT ei_ipa_um "irrev. Fehlerbit für unterer DK-Anschlag im ungültigen Bereich in der Fkt-Überw." UWORD B_TRUE 1 100 0 1 BIT_MASK 0x8000 FORMAT "%13.11" ECU_ADDRESS 0xFD92 /end MEASUREMENT
/begin MEASUREMENT ei_msrc_uc "irreversibles Fehlerbit bei der MSR-Überwachung im Befehlstest" UWORD B_TRUE 1 100 0 1 BIT_MASK 0x8 FORMAT "%13.11" ECU_ADDRESS 0xFD96 /end MEASUREMENT
/begin MEASUREMENT ei_mver_uc "Ebene 3 irreversibles Fehlerbit fuer URCMVER aus BT" UWORD B_TRUE 1 100 0 1 BIT_MASK 0x20 FORMAT "%13.11" ECU_ADDRESS 0xFD96 /end MEASUREMENT
/begin MEASUREMENT ei_nc_um "irreversibles Fehlerbit beim Drehzahlvergleich der Funktionsüberwachung" UWORD B_TRUE 1 100 0 1 BIT_MASK 0x400 FORMAT "%13.11" ECU_ADDRESS 0xFD92 /end MEASUREMENT
/begin MEASUREMENT ei_reac_uc "Ebene 3 irreversibles Fehlerbit fuer UFREAC aus BT" UWORD B_TRUE 1 100 0 1 BIT_MASK 0x40 FORMAT "%13.11" ECU_ADDRESS 0xFD96 /end MEASUREMENT
/begin MEASUREMENT ei_reac_um "irreversibles Fehlerbit der Fehlerreaktionsüberwachung der Funktionsüberwachung" UWORD B_TRUE 1 100 0 1 BIT_MASK 0x400 FORMAT "%13.11" ECU_ADDRESS 0xFD94 /end MEASUREMENT
/begin MEASUREMENT ei_rlc_um "irreversibles Fehlerbit beim rl-Vergleich mit der Funktion in der Funktionsüberw" UWORD B_TRUE 1 100 0 1 BIT_MASK 0x1 FORMAT "%13.11" ECU_ADDRESS 0xFD94 /end MEASUREMENT
/begin MEASUREMENT ei_rlip_um "irreversibles Fehlerbit beim rl/rlip-Vergleich der Funktionsüberwachung" UWORD B_TRUE 1 100 0 1 BIT_MASK 0x2 FORMAT "%13.11" ECU_ADDRESS 0xFD94 /end MEASUREMENT
/begin MEASUREMENT ei_sgsc_uc "irreversibles Fehlerbit bei der SGS-Überwachung im Befehlstest" UWORD B_TRUE 1 100 0 1 BIT_MASK 0x8000 FORMAT "%13.11" ECU_ADDRESS 0xFD94 /end MEASUREMENT
/begin MEASUREMENT ei_sgsc_um "irreversibles Fehlerbit bei der SGS-Überwachung der Funktionsüberwachung" UWORD B_TRUE 1 100 0 1 BIT_MASK 0x2000 FORMAT "%13.11" ECU_ADDRESS 0xFD92 /end MEASUREMENT
/begin MEASUREMENT ei_sgso_um "Irreversibles Fehlerbit bei der SGS-Überwachung der Funktionsüberwachung (-1)" UBYTE B_TRUE 1 100 0 1 BIT_MASK 0x20 FORMAT "%13.11" ECU_ADDRESS 0x380802 /end MEASUREMENT
/begin MEASUREMENT ei_spsc_um "irreversibles Fehlerbit bei d. Sollwertplausibilisierung d. Funktionsüberwachung" UWORD B_TRUE 1 100 0 1 BIT_MASK 0x8 FORMAT "%13.11" ECU_ADDRESS 0xFD94 /end MEASUREMENT
/begin MEASUREMENT ei_ubr_um "irrev. Fehlerbit zur Anforderung Fehlereintrag Hauptrelais-Diagnose aus %UMAUSC" UWORD B_TRUE 1 100 0 1 BIT_MASK 0x8 FORMAT "%13.11" ECU_ADDRESS 0xFD92 /end MEASUREMENT
/begin MEASUREMENT ei_zwc_um "irreversibles Fehlerbit bei der Zündwinkelüberwachung der Funktionsüberwachung" UWORD B_TRUE 1 100 0 1 BIT_MASK 0x4000 FORMAT "%13.11" ECU_ADDRESS 0xFD92 /end MEASUREMENT
/begin MEASUREMENT esst_snm04zuuw "" UWORD dez 1 100 0 65535 FORMAT "%8.2" ECU_ADDRESS 0x382C6E /end MEASUREMENT
/begin MEASUREMENT esst_sns04zusb "" UWORD dez 1 100 0 65535 FORMAT "%8.2" ECU_ADDRESS 0x382C70 /end MEASUREMENT
/begin MEASUREMENT etazwmn "Minimum-Zündwinkelwirkungsgrad" UBYTE rel_ub_b127p5 1 100 0 127.5 FORMAT "%5.1" ECU_ADDRESS 0xFA26 /end MEASUREMENT
/begin MEASUREMENT etazw_uc "Ist-Zündwinkelwirkungsgrad im Befehlstest" UBYTE rel_ub_b127p5 1 100 0 127.5 FORMAT "%5.1" ECU_ADDRESS 0x380B05 /end MEASUREMENT
/begin MEASUREMENT evz_aus_uc "Einspritzausblendmuster im Befehlstest" UBYTE dez 1 100 0 255 FORMAT "%5.1" ECU_ADDRESS 0x380AF8 /end MEASUREMENT
/begin MEASUREMENT ftsdrl "Faktor Lastdynamik zur Schließzeitberechnung" UBYTE fak_ub_b8 1 100 0 7.96875 FORMAT "%5.3" ECU_ADDRESS 0x380B80 /end MEASUREMENT
/begin MEASUREMENT ftsdyn "Faktor Drehzahldynamik zur Schließzeitberechnung" UBYTE fak_ub_b8 1 100 0 7.96875 FORMAT "%5.3" ECU_ADDRESS 0x380B81 /end MEASUREMENT
/begin MEASUREMENT ftsub "Faktor Batterieabhängigkeit bei Schließzeitberechnung" UBYTE fak_ub_b8 1 100 0 7.96875 FORMAT "%5.3" ECU_ADDRESS 0x380B82 /end MEASUREMENT
/begin MEASUREMENT fubaanz "Anzahl der Funkenpakete Funkenbandzündung" UBYTE dez 1 100 0 255 FORMAT "%5.1" ECU_ADDRESS 0x380B83 /end MEASUREMENT
/begin MEASUREMENT fzwmn_w "Abregelfaktor Spätwinkel im Nachstart" UWORD fak_uw_b1 1 100 0 0.999985 FORMAT "%9.7" ECU_ADDRESS 0x382C72 /end MEASUREMENT
/begin MEASUREMENT f_flags_um "Byte für Status-Bits der Funktionsüberwachung" UBYTE dez 1 100 0 255 FORMAT "%5.1" ECU_ADDRESS 0x380802 /end MEASUREMENT
/begin MEASUREMENT ipa_c_um "Fehlerzähler für unterer DK-Anschlag im ungültigen Bereich f. d. Funktionsüberw." UBYTE t40ms_ub_b10200 1 100 0 10200 FORMAT "%7.1" ECU_ADDRESS 0x380822 /end MEASUREMENT
/begin MEASUREMENT ipsn_um "aktive DK-Istwertpoti-Info ohne unteren Anschlag für die Funktionsüberwachung" UBYTE spg_ub_q0p019 1 100 0 4.98047 ECU_ADDRESS 0x380823 /end MEASUREMENT
/begin MEASUREMENT mdif_w_uc "Differenz zwischen zulässigem und Ist-Moment im Befehlstest" SWORD rel_ub_q0p3906 1 100 -12800 12799.6 FORMAT "%8.2" ECU_ADDRESS 0x3828E6 /end MEASUREMENT
/begin MEASUREMENT mdst08_uc "" UWORD dez 1 100 0 65535 FORMAT "%8.2" ECU_ADDRESS 0x3828E4 /end MEASUREMENT
/begin MEASUREMENT mdst08_um "Stützstelle für Momenten-Info (MZ_UM) zur Ermittlung des Momenten-Offsets in FU" UWORD dez 1 100 0 65535 FORMAT "%8.2" ECU_ADDRESS 0x38086C /end MEASUREMENT
/begin MEASUREMENT mfgr_uc "Momentenwunsch aus der Fahrgeschwindigkeitsregelung im Befehlstest" UBYTE rel_ub_q0p3906 1 100 0 99.6094 FORMAT "%5.2" ECU_ADDRESS 0x380B01 /end MEASUREMENT
/begin MEASUREMENT mifa_uc "FGR-/ACC- oder Fahrerwunschmoment der Funktion im Befehlstest" UBYTE rel_ub_q0p3906 1 100 0 99.6094 FORMAT "%5.2" ECU_ADDRESS 0x380AF9 /end MEASUREMENT
/begin MEASUREMENT miopt_uc "optimales indiziertes Moment im Befehlstest" UBYTE rel_ub_b99p6 1 100 0 99.6094 FORMAT "%5.2" ECU_ADDRESS 0x380B06 /end MEASUREMENT
/begin MEASUREMENT mivmxi_w "I-Anteil des indizierten Sollmoments der VMAX-Regelung" UWORD rel_uw_b100 1 100 0 99.9985 FORMAT "%8.5" ECU_ADDRESS 0x384C4A /end MEASUREMENT
/begin MEASUREMENT mivmxp_w "P-Anteil des indizierten Sollmoments der VMAX-Regelung" SWORD rel_sw_b100 1 100 -100 99.9969 FORMAT "%8.4" ECU_ADDRESS 0x384C4C /end MEASUREMENT
/begin MEASUREMENT mivmx_w "Indiziertes Sollmoment der VMAX-Regelung" UWORD rel_uw_b100 1 100 0 99.9985 FORMAT "%8.5" ECU_ADDRESS 0x384C4E /end MEASUREMENT
/begin MEASUREMENT mi_uc "Berechnetes Ist-Moment im Befehlstest" UBYTE rel_ub_b99p6 1 100 0 99.6094 FORMAT "%5.2" ECU_ADDRESS 0x380B07 /end MEASUREMENT
/begin MEASUREMENT mmsr_uc "zulässiger MSR-Momentenwunsch für die Funktionsüberwachung" UBYTE rel_ub_q0p3906 1 100 0 99.6094 FORMAT "%5.2" ECU_ADDRESS 0x380B02 /end MEASUREMENT
/begin MEASUREMENT mped_uc "zulässiges indiziertes Moment aus Fahrpedal im Befehlstest" UBYTE rel_ub_b99p6 1 100 0 99.6094 FORMAT "%5.2" ECU_ADDRESS 0x380B09 /end MEASUREMENT
/begin MEASUREMENT mped_um "zulässiges indiziertes Moment aus Fahrpedal in der Funktionsüberwachung" UBYTE rel_ub_b99p6 1 100 0 99.6094 FORMAT "%5.2" ECU_ADDRESS 0x380AEF /end MEASUREMENT
/begin MEASUREMENT msgs_uc "Soll- Motormoment aus Getriebeüberwachung im Befehlstest" UBYTE rel_ub_q0p3906 1 100 0 99.6094 FORMAT "%5.2" ECU_ADDRESS 0x380858 /end MEASUREMENT
/begin MEASUREMENT msgs_um "Soll- Motormoment aus Getriebeüberwachung in der Funktionsüberwachung" UBYTE rel_ub_q0p3906 1 100 0 99.6094 FORMAT "%5.2" ECU_ADDRESS 0x38081F /end MEASUREMENT
/begin MEASUREMENT msrc_c_uc "Fehlerzähler für MSR-Überwachung des Befehlstestes" UBYTE t40ms_ub_b10200 1 100 0 10200 FORMAT "%7.1" ECU_ADDRESS 0x380B03 /end MEASUREMENT
/begin MEASUREMENT mver_c_uc "Fehlerzähler für Momentenvergleich im Befehlstest" UBYTE t40ms_ub_b10200 1 100 0 10200 FORMAT "%7.1" ECU_ADDRESS 0x380B17 /end MEASUREMENT
/begin MEASUREMENT mzfo_uc "Gefiltertes zulässiges Moment inclusive Offset im Befehlstest" UBYTE rel_ub_q0p3906 1 100 0 99.6094 FORMAT "%5.2" ECU_ADDRESS 0x380B18 /end MEASUREMENT
/begin MEASUREMENT mzf_low_uc "" UBYTE rel_ub_q0p00153 1 100 0 0.389074 ECU_ADDRESS 0x380B0C /end MEASUREMENT
/begin MEASUREMENT mzf_ptr_uc "" UBYTE dez 1 100 0 255 FORMAT "%5.1" ECU_ADDRESS 0x380B0D /end MEASUREMENT
/begin MEASUREMENT mzf_reg_uc "" UBYTE rel_ub_q0p3906 1 100 0 99.6094 FORMAT "%5.2" ARRAY_SIZE 8 ECU_ADDRESS 0x380B0E /end MEASUREMENT
/begin MEASUREMENT mzf_uc "gefiltertes zulässiges Moment im Befehlstest" UBYTE rel_ub_q0p3906 1 100 0 99.6094 FORMAT "%5.2" ECU_ADDRESS 0x380B16 /end MEASUREMENT
/begin MEASUREMENT mzo_uc "Toleranz-Offset für das zulässige Moment im Befehlstest" UBYTE rel_ub_b99p6 1 100 0 99.6094 FORMAT "%5.2" ECU_ADDRESS 0x380B0A /end MEASUREMENT
/begin MEASUREMENT mzo_um "Toleranz-Offset fürs zulässige Moment in der Funktionsüberwachung" UBYTE rel_ub_b99p6 1 100 0 99.6094 FORMAT "%5.2" ECU_ADDRESS 0x38083D /end MEASUREMENT
/begin MEASUREMENT mz_uc "resultierendes zulässiges Moment im Befehlstest" UBYTE rel_ub_b99p6 1 100 0 99.6094 FORMAT "%5.2" ECU_ADDRESS 0x380B0B /end MEASUREMENT
/begin MEASUREMENT mz_um "zulässiges Moment in der Funktionsüberwachung" UBYTE rel_ub_b99p6 1 100 0 99.6094 FORMAT "%5.2" ECU_ADDRESS 0x38083E /end MEASUREMENT
/begin MEASUREMENT nc_c_um "Fehlerzähler für Motordrehzahlvergleich für die Funktionsüberwachung" UBYTE t40ms_ub_b10200 1 100 0 10200 FORMAT "%7.1" ECU_ADDRESS 0x38081B /end MEASUREMENT
/begin MEASUREMENT nmot_uc "Motordrehzahl im Befehlstest" UBYTE nmot_ub_q40 1 100 0 10200 FORMAT "%5.0" ECU_ADDRESS 0x380AFA /end MEASUREMENT
/begin MEASUREMENT nmot_um "Motordrehzahl in der Funktionsüberwachung" UBYTE nmot_ub_q40 1 100 0 10200 FORMAT "%5.0" ECU_ADDRESS 0x38081C /end MEASUREMENT
/begin MEASUREMENT nmst08_uc "" UWORD dez 1 100 0 65535 FORMAT "%8.2" ECU_ADDRESS 0x3828DC /end MEASUREMENT
/begin MEASUREMENT nsc_c_um "Zeit nach Start in der Funktionsüberwachung" UWORD t40msxs_uw_q0p04 1 100 0 2621.4 FORMAT "%8.3" ECU_ADDRESS 0x380862 /end MEASUREMENT
/begin MEASUREMENT nska_uc "Grenzdrehzahl bei aktiver Fehlerreaktion im Befehlstest" UBYTE nmot_ub_q40 1 100 0 10200 FORMAT "%5.0" ECU_ADDRESS 0x380B19 /end MEASUREMENT
/begin MEASUREMENT nska_um "Grenzdrehzahl bei aktiver Fehlerreaktion in der Funktionsüberwachung" UBYTE nmot_ub_q40 1 100 0 10200 FORMAT "%5.0" ECU_ADDRESS 0x38084C /end MEASUREMENT
/begin MEASUREMENT nsof_c_um "Zähler Entprellzeit für Abschaltung der Nachstartaufweitung" UBYTE t40ms_ub_b10200 1 100 0 10200 FORMAT "%7.1" ECU_ADDRESS 0x38081E /end MEASUREMENT
/begin MEASUREMENT nzwst08_uc "" UWORD dez 1 100 0 65535 FORMAT "%8.2" ECU_ADDRESS 0x3828DE /end MEASUREMENT
/begin MEASUREMENT nz_um "Motordrehzahl aus Zahnzählerdifferenz pro Zeit in der Funktionsüberwachung" UBYTE nmot_ub_q40 1 100 0 10200 FORMAT "%5.0" ECU_ADDRESS 0x38081D /end MEASUREMENT
/begin MEASUREMENT n_flags_uc "Byte für Nachstart-Bits des Befehlstestes" UBYTE dez 1 100 0 255 FORMAT "%5.1" ECU_ADDRESS 0x380AF1 /end MEASUREMENT
/begin MEASUREMENT n_flags_um "Byte für Nachstart-Bits der Funktionsüberwachung" UBYTE dez 1 100 0 255 FORMAT "%5.1" ECU_ADDRESS 0x380803 /end MEASUREMENT
/begin MEASUREMENT offz_w "Offenzeit Funkenpakete Funkenbandzündung" UWORD tsegment_sy 1 100 0 43.69 FORMAT "%8.5" ECU_ADDRESS 0x382C84 /end MEASUREMENT
/begin MEASUREMENT ofmnstbg "Offset normierter Massenstrom über Drosselklappe, begrenzt" SBYTE m_q0p1 1 100 -12.8 12.7 FORMAT "%5.2" ECU_ADDRESS 0x384874 /end MEASUREMENT
/begin MEASUREMENT pmcod_w "Parametercode der Variantencodierung" UWORD dez 1 100 0 65535 FORMAT "%8.2" ECU_ADDRESS 0x3853B2 /end MEASUREMENT
/begin MEASUREMENT ram_c_um "Fehlerzähler im Dauer-RAM für RAM-Konsistenz-Prüfung (Diagnose) in der Fkt-Überw" UBYTE dez 1 100 0 255 FORMAT "%5.1" ECU_ADDRESS 0x3833F1 /end MEASUREMENT
/begin MEASUREMENT reac_c1_uc "Fehlerzähler 1 für Fehlerreaktionsüberwachung im Befehlstest" UBYTE t40ms_ub_b10200 1 100 0 10200 FORMAT "%7.1" ECU_ADDRESS 0x380B1A /end MEASUREMENT
/begin MEASUREMENT reac_c1_um "Fehlerzähler 1 für Fehlerreaktionsüberwachung in Funktionsüberwachung" UBYTE t40ms_ub_b10200 1 100 0 10200 FORMAT "%7.1" ECU_ADDRESS 0x38084D /end MEASUREMENT
/begin MEASUREMENT reac_c2_uc "Fehlerzähler 2 für Fehlerreaktionsüberwachung im Befehlstest" UBYTE t40ms_ub_b10200 1 100 0 10200 FORMAT "%7.1" ECU_ADDRESS 0x380B1B /end MEASUREMENT
/begin MEASUREMENT reac_c2_um "Fehlerzähler 2 für Fehlerreaktionsüberwachung in Funktionsüberwachung" UBYTE t40ms_ub_b10200 1 100 0 10200 FORMAT "%7.1" ECU_ADDRESS 0x38084E /end MEASUREMENT
/begin MEASUREMENT reac_c_um "Fehlerzähler im Dauer-RAM für Fehlerreaktionsüberwachung (Diagnose) in der FU" UBYTE dez 1 100 0 255 FORMAT "%5.1" ECU_ADDRESS 0x3833F2 /end MEASUREMENT
/begin MEASUREMENT reset_indication_um "" UWORD dez 1 100 0 65535 FORMAT "%8.2" ECU_ADDRESS 0x383CD6 /end MEASUREMENT
/begin MEASUREMENT rlc_c_um "Fehlerzähler für rl-Vergleich mit der Funktion in der Funktionsüberwachung" UBYTE t40ms_ub_b10200 1 100 0 10200 FORMAT "%7.1" ECU_ADDRESS 0x380824 /end MEASUREMENT
/begin MEASUREMENT rlf_ptr_um "Pointer für Schieberegister des Lastfilters" UBYTE dez 1 100 0 255 FORMAT "%5.1" ECU_ADDRESS 0x380825 /end MEASUREMENT
/begin MEASUREMENT rlf_reg_um "" UBYTE rel_ub_q0p75 1 100 0 191.25 FORMAT "%5.1" ARRAY_SIZE 8 ECU_ADDRESS 0x380826 /end MEASUREMENT
/begin MEASUREMENT rlipf_low_um "" UBYTE rel_ub_q0p0029 1 100 0 0.74707 ECU_ADDRESS 0x38082E /end MEASUREMENT
/begin MEASUREMENT rlipf_um "relative Luftfüllung aus Nebenlastsignal hinter Tiefpaß in der Funktionsüberw." UBYTE rel_ub_q0p75 1 100 0 191.25 FORMAT "%5.1" ECU_ADDRESS 0x38082F /end MEASUREMENT
/begin MEASUREMENT rlip_c_um "Fehlerzähler für rl/rlip-Vergleich in der Funktionsüberwachung" UBYTE t40ms_ub_b10200 1 100 0 10200 FORMAT "%7.1" ECU_ADDRESS 0x380830 /end MEASUREMENT
/begin MEASUREMENT rlip_um "relative Luftfüllung aus Nebenlastsignal für die Funktionsüberwachung" UBYTE rel_ub_q0p75 1 100 0 191.25 FORMAT "%5.1" ECU_ADDRESS 0x380831 /end MEASUREMENT
/begin MEASUREMENT rlst08_uc "rlst08_um im Befehlstest" UWORD dez 1 100 0 65535 FORMAT "%8.2" ECU_ADDRESS 0x3828E0 /end MEASUREMENT
/begin MEASUREMENT rlzo_um "obere Toleranzgrenze für rl aus Nebenlastsignal in der Funktionsüberwachung" UBYTE rel_ub_q0p75 1 100 0 191.25 FORMAT "%5.1" ECU_ADDRESS 0x380AEB /end MEASUREMENT
/begin MEASUREMENT rl_uc "relative Luftfüllung im Befehlstest" UBYTE rel_ub_q0p75 1 100 0 191.25 FORMAT "%5.1" ECU_ADDRESS 0x380AFB /end MEASUREMENT
/begin MEASUREMENT rl_um "relative Luftfüllung in der Funktionsüberwachung" UBYTE rel_ub_q0p75 1 100 0 191.25 FORMAT "%5.1" ECU_ADDRESS 0x380832 /end MEASUREMENT
/begin MEASUREMENT rl_w_um "relative Luftfüllung (Word) in der Funktionsüberwachung" UWORD rel_uw_q0p0234 1 100 0 1535.98 FORMAT "%8.3" ECU_ADDRESS 0x38288A /end MEASUREMENT
/begin MEASUREMENT romErrPage "" UBYTE dez 1 100 0 255 FORMAT "%5.1" ECU_ADDRESS 0x3833F3 /end MEASUREMENT
/begin MEASUREMENT romRstC_um "Zähler im DauerRAM für Resets bei ROM-Check-Fehler in der Init. in der FU" UBYTE dez 1 100 0 255 FORMAT "%5.1" ECU_ADDRESS 0x3833FA /end MEASUREMENT
/begin MEASUREMENT romz_c_um "Fehlerzähler im Dauer-RAM für ROM-Prüfung (Diagnose) in der Funktionsüberwachung" UBYTE dez 1 100 0 255 FORMAT "%5.1" ECU_ADDRESS 0x3833F4 /end MEASUREMENT
/begin MEASUREMENT rst_tv "Variable im Dauer-RAM zur Anforderung Reset-Tastverhältnis aus der Fkt-Überwach." UBYTE dez 1 100 0 255 FORMAT "%5.1" ECU_ADDRESS 0x3833F5 /end MEASUREMENT
/begin MEASUREMENT rst_tv_active "" UBYTE dez 1 100 0 255 FORMAT "%5.1" ECU_ADDRESS 0x3833F9 /end MEASUREMENT
/begin MEASUREMENT r_flags_uc "Byte für Fehlerreaktions-Bits des Befehlstest" UBYTE dez 1 100 0 255 FORMAT "%5.1" ECU_ADDRESS 0x380AF2 /end MEASUREMENT
/begin MEASUREMENT r_flags_um "Byte für Fehlerreaktions-Bits der Funktionsüberwachung" UBYTE dez 1 100 0 255 FORMAT "%5.1" ECU_ADDRESS 0x380804 /end MEASUREMENT
/begin MEASUREMENT sgsc_c_uc "Fehlerzähler für Getriebeüberwachung des Befehlstestes" UBYTE t40ms_ub_b10200 1 100 0 10200 FORMAT "%7.1" ECU_ADDRESS 0x380B00 /end MEASUREMENT
/begin MEASUREMENT sp1p_a_um "10ms alter Wert f. Sollwert-Poti 1 (PWG) vom Überwachungsmodul für den ADC-Test" UBYTE spg_ub_q0p019 1 100 0 4.98047 ECU_ADDRESS 0x380850 /end MEASUREMENT
/begin MEASUREMENT sp1p_st_um "Stationärzähler für Sollwertpoti 1 vom Überwachungsmodul" UBYTE t10msxs_ub_b2p55 1 100 0 2.55 FORMAT "%5.3" ECU_ADDRESS 0x380851 /end MEASUREMENT
/begin MEASUREMENT sp1s_a_um "10ms alter Wert f. Sollwert-Poti 1 (PWG) für die Funktionsüberwachung" UBYTE spg_ub_q0p019 1 100 0 4.98047 ECU_ADDRESS 0x380852 /end MEASUREMENT
/begin MEASUREMENT sp1s_st_um "Stationärzähler für Sollwertpoti 1" UBYTE t10msxs_ub_b2p55 1 100 0 2.55 FORMAT "%5.3" ECU_ADDRESS 0x380853 /end MEASUREMENT
/begin MEASUREMENT sp1s_um "aktueller Wert für Sollwert-Poti 1 (PWG) für die Funktionsüberwachung" UBYTE spg_ub_q0p019 1 100 0 4.98047 ECU_ADDRESS 0x380833 /end MEASUREMENT
/begin MEASUREMENT sp2s_um "aktueller Wert für Sollwert-Poti 2 (PWG) für die Funktionsüberwachung" UBYTE spg_ub_q0p0098 1 100 0 2.49023 FORMAT "%5.3" ECU_ADDRESS 0x380834 /end MEASUREMENT
/begin MEASUREMENT spsc_c_um "Fehlerzähler bei zueinander unplausiblen Sollwerten in der Funktionsüberwachung" UBYTE t40ms_ub_b10200 1 100 0 10200 FORMAT "%7.1" ECU_ADDRESS 0x380835 /end MEASUREMENT
/begin MEASUREMENT spsnst08_uc "" UWORD dez 1 100 0 65535 FORMAT "%8.2" ECU_ADDRESS 0x3828E2 /end MEASUREMENT
/begin MEASUREMENT spsn_uc "Pedalwert (8 Bit) im Befehlstest" UBYTE spg_ub_q0p019 1 100 0 4.98047 ECU_ADDRESS 0x380AFC /end MEASUREMENT
/begin MEASUREMENT spsn_um "Pedalsollwert (8 Bit) in der Funktionsüberwachung" UBYTE spg_ub_q0p019 1 100 0 4.98047 ECU_ADDRESS 0x380836 /end MEASUREMENT
/begin MEASUREMENT srst_c_um "Zähler im Dauer-RAM für Software-Reset (Diagnose) aus der Funktionsüberwachung" UBYTE dez 1 100 0 255 FORMAT "%5.1" ECU_ADDRESS 0x3833F6 /end MEASUREMENT
/begin MEASUREMENT szfuba_w "Schließzeit Funkenband" UWORD tsegment_sy 1 100 0 43.69 FORMAT "%8.5" ECU_ADDRESS 0x382C86 /end MEASUREMENT
/begin MEASUREMENT szout_w "Schließzeitausgabe" UWORD txms_uw_q0p1 1 100 0 6553.5 FORMAT "%8.3" ECU_ADDRESS 0x382C88 /end MEASUREMENT
/begin MEASUREMENT szrl_w "korrigierte Schließzeit zur Winkelausgabe" UWORD txms_uw_q0p1 1 100 0 6553.5 FORMAT "%8.3" ECU_ADDRESS 0x382C8A /end MEASUREMENT
/begin MEASUREMENT sztcalc_w "Schliesszeit in Timer 1 Inkrementen" UWORD DEZL 1 100 0 65535 FORMAT "%8.2" ECU_ADDRESS 0x382C8C /end MEASUREMENT
/begin MEASUREMENT s_flags_uc "Byte für Status-Bits des Befehlstests" UBYTE dez 1 100 0 255 FORMAT "%5.1" ECU_ADDRESS 0x380AF3 /end MEASUREMENT
/begin MEASUREMENT s_flags_um "Byte für Status-Bits der Funktionsüberwachung" UBYTE dez 1 100 0 255 FORMAT "%5.1" ECU_ADDRESS 0x380805 /end MEASUREMENT
/begin MEASUREMENT S_schao_um "Gangwechsel findet statt (Kopie für ebene 2')" UBYTE B_TRUE 1 100 0 1 BIT_MASK 0x4 FORMAT "%13.11" ECU_ADDRESS 0x380802 /end MEASUREMENT
/begin MEASUREMENT talt_um "Timerwert des vorhergehenden Berechnungszeitpunkts im 40ms-Raster" UWORD dez 1 100 0 65535 FORMAT "%8.2" ECU_ADDRESS 0x38085A /end MEASUREMENT
/begin MEASUREMENT tcap_um "Timerwert des aktuellen Berechnungszeitpunkts im 40ms-Raster" UWORD dez 1 100 0 65535 FORMAT "%8.2" ECU_ADDRESS 0x38085C /end MEASUREMENT
/begin MEASUREMENT tfwdksom_w "Zeitkonstante für Filterung Drosselklappenwinkel ohne Momentenstruktur" UWORD zk10msxs_uw_b655 1 100 0.0100002 655.36 FORMAT "%12.8" ECU_ADDRESS 0x38205E /end MEASUREMENT
/begin MEASUREMENT tsdrlmx_w "max. drlsolf für Lastdynamik" SWORD rel_sw_q0p0234 1 100 -768 767.977 FORMAT "%8.4" ECU_ADDRESS 0x382C8E /end MEASUREMENT
/begin MEASUREMENT tsrl "lastabhängige Schließzeit" UBYTE txms_ub_q0p1 1 100 0 25.5 FORMAT "%5.2" ECU_ADDRESS 0x380B84 /end MEASUREMENT
/begin MEASUREMENT tsrldyn "Last- und Dynamikkorrigierte Schließzeit" UBYTE txms_ub_q0p1 1 100 0 25.5 FORMAT "%5.2" ECU_ADDRESS 0x380B85 /end MEASUREMENT
/begin MEASUREMENT tzsCtr "" UBYTE dez 1 100 0 255 FORMAT "%5.1" ECU_ADDRESS 0x380B86 /end MEASUREMENT
/begin MEASUREMENT tzwmnnst_w "Zeitkonstante für Abregelrampe spätester Zündwinkel" UWORD zk10msxs_uw_b655 1 100 0.0100002 655.36 FORMAT "%12.8" ECU_ADDRESS 0x382C74 /end MEASUREMENT
/begin MEASUREMENT t_flags_uc "Byte für Tempomat-Bits des Befehlstests" UBYTE dez 1 100 0 255 FORMAT "%5.1" ECU_ADDRESS 0x380AF4 /end MEASUREMENT
/begin MEASUREMENT t_flags_um "Byte für Tempomat-Bits der Funktionsüberwachung" UBYTE dez 1 100 0 255 FORMAT "%5.1" ECU_ADDRESS 0x380806 /end MEASUREMENT
/begin MEASUREMENT ubn "" UWORD B_TRUE 1 100 0 1 BIT_MASK 0x400 FORMAT "%13.11" ECU_ADDRESS 0xFDA4 /end MEASUREMENT
/begin MEASUREMENT uma2_res "Antwortbeitrag des Befehlstests" SWORD dez 1 100 -32768 32767 FORMAT "%8.2" ECU_ADDRESS 0x382836 /end MEASUREMENT
/begin MEASUREMENT umErrorCtrFr "" UBYTE dez 1 100 0 255 FORMAT "%5.1" ECU_ADDRESS 0x380AE9 /end MEASUREMENT
/begin MEASUREMENT umrst_c_um "Zähler im Dauer-RAM für Software-Reset (Diagnose) aus %UMKOM" UBYTE dez 1 100 0 255 FORMAT "%5.1" ECU_ADDRESS 0x3833F7 /end MEASUREMENT
/begin MEASUREMENT urmcksco "Checksumme über Code der Funktionsüberwachung im zyklischen ROM-Test" UWORD dez 1 100 0 65535 FORMAT "%8.2" ARRAY_SIZE 2 ECU_ADDRESS 0x383CDA /end MEASUREMENT
/begin MEASUREMENT urmcksda "Checksumme über Daten der Funktionsüberwachung im zyklischen ROM-Test" UWORD dez 1 100 0 65535 FORMAT "%8.2" ARRAY_SIZE 2 ECU_ADDRESS 0x383CDE /end MEASUREMENT
/begin MEASUREMENT urmpatco "Patch-Adresse im Code der Funktionsüberwachung für Überprüfung zykl. ROM-Test" UWORD dez 1 100 0 65535 FORMAT "%8.2" ARRAY_SIZE 2 ECU_ADDRESS 0x3828E8 /end MEASUREMENT
/begin MEASUREMENT uzue "" UBYTE spg_ubatt 1 100 0 17.952 FORMAT "%5.2" ECU_ADDRESS 0x380B87 /end MEASUREMENT
/begin MEASUREMENT vfzg_uc "Fahrzeuggeschwindigkeit im Befehlstest" UWORD vfzg_uw_q0p00781 1 100 0 511.992 FORMAT "%8.4" ECU_ADDRESS 0x3828CE /end MEASUREMENT
/begin MEASUREMENT vivmx_w "Istgeschwindigkeit der VMAX-Regelung" UWORD vfzg_uw_q0p00781 1 100 0 511.992 FORMAT "%8.4" ECU_ADDRESS 0x384C50 /end MEASUREMENT
/begin MEASUREMENT vkAbgas1 "" UBYTE dez 1 100 0 255 FORMAT "%5.1" ECU_ADDRESS 0xFA18 /end MEASUREMENT
/begin MEASUREMENT vkAbgas2 "" UBYTE dez 1 100 0 255 FORMAT "%5.1" ECU_ADDRESS 0xFA19 /end MEASUREMENT
/begin MEASUREMENT vkAntrieb "" UBYTE dez 1 100 0 255 FORMAT "%5.1" ECU_ADDRESS 0xFA1A /end MEASUREMENT
/begin MEASUREMENT vkASR "" UBYTE dez 1 100 0 255 FORMAT "%5.1" ECU_ADDRESS 0xFA1B /end MEASUREMENT
/begin MEASUREMENT vkASRAntrieb "" UBYTE dez 1 100 0 255 FORMAT "%5.1" ECU_ADDRESS 0xFA1C /end MEASUREMENT
/begin MEASUREMENT vkFzgtyp "Variantenkriterium für Fahrzeugtyp" UBYTE dez 1 100 0 255 FORMAT "%5.1" ECU_ADDRESS 0xFA1D /end MEASUREMENT
/begin MEASUREMENT vkGetriebe "" UBYTE dez 1 100 0 255 FORMAT "%5.1" ECU_ADDRESS 0xFA1E /end MEASUREMENT
/begin MEASUREMENT vsdmr "Vorgabe Drehmomentreserve über Verstellsystem VSxy" UBYTE rel_ub_q0p3906 1 100 0 99.6094 FORMAT "%5.2" ECU_ADDRESS 0x3808A3 /end MEASUREMENT
/begin MEASUREMENT vsfpses "Faktor zur Verstellung Saugrohrdruck zur Applikation Einspritzung" UBYTE fak_ub_b2 1 100 0 1.99219 FORMAT "%5.3" ECU_ADDRESS 0x3808A4 /end MEASUREMENT
/begin MEASUREMENT vsfrk "Korrektur der relativen Kraftstoffmasse über Verstellsysteme" UBYTE fak_ub_b1p25_o0p75 1 100 0.75 1.24805 FORMAT "%5.3" ECU_ADDRESS 0x3808A5 /end MEASUREMENT
/begin MEASUREMENT vske "verstellbarer Offset für Klopferkennungsschwelle über VS20" SBYTE fak_ub_b16 1 100 -8 7.9375 FORMAT "%5.3" ECU_ADDRESS 0x3808A6 /end MEASUREMENT
/begin MEASUREMENT vsldtv "Verstellgröße LDR-Tastverhältnis vom VSx-System zur Applikation" UBYTE tv_ub_b100 1 100 0 99.6094 FORMAT "%5.2" ECU_ADDRESS 0x3808A7 /end MEASUREMENT
/begin MEASUREMENT vsns "Änderung der Solldrehzahl über Verstellsystem VSxy" UBYTE nmot_ub_q10 1 100 0 2550 FORMAT "%5.0" ECU_ADDRESS 0x3808A8 /end MEASUREMENT
/begin MEASUREMENT vsrlmx "Additive Füllungskorrektur für rlmx vom Verstellsystem" SBYTE rel_sb_q0p75 1 100 -96 95.25 FORMAT "%5.2" ECU_ADDRESS 0x3808A9 /end MEASUREMENT
/begin MEASUREMENT vsvmx_w "Sollgeschwindigkeit der VMAX-Regelung" UWORD vfzg_uw_q0p00781 1 100 0 511.992 FORMAT "%8.4" ECU_ADDRESS 0x384C52 /end MEASUREMENT
/begin MEASUREMENT vsvw "Änderung Einspritzvorlagerungswinkel über Verstellsystem" SBYTE zw_sb_q6 1 100 -768 762 FORMAT "%5.1" ECU_ADDRESS 0x3808AA /end MEASUREMENT
/begin MEASUREMENT vswnws "Änderung der Winkel Nockenwelle (variable NWS) über Verstellsystem VSxy" UBYTE wkw_ub_q0p25 1 100 0 63.75 FORMAT "%5.2" ECU_ADDRESS 0x3808AB /end MEASUREMENT
/begin MEASUREMENT vszw "Zündwinkelkorrektur durch Verstellsystem" SBYTE zw_sb_q0p75 1 100 -96 95.25 FORMAT "%5.2" ECU_ADDRESS 0x3808AC /end MEASUREMENT
/begin MEASUREMENT vszwkr "Zylinderindividuelle ZW-Verstellung durch Verstellsystem" SBYTE zw_sb_q0p75 1 100 -96 95.25 FORMAT "%5.2" ARRAY_SIZE 8 ECU_ADDRESS 0x3808AD /end MEASUREMENT
/begin MEASUREMENT wdkped "Offset Drosselklappenwinkel im Start" UBYTE relDK_q0p390631 1 100 0 99.6109 FORMAT "%5.2" ECU_ADDRESS 0x384875 /end MEASUREMENT
/begin MEASUREMENT wdksomAusBits10ms1 "" UBYTE dez 1 100 0 255 FORMAT "%5.1" ECU_ADDRESS 0x3809D6 /end MEASUREMENT
/begin MEASUREMENT wdksom_w "Drosselklappensollwinkel ohne Momentenstruktur" UWORD relDK_uw_b100 1 100 0 100 FORMAT "%8.4" ECU_ADDRESS 0x382060 /end MEASUREMENT
/begin MEASUREMENT wphg "Zündwinkel DG-Phasenkorrektur" SBYTE zw_sb_q0p75 1 100 -96 95.25 FORMAT "%5.2" ECU_ADDRESS 0x380B61 /end MEASUREMENT
/begin MEASUREMENT wri_c_um "Fehlerzähler im Dauer-RAM für RAM-Beschreibbarkeits-Prüfung (Diagnose) in der FU" UBYTE dez 1 100 0 255 FORMAT "%5.1" ECU_ADDRESS 0x3833F8 /end MEASUREMENT
/begin MEASUREMENT x_uc "" UBYTE dez 1 100 0 255 FORMAT "%5.1" ECU_ADDRESS 0x380AFD /end MEASUREMENT
/begin MEASUREMENT y_uc "" UBYTE dez 1 100 0 255 FORMAT "%5.1" ECU_ADDRESS 0x380AFE /end MEASUREMENT
/begin MEASUREMENT zalt_um "Zahnzählerwert des vorhergehenden Berechnungszeitpunkts im 40ms-Raster" UWORD dez 1 100 0 65535 FORMAT "%8.2" ECU_ADDRESS 0x38085E /end MEASUREMENT
/begin MEASUREMENT zcap_um "Zahnzählerwert des aktuellen Berechnungszeitpunkts im 40ms-Raster" UWORD dez 1 100 0 65535 FORMAT "%8.2" ECU_ADDRESS 0x380860 /end MEASUREMENT
/begin MEASUREMENT znachanz "Anzahl der Zündungen im Nachlauf" UBYTE dez 1 100 0 255 FORMAT "%5.1" ECU_ADDRESS 0xFA20 /end MEASUREMENT
/begin MEASUREMENT zsync_um "Kennung für Synchronisation in der Funktionsüberwachung" UBYTE dez 1 100 0 255 FORMAT "%5.1" ECU_ADDRESS 0x380AEA /end MEASUREMENT
/begin MEASUREMENT zwbas "Basiszündwinkel" SBYTE zw_sb_q0p75 1 100 -96 95.25 FORMAT "%5.2" ECU_ADDRESS 0xFA21 /end MEASUREMENT
/begin MEASUREMENT zwbasar "Basiszündwinkelarray" SBYTE zw_sb_q0p75 1 100 -96 95.25 FORMAT "%5.2" ARRAY_SIZE 4 ECU_ADDRESS 0x380B62 /end MEASUREMENT
/begin MEASUREMENT zwc_c_um "Fehlerzähler für Zündwinkelüberwachung in der Funktionsüberwachung" UBYTE dez 1 100 0 255 FORMAT "%5.1" ECU_ADDRESS 0x380820 /end MEASUREMENT
/begin MEASUREMENT zwgru "Grundzündwinkel" SBYTE zw_sb_q0p75 1 100 -96 95.25 FORMAT "%5.2" ECU_ADDRESS 0x380B7C /end MEASUREMENT
/begin MEASUREMENT zwist "Ist-Zündwinkel" SBYTE zw_sb_q0p75 1 100 -96 95.25 FORMAT "%5.2" ECU_ADDRESS 0xFA22 /end MEASUREMENT
/begin MEASUREMENT zwkrafld "Bitmuster des zyl.ind. abgelegten B_zwkra" UBYTE dez 1 100 0 255 FORMAT "%5.1" ECU_ADDRESS 0xFA23 /end MEASUREMENT
/begin MEASUREMENT zwlate "Spätester Zündwinkel nach Motorschutzplausibilisierung" SBYTE zw_sb_q0p75 1 100 -96 95.25 FORMAT "%5.2" ECU_ADDRESS 0x380B73 /end MEASUREMENT
/begin MEASUREMENT zwmn "Spätester Zündwinkel" SBYTE zw_sb_q0p75 1 100 -96 95.25 FORMAT "%5.2" ECU_ADDRESS 0x380B74 /end MEASUREMENT
/begin MEASUREMENT zwmnd "dynamisch spätest zulässiger Zündwinkel" SBYTE zw_sb_q0p75 1 100 -96 95.25 FORMAT "%5.2" ECU_ADDRESS 0x380B75 /end MEASUREMENT
/begin MEASUREMENT zwmnms "dauerhaft spätest möglicher Zündwinkel" SBYTE zw_sb_q0p75 1 100 -96 95.25 FORMAT "%5.2" ECU_ADDRESS 0x380B76 /end MEASUREMENT
/begin MEASUREMENT zwmnt "Zündwinkel der Brenngrenze plus Temperatur- und Dynamikkorrektur" SBYTE zw_sb_q0p75 1 100 -96 95.25 FORMAT "%5.2" ECU_ADDRESS 0x380B77 /end MEASUREMENT
/begin MEASUREMENT zwnws "Grundzündwinkel mit Berücksichtigung von Nockenwellensteuerung" SBYTE zw_sb_q0p75 1 100 -96 95.25 FORMAT "%5.2" ECU_ADDRESS 0x380B7D /end MEASUREMENT
/begin MEASUREMENT zwopt_uc "optimaler Zündwinkel im Befehlstest" SBYTE zw_sb_q0p75 1 100 -96 95.25 FORMAT "%5.2" ECU_ADDRESS 0x380B08 /end MEASUREMENT
/begin MEASUREMENT zwout "Zündwinkel-Ausgabe" SBYTE zw_sb_q0p75 1 100 -96 95.25 FORMAT "%5.2" ECU_ADDRESS 0xFA24 /end MEASUREMENT
/begin MEASUREMENT zwoutar "Zündwinkel-Ausgabe Array" SBYTE zw_sb_q0p75 1 100 -96 95.25 FORMAT "%5.2" ARRAY_SIZE 4 ECU_ADDRESS 0x380B66 /end MEASUREMENT
/begin MEASUREMENT zwoutcpl "Einerkomplement des Zündwinkels für die Funktionsüberwachung" SBYTE zw_sb_q0p75 1 100 -96 95.25 FORMAT "%5.2" ECU_ADDRESS 0x380B6A /end MEASUREMENT
/begin MEASUREMENT zwout_uc "Ausgabe-Zündwinkel im Befehlstest" SBYTE zw_sb_q0p75 1 100 -96 95.25 FORMAT "%5.2" ECU_ADDRESS 0x380AFF /end MEASUREMENT
/begin MEASUREMENT zwout_um "Ausgabe-Zündwinkel für die Funktionsüberwachung" SBYTE zw_sb_q0p75 1 100 -96 95.25 FORMAT "%5.2" ECU_ADDRESS 0x380821 /end MEASUREMENT
/begin MEASUREMENT zwspae "Spätester Zündwinkel" SBYTE zw_sb_q0p75 1 100 -96 95.25 FORMAT "%5.2" ECU_ADDRESS 0x380B78 /end MEASUREMENT
/begin MEASUREMENT zwstt "Zündwinkel im Start" SBYTE zw_sb_q0p75 1 100 -96 95.25 FORMAT "%5.2" ECU_ADDRESS 0x380B7F /end MEASUREMENT
/begin MEASUREMENT zwzyl1 "Zündwinkel Zylinder 1" SBYTE zw_sb_q0p75 1 100 -96 95.25 FORMAT "%5.2" ECU_ADDRESS 0x380B6B /end MEASUREMENT
/begin MEASUREMENT z_flags_uc "Byte für Status-Bits beim 2-SG-Konzept im Befehlstestes" UBYTE dez 1 100 0 255 FORMAT "%5.1" ECU_ADDRESS 0x380AF5 /end MEASUREMENT
/begin MEASUREMENT z_flags_um "Byte für Status-Bits beim 2-SG-Konzept in der Funktionsüberwachung" UBYTE dez 1 100 0 255 FORMAT "%5.1" ECU_ADDRESS 0x380807 /end MEASUREMENT
/begin FUNCTION UFMZUL "12.20     EGAS Überwachungskonzept: zulässiges Moment der Funktionsüberwachung" /begin DEF_CHARACTERISTIC KFMDZOF_UM KFMPED_UM KFMPNS_UM MDV08_UM /end DEF_CHARACTERISTIC /begin REF_CHARACTERISTIC NMV08_UM SPSNV08_UM /end REF_CHARACTERISTIC
 /begin IN_MEASUREMENT mfgr_um mmsr_um msgs_um nmot_um nmst08_um spsnst08_um spsn_um /end IN_MEASUREMENT
 /begin OUT_MEASUREMENT B_vbmag_um mdst08_um mzo_um mz_um /end OUT_MEASUREMENT
 /begin LOC_MEASUREMENT mped_um /end LOC_MEASUREMENT
 /begin SUB_FUNCTION /end SUB_FUNCTION
/end FUNCTION
/begin FUNCTION UFNC "3.20      EGAS Überwachungskonzept: N-Überwachung für die Funktionsüberwachung" /begin DEF_CHARACTERISTIC NC_T_UM NDIF_UM NMIN_UM TZTOL_UM /end DEF_CHARACTERISTIC /begin REF_CHARACTERISTIC /end REF_CHARACTERISTIC /begin IN_MEASUREMENT B_i_ska_um nmot /end IN_MEASUREMENT /begin OUT_MEASUREMENT ei_nc_um nmot_um /end OUT_MEASUREMENT /begin LOC_MEASUREMENT nc_c_um nz_um talt_um tcap_um zalt_um zcap_um zsync_um /end LOC_MEASUREMENT /begin SUB_FUNCTION /end SUB_FUNCTION /end FUNCTION
/begin FUNCTION UFNSC "2.10      EGAS Überwachungskonzept: Nachstartüberwachung für die Funktionsüberwachung"
 /begin DEF_CHARACTERISTIC NSC_T_UM NSOF_T_UM N_START_UM N_STEND_UM TANSMN_UM TMNSMN_UM /end DEF_CHARACTERISTIC
 /begin REF_CHARACTERISTIC /end REF_CHARACTERISTIC
 /begin IN_MEASUREMENT nmot_um tans_um tmot_um /end IN_MEASUREMENT
 /begin OUT_MEASUREMENT B_mzns_um /end OUT_MEASUREMENT
 /begin LOC_MEASUREMENT nsc_c_um nsof_c_um /end LOC_MEASUREMENT
 /begin SUB_FUNCTION /end SUB_FUNCTION
/end FUNCTION
/begin FUNCTION UFREAC "4.30      EGAS Überwachungskonzept: Fehlerreaktionsüberw.d.Funktionsüberwachung" /begin DEF_CHARACTERISTIC KLNPED_UM NOREA_UM REAC_T1_UM REAC_T2_UM SKA_DRHZ_UM /end DEF_CHARACTERISTIC /begin REF_CHARACTERISTIC /end REF_CHARACTERISTIC /begin IN_MEASUREMENT B_i_ska_um evz_aus_um nmot_um spsn_um /end IN_MEASUREMENT /begin OUT_MEASUREMENT ei_reac_um /end OUT_MEASUREMENT /begin LOC_MEASUREMENT nska_um reac_c1_um reac_c2_um /end LOC_MEASUREMENT /begin SUB_FUNCTION /end SUB_FUNCTION /end FUNCTION
/begin FUNCTION UFRLC "5.10      EGAS Überwachungskonzept: Lastsignalüberw. für Funktionsüberwachung"
 /begin DEF_CHARACTERISTIC IP1A_MX_UM IP2A_MN_UM IPA_T_UM KFRLIP_UM NRLIP_UM RLC_T_UM RLIPFIL_UM RLIPTV_UM RLIP_T_UM RL_BO_UM RL_MO_UM /end DEF_CHARACTERISTIC
 /begin REF_CHARACTERISTIC /end REF_CHARACTERISTIC
 /begin IN_MEASUREMENT B_ehfs B_i_ska_um B_wdk2sel iUipoti1_w iUipoti2_w nmot_um rl rl_w udkp1a udkp2a /end IN_MEASUREMENT
 /begin OUT_MEASUREMENT ei_ipa_um ei_rlc_um ei_rlip_um rl_um /end OUT_MEASUREMENT
 /begin LOC_MEASUREMENT ipa_c_um ipsn_um rlc_c_um rlf_ptr_um rlf_reg_um rlipf_low_um rlipf_um rlip_c_um rlip_um rlzo_um rl_w_um /end LOC_MEASUREMENT
 /begin SUB_FUNCTION /end SUB_FUNCTION
/end FUNCTION
/begin FUNCTION UFSGSC "3.10      EGAS Überwachungskonzept: SGS-Eingriff-Überwachung für die Funktionsübersicht" /begin DEF_CHARACTERISTIC /end DEF_CHARACTERISTIC /begin REF_CHARACTERISTIC /end REF_CHARACTERISTIC /begin IN_MEASUREMENT /end IN_MEASUREMENT /begin OUT_MEASUREMENT B_nosgs_um ei_sgsc_um msgs_um /end OUT_MEASUREMENT /begin LOC_MEASUREMENT /end LOC_MEASUREMENT /begin SUB_FUNCTION /end SUB_FUNCTION /end FUNCTION
/begin FUNCTION UFSPSC "2.30      EGAS Überwachungskonzept: Pedal-Sollwert-Ü. für Funktionsüberwachung" /begin DEF_CHARACTERISTIC SP12LL_UM SP12VG_UM SPSC_MIN_UM SPSC_T_UM SPSVG_UM /end DEF_CHARACTERISTIC /begin REF_CHARACTERISTIC /end REF_CHARACTERISTIC
 /begin IN_MEASUREMENT B_i_ska_um B_pwgnotfr B_sp1s B_sp2s B_spsmin iUspoti1_w iUspoti2_w /end IN_MEASUREMENT
 /begin OUT_MEASUREMENT B_pwgnotum ei_spsc_um spsn_um /end OUT_MEASUREMENT
 /begin LOC_MEASUREMENT sp1s_um sp2s_um spsc_c_um /end LOC_MEASUREMENT
 /begin SUB_FUNCTION /end SUB_FUNCTION
/end FUNCTION
/begin FUNCTION UFURAM "" /begin DEF_CHARACTERISTIC RST_TV_UM UMECRST_TV_UM UMRST_TV_UM WAIT_T_UM /end DEF_CHARACTERISTIC /begin REF_CHARACTERISTIC /end REF_CHARACTERISTIC /begin IN_MEASUREMENT /end IN_MEASUREMENT
 /begin OUT_MEASUREMENT b_flags_um B_i_ska_um d_flags_um f_flags_um n_flags_um reac_c_um romz_c_um r_flags_um srst_c_um s_flags_um t_flags_um umrst_c_um wri_c_um z_flags_um /end OUT_MEASUREMENT
 /begin LOC_MEASUREMENT B_accen_um B_accof_um B_bboak_um B_bboe_um B_bbovf_um B_brems_um B_brfgr_um B_bsl_um B_dcdis_c_um B_dcdis_um B_fabr_um B_fgrca_um B_fgrenold_um B_fgren_um B_fgron_um B_fgr_um_c B_i_ska B_kkl_um B_ll_um B_msthw_um B_mzns_c_um B_nlh_um B_nobrs_um B_nome_c_um B_notlu B_notst_um B_nsakt_um B_nsend_um B_res_um B_rlini_um B_rluf_um B_sgsmx_um B_ubska_c_um B_ub_ska B_vzl_um B_wal_um ei_sgso_um ram_c_um reset_indication_um romErrPage rst_tv S_schao_um /end LOC_MEASUREMENT
 /begin SUB_FUNCTION /end SUB_FUNCTION
/end FUNCTION
/begin FUNCTION UFZWC "2.20      EGAS Überwachungskonzept: ZW-Überwachung für Funktionsüberwachung" /begin DEF_CHARACTERISTIC ZWC_T_UM ZYLANZ_UM /end DEF_CHARACTERISTIC /begin REF_CHARACTERISTIC /end REF_CHARACTERISTIC /begin IN_MEASUREMENT B_i_ska_um zwout zwoutcpl /end IN_MEASUREMENT /begin OUT_MEASUREMENT ei_zwc_um zwout_um /end OUT_MEASUREMENT /begin LOC_MEASUREMENT zwc_c_um /end LOC_MEASUREMENT /begin SUB_FUNCTION /end SUB_FUNCTION /end FUNCTION
/begin FUNCTION UMKOM "7.10      EGAS Überwachungskonzept: Frage/Antwort-Kommunikation zw. UM und FR" /begin DEF_CHARACTERISTIC /end DEF_CHARACTERISTIC /begin REF_CHARACTERISTIC /end REF_CHARACTERISTIC /begin IN_MEASUREMENT B_i_ska_um B_ubdve nmot /end IN_MEASUREMENT /begin OUT_MEASUREMENT auscf_c_um ei_ubr_um uma2_res umErrorCtrFr /end OUT_MEASUREMENT /begin LOC_MEASUREMENT ausc_c_um /end LOC_MEASUREMENT /begin SUB_FUNCTION /end SUB_FUNCTION /end FUNCTION
/begin FUNCTION URADCC "2.20      EGAS Überwachungskonzept: AD-Wandler-Test" /begin DEF_CHARACTERISTIC ADCC_T_UM SP1ADC_DIF SP1_STAT SP1_STAT_T /end DEF_CHARACTERISTIC /begin REF_CHARACTERISTIC /end REF_CHARACTERISTIC /begin IN_MEASUREMENT B_i_ska_fr B_i_ska_um B_notlu_fr B_pwgnotum iUspoti1_w /end IN_MEASUREMENT /begin OUT_MEASUREMENT ei_adcc_um /end OUT_MEASUREMENT /begin LOC_MEASUREMENT adcc_c_um sp1p_a_um sp1p_st_um sp1s_a_um sp1s_st_um /end LOC_MEASUREMENT /begin SUB_FUNCTION /end SUB_FUNCTION /end FUNCTION
/begin FUNCTION URAUSG "" /begin DEF_CHARACTERISTIC AUSGH_T_UM AUSG_T_UM AUSZH_T_UM AUSZ_T_UM /end DEF_CHARACTERISTIC /begin REF_CHARACTERISTIC /end REF_CHARACTERISTIC /begin IN_MEASUREMENT /end IN_MEASUREMENT /begin OUT_MEASUREMENT /end OUT_MEASUREMENT /begin LOC_MEASUREMENT ausgh_c_um ausg_c_um auszh_c_um ausz_c_um /end LOC_MEASUREMENT /begin SUB_FUNCTION /end SUB_FUNCTION /end FUNCTION
/begin FUNCTION URCAUS "" /begin DEF_CHARACTERISTIC /end DEF_CHARACTERISTIC /begin REF_CHARACTERISTIC /end REF_CHARACTERISTIC
 /begin IN_MEASUREMENT B_fgr_uc B_i_ska_uc B_nosgs_uc ei_msrc_uc ei_mver_uc ei_reac_uc ei_sgsc_uc mfgr_uc mi_uc mmsr_uc mped_uc msgs_uc mver_c_uc mzfo_uc reac_c1_uc reac_c2_uc uma2_res /end IN_MEASUREMENT
 /begin OUT_MEASUREMENT /end OUT_MEASUREMENT
 /begin LOC_MEASUREMENT /end LOC_MEASUREMENT
 /begin SUB_FUNCTION /end SUB_FUNCTION
/end FUNCTION
/begin FUNCTION URCEIN ""
 /begin DEF_CHARACTERISTIC ASRL_DAT_UC ASRS_DAT_UC BFGR_DAT_UC BNOMSR_DAT_UC BZMSRA_DAT_UC BZMSR_DAT_UC BZ_ST_DAT_UC CBIT_DAT_UC CMSR_DAT_UC EVZ_DAT_UC MEBZA_DAT_UC MECS_DAT_UC MER_D1_UC MER_D2_UC MIFA_DAT_UC MSGS_DAT_UC MSPSN_DAT_UC MSRC_D_UC MVER_D_UC MZFPTR_DAT_UC MZFREG_DAT_UC MZF_DAT_UC MZL_DAT_UC NFLAGS_D_UC NMOT_DAT_UC REAC_D1_UC REAC_D2_UC RFLAGS_D_UC RL_DAT_UC SFLAGS_D_UC SGSC_D_UC SPSC_MINUC SPSN_DAT_UC TFLAGS_D_UC VFZG_DAT_UC ZFLAGS_D_UC ZWOUT_DAT_UC /end DEF_CHARACTERISTIC
 /begin REF_CHARACTERISTIC /end REF_CHARACTERISTIC
 /begin IN_MEASUREMENT /end IN_MEASUREMENT
 /begin OUT_MEASUREMENT bzmsr_a_uc bz_msr_uc B_fgrfr_uc B_nomsrfr_uc evz_aus_uc mifa_uc nmot_uc rl_uc spsn_uc vfzg_uc zwout_uc /end OUT_MEASUREMENT
 /begin LOC_MEASUREMENT x_uc y_uc /end LOC_MEASUREMENT
 /begin SUB_FUNCTION /end SUB_FUNCTION
/end FUNCTION
/begin FUNCTION URCEINS "" /begin DEF_CHARACTERISTIC NMV08_UC NZWV08_UC RLV08_UC SPSNV08_UC /end DEF_CHARACTERISTIC /begin REF_CHARACTERISTIC /end REF_CHARACTERISTIC /begin IN_MEASUREMENT nmot_uc rl_uc spsn_uc /end IN_MEASUREMENT /begin OUT_MEASUREMENT nmst08_uc nzwst08_uc rlst08_uc spsnst08_uc /end OUT_MEASUREMENT /begin LOC_MEASUREMENT /end LOC_MEASUREMENT /begin SUB_FUNCTION /end SUB_FUNCTION /end FUNCTION
/begin FUNCTION URCFGRC "" /begin DEF_CHARACTERISTIC VMIN_UC /end DEF_CHARACTERISTIC /begin REF_CHARACTERISTIC /end REF_CHARACTERISTIC /begin IN_MEASUREMENT B_fgrfr_uc mifa_uc vfzg_uc /end IN_MEASUREMENT /begin OUT_MEASUREMENT B_fgr_uc mfgr_uc /end OUT_MEASUREMENT /begin LOC_MEASUREMENT /end LOC_MEASUREMENT /begin SUB_FUNCTION /end SUB_FUNCTION /end FUNCTION
/begin FUNCTION URCMIST "" /begin DEF_CHARACTERISTIC KFMI_UC KFZW_UC KLETAZW_UC /end DEF_CHARACTERISTIC /begin REF_CHARACTERISTIC NZWV08_UC RLV08_UC /end REF_CHARACTERISTIC /begin IN_MEASUREMENT nmot_uc nzwst08_uc rlst08_uc rl_uc zwout_uc /end IN_MEASUREMENT /begin OUT_MEASUREMENT mi_uc /end OUT_MEASUREMENT /begin LOC_MEASUREMENT dzw_uc etazw_uc miopt_uc zwopt_uc /end LOC_MEASUREMENT /begin SUB_FUNCTION /end SUB_FUNCTION /end FUNCTION
/begin FUNCTION URCMSRC "" /begin DEF_CHARACTERISTIC BZ_MSR_UC DBZ_MN_UC DBZ_MX_UC MSRC_T_UC NOASR_UC /end DEF_CHARACTERISTIC /begin REF_CHARACTERISTIC /end REF_CHARACTERISTIC /begin IN_MEASUREMENT bzmsr_a_uc bz_msr_uc B_nomsrfr_uc /end IN_MEASUREMENT /begin OUT_MEASUREMENT B_nomsr_uc ei_msrc_uc mmsr_uc msrc_c_uc /end OUT_MEASUREMENT /begin LOC_MEASUREMENT B_nkons_uc /end LOC_MEASUREMENT /begin SUB_FUNCTION /end SUB_FUNCTION /end FUNCTION
/begin FUNCTION URCMVER "" /begin DEF_CHARACTERISTIC MVER_T_UC /end DEF_CHARACTERISTIC /begin REF_CHARACTERISTIC /end REF_CHARACTERISTIC /begin IN_MEASUREMENT mi_uc mzf_uc mzo_uc /end IN_MEASUREMENT /begin OUT_MEASUREMENT B_i_ska_uc ei_mver_uc mver_c_uc mzfo_uc /end OUT_MEASUREMENT /begin LOC_MEASUREMENT mdif_w_uc /end LOC_MEASUREMENT /begin SUB_FUNCTION /end SUB_FUNCTION /end FUNCTION
/begin FUNCTION URCMZF "" /begin DEF_CHARACTERISTIC MZFFIL_UC MZFTV_UC /end DEF_CHARACTERISTIC /begin REF_CHARACTERISTIC /end REF_CHARACTERISTIC /begin IN_MEASUREMENT mz_uc /end IN_MEASUREMENT /begin OUT_MEASUREMENT mzf_low_uc mzf_ptr_uc mzf_reg_uc mzf_uc /end OUT_MEASUREMENT /begin LOC_MEASUREMENT /end LOC_MEASUREMENT /begin SUB_FUNCTION /end SUB_FUNCTION /end FUNCTION
/begin FUNCTION URCMZUL "" /begin DEF_CHARACTERISTIC KFMDZOF_UC KFMPED_UC KFMPNS_UC MDV08_UC /end DEF_CHARACTERISTIC /begin REF_CHARACTERISTIC NMV08_UC SPSNV08_UC /end REF_CHARACTERISTIC
 /begin IN_MEASUREMENT mfgr_uc mmsr_uc msgs_uc nmot_uc nmst08_uc spsnst08_uc spsn_uc /end IN_MEASUREMENT
 /begin OUT_MEASUREMENT mdst08_uc mped_uc mzo_uc mz_uc /end OUT_MEASUREMENT
 /begin LOC_MEASUREMENT /end LOC_MEASUREMENT
 /begin SUB_FUNCTION /end SUB_FUNCTION
/end FUNCTION
/begin FUNCTION URCRAM "" /begin DEF_CHARACTERISTIC /end DEF_CHARACTERISTIC /begin REF_CHARACTERISTIC /end REF_CHARACTERISTIC /begin IN_MEASUREMENT /end IN_MEASUREMENT
 /begin OUT_MEASUREMENT b_flags_uc n_flags_uc r_flags_uc s_flags_uc t_flags_uc z_flags_uc /end OUT_MEASUREMENT
 /begin LOC_MEASUREMENT /end LOC_MEASUREMENT
 /begin SUB_FUNCTION /end SUB_FUNCTION
/end FUNCTION
/begin FUNCTION URCREAC "" /begin DEF_CHARACTERISTIC KLNPED_UC NOREA_UC REAC_T1_UC REAC_T2_UC SKA_DRHZ_UC /end DEF_CHARACTERISTIC /begin REF_CHARACTERISTIC /end REF_CHARACTERISTIC /begin IN_MEASUREMENT B_i_ska_uc evz_aus_uc nmot_uc spsn_uc /end IN_MEASUREMENT /begin OUT_MEASUREMENT ei_reac_uc reac_c1_uc reac_c2_uc /end OUT_MEASUREMENT /begin LOC_MEASUREMENT nska_uc /end LOC_MEASUREMENT /begin SUB_FUNCTION /end SUB_FUNCTION /end FUNCTION
/begin FUNCTION URCREF "" /begin DEF_CHARACTERISTIC /end DEF_CHARACTERISTIC /begin REF_CHARACTERISTIC MZFTV_UC /end REF_CHARACTERISTIC
 /begin IN_MEASUREMENT msrc_c_uc mver_c_uc mzf_low_uc mzf_ptr_uc mzf_reg_uc mzf_uc reac_c1_uc reac_c2_uc sgsc_c_uc /end IN_MEASUREMENT
 /begin OUT_MEASUREMENT /end OUT_MEASUREMENT
 /begin LOC_MEASUREMENT /end LOC_MEASUREMENT
 /begin SUB_FUNCTION /end SUB_FUNCTION
/end FUNCTION
/begin FUNCTION URCSGSC "" /begin DEF_CHARACTERISTIC /end DEF_CHARACTERISTIC /begin REF_CHARACTERISTIC /end REF_CHARACTERISTIC /begin IN_MEASUREMENT /end IN_MEASUREMENT /begin OUT_MEASUREMENT B_nosgs_uc ei_sgsc_uc msgs_uc sgsc_c_uc /end OUT_MEASUREMENT /begin LOC_MEASUREMENT /end LOC_MEASUREMENT /begin SUB_FUNCTION /end SUB_FUNCTION /end FUNCTION
/begin FUNCTION URDELAY "" /begin DEF_CHARACTERISTIC /end DEF_CHARACTERISTIC /begin REF_CHARACTERISTIC NOREA_UM RST_TV_UM WAIT_T_UM /end REF_CHARACTERISTIC /begin IN_MEASUREMENT rst_tv /end IN_MEASUREMENT /begin OUT_MEASUREMENT delayedTime_w rst_tv_active /end OUT_MEASUREMENT /begin LOC_MEASUREMENT /end LOC_MEASUREMENT /begin SUB_FUNCTION /end SUB_FUNCTION /end FUNCTION
/begin FUNCTION URMEM "3.10      EGAS Überwachungskonzept: Zyklischer Speichertest" /begin DEF_CHARACTERISTIC /end DEF_CHARACTERISTIC /begin REF_CHARACTERISTIC /end REF_CHARACTERISTIC /begin IN_MEASUREMENT /end IN_MEASUREMENT /begin OUT_MEASUREMENT urmcksco urmcksda urmpatco /end OUT_MEASUREMENT /begin LOC_MEASUREMENT /end LOC_MEASUREMENT /begin SUB_FUNCTION /end SUB_FUNCTION /end FUNCTION
/begin FUNCTION URRAM "2.10      EGAS Überwachungskonzept: RAM-Test" /begin DEF_CHARACTERISTIC /end DEF_CHARACTERISTIC /begin REF_CHARACTERISTIC /end REF_CHARACTERISTIC /begin IN_MEASUREMENT /end IN_MEASUREMENT /begin OUT_MEASUREMENT /end OUT_MEASUREMENT /begin LOC_MEASUREMENT /end LOC_MEASUREMENT /begin SUB_FUNCTION /end SUB_FUNCTION /end FUNCTION
/begin FUNCTION URROM "2.20      EGAS Überwachungskonzept: ROM-Test" /begin DEF_CHARACTERISTIC CW_NOROMCHKRESET ROMRSTA_UM /end DEF_CHARACTERISTIC /begin REF_CHARACTERISTIC /end REF_CHARACTERISTIC /begin IN_MEASUREMENT B_nlsiko swOffDlBits /end IN_MEASUREMENT /begin OUT_MEASUREMENT romRstC_um /end OUT_MEASUREMENT /begin LOC_MEASUREMENT /end LOC_MEASUREMENT /begin SUB_FUNCTION /end SUB_FUNCTION /end FUNCTION
/begin FUNCTION VAR "332.60    Variantencodierung" /begin DEF_CHARACTERISTIC VARTAB /end DEF_CHARACTERISTIC /begin REF_CHARACTERISTIC /end REF_CHARACTERISTIC /begin IN_MEASUREMENT /end IN_MEASUREMENT
 /begin OUT_MEASUREMENT vkAbgas1 vkAbgas2 vkAntrieb vkASR vkASRAntrieb vkFzgtyp vkGetriebe /end OUT_MEASUREMENT
 /begin LOC_MEASUREMENT /end LOC_MEASUREMENT
 /begin SUB_FUNCTION /end SUB_FUNCTION
/end FUNCTION
/begin FUNCTION VAR_DST "" /begin DEF_CHARACTERISTIC /end DEF_CHARACTERISTIC /begin REF_CHARACTERISTIC VARDEF VARTAB /end REF_CHARACTERISTIC /begin IN_MEASUREMENT /end IN_MEASUREMENT /begin OUT_MEASUREMENT /end OUT_MEASUREMENT /begin LOC_MEASUREMENT pmcod_w /end LOC_MEASUREMENT /begin SUB_FUNCTION /end SUB_FUNCTION /end FUNCTION
/begin FUNCTION VMAXMD "5.10      Drehmomentanforderung von VMAX-Regelung" /begin DEF_CHARACTERISTIC KIVMXG KPVMXG TVMXPRG /end DEF_CHARACTERISTIC /begin REF_CHARACTERISTIC /end REF_CHARACTERISTIC /begin IN_MEASUREMENT bfzgl_w dmllri_w gangi mifab_w mimin_w vfzg_w vmax_w /end IN_MEASUREMENT /begin OUT_MEASUREMENT B_vmax mivmx_w /end OUT_MEASUREMENT /begin LOC_MEASUREMENT dvsi_w mivmxi_w mivmxp_w vivmx_w vsvmx_w /end LOC_MEASUREMENT /begin SUB_FUNCTION /end SUB_FUNCTION /end FUNCTION
/begin FUNCTION VS_VERST "2.40      Verstellparameter für McMess" /begin DEF_CHARACTERISTIC CWVSV /end DEF_CHARACTERISTIC /begin REF_CHARACTERISTIC /end REF_CHARACTERISTIC /begin IN_MEASUREMENT /end IN_MEASUREMENT
 /begin OUT_MEASUREMENT vsdmr vsfpses vsfrk vske vsldtv vsns vsrlmx vsvw vswnws vszw vszwkr /end OUT_MEASUREMENT
 /begin LOC_MEASUREMENT B_mcacti /end LOC_MEASUREMENT
 /begin SUB_FUNCTION /end SUB_FUNCTION
/end FUNCTION
/begin FUNCTION WDKSOM "Berechnung Drosselklappensollwinkel ohne Momentenstruktur"
 /begin DEF_CHARACTERISTIC CWWDKSOM KFWDKOFST KFWDKSST KFWDKTHO_0_A KFWDKTHO_1_A KFWDKTHOKH KLWDKABST_0_A KLWDKABST_1_A KLWDKPED KLWDKTAN NWDKSST_0_A NWDKSST_1_A OFMNSTO OFMNSTU SVFDKSRF TFWDKSOM TSRFDKO TSRFDKU TWDKRED TWDKSNST_0_A TWDKSNST_1_A WDKSNLN WDKSRFE WDKSRFO WDKSRFU /end DEF_CHARACTERISTIC
 /begin REF_CHARACTERISTIC /end REF_CHARACTERISTIC
 /begin IN_MEASUREMENT B_enllri B_kha B_llrein B_nmin B_nmot fho_w miist_w miszul_w nmot ofmsndk_w tabst_w tans tmst vfzg wped /end IN_MEASUREMENT
 /begin OUT_MEASUREMENT B_engoff B_munst B_srfdke B_srfdko B_srfdku B_tfwdksom B_wdksom tfwdksom_w wdksomAusBits10ms1 wdksom_w /end OUT_MEASUREMENT
 /begin LOC_MEASUREMENT ofmnstbg wdkped /end LOC_MEASUREMENT
 /begin SUB_FUNCTION /end SUB_FUNCTION
/end FUNCTION
/begin FUNCTION ZUE "282.130   Grundfunktion - Zündung" /begin DEF_CHARACTERISTIC KLZWBSMN NACHANZ WPHN ZWAPPL /end DEF_CHARACTERISTIC /begin REF_CHARACTERISTIC SNM08__UB /end REF_CHARACTERISTIC
 /begin IN_MEASUREMENT B_llrein B_nozwe B_sa B_zwappl dwkrz dzwob dzwwl dzwzk esst_snm08__ub nmot redist vstdzw vszw wkrdy zwgru zwsol zwspae zwstt zzylzue /end IN_MEASUREMENT
 /begin OUT_MEASUREMENT B_zwkra B_zwspae znachanz zwbas zwbasar zwist zwkrafld zwout zwoutar zwoutcpl zwzyl1 /end OUT_MEASUREMENT
 /begin LOC_MEASUREMENT wphg /end LOC_MEASUREMENT
 /begin SUB_FUNCTION /end SUB_FUNCTION
/end FUNCTION
/begin FUNCTION ZUESZ "3.50      Zündung, Berechnung Schließzeit"
 /begin DEF_CHARACTERISTIC CW_FUBND DTSDRL DUBZS FFLDZ FSWTM FSZTM FTOMN FTSDRLW FUBAOF FWNMOT KFFFANZ KFSZDUB KFSZT KFTSDYN KFTSRL NMNZUESA NMXZUESA TSMNSA TSMX TSMXNL TZSUDYN /end DEF_CHARACTERISTIC
 /begin REF_CHARACTERISTIC /end REF_CHARACTERISTIC
 /begin IN_MEASUREMENT B_lsd B_sa drlsolf_w E_dk E_lm ngfil ngfil_w nmot nmot_w rl tmot ub wped /end IN_MEASUREMENT
 /begin OUT_MEASUREMENT B_ff fubaanz offz_w szfuba_w sztcalc_w /end OUT_MEASUREMENT
 /begin LOC_MEASUREMENT B_swdy B_zb B_zuesa ftsdrl ftsdyn ftsub szout_w szrl_w tsdrlmx_w tsrl tsrldyn tzsCtr ubn uzue /end LOC_MEASUREMENT
 /begin SUB_FUNCTION /end SUB_FUNCTION
/end FUNCTION
/begin FUNCTION ZWGRU "23.110    Grundzündwinkel" /begin DEF_CHARACTERISTIC CNOKT DZWNWSUE KFDZK KFDZWKG KFSWKFZK KFZW KFZW2 TSWKR /end DEF_CHARACTERISTIC /begin REF_CHARACTERISTIC SNM16ZUUW SRL12ZUUW /end REF_CHARACTERISTIC
 /begin IN_MEASUREMENT B_krdws dzwoag dzwol esst_snm16zuuw esst_srl12zuuw fnwue lambas nmot nmot_w rl_w wkrma wnwue /end IN_MEASUREMENT
 /begin OUT_MEASUREMENT B_kfzk dzwkg dzwnwsu dzwzk zwgru /end OUT_MEASUREMENT
 /begin LOC_MEASUREMENT zwnws /end LOC_MEASUREMENT
 /begin SUB_FUNCTION /end SUB_FUNCTION
/end FUNCTION
/begin FUNCTION ZWMIN "3.160     Berechnung des spätest erlaubten Zündwinkels"
 /begin DEF_CHARACTERISTIC CWKHZW DNTIPDYN DNZWMN DZWAML DZWDYN DZWSPM FZWKHMX KFDZMNST KFZWMN_0_A KFZWMN_1_A KFZWMNKH KFZWMNST KFZWMS KLFZWMNKH_0_A KLFZWMNKH_1_A KLFZWMNST_0_A KLFZWMNST_1_A SNM04ZUUW SNS04ZUSB TTIPINEN TTIPINON TVZWMSA TVZWMSE ZWSPTIP /end DEF_CHARACTERISTIC
 /begin REF_CHARACTERISTIC ETADZW SNM16ZUUW SRL12ZUUW STM06__UB /end REF_CHARACTERISTIC
 /begin IN_MEASUREMENT B_kh B_kuppl B_kw B_ll B_llrein B_munst B_sa B_st dns dzwoag dzw_kge esst_snm16zuuw esst_srl12zuuw esst_stm06__ub fmdkh gangi migs_w misolv_w misol_w ml ngfil nmot nmot_w nstat rl rl_w tmot tnst_w zwist zwopt zwstt /end IN_MEASUREMENT
 /begin OUT_MEASUREMENT dzwspae esst_snm04zuuw esst_sns04zusb etazwmn zwspae /end OUT_MEASUREMENT
 /begin LOC_MEASUREMENT B_zwmnpst B_zwms dzwdyn dzwdyntp dzwmna fzwmn_w tzwmnnst_w zwlate zwmn zwmnd zwmnms zwmnt /end LOC_MEASUREMENT
 /begin SUB_FUNCTION /end SUB_FUNCTION
/end FUNCTION
/begin FUNCTION ZWOB "4.10      Zündwinkel - Overboost" /begin DEF_CHARACTERISTIC KFDZWOB KFTZWOB WDZWOBT /end DEF_CHARACTERISTIC /begin REF_CHARACTERISTIC /end REF_CHARACTERISTIC /begin IN_MEASUREMENT evtmod nmot nmot_w rl rl_w /end IN_MEASUREMENT /begin OUT_MEASUREMENT dzwob /end OUT_MEASUREMENT /begin LOC_MEASUREMENT /end LOC_MEASUREMENT /begin SUB_FUNCTION /end SUB_FUNCTION /end FUNCTION
/begin FUNCTION ZWSTT "4.30      Zündung im Start" /begin DEF_CHARACTERISTIC DZWSTTA KFZWSTTM /end DEF_CHARACTERISTIC /begin REF_CHARACTERISTIC /end REF_CHARACTERISTIC /begin IN_MEASUREMENT B_llrein nmot tans tmst /end IN_MEASUREMENT /begin OUT_MEASUREMENT zwstt /end OUT_MEASUREMENT /begin LOC_MEASUREMENT /end LOC_MEASUREMENT /begin SUB_FUNCTION /end SUB_FUNCTION /end FUNCTION
/begin FUNCTION ZWWL "5.40      Warmlauf Zündwinkel" /begin DEF_CHARACTERISTIC FZWWLRLN KFZWWLNM KFZWWLRL /end DEF_CHARACTERISTIC /begin REF_CHARACTERISTIC SNM12ESUB SRL06ESUB STA12WLUB STM12ESUB /end REF_CHARACTERISTIC
 /begin IN_MEASUREMENT esst_snm12esub esst_srl06esub esst_sta12wlub esst_stm12esub nmot rl tans tmot /end IN_MEASUREMENT
 /begin OUT_MEASUREMENT dzwwl /end OUT_MEASUREMENT
 /begin LOC_MEASUREMENT /end LOC_MEASUREMENT
 /begin SUB_FUNCTION /end SUB_FUNCTION
/end FUNCTION
/begin COMPU_METHOD B_TRUE "boolsche Zustände, positive Logik" TAB_VERB "%6.3" "" COMPU_TAB_REF B_TRUE /end COMPU_METHOD
/begin COMPU_VTAB B_TRUE "boolsche Zustände, positive Logik" TAB_VERB 2 0 "----" 1 "TRUE" /end COMPU_VTAB
/begin COMPU_METHOD dez "1 : 1 Umrechnug (dez/hex)" RAT_FUNC "%6.2" "" COEFFS 0 1 0 0 0 1 /end COMPU_METHOD
/begin COMPU_METHOD DEZL "Dezimalzahl in 16-Bit-Hexzahl" RAT_FUNC "%6.2" "" COEFFS 0 1 0 0 0 1 /end COMPU_METHOD
/begin COMPU_METHOD dezsub1 "" RAT_FUNC "%6.2" "-" COEFFS 0 1 -1 0 0 1 /end COMPU_METHOD
/begin COMPU_METHOD fak_ub_b1 "" RAT_FUNC "%6.4" "-" COEFFS 0 256 0 0 0 1 /end COMPU_METHOD
/begin COMPU_METHOD fak_ub_b16 "" RAT_FUNC "%6.4" "-" COEFFS 0 256 0 0 0 16 /end COMPU_METHOD
/begin COMPU_METHOD fak_ub_b1p25_o0p75 "" RAT_FUNC "%6.3" "-" COEFFS 0 1 -0.75 0 0 0.00195313 /end COMPU_METHOD
/begin COMPU_METHOD fak_ub_b2 "" RAT_FUNC "%6.4" "-" COEFFS 0 256 0 0 0 2 /end COMPU_METHOD
/begin COMPU_METHOD fak_ub_b8 "" RAT_FUNC "%6.4" "-" COEFFS 0 256 0 0 0 8 /end COMPU_METHOD
/begin COMPU_METHOD fak_uw_b1 "" RAT_FUNC "%7.6" "-" COEFFS 0 65536 0 0 0 1 /end COMPU_METHOD
/begin COMPU_METHOD fak_uw_b4 "" RAT_FUNC "%7.6" "-" COEFFS 0 65536 0 0 0 4 /end COMPU_METHOD
/begin COMPU_METHOD fak_uw_b8 "" RAT_FUNC "%6.5" "-" COEFFS 0 65536 0 0 0 8 /end COMPU_METHOD
/begin COMPU_METHOD kw_q0p5 "" RAT_FUNC "%6.3" "°KW" COEFFS 0 2 0 0 0 1 /end COMPU_METHOD
/begin COMPU_METHOD m_q0p1 "" RAT_FUNC "%6.3" "kg/h" COEFFS 0 10 0 0 0 1 /end COMPU_METHOD
/begin COMPU_METHOD m_ub_b1020 "" RAT_FUNC "%6.2" "kg/h" COEFFS 0 1 0 0 0 4 /end COMPU_METHOD
/begin COMPU_METHOD nmotd_sb_q10 "" RAT_FUNC "%6.1" "U/min" COEFFS 0 1 0 0 0 10 /end COMPU_METHOD
/begin COMPU_METHOD nmotg_sb_q100 "" RAT_FUNC "%6.0" "U/min/s" COEFFS 0 1 0 0 0 100 /end COMPU_METHOD
/begin COMPU_METHOD nmotg_sw_q0p39 "" RAT_FUNC "%6.3" "U/min/s" COEFFS 0 1 0 0 0 0.39063 /end COMPU_METHOD
/begin COMPU_METHOD nmot_ub_q10 "" RAT_FUNC "%6.1" "U/min" COEFFS 0 1 0 0 0 10 /end COMPU_METHOD
/begin COMPU_METHOD nmot_ub_q40 "" RAT_FUNC "%6.1" "Upm" COEFFS 0 1 0 0 0 40 /end COMPU_METHOD
/begin COMPU_METHOD nmot_uw_q0p25 "" RAT_FUNC "%6.3" "U/min" COEFFS 0 1 0 0 0 0.25 /end COMPU_METHOD
/begin COMPU_METHOD relDK_q0p390631 "" RAT_FUNC "%6.3" "%" COEFFS 0 65535 0 0 0 25600 /end COMPU_METHOD
/begin COMPU_METHOD relDK_uw_b100 "" RAT_FUNC "%6.4" "% DK" COEFFS 0 65535 0 0 0 100 /end COMPU_METHOD
/begin COMPU_METHOD relPED_ub_b100 "" RAT_FUNC "%6.3" "% PED" COEFFS 0 255 0 0 0 100 /end COMPU_METHOD
/begin COMPU_METHOD rel_q0p007629 "" RAT_FUNC "%10.6" "%/(km/h)/s" COEFFS 0 65536 0 0 0 500 /end COMPU_METHOD
/begin COMPU_METHOD rel_sb_q0p75 "" RAT_FUNC "%6.3" "%" COEFFS 0 1 0 0 0 0.75 /end COMPU_METHOD
/begin COMPU_METHOD rel_sw_b100 "" RAT_FUNC "%6.4" "%" COEFFS 0 32768 0 0 0 100 /end COMPU_METHOD
/begin COMPU_METHOD rel_sw_q0p0234 "" RAT_FUNC "%6.4" "%/seg" COEFFS 0 32 0 0 0 0.75 /end COMPU_METHOD
/begin COMPU_METHOD rel_ub_b127p5 "" RAT_FUNC "%6.3" "%" COEFFS 0 2 0 0 0 1 /end COMPU_METHOD
/begin COMPU_METHOD rel_ub_b99p6 "" RAT_FUNC "%6.3" "%" COEFFS 0 256 0 0 0 100 /end COMPU_METHOD
/begin COMPU_METHOD rel_ub_q0p00153 "" RAT_FUNC "%6.4" "%" COEFFS 0 256 0 0 0 0.3906 /end COMPU_METHOD
/begin COMPU_METHOD rel_ub_q0p0029 "" RAT_FUNC "%6.4" "%" COEFFS 0 256 0 0 0 0.75 /end COMPU_METHOD
/begin COMPU_METHOD rel_ub_q0p3906 "" RAT_FUNC "%6.3" "%" COEFFS 0 256 0 0 0 100 /end COMPU_METHOD
/begin COMPU_METHOD rel_ub_q0p391 "" RAT_FUNC "%6.3" "%/km/h" COEFFS 0 1 0 0 0 0.391 /end COMPU_METHOD
/begin COMPU_METHOD rel_ub_q0p75 "" RAT_FUNC "%6.3" "%" COEFFS 0 1 0 0 0 0.75 /end COMPU_METHOD
/begin COMPU_METHOD rel_uw_b100 "" RAT_FUNC "%6.4" "%" COEFFS 0 65536 0 0 0 100 /end COMPU_METHOD
/begin COMPU_METHOD rel_uw_q0p0234 "" RAT_FUNC "%6.4" "%" COEFFS 0 32 0 0 0 0.75 /end COMPU_METHOD
/begin COMPU_METHOD spg_ubatt "" RAT_FUNC "%6.4" "V" COEFFS 0 1 0 0 0 0.0704 /end COMPU_METHOD
/begin COMPU_METHOD spg_ub_q0p0098 "" RAT_FUNC "%6.4" "V" COEFFS 0 256 0 0 0 2.5 /end COMPU_METHOD
/begin COMPU_METHOD spg_ub_q0p019 "" RAT_FUNC "%6.4" "V" COEFFS 0 256 0 0 0 5 /end COMPU_METHOD
/begin COMPU_METHOD t100msxs_ub_b25p5 "" RAT_FUNC "%6.3" "s" COEFFS 0 1 0 0 0 0.1 /end COMPU_METHOD
/begin COMPU_METHOD t10msxs_ub_b2p55 "" RAT_FUNC "%6.4" "s" COEFFS 0 1 0 0 0 0.01 /end COMPU_METHOD
/begin COMPU_METHOD t10msxs_uw_b655p35 "" RAT_FUNC "%6.4" "s" COEFFS 0 1 0 0 0 0.01 /end COMPU_METHOD
/begin COMPU_METHOD t1sxs_uw_q1 "" RAT_FUNC "%6.2" "s" COEFFS 0 1 0 0 0 1 /end COMPU_METHOD
/begin COMPU_METHOD t200msxs_sb_b25p5 "" RAT_FUNC "%6.3" "s" COEFFS 0 1 0 0 0 0.2 /end COMPU_METHOD
/begin COMPU_METHOD t20msxs_ub_q0p02 "" RAT_FUNC "%6.4" "s" COEFFS 0 50 0 0 0 1 /end COMPU_METHOD
/begin COMPU_METHOD t40msxs_uw_q0p04 "" RAT_FUNC "%6.4" "s" COEFFS 0 1 0 0 0 0.04 /end COMPU_METHOD
/begin COMPU_METHOD t40ms_ub_b10200 "" RAT_FUNC "%7.2" "ms" COEFFS 0 1 0 0 0 40 /end COMPU_METHOD
/begin COMPU_METHOD t50msxs_ub_b12p75 "" RAT_FUNC "%6.4" "s" COEFFS 0 1 0 0 0 0.05 /end COMPU_METHOD
/begin COMPU_METHOD temp_ub_q0p75_o48 "" RAT_FUNC "%6.2" "Grad C" COEFFS 0 1 48 0 0 0.75 /end COMPU_METHOD
/begin COMPU_METHOD tsegment_sy "" RAT_FUNC "%6.5" "ms" COEFFS 0 1500 0 0 0 1 /end COMPU_METHOD
/begin COMPU_METHOD tv_ub_b100 "" RAT_FUNC "%6.3" "%" COEFFS 0 256 0 0 0 100 /end COMPU_METHOD
/begin COMPU_METHOD txms_ub_q0p1 "" RAT_FUNC "%6.3" "ms" COEFFS 0 10 0 0 0 1 /end COMPU_METHOD
/begin COMPU_METHOD txms_uw_q0p1 "" RAT_FUNC "%6.3" "ms" COEFFS 0 10 0 0 0 1 /end COMPU_METHOD
/begin COMPU_METHOD t_wdt_high "" RAT_FUNC "%6.2" "ms" COEFFS 0 0.732422 0 0 0 1 /end COMPU_METHOD
/begin COMPU_METHOD vfzg_sw_q0p00781 "" RAT_FUNC "%6.4" "km/h" COEFFS 0 1 0 0 0 0.0078125 /end COMPU_METHOD
/begin COMPU_METHOD vfzg_ub_q1p25 "" RAT_FUNC "%6.2" "km/h" COEFFS 0 1 0 0 0 1.25 /end COMPU_METHOD
/begin COMPU_METHOD vfzg_uw_q0p00781 "" RAT_FUNC "%6.4" "km/h" COEFFS 0 1 0 0 0 0.0078125 /end COMPU_METHOD
/begin COMPU_METHOD wkw_ub_q0p25 "" RAT_FUNC "%6.3" "° KW" COEFFS 0 100 0 0 0 25 /end COMPU_METHOD
/begin COMPU_METHOD zk10msxs_uw_b655 "" RAT_FUNC "%12.5" "s" COEFFS 0 0 65536 0 100 0 /end COMPU_METHOD
/begin COMPU_METHOD zk40ms_ub_b10200 "" RAT_FUNC "%6.1" "ms" COEFFS 0 0 10240 0 1 40 /end COMPU_METHOD
/begin COMPU_METHOD zw_sb_q0p75 "" RAT_FUNC "%6.3" "grad KW" COEFFS 0 255 0 0 0 191.25 /end COMPU_METHOD
/begin COMPU_METHOD zw_sb_q6 "" RAT_FUNC "%6.2" "Grad KW" COEFFS 0 1 0 0 0 6 /end COMPU_METHOD
/begin COMPU_METHOD zw_ub_q0p75 "" RAT_FUNC "%6.3" "Grad KW" COEFFS 0 255 0 0 0 191.25 /end COMPU_METHOD
/begin COMPU_METHOD zw_ub_qn0p75 "" RAT_FUNC "%6.4" "grad KW" COEFFS 0 1 0 0 0 -0.75 /end COMPU_METHOD
/begin RECORD_LAYOUT FklWUb FNC_VALUES 1 UBYTE COLUMN_DIR DIRECT /end RECORD_LAYOUT
/begin RECORD_LAYOUT FklWUw FNC_VALUES 1 UWORD COLUMN_DIR DIRECT /end RECORD_LAYOUT
/begin RECORD_LAYOUT GkfWSb FNC_VALUES 1 SBYTE COLUMN_DIR DIRECT /end RECORD_LAYOUT
/begin RECORD_LAYOUT GkfWUb FNC_VALUES 1 UBYTE COLUMN_DIR DIRECT /end RECORD_LAYOUT
/begin RECORD_LAYOUT GklWSb FNC_VALUES 1 SBYTE COLUMN_DIR DIRECT /end RECORD_LAYOUT
/begin RECORD_LAYOUT KfAxUbAyUbSstxSwSstyUbWUw NO_AXIS_PTS_X 1 UBYTE NO_AXIS_PTS_Y 2 UBYTE AXIS_PTS_X 3 SWORD INDEX_INCR DIRECT AXIS_PTS_Y 4 UBYTE INDEX_INCR DIRECT FNC_VALUES 5 UWORD COLUMN_DIR DIRECT /end RECORD_LAYOUT
/begin RECORD_LAYOUT KfAxUbAyUbSstxUbSstyUbWSb NO_AXIS_PTS_X 1 UBYTE NO_AXIS_PTS_Y 2 UBYTE AXIS_PTS_X 3 UBYTE INDEX_INCR DIRECT AXIS_PTS_Y 4 UBYTE INDEX_INCR DIRECT FNC_VALUES 5 SBYTE COLUMN_DIR DIRECT /end RECORD_LAYOUT
/begin RECORD_LAYOUT KfAxUbAyUbSstxUbSstyUbWUb NO_AXIS_PTS_X 1 UBYTE NO_AXIS_PTS_Y 2 UBYTE AXIS_PTS_X 3 UBYTE INDEX_INCR DIRECT AXIS_PTS_Y 4 UBYTE INDEX_INCR DIRECT FNC_VALUES 5 UBYTE COLUMN_DIR DIRECT /end RECORD_LAYOUT
/begin RECORD_LAYOUT KfAxUbAyUbSstxUbSstyUwWUw NO_AXIS_PTS_X 1 UBYTE NO_AXIS_PTS_Y 2 UBYTE AXIS_PTS_X 3 UBYTE INDEX_INCR DIRECT AXIS_PTS_Y 4 UWORD INDEX_INCR DIRECT FNC_VALUES 5 UWORD COLUMN_DIR DIRECT /end RECORD_LAYOUT
/begin RECORD_LAYOUT KfAxUbAyUbSstxUwSstySbWSb NO_AXIS_PTS_X 1 UBYTE NO_AXIS_PTS_Y 2 UBYTE AXIS_PTS_X 3 UWORD INDEX_INCR DIRECT AXIS_PTS_Y 4 SBYTE INDEX_INCR DIRECT FNC_VALUES 5 SBYTE COLUMN_DIR DIRECT /end RECORD_LAYOUT
/begin RECORD_LAYOUT KfWUb FNC_VALUES 1 UBYTE COLUMN_DIR DIRECT /end RECORD_LAYOUT
/begin RECORD_LAYOUT KlAUbSstUbWSb NO_AXIS_PTS_X 1 UBYTE AXIS_PTS_X 2 UBYTE INDEX_INCR DIRECT FNC_VALUES 3 SBYTE COLUMN_DIR DIRECT /end RECORD_LAYOUT
/begin RECORD_LAYOUT KlAUbSstUbWUb NO_AXIS_PTS_X 1 UBYTE AXIS_PTS_X 2 UBYTE INDEX_INCR DIRECT FNC_VALUES 3 UBYTE COLUMN_DIR DIRECT /end RECORD_LAYOUT
/begin RECORD_LAYOUT KlAUbSstUbWUw NO_AXIS_PTS_X 1 UBYTE AXIS_PTS_X 2 UBYTE INDEX_INCR DIRECT FNC_VALUES 3 UWORD COLUMN_DIR DIRECT /end RECORD_LAYOUT
/begin RECORD_LAYOUT KlAUbSstUwWUb NO_AXIS_PTS_X 1 UWORD AXIS_PTS_X 2 UWORD INDEX_INCR DIRECT FNC_VALUES 3 UBYTE COLUMN_DIR DIRECT /end RECORD_LAYOUT
/begin RECORD_LAYOUT KlAUwSstSwWUw NO_AXIS_PTS_X 1 UWORD AXIS_PTS_X 2 SWORD INDEX_INCR DIRECT FNC_VALUES 3 UWORD COLUMN_DIR DIRECT /end RECORD_LAYOUT
/begin RECORD_LAYOUT KwbUb FNC_VALUES 1 UBYTE COLUMN_DIR DIRECT /end RECORD_LAYOUT
/begin RECORD_LAYOUT KwbUw FNC_VALUES 1 UWORD COLUMN_DIR DIRECT /end RECORD_LAYOUT
/begin RECORD_LAYOUT KwSb FNC_VALUES 1 SBYTE COLUMN_DIR DIRECT /end RECORD_LAYOUT
/begin RECORD_LAYOUT KwSw FNC_VALUES 1 SWORD COLUMN_DIR DIRECT /end RECORD_LAYOUT
/begin RECORD_LAYOUT KwUb FNC_VALUES 1 UBYTE COLUMN_DIR DIRECT /end RECORD_LAYOUT
/begin RECORD_LAYOUT KwUw FNC_VALUES 1 UWORD COLUMN_DIR DIRECT /end RECORD_LAYOUT
/begin RECORD_LAYOUT SstAUbSstSb NO_AXIS_PTS_X 1 UBYTE AXIS_PTS_X 2 SBYTE INDEX_INCR DIRECT /end RECORD_LAYOUT
/begin RECORD_LAYOUT SstAUbSstUb NO_AXIS_PTS_X 1 UBYTE AXIS_PTS_X 2 UBYTE INDEX_INCR DIRECT /end RECORD_LAYOUT
/begin RECORD_LAYOUT SstAUwSstUw NO_AXIS_PTS_X 1 UWORD AXIS_PTS_X 2 UWORD INDEX_INCR DIRECT /end RECORD_LAYOUT
/end MODULE
/end PROJECT
