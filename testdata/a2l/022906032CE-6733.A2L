ASAP2_VERSION 1 3
/begin PROJECT S1103A_25G5_0 "S1103A"
/begin HEADER "" VERSION "S1103A_25G5_0" PROJECT_NO S1103A_25G5_0 /end HEADER
/begin MODULE DIM ""
/begin MOD_COMMON "" BYTE_ORDER MSB_LAST ALIGNMENT_BYTE 1 ALIGNMENT_WORD 2 ALIGNMENT_LONG 2 /end MOD_COMMON
/begin CHARACTERISTIC ATISLATM "" CURVE 0x8EA930 GklWUw 65535.00 dez 0.00 65535.00 FORMAT "%8.2"
 /begin AXIS_DESCR COM_AXIS tmst temp_ub_q0p75_o48 12 -48.00 143.3 FORMAT "%5.1" AXIS_PTS_REF STS12ESUB /end AXIS_DESCR
/end CHARACTERISTIC
/begin CHARACTERISTIC ATIWKSTM "" CURVE 0x8EA948 GklWUw 65535.00 dez 0.00 65535.00 FORMAT "%8.2"
 /begin AXIS_DESCR COM_AXIS tmst temp_ub_q0p75_o48 12 -48.00 143.3 FORMAT "%5.1" AXIS_PTS_REF STS12ESUB /end AXIS_DESCR
/end CHARACTERISTIC
/begin CHARACTERISTIC AZKELDYN "" CURVE 0x8E279B GklWUb 254.0 dez 1.000 255.0 FORMAT "%5.1"
 /begin AXIS_DESCR COM_AXIS nmot nmot_ub_q40 16 0.00 10200. FORMAT "%5.0" AXIS_PTS_REF SNM16KRUB /end AXIS_DESCR
/end CHARACTERISTIC
/begin CHARACTERISTIC AZKRLDYN "" CURVE 0x8E27AB GklWUb 254.0 dez 1.000 255.0 FORMAT "%5.1"
 /begin AXIS_DESCR COM_AXIS nmot nmot_ub_q40 16 0.00 10200. FORMAT "%5.0" AXIS_PTS_REF SNM16KRUB /end AXIS_DESCR
/end CHARACTERISTIC
/begin CHARACTERISTIC AZKRNDYN "" CURVE 0x8E27BB GklWUb 254.0 dez 1.000 255.0 FORMAT "%5.1"
 /begin AXIS_DESCR COM_AXIS nmot nmot_ub_q40 16 0.00 10200. FORMAT "%5.0" AXIS_PTS_REF SNM16KRUB /end AXIS_DESCR
/end CHARACTERISTIC
/begin CHARACTERISTIC CDWGANG "" VALUE 0x8FD385 KwUb 255.0 dez 0.00 255.0 FORMAT "%5.1" /end CHARACTERISTIC
/begin CHARACTERISTIC CDWGANGB "" VALUE 0x8FD386 KwUb 255.0 dez 0.00 255.0 FORMAT "%5.1" /end CHARACTERISTIC
/begin CHARACTERISTIC CDWKOB "" VALUE 0x8FD387 KwUb 255.0 dez 0.00 255.0 FORMAT "%5.1" /end CHARACTERISTIC
/begin CHARACTERISTIC CNFKUPPL "" VALUE 0x8FD188 KwUb 255.0 dez 0.00 255.0 FORMAT "%5.1" /end CHARACTERISTIC
/begin CHARACTERISTIC CNFLLRNS "" VALUE 0x8E29AF KwUb 255.0 dez 0.00 255.0 FORMAT "%5.1" /end CHARACTERISTIC
/begin CHARACTERISTIC CWCKBI "" VALUE 0x8E3FD4 KwUb 255.0 dez 0.00 255.0 FORMAT "%5.1" /end CHARACTERISTIC
/begin CHARACTERISTIC CWDEZWO "" VALUE 0x8E49D8 KwUb 255.0 dez 0.00 255.0 FORMAT "%5.1" /end CHARACTERISTIC
/begin CHARACTERISTIC CWFAN "" VALUE 0x8E2F32 KwUb 255.0 dez 0.00 255.0 FORMAT "%5.1" /end CHARACTERISTIC
/begin CHARACTERISTIC CWGANGLA "" VALUE 0x8E49D9 KwUb 255.0 dez 0.00 255.0 FORMAT "%5.1" /end CHARACTERISTIC
/begin CHARACTERISTIC CWKLDFA "" VALUE 0x8E29B0 KwUb 255.0 dez 0.00 255.0 FORMAT "%5.1" /end CHARACTERISTIC
/begin CHARACTERISTIC CWKMTR "" VALUE 0x8F1132 KwUw 65535.00 dez 0.00 65535.00 FORMAT "%8.2" /end CHARACTERISTIC
/begin CHARACTERISTIC CWKMTR2 "" VALUE 0x8E49DA KwUb 255.0 dez 0.00 255.0 FORMAT "%5.1" /end CHARACTERISTIC
/begin CHARACTERISTIC CWKOC "" VALUE 0x8FD388 KwUb 255.0 dez 0.00 255.0 FORMAT "%5.1" /end CHARACTERISTIC
/begin CHARACTERISTIC CWKOCAN "" VALUE 0x8FD389 KwUb 255.0 dez 0.00 255.0 FORMAT "%5.1" /end CHARACTERISTIC
/begin CHARACTERISTIC CWKOR "" VALUE 0x8FD38A KwUb 255.0 dez 0.00 255.0 FORMAT "%5.1" /end CHARACTERISTIC
/begin CHARACTERISTIC CWKR "" VALUE 0x8E27CB KwUb 1.000 dez 0.00 1.000 FORMAT "%5.3" /end CHARACTERISTIC
/begin CHARACTERISTIC CWKRLZFK "" VALUE 0x8E26B3 KwUb 255.0 dez 0.00 255.0 FORMAT "%5.1" /end CHARACTERISTIC
/begin CHARACTERISTIC CWKRNLR "" VALUE 0x8E26B4 KwUb 255.0 dez 0.00 255.0 FORMAT "%5.1" /end CHARACTERISTIC
/begin CHARACTERISTIC CWKRRA "" VALUE 0x8E26B5 KwUb 255.0 dez 0.00 255.0 FORMAT "%5.1" /end CHARACTERISTIC
/begin CHARACTERISTIC CWKRREF "" VALUE 0x8E2510 KwUb 1.000 dez 0.00 1.000 FORMAT "%5.3" /end CHARACTERISTIC
/begin CHARACTERISTIC CWKUPPL "" VALUE 0x8FD1AC KwUb 255.0 dez 0.00 255.0 FORMAT "%5.1" /end CHARACTERISTIC
/begin CHARACTERISTIC CWLAKH "" VALUE 0x8E2498 KwUb 255.0 dez 0.00 255.0 FORMAT "%5.1" /end CHARACTERISTIC
/begin CHARACTERISTIC CWLAMBTS "" VALUE 0x8E20D6 KwUb 255.0 dez 0.00 255.0 FORMAT "%5.1" /end CHARACTERISTIC
/begin CHARACTERISTIC CWLAMFAW "" VALUE 0x8E1E1B KwUb 255.0 dez 0.00 255.0 FORMAT "%5.1" /end CHARACTERISTIC
/begin CHARACTERISTIC CWLAMKH "" VALUE 0x8FD00C KwUb 255.0 dez 0.00 255.0 FORMAT "%5.1" /end CHARACTERISTIC
/begin CHARACTERISTIC CWLLRG "" VALUE 0x8E29B1 KwUb 255.0 dez 0.00 255.0 FORMAT "%5.1" /end CHARACTERISTIC
/begin CHARACTERISTIC CWLLRNS "" VALUE 0x8E29B2 KwUb 255.0 dez 0.00 255.0 FORMAT "%5.1" /end CHARACTERISTIC
/begin CHARACTERISTIC CWLLRNW "" VALUE 0x8E29B3 KwUb 255.0 dez 0.00 255.0 FORMAT "%5.1" /end CHARACTERISTIC
/begin CHARACTERISTIC CWLLRPA "" VALUE 0x8E2B48 KwUb 255.0 dez 0.00 255.0 FORMAT "%5.1" /end CHARACTERISTIC
/begin CHARACTERISTIC CWLUEKO "" VALUE 0x8F1134 KwUw 65535.00 dez 0.00 65535.00 FORMAT "%8.2" /end CHARACTERISTIC
/begin CHARACTERISTIC CWNSTAT "" VALUE 0x8E29B4 KwUb 255.0 dez 0.00 255.0 FORMAT "%5.1" /end CHARACTERISTIC
/begin CHARACTERISTIC CWREFI "" VALUE 0x8E2511 KwUb 1.000 dez 0.00 1.000 FORMAT "%5.3" /end CHARACTERISTIC
/begin CHARACTERISTIC CWTIPIN "" VALUE 0x8E27CC KwUb 255.0 dez 0.00 255.0 FORMAT "%5.1" /end CHARACTERISTIC
/begin CHARACTERISTIC CWWL "" VALUE 0x8FD044 KwUb 255.0 dez 0.00 255.0 FORMAT "%5.1" /end CHARACTERISTIC
/begin CHARACTERISTIC DKL1DTEV "" VALUE 0x8E49DB KwUb 191.3 temp_ub_q0p75_o48 -48.00 143.3 FORMAT "%5.1" /end CHARACTERISTIC
/begin CHARACTERISTIC DKL2DTEV "" VALUE 0x8E49DC KwUb 191.3 temp_ub_q0p75_o48 -48.00 143.3 FORMAT "%5.1" /end CHARACTERISTIC
/begin CHARACTERISTIC DKMTSMN "" VALUE 0x8E49DD KwSb 191.3 temp_sb_q0p75 -96.00 95.25 FORMAT "%5.2" /end CHARACTERISTIC
/begin CHARACTERISTIC DKMTSMX "" VALUE 0x8E49DE KwSb 191.3 temp_sb_q0p75 -96.00 95.25 FORMAT "%5.2" /end CHARACTERISTIC
/begin CHARACTERISTIC DLAMFAW "" VALUE 0x8E1E1C KwUb 1.992 fak_ub_b2 0.00 1.992 FORMAT "%5.3" /end CHARACTERISTIC
/begin CHARACTERISTIC DLAMNSWL "" VALUE 0x8FD045 KwUb 0.9961 fak_ub_b1 0.00 0.9961 /end CHARACTERISTIC
/begin CHARACTERISTIC DLAMTANS "" CURVE 0x8EAAF2 KlAUbSstUbWSb 1.992 fak_sb_b1 -1.000 0.9922 FORMAT "%5.3"
 /begin AXIS_DESCR STD_AXIS tans temp_ub_q0p75_o48 4 -48.00 143.3 FORMAT "%5.1" DEPOSIT ABSOLUTE /end AXIS_DESCR
/end CHARACTERISTIC
/begin CHARACTERISTIC DLBTSTHX "" CURVE 0x8EAC78 KlAUwSstUwWSw 1.999969 fak_sw_b1 -1.000000 0.9999695 FORMAT "%8.6"
 /begin AXIS_DESCR STD_AXIS thxlsum_w temp_q0p0234_o273 6 -273.1500 1262.827 FORMAT "%8.3" DEPOSIT ABSOLUTE /end AXIS_DESCR
/end CHARACTERISTIC
/begin CHARACTERISTIC DLBTSTHX2 "" CURVE 0x8EAC92 KlAUwSstUwWSw 1.999969 fak_sw_b1 -1.000000 0.9999695 FORMAT "%8.6"
 /begin AXIS_DESCR STD_AXIS thxlsum2_w temp_q0p0234_o273 6 -273.1500 1262.827 FORMAT "%8.3" DEPOSIT ABSOLUTE /end AXIS_DESCR
/end CHARACTERISTIC
/begin CHARACTERISTIC DMLLNGEZ "" MAP 0x8EBBE0 KfAxUbAyUbSstxSwSstyUbWSw 199.9841 rel_q0p00305 -99.99360 99.99055 FORMAT "%8.5"
 /begin AXIS_DESCR STD_AXIS ngasf_w nmotg_sw_q0p39 6 -12800.16 12799.77 FORMAT "%8.2" DEPOSIT ABSOLUTE /end AXIS_DESCR
 /begin AXIS_DESCR STD_AXIS etazws rel_ub_b127p5 4 0.00 127.5 FORMAT "%5.1" DEPOSIT ABSOLUTE /end AXIS_DESCR
/end CHARACTERISTIC
/begin CHARACTERISTIC DMLLNGEZV "" MAP 0x8EBC22 KfAxUbAyUbSstxSwSstyUbWSw 199.9841 rel_q0p00305 -99.99360 99.99055 FORMAT "%8.5"
 /begin AXIS_DESCR STD_AXIS ngasf_w nmotg_sw_q0p39 6 -12800.16 12799.77 FORMAT "%8.2" DEPOSIT ABSOLUTE /end AXIS_DESCR
 /begin AXIS_DESCR STD_AXIS etazws rel_ub_b127p5 4 0.00 127.5 FORMAT "%5.1" DEPOSIT ABSOLUTE /end AXIS_DESCR
/end CHARACTERISTIC
/begin CHARACTERISTIC DMLLRLMNN "" CURVE 0x8E2B79 GklWSb 50.00 rel_sb_q0p39 -50.00 0.00 FORMAT "%5.2"
 /begin AXIS_DESCR COM_AXIS nmot_w nmot_uw_q0p25 6 0.00 16383.75 FORMAT "%8.2" AXIS_PTS_REF SNM06LLUB /end AXIS_DESCR
/end CHARACTERISTIC
/begin CHARACTERISTIC DMLLRLMXN "" CURVE 0x8E2B7F GklWUb 99.61 rel_ub_b99p6 0.00 99.61 FORMAT "%5.2"
 /begin AXIS_DESCR COM_AXIS nmot_w nmot_uw_q0p25 6 0.00 16383.75 FORMAT "%8.2" AXIS_PTS_REF SNM06LLUB /end AXIS_DESCR
/end CHARACTERISTIC
/begin CHARACTERISTIC DMLLRMNN "" CURVE 0x8E2B85 GklWSb 50.00 rel_sb_q0p39 -50.00 0.00 FORMAT "%5.2"
 /begin AXIS_DESCR COM_AXIS nmot_w nmot_uw_q0p25 6 0.00 16383.75 FORMAT "%8.2" AXIS_PTS_REF SNM06LLUB /end AXIS_DESCR
/end CHARACTERISTIC
/begin CHARACTERISTIC DMLLRMNNK "" CURVE 0x8E2B8B GklWSb 50.00 rel_sb_q0p39 -50.00 0.00 FORMAT "%5.2"
 /begin AXIS_DESCR COM_AXIS nmot_w nmot_uw_q0p25 6 0.00 16383.75 FORMAT "%8.2" AXIS_PTS_REF SNM06LLUB /end AXIS_DESCR
/end CHARACTERISTIC
/begin CHARACTERISTIC DMLLRMXN "" CURVE 0x8E2B91 GklWUb 99.61 rel_ub_b99p6 0.00 99.61 FORMAT "%5.2"
 /begin AXIS_DESCR COM_AXIS nmot_w nmot_uw_q0p25 6 0.00 16383.75 FORMAT "%8.2" AXIS_PTS_REF SNM06LLUB /end AXIS_DESCR
/end CHARACTERISTIC
/begin CHARACTERISTIC DMLLRMXNK "" CURVE 0x8E2B97 GklWUb 99.61 rel_ub_b99p6 0.00 99.61 FORMAT "%5.2"
 /begin AXIS_DESCR COM_AXIS nmot_w nmot_uw_q0p25 6 0.00 16383.75 FORMAT "%8.2" AXIS_PTS_REF SNM06LLUB /end AXIS_DESCR
/end CHARACTERISTIC
/begin CHARACTERISTIC DMRESLL "" VALUE 0x8FD1AD KwUb 0.3891 rel_ub_q0p00153 0.00 0.3891 /end CHARACTERISTIC
/begin CHARACTERISTIC DMRESTM "" VALUE 0x8FD1AE KwUb 0.3891 rel_ub_q0p00153 0.00 0.3891 /end CHARACTERISTIC
/begin CHARACTERISTIC DMTSMN "" VALUE 0x8E49DF KwSb 191.3 temp_sb_q0p75 -96.00 95.25 FORMAT "%5.2" /end CHARACTERISTIC
/begin CHARACTERISTIC DMTSMX "" VALUE 0x8E49E0 KwSb 191.3 temp_sb_q0p75 -96.00 95.25 FORMAT "%5.2" /end CHARACTERISTIC
/begin CHARACTERISTIC DNKOACC "" VALUE 0x8E3F46 KwUb 10200. nmot_ub_q40 0.00 10200. FORMAT "%5.0" /end CHARACTERISTIC
/begin CHARACTERISTIC DNLLR "" VALUE 0x8FD189 KwUb 2550. nmot_ub_q10 0.00 2550. FORMAT "%5.0" /end CHARACTERISTIC
/begin CHARACTERISTIC DNLLRES "" VALUE 0x8FD1AF KwSb 2550. nmotd_sb_q10 -1280. 1270. FORMAT "%5.0" /end CHARACTERISTIC
/begin CHARACTERISTIC DNLLRIST "" VALUE 0x8FD18F KwSb 2550. nmotd_sb_q10 -1280. 1270. FORMAT "%5.0" /end CHARACTERISTIC
/begin CHARACTERISTIC DNLLST "" VALUE 0x8FD190 KwUb 255.0 nmot_q1 0.00 255.0 FORMAT "%5.1" /end CHARACTERISTIC
/begin CHARACTERISTIC DNMNI "" VALUE 0x8FD191 KwSb 2550. nmotd_sb_q10 -1280. 1270. FORMAT "%5.0" /end CHARACTERISTIC
/begin CHARACTERISTIC DNSNFST "" VALUE 0x8E29B5 KwUb 2550. nmot_ub_q10 0.00 2550. FORMAT "%5.0" /end CHARACTERISTIC
/begin CHARACTERISTIC DNSNFX "" VALUE 0x8E29B6 KwUb 2550. nmot_ub_q10 0.00 2550. FORMAT "%5.0" /end CHARACTERISTIC
/begin CHARACTERISTIC DNSNWNA "" VALUE 0x8E29B7 KwUb 1280. nmot_ub_q10 0.00 1280. FORMAT "%5.0" /end CHARACTERISTIC
/begin CHARACTERISTIC DPNEG "" VALUE 0x8E49E1 KwUb 50.80 p_q0p2 0.2000 51.00 FORMAT "%5.2" /end CHARACTERISTIC
/begin CHARACTERISTIC DPPOS "" VALUE 0x8E49E2 KwUb 50.80 p_q0p2 0.2000 51.00 FORMAT "%5.2" /end CHARACTERISTIC
/begin CHARACTERISTIC DQUEBERMN "" VALUE 0x8E49E3 KwUb 191.3 rel_ub_q0p75_o48 -48.00 143.3 FORMAT "%5.1" /end CHARACTERISTIC
/begin CHARACTERISTIC DQUEBERMX "" VALUE 0x8E49E4 KwUb 191.3 rel_ub_q0p75_o48 -48.00 143.3 FORMAT "%5.1" /end CHARACTERISTIC
/begin CHARACTERISTIC DQUEBEW "" VALUE 0x8E49E5 KwUb 191.3 rel_ub_q0p75_o48 -48.00 143.3 FORMAT "%5.1" /end CHARACTERISTIC
/begin CHARACTERISTIC DRLKRAN "" CURVE 0x8EB66C GklWUw 767.9766 rel_uw_q0p0234 0.00 767.9766 FORMAT "%8.4"
 /begin AXIS_DESCR COM_AXIS nmot nmot_ub_q40 16 0.00 10200. FORMAT "%5.0" AXIS_PTS_REF SNM16KRUB /end AXIS_DESCR
/end CHARACTERISTIC
/begin CHARACTERISTIC DRLKRSTMX "" VALUE 0x8FE8F0 KwSw 767.9766 rel_sw_q0p0234 0.00 767.9766 FORMAT "%8.4" /end CHARACTERISTIC
/begin CHARACTERISTIC DTAHLL "" VALUE 0x8E29B8 KwUb 191.3 temp_ub_b191p25 0.00 191.3 FORMAT "%5.1" /end CHARACTERISTIC
/begin CHARACTERISTIC DTBTS "" VALUE 0x8EACAC KwUw 1279.980 temp_uw_q0p0195 0.00 1279.980 FORMAT "%8.3" /end CHARACTERISTIC
/begin CHARACTERISTIC DTKAMN "" VALUE 0x8E49E6 KwSb 191.3 temp_sb_q0p75 -96.00 95.25 FORMAT "%5.2" /end CHARACTERISTIC
/begin CHARACTERISTIC DTKAMX "" VALUE 0x8E49E7 KwSb 191.3 temp_sb_q0p75 -96.00 95.25 FORMAT "%5.2" /end CHARACTERISTIC
/begin CHARACTERISTIC DTMHLL "" VALUE 0x8E29B9 KwUb 191.3 temp_ub_b191p25 0.00 191.3 FORMAT "%5.1" /end CHARACTERISTIC
/begin CHARACTERISTIC DTOELNW "" VALUE 0x8EBBA6 KwUw 1535.977 temp_q0p0234_o273 -273.1500 1262.827 FORMAT "%8.3" /end CHARACTERISTIC
/begin CHARACTERISTIC DVNG "" CURVE 0x8E2B9D GklWUb 0.1245 rel_qn0p000488 -0.1245 0.00 FORMAT "%6.4"
 /begin AXIS_DESCR COM_AXIS ngfil nmotg_sb_q100 6 -12800. 12700. FORMAT "%5.0" AXIS_PTS_REF SNG06LLSB /end AXIS_DESCR
/end CHARACTERISTIC
/begin CHARACTERISTIC DVNGV "" CURVE 0x8E2BA3 GklWUb 0.1245 rel_qn0p000488 -0.1245 0.00 FORMAT "%6.4"
 /begin AXIS_DESCR COM_AXIS ngfil nmotg_sb_q100 6 -12800. 12700. FORMAT "%5.0" AXIS_PTS_REF SNG06LLSB /end AXIS_DESCR
/end CHARACTERISTIC
/begin CHARACTERISTIC DWKRMSN "" CURVE 0x8E26B6 GklWUb 191.3 zw_ub_qn0p75 -191.3 0.00 FORMAT "%5.1"
 /begin AXIS_DESCR COM_AXIS nmot nmot_ub_q40 16 0.00 10200. FORMAT "%5.0" AXIS_PTS_REF SNM16KRUB /end AXIS_DESCR
/end CHARACTERISTIC
/begin CHARACTERISTIC DWNWASMX "" VALUE 0x8EBBA8 KwUw 60.09375 kw_uw_q0p0078 0.00 60.09375 FORMAT "%8.5" /end CHARACTERISTIC
/begin CHARACTERISTIC DWNWLLMXA "" VALUE 0x8EBBAA KwUw 60.09375 kw_uw_q0p0078 0.00 60.09375 FORMAT "%8.5" /end CHARACTERISTIC
/begin CHARACTERISTIC DWPEDKOB "" VALUE 0x8E3F47 KwSb 49.61 rel_sb_q0p39 0.00 49.61 FORMAT "%5.2" /end CHARACTERISTIC
/begin CHARACTERISTIC DWPEDSP "" VALUE 0x8E3F48 KwSb 99.21 rel_sb_q0p39 -49.61 49.61 FORMAT "%5.2" /end CHARACTERISTIC
/begin CHARACTERISTIC DYADMXN "" CURVE 0x8FE8F8 FklWUw 49151.25 zw_uw_qn0p75 -49151.25 0.00 FORMAT "%8.2"
 /begin AXIS_DESCR FIX_AXIS stuetz dez 5 0.00 4.000 FORMAT "%5.3" FIX_AXIS_PAR 0 0 5 /end AXIS_DESCR
/end CHARACTERISTIC
/begin CHARACTERISTIC DYADS "" VALUE 0x8FD0C0 KwUb 24.00 zw_ub_qn0p75 -24.00 0.00 FORMAT "%5.2" /end CHARACTERISTIC
/begin CHARACTERISTIC DYAFVS "" VALUE 0x8FD0C1 KwUb 20.25 zw_ub_q0p75 0.00 20.25 FORMAT "%5.2" /end CHARACTERISTIC
/begin CHARACTERISTIC DYAMNV "" VALUE 0x8FD0C2 KwUb 24.00 zw_ub_qn0p75 -24.00 0.00 FORMAT "%5.2" /end CHARACTERISTIC
/begin CHARACTERISTIC DYAVF "" VALUE 0x8FD0C3 KwUb 254.0 dez 1.000 255.0 FORMAT "%5.1" /end CHARACTERISTIC
/begin CHARACTERISTIC DZWTIN "" CURVE 0x8EB90C KlAUwSstSwWUw 20.25000 zw_uw_qn0p75 -20.25000 0.00 FORMAT "%8.5"
 /begin AXIS_DESCR STD_AXIS nmot nmot_ub_q40 16 0.00 10200. FORMAT "%5.0" DEPOSIT ABSOLUTE /end AXIS_DESCR
/end CHARACTERISTIC
/begin CHARACTERISTIC ETRIMN "" VALUE 0x8E49E8 KwSb 199.2 rel_sb_b100 -100.0 99.22 FORMAT "%5.1" /end CHARACTERISTIC
/begin CHARACTERISTIC ETRIMX "" VALUE 0x8E49E9 KwSb 199.2 rel_sb_b100 -100.0 99.22 FORMAT "%5.1" /end CHARACTERISTIC
/begin CHARACTERISTIC FBSTABGM "" CURVE 0x8EACAE KlAUwSstUwWUw 1.999969 fak_uw_b2 0.00 1.999969 FORMAT "%8.6"
 /begin AXIS_DESCR STD_AXIS tabgbts_w temp_uw_q0p0195_o50 4 -50.00000 1229.980 FORMAT "%8.3" DEPOSIT ABSOLUTE /end AXIS_DESCR
/end CHARACTERISTIC
/begin CHARACTERISTIC FBSTMOT "" CURVE 0x8EACC0 KlAUbSstUbWSb 1.992 fak_sb_b1 -1.000 0.9922 FORMAT "%5.3"
 /begin AXIS_DESCR STD_AXIS tmot temp_ub_q0p75_o48 4 -48.00 143.3 FORMAT "%5.1" DEPOSIT ABSOLUTE /end AXIS_DESCR
/end CHARACTERISTIC
/begin CHARACTERISTIC FDDN "" CURVE 0x8E2BA9 GklWUb 0.9961 fak_ub_b1 0.00 0.9961
 /begin AXIS_DESCR COM_AXIS dns nmotd_sb_q10 6 -1280. 1270. FORMAT "%5.0" AXIS_PTS_REF SNS06LLSB /end AXIS_DESCR
/end CHARACTERISTIC
/begin CHARACTERISTIC FDNIKOR "" VALUE 0x8FD192 KwUb 1.992 fak_ub_b2 0.00 1.992 FORMAT "%5.3" /end CHARACTERISTIC
/begin CHARACTERISTIC FHOKOB "" VALUE 0x8E3F49 KwUb 3.984 fak_ub_b4 0.00 3.984 FORMAT "%5.3" /end CHARACTERISTIC
/begin CHARACTERISTIC FKEFMC "" VALUE 0x8FD085 KwUb 2.000 fak_ub_b16 0.00 2.000 FORMAT "%5.3" /end CHARACTERISTIC
/begin CHARACTERISTIC FKELDY "" VALUE 0x8FD086 KwUb 2.000 fak_ub_b16 0.00 2.000 FORMAT "%5.3" /end CHARACTERISTIC
/begin CHARACTERISTIC FKELDYA "" VALUE 0x8FD0C4 KwUb 0.6250 fak_ub_b16 0.6250 1.250 FORMAT "%5.3" /end CHARACTERISTIC
/begin CHARACTERISTIC FKENDY "" VALUE 0x8FD087 KwUb 2.000 fak_ub_b16 0.00 2.000 FORMAT "%5.3" /end CHARACTERISTIC
/begin CHARACTERISTIC FKRFTPFMC "" VALUE 0x8FD088 KwUb 0.5000 fak_ub_b2 0.5000 1.000 FORMAT "%5.3" /end CHARACTERISTIC
/begin CHARACTERISTIC FKVA "" VALUE 0x8E3FD5 KwUb 15.94 fak_ub_b16 0.00 15.94 FORMAT "%5.2" /end CHARACTERISTIC
/begin CHARACTERISTIC FNLPRUEF "" VALUE 0x8E49EA KwUb 0.9961 fak_ub_b1 0.00 0.9961 /end CHARACTERISTIC
/begin CHARACTERISTIC FNSNF "" VALUE 0x8E29BA KwUb 0.9961 fak_ub_b1 0.00 0.9961 /end CHARACTERISTIC
/begin CHARACTERISTIC FNSSTKM "" CURVE 0x8E29BB KlAUbSstUbWUb 1.992 fak_ub_b2 0.00 1.992 FORMAT "%5.3"
 /begin AXIS_DESCR STD_AXIS tmot temp_ub_q0p75_o48 6 -48.00 143.3 FORMAT "%5.1" DEPOSIT ABSOLUTE /end AXIS_DESCR
/end CHARACTERISTIC
/begin CHARACTERISTIC FNSSTM "" CURVE 0x8E29C8 KlAUbSstUbWUb 1.992 fak_ub_b2 0.00 1.992 FORMAT "%5.3"
 /begin AXIS_DESCR STD_AXIS tmot temp_ub_q0p75_o48 6 -48.00 143.3 FORMAT "%5.1" DEPOSIT ABSOLUTE /end AXIS_DESCR
/end CHARACTERISTIC
/begin CHARACTERISTIC FTKANMO "" CURVE 0x8E49EB KlAUbSstUbWUb 4.000 fak_ub_q0p015 0.00 4.000 FORMAT "%5.3"
 /begin AXIS_DESCR STD_AXIS nmot nmot_ub_q40 5 0.00 10200. FORMAT "%5.0" DEPOSIT ABSOLUTE /end AXIS_DESCR
/end CHARACTERISTIC
/begin CHARACTERISTIC GFDLDN "" CURVE 0x8E2BAF GklWUb 0.9961 rel_ub_b1p0 0.00 0.9961
 /begin AXIS_DESCR COM_AXIS dns nmotd_sb_q10 6 -1280. 1270. FORMAT "%5.0" AXIS_PTS_REF SNS06LLSB /end AXIS_DESCR
/end CHARACTERISTIC
/begin CHARACTERISTIC IMLLASKH "" VALUE 0x8E2499 KwUb 0.9961 fak_ub_b1 0.00 0.9961 /end CHARACTERISTIC
/begin CHARACTERISTIC IVDNDTEH "" CURVE 0x8E2B49 GklWUb 0.6076 rel_q0p002383 0.00 0.6076
 /begin AXIS_DESCR COM_AXIS dn_w nmot_sw_q0p25 10 -8192.000 8191.750 FORMAT "%8.3" AXIS_PTS_REF SDN10LLSW /end AXIS_DESCR
/end CHARACTERISTIC
/begin CHARACTERISTIC IVDNHOM "" CURVE 0x8E2B53 GklWUb 0.6076 rel_q0p002383 0.00 0.6076
 /begin AXIS_DESCR COM_AXIS dn_w nmot_sw_q0p25 10 -8192.000 8191.750 FORMAT "%8.3" AXIS_PTS_REF SDN10LLSW /end AXIS_DESCR
/end CHARACTERISTIC
/begin CHARACTERISTIC IVDNHOMV "" CURVE 0x8E2B5D GklWUb 0.6076 rel_q0p002383 0.00 0.6076
 /begin AXIS_DESCR COM_AXIS dn_w nmot_sw_q0p25 10 -8192.000 8191.750 FORMAT "%8.3" AXIS_PTS_REF SDN10LLSW /end AXIS_DESCR
/end CHARACTERISTIC
/begin CHARACTERISTIC KD "" VALUE 0x8E3FD6 KwUb 255.0 dez 0.00 255.0 FORMAT "%5.1" /end CHARACTERISTIC
/begin CHARACTERISTIC KFDLBTS "" MAP 0x8EACCA KfAxUbAyUbSstxUbSstyUbWSb 1.000 fak_sb_b1 -1.000 0.00 FORMAT "%5.3"
 /begin AXIS_DESCR STD_AXIS detazwbs rel_ub_b127p5 8 0.00 127.5 FORMAT "%5.1" DEPOSIT ABSOLUTE /end AXIS_DESCR
 /begin AXIS_DESCR STD_AXIS ml m_ub_b1020 4 0.00 1020. FORMAT "%5.0" DEPOSIT ABSOLUTE /end AXIS_DESCR
/end CHARACTERISTIC
/begin CHARACTERISTIC KFDLBTSGRL "" MAP 0x8EACF8 KfAxUbAyUbSstxUbSstyUbWSb 1.992 fak_sb_b1 -1.000 0.9922 FORMAT "%5.3"
 /begin AXIS_DESCR STD_AXIS gangi dez 8 0.00 255.0 FORMAT "%5.1" DEPOSIT ABSOLUTE /end AXIS_DESCR
 /begin AXIS_DESCR STD_AXIS rl rel_ub_q0p75 8 0.00 191.3 FORMAT "%5.1" DEPOSIT ABSOLUTE /end AXIS_DESCR
/end CHARACTERISTIC
/begin CHARACTERISTIC KFDQTMTU "" MAP 0x8E49F6 KfAxUbAyUbSstxUbSstyUbWUb 191.3 rel_ub_q0p75_o48 -48.00 143.3 FORMAT "%5.1"
 /begin AXIS_DESCR STD_AXIS tmotkmtr temp_ub_q0p75_o48 5 -48.00 143.3 FORMAT "%5.1" DEPOSIT ABSOLUTE /end AXIS_DESCR
 /begin AXIS_DESCR STD_AXIS tumgkmtr temp_ub_q0p75_o48 5 -48.00 143.3 FORMAT "%5.1" DEPOSIT ABSOLUTE /end AXIS_DESCR
/end CHARACTERISTIC
/begin CHARACTERISTIC KFDQUEBER "" MAP 0x8E4A1B GkfWUb 191.3 rel_ub_q0p75_o48 -48.00 143.3 FORMAT "%5.1"
 /begin AXIS_DESCR COM_AXIS dtmtka temp_sb_q0p75 5 -96.00 95.25 FORMAT "%5.2" AXIS_PTS_REF STS05DTKA /end AXIS_DESCR
 /begin AXIS_DESCR COM_AXIS dkmts temp_sb_q0p75 5 -96.00 95.25 FORMAT "%5.2" AXIS_PTS_REF STS05DTTS /end AXIS_DESCR
/end CHARACTERISTIC
/begin CHARACTERISTIC KFDYES "" MAP 0x8EB68C GkfWSw 1535.977 rel_sw_q0p0234 -768.0000 767.9766 FORMAT "%8.4"
 /begin AXIS_DESCR COM_AXIS nmot nmot_ub_q40 16 0.00 10200. FORMAT "%5.0" AXIS_PTS_REF SNM16KRDYUB /end AXIS_DESCR
 /begin AXIS_DESCR COM_AXIS rl rel_ub_q0p75 6 0.00 191.3 FORMAT "%5.1" AXIS_PTS_REF SRL06KRUB /end AXIS_DESCR
/end CHARACTERISTIC
/begin CHARACTERISTIC KFDYMNT "" MAP 0x8EB94E KfAxUbAyUbSstxUbSstyUwWUw 49151.25 zw_uw_qn0p75 -49151.25 0.00 FORMAT "%8.2"
 /begin AXIS_DESCR STD_AXIS evtmod temp_ub_q0p75_o48 16 -48.00 143.3 FORMAT "%5.1" DEPOSIT ABSOLUTE /end AXIS_DESCR
 /begin AXIS_DESCR STD_AXIS nmot nmot_ub_q40 8 0.00 10200. FORMAT "%5.0" DEPOSIT ABSOLUTE /end AXIS_DESCR
/end CHARACTERISTIC
/begin CHARACTERISTIC KFDYRS "" MAP 0x8EB74C GkfWSw 1535.977 rel_sw_q0p0234 -768.0000 767.9766 FORMAT "%8.4"
 /begin AXIS_DESCR COM_AXIS nmot nmot_ub_q40 16 0.00 10200. FORMAT "%5.0" AXIS_PTS_REF SNM16KRDYUB /end AXIS_DESCR
 /begin AXIS_DESCR COM_AXIS rl rel_ub_q0p75 6 0.00 191.3 FORMAT "%5.1" AXIS_PTS_REF SRL06KRUB /end AXIS_DESCR
/end CHARACTERISTIC
/begin CHARACTERISTIC KFDYRSOF "" MAP 0x8EB80C GkfWSw 1535.977 rel_sw_q0p0234 -768.0000 767.9766 FORMAT "%8.4"
 /begin AXIS_DESCR COM_AXIS nmot nmot_ub_q40 16 0.00 10200. FORMAT "%5.0" AXIS_PTS_REF SNM16KRDYUB /end AXIS_DESCR
 /begin AXIS_DESCR COM_AXIS rl rel_ub_q0p75 6 0.00 191.3 FORMAT "%5.1" AXIS_PTS_REF SRL06KRUB /end AXIS_DESCR
/end CHARACTERISTIC
/begin CHARACTERISTIC KFHOEHK "" MAP 0x8E4A34 KfAxUbAyUbSstxUbSstyUbWUb 2.550 fak_ub_b2p55 0.00 2.550 FORMAT "%5.3"
 /begin AXIS_DESCR STD_AXIS tumgkmtr temp_ub_q0p75_o48 5 -48.00 143.3 FORMAT "%5.1" DEPOSIT ABSOLUTE /end AXIS_DESCR
 /begin AXIS_DESCR STD_AXIS pu p_ub_q5 5 0.00 1275. FORMAT "%5.0" DEPOSIT ABSOLUTE /end AXIS_DESCR
/end CHARACTERISTIC
/begin CHARACTERISTIC KFKEF1 "" MAP 0x8E2512 GkfWUb 15.94 fak_ub_b16 0.00 15.94 FORMAT "%5.2"
 /begin AXIS_DESCR COM_AXIS nmot nmot_ub_q40 16 0.00 10200. FORMAT "%5.0" AXIS_PTS_REF SNM16KRUB /end AXIS_DESCR
 /begin AXIS_DESCR COM_AXIS rl rel_ub_q0p75 3 0.00 191.3 FORMAT "%5.1" AXIS_PTS_REF SRL03KRUB /end AXIS_DESCR
/end CHARACTERISTIC
/begin CHARACTERISTIC KFKEF2 "" MAP 0x8E2542 GkfWUb 15.94 fak_ub_b16 0.00 15.94 FORMAT "%5.2"
 /begin AXIS_DESCR COM_AXIS nmot nmot_ub_q40 16 0.00 10200. FORMAT "%5.0" AXIS_PTS_REF SNM16KRUB /end AXIS_DESCR
 /begin AXIS_DESCR COM_AXIS rl rel_ub_q0p75 3 0.00 191.3 FORMAT "%5.1" AXIS_PTS_REF SRL03KRUB /end AXIS_DESCR
/end CHARACTERISTIC
/begin CHARACTERISTIC KFKEF3 "" MAP 0x8E2572 GkfWUb 15.94 fak_ub_b16 0.00 15.94 FORMAT "%5.2"
 /begin AXIS_DESCR COM_AXIS nmot nmot_ub_q40 16 0.00 10200. FORMAT "%5.0" AXIS_PTS_REF SNM16KRUB /end AXIS_DESCR
 /begin AXIS_DESCR COM_AXIS rl rel_ub_q0p75 3 0.00 191.3 FORMAT "%5.1" AXIS_PTS_REF SRL03KRUB /end AXIS_DESCR
/end CHARACTERISTIC
/begin CHARACTERISTIC KFKEF4 "" MAP 0x8E25A2 GkfWUb 15.94 fak_ub_b16 0.00 15.94 FORMAT "%5.2"
 /begin AXIS_DESCR COM_AXIS nmot nmot_ub_q40 16 0.00 10200. FORMAT "%5.0" AXIS_PTS_REF SNM16KRUB /end AXIS_DESCR
 /begin AXIS_DESCR COM_AXIS rl rel_ub_q0p75 3 0.00 191.3 FORMAT "%5.1" AXIS_PTS_REF SRL03KRUB /end AXIS_DESCR
/end CHARACTERISTIC
/begin CHARACTERISTIC KFKEF5 "" MAP 0x8E25D2 GkfWUb 15.94 fak_ub_b16 0.00 15.94 FORMAT "%5.2"
 /begin AXIS_DESCR COM_AXIS nmot nmot_ub_q40 16 0.00 10200. FORMAT "%5.0" AXIS_PTS_REF SNM16KRUB /end AXIS_DESCR
 /begin AXIS_DESCR COM_AXIS rl rel_ub_q0p75 3 0.00 191.3 FORMAT "%5.1" AXIS_PTS_REF SRL03KRUB /end AXIS_DESCR
/end CHARACTERISTIC
/begin CHARACTERISTIC KFKEF6 "" MAP 0x8E2602 GkfWUb 15.94 fak_ub_b16 0.00 15.94 FORMAT "%5.2"
 /begin AXIS_DESCR COM_AXIS nmot nmot_ub_q40 16 0.00 10200. FORMAT "%5.0" AXIS_PTS_REF SNM16KRUB /end AXIS_DESCR
 /begin AXIS_DESCR COM_AXIS rl rel_ub_q0p75 3 0.00 191.3 FORMAT "%5.1" AXIS_PTS_REF SRL03KRUB /end AXIS_DESCR
/end CHARACTERISTIC
/begin CHARACTERISTIC KFKEF7 "" MAP 0x8E2632 GkfWUb 15.94 fak_ub_b16 0.00 15.94 FORMAT "%5.2"
 /begin AXIS_DESCR COM_AXIS nmot nmot_ub_q40 16 0.00 10200. FORMAT "%5.0" AXIS_PTS_REF SNM16KRUB /end AXIS_DESCR
 /begin AXIS_DESCR COM_AXIS rl rel_ub_q0p75 3 0.00 191.3 FORMAT "%5.1" AXIS_PTS_REF SRL03KRUB /end AXIS_DESCR
/end CHARACTERISTIC
/begin CHARACTERISTIC KFKEF8 "" MAP 0x8E2662 GkfWUb 15.94 fak_ub_b16 0.00 15.94 FORMAT "%5.2"
 /begin AXIS_DESCR COM_AXIS nmot nmot_ub_q40 16 0.00 10200. FORMAT "%5.0" AXIS_PTS_REF SNM16KRUB /end AXIS_DESCR
 /begin AXIS_DESCR COM_AXIS rl rel_ub_q0p75 3 0.00 191.3 FORMAT "%5.1" AXIS_PTS_REF SRL03KRUB /end AXIS_DESCR
/end CHARACTERISTIC
/begin CHARACTERISTIC KFKTRLN "" MAP 0x8E4A59 KfAxUbAyUbSstxUbSstyUbWUb 191.3 temp_ub_q0p75_o48 -48.00 143.3 FORMAT "%5.1"
 /begin AXIS_DESCR STD_AXIS nmot nmot_ub_q40 5 0.00 10200. FORMAT "%5.0" DEPOSIT ABSOLUTE /end AXIS_DESCR
 /begin AXIS_DESCR STD_AXIS rltmso1 rel_ub_q0p75 5 0.00 191.3 FORMAT "%5.1" DEPOSIT ABSOLUTE /end AXIS_DESCR
/end CHARACTERISTIC
/begin CHARACTERISTIC KFKTRV "" MAP 0x8E4A7E KfAxUbAyUbSstxUbSstyUbWUb 191.3 temp_ub_q0p75_o48 -48.00 143.3 FORMAT "%5.1"
 /begin AXIS_DESCR STD_AXIS vfzgkmtr vfzg_ub_q1p25 5 0.00 318.8 FORMAT "%5.1" DEPOSIT ABSOLUTE /end AXIS_DESCR
 /begin AXIS_DESCR STD_AXIS tumgkmtr temp_ub_q0p75_o48 5 -48.00 143.3 FORMAT "%5.1" DEPOSIT ABSOLUTE /end AXIS_DESCR
/end CHARACTERISTIC
/begin CHARACTERISTIC KFLAFWL "" MAP 0x8E1E1D GkfWSb 1.992 fak_sb_b1 -1.000 0.9922 FORMAT "%5.3"
 /begin AXIS_DESCR COM_AXIS tmot temp_ub_q0p75_o48 8 -48.00 143.3 FORMAT "%5.1" AXIS_PTS_REF STM08GKUB /end AXIS_DESCR
 /begin AXIS_DESCR COM_AXIS rl rel_ub_q0p75 6 0.00 191.3 FORMAT "%5.1" AXIS_PTS_REF SRL06GKUB /end AXIS_DESCR
/end CHARACTERISTIC
/begin CHARACTERISTIC KFLAMKR "" MAP 0x8E1E4D GkfWUb 1.992 fak_ub_b2 0.00 1.992 FORMAT "%5.3"
 /begin AXIS_DESCR COM_AXIS nmot nmot_ub_q40 6 0.00 10200. FORMAT "%5.0" AXIS_PTS_REF SNM06GKUB /end AXIS_DESCR
 /begin AXIS_DESCR COM_AXIS rl rel_ub_q0p75 6 0.00 191.3 FORMAT "%5.1" AXIS_PTS_REF SRL06GKUB /end AXIS_DESCR
/end CHARACTERISTIC
/begin CHARACTERISTIC KFLAMKRL "" MAP 0x8E1E71 GkfWUb 1.992 fak_ub_b2 0.00 1.992 FORMAT "%5.3"
 /begin AXIS_DESCR COM_AXIS dzwlamfaw zw_ub_qn0p75 6 -191.3 0.00 FORMAT "%5.1" AXIS_PTS_REF SDZ06GKUB /end AXIS_DESCR
 /begin AXIS_DESCR COM_AXIS rl rel_ub_q0p75 6 0.00 191.3 FORMAT "%5.1" AXIS_PTS_REF SRL06GKUB /end AXIS_DESCR
/end CHARACTERISTIC
/begin CHARACTERISTIC KFLANS "" MAP 0x8EA960 KfAxUbAyUbSstxUbSstyUwWUw 15.99976 fak_uw_b16 0.00 15.99976 FORMAT "%8.5"
 /begin AXIS_DESCR STD_AXIS tmst temp_ub_q0p75_o48 12 -48.00 143.3 FORMAT "%5.1" DEPOSIT ABSOLUTE /end AXIS_DESCR
 /begin AXIS_DESCR STD_AXIS anztib1_w dez 12 0.00 65535.00 FORMAT "%8.2" DEPOSIT ABSOLUTE /end AXIS_DESCR
/end CHARACTERISTIC
/begin CHARACTERISTIC KFLANSKH "" MAP 0x8EB3AC KfAxUbAyUbSstxUbSstyUwWUw 15.89990 fak_q0p000244 0.09985352 15.99976 FORMAT "%8.5"
 /begin AXIS_DESCR STD_AXIS tmst temp_ub_q0p75_o48 6 -48.00 143.3 FORMAT "%5.1" DEPOSIT ABSOLUTE /end AXIS_DESCR
 /begin AXIS_DESCR STD_AXIS anztib_w dez 12 0.00 65535.00 FORMAT "%8.2" DEPOSIT ABSOLUTE /end AXIS_DESCR
/end CHARACTERISTIC
/begin CHARACTERISTIC KFLASKH "" MAP 0x8EB45C KfAxUwAyUwSstxUwSstyUwWUw 15.99976 fak_q0p000244 0.00 15.99976 FORMAT "%8.5"
 /begin AXIS_DESCR STD_AXIS nmot_w nmot_uw_q0p25 8 0.00 16383.75 FORMAT "%8.2" DEPOSIT ABSOLUTE /end AXIS_DESCR
 /begin AXIS_DESCR STD_AXIS rl_w rel_uw_q0p0234 8 0.00 1535.977 FORMAT "%8.3" DEPOSIT ABSOLUTE /end AXIS_DESCR
/end CHARACTERISTIC
/begin CHARACTERISTIC KFLASWLR "" MAP 0x8E1D3E GkfWUb 1.992 fak_ub_b2 0.00 1.992 FORMAT "%5.3"
 /begin AXIS_DESCR COM_AXIS tmot temp_ub_q0p75_o48 12 -48.00 143.3 FORMAT "%5.1" AXIS_PTS_REF STM12ESUB /end AXIS_DESCR
 /begin AXIS_DESCR COM_AXIS tmst temp_ub_q0p75_o48 12 -48.00 143.3 FORMAT "%5.1" AXIS_PTS_REF STS12ESUB /end AXIS_DESCR
/end CHARACTERISTIC
/begin CHARACTERISTIC KFLBTS "" MAP 0x8E20D7 GkfWUb 1.000 fak_ub_b2 0.00 1.000 FORMAT "%5.3"
 /begin AXIS_DESCR COM_AXIS rl_w rel_uw_q0p0234 12 0.00 1535.977 FORMAT "%8.3" AXIS_PTS_REF SRL12GKUW /end AXIS_DESCR
 /begin AXIS_DESCR COM_AXIS nmot nmot_ub_q40 16 0.00 10200. FORMAT "%5.0" AXIS_PTS_REF SNM16GKUB /end AXIS_DESCR
/end CHARACTERISTIC
/begin CHARACTERISTIC KFLBTS2 "" MAP 0x8E2197 GkfWUb 1.000 fak_ub_b2 0.00 1.000 FORMAT "%5.3"
 /begin AXIS_DESCR COM_AXIS rl_w rel_uw_q0p0234 12 0.00 1535.977 FORMAT "%8.3" AXIS_PTS_REF SRL12GKUW /end AXIS_DESCR
 /begin AXIS_DESCR COM_AXIS nmot nmot_ub_q40 16 0.00 10200. FORMAT "%5.0" AXIS_PTS_REF SNM16GKUB /end AXIS_DESCR
/end CHARACTERISTIC
/begin CHARACTERISTIC KFLBTSBG "" MAP 0x8E2257 GkfWUb 1.992 fak_ub_b2 0.00 1.992 FORMAT "%5.3"
 /begin AXIS_DESCR COM_AXIS rl_w rel_uw_q0p0234 12 0.00 1535.977 FORMAT "%8.3" AXIS_PTS_REF SRL12GKUW /end AXIS_DESCR
 /begin AXIS_DESCR COM_AXIS nmot nmot_ub_q40 16 0.00 10200. FORMAT "%5.0" AXIS_PTS_REF SNM16GKUB /end AXIS_DESCR
/end CHARACTERISTIC
/begin CHARACTERISTIC KFLBTSDY "" MAP 0x8EAD4A KfAxUbAyUbSstxUbSstyUbWUb 1.000 fak_ub_b2 0.00 1.000 FORMAT "%5.3"
 /begin AXIS_DESCR STD_AXIS detazwbs rel_ub_b127p5 6 0.00 127.5 FORMAT "%5.1" DEPOSIT ABSOLUTE /end AXIS_DESCR
 /begin AXIS_DESCR STD_AXIS nmot nmot_ub_q40 6 0.00 10200. FORMAT "%5.0" DEPOSIT ABSOLUTE /end AXIS_DESCR
/end CHARACTERISTIC
/begin CHARACTERISTIC KFLMSKH "" MAP 0x8EB500 KfAxUwAyUwSstxUwSstyUwWUw 15.99976 fak_q0p000244 0.00 15.99976 FORMAT "%8.5"
 /begin AXIS_DESCR STD_AXIS nmot_w nmot_uw_q0p25 8 0.00 16383.75 FORMAT "%8.2" DEPOSIT ABSOLUTE /end AXIS_DESCR
 /begin AXIS_DESCR STD_AXIS rl_w rel_uw_q0p0234 8 0.00 1535.977 FORMAT "%8.3" DEPOSIT ABSOLUTE /end AXIS_DESCR
/end CHARACTERISTIC
/begin CHARACTERISTIC KFLMSKHKST "" MAP 0x8EB5A4 KfAxUwAyUwSstxUwSstyUwWUw 15.99976 fak_q0p000244 0.00 15.99976 FORMAT "%8.5"
 /begin AXIS_DESCR STD_AXIS nmot_w nmot_uw_q0p25 8 0.00 16383.75 FORMAT "%8.2" DEPOSIT ABSOLUTE /end AXIS_DESCR
 /begin AXIS_DESCR STD_AXIS rl_w rel_uw_q0p0234 8 0.00 1535.977 FORMAT "%8.3" DEPOSIT ABSOLUTE /end AXIS_DESCR
/end CHARACTERISTIC
/begin CHARACTERISTIC KFLUESIC "" MAP 0x8E4AA3 KfAxUbAyUbSstxUbSstyUbWUb 99.61 tv_ub_b100 0.00 99.61 FORMAT "%5.2"
 /begin AXIS_DESCR STD_AXIS tvlues1 tv_ub_b100 6 0.00 99.61 FORMAT "%5.2" DEPOSIT ABSOLUTE /end AXIS_DESCR
 /begin AXIS_DESCR STD_AXIS tvlues2 tv_ub_b100 6 0.00 99.61 FORMAT "%5.2" DEPOSIT ABSOLUTE /end AXIS_DESCR
/end CHARACTERISTIC
/begin CHARACTERISTIC KFMRES "" MAP 0x8E2CF5 GkfWUb 24.90 rel_ub_b24p9 0.00 24.90 FORMAT "%5.2"
 /begin AXIS_DESCR COM_AXIS nmot_w nmot_uw_q0p25 6 0.00 16383.75 FORMAT "%8.2" AXIS_PTS_REF SNM06LLUB /end AXIS_DESCR
 /begin AXIS_DESCR COM_AXIS mifa_w rel_uw_b100 4 0.00 99.99847 FORMAT "%8.5" AXIS_PTS_REF SMI04LLUB /end AXIS_DESCR
/end CHARACTERISTIC
/begin CHARACTERISTIC KFMRESK "" MAP 0x8E2D0D GkfWUb 24.90 rel_ub_b24p9 0.00 24.90 FORMAT "%5.2"
 /begin AXIS_DESCR COM_AXIS nmot_w nmot_uw_q0p25 6 0.00 16383.75 FORMAT "%8.2" AXIS_PTS_REF SNM06LLUB /end AXIS_DESCR
 /begin AXIS_DESCR COM_AXIS mifa_w rel_uw_b100 4 0.00 99.99847 FORMAT "%8.5" AXIS_PTS_REF SMI04LLUB /end AXIS_DESCR
/end CHARACTERISTIC
/begin CHARACTERISTIC KFMRESKH "" MAP 0x8E2D25 GkfWUb 24.90 rel_ub_b24p9 0.00 24.90 FORMAT "%5.2"
 /begin AXIS_DESCR COM_AXIS dns nmotd_sb_q10 6 -1280. 1270. FORMAT "%5.0" AXIS_PTS_REF SNS06LLSB /end AXIS_DESCR
 /begin AXIS_DESCR COM_AXIS tmot temp_ub_q0p75_o48 4 -48.00 143.3 FORMAT "%5.1" AXIS_PTS_REF STM04SAUB /end AXIS_DESCR
/end CHARACTERISTIC
/begin CHARACTERISTIC KFMRESNL "" MAP 0x8E2D3D GkfWUb 24.90 rel_ub_b24p9 0.00 24.90 FORMAT "%5.2"
 /begin AXIS_DESCR COM_AXIS nmot_w nmot_uw_q0p25 6 0.00 16383.75 FORMAT "%8.2" AXIS_PTS_REF SNM06LLUB /end AXIS_DESCR
 /begin AXIS_DESCR COM_AXIS mifa_w rel_uw_b100 4 0.00 99.99847 FORMAT "%8.5" AXIS_PTS_REF SMI04LLUB /end AXIS_DESCR
/end CHARACTERISTIC
/begin CHARACTERISTIC KFMRESTA "" MAP 0x8E2D55 GkfWUb 24.90 rel_ub_b24p9 0.00 24.90 FORMAT "%5.2"
 /begin AXIS_DESCR COM_AXIS tans temp_ub_q0p75_o48 4 -48.00 143.3 FORMAT "%5.1" AXIS_PTS_REF STA04LLUB /end AXIS_DESCR
 /begin AXIS_DESCR COM_AXIS mifa_w rel_uw_b100 4 0.00 99.99847 FORMAT "%8.5" AXIS_PTS_REF SMI04LLUB /end AXIS_DESCR
/end CHARACTERISTIC
/begin CHARACTERISTIC KFNL2TUM "" MAP 0x8F1136 KfAxUwAyUwSstxUwSstyUwWUw 65535.00 t1sxs_uw_b65535 0.00 65535.00 FORMAT "%8.2"
 /begin AXIS_DESCR STD_AXIS tmotkmtr temp_ub_q0p75_o48 5 -48.00 143.3 FORMAT "%5.1" DEPOSIT ABSOLUTE /end AXIS_DESCR
 /begin AXIS_DESCR STD_AXIS tumgkmtr temp_ub_q0p75_o48 5 -48.00 143.3 FORMAT "%5.1" DEPOSIT ABSOLUTE /end AXIS_DESCR
/end CHARACTERISTIC
/begin CHARACTERISTIC KFNLLNST "" MAP 0x8E29D5 GkfWUb 2550. nmot_ub_q10 0.00 2550. FORMAT "%5.0"
 /begin AXIS_DESCR COM_AXIS tnst t1sxs_ub_b255 6 0.00 255.0 FORMAT "%5.1" AXIS_PTS_REF STN06LLUB /end AXIS_DESCR
 /begin AXIS_DESCR COM_AXIS tmot temp_ub_q0p75_o48 6 -48.00 143.3 FORMAT "%5.1" AXIS_PTS_REF STM06LLUB /end AXIS_DESCR
/end CHARACTERISTIC
/begin CHARACTERISTIC KFNLTKV "" MAP 0x8F1180 KfAxUwAyUwSstxUwSstyUwWUw 65535.00 t1sxs_uw_b65535 0.00 65535.00 FORMAT "%8.2"
 /begin AXIS_DESCR STD_AXIS tmotkmtr temp_ub_q0p75_o48 5 -48.00 143.3 FORMAT "%5.1" DEPOSIT ABSOLUTE /end AXIS_DESCR
 /begin AXIS_DESCR STD_AXIS vsksmlf_w volgrd_q5p96Em4 5 0.00 39.06190 FORMAT "%8.5" DEPOSIT ABSOLUTE /end AXIS_DESCR
/end CHARACTERISTIC
/begin CHARACTERISTIC KFNLTUM "" MAP 0x8F11CA KfAxUwAyUwSstxUwSstyUwWUw 65535.00 t1sxs_uw_b65535 0.00 65535.00 FORMAT "%8.2"
 /begin AXIS_DESCR STD_AXIS tmotkmtr temp_ub_q0p75_o48 5 -48.00 143.3 FORMAT "%5.1" DEPOSIT ABSOLUTE /end AXIS_DESCR
 /begin AXIS_DESCR STD_AXIS tumgkmtr temp_ub_q0p75_o48 5 -48.00 143.3 FORMAT "%5.1" DEPOSIT ABSOLUTE /end AXIS_DESCR
/end CHARACTERISTIC
/begin CHARACTERISTIC KFQMRA "" MAP 0x8F1214 KfAxUbAyUbSstxUwSstyUbWUb 191.3 rel_ub_q0p75_o48 -48.00 143.3 FORMAT "%5.1"
 /begin AXIS_DESCR STD_AXIS vsksmlf_w volgrd_q5p96Em4 5 0.00 39.06190 FORMAT "%8.5" DEPOSIT ABSOLUTE /end AXIS_DESCR
 /begin AXIS_DESCR STD_AXIS vfzgkmtr vfzg_ub_q1p25 5 0.00 318.8 FORMAT "%5.1" DEPOSIT ABSOLUTE /end AXIS_DESCR
/end CHARACTERISTIC
/begin CHARACTERISTIC KFQNLUE1 "" MAP 0x8E4AD5 KfAxUbAyUbSstxUbSstyUbWUb 5100. nmot_ub_q20 0.00 5100. FORMAT "%5.0"
 /begin AXIS_DESCR STD_AXIS qmaxl1 rel_ub_q0p75_o48 6 -48.00 143.3 FORMAT "%5.1" DEPOSIT ABSOLUTE /end AXIS_DESCR
 /begin AXIS_DESCR STD_AXIS nmot nmot_ub_q40 6 0.00 10200. FORMAT "%5.0" DEPOSIT ABSOLUTE /end AXIS_DESCR
/end CHARACTERISTIC
/begin CHARACTERISTIC KFQNLUE2 "" MAP 0x8E4B07 KfAxUbAyUbSstxUbSstyUbWUb 5100. nmot_ub_q20 0.00 5100. FORMAT "%5.0"
 /begin AXIS_DESCR STD_AXIS qmaxl2 rel_ub_q0p75_o48 6 -48.00 143.3 FORMAT "%5.1" DEPOSIT ABSOLUTE /end AXIS_DESCR
 /begin AXIS_DESCR STD_AXIS nmot nmot_ub_q40 6 0.00 10200. FORMAT "%5.0" DEPOSIT ABSOLUTE /end AXIS_DESCR
/end CHARACTERISTIC
/begin CHARACTERISTIC KFQTKWP "" MAP 0x8F123E KfAxUbAyUbSstxSbSstyUbWUb 191.3 rel_ub_q0p75_o48 -48.00 143.3 FORMAT "%5.1"
 /begin AXIS_DESCR STD_AXIS dtka temp_sb_q0p75 5 -96.00 95.25 FORMAT "%5.2" DEPOSIT ABSOLUTE /end AXIS_DESCR
 /begin AXIS_DESCR STD_AXIS vfzgkmtr vfzg_ub_q1p25 5 0.00 318.8 FORMAT "%5.1" DEPOSIT ABSOLUTE /end AXIS_DESCR
/end CHARACTERISTIC
/begin CHARACTERISTIC KFQVAC "" MAP 0x8E4B39 KfAxUbAyUbSstxUbSstyUbWUb 191.3 rel_ub_q0p75_o48 -48.00 143.3 FORMAT "%5.1"
 /begin AXIS_DESCR STD_AXIS tmotkmtr temp_ub_q0p75_o48 5 -48.00 143.3 FORMAT "%5.1" DEPOSIT ABSOLUTE /end AXIS_DESCR
 /begin AXIS_DESCR STD_AXIS tumgkmtr temp_ub_q0p75_o48 5 -48.00 143.3 FORMAT "%5.1" DEPOSIT ABSOLUTE /end AXIS_DESCR
/end CHARACTERISTIC
/begin CHARACTERISTIC KFQVKOM "" MAP 0x8E4B5E KfAxUbAyUbSstxUbSstyUbWUb 191.3 rel_ub_q0p75_o48 -48.00 143.3 FORMAT "%5.1"
 /begin AXIS_DESCR STD_AXIS tmotkmtr temp_ub_q0p75_o48 5 -48.00 143.3 FORMAT "%5.1" DEPOSIT ABSOLUTE /end AXIS_DESCR
 /begin AXIS_DESCR STD_AXIS tumgkmtr temp_ub_q0p75_o48 5 -48.00 143.3 FORMAT "%5.1" DEPOSIT ABSOLUTE /end AXIS_DESCR
/end CHARACTERISTIC
/begin CHARACTERISTIC KFTKANRL "" MAP 0x8E4B83 KfAxUbAyUbSstxUbSstyUbWUb 191.3 temp_ub_q0p75_o48 -48.00 143.3 FORMAT "%5.1"
 /begin AXIS_DESCR STD_AXIS nmot nmot_ub_q40 5 0.00 10200. FORMAT "%5.0" DEPOSIT ABSOLUTE /end AXIS_DESCR
 /begin AXIS_DESCR STD_AXIS rl rel_ub_q0p75 5 0.00 191.3 FORMAT "%5.1" DEPOSIT ABSOLUTE /end AXIS_DESCR
/end CHARACTERISTIC
/begin CHARACTERISTIC KFTKAOFF "" MAP 0x8F1264 GkfWSb 191.3 temp_sb_q0p75 -96.00 95.25 FORMAT "%5.2"
 /begin AXIS_DESCR COM_AXIS dtmtka temp_sb_q0p75 5 -96.00 95.25 FORMAT "%5.2" AXIS_PTS_REF STS05DTKA /end AXIS_DESCR
 /begin AXIS_DESCR COM_AXIS dkmts temp_sb_q0p75 5 -96.00 95.25 FORMAT "%5.2" AXIS_PTS_REF STS05DTTS /end AXIS_DESCR
/end CHARACTERISTIC
/begin CHARACTERISTIC KFTKASO "" MAP 0x8E4BA8 KfAxUbAyUbSstxUbSstyUbWUb 191.3 temp_ub_q0p75_o48 -48.00 143.3 FORMAT "%5.1"
 /begin AXIS_DESCR STD_AXIS tkastmot temp_ub_q0p75_o48 5 -48.00 143.3 FORMAT "%5.1" DEPOSIT ABSOLUTE /end AXIS_DESCR
 /begin AXIS_DESCR STD_AXIS tkasnrlf temp_ub_q0p75_o48 5 -48.00 143.3 FORMAT "%5.1" DEPOSIT ABSOLUTE /end AXIS_DESCR
/end CHARACTERISTIC
/begin CHARACTERISTIC KFTKATU "" MAP 0x8F127E KfAxUbAyUbSstxUbSstyUbWSb 191.3 temp_sb_q0p75 -96.00 95.25 FORMAT "%5.2"
 /begin AXIS_DESCR STD_AXIS tumgkmtr temp_ub_q0p75_o48 5 -48.00 143.3 FORMAT "%5.1" DEPOSIT ABSOLUTE /end AXIS_DESCR
 /begin AXIS_DESCR STD_AXIS tmotsoll temp_ub_q0p75_o48 5 -48.00 143.3 FORMAT "%5.1" DEPOSIT ABSOLUTE /end AXIS_DESCR
/end CHARACTERISTIC
/begin CHARACTERISTIC KFTMOTKR "" MAP 0x8F12A4 KfAxUbAyUbSstxUbSstyUwWUb 191.3 temp_ub_q0p75_o48 -48.00 143.3 FORMAT "%5.1"
 /begin AXIS_DESCR STD_AXIS tmotkmtr temp_ub_q0p75_o48 5 -48.00 143.3 FORMAT "%5.1" DEPOSIT ABSOLUTE /end AXIS_DESCR
 /begin AXIS_DESCR STD_AXIS vsksmlf_w volgrd_q5p96Em4 5 0.00 39.06190 FORMAT "%8.5" DEPOSIT ABSOLUTE /end AXIS_DESCR
/end CHARACTERISTIC
/begin CHARACTERISTIC KFTNSTKO "" MAP 0x8F10D2 KfAxUbAyUbSstxUwSstyUbWUb 51.00 t200msxs_ub_b51 0.00 51.00 FORMAT "%5.2"
 /begin AXIS_DESCR STD_AXIS fho_w fak_uw_b4 4 0.00 3.999939 FORMAT "%8.6" DEPOSIT ABSOLUTE /end AXIS_DESCR
 /begin AXIS_DESCR STD_AXIS tmst temp_ub_q0p75_o48 2 -48.00 143.3 FORMAT "%5.1" DEPOSIT ABSOLUTE /end AXIS_DESCR
/end CHARACTERISTIC
/begin CHARACTERISTIC KFTVETR "" MAP 0x8F12D0 KfAxUbAyUbSstxSbSstyUbWUb 99.61 tv_ub_b100 0.00 99.61 FORMAT "%5.2"
 /begin AXIS_DESCR STD_AXIS dkmts temp_sb_q0p75 6 -96.00 95.25 FORMAT "%5.2" DEPOSIT ABSOLUTE /end AXIS_DESCR
 /begin AXIS_DESCR STD_AXIS tmotsoll temp_ub_q0p75_o48 6 -48.00 143.3 FORMAT "%5.1" DEPOSIT ABSOLUTE /end AXIS_DESCR
/end CHARACTERISTIC
/begin CHARACTERISTIC KFTVLU1 "" MAP 0x8F1302 KfAxUbAyUbSstxUbSstyUbWUb 99.61 tv_ub_b100 0.00 99.61 FORMAT "%5.2"
 /begin AXIS_DESCR STD_AXIS nluez1 nmot_ub_q20 6 0.00 5100. FORMAT "%5.0" DEPOSIT ABSOLUTE /end AXIS_DESCR
 /begin AXIS_DESCR STD_AXIS ub spg_ubatt_sy 6 0.00 17.93 FORMAT "%5.2" DEPOSIT ABSOLUTE /end AXIS_DESCR
/end CHARACTERISTIC
/begin CHARACTERISTIC KFTVLU1EW "" MAP 0x8E4BCD KfAxUbAyUbSstxUbSstyUbWUb 99.61 tv_ub_b100 0.00 99.61 FORMAT "%5.2"
 /begin AXIS_DESCR STD_AXIS vfzgkmtr vfzg_ub_q1p25 4 0.00 318.8 FORMAT "%5.1" DEPOSIT ABSOLUTE /end AXIS_DESCR
 /begin AXIS_DESCR STD_AXIS tans temp_ub_q0p75_o48 4 -48.00 143.3 FORMAT "%5.1" DEPOSIT ABSOLUTE /end AXIS_DESCR
/end CHARACTERISTIC
/begin CHARACTERISTIC KFTVLU2 "" MAP 0x8F1334 KfAxUbAyUbSstxUbSstyUbWUb 99.61 tv_ub_b100 0.00 99.61 FORMAT "%5.2"
 /begin AXIS_DESCR STD_AXIS nluez2 nmot_ub_q20 6 0.00 5100. FORMAT "%5.0" DEPOSIT ABSOLUTE /end AXIS_DESCR
 /begin AXIS_DESCR STD_AXIS ub spg_ubatt_sy 6 0.00 17.93 FORMAT "%5.2" DEPOSIT ABSOLUTE /end AXIS_DESCR
/end CHARACTERISTIC
/begin CHARACTERISTIC KFTVLU2EW "" MAP 0x8E4BE7 KfAxUbAyUbSstxUbSstyUbWUb 99.61 tv_ub_b100 0.00 99.61 FORMAT "%5.2"
 /begin AXIS_DESCR STD_AXIS vfzgkmtr vfzg_ub_q1p25 4 0.00 318.8 FORMAT "%5.1" DEPOSIT ABSOLUTE /end AXIS_DESCR
 /begin AXIS_DESCR STD_AXIS tans temp_ub_q0p75_o48 4 -48.00 143.3 FORMAT "%5.1" DEPOSIT ABSOLUTE /end AXIS_DESCR
/end CHARACTERISTIC
/begin CHARACTERISTIC KFTVNL1 "" MAP 0x8F1366 KfAxUbAyUbSstxUbSstyUbWUb 99.61 tv_ub_b100 0.00 99.61 FORMAT "%5.2"
 /begin AXIS_DESCR STD_AXIS tmotkmtr temp_ub_q0p75_o48 6 -48.00 143.3 FORMAT "%5.1" DEPOSIT ABSOLUTE /end AXIS_DESCR
 /begin AXIS_DESCR STD_AXIS tumgkmtr temp_ub_q0p75_o48 6 -48.00 143.3 FORMAT "%5.1" DEPOSIT ABSOLUTE /end AXIS_DESCR
/end CHARACTERISTIC
/begin CHARACTERISTIC KFTVNL2 "" MAP 0x8F1398 KfAxUbAyUbSstxUbSstyUbWUb 99.61 tv_ub_b100 0.00 99.61 FORMAT "%5.2"
 /begin AXIS_DESCR STD_AXIS tmotkmtr temp_ub_q0p75_o48 6 -48.00 143.3 FORMAT "%5.1" DEPOSIT ABSOLUTE /end AXIS_DESCR
 /begin AXIS_DESCR STD_AXIS tumgkmtr temp_ub_q0p75_o48 6 -48.00 143.3 FORMAT "%5.1" DEPOSIT ABSOLUTE /end AXIS_DESCR
/end CHARACTERISTIC
/begin CHARACTERISTIC KFZNSM "" MAP 0x8E29F9 GkfWUb 5.08000 zk20msxs_ub_b5p1 0.0200000 5.10000 FORMAT "%7.5"
 /begin AXIS_DESCR COM_AXIS tmot temp_ub_q0p75_o48 6 -48.00 143.3 FORMAT "%5.1" AXIS_PTS_REF STM06LLUB /end AXIS_DESCR
 /begin AXIS_DESCR COM_AXIS dns nmotd_sb_q10 6 -1280. 1270. FORMAT "%5.0" AXIS_PTS_REF SNS06LLSB /end AXIS_DESCR
/end CHARACTERISTIC
/begin CHARACTERISTIC KLAH1 "" VALUE 0x8E4C01 KwUb 191.3 rel_ub_q0p75_o48 -48.00 143.3 FORMAT "%5.1" /end CHARACTERISTIC
/begin CHARACTERISTIC KLAH2 "" VALUE 0x8E4C02 KwUb 191.3 rel_ub_q0p75_o48 -48.00 143.3 FORMAT "%5.1" /end CHARACTERISTIC
/begin CHARACTERISTIC KLAHEW "" VALUE 0x8E4C03 KwUb 255.0 dez 0.00 255.0 FORMAT "%5.1" /end CHARACTERISTIC
/begin CHARACTERISTIC KLAHTMSMX1 "" VALUE 0x8E4C04 KwUb 191.3 temp_ub_q0p75_o48 -48.00 143.3 FORMAT "%5.1" /end CHARACTERISTIC
/begin CHARACTERISTIC KLAHTMSMX2 "" VALUE 0x8E4C05 KwUb 191.3 temp_ub_q0p75_o48 -48.00 143.3 FORMAT "%5.1" /end CHARACTERISTIC
/begin CHARACTERISTIC KLAHTVLUE1 "" VALUE 0x8E4C06 KwUb 99.61 rel_ub_b100 0.00 99.61 FORMAT "%5.2" /end CHARACTERISTIC
/begin CHARACTERISTIC KLAHTVLUE2 "" VALUE 0x8E4C07 KwUb 99.61 rel_ub_b100 0.00 99.61 FORMAT "%5.2" /end CHARACTERISTIC
/begin CHARACTERISTIC KLANFVFZ "" CURVE 0x8E4C08 KlAUbSstUbWUb 0.9961 fak_ub_b1 0.00 0.9961
 /begin AXIS_DESCR STD_AXIS vfzgkmtr vfzg_ub_q1p25 5 0.00 318.8 FORMAT "%5.1" DEPOSIT ABSOLUTE /end AXIS_DESCR
/end CHARACTERISTIC
/begin CHARACTERISTIC KLDFOFF "" VALUE 0x8E2A1D KwUb 99.61 rel_ub_b99p6 0.00 99.61 FORMAT "%5.2" /end CHARACTERISTIC
/begin CHARACTERISTIC KLDFON "" VALUE 0x8E2A1E KwUb 99.61 rel_ub_b99p6 0.00 99.61 FORMAT "%5.2" /end CHARACTERISTIC
/begin CHARACTERISTIC KLDRLLBTDY "" CURVE 0x8E2317 GklWUb 191.3 rel_sb_q0p75 0.00 191.3 FORMAT "%5.1"
 /begin AXIS_DESCR COM_AXIS nmot nmot_ub_q40 16 0.00 10200. FORMAT "%5.0" AXIS_PTS_REF SNM16GKUB /end AXIS_DESCR
/end CHARACTERISTIC
/begin CHARACTERISTIC KLFDQV "" CURVE 0x8E4C13 KlAUbSstUbWUb 0.9961 fak_ub_b1 0.00 0.9961
 /begin AXIS_DESCR STD_AXIS vfzgkmtr vfzg_ub_q1p25 4 0.00 318.8 FORMAT "%5.1" DEPOSIT ABSOLUTE /end AXIS_DESCR
/end CHARACTERISTIC
/begin CHARACTERISTIC KLFQKV "" CURVE 0x8E4C1C KlAUbSstUbWUb 0.9961 fak_ub_b1 0.00 0.9961
 /begin AXIS_DESCR STD_AXIS vfzgkmtr vfzg_ub_q1p25 4 0.00 318.8 FORMAT "%5.1" DEPOSIT ABSOLUTE /end AXIS_DESCR
/end CHARACTERISTIC
/begin CHARACTERISTIC KLLAKHFH "" CURVE 0x8EB648 KlAUwSstUwWUw 1.999969 fak_uw_b2 0.00 1.999969 FORMAT "%8.6"
 /begin AXIS_DESCR STD_AXIS fho_w fak_uw_b4 4 0.00 3.999939 FORMAT "%8.6" DEPOSIT ABSOLUTE /end AXIS_DESCR
/end CHARACTERISTIC
/begin CHARACTERISTIC KLMLFT "" CURVE 0x8E4C25 KlAUbSstUbWUb 191.3 rel_ub_q0p75_o48 -48.00 143.3 FORMAT "%5.1"
 /begin AXIS_DESCR STD_AXIS tvlueskmtr tv_ub_b100 5 0.00 99.61 FORMAT "%5.2" DEPOSIT ABSOLUTE /end AXIS_DESCR
/end CHARACTERISTIC
/begin CHARACTERISTIC KLMRESTM "" CURVE 0x8E2D65 KlAUbSstUbWUb 24.90 rel_ub_b24p9 0.00 24.90 FORMAT "%5.2"
 /begin AXIS_DESCR STD_AXIS tmot temp_ub_q0p75_o48 10 -48.00 143.3 FORMAT "%5.1" DEPOSIT ABSOLUTE /end AXIS_DESCR
/end CHARACTERISTIC
/begin CHARACTERISTIC KLMRHO "" CURVE 0x8E2D7A KlAUbSstUbWUb 24.90 rel_ub_b24p9 0.00 24.90 FORMAT "%5.2"
 /begin AXIS_DESCR STD_AXIS fho fak_ub_b4 10 0.00 3.984 FORMAT "%5.3" DEPOSIT ABSOLUTE /end AXIS_DESCR
/end CHARACTERISTIC
/begin CHARACTERISTIC KLNLOEL "" CURVE 0x8F13CA KlAUwSstUwWUw 65535.00 t1sxs_uw_b65535 0.00 65535.00 FORMAT "%8.2"
 /begin AXIS_DESCR STD_AXIS toelkmtr temp_ub_q1_o60 6 -60.00 195.0 FORMAT "%5.1" DEPOSIT ABSOLUTE /end AXIS_DESCR
/end CHARACTERISTIC
/begin CHARACTERISTIC KLNLSTP "" CURVE 0x8E4C30 KlAUbSstUbWUb 191.3 temp_ub_q0p75_o48 -48.00 143.3 FORMAT "%5.1"
 /begin AXIS_DESCR STD_AXIS tmotnl2 temp_ub_q0p75_o48 6 -48.00 143.3 FORMAT "%5.1" DEPOSIT ABSOLUTE /end AXIS_DESCR
/end CHARACTERISTIC
/begin CHARACTERISTIC KLNLTABG "" CURVE 0x8F13E4 KlAUbSstUbWUw 65535.00 t1sxs_uw_b65535 0.00 65535.00 FORMAT "%8.2"
 /begin AXIS_DESCR STD_AXIS tabgkmtr temp_ub_q5_o50 5 -50.00 1225. FORMAT "%5.0" DEPOSIT ABSOLUTE /end AXIS_DESCR
/end CHARACTERISTIC
/begin CHARACTERISTIC KLNLTUM "" CURVE 0x8E4C3D KlAUbSstUbWUb 0.9961 fak_ub_b1 0.00 0.9961
 /begin AXIS_DESCR STD_AXIS tumgkmtr temp_ub_q0p75_o48 4 -48.00 143.3 FORMAT "%5.1" DEPOSIT ABSOLUTE /end AXIS_DESCR
/end CHARACTERISTIC
/begin CHARACTERISTIC KLNSNW "" CURVE 0x8E2A1F KlAUbSstUbWUb 2550. nmot_ub_q10 0.00 2550. FORMAT "%5.0"
 /begin AXIS_DESCR STD_AXIS nsnwi nmot_ub_q10 16 0.00 2550. FORMAT "%5.0" DEPOSIT ABSOLUTE /end AXIS_DESCR
/end CHARACTERISTIC
/begin CHARACTERISTIC KLQKAUS "" CURVE 0x8E4C46 KlAUbSstUbWUb 191.3 rel_ub_q0p75_o48 -48.00 143.3 FORMAT "%5.1"
 /begin AXIS_DESCR STD_AXIS pklimaq p_q0p2 5 0.00 51.00 FORMAT "%5.2" DEPOSIT ABSOLUTE /end AXIS_DESCR
/end CHARACTERISTIC
/begin CHARACTERISTIC KLQKLIMA "" CURVE 0x8E4C51 KlAUbSstUbWUb 191.3 rel_ub_q0p75_o48 -48.00 143.3 FORMAT "%5.1"
 /begin AXIS_DESCR STD_AXIS pklimaq p_q0p2 5 0.00 51.00 FORMAT "%5.2" DEPOSIT ABSOLUTE /end AXIS_DESCR
/end CHARACTERISTIC
/begin CHARACTERISTIC KLTMSKR "" CURVE 0x8E4C5C KlAUbSstUbWUb 191.3 temp_ub_q0p75_o48 -48.00 143.3 FORMAT "%5.1"
 /begin AXIS_DESCR STD_AXIS krtmso zw_ub_qn0p75 4 -191.3 0.00 FORMAT "%5.1" DEPOSIT ABSOLUTE /end AXIS_DESCR
/end CHARACTERISTIC
/begin CHARACTERISTIC KLTVKOEP "" CURVE 0x8E3F4A KlAUbSstUbWUb 10.20 t40msxs_ub_q0p04 0.00 10.20 FORMAT "%5.2"
 /begin AXIS_DESCR STD_AXIS pkodrc p_q0p2 8 0.00 51.00 FORMAT "%5.2" DEPOSIT ABSOLUTE /end AXIS_DESCR
/end CHARACTERISTIC
/begin CHARACTERISTIC KLTVLBTDY "" CURVE 0x8EAD7C GklWUw 5.000000 t10msxs_uw_b655p35 0.00 5.000000 FORMAT "%8.6"
 /begin AXIS_DESCR COM_AXIS nmot nmot_ub_q40 16 0.00 10200. FORMAT "%5.0" AXIS_PTS_REF SNM16GKUB /end AXIS_DESCR
/end CHARACTERISTIC
/begin CHARACTERISTIC KLZDLBTS "" CURVE 0x8EAD9C KlAUwSstUwWUw 6553.4999985 zk100msxs_uw_b6553 0.10000152590 6553.6000000 FORMAT "%12.7"
 /begin AXIS_DESCR STD_AXIS ml m_ub_b1020 4 0.00 1020. FORMAT "%5.0" DEPOSIT ABSOLUTE /end AXIS_DESCR
/end CHARACTERISTIC
/begin CHARACTERISTIC KLZKLBTDY "" CURVE 0x8EADD2 KlAUwSstUwWUw 655.34999985 zk10msxs_uw_b655 0.010000152590 655.36000000 FORMAT "%12.8"
 /begin AXIS_DESCR STD_AXIS mivbegv_w rel_uw_b100 6 0.00 99.99847 FORMAT "%8.5" DEPOSIT ABSOLUTE /end AXIS_DESCR
/end CHARACTERISTIC
/begin CHARACTERISTIC KNSNF "" VALUE 0x8E2A40 KwUb 2550. nmot_ub_q10 0.00 2550. FORMAT "%5.0" /end CHARACTERISTIC
/begin CHARACTERISTIC KRAL1N "" CURVE 0x8E26C6 GklWUb 191.3 rel_ub_q0p75 0.00 191.3 FORMAT "%5.1"
 /begin AXIS_DESCR COM_AXIS nmot nmot_ub_q40 16 0.00 10200. FORMAT "%5.0" AXIS_PTS_REF SNM16KRUB /end AXIS_DESCR
/end CHARACTERISTIC
/begin CHARACTERISTIC KRAL2N "" CURVE 0x8E26D6 GklWUb 191.3 rel_ub_q0p75 0.00 191.3 FORMAT "%5.1"
 /begin AXIS_DESCR COM_AXIS nmot nmot_ub_q40 16 0.00 10200. FORMAT "%5.0" AXIS_PTS_REF SNM16KRUB /end AXIS_DESCR
/end CHARACTERISTIC
/begin CHARACTERISTIC KRAL3N "" CURVE 0x8E26E6 GklWUb 191.3 rel_ub_q0p75 0.00 191.3 FORMAT "%5.1"
 /begin AXIS_DESCR COM_AXIS nmot nmot_ub_q40 16 0.00 10200. FORMAT "%5.0" AXIS_PTS_REF SNM16KRUB /end AXIS_DESCR
/end CHARACTERISTIC
/begin CHARACTERISTIC KRALH "" VALUE 0x8E26F6 KwUb 191.3 rel_ub_q0p75 0.00 191.3 FORMAT "%5.1" /end CHARACTERISTIC
/begin CHARACTERISTIC KRAN1 "" VALUE 0x8E26F7 KwUb 10200. nmot_ub_q40 0.00 10200. FORMAT "%5.0" /end CHARACTERISTIC
/begin CHARACTERISTIC KRAN2 "" VALUE 0x8E26F8 KwUb 10200. nmot_ub_q40 0.00 10200. FORMAT "%5.0" /end CHARACTERISTIC
/begin CHARACTERISTIC KRAN3 "" VALUE 0x8E26F9 KwUb 10200. nmot_ub_q40 0.00 10200. FORMAT "%5.0" /end CHARACTERISTIC
/begin CHARACTERISTIC KRAN4 "" VALUE 0x8E26FA KwUb 10200. nmot_ub_q40 0.00 10200. FORMAT "%5.0" /end CHARACTERISTIC
/begin CHARACTERISTIC KRANH "" VALUE 0x8E26FB KwUb 10200. nmot_ub_q40 0.00 10200. FORMAT "%5.0" /end CHARACTERISTIC
/begin CHARACTERISTIC KRDWA "" VALUE 0x8FD098 KwUb 191.3 zw_ub_q0p75 0.00 191.3 FORMAT "%5.1" /end CHARACTERISTIC
/begin CHARACTERISTIC KRDWAA "" VALUE 0x8FD099 KwUb 191.3 zw_ub_qn0p75 -191.3 0.00 FORMAT "%5.1" /end CHARACTERISTIC
/begin CHARACTERISTIC KRDWKLA "" VALUE 0x8FD09A KwUb 6.000 zw_ub_qn0p75 -6.000 0.00 FORMAT "%5.3" /end CHARACTERISTIC
/begin CHARACTERISTIC KRDWSA "" VALUE 0x8FD09B KwUb 6.000 zw_ub_q0p75 0.00 6.000 FORMAT "%5.3" /end CHARACTERISTIC
/begin CHARACTERISTIC KRDWSN "" CURVE 0x8E26FC GklWUb 191.3 zw_ub_qn0p75 -191.3 0.00 FORMAT "%5.1"
 /begin AXIS_DESCR COM_AXIS nmot nmot_ub_q40 16 0.00 10200. FORMAT "%5.0" AXIS_PTS_REF SNM16KRUB /end AXIS_DESCR
/end CHARACTERISTIC
/begin CHARACTERISTIC KRFKLN "" CURVE 0x8E270C GklWUb 191.3 zw_ub_qn0p75 -191.3 0.00 FORMAT "%5.1"
 /begin AXIS_DESCR COM_AXIS nmot nmot_ub_q40 16 0.00 10200. FORMAT "%5.0" AXIS_PTS_REF SNM16KRUB /end AXIS_DESCR
/end CHARACTERISTIC
/begin CHARACTERISTIC KRFKN "" CURVE 0x8E271C GklWUb 191.3 zw_ub_qn0p75 -191.3 0.00 FORMAT "%5.1"
 /begin AXIS_DESCR COM_AXIS nmot nmot_ub_q40 16 0.00 10200. FORMAT "%5.0" AXIS_PTS_REF SNM16KRUB /end AXIS_DESCR
/end CHARACTERISTIC
/begin CHARACTERISTIC KRFTP1 "" VALUE 0x8FD089 KwUb 24.00 dez 8.000 32.00 FORMAT "%5.2" /end CHARACTERISTIC
/begin CHARACTERISTIC KRFTP2 "" VALUE 0x8FD08A KwUb 14.00 dez 2.000 16.00 FORMAT "%5.2" /end CHARACTERISTIC
/begin CHARACTERISTIC KRFTP3 "" VALUE 0x8FD08B KwUb 14.00 dez 2.000 16.00 FORMAT "%5.2" /end CHARACTERISTIC
/begin CHARACTERISTIC KRKFKS "" VALUE 0x8FD08C KwUb 255.0 dez 0.00 255.0 FORMAT "%5.1" /end CHARACTERISTIC
/begin CHARACTERISTIC KRLVFN "" CURVE 0x8E272C GklWUb 254.0 dez 1.000 255.0 FORMAT "%5.1"
 /begin AXIS_DESCR COM_AXIS nmot nmot_ub_q40 16 0.00 10200. FORMAT "%5.0" AXIS_PTS_REF SNM16KRUB /end AXIS_DESCR
/end CHARACTERISTIC
/begin CHARACTERISTIC KRMXN "" CURVE 0x8E273C GklWUb 190.5 zw_ub_qn0p75 -191.3 -0.7500 FORMAT "%5.1"
 /begin AXIS_DESCR COM_AXIS nmot nmot_ub_q40 16 0.00 10200. FORMAT "%5.0" AXIS_PTS_REF SNM16KRUB /end AXIS_DESCR
/end CHARACTERISTIC
/begin CHARACTERISTIC KRNLZ "" VAL_BLK 0x8E274C KwbUb 10200. nmot_ub_q40 0.00 10200. FORMAT "%5.0" NUMBER 8 /end CHARACTERISTIC
/begin CHARACTERISTIC KRVFN "" CURVE 0x8E2754 GklWUb 254.0 dez 1.000 255.0 FORMAT "%5.1"
 /begin AXIS_DESCR COM_AXIS nmot nmot_ub_q40 16 0.00 10200. FORMAT "%5.0" AXIS_PTS_REF SNM16KRUB /end AXIS_DESCR
/end CHARACTERISTIC
/begin CHARACTERISTIC KRVFSN "" CURVE 0x8E2764 GklWUb 254.0 dez 1.000 255.0 FORMAT "%5.1"
 /begin AXIS_DESCR COM_AXIS nmot nmot_ub_q40 16 0.00 10200. FORMAT "%5.0" AXIS_PTS_REF SNM16KRUB /end AXIS_DESCR
/end CHARACTERISTIC
/begin CHARACTERISTIC KRVST "" VALUE 0x8FD08D KwUb 6.000 dez 0.00 6.000 FORMAT "%5.3" /end CHARACTERISTIC
/begin CHARACTERISTIC KRWKRAIN "" VALUE 0x8FD09C KwUb 191.3 zw_ub_qn0p75 -191.3 0.00 FORMAT "%5.1" /end CHARACTERISTIC
/begin CHARACTERISTIC KSZA "" VALUE 0x8FD08E KwUb 3.000 dez 1.000 4.000 FORMAT "%5.3" /end CHARACTERISTIC
/begin CHARACTERISTIC KVB "" VALUE 0x8E3FD7 KwUb 777.0 m_ub_b780 0.00 777.0 FORMAT "%5.1" /end CHARACTERISTIC
/begin CHARACTERISTIC LAMFA "" MAP 0x8EAAFC KfAxUbAyUbSstxUbSstyUwWUb 1.992 fak_ub_b2 0.00 1.992 FORMAT "%5.3"
 /begin AXIS_DESCR STD_AXIS nmot nmot_ub_q40 15 0.00 10200. FORMAT "%5.0" DEPOSIT ABSOLUTE /end AXIS_DESCR
 /begin AXIS_DESCR STD_AXIS mrfa_w rel_uw_b200 6 0.00 199.9969 FORMAT "%8.4" DEPOSIT ABSOLUTE /end AXIS_DESCR
/end CHARACTERISTIC
/begin CHARACTERISTIC LAMFLGSL "" CURVE 0x8E1B72 KlAUbSstUbWUb 1.992 fak_ub_b2 0.00 1.992 FORMAT "%5.3"
 /begin AXIS_DESCR STD_AXIS imlatm m_ub_b23p3 6 0.00 23.21 FORMAT "%5.2" DEPOSIT ABSOLUTE /end AXIS_DESCR
/end CHARACTERISTIC
/begin CHARACTERISTIC LAMLGFKT "" VALUE 0x8E1B7F KwUb 1.992 fak_ub_b2 0.00 1.992 FORMAT "%5.3" /end CHARACTERISTIC
/begin CHARACTERISTIC LAMLGFTM "" CURVE 0x8E1B80 GklWUb 1.992 fak_ub_b2 0.00 1.992 FORMAT "%5.3"
 /begin AXIS_DESCR COM_AXIS tmot temp_ub_q0p75_o48 12 -48.00 143.3 FORMAT "%5.1" AXIS_PTS_REF STM12ESUB /end AXIS_DESCR
/end CHARACTERISTIC
/begin CHARACTERISTIC LAMLGMKT "" VALUE 0x8E1B8C KwUb 1.992 fak_ub_b2 0.00 1.992 FORMAT "%5.3" /end CHARACTERISTIC
/begin CHARACTERISTIC LAMLGMTM "" CURVE 0x8E1B8D GklWUb 1.992 fak_ub_b2 0.00 1.992 FORMAT "%5.3"
 /begin AXIS_DESCR COM_AXIS tmot temp_ub_q0p75_o48 12 -48.00 143.3 FORMAT "%5.1" AXIS_PTS_REF STM12ESUB /end AXIS_DESCR
/end CHARACTERISTIC
/begin CHARACTERISTIC LAMRLMN "" VALUE 0x8E1E95 KwUb 1.992 fak_ub_b2 0.00 1.992 FORMAT "%5.3" /end CHARACTERISTIC
/begin CHARACTERISTIC LASDSLA "" CURVE 0x8EB65A KlAUwSstUwWUw 15.99976 fak_q0p000244 0.00 15.99976 FORMAT "%8.5"
 /begin AXIS_DESCR STD_AXIS ml_w m_uw_b6553p5 4 0.00 6553.500 FORMAT "%8.3" DEPOSIT ABSOLUTE /end AXIS_DESCR
/end CHARACTERISTIC
/begin CHARACTERISTIC LASOAB "" VALUE 0x8FD00D KwUb 1.992 fak_ub_b2 0.00 1.992 FORMAT "%5.3" /end CHARACTERISTIC
/begin CHARACTERISTIC LASTMOT "" CURVE 0x8E249A KlAUbSstUbWUb 1.992 fak_ub_b2 0.00 1.992 FORMAT "%5.3"
 /begin AXIS_DESCR STD_AXIS tmot temp_ub_q0p75_o48 4 -48.00 143.3 FORMAT "%5.1" DEPOSIT ABSOLUTE /end AXIS_DESCR
/end CHARACTERISTIC
/begin CHARACTERISTIC LASWLTM "" CURVE 0x8E1DCE GklWSb 1.992 fak_sb_b1 -1.000 0.9922 FORMAT "%5.3"
 /begin AXIS_DESCR COM_AXIS tmot temp_ub_q0p75_o48 12 -48.00 143.3 FORMAT "%5.1" AXIS_PTS_REF STM12ESUB /end AXIS_DESCR
/end CHARACTERISTIC
/begin CHARACTERISTIC LBZO1 "" VALUE 0x8E2A41 KwUb 99.61 rel_ub_b99p6 0.00 99.61 FORMAT "%5.2" /end CHARACTERISTIC
/begin CHARACTERISTIC LBZO2 "" VALUE 0x8E2A42 KwUb 99.61 rel_ub_b99p6 0.00 99.61 FORMAT "%5.2" /end CHARACTERISTIC
/begin CHARACTERISTIC LBZU "" VALUE 0x8E2A43 KwUb 99.61 rel_ub_b99p6 0.00 99.61 FORMAT "%5.2" /end CHARACTERISTIC
/begin CHARACTERISTIC LIMN "" VALUE 0x8FD193 KwUb 24.90 rel_ub_bn24p9 -24.90 0.00 FORMAT "%5.2" /end CHARACTERISTIC
/begin CHARACTERISTIC LIMNDLLR "" VALUE 0x8FD194 KwUb 24.90 rel_ub_bn24p9 -24.90 0.00 FORMAT "%5.2" /end CHARACTERISTIC
/begin CHARACTERISTIC LIMNDTES "" VALUE 0x8FD195 KwUb 24.90 rel_ub_bn24p9 -24.90 0.00 FORMAT "%5.2" /end CHARACTERISTIC
/begin CHARACTERISTIC LIMNV "" VALUE 0x8FD196 KwUb 24.90 rel_ub_bn24p9 -24.90 0.00 FORMAT "%5.2" /end CHARACTERISTIC
/begin CHARACTERISTIC LIMXDNS "" CURVE 0x8E2B67 GklWUb 24.90 rel_ub_b24p9 0.00 24.90 FORMAT "%5.2"
 /begin AXIS_DESCR COM_AXIS dns nmotd_sb_q10 6 -1280. 1270. FORMAT "%5.0" AXIS_PTS_REF SNS206LLSB /end AXIS_DESCR
/end CHARACTERISTIC
/begin CHARACTERISTIC LIMXVDNS "" CURVE 0x8E2B6D GklWUb 24.90 rel_ub_b24p9 0.00 24.90 FORMAT "%5.2"
 /begin AXIS_DESCR COM_AXIS dns nmotd_sb_q10 6 -1280. 1270. FORMAT "%5.0" AXIS_PTS_REF SNS206LLSB /end AXIS_DESCR
/end CHARACTERISTIC
/begin CHARACTERISTIC LISTM "" CURVE 0x8E2B73 GklWUb 24.90 rel_ub_b24p9 0.00 24.90 FORMAT "%5.2"
 /begin AXIS_DESCR COM_AXIS tmot temp_ub_q0p75_o48 6 -48.00 143.3 FORMAT "%5.1" AXIS_PTS_REF STM06LLUB /end AXIS_DESCR
/end CHARACTERISTIC
/begin CHARACTERISTIC LKRAN "" CURVE 0x8E2774 GklWUb 191.3 rel_ub_q0p75 0.00 191.3 FORMAT "%5.1"
 /begin AXIS_DESCR COM_AXIS nmot nmot_ub_q40 16 0.00 10200. FORMAT "%5.0" AXIS_PTS_REF SNM16KRUB /end AXIS_DESCR
/end CHARACTERISTIC
/begin CHARACTERISTIC LKRN "" CURVE 0x8E2784 GklWUb 191.3 rel_ub_q0p75 0.00 191.3 FORMAT "%5.1"
 /begin AXIS_DESCR COM_AXIS nmot nmot_ub_q40 16 0.00 10200. FORMAT "%5.0" AXIS_PTS_REF SNM16KRUB /end AXIS_DESCR
/end CHARACTERISTIC
/begin CHARACTERISTIC LLRICNF "" VALUE 0x8FD197 KwUb 255.0 dez 0.00 255.0 FORMAT "%5.1" /end CHARACTERISTIC
/begin CHARACTERISTIC LMSTMOT "" CURVE 0x8E24A3 KlAUbSstUbWUb 1.992 fak_ub_b2 0.00 1.992 FORMAT "%5.3"
 /begin AXIS_DESCR STD_AXIS tmot temp_ub_q0p75_o48 4 -48.00 143.3 FORMAT "%5.1" DEPOSIT ABSOLUTE /end AXIS_DESCR
/end CHARACTERISTIC
/begin CHARACTERISTIC LUEKO1 "" VALUE 0x8F13F4 KwUw 65535.00 dez 0.00 65535.00 FORMAT "%8.2" /end CHARACTERISTIC
/begin CHARACTERISTIC LUEKO2 "" VALUE 0x8F13F6 KwUw 65535.00 dez 0.00 65535.00 FORMAT "%8.2" /end CHARACTERISTIC
/begin CHARACTERISTIC LUEKO3 "" VALUE 0x8F13F8 KwUw 65535.00 dez 0.00 65535.00 FORMAT "%8.2" /end CHARACTERISTIC
/begin CHARACTERISTIC LZB1 "" VAL_BLK 0x8FD09D KwbUb 255.0 dez 0.00 255.0 FORMAT "%5.1" NUMBER 8 /end CHARACTERISTIC
/begin CHARACTERISTIC LZB2 "" VAL_BLK 0x8FD0A5 KwbUb 255.0 dez 0.00 255.0 FORMAT "%5.1" NUMBER 8 /end CHARACTERISTIC
/begin CHARACTERISTIC LZFUER "" VAL_BLK 0x8FD0AD KwbUb 255.0 dez 0.00 255.0 FORMAT "%5.1" NUMBER 8 /end CHARACTERISTIC
/begin CHARACTERISTIC MDKOAB "" CURVE 0x8E3F7B GklWUb 199.2 rel_ub_b200 0.00 199.2 FORMAT "%5.1"
 /begin AXIS_DESCR COM_AXIS nmot nmot_ub_q40 8 0.00 10200. FORMAT "%5.0" AXIS_PTS_REF SNM08KOUB /end AXIS_DESCR
/end CHARACTERISTIC
/begin CHARACTERISTIC MDKOAN "" CURVE 0x8E3F83 GklWUb 199.2 rel_ub_b200 0.00 199.2 FORMAT "%5.1"
 /begin AXIS_DESCR COM_AXIS nmot nmot_ub_q40 8 0.00 10200. FORMAT "%5.0" AXIS_PTS_REF SNM08KOUB /end AXIS_DESCR
/end CHARACTERISTIC
/begin CHARACTERISTIC MDKOEN "" CURVE 0x8E3F8B GklWUb 199.2 rel_ub_b200 0.00 199.2 FORMAT "%5.1"
 /begin AXIS_DESCR COM_AXIS nmot nmot_ub_q40 8 0.00 10200. FORMAT "%5.0" AXIS_PTS_REF SNM08KOUB /end AXIS_DESCR
/end CHARACTERISTIC
/begin CHARACTERISTIC MDNKO "" CURVE 0x8E3F5B GklWUb 99.61 rel_ub_b100 0.00 99.61 FORMAT "%5.2"
 /begin AXIS_DESCR COM_AXIS nmot nmot_ub_q40 8 0.00 10200. FORMAT "%5.0" AXIS_PTS_REF SNM08KOUB /end AXIS_DESCR
/end CHARACTERISTIC
/begin CHARACTERISTIC MKLLSCMN "" VALUE 0x8E3F63 KwUb 99.61 rel_q0p39 0.00 99.61 FORMAT "%5.2" /end CHARACTERISTIC
/begin CHARACTERISTIC MRESKH "" VALUE 0x8FEB48 KwUw 99.99847 rel_uw_b100 0.00 99.99847 FORMAT "%8.5" /end CHARACTERISTIC
/begin CHARACTERISTIC MRESLL "" VALUE 0x8FD1B0 KwUb 24.90 rel_ub_b24p9 0.00 24.90 FORMAT "%5.2" /end CHARACTERISTIC
/begin CHARACTERISTIC MRESSL "" VALUE 0x8FEB4A KwUw 99.99847 rel_uw_b100 0.00 99.99847 FORMAT "%8.5" /end CHARACTERISTIC
/begin CHARACTERISTIC NFHZ "" VALUE 0x8E2A44 KwUb 2550. nmot_ub_q10 0.00 2550. FORMAT "%5.0" /end CHARACTERISTIC
/begin CHARACTERISTIC NFHZFS "" VALUE 0x8E2A45 KwUb 2550. nmot_ub_q10 0.00 2550. FORMAT "%5.0" /end CHARACTERISTIC
/begin CHARACTERISTIC NFS2M "" CURVE 0x8E2A46 GklWUb 2550. nmot_ub_q10 0.00 2550. FORMAT "%5.0"
 /begin AXIS_DESCR COM_AXIS tmot temp_ub_q0p75_o48 6 -48.00 143.3 FORMAT "%5.1" AXIS_PTS_REF STM06LLUB /end AXIS_DESCR
/end CHARACTERISTIC
/begin CHARACTERISTIC NFSKLDF "" VALUE 0x8E2A4C KwUb 2550. nmot_ub_q10 0.00 2550. FORMAT "%5.0" /end CHARACTERISTIC
/begin CHARACTERISTIC NFSKO "" VALUE 0x8E2A4D KwUb 2550. nmot_ub_q10 0.00 2550. FORMAT "%5.0" /end CHARACTERISTIC
/begin CHARACTERISTIC NFSKS "" VALUE 0x8E2A4E KwUb 2550. nmot_ub_q10 0.00 2550. FORMAT "%5.0" /end CHARACTERISTIC
/begin CHARACTERISTIC NFSLPWG "" VALUE 0x8E2A4F KwUb 2550. nmot_ub_q10 0.00 2550. FORMAT "%5.0" /end CHARACTERISTIC
/begin CHARACTERISTIC NFSMIN "" VALUE 0x8E2A50 KwUb 2550. nmot_ub_q10 0.00 2550. FORMAT "%5.0" /end CHARACTERISTIC
/begin CHARACTERISTIC NFSNLDG "" VALUE 0x8E2A51 KwUb 2550. nmot_ub_q10 0.00 2550. FORMAT "%5.0" /end CHARACTERISTIC
/begin CHARACTERISTIC NFSNWLL "" VALUE 0x8E2A52 KwUb 2550. nmot_ub_q10 0.00 2550. FORMAT "%5.0" /end CHARACTERISTIC
/begin CHARACTERISTIC NFSSBC "" VALUE 0x8E2A53 KwUb 2550. nmot_ub_q10 0.00 2550. FORMAT "%5.0" /end CHARACTERISTIC
/begin CHARACTERISTIC NFSSL "" VALUE 0x8E2A54 KwUb 2550. nmot_ub_q10 0.00 2550. FORMAT "%5.0" /end CHARACTERISTIC
/begin CHARACTERISTIC NGKRAWN "" CURVE 0x8EB8CC GklWSw 12799.77 nmotg_sw_q0p39 0.00 12799.77 FORMAT "%8.2"
 /begin AXIS_DESCR COM_AXIS nmot nmot_ub_q40 16 0.00 10200. FORMAT "%5.0" AXIS_PTS_REF SNM16KRUB /end AXIS_DESCR
/end CHARACTERISTIC
/begin CHARACTERISTIC NGKRSTMX "" VALUE 0x8FE8F2 KwSw 12799.77 nmotg_sw_q0p39 0.00 12799.77 FORMAT "%8.2" /end CHARACTERISTIC
/begin CHARACTERISTIC NGKRWN "" CURVE 0x8EB8EC GklWSw 12799.77 nmotg_sw_q0p39 0.00 12799.77 FORMAT "%8.2"
 /begin AXIS_DESCR COM_AXIS nmot nmot_ub_q40 16 0.00 10200. FORMAT "%5.0" AXIS_PTS_REF SNM16KRUB /end AXIS_DESCR
/end CHARACTERISTIC
/begin CHARACTERISTIC NGNSNF "" VALUE 0x8E2A55 KwUb 25500. nmotg_ub_q100 0.00 25500. FORMAT "%5.0" /end CHARACTERISTIC
/begin CHARACTERISTIC NKLDF "" VALUE 0x8E2A56 KwUb 2550. nmot_ub_q10 0.00 2550. FORMAT "%5.0" /end CHARACTERISTIC
/begin CHARACTERISTIC NKOACC "" VALUE 0x8E3F64 KwUb 10200. nmot_ub_q40 0.00 10200. FORMAT "%5.0" /end CHARACTERISTIC
/begin CHARACTERISTIC NKOULEV "" VALUE 0x8E3F65 KwUb 10200. nmot_ub_q40 0.00 10200. FORMAT "%5.0" /end CHARACTERISTIC
/begin CHARACTERISTIC NKRAMAX "" VALUE 0x8E2794 KwUb 10200. nmot_ub_q40 0.00 10200. FORMAT "%5.0" /end CHARACTERISTIC
/begin CHARACTERISTIC NKRAMIN "" VALUE 0x8E2795 KwUb 10200. nmot_ub_q40 0.00 10200. FORMAT "%5.0" /end CHARACTERISTIC
/begin CHARACTERISTIC NKRF "" VALUE 0x8E2796 KwUb 10200. nmot_ub_q40 0.00 10200. FORMAT "%5.0" /end CHARACTERISTIC
/begin CHARACTERISTIC NKRMAX "" VALUE 0x8E2797 KwUb 10200. nmot_ub_q40 0.00 10200. FORMAT "%5.0" /end CHARACTERISTIC
/begin CHARACTERISTIC NKRREF "" VALUE 0x8FD08F KwUb 10200. nmot_ub_q40 0.00 10200. FORMAT "%5.0" /end CHARACTERISTIC
/begin CHARACTERISTIC NKRUM "" VALUE 0x8E27CD KwUb 10200. nmot_ub_q40 0.00 10200. FORMAT "%5.0" /end CHARACTERISTIC
/begin CHARACTERISTIC NLL2M "" CURVE 0x8E2A57 GklWUb 2550. nmot_ub_q10 0.00 2550. FORMAT "%5.0"
 /begin AXIS_DESCR COM_AXIS tmot temp_ub_q0p75_o48 6 -48.00 143.3 FORMAT "%5.1" AXIS_PTS_REF STM06LLUB /end AXIS_DESCR
/end CHARACTERISTIC
/begin CHARACTERISTIC NLLCVTMXV "" CURVE 0x8E2A5D KlAUbSstUbWUb 2550. nmot_ub_q10 0.00 2550. FORMAT "%5.0"
 /begin AXIS_DESCR STD_AXIS vfzg vfzg_ub_q1p25 8 0.00 318.8 FORMAT "%5.1" DEPOSIT ABSOLUTE /end AXIS_DESCR
/end CHARACTERISTIC
/begin CHARACTERISTIC NLLMG "" MAP 0x8E2A6E GkfWUb 2550. nmot_ub_q10 0.00 2550. FORMAT "%5.0"
 /begin AXIS_DESCR COM_AXIS tmot temp_ub_q0p75_o48 6 -48.00 143.3 FORMAT "%5.1" AXIS_PTS_REF STM06LLUB /end AXIS_DESCR
 /begin AXIS_DESCR COM_AXIS gangllr dez 8 0.00 255.0 FORMAT "%5.1" AXIS_PTS_REF SGA08LLUB /end AXIS_DESCR
/end CHARACTERISTIC
/begin CHARACTERISTIC NLLMGFS "" MAP 0x8E2A9E GkfWUb 2550. nmot_ub_q10 0.00 2550. FORMAT "%5.0"
 /begin AXIS_DESCR COM_AXIS tmot temp_ub_q0p75_o48 6 -48.00 143.3 FORMAT "%5.1" AXIS_PTS_REF STM06LLUB /end AXIS_DESCR
 /begin AXIS_DESCR COM_AXIS gangllr dez 8 0.00 255.0 FORMAT "%5.1" AXIS_PTS_REF SGA08LLUB /end AXIS_DESCR
/end CHARACTERISTIC
/begin CHARACTERISTIC NLLMIN "" VALUE 0x8E2ACE KwUb 2550. nmot_ub_q10 0.00 2550. FORMAT "%5.0" /end CHARACTERISTIC
/begin CHARACTERISTIC NLLNWDMX "" VALUE 0x8E2ACF KwUb 10200. nmot_ub_q40 0.00 10200. FORMAT "%5.0" /end CHARACTERISTIC
/begin CHARACTERISTIC NM1MN1 "" VALUE 0x8E4C65 KwUb 5100. nmot_ub_q20 0.00 5100. FORMAT "%5.0" /end CHARACTERISTIC
/begin CHARACTERISTIC NM1MN2 "" VALUE 0x8E4C66 KwUb 5100. nmot_ub_q20 0.00 5100. FORMAT "%5.0" /end CHARACTERISTIC
/begin CHARACTERISTIC NM1MN3 "" VALUE 0x8E4C67 KwUb 5100. nmot_ub_q20 0.00 5100. FORMAT "%5.0" /end CHARACTERISTIC
/begin CHARACTERISTIC NM1MX1 "" VALUE 0x8E4C68 KwUb 5100. nmot_ub_q20 0.00 5100. FORMAT "%5.0" /end CHARACTERISTIC
/begin CHARACTERISTIC NM1MX2 "" VALUE 0x8E4C69 KwUb 5100. nmot_ub_q20 0.00 5100. FORMAT "%5.0" /end CHARACTERISTIC
/begin CHARACTERISTIC NM1MX3 "" VALUE 0x8E4C6A KwUb 5100. nmot_ub_q20 0.00 5100. FORMAT "%5.0" /end CHARACTERISTIC
/begin CHARACTERISTIC NM1VMN "" CURVE 0x8E4C6B KlAUbSstUbWUb 5100. nmot_ub_q20 0.00 5100. FORMAT "%5.0"
 /begin AXIS_DESCR STD_AXIS vfzgkmtr vfzg_ub_q1p25 6 0.00 318.8 FORMAT "%5.1" DEPOSIT ABSOLUTE /end AXIS_DESCR
/end CHARACTERISTIC
/begin CHARACTERISTIC NM1VN "" CURVE 0x8E4C78 KlAUbSstUbWUb 5100. nmot_ub_q20 0.00 5100. FORMAT "%5.0"
 /begin AXIS_DESCR STD_AXIS vfzgkmtr vfzg_ub_q1p25 6 0.00 318.8 FORMAT "%5.1" DEPOSIT ABSOLUTE /end AXIS_DESCR
/end CHARACTERISTIC
/begin CHARACTERISTIC NM1VP "" CURVE 0x8E4C85 KlAUbSstUbWUb 5100. nmot_ub_q20 0.00 5100. FORMAT "%5.0"
 /begin AXIS_DESCR STD_AXIS vfzgkmtr vfzg_ub_q1p25 6 0.00 318.8 FORMAT "%5.1" DEPOSIT ABSOLUTE /end AXIS_DESCR
/end CHARACTERISTIC
/begin CHARACTERISTIC NM2MN1 "" VALUE 0x8E4C92 KwUb 5100. nmot_ub_q20 0.00 5100. FORMAT "%5.0" /end CHARACTERISTIC
/begin CHARACTERISTIC NM2MN2 "" VALUE 0x8E4C93 KwUb 5100. nmot_ub_q20 0.00 5100. FORMAT "%5.0" /end CHARACTERISTIC
/begin CHARACTERISTIC NM2MN3 "" VALUE 0x8E4C94 KwUb 5100. nmot_ub_q20 0.00 5100. FORMAT "%5.0" /end CHARACTERISTIC
/begin CHARACTERISTIC NM2MX1 "" VALUE 0x8E4C95 KwUb 5100. nmot_ub_q20 0.00 5100. FORMAT "%5.0" /end CHARACTERISTIC
/begin CHARACTERISTIC NM2MX2 "" VALUE 0x8E4C96 KwUb 5100. nmot_ub_q20 0.00 5100. FORMAT "%5.0" /end CHARACTERISTIC
/begin CHARACTERISTIC NM2MX3 "" VALUE 0x8E4C97 KwUb 5100. nmot_ub_q20 0.00 5100. FORMAT "%5.0" /end CHARACTERISTIC
/begin CHARACTERISTIC NM2VMN "" CURVE 0x8E4C98 KlAUbSstUbWUb 5100. nmot_ub_q20 0.00 5100. FORMAT "%5.0"
 /begin AXIS_DESCR STD_AXIS vfzgkmtr vfzg_ub_q1p25 6 0.00 318.8 FORMAT "%5.1" DEPOSIT ABSOLUTE /end AXIS_DESCR
/end CHARACTERISTIC
/begin CHARACTERISTIC NM2VN "" CURVE 0x8E4CA5 KlAUbSstUbWUb 5100. nmot_ub_q20 0.00 5100. FORMAT "%5.0"
 /begin AXIS_DESCR STD_AXIS vfzgkmtr vfzg_ub_q1p25 6 0.00 318.8 FORMAT "%5.1" DEPOSIT ABSOLUTE /end AXIS_DESCR
/end CHARACTERISTIC
/begin CHARACTERISTIC NM2VP "" CURVE 0x8E4CB2 KlAUbSstUbWUb 5100. nmot_ub_q20 0.00 5100. FORMAT "%5.0"
 /begin AXIS_DESCR STD_AXIS vfzgkmtr vfzg_ub_q1p25 6 0.00 318.8 FORMAT "%5.1" DEPOSIT ABSOLUTE /end AXIS_DESCR
/end CHARACTERISTIC
/begin CHARACTERISTIC NMOTEL "" VALUE 0x8E3F66 KwUb 10200. nmot_ub_q40 0.00 10200. FORMAT "%5.0" /end CHARACTERISTIC
/begin CHARACTERISTIC NMOTZPAUS "" VALUE 0x8E4CBF KwUb 10200. nmot_ub_q40 0.00 10200. FORMAT "%5.0" /end CHARACTERISTIC
/begin CHARACTERISTIC NMOTZPEIN "" VALUE 0x8E4CC0 KwUb 10200. nmot_ub_q40 0.00 10200. FORMAT "%5.0" /end CHARACTERISTIC
/begin CHARACTERISTIC NSAC "" VALUE 0x8E2AD0 KwUb 2550. nmot_ub_q10 0.00 2550. FORMAT "%5.0" /end CHARACTERISTIC
/begin CHARACTERISTIC NSACFS "" VALUE 0x8E2AD1 KwUb 2550. nmot_ub_q10 0.00 2550. FORMAT "%5.0" /end CHARACTERISTIC
/begin CHARACTERISTIC NSHLL "" VALUE 0x8E2AD2 KwUb 2550. nmot_ub_q10 0.00 2550. FORMAT "%5.0" /end CHARACTERISTIC
/begin CHARACTERISTIC NSKO "" VALUE 0x8E2AD3 KwUb 2550. nmot_ub_q10 0.00 2550. FORMAT "%5.0" /end CHARACTERISTIC
/begin CHARACTERISTIC NSKS "" VALUE 0x8E2AD4 KwUb 2550. nmot_ub_q10 0.00 2550. FORMAT "%5.0" /end CHARACTERISTIC
/begin CHARACTERISTIC NSL "" VALUE 0x8E2AD5 KwUb 2550. nmot_ub_q10 0.00 2550. FORMAT "%5.0" /end CHARACTERISTIC
/begin CHARACTERISTIC NSLBZA1 "" VALUE 0x8E2AD6 KwUb 2550. nmot_ub_q10 0.00 2550. FORMAT "%5.0" /end CHARACTERISTIC
/begin CHARACTERISTIC NSLBZA2 "" VALUE 0x8E2AD7 KwUb 2550. nmot_ub_q10 0.00 2550. FORMAT "%5.0" /end CHARACTERISTIC
/begin CHARACTERISTIC NSLBZA3 "" VALUE 0x8E2AD8 KwUb 2550. nmot_ub_q10 0.00 2550. FORMAT "%5.0" /end CHARACTERISTIC
/begin CHARACTERISTIC NSLBZFS "" VALUE 0x8E2AD9 KwUb 2550. nmot_ub_q10 0.00 2550. FORMAT "%5.0" /end CHARACTERISTIC
/begin CHARACTERISTIC NSLBZFS1 "" VALUE 0x8E2ADA KwUb 2550. nmot_ub_q10 0.00 2550. FORMAT "%5.0" /end CHARACTERISTIC
/begin CHARACTERISTIC NSLBZFS2 "" VALUE 0x8E2ADB KwUb 2550. nmot_ub_q10 0.00 2550. FORMAT "%5.0" /end CHARACTERISTIC
/begin CHARACTERISTIC NSLBZLL "" VALUE 0x8E2ADC KwUb 2550. nmot_ub_q10 0.00 2550. FORMAT "%5.0" /end CHARACTERISTIC
/begin CHARACTERISTIC NSLBZLL1 "" VALUE 0x8E2ADD KwUb 2550. nmot_ub_q10 0.00 2550. FORMAT "%5.0" /end CHARACTERISTIC
/begin CHARACTERISTIC NSLBZLL2 "" VALUE 0x8E2ADE KwUb 2550. nmot_ub_q10 0.00 2550. FORMAT "%5.0" /end CHARACTERISTIC
/begin CHARACTERISTIC NSLBZS "" VALUE 0x8E2ADF KwUb 10200. nmot_ub_q40 0.00 10200. FORMAT "%5.0" /end CHARACTERISTIC
/begin CHARACTERISTIC NSLFAA "" VALUE 0x8E2F33 KwUb 2550. nmot_ub_q10 0.00 2550. FORMAT "%5.0" /end CHARACTERISTIC
/begin CHARACTERISTIC NSLFADY "" VALUE 0x8E2F34 KwUb 2550. nmot_ub_q10 0.00 2550. FORMAT "%5.0" /end CHARACTERISTIC
/begin CHARACTERISTIC NSLFAEZLA "" VALUE 0x8E2F35 KwUb 2550. nmot_ub_q10 0.00 2550. FORMAT "%5.0" /end CHARACTERISTIC
/begin CHARACTERISTIC NSLFAKAT "" VALUE 0x8E2F36 KwUb 2550. nmot_ub_q10 0.00 2550. FORMAT "%5.0" /end CHARACTERISTIC
/begin CHARACTERISTIC NSLFAKRS "" VALUE 0x8E2F37 KwUb 2550. nmot_ub_q10 0.00 2550. FORMAT "%5.0" /end CHARACTERISTIC
/begin CHARACTERISTIC NSLFALDP "" VALUE 0x8E2F38 KwUb 2550. nmot_ub_q10 0.00 2550. FORMAT "%5.0" /end CHARACTERISTIC
/begin CHARACTERISTIC NSLFALSF "" VALUE 0x8E2F39 KwUb 2550. nmot_ub_q10 0.00 2550. FORMAT "%5.0" /end CHARACTERISTIC
/begin CHARACTERISTIC NSLFALSV "" VALUE 0x8E2F3A KwUb 2550. nmot_ub_q10 0.00 2550. FORMAT "%5.0" /end CHARACTERISTIC
/begin CHARACTERISTIC NSLFANWKW "" VALUE 0x8E2F3B KwUb 2550. nmot_ub_q10 0.00 2550. FORMAT "%5.0" /end CHARACTERISTIC
/begin CHARACTERISTIC NSLFASF "" VALUE 0x8E2F3C KwUb 2550. nmot_ub_q10 0.00 2550. FORMAT "%5.0" /end CHARACTERISTIC
/begin CHARACTERISTIC NSLFASH "" VALUE 0x8E2F3D KwUb 2550. nmot_ub_q10 0.00 2550. FORMAT "%5.0" /end CHARACTERISTIC
/begin CHARACTERISTIC NSLFASHV "" VALUE 0x8E2F3E KwUb 2550. nmot_ub_q10 0.00 2550. FORMAT "%5.0" /end CHARACTERISTIC
/begin CHARACTERISTIC NSLFASKNO "" VALUE 0x8E2F3F KwUb 2550. nmot_ub_q10 0.00 2550. FORMAT "%5.0" /end CHARACTERISTIC
/begin CHARACTERISTIC NSLFASLS "" VALUE 0x8E2F40 KwUb 2550. nmot_ub_q10 0.00 2550. FORMAT "%5.0" /end CHARACTERISTIC
/begin CHARACTERISTIC NSLFATES "" VALUE 0x8E2F41 KwUb 2550. nmot_ub_q10 0.00 2550. FORMAT "%5.0" /end CHARACTERISTIC
/begin CHARACTERISTIC NSLFATPE "" VALUE 0x8E2F42 KwUb 2550. nmot_ub_q10 0.00 2550. FORMAT "%5.0" /end CHARACTERISTIC
/begin CHARACTERISTIC NSLFAWSA "" VALUE 0x8E2F43 KwUb 2550. nmot_ub_q10 0.00 2550. FORMAT "%5.0" /end CHARACTERISTIC
/begin CHARACTERISTIC NSLFAWSE "" VALUE 0x8E2F44 KwUb 2550. nmot_ub_q10 0.00 2550. FORMAT "%5.0" /end CHARACTERISTIC
/begin CHARACTERISTIC NSLKVS "" VALUE 0x8E2F45 KwUb 2550. nmot_ub_q10 0.00 2550. FORMAT "%5.0" /end CHARACTERISTIC
/begin CHARACTERISTIC NSLLSH "" VALUE 0x8E2F46 KwUb 2550. nmot_ub_q10 0.00 2550. FORMAT "%5.0" /end CHARACTERISTIC
/begin CHARACTERISTIC NSLNWMX "" VALUE 0x8E2AE0 KwUb 2550. nmot_ub_q10 0.00 2550. FORMAT "%5.0" /end CHARACTERISTIC
/begin CHARACTERISTIC NSLPP "" CURVE 0x8E2AE1 KlAUbSstUbWUb 2550. nmot_ub_q10 0.00 2550. FORMAT "%5.0"
 /begin AXIS_DESCR STD_AXIS psl dez 4 0.00 255.0 FORMAT "%5.1" DEPOSIT ABSOLUTE /end AXIS_DESCR
/end CHARACTERISTIC
/begin CHARACTERISTIC NSLPPFS "" CURVE 0x8E2AEA KlAUbSstUbWUb 2550. nmot_ub_q10 0.00 2550. FORMAT "%5.0"
 /begin AXIS_DESCR STD_AXIS psl dez 4 0.00 255.0 FORMAT "%5.1" DEPOSIT ABSOLUTE /end AXIS_DESCR
/end CHARACTERISTIC
/begin CHARACTERISTIC NSLPWG "" VALUE 0x8E2AF3 KwUb 2550. nmot_ub_q10 0.00 2550. FORMAT "%5.0" /end CHARACTERISTIC
/begin CHARACTERISTIC NSNLDG "" VALUE 0x8E2AF4 KwUb 2550. nmot_ub_q10 0.00 2550. FORMAT "%5.0" /end CHARACTERISTIC
/begin CHARACTERISTIC NSNOT "" VALUE 0x8E2AF5 KwUb 2550. nmot_ub_q10 0.00 2550. FORMAT "%5.0" /end CHARACTERISTIC
/begin CHARACTERISTIC NSNWLL "" VALUE 0x8E2AF6 KwUb 2550. nmot_ub_q10 0.00 2550. FORMAT "%5.0" /end CHARACTERISTIC
/begin CHARACTERISTIC NSNWNA "" VALUE 0x8E2AF7 KwUb 2550. nmot_ub_q10 0.00 2550. FORMAT "%5.0" /end CHARACTERISTIC
/begin CHARACTERISTIC NSOLMX "" VALUE 0x8E2AF8 KwUb 2550. nmot_ub_q10 0.00 2550. FORMAT "%5.0" /end CHARACTERISTIC
/begin CHARACTERISTIC NSTNMKMTR "" VALUE 0x8E4CC1 KwUb 10200. nmot_ub_q40 0.00 10200. FORMAT "%5.0" /end CHARACTERISTIC
/begin CHARACTERISTIC NSTOEL "" CURVE 0x8EBBAC KlAUbSstUwWUb 2550. nmot_ub_q10 0.00 2550. FORMAT "%5.0"
 /begin AXIS_DESCR STD_AXIS toelk_w temp_q0p0234_o273 8 -273.1500 1262.827 FORMAT "%8.3" DEPOSIT ABSOLUTE /end AXIS_DESCR
/end CHARACTERISTIC
/begin CHARACTERISTIC NTIPLL "" VALUE 0x8E2AF9 KwUb 8680. nmot_ub_q40 1520. 10200. FORMAT "%5.0" /end CHARACTERISTIC
/begin CHARACTERISTIC NZHDTL "" CURVE 0x8E2AFA KlAUbSstUbWUb 10200. nmot_ub_q40 0.00 10200. FORMAT "%5.0"
 /begin AXIS_DESCR STD_AXIS rl rel_ub_q0p75 6 0.00 191.3 FORMAT "%5.1" DEPOSIT ABSOLUTE /end AXIS_DESCR
/end CHARACTERISTIC
/begin CHARACTERISTIC NZHITL "" CURVE 0x8E2B07 KlAUbSstUbWUb 10200. nmot_ub_q40 0.00 10200. FORMAT "%5.0"
 /begin AXIS_DESCR STD_AXIS rl rel_ub_q0p75 6 0.00 191.3 FORMAT "%5.1" DEPOSIT ABSOLUTE /end AXIS_DESCR
/end CHARACTERISTIC
/begin CHARACTERISTIC PKLIHDV "" VALUE 0x8E4CC2 KwUb 51.00 p_q0p2 0.00 51.00 FORMAT "%5.2" /end CHARACTERISTIC
/begin CHARACTERISTIC PKLIMA "" CURVE 0x8E4CC3 KlAUbSstUbWUb 51.00 p_q0p2 0.00 51.00 FORMAT "%5.2"
 /begin AXIS_DESCR STD_AXIS takols dez 5 0.00 255.0 FORMAT "%5.1" DEPOSIT ABSOLUTE /end AXIS_DESCR
/end CHARACTERISTIC
/begin CHARACTERISTIC PKODR "" VALUE 0x8E4CCE KwUb 51.00 p_q0p2 0.00 51.00 FORMAT "%5.2" /end CHARACTERISTIC
/begin CHARACTERISTIC PKODRCMX "" VALUE 0x8E3F67 KwUb 51.00 p_q0p2 0.00 51.00 FORMAT "%5.2" /end CHARACTERISTIC
/begin CHARACTERISTIC PVDNHOM "" CURVE 0x8E2BB5 GklWUb 0.3891 fak_q0p00153 0.00 0.3891
 /begin AXIS_DESCR COM_AXIS dn_w nmot_sw_q0p25 10 -8192.000 8191.750 FORMAT "%8.3" AXIS_PTS_REF SDN10LLSW /end AXIS_DESCR
/end CHARACTERISTIC
/begin CHARACTERISTIC PVDNHOMV "" CURVE 0x8E2BBF GklWUb 0.3891 fak_q0p00153 0.00 0.3891
 /begin AXIS_DESCR COM_AXIS dn_w nmot_sw_q0p25 10 -8192.000 8191.750 FORMAT "%8.3" AXIS_PTS_REF SDN10LLSW /end AXIS_DESCR
/end CHARACTERISTIC
/begin CHARACTERISTIC PVDNKH "" CURVE 0x8EBC64 KlAUbSstSbWUb 0.3891 fak_q0p00153 0.00 0.3891
 /begin AXIS_DESCR STD_AXIS dns nmotd_sb_q10 10 -1280. 1270. FORMAT "%5.0" DEPOSIT ABSOLUTE /end AXIS_DESCR
/end CHARACTERISTIC
/begin CHARACTERISTIC PVDNST "" CURVE 0x8E2BC9 GklWUb 0.3891 fak_q0p00153 0.00 0.3891
 /begin AXIS_DESCR COM_AXIS dn_w nmot_sw_q0p25 10 -8192.000 8191.750 FORMAT "%8.3" AXIS_PTS_REF SDN10LLSW /end AXIS_DESCR
/end CHARACTERISTIC
/begin CHARACTERISTIC PVLDNEZ "" MAP 0x8E2BD3 GkfWUb 0.3891 fak_q0p00153 0.00 0.3891
 /begin AXIS_DESCR COM_AXIS dn_w nmot_sw_q0p25 10 -8192.000 8191.750 FORMAT "%8.3" AXIS_PTS_REF SDN10LLSW /end AXIS_DESCR
 /begin AXIS_DESCR COM_AXIS etazws rel_ub_b127p5 4 0.00 127.5 FORMAT "%5.1" AXIS_PTS_REF SEZ04LLUB /end AXIS_DESCR
/end CHARACTERISTIC
/begin CHARACTERISTIC PVLDNEZKH "" MAP 0x8E2BFB GkfWUb 0.3891 fak_q0p00153 0.00 0.3891
 /begin AXIS_DESCR COM_AXIS dn_w nmot_sw_q0p25 10 -8192.000 8191.750 FORMAT "%8.3" AXIS_PTS_REF SDN10LLSW /end AXIS_DESCR
 /begin AXIS_DESCR COM_AXIS etazws rel_ub_b127p5 4 0.00 127.5 FORMAT "%5.1" AXIS_PTS_REF SEZ04LLUB /end AXIS_DESCR
/end CHARACTERISTIC
/begin CHARACTERISTIC PVLDNEZV "" MAP 0x8E2C23 GkfWUb 0.3891 fak_q0p00153 0.00 0.3891
 /begin AXIS_DESCR COM_AXIS dn_w nmot_sw_q0p25 10 -8192.000 8191.750 FORMAT "%8.3" AXIS_PTS_REF SDN10LLSW /end AXIS_DESCR
 /begin AXIS_DESCR COM_AXIS etazws rel_ub_b127p5 4 0.00 127.5 FORMAT "%5.1" AXIS_PTS_REF SEZ04LLUB /end AXIS_DESCR
/end CHARACTERISTIC
/begin CHARACTERISTIC PZWKRA "" VALUE 0x8FD0C5 KwUb 99.61 rel_ub_b99p6 0.00 99.61 FORMAT "%5.2" /end CHARACTERISTIC
/begin CHARACTERISTIC QKLIHDV "" VALUE 0x8E4CCF KwUb 191.3 rel_ub_q0p75_o48 -48.00 143.3 FORMAT "%5.1" /end CHARACTERISTIC
/begin CHARACTERISTIC QKLILU1 "" VALUE 0x8E4CD0 KwUb 191.3 rel_ub_q0p75_o48 -48.00 143.3 FORMAT "%5.1" /end CHARACTERISTIC
/begin CHARACTERISTIC QKLILU2 "" VALUE 0x8E4CD1 KwUb 191.3 rel_ub_q0p75_o48 -48.00 143.3 FORMAT "%5.1" /end CHARACTERISTIC
/begin CHARACTERISTIC QKLIMAMX "" VALUE 0x8E4CD2 KwUb 191.3 rel_ub_q0p75_o48 -48.00 143.3 FORMAT "%5.1" /end CHARACTERISTIC
/begin CHARACTERISTIC QMAXL1INI "" VALUE 0x8E4CD3 KwUb 191.3 rel_ub_q0p75_o48 -48.00 143.3 FORMAT "%5.1" /end CHARACTERISTIC
/begin CHARACTERISTIC QMAXL2INI "" VALUE 0x8E4CD4 KwUb 191.3 rel_ub_q0p75_o48 -48.00 143.3 FORMAT "%5.1" /end CHARACTERISTIC
/begin CHARACTERISTIC QMRAHO "" VALUE 0x8E4CD5 KwUb 191.3 rel_ub_q0p75_o48 -48.00 143.3 FORMAT "%5.1" /end CHARACTERISTIC
/begin CHARACTERISTIC QMRAHU "" VALUE 0x8E4CD6 KwUb 191.3 rel_ub_q0p75_o48 -48.00 143.3 FORMAT "%5.1" /end CHARACTERISTIC
/begin CHARACTERISTIC QMRATUMG "" CURVE 0x8E4CD7 KlAUbSstUbWUb 191.3 rel_ub_q0p75_o48 -48.00 143.3 FORMAT "%5.1"
 /begin AXIS_DESCR STD_AXIS tumgkmtr temp_ub_q0p75_o48 5 -48.00 143.3 FORMAT "%5.1" DEPOSIT ABSOLUTE /end AXIS_DESCR
/end CHARACTERISTIC
/begin CHARACTERISTIC QTKWAIK "" VALUE 0x8E4CE2 KwUb 254.996 zk1sxs_ub_b255 1.00392 256.000 FORMAT "%7.3" /end CHARACTERISTIC
/begin CHARACTERISTIC QTKWAIMN "" VALUE 0x8E4CE3 KwSb 191.3 rel_sb_q0p75 -96.00 95.25 FORMAT "%5.2" /end CHARACTERISTIC
/begin CHARACTERISTIC QTKWAIMX "" VALUE 0x8E4CE4 KwSb 191.3 rel_sb_q0p75 -96.00 95.25 FORMAT "%5.2" /end CHARACTERISTIC
/begin CHARACTERISTIC REFINI "" VALUE 0x8FD090 KwUb 0.7227 spg_ub_b5 0.2930 1.016 FORMAT "%5.3" /end CHARACTERISTIC
/begin CHARACTERISTIC RKRMX1N "" CURVE 0x8E2692 GklWUb 317.500 spg_ub_b320 1.25000 318.750
 /begin AXIS_DESCR COM_AXIS nmot nmot_ub_q40 16 0.00 10200. FORMAT "%5.0" AXIS_PTS_REF SNM16KRUB /end AXIS_DESCR
/end CHARACTERISTIC
/begin CHARACTERISTIC RKRMX2N "" CURVE 0x8E26A2 GklWUb 317.500 spg_ub_b320 1.25000 318.750
 /begin AXIS_DESCR COM_AXIS nmot nmot_ub_q40 16 0.00 10200. FORMAT "%5.0" AXIS_PTS_REF SNM16KRUB /end AXIS_DESCR
/end CHARACTERISTIC
/begin CHARACTERISTIC RLLAMMN "" CURVE 0x8E1E96 GklWUb 191.3 rel_ub_q0p75 0.00 191.3 FORMAT "%5.1"
 /begin AXIS_DESCR COM_AXIS nmot nmot_ub_q40 6 0.00 10200. FORMAT "%5.0" AXIS_PTS_REF SNM06GKUB /end AXIS_DESCR
/end CHARACTERISTIC
/begin AXIS_PTS SDN10LLSW "" 0x8EBC7A dn_w SstASwSstSw 16383.75 nmot_sw_q0p25 10 -8192.000 8191.750 FORMAT "%8.3" DEPOSIT ABSOLUTE /end AXIS_PTS
/begin AXIS_PTS SDZ06GKUB "" 0x8E1E9C dzwlamfaw SstAUbSstUb 191.3 zw_ub_qn0p75 6 -191.3 0.00 FORMAT "%5.1" DEPOSIT ABSOLUTE /end AXIS_PTS
/begin AXIS_PTS SEZ04LLUB "" 0x8E2C4B etazws SstAUbSstUb 127.5 rel_ub_b127p5 4 0.00 127.5 FORMAT "%5.1" DEPOSIT ABSOLUTE /end AXIS_PTS
/begin AXIS_PTS SGA08LLUB "" 0x8E2B14 gangllr SstAUbSstUb 255.0 dez 8 0.00 255.0 FORMAT "%5.1" DEPOSIT ABSOLUTE /end AXIS_PTS
/begin AXIS_PTS SMI04LLUB "" 0x8E5A2A mifa_w SstAUwSstUw 99.99847 rel_uw_b100 4 0.00 99.99847 FORMAT "%8.5" DEPOSIT ABSOLUTE /end AXIS_PTS
/begin AXIS_PTS SNG06LLSB "" 0x8E01D9 ngfil SstAUbSstSb 25500. nmotg_sb_q100 6 -12800. 12700. FORMAT "%5.0" DEPOSIT ABSOLUTE /end AXIS_PTS
/begin AXIS_PTS SNM06GKUB "" 0x8E1EA3 nmot SstAUbSstUb 10200. nmot_ub_q40 6 0.00 10200. FORMAT "%5.0" DEPOSIT ABSOLUTE /end AXIS_PTS
/begin AXIS_PTS SNM06LLUB "" 0x8E5A34 nmot_w SstAUwSstUw 16383.75 nmot_uw_q0p25 6 0.00 16383.75 FORMAT "%8.2" DEPOSIT ABSOLUTE /end AXIS_PTS
/begin AXIS_PTS SNM08KOUB "" 0x8E3F93 nmot SstAUbSstUb 10200. nmot_ub_q40 8 0.00 10200. FORMAT "%5.0" DEPOSIT ABSOLUTE /end AXIS_PTS
/begin AXIS_PTS SNM16GKUB "" 0x8E2327 nmot SstAUbSstUb 10200. nmot_ub_q40 16 0.00 10200. FORMAT "%5.0" DEPOSIT ABSOLUTE /end AXIS_PTS
/begin AXIS_PTS SNM16KRDYUB "" 0x8E010A nmot SstAUbSstUb 10200. nmot_ub_q40 16 0.00 10200. FORMAT "%5.0" DEPOSIT ABSOLUTE /end AXIS_PTS
/begin AXIS_PTS SNM16KRUB "" 0x8E011B nmot SstAUbSstUb 10200. nmot_ub_q40 16 0.00 10200. FORMAT "%5.0" DEPOSIT ABSOLUTE /end AXIS_PTS
/begin AXIS_PTS SNS06LLSB "" 0x8E2B1D dns SstAUbSstSb 2550. nmotd_sb_q10 6 -1280. 1270. FORMAT "%5.0" DEPOSIT ABSOLUTE /end AXIS_PTS
/begin AXIS_PTS SNS206LLSB "" 0x8E2C50 dns SstAUbSstSb 2550. nmotd_sb_q10 6 -1280. 1270. FORMAT "%5.0" DEPOSIT ABSOLUTE /end AXIS_PTS
/begin CHARACTERISTIC SRKTEVS "" VALUE 0x8FD198 KwUb 5.080 t20msxs_ub_b5p1 0.02000 5.100 FORMAT "%5.3" /end CHARACTERISTIC
/begin AXIS_PTS SRL03KRUB "" 0x8E012C rl SstAUbSstUb 191.3 rel_ub_q0p75 3 0.00 191.3 FORMAT "%5.1" DEPOSIT ABSOLUTE /end AXIS_PTS
/begin AXIS_PTS SRL06GKUB "" 0x8E1EAA rl SstAUbSstUb 191.3 rel_ub_q0p75 6 0.00 191.3 FORMAT "%5.1" DEPOSIT ABSOLUTE /end AXIS_PTS
/begin AXIS_PTS SRL06KRUB "" 0x8E0135 rl SstAUbSstUb 191.3 rel_ub_q0p75 6 0.00 191.3 FORMAT "%5.1" DEPOSIT ABSOLUTE /end AXIS_PTS
/begin AXIS_PTS SRL12GKUW "" 0x8EADAE rl_w SstAUwSstUw 1535.977 rel_uw_q0p0234 12 0.00 1535.977 FORMAT "%8.3" DEPOSIT ABSOLUTE /end AXIS_PTS
/begin AXIS_PTS STA04LLUB "" 0x8E5AA0 tans SstAUwSstUw 191.3 temp_ub_q0p75_o48 4 -48.00 143.3 FORMAT "%5.1" DEPOSIT ABSOLUTE /end AXIS_PTS
/begin AXIS_PTS STM04SAUB "" 0x8E0262 tmot SstAUbSstUb 191.3 temp_ub_q0p75_o48 4 -48.00 143.3 FORMAT "%5.1" DEPOSIT ABSOLUTE /end AXIS_PTS
/begin AXIS_PTS STM06LLUB "" 0x8E0182 tmot SstAUbSstUb 191.3 temp_ub_q0p75_o48 6 -48.00 143.3 FORMAT "%5.1" DEPOSIT ABSOLUTE /end AXIS_PTS
/begin AXIS_PTS STM08GKUB "" 0x8E1EB1 tmot SstAUbSstUb 191.3 temp_ub_q0p75_o48 8 -48.00 143.3 FORMAT "%5.1" DEPOSIT ABSOLUTE /end AXIS_PTS
/begin AXIS_PTS STM12ESUB "" 0x8E0279 tmot SstAUbSstUb 191.3 temp_ub_q0p75_o48 12 -48.00 143.3 FORMAT "%5.1" DEPOSIT ABSOLUTE /end AXIS_PTS
/begin AXIS_PTS STN06LLUB "" 0x8E01B5 tnst SstAUbSstUb 255.0 t1sxs_ub_b255 6 0.00 255.0 FORMAT "%5.1" DEPOSIT ABSOLUTE /end AXIS_PTS
/begin AXIS_PTS STS05DTKA "" 0x8E4CE5 dtmtka SstAUbSstSb 191.3 temp_sb_q0p75 5 -96.00 95.25 FORMAT "%5.2" DEPOSIT ABSOLUTE /end AXIS_PTS
/begin AXIS_PTS STS05DTTS "" 0x8E4CEB dkmts SstAUbSstSb 191.3 temp_sb_q0p75 5 -96.00 95.25 FORMAT "%5.2" DEPOSIT ABSOLUTE /end AXIS_PTS
/begin AXIS_PTS STS12ESUB "" 0x8E028F tmst SstAUbSstUb 191.3 temp_ub_q0p75_o48 12 -48.00 143.3 FORMAT "%5.1" DEPOSIT ABSOLUTE /end AXIS_PTS
/begin CHARACTERISTIC TABGBTS "" VALUE 0x8EADC8 KwUw 1279.980 temp_uw_q0p0195_o50 -50.00000 1229.980 FORMAT "%8.3" /end CHARACTERISTIC
/begin CHARACTERISTIC TAHLL "" VALUE 0x8E2B24 KwUb 191.3 temp_ub_q0p75_o48 -48.00 143.3 FORMAT "%5.1" /end CHARACTERISTIC
/begin CHARACTERISTIC TANSKO "" VALUE 0x8E2B25 KwUb 191.3 temp_ub_q0p75_o48 -48.00 143.3 FORMAT "%5.1" /end CHARACTERISTIC
/begin CHARACTERISTIC TANSKOB "" VALUE 0x8E3F68 KwUb 191.3 temp_ub_q0p75_o48 -48.00 143.3 FORMAT "%5.1" /end CHARACTERISTIC
/begin CHARACTERISTIC TDLAMBTS "" VALUE 0x8EADCA KwUw 6553.500 t100msxs_uw_b6553p5 0.00 6553.500 FORMAT "%8.3" /end CHARACTERISTIC
/begin CHARACTERISTIC TDMRESLL "" VALUE 0x8FD1B1 KwUb 51.00 t200msxs_ub_b51 0.00 51.00 FORMAT "%5.2" /end CHARACTERISTIC
/begin CHARACTERISTIC TETRST "" VALUE 0x8E4CF1 KwUb 51.00 t200msxs_ub_b51 0.00 51.00 FORMAT "%5.2" /end CHARACTERISTIC
/begin CHARACTERISTIC TFADELAY "" VALUE 0x8F13FA KwUw 765.0000 t1sxs_uw_b65535 0.00 765.0000 FORMAT "%8.4" /end CHARACTERISTIC
/begin CHARACTERISTIC TFLZLR "" VALUE 0x8E4CF2 KwUb 25.50 t100msxs_ub_b25p5 0.00 25.50 FORMAT "%5.2" /end CHARACTERISTIC
/begin CHARACTERISTIC TFQMRA "" VALUE 0x8E4CF3 KwUb 254.996 zk1sxs_ub_b255 1.00392 256.000 FORMAT "%7.3" /end CHARACTERISTIC
/begin CHARACTERISTIC TFTABG "" VALUE 0x8E4CF4 KwUb 254.996 zk1sxs_ub_b255 1.00392 256.000 FORMAT "%7.3" /end CHARACTERISTIC
/begin CHARACTERISTIC TGGLS "" VALUE 0x8E0C91 KwUb 2.000 t1msxms_q1 3.000 5.000 FORMAT "%5.3" /end CHARACTERISTIC
/begin CHARACTERISTIC TIKATBTS "" VALUE 0x8EADCC KwUw 1279.980 temp_uw_q0p0195_o50 -50.00000 1229.980 FORMAT "%8.3" /end CHARACTERISTIC
/begin CHARACTERISTIC TKAETRO "" VALUE 0x8E4CF5 KwUb 191.3 temp_ub_q0p75_o48 -48.00 143.3 FORMAT "%5.1" /end CHARACTERISTIC
/begin CHARACTERISTIC TKAETRU "" VALUE 0x8E4CF6 KwUb 191.3 temp_ub_q0p75_o48 -48.00 143.3 FORMAT "%5.1" /end CHARACTERISTIC
/begin CHARACTERISTIC TKAEW "" VALUE 0x8E4CF7 KwUb 191.3 temp_ub_q0p75_o48 -48.00 143.3 FORMAT "%5.1" /end CHARACTERISTIC
/begin CHARACTERISTIC TKAINI "" VALUE 0x8E4CF8 KwUb 191.3 temp_ub_q0p75_o48 -48.00 143.3 FORMAT "%5.1" /end CHARACTERISTIC
/begin CHARACTERISTIC TKATBTS "" VALUE 0x8EADCE KwUw 1279.980 temp_uw_q0p0195_o50 -50.00000 1229.980 FORMAT "%8.3" /end CHARACTERISTIC
/begin CHARACTERISTIC TKATVLSMN "" VALUE 0x8E4CF9 KwUb 191.3 temp_ub_q0p75_o48 -48.00 143.3 FORMAT "%5.1" /end CHARACTERISTIC
/begin CHARACTERISTIC TKATVLSMX "" VALUE 0x8E4CFA KwUb 191.3 temp_ub_q0p75_o48 -48.00 143.3 FORMAT "%5.1" /end CHARACTERISTIC
/begin CHARACTERISTIC TKLIHDV "" VALUE 0x8E4CFB KwUb 255.0 t1sxs_ub_b255 0.00 255.0 FORMAT "%5.1" /end CHARACTERISTIC
/begin CHARACTERISTIC TKOAMAD "" VALUE 0x8E3F69 KwUb 51.00 t200msxs_ub_b51 0.00 51.00 FORMAT "%5.2" /end CHARACTERISTIC
/begin CHARACTERISTIC TKOAMNN "" CURVE 0x8F10EC GklWUw 1310.700 t20msxs_uw_b1310 0.00 1310.700 FORMAT "%8.3"
 /begin AXIS_DESCR COM_AXIS nmot nmot_ub_q40 8 0.00 10200. FORMAT "%5.0" AXIS_PTS_REF SNM08KOUB /end AXIS_DESCR
/end CHARACTERISTIC
/begin CHARACTERISTIC TKOAMXN "" CURVE 0x8E3F9C GklWUb 51.00 t200msxs_ub_b51 0.00 51.00 FORMAT "%5.2"
 /begin AXIS_DESCR COM_AXIS nmot nmot_ub_q40 8 0.00 10200. FORMAT "%5.0" AXIS_PTS_REF SNM08KOUB /end AXIS_DESCR
/end CHARACTERISTIC
/begin CHARACTERISTIC TKOBEMNN "" CURVE 0x8F10FC GklWUw 1310.700 t20msxs_uw_b1310 0.00 1310.700 FORMAT "%8.3"
 /begin AXIS_DESCR COM_AXIS nmot nmot_ub_q40 8 0.00 10200. FORMAT "%5.0" AXIS_PTS_REF SNM08KOUB /end AXIS_DESCR
/end CHARACTERISTIC
/begin CHARACTERISTIC TKODPAMNN "" CURVE 0x8E3FA4 GklWUb 51.00 t200msxs_ub_b51 0.00 51.00 FORMAT "%5.2"
 /begin AXIS_DESCR COM_AXIS nmot nmot_ub_q40 8 0.00 10200. FORMAT "%5.0" AXIS_PTS_REF SNM08KOUB /end AXIS_DESCR
/end CHARACTERISTIC
/begin CHARACTERISTIC TKODPAMXN "" CURVE 0x8E3FAC GklWUb 51.00 t200msxs_ub_b51 0.00 51.00 FORMAT "%5.2"
 /begin AXIS_DESCR COM_AXIS nmot nmot_ub_q40 8 0.00 10200. FORMAT "%5.0" AXIS_PTS_REF SNM08KOUB /end AXIS_DESCR
/end CHARACTERISTIC
/begin CHARACTERISTIC TKOEMNN "" CURVE 0x8E3FB4 GklWUb 51.00 t200msxs_ub_b51 0.00 51.00 FORMAT "%5.2"
 /begin AXIS_DESCR COM_AXIS nmot nmot_ub_q40 8 0.00 10200. FORMAT "%5.0" AXIS_PTS_REF SNM08KOUB /end AXIS_DESCR
/end CHARACTERISTIC
/begin CHARACTERISTIC TKOEV "" VALUE 0x8E3F6A KwUb 10.20 t40msxs_ub_q0p04 0.00 10.20 FORMAT "%5.2" /end CHARACTERISTIC
/begin CHARACTERISTIC TKOFREEZE "" VALUE 0x8E3F6B KwUb 5.100 t20msxs_ub_b5p1 0.00 5.100 FORMAT "%5.3" /end CHARACTERISTIC
/begin CHARACTERISTIC TKOROFF "" VALUE 0x8E4CFC KwUb 255.0 t1sxs_ub_b255 0.00 255.0 FORMAT "%5.1" /end CHARACTERISTIC
/begin CHARACTERISTIC TKORON "" VALUE 0x8E4CFD KwUb 255.0 t1sxs_ub_b255 0.00 255.0 FORMAT "%5.1" /end CHARACTERISTIC
/begin CHARACTERISTIC TKOTMSK "" VALUE 0x8F10E6 KwUw 1310.700 t20msxs_uw_q0p02 0.00 1310.700 FORMAT "%8.3" /end CHARACTERISTIC
/begin CHARACTERISTIC TKOVKO "" VALUE 0x8E3F6C KwUb 5.100 t20msxs_ub_b5p1 0.00 5.100 FORMAT "%5.3" /end CHARACTERISTIC
/begin CHARACTERISTIC TKOWPAMNN "" CURVE 0x8E3FBC GklWUb 51.00 t200msxs_ub_b51 0.00 51.00 FORMAT "%5.2"
 /begin AXIS_DESCR COM_AXIS nmot nmot_ub_q40 8 0.00 10200. FORMAT "%5.0" AXIS_PTS_REF SNM08KOUB /end AXIS_DESCR
/end CHARACTERISTIC
/begin CHARACTERISTIC TKOWPAMXN "" CURVE 0x8E3FC4 GklWUb 51.00 t200msxs_ub_b51 0.00 51.00 FORMAT "%5.2"
 /begin AXIS_DESCR COM_AXIS nmot nmot_ub_q40 8 0.00 10200. FORMAT "%5.0" AXIS_PTS_REF SNM08KOUB /end AXIS_DESCR
/end CHARACTERISTIC
/begin CHARACTERISTIC TKOWPEDDEL "" VALUE 0x8E3F6D KwUb 5.100 t20msxs_ub_b5p1 0.00 5.100 FORMAT "%5.3" /end CHARACTERISTIC
/begin CHARACTERISTIC TLAFA "" VALUE 0x8E1EBA KwUb 25.50 t100msxs_ub_b25p5 0.00 25.50 FORMAT "%5.2" /end CHARACTERISTIC
/begin CHARACTERISTIC TLUEKT1 "" VALUE 0x8F13FC KwUw 761.03488372 zk1sxs_uw_b65535 1.0000000000 762.03488372 FORMAT "%12.8" /end CHARACTERISTIC
/begin CHARACTERISTIC TLUEKT2 "" VALUE 0x8F13FE KwUw 770.81176471 zk200msxs_uw_b13107 0.20000000000 771.01176471 FORMAT "%12.8" /end CHARACTERISTIC
/begin CHARACTERISTIC TLUEST "" VALUE 0x8E4CFE KwUb 51.00 t200msxs_ub_b51 0.00 51.00 FORMAT "%5.2" /end CHARACTERISTIC
/begin CHARACTERISTIC TMDYNA "" VALUE 0x8FD0C6 KwUb 191.3 temp_ub_q0p75_o48 -48.00 143.3 FORMAT "%5.1" /end CHARACTERISTIC
/begin CHARACTERISTIC TMEWKMTR "" VALUE 0x8E4CFF KwUb 191.3 temp_ub_q0p75_o48 -48.00 143.3 FORMAT "%5.1" /end CHARACTERISTIC
/begin CHARACTERISTIC TMHLEOFF "" VALUE 0x8E4D00 KwUb 191.3 temp_ub_q0p75_o48 -48.00 143.3 FORMAT "%5.1" /end CHARACTERISTIC
/begin CHARACTERISTIC TMHLEON "" VALUE 0x8E4D01 KwUb 191.3 temp_ub_q0p75_o48 -48.00 143.3 FORMAT "%5.1" /end CHARACTERISTIC
/begin CHARACTERISTIC TMHLL "" VALUE 0x8E2B26 KwUb 191.3 temp_ub_q0p75_o48 -48.00 143.3 FORMAT "%5.1" /end CHARACTERISTIC
/begin CHARACTERISTIC TMKOAO "" VALUE 0x8E3F6E KwUb 191.3 temp_ub_q0p75_o48 -48.00 143.3 FORMAT "%5.1" /end CHARACTERISTIC
/begin CHARACTERISTIC TMKOAU "" VALUE 0x8E3F6F KwUb 191.3 temp_ub_q0p75_o48 -48.00 143.3 FORMAT "%5.1" /end CHARACTERISTIC
/begin CHARACTERISTIC TMKOVOFF "" VALUE 0x8E4D02 KwUb 191.3 temp_ub_q0p75_o48 -48.00 143.3 FORMAT "%5.1" /end CHARACTERISTIC
/begin CHARACTERISTIC TMKOVON "" VALUE 0x8E4D03 KwUb 191.3 temp_ub_q0p75_o48 -48.00 143.3 FORMAT "%5.1" /end CHARACTERISTIC
/begin CHARACTERISTIC TMKR "" VALUE 0x8E2798 KwUb 191.3 temp_ub_q0p75_o48 -48.00 143.3 FORMAT "%5.1" /end CHARACTERISTIC
/begin CHARACTERISTIC TMKRA "" VALUE 0x8E2799 KwUb 191.3 temp_ub_q0p75_o48 -48.00 143.3 FORMAT "%5.1" /end CHARACTERISTIC
/begin CHARACTERISTIC TMKRAS "" VALUE 0x8E279A KwUb 191.3 temp_ub_q0p75_o48 -48.00 143.3 FORMAT "%5.1" /end CHARACTERISTIC
/begin CHARACTERISTIC TMLLNW "" VALUE 0x8E2B27 KwUb 191.3 temp_ub_q0p75_o48 -48.00 143.3 FORMAT "%5.1" /end CHARACTERISTIC
/begin CHARACTERISTIC TMLLX "" VALUE 0x8E2B28 KwUb 191.3 temp_ub_q0p75_o48 -48.00 143.3 FORMAT "%5.1" /end CHARACTERISTIC
/begin CHARACTERISTIC TMOTDQMX "" VALUE 0x8E4D04 KwUb 191.3 temp_ub_q0p75_o48 -48.00 143.3 FORMAT "%5.1" /end CHARACTERISTIC
/begin CHARACTERISTIC TMOTDTEV "" VALUE 0x8E4D05 KwUb 191.3 temp_ub_q0p75_o48 -48.00 143.3 FORMAT "%5.1" /end CHARACTERISTIC
/begin CHARACTERISTIC TMOTKRMN "" VALUE 0x8E4D06 KwUb 191.3 temp_ub_q0p75_o48 -48.00 143.3 FORMAT "%5.1" /end CHARACTERISTIC
/begin CHARACTERISTIC TMOTKRMX "" VALUE 0x8E4D07 KwUb 191.3 temp_ub_q0p75_o48 -48.00 143.3 FORMAT "%5.1" /end CHARACTERISTIC
/begin CHARACTERISTIC TMOTZPAUS "" VALUE 0x8E4D08 KwUb 191.3 temp_ub_q0p75_o48 -48.00 143.3 FORMAT "%5.1" /end CHARACTERISTIC
/begin CHARACTERISTIC TMOTZPEIN "" VALUE 0x8E4D09 KwUb 191.3 temp_ub_q0p75_o48 -48.00 143.3 FORMAT "%5.1" /end CHARACTERISTIC
/begin CHARACTERISTIC TMOTZPSTMX "" VALUE 0x8E4D0A KwUb 191.3 temp_ub_q0p75_o48 -48.00 143.3 FORMAT "%5.1" /end CHARACTERISTIC
/begin CHARACTERISTIC TMRESNL "" VALUE 0x8E2CF3 KwUb 191.3 temp_ub_q0p75_o48 -48.00 143.3 FORMAT "%5.1" /end CHARACTERISTIC
/begin CHARACTERISTIC TMRZHLL "" VALUE 0x8E2B29 KwUb 191.3 temp_ub_q0p75_o48 -48.00 143.3 FORMAT "%5.1" /end CHARACTERISTIC
/begin CHARACTERISTIC TMSO5INI "" VALUE 0x8E4D0B KwUb 191.3 temp_ub_q0p75_o48 -48.00 143.3 FORMAT "%5.1" /end CHARACTERISTIC
/begin CHARACTERISTIC TMSOINI "" VALUE 0x8E4D0C KwUb 191.3 temp_ub_q0p75_o48 -48.00 143.3 FORMAT "%5.1" /end CHARACTERISTIC
/begin CHARACTERISTIC TMSOLLEW "" VALUE 0x8E4D0D KwUb 191.3 temp_ub_q0p75_o48 -48.00 143.3 FORMAT "%5.1" /end CHARACTERISTIC
/begin CHARACTERISTIC TMSOTOEL "" CURVE 0x8E4D0E KlAUbSstUbWUb 191.3 temp_ub_q0p75_o48 -48.00 143.3 FORMAT "%5.1"
 /begin AXIS_DESCR STD_AXIS toelkmtr temp_ub_q1_o60 5 -60.00 195.0 FORMAT "%5.1" DEPOSIT ABSOLUTE /end AXIS_DESCR
/end CHARACTERISTIC
/begin CHARACTERISTIC TMSTKOO "" VALUE 0x8E3F70 KwUb 191.3 temp_ub_q0p75_o48 -48.00 143.3 FORMAT "%5.1" /end CHARACTERISTIC
/begin CHARACTERISTIC TMSTKOU "" VALUE 0x8E3F71 KwUb 191.3 temp_ub_q0p75_o48 -48.00 143.3 FORMAT "%5.1" /end CHARACTERISTIC
/begin CHARACTERISTIC TMSTLMS "" VALUE 0x8E24AC KwUb 191.3 temp_ub_q0p75_o48 -48.00 143.3 FORMAT "%5.1" /end CHARACTERISTIC
/begin CHARACTERISTIC TMSTMAD "" VALUE 0x8E3F72 KwUb 191.3 temp_ub_q0p75_o48 -48.00 143.3 FORMAT "%5.1" /end CHARACTERISTIC
/begin CHARACTERISTIC TNLARAMP "" VALUE 0x8F1400 KwUw 65535.00 t1sxs_uw_b65535 0.00 65535.00 FORMAT "%8.2" /end CHARACTERISTIC
/begin CHARACTERISTIC TNLKMTRMN "" VALUE 0x8F1402 KwUw 65535.00 t1sxs_uw_b65535 0.00 65535.00 FORMAT "%8.2" /end CHARACTERISTIC
/begin CHARACTERISTIC TNLSTMX "" VALUE 0x8F1404 KwUw 6553.500 t100msxs_uw_b6553p5 0.00 6553.500 FORMAT "%8.3" /end CHARACTERISTIC
/begin CHARACTERISTIC TNLSTP "" VALUE 0x8F1406 KwUw 65535.00 t1sxs_uw_b65535 0.00 65535.00 FORMAT "%8.2" /end CHARACTERISTIC
/begin CHARACTERISTIC TNLZWP2 "" VALUE 0x8F1408 KwUw 65535.00 t1sxs_uw_b65535 0.00 65535.00 FORMAT "%8.2" /end CHARACTERISTIC
/begin CHARACTERISTIC TNSLBZA "" VALUE 0x8EBBC6 KwUw 1310.700 t20msxs_uw_q0p02 0.00 1310.700 FORMAT "%8.3" /end CHARACTERISTIC
/begin CHARACTERISTIC TNSLBZAI "" VALUE 0x8E2B2A KwUb 0.6375 nmot_q0p0025 0.00 0.6375 /end CHARACTERISTIC
/begin CHARACTERISTIC TNSLBZAN "" VALUE 0x8EBBC8 KwUw 1310.700 t20msxs_uw_q0p02 0.00 1310.700 FORMAT "%8.3" /end CHARACTERISTIC
/begin CHARACTERISTIC TNSLFA "" VALUE 0x8E2F47 KwUb 5.08000 zk20msxs_ub_b5p1 0.0200000 5.10000 FORMAT "%7.5" /end CHARACTERISTIC
/begin CHARACTERISTIC TOLEWKMTR "" VALUE 0x8E4D19 KwUb 255.0 temp_ub_q1_o60 -60.00 195.0 FORMAT "%5.1" /end CHARACTERISTIC
/begin CHARACTERISTIC TOLLNWMX "" VALUE 0x8EBBCA KwUw 1535.977 temp_q0p0234_o273 -273.1500 1262.827 FORMAT "%8.3" /end CHARACTERISTIC
/begin CHARACTERISTIC TUHEMN "" CURVE 0x8E4D1A KlAUbSstUbWUb 191.3 temp_ub_q0p75_o48 -48.00 143.3 FORMAT "%5.1"
 /begin AXIS_DESCR STD_AXIS uhepoti dez 5 0.00 255.0 FORMAT "%5.1" DEPOSIT ABSOLUTE /end AXIS_DESCR
/end CHARACTERISTIC
/begin CHARACTERISTIC TUHEMX "" CURVE 0x8E4D25 KlAUbSstUbWUb 191.3 temp_ub_q0p75_o48 -48.00 143.3 FORMAT "%5.1"
 /begin AXIS_DESCR STD_AXIS uhepoti dez 5 0.00 255.0 FORMAT "%5.1" DEPOSIT ABSOLUTE /end AXIS_DESCR
/end CHARACTERISTIC
/begin CHARACTERISTIC TUMEWKMTR "" VALUE 0x8E4D30 KwUb 191.3 temp_ub_q0p75_o48 -48.00 143.3 FORMAT "%5.1" /end CHARACTERISTIC
/begin CHARACTERISTIC TUMGZWP "" VALUE 0x8E4D31 KwUb 191.3 temp_ub_q0p75_o48 -48.00 143.3 FORMAT "%5.1" /end CHARACTERISTIC
/begin CHARACTERISTIC TUMKLIHDV "" VALUE 0x8E4D32 KwUb 191.3 temp_ub_q0p75_o48 -48.00 143.3 FORMAT "%5.1" /end CHARACTERISTIC
/begin CHARACTERISTIC TUMST1 "" VALUE 0x8E4D33 KwUb 50.00 t200msxs_ub_b51 1.000 51.00 FORMAT "%5.2" /end CHARACTERISTIC
/begin CHARACTERISTIC TUMST2 "" VALUE 0x8E4D34 KwUb 50.80 t200msxs_ub_b51 0.2000 51.00 FORMAT "%5.2" /end CHARACTERISTIC
/begin CHARACTERISTIC TUPOTMN "" CURVE 0x8E4D35 KlAUbSstUbWUb 191.3 temp_ub_q0p75_o48 -48.00 143.3 FORMAT "%5.1"
 /begin AXIS_DESCR STD_AXIS upotpwm dez 5 0.00 255.0 FORMAT "%5.1" DEPOSIT ABSOLUTE /end AXIS_DESCR
/end CHARACTERISTIC
/begin CHARACTERISTIC TUPOTMX "" CURVE 0x8E4D40 KlAUbSstUbWUb 191.3 temp_ub_q0p75_o48 -48.00 143.3 FORMAT "%5.1"
 /begin AXIS_DESCR STD_AXIS upotpwm dez 5 0.00 255.0 FORMAT "%5.1" DEPOSIT ABSOLUTE /end AXIS_DESCR
/end CHARACTERISTIC
/begin CHARACTERISTIC TVDK "" VALUE 0x8FD18A KwUb 5.100 t20msxs_ub_b5p1 0.00 5.100 FORMAT "%5.3" /end CHARACTERISTIC
/begin CHARACTERISTIC TVETREW "" VALUE 0x8E4D4B KwUb 99.61 tv_ub_b100 0.00 99.61 FORMAT "%5.2" /end CHARACTERISTIC
/begin CHARACTERISTIC TVETRMN "" VALUE 0x8E4D4C KwUb 99.61 tv_ub_b100 0.00 99.61 FORMAT "%5.2" /end CHARACTERISTIC
/begin CHARACTERISTIC TVETRMX "" VALUE 0x8E4D4D KwUb 99.61 tv_ub_b100 0.00 99.61 FORMAT "%5.2" /end CHARACTERISTIC
/begin CHARACTERISTIC TVETROFF "" VALUE 0x8E4D4E KwUb 99.61 tv_ub_b100 0.00 99.61 FORMAT "%5.2" /end CHARACTERISTIC
/begin CHARACTERISTIC TVKLIHDV1 "" VALUE 0x8E4D4F KwUb 99.61 tv_ub_b100 0.00 99.61 FORMAT "%5.2" /end CHARACTERISTIC
/begin CHARACTERISTIC TVKLIHDV2 "" VALUE 0x8E4D50 KwUb 99.61 tv_ub_b100 0.00 99.61 FORMAT "%5.2" /end CHARACTERISTIC
/begin CHARACTERISTIC TVKMTRMN "" VALUE 0x8E4D51 KwUb 99.61 tv_ub_b100 0.00 99.61 FORMAT "%5.2" /end CHARACTERISTIC
/begin CHARACTERISTIC TVKMTRMX "" VALUE 0x8E4D52 KwUb 99.61 tv_ub_b100 0.00 99.61 FORMAT "%5.2" /end CHARACTERISTIC
/begin CHARACTERISTIC TVKOEOF "" VALUE 0x8E3F73 KwUb 5.100 t20msxs_ub_b5p1 0.00 5.100 FORMAT "%5.3" /end CHARACTERISTIC
/begin CHARACTERISTIC TVKOGANDEL "" VALUE 0x8E3F74 KwUb 5.100 t20msxs_ub_b5p1 0.00 5.100 FORMAT "%5.3" /end CHARACTERISTIC
/begin CHARACTERISTIC TVKOSSIM "" VALUE 0x8E3F75 KwUb 51.00 t200msxs_ub_b51 0.00 51.00 FORMAT "%5.2" /end CHARACTERISTIC
/begin CHARACTERISTIC TVKOULEV "" VALUE 0x8E3F76 KwUb 51.00 t200msxs_ub_b51 0.00 51.00 FORMAT "%5.2" /end CHARACTERISTIC
/begin CHARACTERISTIC TVKRSTAT "" VALUE 0x8FD0B5 KwUb 25.50 t100msxs_ub_b25p5 0.00 25.50 FORMAT "%5.2" /end CHARACTERISTIC
/begin CHARACTERISTIC TVKUPPL "" VALUE 0x8FD18B KwUb 5.100 t20msxs_ub_b5p1 0.00 5.100 FORMAT "%5.3" /end CHARACTERISTIC
/begin CHARACTERISTIC TVLBTS "" VALUE 0x8E2338 KwUb 25.50 t100msxs_ub_b25p5 0.00 25.50 FORMAT "%5.2" /end CHARACTERISTIC
/begin CHARACTERISTIC TVLISTU "" VALUE 0x8FD199 KwUb 5.100 t20msxs_ub_b5p1 0.00 5.100 FORMAT "%5.3" /end CHARACTERISTIC
/begin CHARACTERISTIC TVLLNWDIF "" VALUE 0x8E2B2B KwUb 5.100 t_q0p02 0.00 5.100 FORMAT "%5.3" /end CHARACTERISTIC
/begin CHARACTERISTIC TVLLNWR "" VALUE 0x8EBBCC KwUw 1310.700 t20msxs_uw_q0p02 0.00 1310.700 FORMAT "%8.3" /end CHARACTERISTIC
/begin CHARACTERISTIC TVLLR "" VALUE 0x8FD18C KwUb 5.100 t20msxs_ub_b5p1 0.00 5.100 FORMAT "%5.3" /end CHARACTERISTIC
/begin CHARACTERISTIC TVLLRI "" CURVE 0x8E2B2E KlAUbSstUbWUb 5.100 t20msxs_ub_b5p1 0.00 5.100 FORMAT "%5.3"
 /begin AXIS_DESCR STD_AXIS tmot temp_ub_q0p75_o48 6 -48.00 143.3 FORMAT "%5.1" DEPOSIT ABSOLUTE /end AXIS_DESCR
/end CHARACTERISTIC
/begin CHARACTERISTIC TVLLRPD "" CURVE 0x8E2B3B KlAUbSstUbWUb 5.100 t20msxs_ub_b5p1 0.00 5.100 FORMAT "%5.3"
 /begin AXIS_DESCR STD_AXIS tmot temp_ub_q0p75_o48 6 -48.00 143.3 FORMAT "%5.1" DEPOSIT ABSOLUTE /end AXIS_DESCR
/end CHARACTERISTIC
/begin CHARACTERISTIC TVLLRPST "" VALUE 0x8FD19A KwUb 51.00 t200msxs_ub_b51 0.00 51.00 FORMAT "%5.2" /end CHARACTERISTIC
/begin CHARACTERISTIC TVLLRSTE "" VALUE 0x8FD18D KwUb 5.100 t20msxs_ub_b5p1 0.00 5.100 FORMAT "%5.3" /end CHARACTERISTIC
/begin CHARACTERISTIC TVLU1MN "" VALUE 0x8E4D53 KwUb 99.61 tv_ub_b100 0.00 99.61 FORMAT "%5.2" /end CHARACTERISTIC
/begin CHARACTERISTIC TVLU1MX "" VALUE 0x8E4D54 KwUb 99.61 tv_ub_b100 0.00 99.61 FORMAT "%5.2" /end CHARACTERISTIC
/begin CHARACTERISTIC TVLU2MN "" VALUE 0x8E4D55 KwUb 99.61 tv_ub_b100 0.00 99.61 FORMAT "%5.2" /end CHARACTERISTIC
/begin CHARACTERISTIC TVLU2MX "" VALUE 0x8E4D56 KwUb 99.61 tv_ub_b100 0.00 99.61 FORMAT "%5.2" /end CHARACTERISTIC
/begin CHARACTERISTIC TVLUESETR "" VALUE 0x8E4D57 KwUb 99.61 tv_ub_b100 0.00 99.61 FORMAT "%5.2" /end CHARACTERISTIC
/begin CHARACTERISTIC TVLUESICEW "" VALUE 0x8E4D58 KwUb 99.61 tv_ub_b100 0.00 99.61 FORMAT "%5.2" /end CHARACTERISTIC
/begin CHARACTERISTIC TVLUESSEW_0_A "" VALUE 0x8E4D59 KwUb 99.61 tv_ub_b100 0.00 99.61 FORMAT "%5.2" /end CHARACTERISTIC
/begin CHARACTERISTIC TVLUESSEW_1_A "" VALUE 0x8E4D5A KwUb 99.61 tv_ub_b100 0.00 99.61 FORMAT "%5.2" /end CHARACTERISTIC
/begin CHARACTERISTIC TVMXBSG "" VALUE 0x8E4D5B KwUb 99.61 tv_ub_b100 0.00 99.61 FORMAT "%5.2" /end CHARACTERISTIC
/begin CHARACTERISTIC TVNL1OFF "" VALUE 0x8E4D5C KwUb 99.61 tv_ub_b100 0.00 99.61 FORMAT "%5.2" /end CHARACTERISTIC
/begin CHARACTERISTIC TVNL2OFF "" VALUE 0x8E4D5D KwUb 99.61 tv_ub_b100 0.00 99.61 FORMAT "%5.2" /end CHARACTERISTIC
/begin CHARACTERISTIC TVNLETR "" VALUE 0x8E4D5E KwUb 99.61 tv_ub_b100 0.00 99.61 FORMAT "%5.2" /end CHARACTERISTIC
/begin CHARACTERISTIC TVNLT1 "" VALUE 0x8E4D5F KwUb 99.61 tv_ub_b100 0.00 99.61 FORMAT "%5.2" /end CHARACTERISTIC
/begin CHARACTERISTIC TVNLT2 "" VALUE 0x8E4D60 KwUb 99.61 tv_ub_b100 0.00 99.61 FORMAT "%5.2" /end CHARACTERISTIC
/begin CHARACTERISTIC TVNLTETR "" VALUE 0x8E4D61 KwUb 99.61 tv_ub_b100 0.00 99.61 FORMAT "%5.2" /end CHARACTERISTIC
/begin CHARACTERISTIC TVOLLNWMAX "" VALUE 0x8EBBCE KwUw 1310.700 t_q0p02 0.00 1310.700 FORMAT "%8.3" /end CHARACTERISTIC
/begin CHARACTERISTIC TVPKH "" VALUE 0x8FEB46 KwUw 13107.00 t200msxs_uw_q0p2 0.00 13107.00 FORMAT "%8.2" /end CHARACTERISTIC
/begin CHARACTERISTIC TVRAMPBS "" VALUE 0x8E4D62 KwUb 99.61 tv_ub_b100 0.00 99.61 FORMAT "%5.2" /end CHARACTERISTIC
/begin CHARACTERISTIC TVRESLL "" VALUE 0x8FEB4C KwUw 1310.700 t20msxs_uw_q0p02 0.00 1310.700 FORMAT "%8.3" /end CHARACTERISTIC
/begin CHARACTERISTIC TVRESTM "" VALUE 0x8E2CF4 KwUb 5.100 t20msxs_ub_b5p1 0.00 5.100 FORMAT "%5.3" /end CHARACTERISTIC
/begin CHARACTERISTIC TVSTETR "" VALUE 0x8E4D63 KwUb 99.61 tv_ub_b100 0.00 99.61 FORMAT "%5.2" /end CHARACTERISTIC
/begin CHARACTERISTIC TVSTL1 "" VALUE 0x8E4D64 KwUb 99.61 tv_ub_b100 0.00 99.61 FORMAT "%5.2" /end CHARACTERISTIC
/begin CHARACTERISTIC TVSTL2 "" VALUE 0x8E4D65 KwUb 99.61 tv_ub_b100 0.00 99.61 FORMAT "%5.2" /end CHARACTERISTIC
/begin CHARACTERISTIC TZWPST "" VALUE 0x8E4D66 KwUb 255.0 t1sxs_ub_b255 0.00 255.0 FORMAT "%5.1" /end CHARACTERISTIC
/begin CHARACTERISTIC TZWPSTH "" VALUE 0x8E4D67 KwUb 51.00 t1sxs_ub_b255 0.00 51.00 FORMAT "%5.2" /end CHARACTERISTIC
/begin CHARACTERISTIC TZWPSV "" VALUE 0x8E4D68 KwUb 255.0 t1sxs_ub_b255 0.00 255.0 FORMAT "%5.1" /end CHARACTERISTIC
/begin CHARACTERISTIC VANF "" VALUE 0x8FD1B2 KwUb 318.8 vfzg_ub_q1p25 0.00 318.8 FORMAT "%5.1" /end CHARACTERISTIC
/begin CHARACTERISTIC VFZGEW "" VALUE 0x8E4D69 KwUb 318.8 vfzg_ub_q1p25 0.00 318.8 FORMAT "%5.1" /end CHARACTERISTIC
/begin CHARACTERISTIC VFZGSP "" VALUE 0x8E3F77 KwUb 318.8 vfzg_ub_q1p25 0.00 318.8 FORMAT "%5.1" /end CHARACTERISTIC
/begin CHARACTERISTIC VKO "" VALUE 0x8E3F78 KwUb 318.8 vfzg_ub_q1p25 0.00 318.8 FORMAT "%5.1" /end CHARACTERISTIC
/begin CHARACTERISTIC VKOAO "" VALUE 0x8E3F79 KwUb 318.8 vfzg_ub_q1p25 0.00 318.8 FORMAT "%5.1" /end CHARACTERISTIC
/begin CHARACTERISTIC VKOB "" VALUE 0x8E3F7A KwUb 318.8 vfzg_ub_q1p25 0.00 318.8 FORMAT "%5.1" /end CHARACTERISTIC
/begin CHARACTERISTIC VLLR "" VALUE 0x8FD18E KwUb 318.8 vfzg_ub_q1p25 0.00 318.8 FORMAT "%5.1" /end CHARACTERISTIC
/begin CHARACTERISTIC VNVKO "" VALUE 0x8F10E8 KwUw 511.9922 qnv_uw_b512 0.00 511.9922 FORMAT "%8.4" /end CHARACTERISTIC
/begin CHARACTERISTIC VNVKOB "" VALUE 0x8F10EA KwUw 511.9922 qnv_uw_b512 0.00 511.9922 FORMAT "%8.4" /end CHARACTERISTIC
/begin CHARACTERISTIC VSL "" VALUE 0x8E2B2C KwUb 318.8 vfzg_ub_q1p25 0.00 318.8 FORMAT "%5.1" /end CHARACTERISTIC
/begin CHARACTERISTIC WFAN "" VALUE 0x8E2F48 KwUb 100.0 relPED_ub_b100 0.00 100.0 FORMAT "%5.1" /end CHARACTERISTIC
/begin CHARACTERISTIC WKRLZOF "" VAL_BLK 0x8FD0B6 KwbUb 191.3 zw_ub_qn0p75 -191.3 0.00 FORMAT "%5.1" NUMBER 8 /end CHARACTERISTIC
/begin CHARACTERISTIC WKRLZOFEKS "" VALUE 0x8FD0BE KwUb 191.3 zw_ub_qn0p75 -191.3 0.00 FORMAT "%5.1" /end CHARACTERISTIC
/begin CHARACTERISTIC WPEDKO "" CURVE 0x8E3FCC GklWUb 99.61 rel_ub_b100 0.00 99.61 FORMAT "%5.2"
 /begin AXIS_DESCR COM_AXIS nmot nmot_ub_q40 8 0.00 10200. FORMAT "%5.0" AXIS_PTS_REF SNM08KOUB /end AXIS_DESCR
/end CHARACTERISTIC
/begin CHARACTERISTIC ZDRLKRA "" VALUE 0x8FE902 KwUw 655.34999985 zk10msxs_uw_b655 0.010000152590 655.36000000 FORMAT "%12.8" /end CHARACTERISTIC
/begin CHARACTERISTIC ZFLASKH "" VALUE 0x8E24AD KwUb 25.4996 zk100msxs_ub_b25p5 0.100392 25.6000 FORMAT "%7.4" /end CHARACTERISTIC
/begin CHARACTERISTIC ZFLLRPL "" VALUE 0x8FD19B KwUb 5.08000 zk20msxs_ub_b5p1 0.0200000 5.10000 FORMAT "%7.5" /end CHARACTERISTIC
/begin CHARACTERISTIC ZHLLA "" VALUE 0x8EBBD0 KwUw 13107.00 t200msxs_uw_q0p2 0.00 13107.00 FORMAT "%8.2" /end CHARACTERISTIC
/begin CHARACTERISTIC ZHLLE "" VALUE 0x8EBBD2 KwUw 13107.00 t200msxs_uw_q0p2 0.00 13107.00 FORMAT "%8.2" /end CHARACTERISTIC
/begin CHARACTERISTIC ZKETR "" VALUE 0x8E4D6A KwUb 254.996 zk1sxs_ub_b255 1.00392 256.000 FORMAT "%7.3" /end CHARACTERISTIC
/begin CHARACTERISTIC ZKLAMFAW "" VALUE 0x8EAB74 KwUw 6553.4999985 zk100msxs_uw_b6553 0.10000152590 6553.6000000 FORMAT "%12.7" /end CHARACTERISTIC
/begin CHARACTERISTIC ZKLANSWL "" VALUE 0x8FE6BC KwUw 655.34999985 zk10msxs_uw_b655 0.010000152590 655.36000000 FORMAT "%12.8" /end CHARACTERISTIC
/begin CHARACTERISTIC ZKLLRD "" VALUE 0x8FD19C KwUb 5.08000 zk20msxs_ub_b5p1 0.0200000 5.10000 FORMAT "%7.5" /end CHARACTERISTIC
/begin CHARACTERISTIC ZKNLST "" VALUE 0x8E4D6B KwUb 254.996 zk1sxs_ub_b255 1.00392 256.000 FORMAT "%7.3" /end CHARACTERISTIC
/begin CHARACTERISTIC ZKNS "" VALUE 0x8EBBD4 KwUw 1310.6999997 zk20msxs_uw_b1310p72 0.020000305180 1310.7200000 FORMAT "%12.7" /end CHARACTERISTIC
/begin CHARACTERISTIC ZKNSU "" VALUE 0x8EBBD6 KwUw 1310.6999997 zk20msxs_uw_b1310p72 0.020000305180 1310.7200000 FORMAT "%12.7" /end CHARACTERISTIC
/begin CHARACTERISTIC ZKNWLL "" VALUE 0x8EBBD8 KwUw 1310.6999997 zk20msxs_uw_b1310 0.020000305180 1310.7200000 FORMAT "%12.7" /end CHARACTERISTIC
/begin CHARACTERISTIC ZKNWLLANH "" VALUE 0x8EBBDA KwUw 2548.008 nmotg_uw_b2550 1.992188 2550.000 FORMAT "%8.3" /end CHARACTERISTIC
/begin CHARACTERISTIC ZKNWLLDIF "" VALUE 0x8EBBDC KwUw 2548.008 nmotg_uw_b2550 1.992188 2550.000 FORMAT "%8.3" /end CHARACTERISTIC
/begin CHARACTERISTIC ZKNWLLNA "" VALUE 0x8EBBDE KwUw 2548.828 nmotg_qn1p953125 -2550.781 -1.953125 FORMAT "%8.3" /end CHARACTERISTIC
/begin CHARACTERISTIC ZKQMAXL1 "" VALUE 0x8E4D6C KwUb 254.996 zk1sxs_ub_b255 1.00392 256.000 FORMAT "%7.3" /end CHARACTERISTIC
/begin CHARACTERISTIC ZKQMAXL2 "" VALUE 0x8E4D6D KwUb 254.996 zk1sxs_ub_b255 1.00392 256.000 FORMAT "%7.3" /end CHARACTERISTIC
/begin CHARACTERISTIC ZKTKASNRLN "" VALUE 0x8E4D6E KwUb 254.996 zk1sxs_ub_b255 1.00392 256.000 FORMAT "%7.3" /end CHARACTERISTIC
/begin CHARACTERISTIC ZKTKASNRLP "" VALUE 0x8E4D6F KwUb 254.996 zk1sxs_ub_b255 1.00392 256.000 FORMAT "%7.3" /end CHARACTERISTIC
/begin CHARACTERISTIC ZKTKASO "" VALUE 0x8E4D70 KwUb 254.996 zk1sxs_ub_b255 1.00392 256.000 FORMAT "%7.3" /end CHARACTERISTIC
/begin CHARACTERISTIC ZKTMSN "" VALUE 0x8E4D71 KwUb 254.996 zk1sxs_ub_b255 1.00392 256.000 FORMAT "%7.3" /end CHARACTERISTIC
/begin CHARACTERISTIC ZKTMSP "" VALUE 0x8E4D72 KwUb 254.996 zk1sxs_ub_b255 1.00392 256.000 FORMAT "%7.3" /end CHARACTERISTIC
/begin CHARACTERISTIC ZKWLAFWL "" VALUE 0x8E1EBB KwUb 25.4996 zk100msxs_ub_b25p5 0.100392 25.6000 FORMAT "%7.4" /end CHARACTERISTIC
/begin CHARACTERISTIC ZLBTS "" VALUE 0x8EADD0 KwUw 6553.4999985 zk100msxs_uw_b6553 0.10000152590 6553.6000000 FORMAT "%12.7" /end CHARACTERISTIC
/begin CHARACTERISTIC ZLIBG "" VALUE 0x8FD19D KwUb 5.08000 zk20msxs_ub_b5p1 0.0200000 5.10000 FORMAT "%7.5" /end CHARACTERISTIC
/begin CHARACTERISTIC ZNFNGLL "" VALUE 0x8FD19E KwUb 5.08000 zk20msxs_ub_b5p1 0.0200000 5.10000 FORMAT "%7.5" /end CHARACTERISTIC
/begin CHARACTERISTIC ZNGKRA "" VALUE 0x8FE904 KwUw 655.34999985 zk10msxs_uw_b655 0.010000152590 655.36000000 FORMAT "%12.8" /end CHARACTERISTIC
/begin CHARACTERISTIC ZNSUB "" VALUE 0x8E2B2D KwUb 50.8000 zk200msxs_ub_b51p2 0.200000 51.0000 FORMAT "%7.4" /end CHARACTERISTIC
/begin CHARACTERISTIC ZVSKS "" VALUE 0x8E4D73 KwUb 254.996 zk1sxs_ub_b255 1.00392 256.000 FORMAT "%7.3" /end CHARACTERISTIC
/begin CHARACTERISTIC ZYRKR "" VALUE 0x8E26B2 KwUb 255.0 dez 0.00 255.0 FORMAT "%5.1" /end CHARACTERISTIC
/begin MEASUREMENT anztib0_w "" UWORD dez 1 100 0.00 65535.00 FORMAT "%8.2" ECU_ADDRESS 0xF1FC0 /end MEASUREMENT
/begin MEASUREMENT anztib1_w "" UWORD dez 1 100 0.00 65535.00 FORMAT "%8.2" ECU_ADDRESS 0xF1FC2 /end MEASUREMENT
/begin MEASUREMENT B_acres "" UWORD B_TRUE 1 100 0.00 1.00000000000 BIT_MASK 0x8 FORMAT "%13.11" ECU_ADDRESS 0xFDC6 /end MEASUREMENT
/begin MEASUREMENT B_anpkangl "" UWORD B_TRUE 1 100 0.00 1.00000000000 BIT_MASK 0x80 FORMAT "%13.11" ECU_ADDRESS 0xFD0E /end MEASUREMENT
/begin MEASUREMENT B_brufs "" UBYTE B_TRUE 1 100 0.00 1.00000000000 BIT_MASK 0x80 FORMAT "%13.11" ECU_ADDRESS 0xF0AED /end MEASUREMENT
/begin MEASUREMENT B_c95_g0 "" UWORD B_TRUE 1 100 0.00 1.00000000000 BIT_MASK 0x4 FORMAT "%13.11" ECU_ADDRESS 0xFD90 /end MEASUREMENT
/begin MEASUREMENT B_c95_g1 "" UWORD B_TRUE 1 100 0.00 1.00000000000 BIT_MASK 0x8 FORMAT "%13.11" ECU_ADDRESS 0xFD90 /end MEASUREMENT
/begin MEASUREMENT B_c95_g2 "" UWORD B_TRUE 1 100 0.00 1.00000000000 BIT_MASK 0x10 FORMAT "%13.11" ECU_ADDRESS 0xFD90 /end MEASUREMENT
/begin MEASUREMENT B_deaklue "" UBYTE B_TRUE 1 100 0.00 1.00000000000 BIT_MASK 0x1 FORMAT "%13.11" ECU_ADDRESS 0xF41B7 /end MEASUREMENT
/begin MEASUREMENT B_deaklue1 "" UBYTE B_TRUE 1 100 0.00 1.00000000000 BIT_MASK 0x2 FORMAT "%13.11" ECU_ADDRESS 0xF41B7 /end MEASUREMENT
/begin MEASUREMENT B_deaklue2 "" UBYTE B_TRUE 1 100 0.00 1.00000000000 BIT_MASK 0x4 FORMAT "%13.11" ECU_ADDRESS 0xF41B7 /end MEASUREMENT
/begin MEASUREMENT B_drlkrdy "" UWORD B_TRUE 1 100 0.00 1.00000000000 BIT_MASK 0x200 FORMAT "%13.11" ECU_ADDRESS 0xFD92 /end MEASUREMENT
/begin MEASUREMENT B_dslafa "" UBYTE B_TRUE 1 100 0.00 1.00000000000 BIT_MASK 0x1 FORMAT "%13.11" ECU_ADDRESS 0xF0A58 /end MEASUREMENT
/begin MEASUREMENT B_elues1 "" UBYTE B_TRUE 1 100 0.00 1.00000000000 BIT_MASK 0x1 FORMAT "%13.11" ECU_ADDRESS 0xF41B8 /end MEASUREMENT
/begin MEASUREMENT B_elues2 "" UBYTE B_TRUE 1 100 0.00 1.00000000000 BIT_MASK 0x2 FORMAT "%13.11" ECU_ADDRESS 0xF41B8 /end MEASUREMENT
/begin MEASUREMENT B_enllri "" UWORD B_TRUE 1 100 0.00 1.00000000000 BIT_MASK 0x1 FORMAT "%13.11" ECU_ADDRESS 0xFDA0 /end MEASUREMENT
/begin MEASUREMENT B_ensol "" UWORD B_TRUE 1 100 0.00 1.00000000000 BIT_MASK 0x2 FORMAT "%13.11" ECU_ADDRESS 0xFDA0 /end MEASUREMENT
/begin MEASUREMENT B_etb "" UWORD B_TRUE 1 100 0.00 1.00000000000 BIT_MASK 0x800 FORMAT "%13.11" ECU_ADDRESS 0xFDCC /end MEASUREMENT
/begin MEASUREMENT B_fanfg "" UBYTE B_TRUE 1 100 0.00 1.00000000000 BIT_MASK 0x1 FORMAT "%13.11" ECU_ADDRESS 0xF0B18 /end MEASUREMENT
/begin MEASUREMENT B_fpwld_ok "" UWORD B_TRUE 1 100 0.00 1.00000000000 BIT_MASK 0x1000 FORMAT "%13.11" ECU_ADDRESS 0xFDCC /end MEASUREMENT
/begin MEASUREMENT B_hll "" UBYTE B_TRUE 1 100 0.00 1.00000000000 BIT_MASK 0x10 FORMAT "%13.11" ECU_ADDRESS 0xF0AED /end MEASUREMENT
/begin MEASUREMENT B_hlonkmtr "" UWORD B_TRUE 1 100 0.00 1.00000000000 BIT_MASK 0x2000 FORMAT "%13.11" ECU_ADDRESS 0xFDCC /end MEASUREMENT
/begin MEASUREMENT B_kl "" UWORD B_TRUE 1 100 0.00 1.00000000000 BIT_MASK 0x20 FORMAT "%13.11" ECU_ADDRESS 0xFD90 /end MEASUREMENT
/begin MEASUREMENT B_klahmx "" UBYTE B_TRUE 1 100 0.00 1.00000000000 BIT_MASK 0x4 FORMAT "%13.11" ECU_ADDRESS 0xF41B8 /end MEASUREMENT
/begin MEASUREMENT B_kldf "" UBYTE B_TRUE 1 100 0.00 1.00000000000 BIT_MASK 0x1 FORMAT "%13.11" ECU_ADDRESS 0xF0AED /end MEASUREMENT
/begin MEASUREMENT B_kldynrm "" UWORD B_TRUE 1 100 0.00 1.00000000000 BIT_MASK 0x400 FORMAT "%13.11" ECU_ADDRESS 0xFD92 /end MEASUREMENT
/begin MEASUREMENT B_kldystk "" UWORD B_TRUE 1 100 0.00 1.00000000000 BIT_MASK 0x800 FORMAT "%13.11" ECU_ADDRESS 0xFD92 /end MEASUREMENT
/begin MEASUREMENT B_klihdv "" UBYTE B_TRUE 1 100 0.00 1.00000000000 BIT_MASK 0x40 FORMAT "%13.11" ECU_ADDRESS 0xF41B8 /end MEASUREMENT
/begin MEASUREMENT B_kmtre "" UWORD B_TRUE 1 100 0.00 1.00000000000 BIT_MASK 0x4000 FORMAT "%13.11" ECU_ADDRESS 0xFDCC /end MEASUREMENT
/begin MEASUREMENT B_ko "" UWORD B_TRUE 1 100 0.00 1.00000000000 BIT_MASK 0x10 FORMAT "%13.11" ECU_ADDRESS 0xFDC6 /end MEASUREMENT
/begin MEASUREMENT B_koa "" UBYTE B_TRUE 1 100 0.00 1.00000000000 BIT_MASK 0x8 FORMAT "%13.11" ECU_ADDRESS 0xF0C77 /end MEASUREMENT
/begin MEASUREMENT B_kobaus "" UBYTE B_TRUE 1 100 0.00 1.00000000000 BIT_MASK 0x10 FORMAT "%13.11" ECU_ADDRESS 0xF0C78 /end MEASUREMENT
/begin MEASUREMENT B_kobmnon "" UBYTE B_TRUE 1 100 0.00 1.00000000000 BIT_MASK 0x20 FORMAT "%13.11" ECU_ADDRESS 0xF0C78 /end MEASUREMENT
/begin MEASUREMENT B_kobped "" UBYTE B_TRUE 1 100 0.00 1.00000000000 BIT_MASK 0x1 FORMAT "%13.11" ECU_ADDRESS 0xF0C78 /end MEASUREMENT
/begin MEASUREMENT B_kobpedt "" UBYTE B_TRUE 1 100 0.00 1.00000000000 BIT_MASK 0x2 FORMAT "%13.11" ECU_ADDRESS 0xF0C78 /end MEASUREMENT
/begin MEASUREMENT B_kobwped "" UBYTE B_TRUE 1 100 0.00 1.00000000000 BIT_MASK 0x4 FORMAT "%13.11" ECU_ADDRESS 0xF0C78 /end MEASUREMENT
/begin MEASUREMENT B_kobwpedt "" UBYTE B_TRUE 1 100 0.00 1.00000000000 BIT_MASK 0x8 FORMAT "%13.11" ECU_ADDRESS 0xF0C78 /end MEASUREMENT
/begin MEASUREMENT B_koe "" UWORD B_TRUE 1 100 0.00 1.00000000000 BIT_MASK 0x20 FORMAT "%13.11" ECU_ADDRESS 0xFDC6 /end MEASUREMENT
/begin MEASUREMENT B_koena "" UBYTE B_TRUE 1 100 0.00 1.00000000000 BIT_MASK 0x40 FORMAT "%13.11" ECU_ADDRESS 0xF0C77 /end MEASUREMENT
/begin MEASUREMENT B_koenat "" UBYTE B_TRUE 1 100 0.00 1.00000000000 BIT_MASK 0x80 FORMAT "%13.11" ECU_ADDRESS 0xF0C77 /end MEASUREMENT
/begin MEASUREMENT B_koevab "" UWORD B_TRUE 1 100 0.00 1.00000000000 BIT_MASK 0x1 FORMAT "%13.11" ECU_ADDRESS 0xFD72 /end MEASUREMENT
/begin MEASUREMENT B_kofreeze "" UBYTE B_TRUE 1 100 0.00 1.00000000000 BIT_MASK 0x1 FORMAT "%13.11" ECU_ADDRESS 0xF0C7A /end MEASUREMENT
/begin MEASUREMENT B_kogandel "" UBYTE B_TRUE 1 100 0.00 1.00000000000 BIT_MASK 0x80 FORMAT "%13.11" ECU_ADDRESS 0xF0C78 /end MEASUREMENT
/begin MEASUREMENT B_koganped "" UBYTE B_TRUE 1 100 0.00 1.00000000000 BIT_MASK 0x40 FORMAT "%13.11" ECU_ADDRESS 0xF0C78 /end MEASUREMENT
/begin MEASUREMENT B_koint "" UBYTE B_TRUE 1 100 0.00 1.00000000000 BIT_MASK 0x8 FORMAT "%13.11" ECU_ADDRESS 0xF0C79 /end MEASUREMENT
/begin MEASUREMENT B_komna "" UBYTE B_TRUE 1 100 0.00 1.00000000000 BIT_MASK 0x2 FORMAT "%13.11" ECU_ADDRESS 0xF0C7A /end MEASUREMENT
/begin MEASUREMENT B_komnoff "" UBYTE B_TRUE 1 100 0.00 1.00000000000 BIT_MASK 0x1 FORMAT "%13.11" ECU_ADDRESS 0xF0C77 /end MEASUREMENT
/begin MEASUREMENT B_komnon "" UBYTE B_TRUE 1 100 0.00 1.00000000000 BIT_MASK 0x4 FORMAT "%13.11" ECU_ADDRESS 0xF0C77 /end MEASUREMENT
/begin MEASUREMENT B_komxoff "" UBYTE B_TRUE 1 100 0.00 1.00000000000 BIT_MASK 0x2 FORMAT "%13.11" ECU_ADDRESS 0xF0C77 /end MEASUREMENT
/begin MEASUREMENT B_kondel "" UBYTE B_TRUE 1 100 0.00 1.00000000000 BIT_MASK 0x1 FORMAT "%13.11" ECU_ADDRESS 0xF0C79 /end MEASUREMENT
/begin MEASUREMENT B_kooff "" UBYTE B_TRUE 1 100 0.00 1.00000000000 BIT_MASK 0x10 FORMAT "%13.11" ECU_ADDRESS 0xF0C77 /end MEASUREMENT
/begin MEASUREMENT B_koofft "" UBYTE B_TRUE 1 100 0.00 1.00000000000 BIT_MASK 0x20 FORMAT "%13.11" ECU_ADDRESS 0xF0C77 /end MEASUREMENT
/begin MEASUREMENT B_koondel "" UBYTE B_TRUE 1 100 0.00 1.00000000000 BIT_MASK 0x10 FORMAT "%13.11" ECU_ADDRESS 0xF0C79 /end MEASUREMENT
/begin MEASUREMENT B_kosrc "" UWORD B_TRUE 1 100 0.00 1.00000000000 BIT_MASK 0x40 FORMAT "%13.11" ECU_ADDRESS 0xFDC6 /end MEASUREMENT
/begin MEASUREMENT B_kostart "" UBYTE B_TRUE 1 100 0.00 1.00000000000 BIT_MASK 0x80 FORMAT "%13.11" ECU_ADDRESS 0xF0C79 /end MEASUREMENT
/begin MEASUREMENT B_kotmsk "" UBYTE B_TRUE 1 100 0.00 1.00000000000 BIT_MASK 0x2 FORMAT "%13.11" ECU_ADDRESS 0xF0C79 /end MEASUREMENT
/begin MEASUREMENT B_kotmsko "" UBYTE B_TRUE 1 100 0.00 1.00000000000 BIT_MASK 0x4 FORMAT "%13.11" ECU_ADDRESS 0xF0C79 /end MEASUREMENT
/begin MEASUREMENT B_kov "" UWORD B_TRUE 1 100 0.00 1.00000000000 BIT_MASK 0x80 FORMAT "%13.11" ECU_ADDRESS 0xFDC6 /end MEASUREMENT
/begin MEASUREMENT B_kovdown "" UBYTE B_TRUE 1 100 0.00 1.00000000000 BIT_MASK 0x20 FORMAT "%13.11" ECU_ADDRESS 0xF0C79 /end MEASUREMENT
/begin MEASUREMENT B_kovkmtr "" UWORD B_TRUE 1 100 0.00 1.00000000000 BIT_MASK 0x8000 FORMAT "%13.11" ECU_ADDRESS 0xFDCC /end MEASUREMENT
/begin MEASUREMENT B_kow "" UBYTE B_TRUE 1 100 0.00 1.00000000000 BIT_MASK 0x40 FORMAT "%13.11" ECU_ADDRESS 0xF0C79 /end MEASUREMENT
/begin MEASUREMENT B_kr "" UWORD B_TRUE 1 100 0.00 1.00000000000 BIT_MASK 0x40 FORMAT "%13.11" ECU_ADDRESS 0xFD90 /end MEASUREMENT
/begin MEASUREMENT B_kra "" UWORD B_TRUE 1 100 0.00 1.00000000000 BIT_MASK 0x80 FORMAT "%13.11" ECU_ADDRESS 0xFD90 /end MEASUREMENT
/begin MEASUREMENT B_krafrz "" UWORD B_TRUE 1 100 0.00 1.00000000000 BIT_MASK 0x100 FORMAT "%13.11" ECU_ADDRESS 0xFD90 /end MEASUREMENT
/begin MEASUREMENT B_krdws "" UWORD B_TRUE 1 100 0.00 1.00000000000 BIT_MASK 0x200 FORMAT "%13.11" ECU_ADDRESS 0xFD90 /end MEASUREMENT
/begin MEASUREMENT B_krfdks "" UWORD B_TRUE 1 100 0.00 1.00000000000 BIT_MASK 0x400 FORMAT "%13.11" ECU_ADDRESS 0xFD90 /end MEASUREMENT
/begin MEASUREMENT B_krfrz "" UWORD B_TRUE 1 100 0.00 1.00000000000 BIT_MASK 0x800 FORMAT "%13.11" ECU_ADDRESS 0xFD90 /end MEASUREMENT
/begin MEASUREMENT B_krldy "" UWORD B_TRUE 1 100 0.00 1.00000000000 BIT_MASK 0x1000 FORMAT "%13.11" ECU_ADDRESS 0xFD92 /end MEASUREMENT
/begin MEASUREMENT B_krldya "" UWORD B_TRUE 1 100 0.00 1.00000000000 BIT_MASK 0x2000 FORMAT "%13.11" ECU_ADDRESS 0xFD92 /end MEASUREMENT
/begin MEASUREMENT B_krldyf "" UWORD B_TRUE 1 100 0.00 1.00000000000 BIT_MASK 0x4000 FORMAT "%13.11" ECU_ADDRESS 0xFD92 /end MEASUREMENT
/begin MEASUREMENT B_krldyn "" UWORD B_TRUE 1 100 0.00 1.00000000000 BIT_MASK 0x8000 FORMAT "%13.11" ECU_ADDRESS 0xFD92 /end MEASUREMENT
/begin MEASUREMENT B_krldyv "" UWORD B_TRUE 1 100 0.00 1.00000000000 BIT_MASK 0x1 FORMAT "%13.11" ECU_ADDRESS 0xFD94 /end MEASUREMENT
/begin MEASUREMENT B_krlz "" UWORD B_TRUE 1 100 0.00 1.00000000000 BIT_MASK 0x1000 FORMAT "%13.11" ECU_ADDRESS 0xFD90 /end MEASUREMENT
/begin MEASUREMENT B_krlzn "" UWORD B_TRUE 1 100 0.00 1.00000000000 BIT_MASK 0x1fe000 FORMAT "%13.11" ECU_ADDRESS 0xFD90 /end MEASUREMENT
/begin MEASUREMENT B_krndy "" UWORD B_TRUE 1 100 0.00 1.00000000000 BIT_MASK 0x2 FORMAT "%13.11" ECU_ADDRESS 0xFD94 /end MEASUREMENT
/begin MEASUREMENT B_krndyn "" UWORD B_TRUE 1 100 0.00 1.00000000000 BIT_MASK 0x4 FORMAT "%13.11" ECU_ADDRESS 0xFD94 /end MEASUREMENT
/begin MEASUREMENT B_krnl "" UWORD B_TRUE 1 100 0.00 1.00000000000 BIT_MASK 0x4000 FORMAT "%13.11" ECU_ADDRESS 0xFD90 /end MEASUREMENT
/begin MEASUREMENT B_krnlr "" UWORD B_TRUE 1 100 0.00 1.00000000000 BIT_MASK 0x8000 FORMAT "%13.11" ECU_ADDRESS 0xFD90 /end MEASUREMENT
/begin MEASUREMENT B_krstatb "" UWORD B_TRUE 1 100 0.00 1.00000000000 BIT_MASK 0x1 FORMAT "%13.11" ECU_ADDRESS 0xFD92 /end MEASUREMENT
/begin MEASUREMENT B_krvf "" UWORD B_TRUE 1 100 0.00 1.00000000000 BIT_MASK 0x2 FORMAT "%13.11" ECU_ADDRESS 0xFD92 /end MEASUREMENT
/begin MEASUREMENT B_krwa "" UWORD B_TRUE 1 100 0.00 1.00000000000 BIT_MASK 0x4 FORMAT "%13.11" ECU_ADDRESS 0xFD92 /end MEASUREMENT
/begin MEASUREMENT B_kseb1 "" UWORD B_TRUE 1 100 0.00 1.00000000000 BIT_MASK 0x8 FORMAT "%13.11" ECU_ADDRESS 0xFD92 /end MEASUREMENT
/begin MEASUREMENT B_kseb2 "" UWORD B_TRUE 1 100 0.00 1.00000000000 BIT_MASK 0x10 FORMAT "%13.11" ECU_ADDRESS 0xFD92 /end MEASUREMENT
/begin MEASUREMENT B_kuplaus "" UWORD B_TRUE 1 100 0.00 1.00000000000 BIT_MASK 0x8000 FORMAT "%13.11" ECU_ADDRESS 0xFDA0 /end MEASUREMENT
/begin MEASUREMENT B_kvakbi "" UWORD B_TRUE 1 100 0.00 1.00000000000 BIT_MASK 0x20 FORMAT "%13.11" ECU_ADDRESS 0xFDCC /end MEASUREMENT
/begin MEASUREMENT B_lalgf "" UWORD B_TRUE 1 100 0.00 1.00000000000 BIT_MASK 0x20 FORMAT "%13.11" ECU_ADDRESS 0xFD72 /end MEASUREMENT
/begin MEASUREMENT B_lalgf2 "" UWORD B_TRUE 1 100 0.00 1.00000000000 BIT_MASK 0x40 FORMAT "%13.11" ECU_ADDRESS 0xFD72 /end MEASUREMENT
/begin MEASUREMENT B_lambts "" UWORD B_TRUE 1 100 0.00 1.00000000000 BIT_MASK 0x80 FORMAT "%13.11" ECU_ADDRESS 0xFD72 /end MEASUREMENT
/begin MEASUREMENT B_lambts2 "" UWORD B_TRUE 1 100 0.00 1.00000000000 BIT_MASK 0x100 FORMAT "%13.11" ECU_ADDRESS 0xFD72 /end MEASUREMENT
/begin MEASUREMENT B_lamdiag "" UWORD B_TRUE 1 100 0.00 1.00000000000 BIT_MASK 0x200 FORMAT "%13.11" ECU_ADDRESS 0xFD72 /end MEASUREMENT
/begin MEASUREMENT B_lamdiag2 "" UWORD B_TRUE 1 100 0.00 1.00000000000 BIT_MASK 0x400 FORMAT "%13.11" ECU_ADDRESS 0xFD72 /end MEASUREMENT
/begin MEASUREMENT B_lamfas "" UWORD B_TRUE 1 100 0.00 1.00000000000 BIT_MASK 0x100 FORMAT "%13.11" ECU_ADDRESS 0xFD7A /end MEASUREMENT
/begin MEASUREMENT B_lamkh "" UWORD B_TRUE 1 100 0.00 1.00000000000 BIT_MASK 0x800 FORMAT "%13.11" ECU_ADDRESS 0xFD72 /end MEASUREMENT
/begin MEASUREMENT B_lamkhe "" UWORD B_TRUE 1 100 0.00 1.00000000000 BIT_MASK 0x4 FORMAT "%13.11" ECU_ADDRESS 0xFD8E /end MEASUREMENT
/begin MEASUREMENT B_lamnse "" UWORD B_TRUE 1 100 0.00 1.00000000000 BIT_MASK 0x1 FORMAT "%13.11" ECU_ADDRESS 0xFD78 /end MEASUREMENT
/begin MEASUREMENT B_lamnswl "" UWORD B_TRUE 1 100 0.00 1.00000000000 BIT_MASK 0x1000 FORMAT "%13.11" ECU_ADDRESS 0xFD72 /end MEASUREMENT
/begin MEASUREMENT B_lamsdef "" UWORD B_TRUE 1 100 0.00 1.00000000000 BIT_MASK 0x2000 FORMAT "%13.11" ECU_ADDRESS 0xFD72 /end MEASUREMENT
/begin MEASUREMENT B_lawlon "" UWORD B_TRUE 1 100 0.00 1.00000000000 BIT_MASK 0x2 FORMAT "%13.11" ECU_ADDRESS 0xFD78 /end MEASUREMENT
/begin MEASUREMENT B_ldef "" UWORD B_TRUE 1 100 0.00 1.00000000000 BIT_MASK 0x4000 FORMAT "%13.11" ECU_ADDRESS 0xFD72 /end MEASUREMENT
/begin MEASUREMENT B_ldef2 "" UWORD B_TRUE 1 100 0.00 1.00000000000 BIT_MASK 0x8000 FORMAT "%13.11" ECU_ADDRESS 0xFD72 /end MEASUREMENT
/begin MEASUREMENT B_ldeffw "" UWORD B_TRUE 1 100 0.00 1.00000000000 BIT_MASK 0x200 FORMAT "%13.11" ECU_ADDRESS 0xFD7A /end MEASUREMENT
/begin MEASUREMENT B_llr "" UWORD B_TRUE 1 100 0.00 1.00000000000 BIT_MASK 0x4 FORMAT "%13.11" ECU_ADDRESS 0xFDA0 /end MEASUREMENT
/begin MEASUREMENT B_llrein "" UWORD B_TRUE 1 100 0.00 1.00000000000 BIT_MASK 0x8 FORMAT "%13.11" ECU_ADDRESS 0xFDA0 /end MEASUREMENT
/begin MEASUREMENT B_llri "" UWORD B_TRUE 1 100 0.00 1.00000000000 BIT_MASK 0x10 FORMAT "%13.11" ECU_ADDRESS 0xFDA0 /end MEASUREMENT
/begin MEASUREMENT B_llrpd "" UWORD B_TRUE 1 100 0.00 1.00000000000 BIT_MASK 0x20 FORMAT "%13.11" ECU_ADDRESS 0xFDA0 /end MEASUREMENT
/begin MEASUREMENT B_llrpkh "" UWORD B_TRUE 1 100 0.00 1.00000000000 BIT_MASK 0x100 FORMAT "%13.11" ECU_ADDRESS 0xFDA0 /end MEASUREMENT
/begin MEASUREMENT B_llrpst "" UWORD B_TRUE 1 100 0.00 1.00000000000 BIT_MASK 0x200 FORMAT "%13.11" ECU_ADDRESS 0xFDA0 /end MEASUREMENT
/begin MEASUREMENT B_llrst "" UWORD B_TRUE 1 100 0.00 1.00000000000 BIT_MASK 0x400 FORMAT "%13.11" ECU_ADDRESS 0xFDA0 /end MEASUREMENT
/begin MEASUREMENT B_motabw "" UWORD B_TRUE 1 100 0.00 1.00000000000 BIT_MASK 0x1 FORMAT "%13.11" ECU_ADDRESS 0xFDCE /end MEASUREMENT
/begin MEASUREMENT B_nac "" UWORD B_TRUE 1 100 0.00 1.00000000000 BIT_MASK 0x100 FORMAT "%13.11" ECU_ADDRESS 0xFDC6 /end MEASUREMENT
/begin MEASUREMENT B_nlbza "" UBYTE B_TRUE 1 100 0.00 1.00000000000 BIT_MASK 0x80 FORMAT "%13.11" ECU_ADDRESS 0xF0AEC /end MEASUREMENT
/begin MEASUREMENT B_nlbzasb "" UBYTE B_TRUE 1 100 0.00 1.00000000000 BIT_MASK 0x1 FORMAT "%13.11" ECU_ADDRESS 0xF0AEE /end MEASUREMENT
/begin MEASUREMENT B_nlbza_tmp "" UBYTE B_TRUE 1 100 0.00 1.00000000000 BIT_MASK 0x4 FORMAT "%13.11" ECU_ADDRESS 0xF0AEE /end MEASUREMENT
/begin MEASUREMENT B_nlel "" UWORD B_TRUE 1 100 0.00 1.00000000000 BIT_MASK 0x2 FORMAT "%13.11" ECU_ADDRESS 0xFDCE /end MEASUREMENT
/begin MEASUREMENT B_nlphase2 "" UBYTE B_TRUE 1 100 0.00 1.00000000000 BIT_MASK 0x1 FORMAT "%13.11" ECU_ADDRESS 0x38402D /end MEASUREMENT
/begin MEASUREMENT B_nlsgls2 "" UBYTE B_TRUE 1 100 0.00 1.00000000000 BIT_MASK 0x8 FORMAT "%13.11" ECU_ADDRESS 0xF41B8 /end MEASUREMENT
/begin MEASUREMENT B_ns2 "" UBYTE B_TRUE 1 100 0.00 1.00000000000 BIT_MASK 0x2 FORMAT "%13.11" ECU_ADDRESS 0xF0AED /end MEASUREMENT
/begin MEASUREMENT B_ns2a "" UBYTE B_TRUE 1 100 0.00 1.00000000000 BIT_MASK 0x1 FORMAT "%13.11" ECU_ADDRESS 0xF0AF1 /end MEASUREMENT
/begin MEASUREMENT B_nsget "" UWORD B_TRUE 1 100 0.00 1.00000000000 BIT_MASK 0x8000 FORMAT "%13.11" ECU_ADDRESS 0xFD9E /end MEASUREMENT
/begin MEASUREMENT B_nsks "" UBYTE B_TRUE 1 100 0.00 1.00000000000 BIT_MASK 0x4 FORMAT "%13.11" ECU_ADDRESS 0xF0AED /end MEASUREMENT
/begin MEASUREMENT B_nslbzaa1 "" UBYTE B_TRUE 1 100 0.00 1.00000000000 BIT_MASK 0x10 FORMAT "%13.11" ECU_ADDRESS 0xF0AEC /end MEASUREMENT
/begin MEASUREMENT B_nslbzaa2 "" UBYTE B_TRUE 1 100 0.00 1.00000000000 BIT_MASK 0x20 FORMAT "%13.11" ECU_ADDRESS 0xF0AEC /end MEASUREMENT
/begin MEASUREMENT B_nsnwres "" UBYTE B_TRUE 1 100 0.00 1.00000000000 BIT_MASK 0x1 FORMAT "%13.11" ECU_ADDRESS 0x382141 /end MEASUREMENT
/begin MEASUREMENT B_nssl "" UBYTE B_TRUE 1 100 0.00 1.00000000000 BIT_MASK 0x8 FORMAT "%13.11" ECU_ADDRESS 0xF0AED /end MEASUREMENT
/begin MEASUREMENT B_nstabk "" UBYTE B_TRUE 1 100 0.00 1.00000000000 BIT_MASK 0x1 FORMAT "%13.11" ECU_ADDRESS 0xF0AEB /end MEASUREMENT
/begin MEASUREMENT B_nstu "" UWORD B_TRUE 1 100 0.00 1.00000000000 BIT_MASK 0x40 FORMAT "%13.11" ECU_ADDRESS 0xFDA0 /end MEASUREMENT
/begin MEASUREMENT B_nwdn "" UBYTE B_TRUE 1 100 0.00 1.00000000000 BIT_MASK 0x1 FORMAT "%13.11" ECU_ADDRESS 0xF0AEC /end MEASUREMENT
/begin MEASUREMENT B_nwll "" UBYTE B_TRUE 1 100 0.00 1.00000000000 BIT_MASK 0x40 FORMAT "%13.11" ECU_ADDRESS 0xF0AED /end MEASUREMENT
/begin MEASUREMENT B_nwlldif "" UBYTE B_TRUE 1 100 0.00 1.00000000000 BIT_MASK 0x2 FORMAT "%13.11" ECU_ADDRESS 0xF0AEC /end MEASUREMENT
/begin MEASUREMENT B_nwlldif2 "" UBYTE B_TRUE 1 100 0.00 1.00000000000 BIT_MASK 0x4 FORMAT "%13.11" ECU_ADDRESS 0xF0AEC /end MEASUREMENT
/begin MEASUREMENT B_nwlr "" UBYTE B_TRUE 1 100 0.00 1.00000000000 BIT_MASK 0x8 FORMAT "%13.11" ECU_ADDRESS 0xF0AEC /end MEASUREMENT
/begin MEASUREMENT B_tabgbts "" UBYTE B_TRUE 1 100 0.00 1.00000000000 BIT_MASK 0x1 FORMAT "%13.11" ECU_ADDRESS 0xF0914 /end MEASUREMENT
/begin MEASUREMENT B_tatmbts "" UBYTE B_TRUE 1 100 0.00 1.00000000000 BIT_MASK 0x10 FORMAT "%13.11" ECU_ADDRESS 0xF0914 /end MEASUREMENT
/begin MEASUREMENT B_tikatbts "" UBYTE B_TRUE 1 100 0.00 1.00000000000 BIT_MASK 0x8 FORMAT "%13.11" ECU_ADDRESS 0xF0914 /end MEASUREMENT
/begin MEASUREMENT B_tipin "" UWORD B_TRUE 1 100 0.00 1.00000000000 BIT_MASK 0x8 FORMAT "%13.11" ECU_ADDRESS 0xFD94 /end MEASUREMENT
/begin MEASUREMENT B_tisum "" UWORD B_TRUE 1 100 0.00 1.00000000000 BIT_MASK 0x40 FORMAT "%13.11" ECU_ADDRESS 0xFDCC /end MEASUREMENT
/begin MEASUREMENT B_tkatbts "" UBYTE B_TRUE 1 100 0.00 1.00000000000 BIT_MASK 0x2 FORMAT "%13.11" ECU_ADDRESS 0xF0914 /end MEASUREMENT
/begin MEASUREMENT B_tmkmtr "" UWORD B_TRUE 1 100 0.00 1.00000000000 BIT_MASK 0x4 FORMAT "%13.11" ECU_ADDRESS 0xFDCE /end MEASUREMENT
/begin MEASUREMENT B_tmkr "" UWORD B_TRUE 1 100 0.00 1.00000000000 BIT_MASK 0x20 FORMAT "%13.11" ECU_ADDRESS 0xFD92 /end MEASUREMENT
/begin MEASUREMENT B_toelkmtr "" UBYTE B_TRUE 1 100 0.00 1.00000000000 BIT_MASK 0x10 FORMAT "%13.11" ECU_ADDRESS 0xF41B8 /end MEASUREMENT
/begin MEASUREMENT B_tpn "" UBYTE B_TRUE 1 100 0.00 1.00000000000 BIT_MASK 0x40 FORMAT "%13.11" ECU_ADDRESS 0xF0AEC /end MEASUREMENT
/begin MEASUREMENT B_tumkmtr "" UBYTE B_TRUE 1 100 0.00 1.00000000000 BIT_MASK 0x20 FORMAT "%13.11" ECU_ADDRESS 0xF41B8 /end MEASUREMENT
/begin MEASUREMENT B_twilabts "" UBYTE B_TRUE 1 100 0.00 1.00000000000 BIT_MASK 0x20 FORMAT "%13.11" ECU_ADDRESS 0xF0914 /end MEASUREMENT
/begin MEASUREMENT B_twistbts "" UBYTE B_TRUE 1 100 0.00 1.00000000000 BIT_MASK 0x4 FORMAT "%13.11" ECU_ADDRESS 0xF0914 /end MEASUREMENT
/begin MEASUREMENT B_vllr "" UWORD B_TRUE 1 100 0.00 1.00000000000 BIT_MASK 0x80 FORMAT "%13.11" ECU_ADDRESS 0xFDA0 /end MEASUREMENT
/begin MEASUREMENT B_wkral "" UWORD B_TRUE 1 100 0.00 1.00000000000 BIT_MASK 0x40 FORMAT "%13.11" ECU_ADDRESS 0xFD92 /end MEASUREMENT
/begin MEASUREMENT B_zwafh "" UWORD B_TRUE 1 100 0.00 1.00000000000 BIT_MASK 0x1 FORMAT "%13.11" ECU_ADDRESS 0xFDA2 /end MEASUREMENT
/begin MEASUREMENT B_zwkraa "" UWORD B_TRUE 1 100 0.00 1.00000000000 BIT_MASK 0x80 FORMAT "%13.11" ECU_ADDRESS 0xFD92 /end MEASUREMENT
/begin MEASUREMENT B_zwkrum "" UWORD B_TRUE 1 100 0.00 1.00000000000 BIT_MASK 0x100 FORMAT "%13.11" ECU_ADDRESS 0xFD92 /end MEASUREMENT
/begin MEASUREMENT B_zwp "" UWORD B_TRUE 1 100 0.00 1.00000000000 BIT_MASK 0x8 FORMAT "%13.11" ECU_ADDRESS 0xFDCE /end MEASUREMENT
/begin MEASUREMENT B_zwp2 "" UWORD B_TRUE 1 100 0.00 1.00000000000 BIT_MASK 0x10 FORMAT "%13.11" ECU_ADDRESS 0xFDCE /end MEASUREMENT
/begin MEASUREMENT detazwbs "" UBYTE rel_ub_b127p5 1 100 0.00 127.5 FORMAT "%5.1" ECU_ADDRESS 0xF40FD /end MEASUREMENT
/begin MEASUREMENT dkmts "" SBYTE temp_sb_q0p75 1 100 -96.00 95.25 FORMAT "%5.2" ECU_ADDRESS 0xF41AE /end MEASUREMENT
/begin MEASUREMENT dlambts_w "" SWORD fak_sw_b8 1 100 -8.000000 7.999756 FORMAT "%8.6" ECU_ADDRESS 0xF46BC /end MEASUREMENT
/begin MEASUREMENT dlbtsug "" SBYTE fak_sb_b1 1 100 -1.000 0.9922 FORMAT "%5.3" ECU_ADDRESS 0xF40FE /end MEASUREMENT
/begin MEASUREMENT dmllrdl_w "" SWORD rel_sw_b100 1 100 -100.0000 99.99695 FORMAT "%8.4" ECU_ADDRESS 0xF23B2 /end MEASUREMENT
/begin MEASUREMENT dmllrd_w "" SWORD rel_sw_b100 1 100 -100.0000 99.99695 FORMAT "%8.4" ECU_ADDRESS 0xF23B4 /end MEASUREMENT
/begin MEASUREMENT dmllrib_w "" SWORD rel_sw_b100 1 100 -100.0000 99.99695 FORMAT "%8.4" ECU_ADDRESS 0xF23B6 /end MEASUREMENT
/begin MEASUREMENT dmllrii_w "" SWORD rel_sw_b100 1 100 -100.0000 99.99695 FORMAT "%8.4" ECU_ADDRESS 0xF23B8 /end MEASUREMENT
/begin MEASUREMENT dmllriz_w "" SWORD rel_sw_b100 1 100 -100.0000 99.99695 FORMAT "%8.4" ECU_ADDRESS 0xF23BA /end MEASUREMENT
/begin MEASUREMENT dmllri_w "" SWORD rel_sw_b100 1 100 -100.0000 99.99695 FORMAT "%8.4" ECU_ADDRESS 0xF23BC /end MEASUREMENT
/begin MEASUREMENT dmllrl_w "" SWORD rel_sw_b100 1 100 -100.0000 99.99695 FORMAT "%8.4" ECU_ADDRESS 0xF23BE /end MEASUREMENT
/begin MEASUREMENT dmllrpl_w "" SWORD rel_sw_b100 1 100 -100.0000 99.99695 FORMAT "%8.4" ECU_ADDRESS 0xF23C0 /end MEASUREMENT
/begin MEASUREMENT dmllrp_w "" SWORD rel_sw_b100 1 100 -100.0000 99.99695 FORMAT "%8.4" ECU_ADDRESS 0xF23C2 /end MEASUREMENT
/begin MEASUREMENT dmllr_w "" SWORD rel_sw_b100 1 100 -100.0000 99.99695 FORMAT "%8.4" ECU_ADDRESS 0xF23C4 /end MEASUREMENT
/begin MEASUREMENT dmresll_w "" UWORD rel_uw_b100 1 100 0.00 99.99847 FORMAT "%8.5" ECU_ADDRESS 0xF2436 /end MEASUREMENT
/begin MEASUREMENT dmrllr_w "" UWORD rel_uw_b100 1 100 0.00 99.99847 FORMAT "%8.5" ECU_ADDRESS 0xF2438 /end MEASUREMENT
/begin MEASUREMENT dmrnwa_w "" UWORD rel_uw_b100 1 100 0.00 99.99847 FORMAT "%8.5" ECU_ADDRESS 0xF243A /end MEASUREMENT
/begin MEASUREMENT dmrnwe_w "" UWORD rel_uw_b100 1 100 0.00 99.99847 FORMAT "%8.5" ECU_ADDRESS 0xF243C /end MEASUREMENT
/begin MEASUREMENT dmvllrsu_w "" UWORD rel_uw_b100 1 100 0.00 99.99847 FORMAT "%8.5" ECU_ADDRESS 0xF243E /end MEASUREMENT
/begin MEASUREMENT dn "" SBYTE nmotd_sb_q10 1 100 -1280. 1270. FORMAT "%5.0" ECU_ADDRESS 0xF0B0B /end MEASUREMENT
/begin MEASUREMENT dnbi_w "" SWORD nmot_sw_q0p25 1 100 -8192.000 8191.750 FORMAT "%8.3" ECU_ADDRESS 0xF23C6 /end MEASUREMENT
/begin MEASUREMENT dnikorr_w "" UWORD nmot_uw_q0p25 1 100 0.00 16383.75 FORMAT "%8.2" ECU_ADDRESS 0xF23C8 /end MEASUREMENT
/begin MEASUREMENT dns "" SBYTE nmotd_sb_q10 1 100 -1280. 1270. FORMAT "%5.0" ECU_ADDRESS 0xF0AEA /end MEASUREMENT
/begin MEASUREMENT dn_w "" SWORD nmot_sw_q0p25 1 100 -8192.000 8191.750 FORMAT "%8.3" ECU_ADDRESS 0xF23CA /end MEASUREMENT
/begin MEASUREMENT dqueber "" UBYTE rel_ub_q0p75_o48 1 100 -48.00 143.3 FORMAT "%5.1" ECU_ADDRESS 0xF41AF /end MEASUREMENT
/begin MEASUREMENT drlkrav "" SWORD rel_sw_q0p0234 1 100 -768.0000 767.9766 FORMAT "%8.4" ECU_ADDRESS 0xF2302 /end MEASUREMENT
/begin MEASUREMENT drlkrdy "" SWORD rel_sw_q0p0234 1 100 -768.0000 767.9766 FORMAT "%8.4" ECU_ADDRESS 0xF2304 /end MEASUREMENT
/begin MEASUREMENT drlkrra "" SWORD rel_sw_q0p0234 1 100 -768.0000 767.9766 FORMAT "%8.4" ECU_ADDRESS 0xF2306 /end MEASUREMENT
/begin MEASUREMENT dtka "" SBYTE temp_sb_q0p75 1 100 -96.00 95.25 FORMAT "%5.2" ECU_ADDRESS 0xF41B0 /end MEASUREMENT
/begin MEASUREMENT dtkaint "" SBYTE rel_sb_q0p75 1 100 -96.00 95.25 FORMAT "%5.2" ECU_ADDRESS 0xF41B1 /end MEASUREMENT
/begin MEASUREMENT dtmtka "" SBYTE temp_sb_q0p75 1 100 -96.00 95.25 FORMAT "%5.2" ECU_ADDRESS 0xF41B2 /end MEASUREMENT
/begin MEASUREMENT dwkr "" SBYTE zw_sb_q0p75 1 100 -96.00 95.25 FORMAT "%5.2" ECU_ADDRESS 0xF0A99 /end MEASUREMENT
/begin MEASUREMENT dwkrmsw "" UBYTE zw_ub_qn0p75 1 100 -191.3 0.00 FORMAT "%5.1" ECU_ADDRESS 0xF0A9A /end MEASUREMENT
/begin MEASUREMENT dwkrz "" SBYTE zw_sb_q0p75 1 100 -96.00 95.25 FORMAT "%5.2" ARRAY_SIZE 8 ECU_ADDRESS 0xF0A9B /end MEASUREMENT
/begin MEASUREMENT dyesv "" SWORD rel_sw_q0p0234 1 100 -768.0000 767.9766 FORMAT "%8.4" ECU_ADDRESS 0xF2308 /end MEASUREMENT
/begin MEASUREMENT dymntv "" UBYTE zw_ub_qn0p75 1 100 -191.3 0.00 FORMAT "%5.1" ECU_ADDRESS 0xF0AC0 /end MEASUREMENT
/begin MEASUREMENT dyrsofv "" SWORD rel_sw_q0p0234 1 100 -768.0000 767.9766 FORMAT "%8.4" ECU_ADDRESS 0xF230A /end MEASUREMENT
/begin MEASUREMENT dyrsv "" SWORD rel_sw_q0p0234 1 100 -768.0000 767.9766 FORMAT "%8.4" ECU_ADDRESS 0xF230C /end MEASUREMENT
/begin MEASUREMENT dzwg "" SBYTE zw_sb_q0p75 1 100 -96.00 95.25 FORMAT "%5.2" ECU_ADDRESS 0xF40FF /end MEASUREMENT
/begin MEASUREMENT dzwlamfaw "" UBYTE zw_ub_qn0p75 1 100 -191.3 0.00 FORMAT "%5.1" ECU_ADDRESS 0xF40ED /end MEASUREMENT
/begin MEASUREMENT esst_sdn10llsw "" UWORD dez 1 100 0.00 65535.00 FORMAT "%8.2" ECU_ADDRESS 0xF23CC /end MEASUREMENT
/begin MEASUREMENT esst_sdz06gkub "" UWORD dez 1 100 0.00 65535.00 FORMAT "%8.2" ECU_ADDRESS 0xF466A /end MEASUREMENT
/begin MEASUREMENT esst_sez04llub "" UWORD dez 1 100 0.00 65535.00 FORMAT "%8.2" ECU_ADDRESS 0xF23CE /end MEASUREMENT
/begin MEASUREMENT esst_sga08llub "" UWORD dez 1 100 0.00 65535.00 FORMAT "%8.2" ECU_ADDRESS 0xF4744 /end MEASUREMENT
/begin MEASUREMENT esst_snm06gkub "" UWORD dez 1 100 0.00 65535.00 FORMAT "%8.2" ECU_ADDRESS 0xF466C /end MEASUREMENT
/begin MEASUREMENT esst_snm08koub "" UWORD dez 1 100 0.00 65535.00 FORMAT "%8.2" ECU_ADDRESS 0x383162 /end MEASUREMENT
/begin MEASUREMENT esst_snm16gkub "" UWORD dez 1 100 0.00 65535.00 FORMAT "%8.2" ECU_ADDRESS 0xF46BE /end MEASUREMENT
/begin MEASUREMENT esst_sns06llsb "" UWORD dez 1 100 0.00 65535.00 FORMAT "%8.2" ECU_ADDRESS 0xF2390 /end MEASUREMENT
/begin MEASUREMENT esst_sns206llsb "" UWORD dez 1 100 0.00 65535.00 FORMAT "%8.2" ECU_ADDRESS 0xF23D0 /end MEASUREMENT
/begin MEASUREMENT esst_srl06gkub "" UWORD dez 1 100 0.00 65535.00 FORMAT "%8.2" ECU_ADDRESS 0xF466E /end MEASUREMENT
/begin MEASUREMENT esst_srl12gkuw "" UWORD dez 1 100 0.00 65535.00 FORMAT "%8.2" ECU_ADDRESS 0xF46C0 /end MEASUREMENT
/begin MEASUREMENT esst_stm08gkub "" UWORD dez 1 100 0.00 65535.00 FORMAT "%8.2" ECU_ADDRESS 0xF4670 /end MEASUREMENT
/begin MEASUREMENT esst_sts05dtka "" UWORD dez 1 100 0.00 65535.00 FORMAT "%8.2" ECU_ADDRESS 0xF4FBA /end MEASUREMENT
/begin MEASUREMENT esst_sts05dtts "" UWORD dez 1 100 0.00 65535.00 FORMAT "%8.2" ECU_ADDRESS 0xF4FBC /end MEASUREMENT
/begin MEASUREMENT etazwg "" UBYTE rel_ub_b127p5 1 100 0.00 127.5 FORMAT "%5.1" ECU_ADDRESS 0xF4100 /end MEASUREMENT
/begin MEASUREMENT fhoehk "" UBYTE fak_ub_b2p55 1 100 0.00 2.550 FORMAT "%5.3" ECU_ADDRESS 0xF41B3 /end MEASUREMENT
/begin MEASUREMENT flashzlr "" UBYTE dez 1 100 0.00 255.0 FORMAT "%5.1" ECU_ADDRESS 0xF41B4 /end MEASUREMENT
/begin MEASUREMENT flaskh "" UBYTE fak_ub_b1 1 100 0.00 0.9961 ECU_ADDRESS 0xF4121 /end MEASUREMENT
/begin MEASUREMENT flbts_w "" UWORD fak_uw_b2 1 100 0.00 1.999969 FORMAT "%8.6" ECU_ADDRESS 0xF46C2 /end MEASUREMENT
/begin MEASUREMENT flmsslkh "" UBYTE fak_ub_b1 1 100 0.00 0.9961 ECU_ADDRESS 0xF4122 /end MEASUREMENT
/begin MEASUREMENT fslsdyn "" UBYTE fak_ub_b1 1 100 0.00 0.9961 ECU_ADDRESS 0xF4123 /end MEASUREMENT
/begin MEASUREMENT gangllr "" UBYTE dez 1 100 0.00 255.0 FORMAT "%5.1" ECU_ADDRESS 0xF414C /end MEASUREMENT
/begin MEASUREMENT ikrrkr_wert "" UBYTE dez 1 100 0.00 255.0 FORMAT "%5.1" ECU_ADDRESS 0xF0A70 /end MEASUREMENT
/begin MEASUREMENT ikr_kek_wert "" UBYTE dez 1 100 0.00 255.0 FORMAT "%5.1" ECU_ADDRESS 0xF0A71 /end MEASUREMENT
/begin MEASUREMENT int_ctr "" UBYTE dez 1 100 0.00 255.0 FORMAT "%5.1" ECU_ADDRESS 0xF0C7C /end MEASUREMENT
/begin MEASUREMENT iver "" UBYTE rel_q0p002383 1 100 0.00 0.6076 ECU_ADDRESS 0xF0B0C /end MEASUREMENT
/begin MEASUREMENT ke "" UBYTE fak_ub_b16 1 100 0.00 15.94 FORMAT "%5.2" ARRAY_SIZE 8 ECU_ADDRESS 0xF4124 /end MEASUREMENT
/begin MEASUREMENT kek "" UBYTE fak_ub_b16 1 100 0.00 15.94 FORMAT "%5.2" ARRAY_SIZE 8 ECU_ADDRESS 0xF0A72 /end MEASUREMENT
/begin MEASUREMENT kek_tst "" UBYTE fak_ub_b16 1 100 0.00 15.94 FORMAT "%5.2" ECU_ADDRESS 0xF0A7A /end MEASUREMENT
/begin MEASUREMENT klah "" UBYTE temp_ub_q0p75_o48 1 100 -48.00 143.3 FORMAT "%5.1" ECU_ADDRESS 0xF41B5 /end MEASUREMENT
/begin MEASUREMENT klahtmsmx "" UBYTE temp_ub_q0p75_o48 1 100 -48.00 143.3 FORMAT "%5.1" ECU_ADDRESS 0xF41B6 /end MEASUREMENT
/begin MEASUREMENT kral1w "" UBYTE rel_ub_q0p75 1 100 0.00 191.3 FORMAT "%5.1" ECU_ADDRESS 0xF412E /end MEASUREMENT
/begin MEASUREMENT kral2w "" UBYTE rel_ub_q0p75 1 100 0.00 191.3 FORMAT "%5.1" ECU_ADDRESS 0xF412F /end MEASUREMENT
/begin MEASUREMENT kral3w "" UBYTE rel_ub_q0p75 1 100 0.00 191.3 FORMAT "%5.1" ECU_ADDRESS 0xF4130 /end MEASUREMENT
/begin MEASUREMENT krdwsw "" UBYTE zw_ub_qn0p75 1 100 -191.3 0.00 FORMAT "%5.1" ECU_ADDRESS 0xF0AA3 /end MEASUREMENT
/begin MEASUREMENT krfkw "" UBYTE zw_ub_qn0p75 1 100 -191.3 0.00 FORMAT "%5.1" ECU_ADDRESS 0xF0AA4 /end MEASUREMENT
/begin MEASUREMENT krftpakt "" UBYTE dez 1 100 0.00 255.0 FORMAT "%5.1" ECU_ADDRESS 0xF0A7B /end MEASUREMENT
/begin MEASUREMENT krlzn "" UBYTE dez 1 100 0.00 255.0 FORMAT "%5.1" ECU_ADDRESS 0xF0AA5 /end MEASUREMENT
/begin MEASUREMENT krmxw "" UBYTE zw_ub_qn0p75 1 100 -191.3 0.00 FORMAT "%5.1" ECU_ADDRESS 0xF0AA6 /end MEASUREMENT
/begin MEASUREMENT krtmso "" UBYTE zw_ub_qn0p75 1 100 -191.3 0.00 FORMAT "%5.1" ECU_ADDRESS 0xF41B9 /end MEASUREMENT
/begin MEASUREMENT krvfsw "" UBYTE dez 1 100 0.00 255.0 FORMAT "%5.1" ECU_ADDRESS 0xF0AA7 /end MEASUREMENT
/begin MEASUREMENT krvfw "" UBYTE dez 1 100 0.00 255.0 FORMAT "%5.1" ECU_ADDRESS 0xF0AA8 /end MEASUREMENT
/begin MEASUREMENT ktvlue1 "" SBYTE fak_sb_b127 1 100 -128.0 127.0 FORMAT "%5.1" ECU_ADDRESS 0xF41BA /end MEASUREMENT
/begin MEASUREMENT ktvlue2 "" SBYTE fak_sb_b127 1 100 -128.0 127.0 FORMAT "%5.1" ECU_ADDRESS 0xF41BB /end MEASUREMENT
/begin MEASUREMENT kvakbi_w "" UWORD dez 1 100 0.00 65535.00 FORMAT "%8.2" ECU_ADDRESS 0xF2C82 /end MEASUREMENT
/begin MEASUREMENT LAKHlokBits "" UBYTE dez 1 100 0.00 255.0 FORMAT "%5.1" ECU_ADDRESS 0xF0A58 /end MEASUREMENT
/begin MEASUREMENT lambas "" UBYTE fak_ub_b2 1 100 0.00 1.992 FORMAT "%5.3" ECU_ADDRESS 0xF08ED /end MEASUREMENT
/begin MEASUREMENT lambas_w "" UWORD fak_uw_b16 1 100 0.00 15.99976 FORMAT "%8.5" ECU_ADDRESS 0xF1F88 /end MEASUREMENT
/begin MEASUREMENT lambts2_w "" UWORD fak_uw_b16 1 100 0.00 15.99976 FORMAT "%8.5" ECU_ADDRESS 0xF46C4 /end MEASUREMENT
/begin MEASUREMENT LAMBTSlokbits "" UBYTE dez 1 100 0.00 255.0 FORMAT "%5.1" ECU_ADDRESS 0xF0914 /end MEASUREMENT
/begin MEASUREMENT lambts_w "" UWORD fak_uw_b16 1 100 0.00 15.99976 FORMAT "%8.5" ECU_ADDRESS 0xF46C6 /end MEASUREMENT
/begin MEASUREMENT lamdiag2_w "" UWORD fak_uw_b16 1 100 0.00 15.99976 FORMAT "%8.5" ECU_ADDRESS 0xF1F8A /end MEASUREMENT
/begin MEASUREMENT lamdiag_w "" UWORD fak_uw_b16 1 100 0.00 15.99976 FORMAT "%8.5" ECU_ADDRESS 0xF1F8C /end MEASUREMENT
/begin MEASUREMENT lamfawkr_w "" UWORD fak_uw_b16 1 100 0.00 15.99976 FORMAT "%8.5" ECU_ADDRESS 0xF4672 /end MEASUREMENT
/begin MEASUREMENT lamfaws_w "" UWORD fak_uw_b16 1 100 0.00 15.99976 FORMAT "%8.5" ECU_ADDRESS 0xF4674 /end MEASUREMENT
/begin MEASUREMENT lamfaw_w "" UWORD fak_uw_b16 1 100 0.00 15.99976 FORMAT "%8.5" ECU_ADDRESS 0xF4676 /end MEASUREMENT
/begin MEASUREMENT lamfa_w "" UWORD fak_uw_b16 1 100 0.00 15.99976 FORMAT "%8.5" ECU_ADDRESS 0xF4678 /end MEASUREMENT
/begin MEASUREMENT lamfwl_w "" UWORD fak_uw_b16 1 100 0.00 15.99976 FORMAT "%8.5" ECU_ADDRESS 0xF467A /end MEASUREMENT
/begin MEASUREMENT lamkh2_w "" UWORD fak_q0p000244 1 100 0.00 15.99976 FORMAT "%8.5" ECU_ADDRESS 0xF22BA /end MEASUREMENT
/begin MEASUREMENT lamkhe2_w "" UWORD fak_uw_b16 1 100 0.00 15.99976 FORMAT "%8.5" ECU_ADDRESS 0xF1F8E /end MEASUREMENT
/begin MEASUREMENT lamkhe_w "" UWORD fak_uw_b16 1 100 0.00 15.99976 FORMAT "%8.5" ECU_ADDRESS 0xF1F90 /end MEASUREMENT
/begin MEASUREMENT lamkhg2_w "" UWORD fak_q0p000244 1 100 0.00 15.99976 FORMAT "%8.5" ECU_ADDRESS 0xF22BC /end MEASUREMENT
/begin MEASUREMENT lamkhg_w "" UWORD fak_q0p000244 1 100 0.00 15.99976 FORMAT "%8.5" ECU_ADDRESS 0xF22BE /end MEASUREMENT
/begin MEASUREMENT lamkhr2_w "" UWORD fak_q0p000244 1 100 0.00 15.99976 FORMAT "%8.5" ECU_ADDRESS 0xF470A /end MEASUREMENT
/begin MEASUREMENT lamkhr_w "" UWORD fak_q0p000244 1 100 0.00 15.99976 FORMAT "%8.5" ECU_ADDRESS 0xF470C /end MEASUREMENT
/begin MEASUREMENT lamkh_w "" UWORD fak_q0p000244 1 100 0.00 15.99976 FORMAT "%8.5" ECU_ADDRESS 0xF22C0 /end MEASUREMENT
/begin MEASUREMENT lamlgfmn "" UBYTE fak_ub_b2 1 100 0.00 1.992 FORMAT "%5.3" ECU_ADDRESS 0xF40E8 /end MEASUREMENT
/begin MEASUREMENT lamlgm "" UBYTE fak_ub_b2 1 100 0.00 1.992 FORMAT "%5.3" ECU_ADDRESS 0xF40E9 /end MEASUREMENT
/begin MEASUREMENT lamnswl_w "" UWORD fak_uw_b16 1 100 0.00 15.99976 FORMAT "%8.5" ECU_ADDRESS 0xF1FC4 /end MEASUREMENT
/begin MEASUREMENT lamns_w "" UWORD fak_uw_b16 1 100 0.00 15.99976 FORMAT "%8.5" ECU_ADDRESS 0xF1FC6 /end MEASUREMENT
/begin MEASUREMENT lamrlmn_w "" UWORD fak_uw_b16 1 100 0.00 15.99976 FORMAT "%8.5" ECU_ADDRESS 0xF467C /end MEASUREMENT
/begin MEASUREMENT lams2_w "" UWORD fak_uw_b16 1 100 0.00 15.99976 FORMAT "%8.5" ECU_ADDRESS 0xF1F92 /end MEASUREMENT
/begin MEASUREMENT lamsbg2_w "" UWORD fak_uw_b16 1 100 0.00 15.99976 FORMAT "%8.5" ECU_ADDRESS 0xF1F94 /end MEASUREMENT
/begin MEASUREMENT lamsbg_w "" UWORD fak_uw_b16 1 100 0.00 15.99976 FORMAT "%8.5" ECU_ADDRESS 0xF1F96 /end MEASUREMENT
/begin MEASUREMENT lamsubg2_w "" UWORD fak_uw_b16 1 100 0.00 15.99976 FORMAT "%8.5" ECU_ADDRESS 0xF1F98 /end MEASUREMENT
/begin MEASUREMENT lamsubg_w "" UWORD fak_uw_b16 1 100 0.00 15.99976 FORMAT "%8.5" ECU_ADDRESS 0xF1F9A /end MEASUREMENT
/begin MEASUREMENT lams_w "" UWORD fak_uw_b16 1 100 0.00 15.99976 FORMAT "%8.5" ECU_ADDRESS 0xF1F9C /end MEASUREMENT
/begin MEASUREMENT lamvoa2_w "" UWORD fak_uw_b16 1 100 0.00 15.99976 FORMAT "%8.5" ECU_ADDRESS 0xF1F9E /end MEASUREMENT
/begin MEASUREMENT lamvoa_w "" UWORD fak_uw_b16 1 100 0.00 15.99976 FORMAT "%8.5" ECU_ADDRESS 0xF1FA0 /end MEASUREMENT
/begin MEASUREMENT lamwl_w "" UWORD fak_uw_b16 1 100 0.00 15.99976 FORMAT "%8.5" ECU_ADDRESS 0xF1FC8 /end MEASUREMENT
/begin MEASUREMENT lanskh_w "" UWORD fak_q0p000244 1 100 0.00 15.99976 FORMAT "%8.5" ECU_ADDRESS 0xF470E /end MEASUREMENT
/begin MEASUREMENT lasdslg2_w "" UWORD fak_q0p000244 1 100 0.00 15.99976 FORMAT "%8.5" ECU_ADDRESS 0xF4710 /end MEASUREMENT
/begin MEASUREMENT lasdslg_w "" UWORD fak_q0p000244 1 100 0.00 15.99976 FORMAT "%8.5" ECU_ADDRESS 0xF4712 /end MEASUREMENT
/begin MEASUREMENT lasdsl_w "" UWORD fak_q0p000244 1 100 0.00 15.99976 FORMAT "%8.5" ECU_ADDRESS 0xF4714 /end MEASUREMENT
/begin MEASUREMENT laskh_w "" UWORD fak_q0p000244 1 100 0.00 15.99976 FORMAT "%8.5" ECU_ADDRESS 0xF4716 /end MEASUREMENT
/begin MEASUREMENT lbts2_w "" UWORD fak_uw_b16 1 100 0.00 15.99976 FORMAT "%8.5" ECU_ADDRESS 0xF46C8 /end MEASUREMENT
/begin MEASUREMENT lbtsbg_w "" UWORD fak_uw_b16 1 100 0.00 15.99976 FORMAT "%8.5" ECU_ADDRESS 0xF46CA /end MEASUREMENT
/begin MEASUREMENT lbtsdy_w "" UWORD fak_uw_b16 1 100 0.00 15.99976 FORMAT "%8.5" ECU_ADDRESS 0xF206A /end MEASUREMENT
/begin MEASUREMENT lbtsubg2_w "" UWORD fak_uw_b16 1 100 0.00 15.99976 FORMAT "%8.5" ECU_ADDRESS 0xF46CC /end MEASUREMENT
/begin MEASUREMENT lbtsubg_w "" UWORD fak_uw_b16 1 100 0.00 15.99976 FORMAT "%8.5" ECU_ADDRESS 0xF46CE /end MEASUREMENT
/begin MEASUREMENT lbts_w "" UWORD fak_uw_b16 1 100 0.00 15.99976 FORMAT "%8.5" ECU_ADDRESS 0xF46D0 /end MEASUREMENT
/begin MEASUREMENT limax_w "" SWORD rel_sw_b100 1 100 -100.0000 99.99695 FORMAT "%8.4" ECU_ADDRESS 0xF23D2 /end MEASUREMENT
/begin MEASUREMENT limin_w "" SWORD rel_sw_b100 1 100 -100.0000 99.99695 FORMAT "%8.4" ECU_ADDRESS 0xF23D4 /end MEASUREMENT
/begin MEASUREMENT limnst "" UBYTE rel_ub_b24p9 1 100 0.00 24.90 FORMAT "%5.2" ECU_ADDRESS 0xF0B0D /end MEASUREMENT
/begin MEASUREMENT lkraw "" UBYTE rel_ub_q0p75 1 100 0.00 191.3 FORMAT "%5.1" ECU_ADDRESS 0xF4131 /end MEASUREMENT
/begin MEASUREMENT lkrnew "" SWORD rel_sw_q0p0234 1 100 -768.0000 767.9766 FORMAT "%8.4" ECU_ADDRESS 0xF230E /end MEASUREMENT
/begin MEASUREMENT lkrold "" SWORD rel_sw_q0p0234 1 100 -768.0000 767.9766 FORMAT "%8.4" ECU_ADDRESS 0xF2310 /end MEASUREMENT
/begin MEASUREMENT lkrw "" UBYTE rel_ub_q0p75 1 100 0.00 191.3 FORMAT "%5.1" ECU_ADDRESS 0xF4132 /end MEASUREMENT
/begin MEASUREMENT lmskh_w "" UWORD fak_q0p000244 1 100 0.00 15.99976 FORMAT "%8.5" ECU_ADDRESS 0xF4718 /end MEASUREMENT
/begin MEASUREMENT lmssl2_w "" UWORD fak_q0p000244 1 100 0.00 15.99976 FORMAT "%8.5" ECU_ADDRESS 0xF471A /end MEASUREMENT
/begin MEASUREMENT lmssl_w "" UWORD fak_q0p000244 1 100 0.00 15.99976 FORMAT "%8.5" ECU_ADDRESS 0xF471C /end MEASUREMENT
/begin MEASUREMENT luelogin "" UWORD dez 1 100 0.00 65535.00 FORMAT "%8.2" ECU_ADDRESS 0xF4FBE /end MEASUREMENT
/begin MEASUREMENT lzist "" UBYTE dez 1 100 0.00 255.0 FORMAT "%5.1" ARRAY_SIZE 6 ECU_ADDRESS 0x382095 /end MEASUREMENT
/begin MEASUREMENT ngasf_w "" SWORD nmotg_sw_q0p39 1 100 -12800.16 12799.77 FORMAT "%8.2" ECU_ADDRESS 0xF23D6 /end MEASUREMENT
/begin MEASUREMENT ngkraf_w "" SWORD nmotg_sw_q0p39 1 100 -12800.16 12799.77 FORMAT "%8.2" ECU_ADDRESS 0xF2312 /end MEASUREMENT
/begin MEASUREMENT ngkrav_w "" SWORD nmotg_sw_q0p39 1 100 -12800.16 12799.77 FORMAT "%8.2" ECU_ADDRESS 0xF2314 /end MEASUREMENT
/begin MEASUREMENT ngkrv_w "" SWORD nmotg_sw_q0p39 1 100 -12800.16 12799.77 FORMAT "%8.2" ECU_ADDRESS 0xF2316 /end MEASUREMENT
/begin MEASUREMENT nllcvt2 "" UBYTE nmot_ub_q10 1 100 0.00 2550. FORMAT "%5.0" ECU_ADDRESS 0xF0AF5 /end MEASUREMENT
/begin MEASUREMENT nlue1 "" UBYTE nmot_ub_q20 1 100 0.00 5100. FORMAT "%5.0" ECU_ADDRESS 0xF41BC /end MEASUREMENT
/begin MEASUREMENT nlue1mn "" UBYTE nmot_ub_q20 1 100 0.00 5100. FORMAT "%5.0" ECU_ADDRESS 0xF41BD /end MEASUREMENT
/begin MEASUREMENT nlue2 "" UBYTE nmot_ub_q20 1 100 0.00 5100. FORMAT "%5.0" ECU_ADDRESS 0xF41BE /end MEASUREMENT
/begin MEASUREMENT nlue2mn "" UBYTE nmot_ub_q20 1 100 0.00 5100. FORMAT "%5.0" ECU_ADDRESS 0xF41BF /end MEASUREMENT
/begin MEASUREMENT nluez1 "" UBYTE nmot_ub_q20 1 100 0.00 5100. FORMAT "%5.0" ECU_ADDRESS 0xF41C0 /end MEASUREMENT
/begin MEASUREMENT nluez2 "" UBYTE nmot_ub_q20 1 100 0.00 5100. FORMAT "%5.0" ECU_ADDRESS 0xF41C1 /end MEASUREMENT
/begin MEASUREMENT nsfsm "" UBYTE nmot_ub_q10 1 100 0.00 2550. FORMAT "%5.0" ECU_ADDRESS 0xF4156 /end MEASUREMENT
/begin MEASUREMENT nsfsmn "" UBYTE nmot_ub_q10 1 100 0.00 2550. FORMAT "%5.0" ECU_ADDRESS 0xF0AF6 /end MEASUREMENT
/begin MEASUREMENT nslbz "" UBYTE nmot_ub_q10 1 100 0.00 2550. FORMAT "%5.0" ECU_ADDRESS 0xF4157 /end MEASUREMENT
/begin MEASUREMENT nslbzaa "" UBYTE nmot_ub_q10 1 100 0.00 2550. FORMAT "%5.0" ECU_ADDRESS 0xF0AF7 /end MEASUREMENT
/begin MEASUREMENT nslbzamx "" UBYTE nmot_ub_q10 1 100 0.00 2550. FORMAT "%5.0" ECU_ADDRESS 0xF0AF8 /end MEASUREMENT
/begin MEASUREMENT nslfa "" UBYTE nmot_ub_q10 1 100 0.00 2550. FORMAT "%5.0" ECU_ADDRESS 0xF0B19 /end MEASUREMENT
/begin MEASUREMENT nsllm "" UBYTE nmot_ub_q10 1 100 0.00 2550. FORMAT "%5.0" ECU_ADDRESS 0xF4158 /end MEASUREMENT
/begin MEASUREMENT nsllmn "" UBYTE nmot_ub_q10 1 100 0.00 2550. FORMAT "%5.0" ECU_ADDRESS 0xF0AF9 /end MEASUREMENT
/begin MEASUREMENT nsnbz "" UBYTE nmot_ub_q10 1 100 0.00 2550. FORMAT "%5.0" ECU_ADDRESS 0xF0AFA /end MEASUREMENT
/begin MEASUREMENT nsnf "" UBYTE nmot_ub_q10 1 100 0.00 2550. FORMAT "%5.0" ECU_ADDRESS 0xF0AFB /end MEASUREMENT
/begin MEASUREMENT nsnw "" UBYTE nmot_ub_q10 1 100 0.00 2550. FORMAT "%5.0" ECU_ADDRESS 0xF0AFC /end MEASUREMENT
/begin MEASUREMENT nsnwi "" UBYTE nmot_ub_q10 1 100 0.00 2550. FORMAT "%5.0" ECU_ADDRESS 0x382142 /end MEASUREMENT
/begin MEASUREMENT nsnwib "" UBYTE nmot_ub_q10 1 100 0.00 2550. FORMAT "%5.0" ECU_ADDRESS 0xF0AFD /end MEASUREMENT
/begin MEASUREMENT nsnwibz "" UBYTE nmot_ub_q10 1 100 0.00 2550. FORMAT "%5.0" ECU_ADDRESS 0xF0AFE /end MEASUREMENT
/begin MEASUREMENT nsnwmx "" UBYTE nmot_ub_q10 1 100 0.00 2550. FORMAT "%5.0" ECU_ADDRESS 0xF0AFF /end MEASUREMENT
/begin MEASUREMENT nsnwnaf "" UBYTE nmot_ub_q10 1 100 0.00 2550. FORMAT "%5.0" ECU_ADDRESS 0xF0B00 /end MEASUREMENT
/begin MEASUREMENT nsol "" UBYTE nmot_ub_q10 1 100 0.00 2550. FORMAT "%5.0" ECU_ADDRESS 0xF0B01 /end MEASUREMENT
/begin MEASUREMENT nsol_w "" UWORD nmot_uw_q0p25 1 100 0.00 16383.75 FORMAT "%8.2" ECU_ADDRESS 0xF23A6 /end MEASUREMENT
/begin MEASUREMENT nsst "" UBYTE nmot_ub_q10 1 100 0.00 2550. FORMAT "%5.0" ECU_ADDRESS 0xF0B02 /end MEASUREMENT
/begin MEASUREMENT nstat "" UBYTE nmot_ub_q10 1 100 0.00 2550. FORMAT "%5.0" ECU_ADDRESS 0xF0B03 /end MEASUREMENT
/begin MEASUREMENT nstat2 "" UBYTE nmot_ub_q10 1 100 0.00 2550. FORMAT "%5.0" ECU_ADDRESS 0xF0B04 /end MEASUREMENT
/begin MEASUREMENT nstat3 "" UBYTE nmot_ub_q10 1 100 0.00 2550. FORMAT "%5.0" ECU_ADDRESS 0xF0B05 /end MEASUREMENT
/begin MEASUREMENT nstatd "" UBYTE nmot_ub_q10 1 100 0.00 2550. FORMAT "%5.0" ECU_ADDRESS 0xF0B06 /end MEASUREMENT
/begin MEASUREMENT nstatfil "" UBYTE nmot_ub_q10 1 100 0.00 2550. FORMAT "%5.0" ECU_ADDRESS 0xF0B07 /end MEASUREMENT
/begin MEASUREMENT nstatfilv "" UBYTE nmot_ub_q10 1 100 0.00 2550. FORMAT "%5.0" ECU_ADDRESS 0xF0B08 /end MEASUREMENT
/begin MEASUREMENT pklimakmtr "" UBYTE p_q0p2 1 100 0.00 51.00 FORMAT "%5.2" ECU_ADDRESS 0xF41C2 /end MEASUREMENT
/begin MEASUREMENT pklimaq "" UBYTE p_q0p2 1 100 0.00 51.00 FORMAT "%5.2" ECU_ADDRESS 0xF41C3 /end MEASUREMENT
/begin MEASUREMENT qkl1dtev "" UBYTE temp_ub_q0p75_o48 1 100 -48.00 143.3 FORMAT "%5.1" ECU_ADDRESS 0xF41C4 /end MEASUREMENT
/begin MEASUREMENT qkl2dtev "" UBYTE temp_ub_q0p75_o48 1 100 -48.00 143.3 FORMAT "%5.1" ECU_ADDRESS 0xF41C5 /end MEASUREMENT
/begin MEASUREMENT qklima "" UBYTE rel_ub_q0p75_o48 1 100 -48.00 143.3 FORMAT "%5.1" ECU_ADDRESS 0xF41C6 /end MEASUREMENT
/begin MEASUREMENT qmax1dtev "" UBYTE rel_ub_q0p75_o48 1 100 -48.00 143.3 FORMAT "%5.1" ECU_ADDRESS 0xF41C7 /end MEASUREMENT
/begin MEASUREMENT qmax2dtev "" UBYTE rel_ub_q0p75_o48 1 100 -48.00 143.3 FORMAT "%5.1" ECU_ADDRESS 0xF41C8 /end MEASUREMENT
/begin MEASUREMENT qmaxdtev1 "" UBYTE rel_ub_q0p75_o48 1 100 -48.00 143.3 FORMAT "%5.1" ECU_ADDRESS 0xF41C9 /end MEASUREMENT
/begin MEASUREMENT qmaxdtev2 "" UBYTE rel_ub_q0p75_o48 1 100 -48.00 143.3 FORMAT "%5.1" ECU_ADDRESS 0xF41CA /end MEASUREMENT
/begin MEASUREMENT qmaxl1 "" UBYTE rel_ub_q0p75_o48 1 100 -48.00 143.3 FORMAT "%5.1" ECU_ADDRESS 0xF41CB /end MEASUREMENT
/begin MEASUREMENT qmaxl2 "" UBYTE rel_ub_q0p75_o48 1 100 -48.00 143.3 FORMAT "%5.1" ECU_ADDRESS 0xF41CC /end MEASUREMENT
/begin MEASUREMENT qmotra "" UBYTE rel_ub_q0p75_o48 1 100 -48.00 143.3 FORMAT "%5.1" ECU_ADDRESS 0xF41CD /end MEASUREMENT
/begin MEASUREMENT rkr "" UBYTE spg_ub_b5 1 100 0.00 4.980 FORMAT "%5.3" ARRAY_SIZE 8 ECU_ADDRESS 0xF0A7C /end MEASUREMENT
/begin MEASUREMENT rkrmx "" UBYTE spg_ub_b5 1 100 0.00 4.980 FORMAT "%5.3" ECU_ADDRESS 0xE1A6 /end MEASUREMENT
/begin MEASUREMENT rkrmx1w "" UBYTE spg_ub_b320 1 100 0.00 318.750 ECU_ADDRESS 0xF412C /end MEASUREMENT
/begin MEASUREMENT rkrmx2w "" UBYTE spg_ub_b320 1 100 0.00 318.750 ECU_ADDRESS 0xF412D /end MEASUREMENT
/begin MEASUREMENT rkr_tst "" UBYTE spg_ub_b5 1 100 0.00 4.980 FORMAT "%5.3" ECU_ADDRESS 0xF0A84 /end MEASUREMENT
/begin MEASUREMENT rltmso1 "" UBYTE rel_ub_q0p75 1 100 0.00 191.3 FORMAT "%5.1" ECU_ADDRESS 0xF41CE /end MEASUREMENT
/begin MEASUREMENT stkrax "" UBYTE dez 1 100 0.00 255.0 FORMAT "%5.1" ECU_ADDRESS 0xF0AA9 /end MEASUREMENT
/begin MEASUREMENT stkrlx "" UBYTE dez 1 100 0.00 255.0 FORMAT "%5.1" ECU_ADDRESS 0xF0AAA /end MEASUREMENT
/begin MEASUREMENT stkrnx "" UBYTE dez 1 100 0.00 255.0 FORMAT "%5.1" ECU_ADDRESS 0xF0AAB /end MEASUREMENT
/begin MEASUREMENT stuetz "" UBYTE dez 1 100 0.00 255.0 FORMAT "%5.1" ECU_ADDRESS 0xF0AC1 /end MEASUREMENT
/begin MEASUREMENT S_acw "" UWORD B_TRUE 1 100 0.00 1.00000000000 BIT_MASK 0x200 FORMAT "%13.11" ECU_ADDRESS 0xFDC6 /end MEASUREMENT
/begin MEASUREMENT tabgbts_w "" UWORD temp_uw_q0p0195_o50 1 100 -50.00000 1229.980 FORMAT "%8.3" ECU_ADDRESS 0xF46D2 /end MEASUREMENT
/begin MEASUREMENT tabgkmtr "" UBYTE temp_ub_q5_o50 1 100 -50.00 1225. FORMAT "%5.0" ECU_ADDRESS 0xF41CF /end MEASUREMENT
/begin MEASUREMENT temp_b_wert "" UBYTE dez 1 100 0.00 255.0 FORMAT "%5.1" ECU_ADDRESS 0xF0A85 /end MEASUREMENT
/begin MEASUREMENT tisum_w "" UWORD dez 1 100 0.00 65535.00 FORMAT "%8.2" ECU_ADDRESS 0xF2C84 /end MEASUREMENT
/begin MEASUREMENT tkakmtr "" UBYTE temp_ub_q0p75_o48 1 100 -48.00 143.3 FORMAT "%5.1" ECU_ADDRESS 0xF41D0 /end MEASUREMENT
/begin MEASUREMENT tkasnrl "" UBYTE temp_ub_q0p75_o48 1 100 -48.00 143.3 FORMAT "%5.1" ECU_ADDRESS 0xF41D1 /end MEASUREMENT
/begin MEASUREMENT tkasnrlf "" UBYTE temp_ub_q0p75_o48 1 100 -48.00 143.3 FORMAT "%5.1" ECU_ADDRESS 0xF41D2 /end MEASUREMENT
/begin MEASUREMENT tkasolgru "" UBYTE temp_ub_q0p75_o48 1 100 -48.00 143.3 FORMAT "%5.1" ECU_ADDRESS 0xF41D3 /end MEASUREMENT
/begin MEASUREMENT tkasoll "" UBYTE temp_ub_q0p75_o48 1 100 -48.00 143.3 FORMAT "%5.1" ECU_ADDRESS 0xF41D4 /end MEASUREMENT
/begin MEASUREMENT tkastmot "" UBYTE temp_ub_q0p75_o48 1 100 -48.00 143.3 FORMAT "%5.1" ECU_ADDRESS 0xF41D5 /end MEASUREMENT
/begin MEASUREMENT tkvad "" UBYTE dez 1 100 0.00 255.0 FORMAT "%5.1" ECU_ADDRESS 0xF41AB /end MEASUREMENT
/begin MEASUREMENT tkvag_w "" UWORD dez 1 100 0.00 65535.00 FORMAT "%8.2" ECU_ADDRESS 0xF4FAC /end MEASUREMENT
/begin MEASUREMENT tkvar "" UBYTE dez 1 100 0.00 255.0 FORMAT "%5.1" ECU_ADDRESS 0xF41AC /end MEASUREMENT
/begin MEASUREMENT tkva_h "" UWORD dez 1 100 0.00 65535.00 FORMAT "%8.2" ECU_ADDRESS 0xF2C86 /end MEASUREMENT
/begin MEASUREMENT tmotkmtr "" UBYTE temp_ub_q0p75_o48 1 100 -48.00 143.3 FORMAT "%5.1" ECU_ADDRESS 0xF41D6 /end MEASUREMENT
/begin MEASUREMENT tmotnl2 "" UBYTE temp_ub_q0p75_o48 1 100 -48.00 143.3 FORMAT "%5.1" ECU_ADDRESS 0x38402E /end MEASUREMENT
/begin MEASUREMENT tmotsoll "" UBYTE temp_ub_q0p75_o48 1 100 -48.00 143.3 FORMAT "%5.1" ECU_ADDRESS 0xF41D7 /end MEASUREMENT
/begin MEASUREMENT tmso1 "" UBYTE temp_ub_q0p75_o48 1 100 -48.00 143.3 FORMAT "%5.1" ECU_ADDRESS 0xF41D8 /end MEASUREMENT
/begin MEASUREMENT tmso2 "" UBYTE temp_ub_q0p75_o48 1 100 -48.00 143.3 FORMAT "%5.1" ECU_ADDRESS 0xF41D9 /end MEASUREMENT
/begin MEASUREMENT tmso3 "" UBYTE temp_ub_q0p75_o48 1 100 -48.00 143.3 FORMAT "%5.1" ECU_ADDRESS 0xF41DA /end MEASUREMENT
/begin MEASUREMENT tmso4 "" UBYTE temp_ub_q0p75_o48 1 100 -48.00 143.3 FORMAT "%5.1" ECU_ADDRESS 0xF41DB /end MEASUREMENT
/begin MEASUREMENT tmso5 "" UBYTE temp_ub_q0p75_o48 1 100 -48.00 143.3 FORMAT "%5.1" ECU_ADDRESS 0xF41DC /end MEASUREMENT
/begin MEASUREMENT tmso6 "" UBYTE temp_ub_q0p75_o48 1 100 -48.00 143.3 FORMAT "%5.1" ECU_ADDRESS 0xF41DD /end MEASUREMENT
/begin MEASUREMENT tmvsks "" UBYTE temp_ub_q0p75_o48 1 100 -48.00 143.3 FORMAT "%5.1" ECU_ADDRESS 0xF41DE /end MEASUREMENT
/begin MEASUREMENT tnlkmtr_w "" UWORD t1sxs_uw_b65535 1 100 0.00 65535.00 FORMAT "%8.2" ECU_ADDRESS 0x384096 /end MEASUREMENT
/begin MEASUREMENT tnlst2kt_w "" UWORD t1sxs_uw_b65535 1 100 0.00 65535.00 FORMAT "%8.2" ECU_ADDRESS 0xF4FC0 /end MEASUREMENT
/begin MEASUREMENT tnlstktr_w "" UWORD t1sxs_uw_b65535 1 100 0.00 65535.00 FORMAT "%8.2" ECU_ADDRESS 0x384098 /end MEASUREMENT
/begin MEASUREMENT tnltabg_w "" UWORD t1sxs_uw_b65535 1 100 0.00 65535.00 FORMAT "%8.2" ECU_ADDRESS 0xF4FC2 /end MEASUREMENT
/begin MEASUREMENT tnst "" UBYTE t1sxs_ub_b255 1 100 0.00 255.0 FORMAT "%5.1" ECU_ADDRESS 0xF0B09 /end MEASUREMENT
/begin MEASUREMENT toelkmtr "" UBYTE temp_ub_q1_o60 1 100 -60.00 195.0 FORMAT "%5.1" ECU_ADDRESS 0xF41DF /end MEASUREMENT
/begin MEASUREMENT toelknw_w "" UWORD temp_q0p0234_o273 1 100 -273.1500 1262.827 FORMAT "%8.3" ECU_ADDRESS 0xF23A8 /end MEASUREMENT
/begin MEASUREMENT toellrns "" UBYTE temp_ub_q1_o60 1 100 -60.00 195.0 FORMAT "%5.1" ECU_ADDRESS 0xF4159 /end MEASUREMENT
/begin MEASUREMENT tumgkmtr "" UBYTE temp_ub_q0p75_o48 1 100 -48.00 143.3 FORMAT "%5.1" ECU_ADDRESS 0xF41E0 /end MEASUREMENT
/begin MEASUREMENT tvetrint "" SBYTE rel_sb_q0p75 1 100 -96.00 95.25 FORMAT "%5.2" ECU_ADDRESS 0xF41E1 /end MEASUREMENT
/begin MEASUREMENT tvetrr "" UBYTE tv_ub_b100 1 100 0.00 99.61 FORMAT "%5.2" ECU_ADDRESS 0xF41E2 /end MEASUREMENT
/begin MEASUREMENT tvkmtr "" UBYTE tv_ub_b100 1 100 0.00 99.61 FORMAT "%5.2" ECU_ADDRESS 0xF41E3 /end MEASUREMENT
/begin MEASUREMENT tvlu1r "" UBYTE tv_ub_b100 1 100 0.00 99.61 FORMAT "%5.2" ECU_ADDRESS 0xF41E4 /end MEASUREMENT
/begin MEASUREMENT tvlu2r "" UBYTE tv_ub_b100 1 100 0.00 99.61 FORMAT "%5.2" ECU_ADDRESS 0xF41E5 /end MEASUREMENT
/begin MEASUREMENT tvluekt1 "" UBYTE tv_ub_b100 1 100 0.00 99.61 FORMAT "%5.2" ECU_ADDRESS 0xF41E6 /end MEASUREMENT
/begin MEASUREMENT tvluekt2 "" UBYTE tv_ub_b100 1 100 0.00 99.61 FORMAT "%5.2" ECU_ADDRESS 0xF41E7 /end MEASUREMENT
/begin MEASUREMENT tvlues1 "" UBYTE tv_ub_b100 1 100 0.00 99.61 FORMAT "%5.2" ECU_ADDRESS 0xF41E8 /end MEASUREMENT
/begin MEASUREMENT tvlues1r "" UBYTE tv_ub_b100 1 100 0.00 99.61 FORMAT "%5.2" ECU_ADDRESS 0xF41E9 /end MEASUREMENT
/begin MEASUREMENT tvlues2 "" UBYTE tv_ub_b100 1 100 0.00 99.61 FORMAT "%5.2" ECU_ADDRESS 0xF41EA /end MEASUREMENT
/begin MEASUREMENT tvlues2r "" UBYTE tv_ub_b100 1 100 0.00 99.61 FORMAT "%5.2" ECU_ADDRESS 0xF41EB /end MEASUREMENT
/begin MEASUREMENT tvluesbsg "" UBYTE tv_ub_b100 1 100 0.00 99.61 FORMAT "%5.2" ECU_ADDRESS 0xF41EC /end MEASUREMENT
/begin MEASUREMENT tvluesfl "" UBYTE tv_ub_b100 1 100 0.00 99.61 FORMAT "%5.2" ECU_ADDRESS 0xF41ED /end MEASUREMENT
/begin MEASUREMENT tvluesic "" UBYTE tv_ub_b100 1 100 0.00 99.61 FORMAT "%5.2" ECU_ADDRESS 0xF41EE /end MEASUREMENT
/begin MEASUREMENT tvluesicb "" UBYTE tv_ub_b100 1 100 0.00 99.61 FORMAT "%5.2" ECU_ADDRESS 0xF41EF /end MEASUREMENT
/begin MEASUREMENT tvlueskmtr "" UBYTE tv_ub_b100 1 100 0.00 99.61 FORMAT "%5.2" ECU_ADDRESS 0xF41F0 /end MEASUREMENT
/begin MEASUREMENT tvnl1soll "" UBYTE tv_ub_b100 1 100 0.00 99.61 FORMAT "%5.2" ECU_ADDRESS 0xF41F1 /end MEASUREMENT
/begin MEASUREMENT tvnl2soll "" UBYTE tv_ub_b100 1 100 0.00 99.61 FORMAT "%5.2" ECU_ADDRESS 0xF41F2 /end MEASUREMENT
/begin MEASUREMENT tvnll1r "" UBYTE tv_ub_b100 1 100 0.00 99.61 FORMAT "%5.2" ECU_ADDRESS 0xF41F3 /end MEASUREMENT
/begin MEASUREMENT tvnll2r "" UBYTE tv_ub_b100 1 100 0.00 99.61 FORMAT "%5.2" ECU_ADDRESS 0xF41F4 /end MEASUREMENT
/begin MEASUREMENT valutggls "" UBYTE t1msxms_q1 1 100 0.00 255.0 FORMAT "%5.1" ECU_ADDRESS 0xE0DE /end MEASUREMENT
/begin MEASUREMENT vfzgkmtr "" UBYTE vfzg_ub_q1p25 1 100 0.00 318.8 FORMAT "%5.1" ECU_ADDRESS 0xF41F5 /end MEASUREMENT
/begin MEASUREMENT virkr "" UBYTE fak_ub_b16 1 100 0.00 15.94 FORMAT "%5.2" ECU_ADDRESS 0xE1A7 /end MEASUREMENT
/begin MEASUREMENT vkr "" UBYTE dez 1 100 0.00 255.0 FORMAT "%5.1" ARRAY_SIZE 8 ECU_ADDRESS 0xF0A86 /end MEASUREMENT
/begin MEASUREMENT vkr_tst "" UBYTE dez 1 100 0.00 255.0 FORMAT "%5.1" ECU_ADDRESS 0xF0A8E /end MEASUREMENT
/begin MEASUREMENT vsksmlf_w "" UWORD volgrd_q5p96Em4 1 100 0.00 39.06190 FORMAT "%8.5" ECU_ADDRESS 0xF4FC4 /end MEASUREMENT
/begin MEASUREMENT vstnlsl "" SBYTE nmot_sb_q10 1 100 -1280. 1270. FORMAT "%5.0" ECU_ADDRESS 0xF0B0A /end MEASUREMENT
/begin MEASUREMENT vszwm "" SBYTE zw_sb_q0p75 1 100 -96.00 95.25 FORMAT "%5.2" ECU_ADDRESS 0xF0AAC /end MEASUREMENT
/begin MEASUREMENT wkr "" UBYTE zw_ub_qn0p75 1 100 -191.3 0.00 FORMAT "%5.1" ARRAY_SIZE 6 ECU_ADDRESS 0xE1A8 /end MEASUREMENT
/begin MEASUREMENT wkra "" UBYTE zw_ub_qn0p75 1 100 -191.3 0.00 FORMAT "%5.1" ARRAY_SIZE 160 ECU_ADDRESS 0x38209B /end MEASUREMENT
/begin MEASUREMENT wkraa "" UBYTE zw_ub_qn0p75 1 100 -191.3 0.00 FORMAT "%5.1" ARRAY_SIZE 8 ECU_ADDRESS 0xF0AAD /end MEASUREMENT
/begin MEASUREMENT wkratst "" UBYTE zw_ub_qn0p75 1 100 -191.3 0.00 FORMAT "%5.1" ECU_ADDRESS 0xF0AB5 /end MEASUREMENT
/begin MEASUREMENT wkrdy "" UBYTE zw_ub_qn0p75 1 100 -191.3 0.00 FORMAT "%5.1" ECU_ADDRESS 0xE1B0 /end MEASUREMENT
/begin MEASUREMENT wkrdya "" UBYTE zw_ub_qn0p75 1 100 -191.3 0.00 FORMAT "%5.1" ARRAY_SIZE 5 ECU_ADDRESS 0x38213B /end MEASUREMENT
/begin MEASUREMENT wkrm "" UBYTE zw_ub_qn0p75 1 100 -191.3 0.00 FORMAT "%5.1" ECU_ADDRESS 0xE1AE /end MEASUREMENT
/begin MEASUREMENT wkrma "" UBYTE zw_ub_qn0p75 1 100 -191.3 0.00 FORMAT "%5.1" ECU_ADDRESS 0xE1AF /end MEASUREMENT
/begin MEASUREMENT wkr_tst "" UBYTE zw_ub_qn0p75 1 100 -191.3 0.00 FORMAT "%5.1" ECU_ADDRESS 0xF0AB6 /end MEASUREMENT
/begin MEASUREMENT zaldy "" UBYTE dez 1 100 0.00 255.0 FORMAT "%5.1" ECU_ADDRESS 0xF0AC2 /end MEASUREMENT
/begin MEASUREMENT zhll_w "" UWORD t200msxs_uw_q0p2 1 100 0.00 13107.00 FORMAT "%8.2" ECU_ADDRESS 0x382F24 /end MEASUREMENT
/begin MEASUREMENT zkrstat "" UBYTE t100msxs_ub_b25p5 1 100 0.00 25.50 FORMAT "%5.2" ECU_ADDRESS 0xF0AB7 /end MEASUREMENT
/begin MEASUREMENT zkrvf "" UBYTE dez 1 100 0.00 255.0 FORMAT "%5.1" ARRAY_SIZE 8 ECU_ADDRESS 0xF0AB8 /end MEASUREMENT
/begin MEASUREMENT zldy "" UBYTE dez 1 100 0.00 255.0 FORMAT "%5.1" ECU_ADDRESS 0xE1B1 /end MEASUREMENT
/begin MEASUREMENT zldyke "" UBYTE dez 1 100 0.00 255.0 FORMAT "%5.1" ECU_ADDRESS 0xE1B2 /end MEASUREMENT
/begin MEASUREMENT zndy "" UBYTE dez 1 100 0.00 255.0 FORMAT "%5.1" ECU_ADDRESS 0xE1B3 /end MEASUREMENT
/begin MEASUREMENT zzwdykr "" UWORD dez 1 100 0.00 65535.00 FORMAT "%8.2" ECU_ADDRESS 0xE1B4 /end MEASUREMENT
/begin MEASUREMENT zzwdymd "" UWORD dez 1 100 0.00 65535.00 FORMAT "%8.2" ECU_ADDRESS 0xE1B6 /end MEASUREMENT
/begin FUNCTION KMTR "3.371"
 /begin DEF_CHARACTERISTIC CWDEZWO CWGANGLA CWKMTR CWKMTR2 CWLUEKO DKL1DTEV DKL2DTEV DKMTSMN DKMTSMX DMTSMN DMTSMX DPNEG DPPOS DQUEBERMN DQUEBERMX DQUEBEW DTKAMN DTKAMX ETRIMN ETRIMX FNLPRUEF FTKANMO KFDQTMTU KFDQUEBER KFHOEHK KFKTRLN KFKTRV KFLUESIC KFNL2TUM KFNLTKV KFNLTUM KFQMRA KFQNLUE1 KFQNLUE2 KFQTKWP KFQVAC KFQVKOM KFTKANRL KFTKAOFF KFTKASO KFTKATU KFTMOTKR KFTVETR KFTVLU1 KFTVLU1EW KFTVLU2 KFTVLU2EW KFTVNL1 KFTVNL2 KLAH1 KLAH2 KLAHEW KLAHTMSMX1 KLAHTMSMX2 KLAHTVLUE1 KLAHTVLUE2 KLANFVFZ KLFDQV KLFQKV KLMLFT KLNLOEL KLNLSTP KLNLTABG KLNLTUM KLQKAUS KLQKLIMA KLTMSKR LUEKO1 LUEKO2 LUEKO3 NM1MN1 NM1MN2 NM1MN3 NM1MX1 NM1MX2 NM1MX3 NM1VMN NM1VN NM1VP NM2MN1 NM2MN2 NM2MN3 NM2MX1 NM2MX2 NM2MX3 NM2VMN NM2VN NM2VP NMOTZPAUS NMOTZPEIN NSTNMKMTR PKLIHDV PKLIMA PKODR QKLIHDV QKLILU1 QKLILU2 QKLIMAMX QMAXL1INI QMAXL2INI QMRAHO QMRAHU QMRATUMG QTKWAIK QTKWAIMN QTKWAIMX STS05DTKA STS05DTTS TETRST TFADELAY TFLZLR TFQMRA TFTABG TKAETRO TKAETRU TKAEW TKAINI TKATVLSMN TKATVLSMX TKLIHDV TKOROFF TKORON TLUEKT1 TLUEKT2 TLUEST TMEWKMTR TMHLEOFF TMHLEON TMKOVOFF TMKOVON TMOTDQMX TMOTDTEV TMOTKRMN TMOTKRMX TMOTZPAUS TMOTZPEIN TMOTZPSTMX TMSO5INI TMSOINI TMSOLLEW TMSOTOEL TNLARAMP TNLKMTRMN TNLSTMX TNLSTP TNLZWP2 TOLEWKMTR TUHEMN TUHEMX TUMEWKMTR TUMGZWP TUMKLIHDV TUMST1 TUMST2 TUPOTMN TUPOTMX TVETREW TVETRMN TVETRMX TVETROFF TVKLIHDV1 TVKLIHDV2 TVKMTRMN TVKMTRMX TVLU1MN TVLU1MX TVLU2MN TVLU2MX TVLUESETR TVLUESICEW TVLUESSEW_0_A TVLUESSEW_1_A TVMXBSG TVNL1OFF TVNL2OFF TVNLETR TVNLT1 TVNLT2 TVNLTETR TVRAMPBS TVSTETR TVSTL1 TVSTL2 TZWPST TZWPSTH TZWPSV VFZGEW ZKETR ZKNLST ZKQMAXL1 ZKQMAXL2 ZKTKASNRLN ZKTKASNRLP ZKTKASO ZKTMSN ZKTMSP ZVSKS /end DEF_CHARACTERISTIC
 /begin REF_CHARACTERISTIC CWKVHR /end REF_CHARACTERISTIC
 /begin IN_MEASUREMENT B_bsglue B_ctol B_ctum B_dtes B_dtest B_etoltm B_fakmtr B_falues B_fpwld B_ge1bot B_hlon B_kdhre B_kl15 B_klimex B_luef1 B_luef2 B_luef3 B_luesscb B_nlsgls B_nmot B_nukla B_pwf B_sacc B_skoc B_st B_stend ctol ctum gangi klahc nmot pkodrc pu rl rlshk S_ac S_ko tabgm takols tans tka tmki tmot tnse_w toel toltm tumg tvluesfa tvluessc ub uhepoti upotpwm vfzg vsksml_w wkrma /end IN_MEASUREMENT
 /begin OUT_MEASUREMENT B_etb B_fpwld_ok B_hlonkmtr B_kmtre B_kovkmtr B_motabw B_nlel B_tmkmtr B_zwp B_zwp2 dkmts dtmtka esst_sts05dtka esst_sts05dtts klah klahtmsmx tkakmtr tmotkmtr tvkmtr tvlues1 tvlues2 tvluesic tvlueskmtr vfzgkmtr /end OUT_MEASUREMENT
 /begin LOC_MEASUREMENT B_deaklue B_deaklue1 B_deaklue2 B_elues1 B_elues2 B_klahmx B_klihdv B_nlphase2 B_nlsgls2 B_toelkmtr B_tumkmtr dqueber dtka dtkaint fhoehk flashzlr krtmso ktvlue1 ktvlue2 luelogin nlue1 nlue1mn nlue2 nlue2mn nluez1 nluez2 pklimakmtr pklimaq qkl1dtev qkl2dtev qklima qmax1dtev qmax2dtev qmaxdtev1 qmaxdtev2 qmaxl1 qmaxl2 qmotra rltmso1 tabgkmtr tkasnrl tkasnrlf tkasolgru tkasoll tkastmot tmotnl2 tmotsoll tmso1 tmso2 tmso3 tmso4 tmso5 tmso6 tmvsks tnlkmtr_w tnlst2kt_w tnlstktr_w tnltabg_w toelkmtr tumgkmtr tvetrint tvetrr tvlu1r tvlu2r tvluekt1 tvluekt2 tvlues1r tvlues2r tvluesbsg tvluesfl tvluesicb tvnl1soll tvnl2soll tvnll1r tvnll2r vsksmlf_w /end LOC_MEASUREMENT
/end FUNCTION
/begin FUNCTION KOEVAB "1.100" /begin IN_MEASUREMENT B_hrevab B_motstop B_nmaxd B_phesab /end IN_MEASUREMENT /begin OUT_MEASUREMENT B_koevab /end OUT_MEASUREMENT /end FUNCTION
/begin FUNCTION KOS "113.312"
 /begin DEF_CHARACTERISTIC CDWGANG CDWGANGB CDWKOB CWKOC CWKOCAN CWKOR DNKOACC DWPEDKOB DWPEDSP FHOKOB KFTNSTKO KLTVKOEP MDKOAB MDKOAN MDKOEN MDNKO MKLLSCMN NKOACC NKOULEV NMOTEL PKODRCMX SNM08KOUB TANSKOB TKOAMAD TKOAMNN TKOAMXN TKOBEMNN TKODPAMNN TKODPAMXN TKOEMNN TKOEV TKOFREEZE TKOTMSK TKOVKO TKOWPAMNN TKOWPAMXN TKOWPEDDEL TMKOAO TMKOAU TMSTKOO TMSTKOU TMSTMAD TVKOEOF TVKOGANDEL TVKOSSIM TVKOULEV VFZGSP VKO VKOAO VKOB VNVKO VNVKOB WPEDKO /end DEF_CHARACTERISTIC
 /begin IN_MEASUREMENT B_autget B_dknolu B_dkpu B_gekoa B_grdst B_gsch B_gwhs B_kooffc B_kuppl B_ll B_madfk B_madfs B_madko B_madll B_sa B_sacc B_skoc B_st B_stend dwped fho fho_w gangi mdko_w mifal_w mkllsc nmot pkodrc S_ac S_ko tans tmki tmot tmst vfzg wped /end IN_MEASUREMENT
 /begin OUT_MEASUREMENT B_acres B_ko B_koe B_kosrc B_kov B_nac /end OUT_MEASUREMENT
 /begin LOC_MEASUREMENT B_koa B_kobaus B_kobmnon B_kobped B_kobpedt B_kobwped B_kobwpedt B_koena B_koenat B_kofreeze B_kogandel B_koganped B_koint B_komna B_komnoff B_komnon B_komxoff B_kondel B_kooff B_koofft B_koondel B_kostart B_kotmsk B_kotmsko B_kovdown B_kow esst_snm08koub S_acw /end LOC_MEASUREMENT
/end FUNCTION
/begin FUNCTION KRACT ""
 /begin REF_CHARACTERISTIC AGR_AOG AGR_AUG CNSDEF CNS_AOG CNS_AUG CWTAF CWTAK CWTAS DZW_AOG DZW_AUG FBA_AOG FBA_AUG FLR_AOG FLR_AUG FNS_AOG FNS_AUG FRK_AOG FRK_AUG FST_AOG FST_AUG FVA_AOG FVA_AUG FWL_AOG FWL_AUG MDR_AOG MDR_AUG MWNTKB5 NLS_AOG NLS_AUG RLX_AOG RLX_AUG VVR_AOG VVR_AUG /end REF_CHARACTERISTIC
 /begin IN_MEASUREMENT B_ekpvl B_fa B_grdst B_kl15 B_kstebf B_stend nmot_w vstagr vstcns vstdzw vstfba vstfns vstfrk vstfst vstfva vstfwl vstlr vstmdr vstnls vstrlx vstvvr /end IN_MEASUREMENT
 /begin OUT_MEASUREMENT B_anpkangl /end OUT_MEASUREMENT
/end FUNCTION
/begin FUNCTION KRDY "17.120"
 /begin DEF_CHARACTERISTIC AZKELDYN AZKRLDYN AZKRNDYN CWKR CWTIPIN DRLKRAN DYADMXN DYADS DYAFVS DYAMNV DYAVF DZWTIN FKELDYA KFDYES KFDYMNT KFDYRS KFDYRSOF NGKRAWN NGKRWN NKRUM PZWKRA TMDYNA ZDRLKRA ZNGKRA /end DEF_CHARACTERISTIC
 /begin REF_CHARACTERISTIC SNM16KRDYUB SNM16KRUB SRL06KRUB /end REF_CHARACTERISTIC
 /begin IN_MEASUREMENT B_kl B_kr B_krdws B_kuppl B_ll B_pwf B_tmkr B_vnull B_zwkraa drlp_w drl_w esst_snm16krdyub esst_snm16krub esst_srl06krub evtmod gangi kek krfkw ngas_w nmot rl rlp_w rl_w stkrnx tmot virkr zzylkr /end IN_MEASUREMENT
 /begin OUT_MEASUREMENT B_krldy B_krldya B_krldyf B_krldyn B_krldyv B_krndy B_krndyn B_tipin drlkrdy ngkrv_w stuetz wkrdy zaldy zldy zldyke zndy zzwdykr zzwdymd /end OUT_MEASUREMENT
 /begin LOC_MEASUREMENT B_drlkrdy B_kldynrm B_kldystk drlkrav drlkrra dyesv dymntv dyrsofv dyrsv lkrnew lkrold ngkraf_w ngkrav_w wkrdya /end LOC_MEASUREMENT
/end FUNCTION
/begin FUNCTION KRKE "16.40"
 /begin DEF_CHARACTERISTIC CWKRREF CWREFI FKEFMC FKELDY FKENDY FKRFTPFMC KFKEF1 KFKEF2 KFKEF3 KFKEF4 KFKEF5 KFKEF6 KFKEF7 KFKEF8 KRFTP1 KRFTP2 KRFTP3 KRKFKS KRVST KSZA NKRREF REFINI RKRMX1N RKRMX2N ZYRKR /end DEF_CHARACTERISTIC
 /begin REF_CHARACTERISTIC SNM16KRUB SRL03KRUB /end REF_CHARACTERISTIC
 /begin IN_MEASUREMENT B_c95ks3 B_dnt B_dntb B_dtp B_dtpb B_fmfkrc B_kr B_krldy B_krndy B_krnl B_st esst_snm16krub esst_srl03krub ikr ikrma ikrme nmot rl vske zzylkr /end IN_MEASUREMENT
 /begin OUT_MEASUREMENT B_c95_g0 B_c95_g1 B_c95_g2 B_kl ikrrkr_wert ikr_kek_wert ke kek kek_tst krftpakt rkr rkrmx rkrmx1w rkrmx2w rkr_tst temp_b_wert virkr vkr vkr_tst /end OUT_MEASUREMENT
/end FUNCTION
/begin FUNCTION KRRA "15.135"
 /begin DEF_CHARACTERISTIC CWKRLZFK CWKRNLR CWKRRA DRLKRSTMX DWKRMSN KRAL1N KRAL2N KRAL3N KRALH KRAN1 KRAN2 KRAN3 KRAN4 KRANH KRDWA KRDWAA KRDWKLA KRDWSA KRDWSN KRFKLN KRFKN KRLVFN KRMXN KRNLZ KRVFN KRVFSN KRWKRAIN LKRAN LKRN LZB1 LZB2 LZFUER NGKRSTMX NKRAMAX NKRAMIN NKRF NKRMAX TMKR TMKRA TMKRAS TVKRSTAT WKRLZOF WKRLZOFEKS /end DEF_CHARACTERISTIC
 /begin REF_CHARACTERISTIC KSZA SENZZYL SNM16KRUB /end REF_CHARACTERISTIC
 /begin IN_MEASUREMENT B_adrkra B_asr B_kl B_krldy B_krldya B_krldyn B_krndy B_krndyn B_llr B_nldg B_nmax B_pwf B_stend B_synph B_vmax drl_w esst_snm16krub ngfil_w nmot rl tmot vszwkr zwkrafld zzylkr /end IN_MEASUREMENT
 /begin OUT_MEASUREMENT B_kr B_krdws B_krfdks B_krlz B_krnl B_krnlr B_krstatb B_krwa B_tmkr dwkr dwkrz lkraw lkrw stkrnx wkrm wkrma /end OUT_MEASUREMENT
 /begin LOC_MEASUREMENT B_kra B_krafrz B_krfrz B_krlzn B_krvf B_kseb1 B_kseb2 B_wkral B_zwkraa B_zwkrum dwkrmsw kral1w kral2w kral3w krdwsw krfkw krlzn krmxw krvfsw krvfw lzist stkrax stkrlx vszwm wkr wkra wkraa wkratst wkr_tst zkrstat zkrvf /end LOC_MEASUREMENT
/end FUNCTION
/begin FUNCTION KTGGLSVFH "1.10" /begin DEF_CHARACTERISTIC TGGLS /end DEF_CHARACTERISTIC /begin OUT_MEASUREMENT valutggls /end OUT_MEASUREMENT /end FUNCTION
/begin FUNCTION KVA "41.40" /begin DEF_CHARACTERISTIC CWCKBI FKVA KD KVB /end DEF_CHARACTERISTIC /begin REF_CHARACTERISTIC KRKTE /end REF_CHARACTERISTIC /begin IN_MEASUREMENT B_sa rk2_w rkte_w rk_w /end IN_MEASUREMENT /begin OUT_MEASUREMENT B_kvakbi int_ctr kvakbi_w tkvad tkvag_w tkvar tkva_h /end OUT_MEASUREMENT /begin LOC_MEASUREMENT B_tisum tisum_w /end LOC_MEASUREMENT /end FUNCTION
/begin FUNCTION KWPDATR ""
 /begin REF_CHARACTERISTIC AAGOFLOGIN AAGONLOGIN ADRONLOGIN GRAOFLOGIN GRAONLOGIN HLOFFLOGIN HLONLOGIN KLOGIN LFWOFLOGIN LFWONLOGIN LUEN1LOGIN LUEN2LOGIN LUEN3LOGIN SLOGIN /end REF_CHARACTERISTIC
 /begin IN_MEASUREMENT B_acc B_accen B_fgrte B_hlon B_kl15 B_luef1 B_luef2 B_luef3 nmot_w /end IN_MEASUREMENT
/end FUNCTION
/begin FUNCTION KWPSTDAA "" /begin IN_MEASUREMENT B_kl15 fcmEnd FCMTab ffzdfp /end IN_MEASUREMENT /end FUNCTION
/begin FUNCTION KWPTP "" /begin IN_MEASUREMENT B_JumpRamOK B_nachl /end IN_MEASUREMENT /end FUNCTION
/begin FUNCTION LAKH "4.70"
 /begin DEF_CHARACTERISTIC CWLAKH IMLLASKH KFLANSKH KFLASKH KFLMSKH KFLMSKHKST KLLAKHFH LASDSLA LASTMOT LMSTMOT TMSTLMS ZFLASKH /end DEF_CHARACTERISTIC
 /begin IN_MEASUREMENT anztib_w B_dsla B_fasla B_kh fho_w flakh flamsl2_w flamsl_w flmssl fmsldyn fslpdyn imlpr ml_w nmot_w rl_w tmot tmst /end IN_MEASUREMENT
 /begin OUT_MEASUREMENT B_lamkhe lamkh2_w lamkh_w /end OUT_MEASUREMENT
 /begin LOC_MEASUREMENT B_dslafa flaskh flmsslkh fslsdyn LAKHlokBits lamkhg2_w lamkhg_w lamkhr2_w lamkhr_w lanskh_w lasdslg2_w lasdslg_w lasdsl_w laskh_w lmskh_w lmssl2_w lmssl_w /end LOC_MEASUREMENT
/end FUNCTION
/begin FUNCTION LAMBTS "17.50"
 /begin DEF_CHARACTERISTIC CWLAMBTS DLBTSTHX DLBTSTHX2 DTBTS FBSTABGM FBSTMOT KFDLBTS KFDLBTSGRL KFLBTS KFLBTS2 KFLBTSBG KFLBTSDY KLDRLLBTDY KLTVLBTDY KLZDLBTS KLZKLBTDY SNM16GKUB SRL12GKUW TABGBTS TDLAMBTS TIKATBTS TKATBTS TVLBTS ZLBTS /end DEF_CHARACTERISTIC
 /begin REF_CHARACTERISTIC ETADZW /end REF_CHARACTERISTIC
 /begin IN_MEASUREMENT B_dash B_gsaf drlp_w etazwist gangi mivbegv_w ml nmot rl rl_w tabgm_w thxlsum2_w thxlsum_w tikatm_w tkatm_w tmot zwgru zwopt /end IN_MEASUREMENT
 /begin OUT_MEASUREMENT esst_snm16gkub esst_srl12gkuw lambts2_w lambts_w /end OUT_MEASUREMENT
 /begin LOC_MEASUREMENT B_tabgbts B_tatmbts B_tikatbts B_tkatbts B_twilabts B_twistbts detazwbs dlambts_w dlbtsug dzwg etazwg flbts_w LAMBTSlokbits lbts2_w lbtsbg_w lbtsdy_w lbtsubg2_w lbtsubg_w lbts_w tabgbts_w /end LOC_MEASUREMENT
/end FUNCTION
/begin FUNCTION LAMFAW "11.10"
 /begin DEF_CHARACTERISTIC CWLAMFAW DLAMFAW DLAMTANS KFLAFWL KFLAMKR KFLAMKRL LAMFA LAMRLMN RLLAMMN SDZ06GKUB SNM06GKUB SRL06GKUB STM08GKUB TLAFA ZKLAMFAW ZKWLAFWL /end DEF_CHARACTERISTIC
 /begin IN_MEASUREMENT B_sab B_stend dzwwl mifafu_w milsol_w mrfa_w nmot rl tans tmot wkrma /end IN_MEASUREMENT
 /begin OUT_MEASUREMENT B_ldeffw esst_sdz06gkub esst_snm06gkub esst_srl06gkub esst_stm08gkub lamfa_w /end OUT_MEASUREMENT
 /begin LOC_MEASUREMENT B_lamfas dzwlamfaw lamfawkr_w lamfaws_w lamfaw_w lamfwl_w lamrlmn_w /end LOC_MEASUREMENT
/end FUNCTION
/begin FUNCTION LAMKO "9.120"
 /begin DEF_CHARACTERISTIC CWLAMKH LAMFLGSL LAMLGFKT LAMLGFTM LAMLGMKT LAMLGMTM LASOAB /end DEF_CHARACTERISTIC
 /begin REF_CHARACTERISTIC STM12ESUB /end REF_CHARACTERISTIC
 /begin IN_MEASUREMENT B_auakt B_bevab B_bevab2 B_dsla B_fa B_falsh B_falsh2 B_fasla B_kh B_lamka B_lamka2 B_lamkhe B_lamlash B_lamlash2 B_lamlshv B_lamlshv2 B_lamnse B_ldeffw B_sls esst_stm12esub flamkh imlatm lamau_w lambts2_w lambts_w lamelsh2_w lamelsh_w lamfa_w lamka2_w lamka_w lamkh2_w lamkh_w lamlash2_w lamlash_w lamlshv2_w lamlshv_w lamnswl_w tmot /end IN_MEASUREMENT
 /begin OUT_MEASUREMENT B_lalgf B_lalgf2 B_lamdiag B_lamdiag2 B_lamsdef lambas lambas_w lamdiag2_w lamdiag_w lamsbg2_w lamsbg_w lamvoa2_w lamvoa_w /end OUT_MEASUREMENT
 /begin LOC_MEASUREMENT B_lambts B_lambts2 B_lamkh B_lamnswl B_ldef B_ldef2 lamkhe2_w lamkhe_w lamlgfmn lamlgm lams2_w lamsubg2_w lamsubg_w lams_w /end LOC_MEASUREMENT
/end FUNCTION
/begin FUNCTION LANSWL "2.20"
 /begin DEF_CHARACTERISTIC ATISLATM ATIWKSTM CWWL DLAMNSWL KFLANS KFLASWLR LASWLTM ZKLANSWL /end DEF_CHARACTERISTIC
 /begin REF_CHARACTERISTIC STM12ESUB STS12ESUB /end REF_CHARACTERISTIC
 /begin IN_MEASUREMENT anztib_w B_lrnda B_lrnda2 B_stendes B_wks esst_stm12esub esst_sts12esub tmot tmst /end IN_MEASUREMENT
 /begin OUT_MEASUREMENT B_lamnse lamnswl_w lamns_w /end OUT_MEASUREMENT
 /begin LOC_MEASUREMENT anztib0_w anztib1_w B_lawlon lamwl_w /end LOC_MEASUREMENT
/end FUNCTION
/begin FUNCTION LLRBB "505.10"
 /begin DEF_CHARACTERISTIC CNFKUPPL DNLLR TVDK TVKUPPL TVLLR TVLLRI TVLLRPD TVLLRSTE VLLR /end DEF_CHARACTERISTIC
 /begin IN_MEASUREMENT B_dash B_fil B_fs B_kuppl B_ll B_mdein B_nmot B_sa B_sab B_stend dmllri_w dn gangi mill_w nmot nmotll nsol nstat tmot vfzg /end IN_MEASUREMENT
 /begin OUT_MEASUREMENT B_enllri B_ensol B_llr B_llrein B_llri B_llrpd B_nstu B_vllr /end OUT_MEASUREMENT
/end FUNCTION
/begin FUNCTION LLRMR "21.10"
 /begin DEF_CHARACTERISTIC CWKUPPL DMRESLL DMRESTM DNLLRES KFMRES KFMRESK KFMRESKH KFMRESNL KFMRESTA KLMRESTM KLMRHO MRESKH MRESLL MRESSL TDMRESLL TMRESNL TVRESLL TVRESTM VANF /end DEF_CHARACTERISTIC
 /begin REF_CHARACTERISTIC SMI04LLUB SNM06LLUB SNS06LLSB STA04LLUB STM04SAUB /end REF_CHARACTERISTIC
 /begin IN_MEASUREMENT B_kh B_kuppl B_ll B_sl B_st B_stend dmrac dmrlf dmrwan dn dns esst_smi04llub esst_snm06llub esst_sns06llsb esst_sta04llub esst_stm04saub fho mifa_w nmot_w tans tmot vfzg vstmdr /end IN_MEASUREMENT
 /begin OUT_MEASUREMENT B_zwafh dmrllr_w dmrnwa_w dmrnwe_w /end OUT_MEASUREMENT
 /begin LOC_MEASUREMENT B_kuplaus dmresll_w dmvllrsu_w /end LOC_MEASUREMENT
/end FUNCTION
/begin FUNCTION LLRNFA "1.210"
 /begin DEF_CHARACTERISTIC CWFAN NSLFAA NSLFADY NSLFAEZLA NSLFAKAT NSLFAKRS NSLFALDP NSLFALSF NSLFALSV NSLFANWKW NSLFASF NSLFASH NSLFASHV NSLFASKNO NSLFASLS NSLFATES NSLFATPE NSLFAWSA NSLFAWSE NSLKVS NSLLSH TNSLFA WFAN /end DEF_CHARACTERISTIC
 /begin IN_MEASUREMENT B_autget B_brems B_faa B_faagr B_faan B_faatm B_fadylsu B_faezla B_fakat B_fakrs B_fakvs B_faldp B_falsf B_falsh B_falshv B_falsv B_fanwkw B_fanwsa B_fanwse B_fasf B_fash B_fasls B_fates B_fs B_ll vfzg wped /end IN_MEASUREMENT
 /begin OUT_MEASUREMENT B_fanfg nslfa /end OUT_MEASUREMENT
/end FUNCTION
/begin FUNCTION LLRNS "541.350"
 /begin DEF_CHARACTERISTIC CNFLLRNS CWKLDFA CWLLRG CWLLRNS CWLLRNW CWNSTAT DNSNFST DNSNFX DNSNWNA DTAHLL DTMHLL DTOELNW DWNWASMX DWNWLLMXA FNSNF FNSSTKM FNSSTM KFNLLNST KFZNSM KLDFOFF KLDFON KLNSNW KNSNF LBZO1 LBZO2 LBZU NFHZ NFHZFS NFS2M NFSKLDF NFSKO NFSKS NFSLPWG NFSMIN NFSNLDG NFSNWLL NFSSBC NFSSL NGNSNF NKLDF NLL2M NLLCVTMXV NLLMG NLLMGFS NLLMIN NLLNWDMX NSAC NSACFS NSHLL NSKO NSKS NSL NSLBZA1 NSLBZA2 NSLBZA3 NSLBZFS NSLBZFS1 NSLBZFS2 NSLBZLL NSLBZLL1 NSLBZLL2 NSLBZS NSLNWMX NSLPP NSLPPFS NSLPWG NSNLDG NSNOT NSNWLL NSNWNA NSOLMX NSTOEL NTIPLL NZHDTL NZHITL SGA08LLUB SNS06LLSB TAHLL TANSKO TMHLL TMLLNW TMLLX TMRZHLL TNSLBZA TNSLBZAI TNSLBZAN TOLLNWMX TVLLNWDIF TVLLNWR TVOLLNWMAX VSL ZHLLA ZHLLE ZKNS ZKNSU ZKNWLL ZKNWLLANH ZKNWLLDIF ZKNWLLNA ZNSUB /end DEF_CHARACTERISTIC
 /begin REF_CHARACTERISTIC NLS_AOG NLS_AUG STM06LLUB STN06LLUB WNWRAS /end REF_CHARACTERISTIC
 /begin IN_MEASUREMENT B_anwsea B_autget B_br2k B_cvt B_cvtad B_dknolu B_dkpu B_fanfg B_fhz B_fnwaktv B_fs B_khn B_ko B_kuppl B_ll B_llrein B_llrst B_nac B_nlbzanf B_nlbzanf2 B_nldg B_nswo1 B_nwllna B_nws B_pwf B_sacc B_skoc B_sl B_spsmin B_st B_stend B_tolcb B_vllr B_wkauf esst_stm06llub esst_stn06llub gangi kldfpwm kldfpwmf lbz nfskh ngfil nllcvt1 nllkh nmot nmotll nslfa nspwgnot psl rl S_ac S_ko tans tmot tmst tnst_w toelk_w vfzg vsns vstcns vstnls wnwa_w wnwsa_w /end IN_MEASUREMENT
 /begin OUT_MEASUREMENT B_nsget B_nstabk dns esst_sga08llub esst_sns06llsb nsnw nsnwmx nsol nsol_w nsst nstat nstat2 nstatfil vstnlsl /end OUT_MEASUREMENT
 /begin LOC_MEASUREMENT B_brufs B_hll B_kldf B_nlbza B_nlbzasb B_nlbza_tmp B_ns2 B_ns2a B_nsks B_nslbzaa1 B_nslbzaa2 B_nsnwres B_nssl B_nwdn B_nwll B_nwlldif B_nwlldif2 B_nwlr B_tpn gangllr nllcvt2 nsfsm nsfsmn nslbz nslbzaa nslbzamx nsllm nsllmn nsnbz nsnf nsnwi nsnwib nsnwibz nsnwnaf nstat3 nstatd nstatfilv tnst toelknw_w toellrns zhll_w /end LOC_MEASUREMENT
/end FUNCTION
/begin FUNCTION LLRRM "11.110"
 /begin DEF_CHARACTERISTIC CWLLRPA DMLLNGEZ DMLLNGEZV DMLLRLMNN DMLLRLMXN DMLLRMNN DMLLRMNNK DMLLRMXN DMLLRMXNK DNLLRIST DNLLST DNMNI DVNG DVNGV FDDN FDNIKOR GFDLDN IVDNDTEH IVDNHOM IVDNHOMV LIMN LIMNDLLR LIMNDTES LIMNV LIMXDNS LIMXVDNS LISTM LLRICNF PVDNHOM PVDNHOMV PVDNKH PVDNST PVLDNEZ PVLDNEZKH PVLDNEZV SDN10LLSW SEZ04LLUB SNS206LLSB SRKTEVS TVLISTU TVLLRPST TVPKH ZFLLRPL ZKLLRD ZLIBG ZNFNGLL /end DEF_CHARACTERISTIC
 /begin REF_CHARACTERISTIC SNG06LLSB SNM06LLUB SNS06LLSB STM06LLUB /end REF_CHARACTERISTIC
 /begin IN_MEASUREMENT B_dllr B_dteaam B_dtes B_dtest B_faan B_kh B_kha B_llr B_llrein B_llri B_llrpd B_mdmin B_nswo1 B_st B_stend B_temin B_trkh B_vllr dns esst_sng06llsb esst_snm06llub esst_sns06llsb esst_stm06llub etazws ngas_w ngfil nmot_w nsol_w nstat tmot /end IN_MEASUREMENT
 /begin OUT_MEASUREMENT B_llrst dmllrdl_w dmllrd_w dmllri_w dmllrl_w dmllrpl_w dmllrp_w dmllr_w dn dn_w esst_sdn10llsw esst_sez04llub esst_sns206llsb limax_w limin_w /end OUT_MEASUREMENT
 /begin LOC_MEASUREMENT B_llrpkh B_llrpst dmllrib_w dmllrii_w dmllriz_w dnbi_w dnikorr_w iver limnst ngasf_w /end LOC_MEASUREMENT
/end FUNCTION
/begin COMPU_METHOD B_TRUE "" TAB_VERB "%6.3" "" COMPU_TAB_REF B_TRUE /end COMPU_METHOD
/begin COMPU_VTAB B_TRUE "" TAB_VERB 2 0 "----" 1 "TRUE" /end COMPU_VTAB
/begin COMPU_METHOD dez "" RAT_FUNC "%6.2" "" COEFFS 0 1 0 0 0 1 /end COMPU_METHOD
/begin COMPU_METHOD fak_q0p000244 "" RAT_FUNC "%6.5" "-" COEFFS 0 65536 0 0 0 16 /end COMPU_METHOD
/begin COMPU_METHOD fak_q0p00153 "" RAT_FUNC "%6.4" "-" COEFFS 0 256 0 0 0 0.390625 /end COMPU_METHOD
/begin COMPU_METHOD fak_sb_b1 "" RAT_FUNC "%6.4" "-" COEFFS 0 256 0 0 0 2 /end COMPU_METHOD
/begin COMPU_METHOD fak_sb_b127 "" RAT_FUNC "%6.2" "-" COEFFS 0 1 0 0 0 1 /end COMPU_METHOD
/begin COMPU_METHOD fak_sw_b1 "" RAT_FUNC "%7.6" "-" COEFFS 0 65536 0 0 0 2 /end COMPU_METHOD
/begin COMPU_METHOD fak_sw_b8 "" RAT_FUNC "%6.5" "-" COEFFS 0 65536 0 0 0 16 /end COMPU_METHOD
/begin COMPU_METHOD fak_ub_b1 "" RAT_FUNC "%6.4" "-" COEFFS 0 256 0 0 0 1 /end COMPU_METHOD
/begin COMPU_METHOD fak_ub_b16 "" RAT_FUNC "%6.4" "-" COEFFS 0 256 0 0 0 16 /end COMPU_METHOD
/begin COMPU_METHOD fak_ub_b2 "" RAT_FUNC "%6.4" "-" COEFFS 0 256 0 0 0 2 /end COMPU_METHOD
/begin COMPU_METHOD fak_ub_b2p55 "" RAT_FUNC "%6.4" "" COEFFS 0 256 0 0 0 2.56 /end COMPU_METHOD
/begin COMPU_METHOD fak_ub_b4 "" RAT_FUNC "%6.4" "-" COEFFS 0 256 0 0 0 4 /end COMPU_METHOD
/begin COMPU_METHOD fak_ub_q0p015 "" RAT_FUNC "%6.4" "-" COEFFS 0 63.75 0 0 0 1 /end COMPU_METHOD
/begin COMPU_METHOD fak_uw_b16 "" RAT_FUNC "%6.5" "-" COEFFS 0 65536 0 0 0 16 /end COMPU_METHOD
/begin COMPU_METHOD fak_uw_b2 "" RAT_FUNC "%7.6" "-" COEFFS 0 65536 0 0 0 2 /end COMPU_METHOD
/begin COMPU_METHOD fak_uw_b4 "" RAT_FUNC "%7.6" "-" COEFFS 0 65536 0 0 0 4 /end COMPU_METHOD
/begin COMPU_METHOD kw_uw_q0p0078 "" RAT_FUNC "%6.4" "Grad KW" COEFFS 0 128 0 0 0 1 /end COMPU_METHOD
/begin COMPU_METHOD m_ub_b1020 "" RAT_FUNC "%6.2" "kg/h" COEFFS 0 1 0 0 0 4 /end COMPU_METHOD
/begin COMPU_METHOD m_ub_b23p3 "" RAT_FUNC "%6.3" "kg" COEFFS 0 2812.5 0 0 0 256 /end COMPU_METHOD
/begin COMPU_METHOD m_ub_b780 "" RAT_FUNC "%6.2" "cm^3/min" COEFFS 0 256 0 0 0 780 /end COMPU_METHOD
/begin COMPU_METHOD m_uw_b6553p5 "" RAT_FUNC "%6.3" "kg/h" COEFFS 0 1 0 0 0 0.1 /end COMPU_METHOD
/begin COMPU_METHOD nmotd_sb_q10 "" RAT_FUNC "%6.1" "1/min" COEFFS 0 1 0 0 0 10 /end COMPU_METHOD
/begin COMPU_METHOD nmotg_qn1p953125 "" RAT_FUNC "%6.4" "U/min/s" COEFFS 0 -512 0 0 0 1000 /end COMPU_METHOD
/begin COMPU_METHOD nmotg_sb_q100 "" RAT_FUNC "%6.0" "1/min/s" COEFFS 0 1 0 0 0 100 /end COMPU_METHOD
/begin COMPU_METHOD nmotg_sw_q0p39 "" RAT_FUNC "%6.3" "1/min/s" COEFFS 0 1 0 0 0 0.39063 /end COMPU_METHOD
/begin COMPU_METHOD nmotg_ub_q100 "" RAT_FUNC "%6.0" "1/min/s" COEFFS 0 1 0 0 0 100 /end COMPU_METHOD
/begin COMPU_METHOD nmotg_uw_b2550 "" RAT_FUNC "%6.4" "U/min/s" COEFFS 0 256 0 0 0 10 /end COMPU_METHOD
/begin COMPU_METHOD nmot_q0p0025 "" RAT_FUNC "%6.4" "U/min" COEFFS 0 1 0 0 0 0.0025 /end COMPU_METHOD
/begin COMPU_METHOD nmot_q1 "" RAT_FUNC "%6.2" "1/min" COEFFS 0 1 0 0 0 1 /end COMPU_METHOD
/begin COMPU_METHOD nmot_sb_q10 "" RAT_FUNC "%6.1" "1/min" COEFFS 0 1 0 0 0 10 /end COMPU_METHOD
/begin COMPU_METHOD nmot_sw_q0p25 "" RAT_FUNC "%6.3" "1/min" COEFFS 0 1 0 0 0 0.25 /end COMPU_METHOD
/begin COMPU_METHOD nmot_ub_q10 "" RAT_FUNC "%6.1" "1/min" COEFFS 0 1 0 0 0 10 /end COMPU_METHOD
/begin COMPU_METHOD nmot_ub_q20 "" RAT_FUNC "%6.1" "1/min" COEFFS 0 1 0 0 0 20 /end COMPU_METHOD
/begin COMPU_METHOD nmot_ub_q40 "" RAT_FUNC "%6.1" "1/min" COEFFS 0 1 0 0 0 40 /end COMPU_METHOD
/begin COMPU_METHOD nmot_uw_q0p25 "" RAT_FUNC "%6.3" "1/min" COEFFS 0 1 0 0 0 0.25 /end COMPU_METHOD
/begin COMPU_METHOD p_q0p2 "" RAT_FUNC "%6.3" "bar" COEFFS 0 5 0 0 0 1 /end COMPU_METHOD
/begin COMPU_METHOD p_ub_q5 "" RAT_FUNC "%6.2" "hPa" COEFFS 0 1 0 0 0 5 /end COMPU_METHOD
/begin COMPU_METHOD qnv_uw_b512 "" RAT_FUNC "%6.4" "(1/min) / (km/h)" COEFFS 0 65536 0 0 0 512 /end COMPU_METHOD
/begin COMPU_METHOD relPED_ub_b100 "" RAT_FUNC "%6.3" "%PED" COEFFS 0 255 0 0 0 100 /end COMPU_METHOD
/begin COMPU_METHOD rel_q0p002383 "" RAT_FUNC "%6.4" "%/(s*1/min)" COEFFS 0 256 0 0 0 0.61 /end COMPU_METHOD
/begin COMPU_METHOD rel_q0p00305 "" RAT_FUNC "%6.4" "%/(1/min)" COEFFS 0 256 0 0 0 0.7812 /end COMPU_METHOD
/begin COMPU_METHOD rel_q0p39 "" RAT_FUNC "%6.3" "%" COEFFS 0 256 0 0 0 100 /end COMPU_METHOD
/begin COMPU_METHOD rel_qn0p000488 "" RAT_FUNC "%8.7" "(%*s)/(1/min)" COEFFS 0 -256 0 0 0 0.125 /end COMPU_METHOD
/begin COMPU_METHOD rel_sb_b100 "" RAT_FUNC "%6.3" "%" COEFFS 0 128 0 0 0 100 /end COMPU_METHOD
/begin COMPU_METHOD rel_sb_q0p39 "" RAT_FUNC "%6.3" "%" COEFFS 0 1 0 0 0 0.3906 /end COMPU_METHOD
/begin COMPU_METHOD rel_sb_q0p75 "" RAT_FUNC "%6.3" "%" COEFFS 0 1 0 0 0 0.75 /end COMPU_METHOD
/begin COMPU_METHOD rel_sw_b100 "" RAT_FUNC "%6.4" "%" COEFFS 0 32768 0 0 0 100 /end COMPU_METHOD
/begin COMPU_METHOD rel_sw_q0p0234 "" RAT_FUNC "%6.4" "%/seg" COEFFS 0 32 0 0 0 0.75 /end COMPU_METHOD
/begin COMPU_METHOD rel_ub_b100 "" RAT_FUNC "%6.3" "%" COEFFS 0 256 0 0 0 100 /end COMPU_METHOD
/begin COMPU_METHOD rel_ub_b127p5 "" RAT_FUNC "%6.3" "%" COEFFS 0 2 0 0 0 1 /end COMPU_METHOD
/begin COMPU_METHOD rel_ub_b1p0 "" RAT_FUNC "%6.4" "%" COEFFS 0 256 0 0 0 1 /end COMPU_METHOD
/begin COMPU_METHOD rel_ub_b200 "" RAT_FUNC "%6.3" "%" COEFFS 0 256 0 0 0 200 /end COMPU_METHOD
/begin COMPU_METHOD rel_ub_b24p9 "" RAT_FUNC "%6.3" "%" COEFFS 0 255 0 0 0 24.9 /end COMPU_METHOD
/begin COMPU_METHOD rel_ub_b99p6 "" RAT_FUNC "%6.3" "%" COEFFS 0 256 0 0 0 100 /end COMPU_METHOD
/begin COMPU_METHOD rel_ub_bn24p9 "" RAT_FUNC "%6.5" "%" COEFFS 0 -255 0 0 0 24.9 /end COMPU_METHOD
/begin COMPU_METHOD rel_ub_q0p00153 "" RAT_FUNC "%6.4" "%" COEFFS 0 256 0 0 0 0.3906 /end COMPU_METHOD
/begin COMPU_METHOD rel_ub_q0p75 "" RAT_FUNC "%6.3" "%" COEFFS 0 1 0 0 0 0.75 /end COMPU_METHOD
/begin COMPU_METHOD rel_ub_q0p75_o48 "" RAT_FUNC "%6.2" "%" COEFFS 0 1 48 0 0 0.75 /end COMPU_METHOD
/begin COMPU_METHOD rel_uw_b100 "" RAT_FUNC "%6.4" "%" COEFFS 0 65536 0 0 0 100 /end COMPU_METHOD
/begin COMPU_METHOD rel_uw_b200 "" RAT_FUNC "%6.4" "%" COEFFS 0 65536 0 0 0 200 /end COMPU_METHOD
/begin COMPU_METHOD rel_uw_q0p0234 "" RAT_FUNC "%6.4" "%" COEFFS 0 32 0 0 0 0.75 /end COMPU_METHOD
/begin COMPU_METHOD spg_ubatt_sy "" RAT_FUNC "%6.4" "V" COEFFS 0 14.2222222222222 0 0 0 1 /end COMPU_METHOD
/begin COMPU_METHOD spg_ub_b320 "" RAT_FUNC "%7.3" "V" COEFFS 0 1 0 0 0 1.25 /end COMPU_METHOD
/begin COMPU_METHOD spg_ub_b5 "" RAT_FUNC "%6.4" "V" COEFFS 0 256 0 0 0 5 /end COMPU_METHOD
/begin COMPU_METHOD t100msxs_ub_b25p5 "" RAT_FUNC "%6.3" "s" COEFFS 0 1 0 0 0 0.1 /end COMPU_METHOD
/begin COMPU_METHOD t100msxs_uw_b6553p5 "" RAT_FUNC "%6.3" "s" COEFFS 0 1 0 0 0 0.1 /end COMPU_METHOD
/begin COMPU_METHOD t10msxs_uw_b655p35 "" RAT_FUNC "%6.4" "s" COEFFS 0 1 0 0 0 0.01 /end COMPU_METHOD
/begin COMPU_METHOD t1msxms_q1 "" RAT_FUNC "%6.2" "ms" COEFFS 0 1 0 0 0 1 /end COMPU_METHOD
/begin COMPU_METHOD t1sxs_ub_b255 "" RAT_FUNC "%6.2" "s" COEFFS 0 1 0 0 0 1 /end COMPU_METHOD
/begin COMPU_METHOD t1sxs_uw_b65535 "" RAT_FUNC "%6.2" "s" COEFFS 0 1 0 0 0 1 /end COMPU_METHOD
/begin COMPU_METHOD t200msxs_ub_b51 "" RAT_FUNC "%6.3" "s" COEFFS 0 1 0 0 0 0.2 /end COMPU_METHOD
/begin COMPU_METHOD t200msxs_uw_q0p2 "" RAT_FUNC "%6.3" "s" COEFFS 0 1 0 0 0 0.2 /end COMPU_METHOD
/begin COMPU_METHOD t20msxs_ub_b5p1 "" RAT_FUNC "%6.4" "s" COEFFS 0 1 0 0 0 0.02 /end COMPU_METHOD
/begin COMPU_METHOD t20msxs_uw_b1310 "" RAT_FUNC "%6.4" "s" COEFFS 0 1 0 0 0 0.02 /end COMPU_METHOD
/begin COMPU_METHOD t20msxs_uw_q0p02 "" RAT_FUNC "%6.4" "s" COEFFS 0 1 0 0 0 0.02 /end COMPU_METHOD
/begin COMPU_METHOD t40msxs_ub_q0p04 "" RAT_FUNC "%6.4" "s" COEFFS 0 1 0 0 0 0.04 /end COMPU_METHOD
/begin COMPU_METHOD temp_q0p0234_o273 "" RAT_FUNC "%6.1" "Grad C" COEFFS 0 1 273.15 0 0 0.0234375 /end COMPU_METHOD
/begin COMPU_METHOD temp_sb_q0p75 "" RAT_FUNC "%6.3" "Grad C" COEFFS 0 1 0 0 0 0.75 /end COMPU_METHOD
/begin COMPU_METHOD temp_ub_b191p25 "" RAT_FUNC "%6.3" "Grad C" COEFFS 0 1 0 0 0 0.75 /end COMPU_METHOD
/begin COMPU_METHOD temp_ub_q0p75_o48 "" RAT_FUNC "%6.2" "Grad C" COEFFS 0 1 48 0 0 0.75 /end COMPU_METHOD
/begin COMPU_METHOD temp_ub_q1_o60 "" RAT_FUNC "%6.2" "Grad C" COEFFS 0 1 60 0 0 1 /end COMPU_METHOD
/begin COMPU_METHOD temp_ub_q5_o50 "" RAT_FUNC "%6.2" "Grad C" COEFFS 0 1 50 0 0 5 /end COMPU_METHOD
/begin COMPU_METHOD temp_uw_q0p0195 "" RAT_FUNC "%6.4" "Grad C" COEFFS 0 256 0 0 0 5 /end COMPU_METHOD
/begin COMPU_METHOD temp_uw_q0p0195_o50 "" RAT_FUNC "%6.2" "Grad C" COEFFS 0 256 12800 0 0 5 /end COMPU_METHOD
/begin COMPU_METHOD tv_ub_b100 "" RAT_FUNC "%6.3" "%TV" COEFFS 0 256 0 0 0 100 /end COMPU_METHOD
/begin COMPU_METHOD t_q0p02 "" RAT_FUNC "%6.4" "s" COEFFS 0 100 0 0 0 2 /end COMPU_METHOD
/begin COMPU_METHOD vfzg_ub_q1p25 "" RAT_FUNC "%6.2" "km/h" COEFFS 0 1 0 0 0 1.25 /end COMPU_METHOD
/begin COMPU_METHOD volgrd_q5p96Em4 "" RAT_FUNC "%6.5" "ml/s" COEFFS 0 65536 0 0 0 39.0625 /end COMPU_METHOD
/begin COMPU_METHOD zk100msxs_ub_b25p5 "" RAT_FUNC "%6.3" "s" COEFFS 0 0 256 0 10 0 /end COMPU_METHOD
/begin COMPU_METHOD zk100msxs_uw_b6553 "" RAT_FUNC "%6.1" "s" COEFFS 0 0 65536 0 10 0 /end COMPU_METHOD
/begin COMPU_METHOD zk10msxs_uw_b655 "" RAT_FUNC "%6.2" "s" COEFFS 0 0 65536 0 100 0 /end COMPU_METHOD
/begin COMPU_METHOD zk1sxs_ub_b255 "" RAT_FUNC "%6.2" "s" COEFFS 0 0 256 0 1 0 /end COMPU_METHOD
/begin COMPU_METHOD zk1sxs_uw_b65535 "" RAT_FUNC "%6.0" "s" COEFFS 0 0 65535 0 1 0 /end COMPU_METHOD
/begin COMPU_METHOD zk200msxs_ub_b51p2 "" RAT_FUNC "%6.3" "s" COEFFS 0 0 255 0 5 0 /end COMPU_METHOD
/begin COMPU_METHOD zk200msxs_uw_b13107 "" RAT_FUNC "%12.3" "s" COEFFS 0 0 13107.2 0 1 0 /end COMPU_METHOD
/begin COMPU_METHOD zk20msxs_ub_b5p1 "" RAT_FUNC "%6.4" "s" COEFFS 0 0 5.1 0 1 0 /end COMPU_METHOD
/begin COMPU_METHOD zk20msxs_uw_b1310 "" RAT_FUNC "%12.4" "s" COEFFS 0 0 65536 0 50 0 /end COMPU_METHOD
/begin COMPU_METHOD zk20msxs_uw_b1310p72 "" RAT_FUNC "%6.1" "s" COEFFS 0 0 65536 0 50 0 /end COMPU_METHOD
/begin COMPU_METHOD zw_sb_q0p75 "" RAT_FUNC "%6.3" "Grad KW" COEFFS 0 255 0 0 0 191.25 /end COMPU_METHOD
/begin COMPU_METHOD zw_ub_q0p75 "" RAT_FUNC "%6.3" "Grad KW" COEFFS 0 255 0 0 0 191.25 /end COMPU_METHOD
/begin COMPU_METHOD zw_ub_qn0p75 "" RAT_FUNC "%6.4" "Grad KW" COEFFS 0 1 0 0 0 -0.75 /end COMPU_METHOD
/begin COMPU_METHOD zw_uw_qn0p75 "" RAT_FUNC "%6.4" "grad KW" COEFFS 0 1 0 0 0 -0.75 /end COMPU_METHOD
/begin RECORD_LAYOUT FklWUw FNC_VALUES 1 UWORD COLUMN_DIR DIRECT /end RECORD_LAYOUT
/begin RECORD_LAYOUT GkfWSb FNC_VALUES 1 SBYTE COLUMN_DIR DIRECT /end RECORD_LAYOUT
/begin RECORD_LAYOUT GkfWSw FNC_VALUES 1 SWORD COLUMN_DIR DIRECT /end RECORD_LAYOUT
/begin RECORD_LAYOUT GkfWUb FNC_VALUES 1 UBYTE COLUMN_DIR DIRECT /end RECORD_LAYOUT
/begin RECORD_LAYOUT GklWSb FNC_VALUES 1 SBYTE COLUMN_DIR DIRECT /end RECORD_LAYOUT
/begin RECORD_LAYOUT GklWSw FNC_VALUES 1 SWORD COLUMN_DIR DIRECT /end RECORD_LAYOUT
/begin RECORD_LAYOUT GklWUb FNC_VALUES 1 UBYTE COLUMN_DIR DIRECT /end RECORD_LAYOUT
/begin RECORD_LAYOUT GklWUw FNC_VALUES 1 UWORD COLUMN_DIR DIRECT /end RECORD_LAYOUT
/begin RECORD_LAYOUT KfAxUbAyUbSstxSbSstyUbWUb NO_AXIS_PTS_X 1 UBYTE NO_AXIS_PTS_Y 2 UBYTE AXIS_PTS_X 3 SBYTE INDEX_INCR DIRECT AXIS_PTS_Y 4 UBYTE INDEX_INCR DIRECT FNC_VALUES 5 UBYTE COLUMN_DIR DIRECT /end RECORD_LAYOUT
/begin RECORD_LAYOUT KfAxUbAyUbSstxSwSstyUbWSw NO_AXIS_PTS_X 1 UBYTE NO_AXIS_PTS_Y 2 UBYTE AXIS_PTS_X 3 SWORD INDEX_INCR DIRECT AXIS_PTS_Y 4 UBYTE INDEX_INCR DIRECT FNC_VALUES 5 SWORD COLUMN_DIR DIRECT /end RECORD_LAYOUT
/begin RECORD_LAYOUT KfAxUbAyUbSstxUbSstyUbWSb NO_AXIS_PTS_X 1 UBYTE NO_AXIS_PTS_Y 2 UBYTE AXIS_PTS_X 3 UBYTE INDEX_INCR DIRECT AXIS_PTS_Y 4 UBYTE INDEX_INCR DIRECT FNC_VALUES 5 SBYTE COLUMN_DIR DIRECT /end RECORD_LAYOUT
/begin RECORD_LAYOUT KfAxUbAyUbSstxUbSstyUbWUb NO_AXIS_PTS_X 1 UBYTE NO_AXIS_PTS_Y 2 UBYTE AXIS_PTS_X 3 UBYTE INDEX_INCR DIRECT AXIS_PTS_Y 4 UBYTE INDEX_INCR DIRECT FNC_VALUES 5 UBYTE COLUMN_DIR DIRECT /end RECORD_LAYOUT
/begin RECORD_LAYOUT KfAxUbAyUbSstxUbSstyUwWUb NO_AXIS_PTS_X 1 UBYTE NO_AXIS_PTS_Y 2 UBYTE AXIS_PTS_X 3 UBYTE INDEX_INCR DIRECT AXIS_PTS_Y 4 UWORD INDEX_INCR DIRECT FNC_VALUES 5 UBYTE COLUMN_DIR DIRECT /end RECORD_LAYOUT
/begin RECORD_LAYOUT KfAxUbAyUbSstxUbSstyUwWUw NO_AXIS_PTS_X 1 UBYTE NO_AXIS_PTS_Y 2 UBYTE AXIS_PTS_X 3 UBYTE INDEX_INCR DIRECT AXIS_PTS_Y 4 UWORD INDEX_INCR DIRECT FNC_VALUES 5 UWORD COLUMN_DIR DIRECT /end RECORD_LAYOUT
/begin RECORD_LAYOUT KfAxUbAyUbSstxUwSstyUbWUb NO_AXIS_PTS_X 1 UBYTE NO_AXIS_PTS_Y 2 UBYTE AXIS_PTS_X 3 UWORD INDEX_INCR DIRECT AXIS_PTS_Y 4 UBYTE INDEX_INCR DIRECT FNC_VALUES 5 UBYTE COLUMN_DIR DIRECT /end RECORD_LAYOUT
/begin RECORD_LAYOUT KfAxUwAyUwSstxUwSstyUwWUw NO_AXIS_PTS_X 1 UWORD NO_AXIS_PTS_Y 2 UWORD AXIS_PTS_X 3 UWORD INDEX_INCR DIRECT AXIS_PTS_Y 4 UWORD INDEX_INCR DIRECT FNC_VALUES 5 UWORD COLUMN_DIR DIRECT /end RECORD_LAYOUT
/begin RECORD_LAYOUT KlAUbSstSbWUb NO_AXIS_PTS_X 1 UBYTE AXIS_PTS_X 2 SBYTE INDEX_INCR DIRECT FNC_VALUES 3 UBYTE COLUMN_DIR DIRECT /end RECORD_LAYOUT
/begin RECORD_LAYOUT KlAUbSstUbWSb NO_AXIS_PTS_X 1 UBYTE AXIS_PTS_X 2 UBYTE INDEX_INCR DIRECT FNC_VALUES 3 SBYTE COLUMN_DIR DIRECT /end RECORD_LAYOUT
/begin RECORD_LAYOUT KlAUbSstUbWUb NO_AXIS_PTS_X 1 UBYTE AXIS_PTS_X 2 UBYTE INDEX_INCR DIRECT FNC_VALUES 3 UBYTE COLUMN_DIR DIRECT /end RECORD_LAYOUT
/begin RECORD_LAYOUT KlAUbSstUbWUw NO_AXIS_PTS_X 1 UBYTE AXIS_PTS_X 2 UBYTE INDEX_INCR DIRECT FNC_VALUES 3 UWORD COLUMN_DIR DIRECT /end RECORD_LAYOUT
/begin RECORD_LAYOUT KlAUbSstUwWUb NO_AXIS_PTS_X 1 UBYTE AXIS_PTS_X 2 UWORD INDEX_INCR DIRECT FNC_VALUES 3 UBYTE COLUMN_DIR DIRECT /end RECORD_LAYOUT
/begin RECORD_LAYOUT KlAUwSstSwWUw NO_AXIS_PTS_X 1 UWORD AXIS_PTS_X 2 SWORD INDEX_INCR DIRECT FNC_VALUES 3 UWORD COLUMN_DIR DIRECT /end RECORD_LAYOUT
/begin RECORD_LAYOUT KlAUwSstUwWSw NO_AXIS_PTS_X 1 UWORD AXIS_PTS_X 2 UWORD INDEX_INCR DIRECT FNC_VALUES 3 SWORD COLUMN_DIR DIRECT /end RECORD_LAYOUT
/begin RECORD_LAYOUT KlAUwSstUwWUw NO_AXIS_PTS_X 1 UWORD AXIS_PTS_X 2 UWORD INDEX_INCR DIRECT FNC_VALUES 3 UWORD COLUMN_DIR DIRECT /end RECORD_LAYOUT
/begin RECORD_LAYOUT KwbUb FNC_VALUES 1 UBYTE COLUMN_DIR DIRECT /end RECORD_LAYOUT
/begin RECORD_LAYOUT KwSb FNC_VALUES 1 SBYTE COLUMN_DIR DIRECT /end RECORD_LAYOUT
/begin RECORD_LAYOUT KwSw FNC_VALUES 1 SWORD COLUMN_DIR DIRECT /end RECORD_LAYOUT
/begin RECORD_LAYOUT KwUb FNC_VALUES 1 UBYTE COLUMN_DIR DIRECT /end RECORD_LAYOUT
/begin RECORD_LAYOUT KwUw FNC_VALUES 1 UWORD COLUMN_DIR DIRECT /end RECORD_LAYOUT
/begin RECORD_LAYOUT SstASwSstSw NO_AXIS_PTS_X 1 SWORD AXIS_PTS_X 2 SWORD INDEX_INCR DIRECT /end RECORD_LAYOUT
/begin RECORD_LAYOUT SstAUbSstSb NO_AXIS_PTS_X 1 SBYTE AXIS_PTS_X 2 SBYTE INDEX_INCR DIRECT /end RECORD_LAYOUT
/begin RECORD_LAYOUT SstAUbSstUb NO_AXIS_PTS_X 1 UBYTE AXIS_PTS_X 2 UBYTE INDEX_INCR DIRECT /end RECORD_LAYOUT
/begin RECORD_LAYOUT SstAUwSstUw NO_AXIS_PTS_X 1 UWORD AXIS_PTS_X 2 UWORD INDEX_INCR DIRECT /end RECORD_LAYOUT
/end MODULE
/end PROJECT
