/begin PROJECT X505S24EX "4016.32"
/begin HEADER "" VERSION "X505S24EX" PROJECT_NO X505S24EX /end HEADER
/begin MODULE DIM ""
/begin MOD_COMMON "" BYTE_ORDER BIG_ENDIAN S_REC_LAYOUT DAMOS /end MOD_COMMON
/begin CHARACTERISTIC MWNTKB14 "Meßwert lesen normiert Testerkommunikation Block 14" VAL_BLK 0x826E2E KwbUw 65535.00 dez 0.00 65535.00 NUMBER 40 FUNCTION_LIST TKMWL IF_DATA DIM_X DIRECT 0x826E2E /end CHARACTERISTIC
/begin CHARACTERISTIC MWNTKB15 "Meßwert lesen normiert Testerkommunikation Block 15" VAL_BLK 0x826E7E KwbUw 65535.00 dez 0.00 65535.00 NUMBER 40 FUNCTION_LIST TKMWL IF_DATA DIM_X DIRECT 0x826E7E /end CHARACTERISTIC
/begin CHARACTERISTIC MWNTKB16 "Meßwert lesen normiert Testerkommunikation Block 16" VAL_BLK 0x826ECE KwbUw 65535.00 dez 0.00 65535.00 NUMBER 40 FUNCTION_LIST TKMWL IF_DATA DIM_X DIRECT 0x826ECE /end CHARACTERISTIC
/begin CHARACTERISTIC MWNTKB17 "Meßwert lesen normiert Testerkommunikation Block 17" VAL_BLK 0x826F1E KwbUw 65535.00 dez 0.00 65535.00 NUMBER 40 FUNCTION_LIST TKMWL IF_DATA DIM_X DIRECT 0x826F1E /end CHARACTERISTIC
/begin CHARACTERISTIC MWNTKB18 "Meßwert lesen normiert Testerkommunikation Block 18" VAL_BLK 0x826F6E KwbUw 65535.00 dez 0.00 65535.00 NUMBER 40 FUNCTION_LIST TKMWL IF_DATA DIM_X DIRECT 0x826F6E /end CHARACTERISTIC
/begin CHARACTERISTIC MWNTKB2 "Meßwert lesen normiert Testerkommunikation Block 2" VAL_BLK 0x827086 KwbUw 65535.00 dez 0.00 65535.00 NUMBER 40 FUNCTION_LIST TKMWL IF_DATA DIM_X DIRECT 0x827086 /end CHARACTERISTIC
/begin CHARACTERISTIC MWNTKB20 "Meßwert lesen normiert Testerkommunikation Block 20" VAL_BLK 0x8270D6 KwbUw 65535.00 dez 0.00 65535.00 NUMBER 40 FUNCTION_LIST TKMWL IF_DATA DIM_X DIRECT 0x8270D6 /end CHARACTERISTIC
/begin CHARACTERISTIC MWNTKB3 "Meßwert lesen normiert Testerkommunikation Block 3" VAL_BLK 0x827296 KwbUw 65535.00 dez 0.00 65535.00 NUMBER 40 FUNCTION_LIST TKMWL IF_DATA DIM_X DIRECT 0x827296 /end CHARACTERISTIC
/begin CHARACTERISTIC MWNTKB4 "Meßwert lesen normiert Testerkommunikation Block 4" VAL_BLK 0x8272E6 KwbUw 65535.00 dez 0.00 65535.00 NUMBER 40 FUNCTION_LIST TKMWL IF_DATA DIM_X DIRECT 0x8272E6 /end CHARACTERISTIC
/begin CHARACTERISTIC MWNTKB5 "Meßwert lesen normiert Testerkommunikation Block 5" VAL_BLK 0x827336 KwbUw 65535.00 dez 0.00 65535.00 NUMBER 40 FUNCTION_LIST TKMWL KRACT IF_DATA DIM_X DIRECT 0x827336 /end CHARACTERISTIC
/begin CHARACTERISTIC MWNTKB6 "Meßwert lesen normiert Testerkommunikation Block 6" VAL_BLK 0x827386 KwbUw 65535.00 dez 0.00 65535.00 NUMBER 40 FUNCTION_LIST TKMWL IF_DATA DIM_X DIRECT 0x827386 /end CHARACTERISTIC
/begin CHARACTERISTIC MWNTKB9 "Meßwert lesen normiert Testerkommunikation Block 9" VAL_BLK 0x827476 KwbUw 65535.00 dez 0.00 65535.00 NUMBER 40 FUNCTION_LIST TKMWL IF_DATA DIM_X DIRECT 0x827476 /end CHARACTERISTIC
/begin CHARACTERISTIC MXFLAD "Max. Anzahl Flankenadaptionen Nockenwellen Phasensensor" VALUE 0x81A88A KwUb 255.0 dez 0.00 255.0 FUNCTION_LIST BGARNW IF_DATA DIM_X DIRECT 0x81A88A /end CHARACTERISTIC
/begin CHARACTERISTIC MXNLN "Mindestanzahl von Zahnsignalen zur Heilung des NLDG" VALUE 0x818489 KwUb 255.0 dez 0.00 255.0 FUNCTION_LIST DDG IF_DATA DIM_X DIRECT 0x818489 /end CHARACTERISTIC
/begin CHARACTERISTIC MZFFIL_UC "Filter-Zeitkonstante für verzögertes Moment im Befehlstest" VALUE 0x812667 KwUb 10159.4 zk40ms_ub_b10200 40.6299 10200.0 FUNCTION_LIST URCMZF IF_DATA DIM_X DIRECT 0x812667 /end CHARACTERISTIC
/begin CHARACTERISTIC MZFFIL_UM "Filter-Zeitkonstante für verzögertes Moment in der Funktionsüberwachung" VALUE 0x8141F7 KwUb 10159.4 zk40ms_ub_b10200 40.6299 10200.0 FUNCTION_LIST UFMZF IF_DATA DIM_X DIRECT 0x8141F7 /end CHARACTERISTIC
/begin CHARACTERISTIC MZFPTR_DAT_UC "" VAL_BLK 0x812373 KwbUb 255.0 dez 0.00 255.0 NUMBER 16 FUNCTION_LIST URCEIN IF_DATA DIM_X DIRECT 0x812373 /end CHARACTERISTIC
/begin CHARACTERISTIC MZFREG_DAT_UC "" MAP 0x812383 KfWUb 255.0 dez 0.00 255.0 FUNCTION_LIST URCEIN IF_DATA DIM_X DIRECT 0x812383 /begin AXIS_DESCR FIX_AXIS x_uc dez 16 0.00 15.00 FIX_AXIS_PAR 0 0 16 /end AXIS_DESCR /begin AXIS_DESCR FIX_AXIS y_uc dez 8 0.00 7.000 FIX_AXIS_PAR 0 0 8 /end AXIS_DESCR /end CHARACTERISTIC
/begin CHARACTERISTIC MZFTV_UC "Verzugszeit für zulässiges Moment mz_um im Befehlstest" VALUE 0x812668 KwUb 280.000 t40ms_ub_b10200 40.0000 320.000 FUNCTION_LIST URCMZF URCREF IF_DATA DIM_X DIRECT 0x812668 /end CHARACTERISTIC
/begin CHARACTERISTIC MZFTV_UM "Verzugszeit für zulässiges Moment mz_um in der Funktionsüberwachg" VALUE 0x8141F8 KwUb 280.000 t40ms_ub_b10200 40.0000 320.000 FUNCTION_LIST UFMZF IF_DATA DIM_X DIRECT 0x8141F8 /end CHARACTERISTIC
/begin CHARACTERISTIC MZF_DAT_UC "" VAL_BLK 0x812403 KwbUb 99.61 rel_ub_q0p3906 0.00 99.61 NUMBER 16 FUNCTION_LIST URCEIN IF_DATA DIM_X DIRECT 0x812403 /end CHARACTERISTIC
/begin CHARACTERISTIC MZL_DAT_UC "" VAL_BLK 0x812413 KwbUb 0.3891 rel_ub_q0p00153 0.00 0.3891 NUMBER 16 FUNCTION_LIST URCEIN IF_DATA DIM_X DIRECT 0x812413 /end CHARACTERISTIC
/begin CHARACTERISTIC N0 "Umrechnungskonstante für Einrechnung Gemischkorrektur rkat" VALUE 0x811610 KwUb 10200. nmot_ub_q40 0.00 10200. FUNCTION_LIST LRA IF_DATA DIM_X DIRECT 0x811610 /end CHARACTERISTIC
/begin CHARACTERISTIC NACHANZ "" VALUE 0x8127A8 KwUb 255.0 dez 0.00 255.0 FUNCTION_LIST ZUE IF_DATA DIM_X DIRECT 0x8127A8 /end CHARACTERISTIC
/begin CHARACTERISTIC NARASTGU "Gangabhängige Drehzahlschwelle für AR aktiv" CURVE 0x811EF5 FklWUb 10200. nmot_ub_q40 0.00 10200. FUNCTION_LIST ARMD IF_DATA DIM_X DIRECT 0x811EF5 /begin AXIS_DESCR FIX_AXIS gangi dez 8 0.00 7.000 FIX_AXIS_PAR 0 0 8 /end AXIS_DESCR /end CHARACTERISTIC
/begin CHARACTERISTIC NARLLGA "Drehzahlschwelle für AR im Leerlauf" CURVE 0x811EFD FklWUb 10200. nmot_ub_q40 0.00 10200. FUNCTION_LIST ARMD IF_DATA DIM_X DIRECT 0x811EFD /begin AXIS_DESCR FIX_AXIS gangi dez 8 0.00 7.000 FIX_AXIS_PAR 0 0 8 /end AXIS_DESCR /end CHARACTERISTIC
/begin CHARACTERISTIC NARLLMXG "Maximaldrehzahl für Aktivierung Antiruckel-Eingriff im Leerlauf" CURVE 0x811F05 FklWUb 10200. nmot_ub_q40 0.00 10200. FUNCTION_LIST ARMD IF_DATA DIM_X DIRECT 0x811F05 /begin AXIS_DESCR FIX_AXIS gangi dez 8 0.00 7.000 FIX_AXIS_PAR 0 0 8 /end AXIS_DESCR /end CHARACTERISTIC
/begin CHARACTERISTIC NARMXG "Maximaldrehzahl für Aktivierung Antiruckel-Eingriff außerhalb Leerlauf" CURVE 0x811F0D FklWUb 10200. nmot_ub_q40 0.00 10200. FUNCTION_LIST ARMD IF_DATA DIM_X DIRECT 0x811F0D /begin AXIS_DESCR FIX_AXIS gangi dez 8 0.00 7.000 FIX_AXIS_PAR 0 0 8 /end AXIS_DESCR /end CHARACTERISTIC
/begin CHARACTERISTIC NASNOTKL "Kennlinie für Drehzahlschwelle für Abwürgeschutz" CURVE 0x81A338 KlAUbSstUbWUb 10200. nmot_ub_q40 0.00 10200. FUNCTION_LIST MDKOG IF_DATA DIM_X DIRECT 0x81A338
 /begin AXIS_DESCR STD_AXIS tmot temp_ub_q0p75_o48 4 -48.00 143.3 DEPOSIT ABSOLUT /end AXIS_DESCR
/end CHARACTERISTIC
/begin CHARACTERISTIC NC_T_UM "Fehlertoleranzzeit für Motordrehzahlüberwachung für Funktionsüberwachung" VALUE 0x814009 KwUb 10200.0 t40ms_ub_b10200 0.00 10200.0 FUNCTION_LIST UFNC IF_DATA DIM_X DIRECT 0x814009 /end CHARACTERISTIC
/begin CHARACTERISTIC NDFILOG "Schwelle für Filterausgang ndfil" CURVE 0x8167A6 FklWUw 16383.75 nmot_uw_q0p25 0.00 16383.75 FUNCTION_LIST ARMD IF_DATA DIM_X DIRECT 0x8167A6 /begin AXIS_DESCR FIX_AXIS gangi dez 8 0.00 7.000 FIX_AXIS_PAR 0 0 8 /end AXIS_DESCR /end CHARACTERISTIC
/begin CHARACTERISTIC NDIFFOG "Schwelle Drehzahldifferenz zum Auslösen Ini der AR beim Verzögern" CURVE 0x8284DE FklWSw 16383.75 nmot_sw_q0p25 -8192.000 8191.750 FUNCTION_LIST ARMD IF_DATA DIM_X DIRECT 0x8284DE /begin AXIS_DESCR FIX_AXIS gangi dez 8 0.00 7.000 FIX_AXIS_PAR 0 0 8 /end AXIS_DESCR /end CHARACTERISTIC
/begin CHARACTERISTIC NDIF_UM "erlaubte Differenz zwischen nmot und nz_um in der Funktionsüberwachung" VALUE 0x81400A KwUb 10200. nmot_ub_q40 0.00 10200. FUNCTION_LIST UFNC IF_DATA DIM_X DIRECT 0x81400A /end CHARACTERISTIC
/begin CHARACTERISTIC NDKPPU "Minimaldrehzahl für Plausibilisierung DK-Poti 2 nach unten im Normalbetrieb" VALUE 0x811109 KwUb 10000. nmot_ub_q40 200.0 10200. FUNCTION_LIST GGDVE IF_DATA DIM_X DIRECT 0x811109 /end CHARACTERISTIC
/begin CHARACTERISTIC NDKRA "Drehzahlschwelle für Diagnose Klopfregelanschlag" VALUE 0x811C37 KwUb 10200. nmot_ub_q40 0.00 10200. FUNCTION_LIST DKRA IF_DATA DIM_X DIRECT 0x811C37 /end CHARACTERISTIC
/begin CHARACTERISTIC NDKS "Drehzahlschwelle für Dia KS" VALUE 0x819CEC KwUb 10200. nmot_ub_q40 0.00 10200. FUNCTION_LIST DKRS IF_DATA DIM_X DIRECT 0x819CEC /end CHARACTERISTIC
/begin CHARACTERISTIC NDKSBET "Drehzahlschwelle für Dia KS, Bandendetest" VALUE 0x819CED KwUb 10200. nmot_ub_q40 0.00 10200. FUNCTION_LIST DKRS IF_DATA DIM_X DIRECT 0x819CED /end CHARACTERISTIC
/begin CHARACTERISTIC NDLSO "obere Drehzahlschwelle für digitale Leerlaufstabilisierung" VALUE 0x8127A6 KwUb 2550. nmot_ub_q10 0.00 2550. FUNCTION_LIST BBDLS IF_DATA DIM_X DIRECT 0x8127A6 /end CHARACTERISTIC
/begin CHARACTERISTIC NDLSU "untere Drehzahlschwelle für digitale Leerlaufstabilisierung" VALUE 0x8127A7 KwUb 2550. nmot_ub_q10 0.00 2550. FUNCTION_LIST BBDLS IF_DATA DIM_X DIRECT 0x8127A7 /end CHARACTERISTIC
/begin CHARACTERISTIC NDNWMN "Minimaldrehzahl für Diagnose Nockenwellensteuerung" VALUE 0x81A86A KwUb 10200. nmot_ub_q40 0.00 10200. FUNCTION_LIST BBDNWS IF_DATA DIM_X DIRECT 0x81A86A /end CHARACTERISTIC
/begin CHARACTERISTIC NDNWMNFA "Minimaldrehzahl für Diagnose Nockenwellensteuerung bei Testeranforderung" VALUE 0x81A86B KwUb 10200. nmot_ub_q40 0.00 10200. FUNCTION_LIST BBDNWS IF_DATA DIM_X DIRECT 0x81A86B /end CHARACTERISTIC
/begin CHARACTERISTIC NDSVLO "obere Drehzahlschwelle für Signalvergleich Ladedruck mit Umgebungsdruck" VALUE 0x818895 KwUb 10200. nmot_ub_q40 0.00 10200. FUNCTION_LIST GGDSAS IF_DATA DIM_X DIRECT 0x818895 /end CHARACTERISTIC
/begin CHARACTERISTIC NDSVLU "Drehzahlschwelle für Signalvergleich Ladedruck mit Umgebungsdruck" VALUE 0x818896 KwUb 10200. nmot_ub_q40 0.00 10200. FUNCTION_LIST GGDSAS IF_DATA DIM_X DIRECT 0x818896 /end CHARACTERISTIC
/begin CHARACTERISTIC NDTHMU "untere Drehzahlschwelle für Freigabe Thermostatdiagnose" VALUE 0x8197D2 KwUb 10200. nmot_ub_q40 0.00 10200. FUNCTION_LIST DTHM IF_DATA DIM_X DIRECT 0x8197D2 /end CHARACTERISTIC
/begin CHARACTERISTIC NDV "Fehlererkennung Tachosignal / Drehzahlschwelle minimal" VALUE 0x818709 KwUb 10200. nmot_ub_q40 0.00 10200. FUNCTION_LIST DVFZ IF_DATA DIM_X DIRECT 0x818709 /end CHARACTERISTIC
/begin CHARACTERISTIC NDVO "Fehlererkennung Fz-Geschwindigkeitssignal, obere Drehzahlgrenze" VALUE 0x81870A KwUb 10200. nmot_ub_q40 0.00 10200. FUNCTION_LIST DVFZ IF_DATA DIM_X DIRECT 0x81870A /end CHARACTERISTIC
/begin CHARACTERISTIC NEGABW "neg zeitliche Abweichung zur Fehlererkennung" VALUE 0x8187F0 KwUb 0.8000 fak_q0p1 0.00 0.8000 FUNCTION_LIST DKMTR IF_DATA DIM_X DIRECT 0x8187F0 /end CHARACTERISTIC
/begin CHARACTERISTIC NFANWS "Drehzahlschwelle für Funktionsanforderung NWS" VALUE 0x81A8C8 KwUb 10200. nmot_ub_q40 0.00 10200. FUNCTION_LIST NWSFAT IF_DATA DIM_X DIRECT 0x81A8C8 /end CHARACTERISTIC
/begin CHARACTERISTIC NFGRMIN "Min. zul. Drehzahl bei FGR-Betrieb" VALUE 0x8187F5 KwUb 10120. nmot_ub_q40 0.00 10120. FUNCTION_LIST FGRABED IF_DATA DIM_X DIRECT 0x8187F5 /end CHARACTERISTIC
/begin CHARACTERISTIC NFHZ "Solldrehzahl bei eingeschalteter Frontscheibenheizung" VALUE 0x819FA5 KwUb 2550. nmot_ub_q10 0.00 2550. FUNCTION_LIST LLRNS IF_DATA DIM_X DIRECT 0x819FA5 /end CHARACTERISTIC
/begin CHARACTERISTIC NFHZFS "Solldrehzahl bei eingeschalteter Frontscheibenheizung und B_fs=1" VALUE 0x819FA6 KwUb 2550. nmot_ub_q10 0.00 2550. FUNCTION_LIST LLRNS IF_DATA DIM_X DIRECT 0x819FA6 /end CHARACTERISTIC
/begin CHARACTERISTIC NFLAGS_D_UC "" VAL_BLK 0x812423 KwbUb 255.0 dez 0.00 255.0 NUMBER 16 FUNCTION_LIST URCEIN IF_DATA DIM_X DIRECT 0x812423 /end CHARACTERISTIC
/begin CHARACTERISTIC NFS2M "Solldrehzahl 2 Fahrstufenschalter ein" CURVE 0x819FA7 GklWUb 2550. nmot_ub_q10 0.00 2550. FUNCTION_LIST LLRNS IF_DATA DIM_X DIRECT 0x819FA7
 /begin AXIS_DESCR COM_AXIS tmot temp_ub_q0p75_o48 6 -48.00 143.3 AXIS_PTS_REF STM06LLUB /end AXIS_DESCR
/end CHARACTERISTIC
/begin CHARACTERISTIC NGALU_0_A "Misfire Detection : Schwelle Drehzahländerung für Ausblendung" CURVE 0x813D72 GklWUw 12799.77 nmotg_sw_q0p39 0.00 12799.77 FUNCTION_LIST DMDSTP IF_DATA DIM_X INDIRECT 0x8173E4
 /begin AXIS_DESCR COM_AXIS nmot nmot_ub_q40 8 0.00 10200. AXIS_PTS_REF SNM08DMUB /end AXIS_DESCR
/end CHARACTERISTIC
/begin CHARACTERISTIC NGALU_1_A "Misfire Detection : Schwelle Drehzahländerung für Ausblendung" CURVE 0x813D82 GklWUw 12799.77 nmotg_sw_q0p39 0.00 12799.77 FUNCTION_LIST DMDSTP IF_DATA DIM_X INDIRECT 0x8173E6
 /begin AXIS_DESCR COM_AXIS nmot nmot_ub_q40 8 0.00 10200. AXIS_PTS_REF SNM08DMUB /end AXIS_DESCR
/end CHARACTERISTIC
/begin CHARACTERISTIC NGALUST_0_A "Misfire Detection : Schwelle Drehzahländerung für Ausblendung nach Start" VALUE 0x813DA6 KwUw 12799.77 nmotg_sw_q0p39 0.00 12799.77 FUNCTION_LIST DMDSTP IF_DATA DIM_X DIRECT 0x813DA6 /end CHARACTERISTIC
/begin CHARACTERISTIC NGALUST_1_A "Misfire Detection : Schwelle Drehzahländerung für Ausblendung nach Start" VALUE 0x813DA8 KwUw 12799.77 nmotg_sw_q0p39 0.00 12799.77 FUNCTION_LIST DMDSTP IF_DATA DIM_X DIRECT 0x813DA8 /end CHARACTERISTIC
/begin CHARACTERISTIC NGDNWEGTR "Drehzahlgradient beim Absteuern der Wiedereinsetzdrehzal Kuppl. offen" VALUE 0x8165CC KwSw 10239.84 nmotg_sw_q0p15625 -5120.000 5119.844 FUNCTION_LIST BBSAWE IF_DATA DIM_X DIRECT 0x8165CC /end CHARACTERISTIC
/begin CHARACTERISTIC NGFSAWE "Schwelle Drehzahlgradient für Sperrung Filter SA/WE" VALUE 0x816FFA KwSw 25599.94 nmotg_sw_q0p39 -12800.16 12799.77 FUNCTION_LIST MDFAW IF_DATA DIM_X DIRECT 0x816FFA /end CHARACTERISTIC
/begin CHARACTERISTIC NGKRAWN "Schwellwert Drehzahlgradient für Dynamikerkennung KRRA" CURVE 0x81FA2C GklWSw 12799.77 nmotg_sw_q0p39 0.00 12799.77 FUNCTION_LIST KRDY IF_DATA DIM_X DIRECT 0x81FA2C
 /begin AXIS_DESCR COM_AXIS nmot nmot_ub_q40 16 0.00 10200. AXIS_PTS_REF SNM16KRUB /end AXIS_DESCR
/end CHARACTERISTIC
/begin CHARACTERISTIC NGKRSTMX "maximaler Drehzahlgradient im KR stationär Betrieb" VALUE 0x81610C KwSw 12799.77 nmotg_sw_q0p39 0.00 12799.77 FUNCTION_LIST KRRA IF_DATA DIM_X DIRECT 0x81610C /end CHARACTERISTIC
/begin CHARACTERISTIC NGKRWN "Schwellwert Drehzahlgradient für Dynamikerkennung" CURVE 0x81FA4C GklWSw 12799.77 nmotg_sw_q0p39 0.00 12799.77 FUNCTION_LIST KRDY IF_DATA DIM_X DIRECT 0x81FA4C
 /begin AXIS_DESCR COM_AXIS nmot nmot_ub_q40 16 0.00 10200. AXIS_PTS_REF SNM16KRUB /end AXIS_DESCR
/end CHARACTERISTIC
/begin CHARACTERISTIC NKRAMAX "Drehzahl oberhalb der KR-Adaption gefreezt wird" VALUE 0x819B7B KwUb 10200. nmot_ub_q40 0.00 10200. FUNCTION_LIST KRRA IF_DATA DIM_X DIRECT 0x819B7B /end CHARACTERISTIC
/begin CHARACTERISTIC NKRAMIN "Drehzahl unterhalb der KR-Adaption gefreezt wird" VALUE 0x819B7C KwUb 10200. nmot_ub_q40 0.00 10200. FUNCTION_LIST KRRA IF_DATA DIM_X DIRECT 0x819B7C /end CHARACTERISTIC
/begin CHARACTERISTIC NKRF "Drehzahlschwelle für Klopfregelfreigabe" VALUE 0x819B7D KwUb 10200. nmot_ub_q40 0.00 10200. FUNCTION_LIST KRRA IF_DATA DIM_X DIRECT 0x819B7D /end CHARACTERISTIC
/begin CHARACTERISTIC NKRFM1 "Drehzahlschwelle für Filtermittenfrequenz Bereich1" VALUE 0x8198EC KwUb 10200. nmot_ub_q40 0.00 10200. FUNCTION_LIST GGKS IF_DATA DIM_X DIRECT 0x8198EC /end CHARACTERISTIC
/begin CHARACTERISTIC NKRFM2 "Drehzahlschwelle für Filtermittenfrequenz Bereich 2" VALUE 0x8198ED KwUb 10200. nmot_ub_q40 0.00 10200. FUNCTION_LIST GGKS IF_DATA DIM_X DIRECT 0x8198ED /end CHARACTERISTIC
/begin CHARACTERISTIC NKRFM3 "Drehzahlschwelle für Filtermittenfrequenz Bereich 3" VALUE 0x8198EE KwUb 10200. nmot_ub_q40 0.00 10200. FUNCTION_LIST GGKS IF_DATA DIM_X DIRECT 0x8198EE /end CHARACTERISTIC
/begin CHARACTERISTIC NKRMAX "Drehzahl oberhalb der KR gefreezt wird" VALUE 0x819B7E KwUb 10200. nmot_ub_q40 0.00 10200. FUNCTION_LIST KRRA IF_DATA DIM_X DIRECT 0x819B7E /end CHARACTERISTIC
/begin CHARACTERISTIC NKTDOT "Obere Drehzahlgrenze Katdiagnose bei Testerbetrieb" VALUE 0x8186E5 KwUb 10200. nmot_ub_q40 0.00 10200. FUNCTION_LIST DKATSPEB IF_DATA DIM_X DIRECT 0x8186E5 /end CHARACTERISTIC
/begin CHARACTERISTIC NKTDUT "Untere Drehzahlgrenze Katdiagnose bei Testerbetrieb" VALUE 0x8186E6 KwUb 10200. nmot_ub_q40 0.00 10200. FUNCTION_LIST DKATSPEB IF_DATA DIM_X DIRECT 0x8186E6 /end CHARACTERISTIC
/begin CHARACTERISTIC NLDIAPU "Drehzahlschwelle für Adaption I-Begrenzung" CURVE 0x827964 KlAUbSstUbWUb 10200. nmot_ub_q40 0.00 10200. FUNCTION_LIST LDRPID IF_DATA DIM_X DIRECT 0x827964 /begin AXIS_DESCR STD_AXIS pu p_ub_q5 2 0.00 1275. DEPOSIT ABSOLUT /end AXIS_DESCR /end CHARACTERISTIC
/begin CHARACTERISTIC NLL2M "Solldrehzahl 2" CURVE 0x819FB6 GklWUb 2550. nmot_ub_q10 0.00 2550. FUNCTION_LIST LLRNS IF_DATA DIM_X DIRECT 0x819FB6
 /begin AXIS_DESCR COM_AXIS tmot temp_ub_q0p75_o48 6 -48.00 143.3 AXIS_PTS_REF STM06LLUB /end AXIS_DESCR
/end CHARACTERISTIC
/begin CHARACTERISTIC NLLAD "Leerlaufsolldrehzahl bei Aktivdiagnose-Sekundärluft" VALUE 0x81983E KwUb 2550. nmot_ub_q10 0.00 2550. FUNCTION_LIST BBKHZ IF_DATA DIM_X DIRECT 0x81983E /end CHARACTERISTIC
/begin CHARACTERISTIC NLLCVTMXV "Begrenzung der Drehzahlvorgabe (CVT-Getriebe)" CURVE 0x819FBC KlAUbSstUbWUb 2550. nmot_ub_q10 0.00 2550. FUNCTION_LIST LLRNS IF_DATA DIM_X DIRECT 0x819FBC /begin AXIS_DESCR STD_AXIS vfzg vfzg_ub_q1p25 8 0.00 318.8 DEPOSIT ABSOLUT /end AXIS_DESCR /end CHARACTERISTIC
/begin CHARACTERISTIC NLLMG "Solldrehzahl" MAP 0x819FCD GkfWUb 2550. nmot_ub_q10 0.00 2550. FUNCTION_LIST LLRNS IF_DATA DIM_X DIRECT 0x819FCD
 /begin AXIS_DESCR COM_AXIS tmot temp_ub_q0p75_o48 6 -48.00 143.3 AXIS_PTS_REF STM06LLUB /end AXIS_DESCR
 /begin AXIS_DESCR COM_AXIS gangllr dez 8 0.00 255.0 AXIS_PTS_REF SGA08LLUB /end AXIS_DESCR
/end CHARACTERISTIC
/begin CHARACTERISTIC NLLMGFS "Solldrehzahl bei eingel. Fahrstufe für Automatikfahrzeuge" MAP 0x819FFD GkfWUb 2550. nmot_ub_q10 0.00 2550. FUNCTION_LIST LLRNS IF_DATA DIM_X DIRECT 0x819FFD
 /begin AXIS_DESCR COM_AXIS tmot temp_ub_q0p75_o48 6 -48.00 143.3 AXIS_PTS_REF STM06LLUB /end AXIS_DESCR
 /begin AXIS_DESCR COM_AXIS gangllr dez 8 0.00 255.0 AXIS_PTS_REF SGA08LLUB /end AXIS_DESCR
/end CHARACTERISTIC
/begin CHARACTERISTIC NLPST1T "Wartezeit 1 im NLP-Lernen" VALUE 0x81114A KwUb 2.540 t10msxs_ub_b2p55 0.01000 2.550 FUNCTION_LIST BGDVE IF_DATA DIM_X DIRECT 0x81114A /end CHARACTERISTIC
/begin CHARACTERISTIC NLPST2T "Wartezeit 2 im NLP-Lernen" VALUE 0x81114B KwUb 2.540 t10msxs_ub_b2p55 0.01000 2.550 FUNCTION_LIST BGDVE IF_DATA DIM_X DIRECT 0x81114B /end CHARACTERISTIC
/begin CHARACTERISTIC NLRHO "obere Drehzahlgrenze für Regelung hinter Kat" VALUE 0x812726 KwUb 10200. nmot_ub_q40 0.00 10200. FUNCTION_LIST LRSHK IF_DATA DIM_X DIRECT 0x812726 /end CHARACTERISTIC
/begin CHARACTERISTIC NLRHU "untere Drehzahlgrenze für Regelung hinter Kat" VALUE 0x812727 KwUb 10200. nmot_ub_q40 0.00 10200. FUNCTION_LIST LRSHK IF_DATA DIM_X DIRECT 0x812727 /end CHARACTERISTIC
/begin CHARACTERISTIC NLRKA "Drehzahlschwelle für Unterdrücken gesteuertes Kat-Ausräumen" VALUE 0x81274F KwUb 10200. nmot_ub_q40 0.00 10200. FUNCTION_LIST LRSKA IF_DATA DIM_X DIRECT 0x81274F /end CHARACTERISTIC
/begin CHARACTERISTIC NLRSHB "Drehzahlschwelle, Abschalten LR bei Schub, in Verbindung mit LL und TLLRSHB" VALUE 0x8126F1 KwUb 10200. nmot_ub_q40 0.00 10200. FUNCTION_LIST LRSEB IF_DATA DIM_X DIRECT 0x8126F1 /end CHARACTERISTIC
/begin CHARACTERISTIC NLS_AOG "oberer Grenzwert Anpassung LL-Solldrehzahl" VALUE 0x811C62 KwSb 2550. nmot_q10 -1280. 1270. FUNCTION_LIST TKMWL KRACT IF_DATA DIM_X DIRECT 0x811C62 /end CHARACTERISTIC
/begin CHARACTERISTIC NLS_AUG "unterer Grenzwert Anpassung LL-Solldrehzahl" VALUE 0x811C63 KwSb 2550. nmot_q10 -1280. 1270. FUNCTION_LIST TKMWL KRACT IF_DATA DIM_X DIRECT 0x811C63 /end CHARACTERISTIC
/begin CHARACTERISTIC NM1MN1 "untere Grenze Ausblendbereich 1 für Solldrehzahl Lüfter 1" VALUE 0x81AEC6 KwUb 5100. nmot_ub_q20 0.00 5100. FUNCTION_LIST KMTR IF_DATA DIM_X DIRECT 0x81AEC6 /end CHARACTERISTIC
/begin CHARACTERISTIC NM1MN2 "untere Grenze Ausblendbereich 2 für Solldrehzahl Lüfter 1" VALUE 0x81AEC7 KwUb 5100. nmot_ub_q20 0.00 5100. FUNCTION_LIST KMTR IF_DATA DIM_X DIRECT 0x81AEC7 /end CHARACTERISTIC
/begin CHARACTERISTIC NM1MN3 "untere Grenze Ausblendbereich 3 für Solldrehzahl Lüfter 1" VALUE 0x81AEC8 KwUb 5100. nmot_ub_q20 0.00 5100. FUNCTION_LIST KMTR IF_DATA DIM_X DIRECT 0x81AEC8 /end CHARACTERISTIC
/begin CHARACTERISTIC NM1MX1 "obere Grenze Ausblendbereich 1 für Solldrehzahl Lüfter 1" VALUE 0x81AEC9 KwUb 5100. nmot_ub_q20 0.00 5100. FUNCTION_LIST KMTR IF_DATA DIM_X DIRECT 0x81AEC9 /end CHARACTERISTIC
/begin CHARACTERISTIC NM1MX2 "obere Grenze Ausblendbereich 2 für Solldrehzahl Lüfter 1" VALUE 0x81AECA KwUb 5100. nmot_ub_q20 0.00 5100. FUNCTION_LIST KMTR IF_DATA DIM_X DIRECT 0x81AECA /end CHARACTERISTIC
/begin CHARACTERISTIC NM1MX3 "obere Grenze Ausblendbereich 3 für Solldrehzahl Lüfter 1" VALUE 0x81AECB KwUb 5100. nmot_ub_q20 0.00 5100. FUNCTION_LIST KMTR IF_DATA DIM_X DIRECT 0x81AECB /end CHARACTERISTIC
/begin CHARACTERISTIC NM1VMN "Kennlinie minimale Lüfterdrehzahl 1 abhängig von Fahrzeuggeschwindigkeit" CURVE 0x81AECC KlAUbSstUbWUb 5100. nmot_ub_q20 0.00 5100. FUNCTION_LIST KMTR IF_DATA DIM_X DIRECT 0x81AECC
 /begin AXIS_DESCR STD_AXIS vfzgkmtr vfzg_ub_q1p25 6 0.00 318.8 DEPOSIT ABSOLUT /end AXIS_DESCR
/end CHARACTERISTIC
/begin CHARACTERISTIC NM1VN "Untere kleinste Lüfterdrehzahlschwelle geschwindigkeitsabhängig" CURVE 0x81AED9 KlAUbSstUbWUb 5100. nmot_ub_q20 0.00 5100. FUNCTION_LIST KMTR IF_DATA DIM_X DIRECT 0x81AED9
 /begin AXIS_DESCR STD_AXIS vfzgkmtr vfzg_ub_q1p25 6 0.00 318.8 DEPOSIT ABSOLUT /end AXIS_DESCR
/end CHARACTERISTIC
/begin CHARACTERISTIC NM1VP "Obere kleinste  Lüfterdrehzahlschwelle geschwindigkeitsabhängig" CURVE 0x81AEE6 KlAUbSstUbWUb 5100. nmot_ub_q20 0.00 5100. FUNCTION_LIST KMTR IF_DATA DIM_X DIRECT 0x81AEE6
 /begin AXIS_DESCR STD_AXIS vfzgkmtr vfzg_ub_q1p25 6 0.00 318.8 DEPOSIT ABSOLUT /end AXIS_DESCR
/end CHARACTERISTIC
/begin CHARACTERISTIC NM2MN1 "untere Grenze Ausblendbereich 1 für Solldrehzahl Lüfter 2" VALUE 0x81AEF3 KwUb 5100. nmot_ub_q20 0.00 5100. FUNCTION_LIST KMTR IF_DATA DIM_X DIRECT 0x81AEF3 /end CHARACTERISTIC
/begin CHARACTERISTIC NM2MN2 "untere Grenze Ausblendbereich 2 für Solldrehzahl Lüfter 2" VALUE 0x81AEF4 KwUb 5100. nmot_ub_q20 0.00 5100. FUNCTION_LIST KMTR IF_DATA DIM_X DIRECT 0x81AEF4 /end CHARACTERISTIC
/begin CHARACTERISTIC NM2MN3 "untere Grenze Ausblendbereich 3 für Solldrehzahl Lüfter 2" VALUE 0x81AEF5 KwUb 5100. nmot_ub_q20 0.00 5100. FUNCTION_LIST KMTR IF_DATA DIM_X DIRECT 0x81AEF5 /end CHARACTERISTIC
/begin CHARACTERISTIC NM2MX1 "obere Grenze Ausblendbereich 1 für Solldrehzahl Lüfter 2" VALUE 0x81AEF6 KwUb 5100. nmot_ub_q20 0.00 5100. FUNCTION_LIST KMTR IF_DATA DIM_X DIRECT 0x81AEF6 /end CHARACTERISTIC
/begin CHARACTERISTIC NM2MX2 "obere Grenze Ausblendbereich 2 für Solldrehzahl Lüfter 2" VALUE 0x81AEF7 KwUb 5100. nmot_ub_q20 0.00 5100. FUNCTION_LIST KMTR IF_DATA DIM_X DIRECT 0x81AEF7 /end CHARACTERISTIC
/begin CHARACTERISTIC NM2MX3 "obere Grenze Ausblendbereich 3 für Solldrehzahl Lüfter 2" VALUE 0x81AEF8 KwUb 5100. nmot_ub_q20 0.00 5100. FUNCTION_LIST KMTR IF_DATA DIM_X DIRECT 0x81AEF8 /end CHARACTERISTIC
/begin CHARACTERISTIC NM2VMN "Kennlinie minimale Lüfterdrehzahl 2 abhängig von Fahrzeuggeschwindigkeit" CURVE 0x81AEF9 KlAUbSstUbWUb 5100. nmot_ub_q20 0.00 5100. FUNCTION_LIST KMTR IF_DATA DIM_X DIRECT 0x81AEF9
 /begin AXIS_DESCR STD_AXIS vfzgkmtr vfzg_ub_q1p25 6 0.00 318.8 DEPOSIT ABSOLUT /end AXIS_DESCR
/end CHARACTERISTIC
/begin CHARACTERISTIC NM2VN "Untere kleinste Lüfterdrehzahlschwelle geschwindigkeitsabhängig" CURVE 0x81AF06 KlAUbSstUbWUb 5100. nmot_ub_q20 0.00 5100. FUNCTION_LIST KMTR IF_DATA DIM_X DIRECT 0x81AF06
 /begin AXIS_DESCR STD_AXIS vfzgkmtr vfzg_ub_q1p25 6 0.00 318.8 DEPOSIT ABSOLUT /end AXIS_DESCR
/end CHARACTERISTIC
/begin CHARACTERISTIC NM2VP "Obere kleinste  Lüfterdrehzahlschwelle geschwindigkeitsabhängig" CURVE 0x81AF13 KlAUbSstUbWUb 5100. nmot_ub_q20 0.00 5100. FUNCTION_LIST KMTR IF_DATA DIM_X DIRECT 0x81AF13
 /begin AXIS_DESCR STD_AXIS vfzgkmtr vfzg_ub_q1p25 6 0.00 318.8 DEPOSIT ABSOLUT /end AXIS_DESCR
/end CHARACTERISTIC
/begin CHARACTERISTIC NMAX "Drehzahlbegrenzung" VALUE 0x8172FC KwUw 16383.75 nmot_uw_q0p25 0.00 16383.75 FUNCTION_LIST NMAXMD DFFTCNV IF_DATA DIM_X DIRECT 0x8172FC /end CHARACTERISTIC
/begin CHARACTERISTIC NMAXDV "Drehzahlbegrenzung bei Fehlererkennung Geschwindigkeitssignal" VALUE 0x8172FE KwUw 10200.00 nmot_uw_q0p25 0.00 10200.00 FUNCTION_LIST NMAXMD IF_DATA DIM_X DIRECT 0x8172FE /end CHARACTERISTIC
/begin CHARACTERISTIC NMAXDVG "Drehzahlgrenze für Automatik-Getriebe bei Fehler Geschwindigkeitssignal" CURVE 0x8294EC GklWUw 16383.75 nmot_uw_q0p25 0.00 16383.75 FUNCTION_LIST NMAXMD IF_DATA DIM_X DIRECT 0x8294EC /begin AXIS_DESCR COM_AXIS gangi dez 8 0.00 255.0 AXIS_PTS_REF SGA08MDUB /end AXIS_DESCR /end CHARACTERISTIC
/begin CHARACTERISTIC NMAXDZ "Drehzahlgrenze bei doppelter Zündausgabe" VALUE 0x817300 KwUw 16383.75 nmot_uw_q0p25 0.00 16383.75 FUNCTION_LIST NMAXMD IF_DATA DIM_X DIRECT 0x817300 /end CHARACTERISTIC
/begin CHARACTERISTIC NMAXGA "Maximal zulässige Motordrehzahl (stationär)" CURVE 0x8294FC GklWUw 16383.75 nmot_uw_q0p25 0.00 16383.75 FUNCTION_LIST NMAXMD IF_DATA DIM_X DIRECT 0x8294FC /begin AXIS_DESCR COM_AXIS gangi dez 8 0.00 255.0 AXIS_PTS_REF SGA08MDUB /end AXIS_DESCR /end CHARACTERISTIC
/begin CHARACTERISTIC NMAXKBI "Drehzahl bei maximalem Moment für Ausgabe an Kombi" VALUE 0x810186 KwUb 25500. nmotg_ub_q100 0.00 25500. FUNCTION_LIST CAN IF_DATA DIM_X DIRECT 0x810186 /end CHARACTERISTIC
/begin CHARACTERISTIC NMAXOG "erhöhte Drehzahlgrenze" VALUE 0x817304 KwUw 16383.75 nmot_uw_q0p25 0.00 16383.75 FUNCTION_LIST NMAXMD SWADP IF_DATA DIM_X DIRECT 0x817304 /end CHARACTERISTIC
/begin CHARACTERISTIC NMIALU "Min. Drehzahl für Ausblendung der Aussetzererkennung" VALUE 0x810727 KwUb 10200. nmot_ub_q40 0.00 10200. FUNCTION_LIST DMDSTP IF_DATA DIM_X DIRECT 0x810727 /end CHARACTERISTIC
/begin CHARACTERISTIC NMIN_UM "minimale Drehzahl für Motordrehzahlüberwachung der Funktionsüberwachung" VALUE 0x81400B KwUb 9680. nmot_ub_q40 520.0 10200. FUNCTION_LIST UFNC IF_DATA DIM_X DIRECT 0x81400B /end CHARACTERISTIC
/begin CHARACTERISTIC NMNWSTMN "Minimale Drehzahl für Freigabe der Nockenwellenverstellung im Start" VALUE 0x81A822 KwUb 10200. nmot_ub_q40 0.00 10200. FUNCTION_LIST BBNWS IF_DATA DIM_X DIRECT 0x81A822 /end CHARACTERISTIC
/begin CHARACTERISTIC NMNZUESA "untere nmot-Schwelle für Ausgabe TSMNSA" VALUE 0x81ABE0 KwUb 10200. nmot_ub_q40 0.00 10200. FUNCTION_LIST ZUESZ IF_DATA DIM_X DIRECT 0x81ABE0 /end CHARACTERISTIC
/begin CHARACTERISTIC NMN_DUF "Drehzahl-Schwelle fürs Setzen der Zyklusflags der Funktionsüberwachungs-Diagnose" VALUE 0x812681 KwUb 10200. nmot_ub_q40 0.00 10200. FUNCTION_LIST DUF IF_DATA DIM_X DIRECT 0x812681 /end CHARACTERISTIC
/begin CHARACTERISTIC NMOTDELAY "Wartezeit bis Motorstillstand erkannt" VALUE 0x812DF4 KwUb 2.550 t10msxs_ub_b2p55 0.00 2.550 FUNCTION_LIST GGCS IF_DATA DIM_X DIRECT 0x812DF4 /end CHARACTERISTIC
/begin CHARACTERISTIC NMOTDYFA "untere Drehzahlschwelle für Dynamikprüfung LSU bei Kurztest" VALUE 0x8186F2 KwUb 10200. nmot_ub_q40 0.00 10200. FUNCTION_LIST DLSU IF_DATA DIM_X DIRECT 0x8186F2 /end CHARACTERISTIC
/begin CHARACTERISTIC NMOTDYNO "obere Drehzahlschwelle für Dynamikprüfung LSU" VALUE 0x8186F3 KwUb 10200. nmot_ub_q40 0.00 10200. FUNCTION_LIST DLSU IF_DATA DIM_X DIRECT 0x8186F3 /end CHARACTERISTIC
/begin CHARACTERISTIC NMOTDYNU "untere Drehzahlschwelle für Dynamikprüfung LSU" VALUE 0x8186F4 KwUb 10200. nmot_ub_q40 0.00 10200. FUNCTION_LIST DLSU IF_DATA DIM_X DIRECT 0x8186F4 /end CHARACTERISTIC
/begin CHARACTERISTIC NMOTRDE "Drehzahlschwelle zur Freigabe der Funktion RDE" VALUE 0x810FAC KwUb 2550. nmot_ub_q10 0.00 2550. FUNCTION_LIST RDE IF_DATA DIM_X DIRECT 0x810FAC /end CHARACTERISTIC
/begin CHARACTERISTIC NMOT_DAT_UC "" VAL_BLK 0x812433 KwbUb 10200. nmot_ub_q40 0.00 10200. NUMBER 16 FUNCTION_LIST URCEIN IF_DATA DIM_X DIRECT 0x812433 /end CHARACTERISTIC
/begin CHARACTERISTIC NMXALU "Max. Drehzahl für Ausblendung der Aussetzererkennung" VALUE 0x810728 KwUb 10200. nmot_ub_q40 0.00 10200. FUNCTION_LIST DMDSTP IF_DATA DIM_X DIRECT 0x810728 /end CHARACTERISTIC
/begin CHARACTERISTIC NMXDAEF "Maximaldrehzahl bei Drosselklappen-Antrieb-Ersatzbetrieb" CURVE 0x81214E KlAUbSstUbWUb 10200. nmot_ub_q40 0.00 10200. FUNCTION_LIST NMAXMD IF_DATA DIM_X DIRECT 0x81214E /begin AXIS_DESCR STD_AXIS wped relPED_ub_b100 6 0.00 100.0 DEPOSIT ABSOLUT /end AXIS_DESCR /end CHARACTERISTIC
/begin CHARACTERISTIC NMXDKPU "Maximaldrehzahl bei Sicherheitskraftstoffabschaltung (SKA)" VALUE 0x817306 KwUw 16383.75 nmot_uw_q0p25 0.00 16383.75 FUNCTION_LIST NMAXMD IF_DATA DIM_X DIRECT 0x817306 /end CHARACTERISTIC
/begin CHARACTERISTIC NMXPNL "Verstärkung Proportionalanteil der NMAX-Regelung bei stromloser Drosselklappe" VALUE 0x81A39D KwUb 0.9961 relnmot_q0p0039 0.00 0.9961 FUNCTION_LIST NMAXMD IF_DATA DIM_X DIRECT 0x81A39D /end CHARACTERISTIC
/begin CHARACTERISTIC NMXPRLG "Verstärkung Proportionalanteil der NMAX-Regelung im Normalbetrieb" MAP 0x81A39E GkfWUb 0.9961 relnmot_q0p0039 0.00 0.9961 FUNCTION_LIST NMAXMD IF_DATA DIM_X DIRECT 0x81A39E
 /begin AXIS_DESCR COM_AXIS rl rel_ub_q0p75 8 0.00 191.3 AXIS_PTS_REF SRL08NXUB /end AXIS_DESCR
 /begin AXIS_DESCR COM_AXIS gangi dez 8 0.00 255.0 AXIS_PTS_REF SGA08MDUB /end AXIS_DESCR
/end CHARACTERISTIC
/begin CHARACTERISTIC NMXSKA "Maximaldrehzahl bei unbekannter Drosselklappenposition -> Ev-Abschaltung" VALUE 0x811BC9 KwUb 10200. nmot_ub_q40 0.00 10200. FUNCTION_LIST AEVABU IF_DATA DIM_X DIRECT 0x811BC9 /end CHARACTERISTIC
/begin CHARACTERISTIC NMXZUESA "obere nmot-Schwelle für Ausgabe TSMNSA" VALUE 0x81ABE1 KwUb 10200. nmot_ub_q40 0.00 10200. FUNCTION_LIST ZUESZ IF_DATA DIM_X DIRECT 0x81ABE1 /end CHARACTERISTIC
/begin CHARACTERISTIC NNSTA "Drehzahlübergang Normal -> Start" CURVE 0x81A533 KlAUbSstUbWUb 10200. nmot_ub_q40 0.00 10200. FUNCTION_LIST BBSTT IF_DATA DIM_X DIRECT 0x81A533
 /begin AXIS_DESCR STD_AXIS tans temp_ub_q0p75_o48 3 -48.00 143.3 DEPOSIT ABSOLUT /end AXIS_DESCR
/end CHARACTERISTIC
/begin CHARACTERISTIC NNWMX "maximale Drehzahlschwelle für Abschaltung der NW-Verstellung" VALUE 0x81A823 KwUb 10200. nmot_ub_q40 0.00 10200. FUNCTION_LIST BBNWS IF_DATA DIM_X DIRECT 0x81A823 /end CHARACTERISTIC
/begin CHARACTERISTIC NNWTMN "Minimaldrehzahlschwelle für Freigabe der Nockenwellenverstellung" CURVE 0x829E2C KlAUbSstUwWUb 10200. nmot_ub_q40 0.00 10200. FUNCTION_LIST BBNWS IF_DATA DIM_X DIRECT 0x829E2C
 /begin AXIS_DESCR STD_AXIS toelk_w temp_q0p0234_o273 4 -273.1500 1262.827 DEPOSIT ABSOLUT /end AXIS_DESCR
/end CHARACTERISTIC
/begin CHARACTERISTIC NO1 "obere Drehzahlschwelle Bereich 1" VALUE 0x819058 KwUb 10200. nmot_ub_q40 0.00 10200. FUNCTION_LIST LRA IF_DATA DIM_X DIRECT 0x819058 /end CHARACTERISTIC
/begin CHARACTERISTIC NO2 "obere Drehzahlschwelle Bereich 2" VALUE 0x819059 KwUb 10200. nmot_ub_q40 0.00 10200. FUNCTION_LIST LRA IF_DATA DIM_X DIRECT 0x819059 /end CHARACTERISTIC
/begin CHARACTERISTIC NOASR "Wert für inaktiver ASR-Botschaft" VALUE 0x81019F KwUb 99.61 rel_ub_b99p6 0.00 99.61 FUNCTION_LIST GGCASR CAN IF_DATA DIM_X DIRECT 0x81019F /end CHARACTERISTIC
/begin CHARACTERISTIC NOASR_UC "" VALUE 0x8124E8 KwUb 99.61 rel_ub_q0p3906 0.00 99.61 FUNCTION_LIST URCMSRC IF_DATA DIM_X DIRECT 0x8124E8 /end CHARACTERISTIC
/begin CHARACTERISTIC NOASR_UM "Inaktivmaske für ASR" VALUE 0x814078 KwUb 99.61 rel_ub_q0p3906 0.00 99.61 FUNCTION_LIST UFMSRC IF_DATA DIM_X DIRECT 0x814078 /end CHARACTERISTIC
/begin CHARACTERISTIC NOBMINC "Wert der bei nicht erkannter Bezugsmarke aufaddiert wird" VALUE 0x81848A KwUb 255.0 dez 0.00 255.0 FUNCTION_LIST DDG IF_DATA DIM_X DIRECT 0x81848A /end CHARACTERISTIC
/begin CHARACTERISTIC NOBMINIT "Initialisierungswert für Zähler Bezugsmarkenverlust" VALUE 0x81848B KwUb 255.0 dez 0.00 255.0 FUNCTION_LIST DDG IF_DATA DIM_X DIRECT 0x81848B /end CHARACTERISTIC
/begin CHARACTERISTIC NOBMSTMX "Maximalwert für nicht erkannte Bezugsmarken im Start" VALUE 0x81848C KwUb 255.0 dez 0.00 255.0 FUNCTION_LIST DDG IF_DATA DIM_X DIRECT 0x81848C /end CHARACTERISTIC
/begin CHARACTERISTIC NOLRA "Codewort für Adaptionsfreigabe" VALUE 0x81905A KwUb 255.0 dez 0.00 255.0 FUNCTION_LIST LRA IF_DATA DIM_X DIRECT 0x81905A /end CHARACTERISTIC
/begin CHARACTERISTIC NOREA_UC "" VALUE 0x81267B KwUb 255.0 dez 0.00 255.0 FUNCTION_LIST URCREAC IF_DATA DIM_X DIRECT 0x81267B /end CHARACTERISTIC
/begin CHARACTERISTIC NOREA_UM "Kennung zur Anforderung kein Motorbetrieb möglich aus %UFREAC der Funktionsüberw" VALUE 0x81420B KwUb 255.0 dez 0.00 255.0 FUNCTION_LIST UFREAC URDELAY IF_DATA DIM_X DIRECT 0x81420B /end CHARACTERISTIC
/begin CHARACTERISTIC NPHERKMN "minimale Motordrehzahl für Phasensuche" VALUE 0x810FB8 KwUb 10200. nmot_ub_q40 0.00 10200. FUNCTION_LIST NLPH IF_DATA DIM_X DIRECT 0x810FB8 /end CHARACTERISTIC
/begin CHARACTERISTIC NPHERKMX "maximale Motordrehzahl für Phasensuche" VALUE 0x810FB9 KwUb 10200. nmot_ub_q40 0.00 10200. FUNCTION_LIST NLPH IF_DATA DIM_X DIRECT 0x810FB9 /end CHARACTERISTIC
/begin CHARACTERISTIC NPHINVMN "minimale Motordrehzahl für Initialisierung" VALUE 0x810FBA KwUb 10200. nmot_ub_q40 0.00 10200. FUNCTION_LIST NLPH IF_DATA DIM_X DIRECT 0x810FBA /end CHARACTERISTIC
/begin CHARACTERISTIC NPHINVMX "maximale Motordrehzahl für Initialisierung" VALUE 0x810FBB KwUb 10200. nmot_ub_q40 0.00 10200. FUNCTION_LIST NLPH IF_DATA DIM_X DIRECT 0x810FBB /end CHARACTERISTIC
/begin CHARACTERISTIC NRKAB "Mindestdrehzahl für Begrenzung Stelleingriff rkat bei niedrigen Drehzahlen" VALUE 0x811611 KwUb 10200. nmot_ub_q40 0.00 10200. FUNCTION_LIST LRA IF_DATA DIM_X DIRECT 0x811611 /end CHARACTERISTIC
/begin CHARACTERISTIC NRLIP_UM "Motordrehzahl-Schwelle für den rl/rlip-Vergleich in der Funktionsüberwachg" VALUE 0x814068 KwUb 10200. nmot_ub_q40 0.00 10200. FUNCTION_LIST UFRLC IF_DATA DIM_X DIRECT 0x814068 /end CHARACTERISTIC
/begin CHARACTERISTIC NRUBMX "Maximale Drehzahl für Batteriespannungsregelung" VALUE 0x818705 KwUb 2550. nmot_ub_q10 0.00 2550. FUNCTION_LIST BGLBZ IF_DATA DIM_X DIRECT 0x818705 /end CHARACTERISTIC
/begin CHARACTERISTIC NSLBZLL "Solldrehzahl bei entladener Batterie" VALUE 0x81A035 KwUb 2550. nmot_ub_q10 0.00 2550. FUNCTION_LIST LLRNS IF_DATA DIM_X DIRECT 0x81A035 /end CHARACTERISTIC
/begin CHARACTERISTIC NSLBZS "Drehzahlschwelle zur Umschaltung der Solldrehzahl durch lbz" VALUE 0x81A036 KwUb 10200. nmot_ub_q40 0.00 10200. FUNCTION_LIST LLRNS IF_DATA DIM_X DIRECT 0x81A036 /end CHARACTERISTIC
/begin CHARACTERISTIC NSLFAA "Leerlaufdrehzahl bei Bandendetest (bei allgemeiner Anforderung)" VALUE 0x81A22E KwUb 2550. nmot_ub_q10 0.00 2550. FUNCTION_LIST LLRNFA IF_DATA DIM_X DIRECT 0x81A22E /end CHARACTERISTIC
/begin CHARACTERISTIC NSLFAEZLA "Solldrehzahl bei Kurztrip Einzelzylinder-Lambda-Regelung" VALUE 0x81A22F KwUb 2550. nmot_ub_q10 0.00 2550. FUNCTION_LIST LLRNFA IF_DATA DIM_X DIRECT 0x81A22F /end CHARACTERISTIC
/begin CHARACTERISTIC NSLFAKAT "Solldrehzahl bei Kurztrip Katdiagnose" VALUE 0x81A230 KwUb 2550. nmot_ub_q10 0.00 2550. FUNCTION_LIST LLRNFA IF_DATA DIM_X DIRECT 0x81A230 /end CHARACTERISTIC
/begin CHARACTERISTIC NSLFAKRS "Solldrehzahl bei Kurztrip Klopfsensor" VALUE 0x81A231 KwUb 2550. nmot_ub_q10 0.00 2550. FUNCTION_LIST LLRNFA IF_DATA DIM_X DIRECT 0x81A231 /end CHARACTERISTIC
/begin CHARACTERISTIC NSLFALDP "Solldrehzahl bei Kurztrip Tankleckdiagnose" VALUE 0x81A232 KwUb 2550. nmot_ub_q10 0.00 2550. FUNCTION_LIST LLRNFA IF_DATA DIM_X DIRECT 0x81A232 /end CHARACTERISTIC
/begin CHARACTERISTIC NSLFALSV "Solldrehzahl bei Kurztrip Lambdasonde vor Kat" VALUE 0x81A233 KwUb 2550. nmot_ub_q10 0.00 2550. FUNCTION_LIST LLRNFA IF_DATA DIM_X DIRECT 0x81A233 /end CHARACTERISTIC
/begin CHARACTERISTIC NSLFASH "Solldrehzahl bei Kurztrip Schwingungsprüfung" VALUE 0x81A234 KwUb 2550. nmot_ub_q10 0.00 2550. FUNCTION_LIST LLRNFA IF_DATA DIM_X DIRECT 0x81A234 /end CHARACTERISTIC
/begin CHARACTERISTIC NSLFASHV "Solldrehzahl bei Kurztrip Sodenvertauscherkennung" VALUE 0x81A235 KwUb 2550. nmot_ub_q10 0.00 2550. FUNCTION_LIST LLRNFA IF_DATA DIM_X DIRECT 0x81A235 /end CHARACTERISTIC
/begin CHARACTERISTIC NSLFASKNO "Drehzahlanforderung für Kurztrip: Diagnose Speicherkat" VALUE 0x81A236 KwUb 2550. nmot_ub_q10 0.00 2550. FUNCTION_LIST LLRNFA IF_DATA DIM_X DIRECT 0x81A236 /end CHARACTERISTIC
/begin CHARACTERISTIC NSLFASLS "Solldrehzahl bei Kurztrip Sekundärluft" VALUE 0x81A237 KwUb 2550. nmot_ub_q10 0.00 2550. FUNCTION_LIST LLRNFA IF_DATA DIM_X DIRECT 0x81A237 /end CHARACTERISTIC
/begin CHARACTERISTIC NSLFATES "Solldrehzahl bei Kurztrip Tankentlüftung" VALUE 0x81A238 KwUb 2550. nmot_ub_q10 0.00 2550. FUNCTION_LIST LLRNFA IF_DATA DIM_X DIRECT 0x81A238 /end CHARACTERISTIC
/begin CHARACTERISTIC NSLFAWSA "Leerlaufdrehzahl bei Kurztrip Auslaß-NW" VALUE 0x81A239 KwUb 2550. nmot_ub_q10 0.00 2550. FUNCTION_LIST LLRNFA IF_DATA DIM_X DIRECT 0x81A239 /end CHARACTERISTIC
/begin CHARACTERISTIC NSLFAWSE "Leerlaufdrehzahl bei Kurztrip Einlaß-NW" VALUE 0x81A23A KwUb 2550. nmot_ub_q10 0.00 2550. FUNCTION_LIST LLRNFA IF_DATA DIM_X DIRECT 0x81A23A /end CHARACTERISTIC
/begin CHARACTERISTIC NSLKVS "Solldrehzahl bei Kurztrip Diagnose Kraftstoffversorgung" VALUE 0x81A23B KwUb 2550. nmot_ub_q10 0.00 2550. FUNCTION_LIST LLRNFA IF_DATA DIM_X DIRECT 0x81A23B /end CHARACTERISTIC
/begin CHARACTERISTIC NSLLSH "Solldrehzahl bei Kurztrip Lambdasonde hinter Kat" VALUE 0x81A23C KwUb 2550. nmot_ub_q10 0.00 2550. FUNCTION_LIST LLRNFA IF_DATA DIM_X DIRECT 0x81A23C /end CHARACTERISTIC
/begin CHARACTERISTIC NSLPP "Solldrehzahl abhängig vom Pumpendruck der Servolenkung" CURVE 0x81A037 KlAUbSstUbWUb 2550. nmot_ub_q10 0.00 2550. FUNCTION_LIST LLRNS IF_DATA DIM_X DIRECT 0x81A037 /begin AXIS_DESCR STD_AXIS psl dez 4 0.00 255.0 DEPOSIT ABSOLUT /end AXIS_DESCR /end CHARACTERISTIC
/begin CHARACTERISTIC NSLPPFS "Solldrehzahl abhängig vom Pumpendruck der Servolenkung bei B_fs=1" CURVE 0x81A040 KlAUbSstUbWUb 2550. nmot_ub_q10 0.00 2550. FUNCTION_LIST LLRNS IF_DATA DIM_X DIRECT 0x81A040 /begin AXIS_DESCR STD_AXIS psl dez 4 0.00 255.0 DEPOSIT ABSOLUT /end AXIS_DESCR /end CHARACTERISTIC
/begin CHARACTERISTIC NSLPWG "Solldrehzahl bei Ausfall PWG-Signale" VALUE 0x81A049 KwUb 2550. nmot_ub_q10 0.00 2550. FUNCTION_LIST LLRNS IF_DATA DIM_X DIRECT 0x81A049 /end CHARACTERISTIC
/begin CHARACTERISTIC NSNLDG "Soll-Drehzahlerhöhung bei Drehzahlgeber-Notlauf" VALUE 0x81A04A KwUb 2550. nmot_ub_q10 0.00 2550. FUNCTION_LIST LLRNS IF_DATA DIM_X DIRECT 0x81A04A /end CHARACTERISTIC
/begin CHARACTERISTIC NSNOT "Solldrehzahlanhebung bei B_nnot=1" VALUE 0x81A04B KwUb 2550. nmot_ub_q10 0.00 2550. FUNCTION_LIST LLRNS IF_DATA DIM_X DIRECT 0x81A04B /end CHARACTERISTIC
/begin CHARACTERISTIC NSNWLL "Solldrehzahlanhebung bei Nockenwellenfehler (B_fs = false)" VALUE 0x81A04C KwUb 2550. nmot_ub_q10 0.00 2550. FUNCTION_LIST LLRNS IF_DATA DIM_X DIRECT 0x81A04C /end CHARACTERISTIC
/begin CHARACTERISTIC NSOF_T_UM "Entprellzeit für Abschaltung der Nachstartaufweitung" VALUE 0x81400C KwUb 10200.0 t40ms_ub_b10200 0.00 10200.0 FUNCTION_LIST UFNSC IF_DATA DIM_X DIRECT 0x81400C /end CHARACTERISTIC
/begin CHARACTERISTIC NSOLMX "Maximalbegrenzung der Solldrehzahl" VALUE 0x81A04D KwUb 2550. nmot_ub_q10 0.00 2550. FUNCTION_LIST LLRNS IF_DATA DIM_X DIRECT 0x81A04D /end CHARACTERISTIC
/begin CHARACTERISTIC NSTAK "Anlassdrehzahlschwelle für Hochlauferkennung" VALUE 0x815D34 KwUw 16383.75 nmot_uw_q0p25 0.00 16383.75 FUNCTION_LIST STADAP IF_DATA DIM_X DIRECT 0x815D34 /end CHARACTERISTIC
/begin CHARACTERISTIC NSTART "Motordrehzahlschwelle für Unterdrehzahl-Ausstieg bei Nachstartaufweitung" VALUE 0x812233 KwUb 10200. nmot_ub_q40 0.00 10200. FUNCTION_LIST MDZUL IF_DATA DIM_X DIRECT 0x812233 /end CHARACTERISTIC
/begin CHARACTERISTIC NSTEND "Motordrehzahlschwelle für Start Ende bei Nachstartaufweitung" VALUE 0x812234 KwUb 10200. nmot_ub_q40 0.00 10200. FUNCTION_LIST MDZUL IF_DATA DIM_X DIRECT 0x812234 /end CHARACTERISTIC
/begin CHARACTERISTIC NSTNM "Übergang Start -> Normal" CURVE 0x81A53A KlAUbSstUbWUb 10200. nmot_ub_q40 0.00 10200. FUNCTION_LIST BBSTT GGCS IF_DATA DIM_X DIRECT 0x81A53A
 /begin AXIS_DESCR STD_AXIS tmot temp_ub_q0p75_o48 3 -48.00 143.3 DEPOSIT ABSOLUT /end AXIS_DESCR
/end CHARACTERISTIC
/begin CHARACTERISTIC NSTNMKMTR "Schwelle für Mindestdrehzahl zur Berechnung gefilterter Kraftstoffverbrauch" VALUE 0x81AF20 KwUb 10200. nmot_ub_q40 0.00 10200. FUNCTION_LIST KMTR IF_DATA DIM_X DIRECT 0x81AF20 /end CHARACTERISTIC
/begin CHARACTERISTIC NSWO1 "Drehzahlschwelle 1 Umschaltg. zur Rechenzeitersparnis" VALUE 0x8181C2 KwUb 10200. nmot_ub_q40 0.00 10200. FUNCTION_LIST PROKON IF_DATA DIM_X DIRECT 0x8181C2 /end CHARACTERISTIC
/begin CHARACTERISTIC NSWO2 "Drehzahlschwelle 2 Umschaltg. zur Rechenzeitersparnis" VALUE 0x8181C3 KwUb 10200. nmot_ub_q40 0.00 10200. FUNCTION_LIST PROKON IF_DATA DIM_X DIRECT 0x8181C3 /end CHARACTERISTIC
/begin CHARACTERISTIC NTUMTA "Schwelle Drehzahl für Bestimmung Umgebungstemperatur" VALUE 0x819546 KwUb 10200. nmot_ub_q40 0.00 10200. FUNCTION_LIST BGTUMG IF_DATA DIM_X DIRECT 0x819546 /end CHARACTERISTIC
/begin CHARACTERISTIC NTUMTAT "Schwelle Drehzahl für Bestimmung Umgebungstemperatur aus TANS" VALUE 0x81864C KwUb 10200. nmot_ub_q40 0.00 10200. FUNCTION_LIST ATM IF_DATA DIM_X DIRECT 0x81864C /end CHARACTERISTIC
/begin CHARACTERISTIC NU2 "untere Drehzahlschwelle Bereich 2" VALUE 0x81905B KwUb 10200. nmot_ub_q40 0.00 10200. FUNCTION_LIST LRA IF_DATA DIM_X DIRECT 0x81905B /end CHARACTERISTIC
/begin CHARACTERISTIC NU3 "untere Drehzahlschwelle Bereich 3" VALUE 0x81905C KwUb 10200. nmot_ub_q40 0.00 10200. FUNCTION_LIST LRA IF_DATA DIM_X DIRECT 0x81905C /end CHARACTERISTIC
/begin CHARACTERISTIC NUKAO "obere Drehzahlgrenze für ÜK-Adaption" VALUE 0x811BF2 KwUb 10200. nmot_ub_q40 0.00 10200. FUNCTION_LIST ESUKAS IF_DATA DIM_X DIRECT 0x811BF2 /end CHARACTERISTIC
/begin CHARACTERISTIC NUKAU "untere Drehzahlgrenze für ÜK-Adaption" VALUE 0x811BF3 KwUb 10200. nmot_ub_q40 0.00 10200. FUNCTION_LIST ESUKAS IF_DATA DIM_X DIRECT 0x811BF3 /end CHARACTERISTIC
/begin CHARACTERISTIC NVERZMN "minimale Drehzahl für Verzögerung" VALUE 0x817816 KwUw 16383.75 nmot_uw_q0p25 0.00 16383.75 FUNCTION_LIST TEB IF_DATA DIM_X DIRECT 0x817816 /end CHARACTERISTIC
/begin CHARACTERISTIC NVGDSLL "Drehzahlschwelle  für Drucksensorvergleich DSU/DSL im Leerlauf" VALUE 0x818897 KwUb 10200. nmot_ub_q40 0.00 10200. FUNCTION_LIST GGDSAS IF_DATA DIM_X DIRECT 0x818897 /end CHARACTERISTIC
/begin CHARACTERISTIC NVMNG "Minimales Drehzahl/Geschwindigkeits-Verhältnis" CURVE 0x8284EE FklWUw 511.9922 qnv_uw_b512 0.00 511.9922 FUNCTION_LIST ARMD IF_DATA DIM_X DIRECT 0x8284EE /begin AXIS_DESCR FIX_AXIS gangi dez 8 0.00 7.000 FIX_AXIS_PAR 0 0 8 /end AXIS_DESCR /end CHARACTERISTIC
/begin CHARACTERISTIC NVMXG "Maximales Drehzahl/Geschwindigkeits-Verhältnis" CURVE 0x8284FE FklWUw 511.9922 qnv_uw_b512 0.00 511.9922 FUNCTION_LIST ARMD IF_DATA DIM_X DIRECT 0x8284FE /begin AXIS_DESCR FIX_AXIS gangi dez 8 0.00 7.000 FIX_AXIS_PAR 0 0 8 /end AXIS_DESCR /end CHARACTERISTIC
/begin CHARACTERISTIC NWDK3 "Minimaldrehzahl für Berechnung DK-Winkel-Ersatzwert aus Füllungssignal" VALUE 0x81110A KwUb 10000. nmot_ub_q40 200.0 10200. FUNCTION_LIST GGDVE IF_DATA DIM_X DIRECT 0x81110A /end CHARACTERISTIC
/begin CHARACTERISTIC NWEGTRM "Wiedereinsetzdrehzahl bei Getriebeeingriff" CURVE 0x819F24 GklWUb 10200. nmot_ub_q40 0.00 10200. FUNCTION_LIST BBSAWE IF_DATA DIM_X DIRECT 0x819F24
 /begin AXIS_DESCR COM_AXIS tmot temp_ub_q0p75_o48 5 -48.00 143.3 AXIS_PTS_REF STM05SAUB /end AXIS_DESCR
/end CHARACTERISTIC
/begin CHARACTERISTIC NWENG "Wiedereinsetzdrehzahl" CURVE 0x8165CE KlAUbSstSbWUb 10200. nmot_ub_q40 0.00 10200. FUNCTION_LIST BBSAWE IF_DATA DIM_X DIRECT 0x8165CE
 /begin AXIS_DESCR STD_AXIS ngfil nmotg_sb_q100 5 -12800. 12700. DEPOSIT ABSOLUT /end AXIS_DESCR
/end CHARACTERISTIC
/begin CHARACTERISTIC NWENGFS "Delta Wiedereinsetzdrehzahl bei Fahrstufe" CURVE 0x8165DA KlAUbSstSbWUb 10200. nmot_ub_q40 0.00 10200. FUNCTION_LIST BBSAWE IF_DATA DIM_X DIRECT 0x8165DA
 /begin AXIS_DESCR STD_AXIS ngfil nmotg_sb_q100 5 -12800. 12700. DEPOSIT ABSOLUT /end AXIS_DESCR
/end CHARACTERISTIC
/begin CHARACTERISTIC NWFDECE "Dekrementierung des Fehlerentprellzählers Nockenwellensteller Einlaß" VALUE 0x81A901 KwUb 255.0 dez 0.00 255.0 FUNCTION_LIST DNWSEIN IF_DATA DIM_X DIRECT 0x81A901 /end CHARACTERISTIC
/begin CHARACTERISTIC NWFINCE "Inkrementierung des Fehlerentprellzählers Nockenwellensteller Einlaß" VALUE 0x81A902 KwUb 255.0 dez 0.00 255.0 FUNCTION_LIST DNWSEIN IF_DATA DIM_X DIRECT 0x81A902 /end CHARACTERISTIC
/begin CHARACTERISTIC NWFMXE "Maximalwert des Fehlerentprellzählers Nockenwellensteller Einlaß für Fehlereintr" VALUE 0x81A903 KwUb 255.0 dez 0.00 255.0 FUNCTION_LIST DNWSEIN IF_DATA DIM_X DIRECT 0x81A903 /end CHARACTERISTIC
/begin CHARACTERISTIC NWPMBBR "Mindestdrehzahl für Pedalwertbegrenzung bei betätigter Bremse" VALUE 0x81103D KwUb 10200. nmot_ub_q40 0.00 10200. FUNCTION_LIST GGPED IF_DATA DIM_X DIRECT 0x81103D /end CHARACTERISTIC
/begin CHARACTERISTIC NZHDTL "Drehzahlschwelle für Zeitzähler Heiß-Leerlauf dekrementieren abh. von TL" CURVE 0x81A04E KlAUbSstUbWUb 10200. nmot_ub_q40 0.00 10200. FUNCTION_LIST LLRNS IF_DATA DIM_X DIRECT 0x81A04E /begin AXIS_DESCR STD_AXIS rl rel_ub_q0p75 6 0.00 191.3 DEPOSIT ABSOLUT /end AXIS_DESCR /end CHARACTERISTIC
/begin CHARACTERISTIC NZHITL "Drehzahlschwelle für Zeitzähler Heiß-Leerlauf inkrementieren abh. von TL" CURVE 0x81A05B KlAUbSstUbWUb 10200. nmot_ub_q40 0.00 10200. FUNCTION_LIST LLRNS IF_DATA DIM_X DIRECT 0x81A05B /begin AXIS_DESCR STD_AXIS rl rel_ub_q0p75 6 0.00 191.3 DEPOSIT ABSOLUT /end AXIS_DESCR /end CHARACTERISTIC
/begin CHARACTERISTIC NZMSE_0_A "Drehzahlgrenze für sicheres Verlassen der ZMS-Resonanz" VALUE 0x82B192 KwUw 16383.75 nmot_uw_q0p25 0.00 16383.75 FUNCTION_LIST BBZMS IF_DATA DIM_X DIRECT 0x82B192 /end CHARACTERISTIC
/begin CHARACTERISTIC NZMSE_1_A "Drehzahlgrenze für sicheres Verlassen der ZMS-Resonanz" VALUE 0x82B194 KwUw 16383.75 nmot_uw_q0p25 0.00 16383.75 FUNCTION_LIST BBZMS IF_DATA DIM_X DIRECT 0x82B194 /end CHARACTERISTIC
/begin CHARACTERISTIC NZMSMN_0_A "untere Drehzahlgrenze für ZMS-Schutz" VALUE 0x82B196 KwUw 16383.75 nmot_uw_q0p25 0.00 16383.75 FUNCTION_LIST BBZMS IF_DATA DIM_X DIRECT 0x82B196 /end CHARACTERISTIC
/begin CHARACTERISTIC NZMSMN_1_A "untere Drehzahlgrenze für ZMS-Schutz" VALUE 0x82B198 KwUw 16383.75 nmot_uw_q0p25 0.00 16383.75 FUNCTION_LIST BBZMS IF_DATA DIM_X DIRECT 0x82B198 /end CHARACTERISTIC
/begin CHARACTERISTIC NZMSMX_0_A "obere Drehzahlgrenze für ZMS-Schutz" VALUE 0x82B19A KwUw 16383.75 nmot_uw_q0p25 0.00 16383.75 FUNCTION_LIST BBZMS IF_DATA DIM_X DIRECT 0x82B19A /end CHARACTERISTIC
/begin CHARACTERISTIC NZMSMX_1_A "obere Drehzahlgrenze für ZMS-Schutz" VALUE 0x82B19C KwUw 16383.75 nmot_uw_q0p25 0.00 16383.75 FUNCTION_LIST BBZMS IF_DATA DIM_X DIRECT 0x82B19C /end CHARACTERISTIC
/begin CHARACTERISTIC N_START_UM "Motordrehzahlschwelle für Unterdrehzahl-Ausstieg für die Fkt.-Überwachung" VALUE 0x81400D KwUb 10200. nmot_ub_q40 0.00 10200. FUNCTION_LIST UFNSC IF_DATA DIM_X DIRECT 0x81400D /end CHARACTERISTIC
/begin CHARACTERISTIC N_STEND_UM "Motordrehzahlschwelle für Startende in der Fkt.-Überwachung" VALUE 0x81400E KwUb 10200. nmot_ub_q40 0.00 10200. FUNCTION_LIST UFNSC IF_DATA DIM_X DIRECT 0x81400E /end CHARACTERISTIC
/begin CHARACTERISTIC OPBKVUKNWB "Offset zu DPBKVUKNW bei betätigter Bremse" VALUE 0x82B298 KwSw 2559.961 p_sw_q0p039 -1280.000 1279.961 FUNCTION_LIST BKV IF_DATA DIM_X DIRECT 0x82B298 /end CHARACTERISTIC
/begin CHARACTERISTIC OSCKTD "Schwelle Sauerstoffspeicherfähigkeit des Kats für Gut-Erkennung" VALUE 0x81C6FC KwUw 15.99976 fak_uw_b16 0.00 15.99976 FUNCTION_LIST DKATSP IF_DATA DIM_X DIRECT 0x81C6FC /end CHARACTERISTIC
/begin CHARACTERISTIC OSCKTDNG "Meßbereich  der normierten Sauerstoffspeicherfähigkeit" VALUE 0x81C6FE KwUw 15.99976 fak_uw_b16 0.00 15.99976 FUNCTION_LIST DKATSP IF_DATA DIM_X DIRECT 0x81C6FE /end CHARACTERISTIC
/begin CHARACTERISTIC OSCKTDT "Schwelle Sauerstoffspeicherfähigkeit des Kats bei Testerbetrieb" VALUE 0x81C700 KwUw 15.99976 fak_uw_b16 0.00 15.99976 FUNCTION_LIST DKATSP IF_DATA DIM_X DIRECT 0x81C700 /end CHARACTERISTIC
/begin CHARACTERISTIC PADMSA "Abgasgegendruck am Sondeneinbauort LSU" CURVE 0x81C630 KlAUwSstUwWUw 2559.961 p_uw_q0p039 0.00 2559.961 FUNCTION_LIST GGLSU IF_DATA DIM_X DIRECT 0x81C630
 /begin AXIS_DESCR STD_AXIS msabg_w m_uw_b6553p5 6 0.00 6553.500 DEPOSIT ABSOLUT /end AXIS_DESCR
/end CHARACTERISTIC
/begin CHARACTERISTIC PBKVKRHY "Hysterese zur kritischen Obergrenze für Druck im Bremskraftverstärker" VALUE 0x82B2A0 KwUw 2559.961 p_uw_q0p039 0.00 2559.961 FUNCTION_LIST BKV DBKVP IF_DATA DIM_X DIRECT 0x82B2A0 /end CHARACTERISTIC
/begin CHARACTERISTIC PBKVVSTGPV "Unterdruckverstärkung durch Saugstrahleffekt" CURVE 0x82B1C8 KlAUwSstUwWUw 2559.961 p_uw_q0p039 0.00 2559.961 FUNCTION_LIST GGPBKV IF_DATA DIM_X DIRECT 0x82B1C8
 /begin AXIS_DESCR STD_AXIS dpspvdkd_w p_uw_q0p039 6 0.00 2559.961 DEPOSIT ABSOLUT /end AXIS_DESCR
/end CHARACTERISTIC
/begin CHARACTERISTIC PEKP "Förderleistung EKP" VALUE 0x81ABFD KwUb 25.50 vs_q0p1 0.00 25.50 FUNCTION_LIST AEKP IF_DATA DIM_X DIRECT 0x81ABFD /end CHARACTERISTIC
/begin CHARACTERISTIC PGFLNL "Anzahl an Phasenflanken bis NLDG aufgerufen wird bei eingetragenem E_n" VALUE 0x81848D KwUb 255.0 dez 0.00 255.0 FUNCTION_LIST DDG IF_DATA DIM_X DIRECT 0x81848D /end CHARACTERISTIC
/begin CHARACTERISTIC PGFLWA "Anzahl PG-Flankenwechsel für DG-Fehler B_signal" VALUE 0x810FAB KwUb 255.0 dez 0.00 255.0 FUNCTION_LIST DDG IF_DATA DIM_X DIRECT 0x810FAB /end CHARACTERISTIC
/begin CHARACTERISTIC PHNMO "Drehzahlschwelle für Umschaltung auf 1 Phasenflanke" VALUE 0x818497 KwUb 10200. nmot_ub_q40 0.00 10200. FUNCTION_LIST GGNW IF_DATA DIM_X DIRECT 0x818497 /end CHARACTERISTIC
/begin CHARACTERISTIC PHNMU "Drehzahlschwelle für Umschaltung auf 2 Phasenflanken" VALUE 0x818498 KwUb 10200. nmot_ub_q40 0.00 10200. FUNCTION_LIST GGNW IF_DATA DIM_X DIRECT 0x818498 /end CHARACTERISTIC
/begin CHARACTERISTIC PHNOKA "Anfangswert für Zähler Phasensignal nicht ok" VALUE 0x810FB2 KwUb 255.0 dez 0.00 255.0 FUNCTION_LIST DPH IF_DATA DIM_X DIRECT 0x810FB2 /end CHARACTERISTIC
/begin CHARACTERISTIC PH_MINSEG "Segmentlänge kurzes Segment beim Schnellstart-Phasengebersignal" VALUE 0x810FC5 KwUb 90.00 kw_tooth_sy 0.00 90.00 FUNCTION_LIST GGDPG IF_DATA DIM_X DIRECT 0x810FC5 /end CHARACTERISTIC
/begin CHARACTERISTIC PKLIHDV "Klimadruck-Schwelle für Lüfter schnell-Hochlauf" VALUE 0x81AF21 KwUb 51.00 p_q0p2 0.00 51.00 FUNCTION_LIST KMTR IF_DATA DIM_X DIRECT 0x81AF21 /end CHARACTERISTIC
/begin CHARACTERISTIC PKLIMA "Kennlinie Systemdruck Klimaanlage" CURVE 0x81AF22 KlAUbSstUbWUb 51.00 p_q0p2 0.00 51.00 FUNCTION_LIST KMTR IF_DATA DIM_X DIRECT 0x81AF22 /begin AXIS_DESCR STD_AXIS takols dez 5 0.00 255.0 DEPOSIT ABSOLUT /end AXIS_DESCR /end CHARACTERISTIC
/begin CHARACTERISTIC PKODR "Ersatzwert Druck Klimaanlage für KMTR" VALUE 0x81AF2D KwUb 51.00 p_q0p2 0.00 51.00 FUNCTION_LIST KMTR IF_DATA DIM_X DIRECT 0x81AF2D /end CHARACTERISTIC
/begin CHARACTERISTIC PKODRCMX "Kältemitteldruckschwelle zur Kompressorabschaltung" VALUE 0x81ABE5 KwUb 51.00 p_q0p2 0.00 51.00 FUNCTION_LIST KOS IF_DATA DIM_X DIRECT 0x81ABE5 /end CHARACTERISTIC
/begin CHARACTERISTIC PLRHAV "Wichtungsfaktor des P-Anteils in der LRHK über KAT-Alterung" CURVE 0x812728 KlAUbSstUbWUb 0.9961 fak_ub_b1 0.00 0.9961 FUNCTION_LIST LRSHK IF_DATA DIM_X DIRECT 0x812728 /begin AXIS_DESCR STD_AXIS avkatf fak_ub_b1 8 0.00 0.9961 DEPOSIT ABSOLUT /end AXIS_DESCR /end CHARACTERISTIC
/begin CHARACTERISTIC PMAXKBI "Kombiausgabe maximale Leistung" VALUE 0x813CE6 KwUw 511.0000 kw_q1 0.00 511.0000 FUNCTION_LIST CAN IF_DATA DIM_X DIRECT 0x813CE6 /end CHARACTERISTIC
/begin CHARACTERISTIC POSABW "pos zeitliche Abweichung zur Fehlererkennung" VALUE 0x8187F1 KwUb 1.000 fak_q0p1 0.00 1.000 FUNCTION_LIST DKMTR IF_DATA DIM_X DIRECT 0x8187F1 /end CHARACTERISTIC
/begin CHARACTERISTIC PSAPES "Saugrohrdruck für Applikation Einspritzung" VALUE 0x81DF8E KwUw 2559.961 p_uw_q0p039 0.00 2559.961 FUNCTION_LIST RKTI IF_DATA DIM_X DIRECT 0x81DF8E /end CHARACTERISTIC
/begin CHARACTERISTIC PSPVDKUG "Verhältnis pspvdk ungedrosselt" VALUE 0x81588A KwUw 1.999969 fak_uw_b2 0.00 1.999969 FUNCTION_LIST BGMSZS BGRLP FUEDK IF_DATA DIM_X DIRECT 0x81588A /end CHARACTERISTIC
/begin CHARACTERISTIC PSSOLNGRD "Schwelle negativer pssol-Gradient" VALUE 0x81588C KwSw 51199.22 grd_sw_q0p78 -25600.00 25599.22 FUNCTION_LIST BGMSZS IF_DATA DIM_X DIRECT 0x81588C /end CHARACTERISTIC
/begin CHARACTERISTIC PSSOLPF "Schwelle positiver gefilteter pssol-Gradient" VALUE 0x81588E KwSw 51199.22 grd_sw_q0p78 -25600.00 25599.22 FUNCTION_LIST BGMSZS IF_DATA DIM_X DIRECT 0x81588E /end CHARACTERISTIC
/begin CHARACTERISTIC PSSOLPGRD "Schwelle positiver pssol-Gradient" VALUE 0x815890 KwSw 51199.22 grd_sw_q0p78 -25600.00 25599.22 FUNCTION_LIST BGMSZS IF_DATA DIM_X DIRECT 0x815890 /end CHARACTERISTIC
/begin CHARACTERISTIC PUE "Ersatzwert für Umgebungsdruck" VALUE 0x81D628 KwUw 2559.961 p_uw_q0p039 0.00 2559.961 FUNCTION_LIST GGDSAS IF_DATA DIM_X DIRECT 0x81D628 /end CHARACTERISTIC
/begin CHARACTERISTIC PUEBKV "Ersatzwert für Umgebungsdruck für BKV" VALUE 0x82B1E2 KwUw 1279.961 p_uw_q0p039 0.00 1279.961 FUNCTION_LIST GGPBKV IF_DATA DIM_X DIRECT 0x82B1E2 /end CHARACTERISTIC
/begin CHARACTERISTIC PUELSU "Ersatzwert für Umgebungsdruck" VALUE 0x81C64A KwUw 2559.961 p_uw_q0p039 0.00 2559.961 FUNCTION_LIST GGLSU IF_DATA DIM_X DIRECT 0x81C64A /end CHARACTERISTIC
/begin CHARACTERISTIC PUKANS "Pulsationskorrektur abhängig von Ansauglufttemperatur" CURVE 0x81887B KlAUbSstUbWUb 1.992 fak_ub_b2 0.00 1.992 FUNCTION_LIST GGHFM IF_DATA DIM_X DIRECT 0x81887B
 /begin AXIS_DESCR STD_AXIS tans temp_ub_q0p75_o48 8 -48.00 143.3 DEPOSIT ABSOLUT /end AXIS_DESCR
/end CHARACTERISTIC
/begin CHARACTERISTIC PUMN "Umgebungsdruckbegrenzung minimal" VALUE 0x81D62A KwUw 2559.961 p_uw_q0p039 0.00 2559.961 FUNCTION_LIST GGDSAS IF_DATA DIM_X DIRECT 0x81D62A /end CHARACTERISTIC
/begin CHARACTERISTIC PUMX "Umgebungsdruckbegrenzung maximal" VALUE 0x81D62C KwUw 2559.961 p_uw_q0p039 0.00 2559.961 FUNCTION_LIST GGDSAS IF_DATA DIM_X DIRECT 0x81D62C /end CHARACTERISTIC
/begin CHARACTERISTIC PUSMAX "maximal plausible Umgebungsdruckschwelle" VALUE 0x8178CE KwUw 2559.961 p_uw_q0p039 0.00 2559.961 FUNCTION_LIST BGPUK IF_DATA DIM_X DIRECT 0x8178CE /end CHARACTERISTIC
/begin CHARACTERISTIC PUSMIN "minimal plausible Umgebungsdruckschwelle" VALUE 0x8178D0 KwUw 2559.961 p_uw_q0p039 0.00 2559.961 FUNCTION_LIST BGPUK IF_DATA DIM_X DIRECT 0x8178D0 /end CHARACTERISTIC
/begin CHARACTERISTIC PUSPSMX "max. Abweichung von Umgebungsdruck und Saugrohrdruck" VALUE 0x81D62E KwUw 2559.961 p_uw_q0p039 0.00 2559.961 FUNCTION_LIST GGDSAS IF_DATA DIM_X DIRECT 0x81D62E /end CHARACTERISTIC
/begin CHARACTERISTIC PVDKMN "pvdk min. Schwelle für Fehlererkennung Ladedrucksensor" VALUE 0x81D630 KwUw 2559.961 p_uw_q0p039 0.00 2559.961 FUNCTION_LIST GGDSAS IF_DATA DIM_X DIRECT 0x81D630 /end CHARACTERISTIC
/begin CHARACTERISTIC PVDKMX "Ladedruckgrenze für Diagnose max. Fehler" CURVE 0x81D632 KlAUwSstUwWUw 2559.961 p_uw_q0p039 0.00 2559.961 FUNCTION_LIST GGDSAS IF_DATA DIM_X DIRECT 0x81D632
 /begin AXIS_DESCR STD_AXIS nmot_w nmot_uw_q0p25 4 0.00 16383.75 DEPOSIT ABSOLUT /end AXIS_DESCR
/end CHARACTERISTIC
/begin CHARACTERISTIC PVDKPSMX "max. Abweichung von Saugrohrdruck und Druck vor Drosselklappe" VALUE 0x81D644 KwUw 2559.961 p_uw_q0p039 0.00 2559.961 FUNCTION_LIST GGDSAS IF_DATA DIM_X DIRECT 0x81D644 /end CHARACTERISTIC
/begin CHARACTERISTIC PVDKPUD "Schwelle unterhalb welcher die Diff. zw. pvdkds und pu als 0 ausgegeben wird" VALUE 0x818898 KwUb 2550. p_ub_q10 0.00 2550. FUNCTION_LIST GGDSAS IF_DATA DIM_X DIRECT 0x818898 /end CHARACTERISTIC
/begin CHARACTERISTIC PVDNKH "Kennlinie P-Verstärkung bei Thermoreaktor" CURVE 0x81669C KlAUbSstSbWUb 0.3891 fak_q0p00153 0.00 0.3891 FUNCTION_LIST LLRRM IF_DATA DIM_X DIRECT 0x81669C /begin AXIS_DESCR STD_AXIS dns nmotd_sb_q10 10 -1280. 1270. DEPOSIT ABSOLUT /end AXIS_DESCR /end CHARACTERISTIC
/begin CHARACTERISTIC PVMITIBGR "P-Verstärkungsfaktor für Momentenbegrenzung bei Dauerstricheinspritzung" VALUE 0x818F77 KwUb 9.120 rkti_p_sy 0.00 9.120 FUNCTION_LIST RKTI IF_DATA DIM_X DIRECT 0x818F77 /end CHARACTERISTIC
/begin CHARACTERISTIC PZWKRA "Prozentuale Häufigkeit der ZW-Ausgabe durch die KR während Dynamikadaption" VALUE 0x811C42 KwUb 99.61 rel_ub_b99p6 0.00 99.61 FUNCTION_LIST KRDY IF_DATA DIM_X DIRECT 0x811C42 /end CHARACTERISTIC
/begin CHARACTERISTIC P_ZYL "Abstand zur Bestimmung des arithmet Mittelwertes - DMDLU" VALUE 0x810D0B KwUb 7.000 dez 0.00 7.000 FUNCTION_LIST DMDLU IF_DATA DIM_X DIRECT 0x810D0B /end CHARACTERISTIC
/begin CHARACTERISTIC QKLIHDV "Wärmestrom-Schwelle für Lüfter schnell-Hochlauf" VALUE 0x81AF2E KwUb 191.3 temp_ub_q0p75_o48 -48.00 143.3 FUNCTION_LIST KMTR IF_DATA DIM_X DIRECT 0x81AF2E /end CHARACTERISTIC
/begin CHARACTERISTIC QKLILU1 "Festwert Wärmestrom Klima f. Lüfter 1" VALUE 0x81AF2F KwUb 191.3 temp_ub_q0p75_o48 -48.00 143.3 FUNCTION_LIST KMTR IF_DATA DIM_X DIRECT 0x81AF2F /end CHARACTERISTIC
/begin CHARACTERISTIC QKLILU2 "Festwert Wärmestrom Klima f. Lüfter 2" VALUE 0x81AF30 KwUb 191.3 temp_ub_q0p75_o48 -48.00 143.3 FUNCTION_LIST KMTR IF_DATA DIM_X DIRECT 0x81AF30 /end CHARACTERISTIC
/begin CHARACTERISTIC QMAXL1INI "Initialisierungswert Einschaltschwelle Lüfter 1" VALUE 0x81AF31 KwUb 191.3 temp_ub_q0p75_o48 -48.00 143.3 FUNCTION_LIST KMTR IF_DATA DIM_X DIRECT 0x81AF31 /end CHARACTERISTIC
/begin CHARACTERISTIC QMAXL2INI "Initialisierungswert Einschaltschwelle Lüfter 2" VALUE 0x81AF32 KwUb 191.3 temp_ub_q0p75_o48 -48.00 143.3 FUNCTION_LIST KMTR IF_DATA DIM_X DIRECT 0x81AF32 /end CHARACTERISTIC
/begin CHARACTERISTIC RALEZMAX "Begrenzung der Anzahl rückwärts drehender Zähne im Auslauf" VALUE 0x810FB4 KwUb 127.0 dez 0.00 127.0 FUNCTION_LIST ALE IF_DATA DIM_X DIRECT 0x810FB4 /end CHARACTERISTIC
/begin CHARACTERISTIC RAMPASR "Rampensteilheit bei Aufregelung des ASR-Moments" VALUE 0x813D2C KwUw 655.34999985 zk10msxs_uw_b655 0.010000152590 655.36000000 FUNCTION_LIST GGCASR IF_DATA DIM_X DIRECT 0x813D2C /end CHARACTERISTIC
/begin CHARACTERISTIC RDUNDEF "Winkelbereich in dem keine Plausibilisierung des Rückdrehverdachts möglich ist" VALUE 0x810FAD KwUb 1530. kw_q6 0.00 1530. FUNCTION_LIST RDE IF_DATA DIM_X DIRECT 0x810FAD /end CHARACTERISTIC
/begin CHARACTERISTIC REAC_D1_UC "" VAL_BLK 0x812443 KwbUb 255.0 dez 0.00 255.0 NUMBER 16 FUNCTION_LIST URCEIN IF_DATA DIM_X DIRECT 0x812443 /end CHARACTERISTIC
/begin CHARACTERISTIC REAC_D2_UC "" VAL_BLK 0x812453 KwbUb 255.0 dez 0.00 255.0 NUMBER 16 FUNCTION_LIST URCEIN IF_DATA DIM_X DIRECT 0x812453 /end CHARACTERISTIC
/begin CHARACTERISTIC REAC_T1_UC "Fehlerzeit bei der Funktions-Fehlerreaktionsüberwachung im Befehlstest" VALUE 0x81267C KwUb 10200.0 t40ms_ub_b10200 0.00 10200.0 FUNCTION_LIST URCREAC IF_DATA DIM_X DIRECT 0x81267C /end CHARACTERISTIC
/begin CHARACTERISTIC REAC_T1_UM "Fehlerzeit bei der Funktions-Fehlerreaktionsüberwachung in der Funktionsüberw." VALUE 0x81420C KwUb 10200.0 t40ms_ub_b10200 0.00 10200.0 FUNCTION_LIST UFREAC IF_DATA DIM_X DIRECT 0x81420C /end CHARACTERISTIC
/begin CHARACTERISTIC REAC_T2_UC "Fehlerzeit bei der Funktionsüberwachungs-Fehlerreaktionsüberw. im Befehlstest" VALUE 0x81267D KwUb 10200.0 t40ms_ub_b10200 0.00 10200.0 FUNCTION_LIST URCREAC IF_DATA DIM_X DIRECT 0x81267D /end CHARACTERISTIC
/begin CHARACTERISTIC REAC_T2_UM "Fehlerzeit bei der Funktionsüberwachungs-Fehlerreaktionsüberwachung" VALUE 0x81420D KwUb 10200.0 t40ms_ub_b10200 0.00 10200.0 FUNCTION_LIST UFREAC IF_DATA DIM_X DIRECT 0x81420D /end CHARACTERISTIC
/begin CHARACTERISTIC REDABM "Ev-Abschaltmuster für Momentenreduzierung" MAP 0x8114EF FkfNoShNoOffWUb 255.0 dez 0.00 255.0 FUNCTION_LIST AEVAB IF_DATA DIM_X DIRECT 0x8114EF /begin AXIS_DESCR FIX_AXIS evrbgn_one dez 4 0.00 3.000 FIX_AXIS_PAR 0 0 4 /end AXIS_DESCR /begin AXIS_DESCR FIX_AXIS redsol_one dez 4 0.00 3.000 FIX_AXIS_PAR 0 0 4 /end AXIS_DESCR /end CHARACTERISTIC
/begin CHARACTERISTIC REDHYOC "Hysterese der Reduzierstufe bei größerer Soll-Reduzierstufe als Ist-Wert" VALUE 0x81215F KwSb 5.100 rel_sb_q0p02 -2.560 2.540 FUNCTION_LIST MDRED IF_DATA DIM_X DIRECT 0x81215F /end CHARACTERISTIC
/begin CHARACTERISTIC REDHYUC "Hysterese der Reduzierstufe bei kleinerer Soll-Reduzierstufe als Ist-Wert" VALUE 0x812160 KwSb 5.100 rel_sb_q0p02 -2.560 2.540 FUNCTION_LIST MDRED IF_DATA DIM_X DIRECT 0x812160 /end CHARACTERISTIC
/begin CHARACTERISTIC REDMXSA "maximale Reduzierstufe bei sequentieller Schubabschaltung" VALUE 0x812161 KwUb 255.0 dez 0.00 255.0 FUNCTION_LIST MDRED IF_DATA DIM_X DIRECT 0x812161 /end CHARACTERISTIC
/begin CHARACTERISTIC REDZEM "Schwelle zwischen Zündeingriff und Einspritzausblendung" CURVE 0x81A3DE KlAUbSstUbWUb 255.0 dez 0.00 255.0 FUNCTION_LIST MDRED IF_DATA DIM_X DIRECT 0x81A3DE
 /begin AXIS_DESCR STD_AXIS tmot temp_ub_q0p75_o48 5 -48.00 143.3 DEPOSIT ABSOLUT /end AXIS_DESCR
/end CHARACTERISTIC
/begin CHARACTERISTIC REFINI "Startwert Referenzpegel bei Klopfregelung aktiv" VALUE 0x811C08 KwUb 0.7227 spg_ub_b5 0.2930 1.016 FUNCTION_LIST KRKE IF_DATA DIM_X DIRECT 0x811C08 /end CHARACTERISTIC
/begin CHARACTERISTIC RESETMAX "" VALUE 0x81A456 KwUb 1.000 dez 0.00 1.000 FUNCTION_LIST RUNTIME IF_DATA DIM_X DIRECT 0x81A456 /end CHARACTERISTIC
/begin CHARACTERISTIC RFLAGS_D_UC "" VAL_BLK 0x812463 KwbUb 255.0 dez 0.00 255.0 NUMBER 16 FUNCTION_LIST URCEIN IF_DATA DIM_X DIRECT 0x812463 /end CHARACTERISTIC
/begin CHARACTERISTIC RKADTEVO "obere rka Schwelle für passive Einschaltbedingungen Diagnose TEV" VALUE 0x829D1E KwSw 9.984375 rel_sw_b1536 0.00 9.984375 FUNCTION_LIST DTEV IF_DATA DIM_X DIRECT 0x829D1E /end CHARACTERISTIC
/begin CHARACTERISTIC RKADTEVU "untere rka Schwelle für passive Einschaltbedingungen Diagnose TEV" VALUE 0x829D20 KwSw 9.984375 rel_sw_b1536 -9.984375 0.00 FUNCTION_LIST DTEV IF_DATA DIM_X DIRECT 0x829D20 /end CHARACTERISTIC
/begin CHARACTERISTIC RKAE "Delta rkat- bzw. rkaz-Schwelle für Erkennung der eingeschwungenen Grundadaption" VALUE 0x81E4E2 KwSw 3071.953 rel_sw_b1536 -1536.000 1535.953 FUNCTION_LIST DKVS IF_DATA DIM_X DIRECT 0x81E4E2 /end CHARACTERISTIC
/begin CHARACTERISTIC RKATDN "untere Diagnoseschwelle additive Korrektur pro Zeit" VALUE 0x81E4E4 KwSw 3071.953 rel_sw_b1536 -1536.000 1535.953 FUNCTION_LIST DKVS IF_DATA DIM_X DIRECT 0x81E4E4 /end CHARACTERISTIC
/begin CHARACTERISTIC RKATDX "obere Diagnoseschwelle additive Korrektur pro Zeit" VALUE 0x81E4E6 KwSw 3071.953 rel_sw_b1536 -1536.000 1535.953 FUNCTION_LIST DKVS IF_DATA DIM_X DIRECT 0x81E4E6 /end CHARACTERISTIC
/begin CHARACTERISTIC RKATMN "untere Schwelle additive Korrektur pro Zeit" VALUE 0x81E034 KwSw 383.9941 rel_sw_b192 -192.0000 191.9941 FUNCTION_LIST LRA IF_DATA DIM_X DIRECT 0x81E034 /end CHARACTERISTIC
/begin CHARACTERISTIC RKATMX "obere Schwelle additive Korrektur pro Zeit" VALUE 0x81E036 KwSw 383.9941 rel_sw_b192 -192.0000 191.9941 FUNCTION_LIST LRA IF_DATA DIM_X DIRECT 0x81E036 /end CHARACTERISTIC
/begin CHARACTERISTIC RKATRN "reduzierte untere Schwelle additive Korrektur pro Zeit" VALUE 0x81E038 KwSw 383.9941 rel_sw_b192 -192.0000 191.9941 FUNCTION_LIST LRA IF_DATA DIM_X DIRECT 0x81E038 /end CHARACTERISTIC
/begin CHARACTERISTIC RKATRX "reduzierte obere Schwelle additive Korrektur pro Zeit" VALUE 0x81E03A KwSw 383.9941 rel_sw_b192 -192.0000 191.9941 FUNCTION_LIST LRA IF_DATA DIM_X DIRECT 0x81E03A /end CHARACTERISTIC
/begin CHARACTERISTIC RKAZDN "untere Diagnoseschwelle additive Korrektur pro Zündung" VALUE 0x81E4E8 KwSw 3071.953 rel_sw_b1536 -1536.000 1535.953 FUNCTION_LIST DKVS IF_DATA DIM_X DIRECT 0x81E4E8 /end CHARACTERISTIC
/begin CHARACTERISTIC RKAZDX "obere Diagnoseschwelle additive Korrektur pro Zündung" VALUE 0x81E4EA KwSw 3071.953 rel_sw_b1536 -1536.000 1535.953 FUNCTION_LIST DKVS IF_DATA DIM_X DIRECT 0x81E4EA /end CHARACTERISTIC
/begin CHARACTERISTIC RKAZMN "untere Schwelle additive Korrektur pro Zündung" VALUE 0x81E03C KwSw 383.9941 rel_sw_b192 -192.0000 191.9941 FUNCTION_LIST LRA IF_DATA DIM_X DIRECT 0x81E03C /end CHARACTERISTIC
/begin CHARACTERISTIC RKAZMX "obere Schwelle additive Korrektur pro Zündung" VALUE 0x81E03E KwSw 383.9941 rel_sw_b192 -192.0000 191.9941 FUNCTION_LIST LRA IF_DATA DIM_X DIRECT 0x81E03E /end CHARACTERISTIC
/begin CHARACTERISTIC RKAZRN "reduzierte untere Schwelle additive Korrektur pro Zündung" VALUE 0x81E040 KwSw 383.9941 rel_sw_b192 -192.0000 191.9941 FUNCTION_LIST LRA IF_DATA DIM_X DIRECT 0x81E040 /end CHARACTERISTIC
/begin CHARACTERISTIC RKAZRX "reduzierte obere Schwelle additive Korrektur pro Zündung" VALUE 0x81E042 KwSw 383.9941 rel_sw_b192 -192.0000 191.9941 FUNCTION_LIST LRA IF_DATA DIM_X DIRECT 0x81E042 /end CHARACTERISTIC
/begin CHARACTERISTIC RKBAUM "rk-Schwelle für BA-Anzeige" CURVE 0x81E42A GklWSw 6143.813 rel_sw_q0p1875 0.00 6143.813 FUNCTION_LIST ESUK IF_DATA DIM_X DIRECT 0x81E42A
 /begin AXIS_DESCR COM_AXIS tmot temp_ub_q0p75_o48 9 -48.00 143.3 AXIS_PTS_REF STM09ESUB /end AXIS_DESCR
/end CHARACTERISTIC
/begin CHARACTERISTIC RKRMX1N "Maximaler Referenzpegel für Klopferkennungsschwelle Zyl.-gruppe 1" CURVE 0x819A7A GklWUb 317.5 spg_ub_b320 1.250 318.8 FUNCTION_LIST KRKE IF_DATA DIM_X DIRECT 0x819A7A
 /begin AXIS_DESCR COM_AXIS nmot nmot_ub_q40 16 0.00 10200. AXIS_PTS_REF SNM16KRUB /end AXIS_DESCR
/end CHARACTERISTIC
/begin CHARACTERISTIC RKRMX2N "Maximaler Referenzpegel für Klopferkennungsschwelle Zyl.-gruppe 2" CURVE 0x819A8A GklWUb 317.5 spg_ub_b320 1.250 318.8 FUNCTION_LIST KRKE IF_DATA DIM_X DIRECT 0x819A8A
 /begin AXIS_DESCR COM_AXIS nmot nmot_ub_q40 16 0.00 10200. AXIS_PTS_REF SNM16KRUB /end AXIS_DESCR
/end CHARACTERISTIC
/begin CHARACTERISTIC RKUKKLU "Schwelle Summe Kurz-/Langzeitanteil" VALUE 0x815F10 KwSw 12287.81 rel_sw_q0p1875 -6144.000 6143.813 FUNCTION_LIST ESUK IF_DATA DIM_X DIRECT 0x815F10 /end CHARACTERISTIC
/begin CHARACTERISTIC RKVAUM "rk-Schwelle für VA-Anzeige" CURVE 0x81E43C GklWSw 6144.000 rel_sw_q0p1875 -6144.000 0.00 FUNCTION_LIST ESUK IF_DATA DIM_X DIRECT 0x81E43C
 /begin AXIS_DESCR COM_AXIS tmot temp_ub_q0p75_o48 9 -48.00 143.3 AXIS_PTS_REF STM09ESUB /end AXIS_DESCR
/end CHARACTERISTIC
/begin CHARACTERISTIC RL1FGV "RL-Kennlinie Bergaberkennung Gang 1 bei Feinstleckdiagnose" CURVE 0x81A7B0 GklWUb 191.3 rel_ub_q0p75 0.00 191.3 FUNCTION_LIST DLDP IF_DATA DIM_X DIRECT 0x81A7B0
 /begin AXIS_DESCR COM_AXIS vfzg vfzg_ub_q1p25 6 0.00 318.8 AXIS_PTS_REF SVF06D_UB /end AXIS_DESCR
/end CHARACTERISTIC
/begin CHARACTERISTIC RL1GV "RL - Kennlinie Bergaberkennung Gang 1" CURVE 0x81A7B6 GklWUb 191.3 rel_ub_q0p75 0.00 191.3 FUNCTION_LIST DLDP IF_DATA DIM_X DIRECT 0x81A7B6
 /begin AXIS_DESCR COM_AXIS vfzg vfzg_ub_q1p25 6 0.00 318.8 AXIS_PTS_REF SVF06D_UB /end AXIS_DESCR
/end CHARACTERISTIC
/begin CHARACTERISTIC RL2FGV "RL-Kennlinie Bergaberkennung Gang 2 bei Feinstleckdiagnose" CURVE 0x81A7BC GklWUb 191.3 rel_ub_q0p75 0.00 191.3 FUNCTION_LIST DLDP IF_DATA DIM_X DIRECT 0x81A7BC
 /begin AXIS_DESCR COM_AXIS vfzg vfzg_ub_q1p25 6 0.00 318.8 AXIS_PTS_REF SVF06D_UB /end AXIS_DESCR
/end CHARACTERISTIC
/begin CHARACTERISTIC RL2GV "RL - Kennlinie Bergaberkennung Gang 2" CURVE 0x81A7C2 GklWUb 191.3 rel_ub_q0p75 0.00 191.3 FUNCTION_LIST DLDP IF_DATA DIM_X DIRECT 0x81A7C2
 /begin AXIS_DESCR COM_AXIS vfzg vfzg_ub_q1p25 6 0.00 318.8 AXIS_PTS_REF SVF06D_UB /end AXIS_DESCR
/end CHARACTERISTIC
/begin CHARACTERISTIC RL3FGV "RL-Kennlinie Bergaberkennung Gang 3 bei Feinstleckdiagnose" CURVE 0x81A7C8 GklWUb 191.3 rel_ub_q0p75 0.00 191.3 FUNCTION_LIST DLDP IF_DATA DIM_X DIRECT 0x81A7C8
 /begin AXIS_DESCR COM_AXIS vfzg vfzg_ub_q1p25 6 0.00 318.8 AXIS_PTS_REF SVF06D_UB /end AXIS_DESCR
/end CHARACTERISTIC
/begin CHARACTERISTIC RL3GV "RL - Kennlinie Bergaberkennung Gang 3" CURVE 0x81A7CE GklWUb 191.3 rel_ub_q0p75 0.00 191.3 FUNCTION_LIST DLDP IF_DATA DIM_X DIRECT 0x81A7CE
 /begin AXIS_DESCR COM_AXIS vfzg vfzg_ub_q1p25 6 0.00 318.8 AXIS_PTS_REF SVF06D_UB /end AXIS_DESCR
/end CHARACTERISTIC
/begin CHARACTERISTIC RL4FGV "RL-Kennlinie Bergaberkennung Gang 4 bei Feinstleckdiagnose" CURVE 0x81A7D4 GklWUb 191.3 rel_ub_q0p75 0.00 191.3 FUNCTION_LIST DLDP IF_DATA DIM_X DIRECT 0x81A7D4
 /begin AXIS_DESCR COM_AXIS vfzg vfzg_ub_q1p25 6 0.00 318.8 AXIS_PTS_REF SVF06D_UB /end AXIS_DESCR
/end CHARACTERISTIC
/begin CHARACTERISTIC RL4GV "RL - Kennlinie Bergaberkennung Gang 4" CURVE 0x81A7DA GklWUb 191.3 rel_ub_q0p75 0.00 191.3 FUNCTION_LIST DLDP IF_DATA DIM_X DIRECT 0x81A7DA
 /begin AXIS_DESCR COM_AXIS vfzg vfzg_ub_q1p25 6 0.00 318.8 AXIS_PTS_REF SVF06D_UB /end AXIS_DESCR
/end CHARACTERISTIC
/begin CHARACTERISTIC RL5FGV "RL-Kennlinie Bergaberkennung Gang 5 bei Feinstleckdiagnose" CURVE 0x81A7E0 GklWUb 191.3 rel_ub_q0p75 0.00 191.3 FUNCTION_LIST DLDP IF_DATA DIM_X DIRECT 0x81A7E0
 /begin AXIS_DESCR COM_AXIS vfzg vfzg_ub_q1p25 6 0.00 318.8 AXIS_PTS_REF SVF06D_UB /end AXIS_DESCR
/end CHARACTERISTIC
/begin CHARACTERISTIC RL5GV "RL - Kennlinie Bergaberkennung Gang 5" CURVE 0x81A7E6 GklWUb 191.3 rel_ub_q0p75 0.00 191.3 FUNCTION_LIST DLDP IF_DATA DIM_X DIRECT 0x81A7E6
 /begin AXIS_DESCR COM_AXIS vfzg vfzg_ub_q1p25 6 0.00 318.8 AXIS_PTS_REF SVF06D_UB /end AXIS_DESCR
/end CHARACTERISTIC
/begin CHARACTERISTIC RL6FGV "RL-Kennlinie Bergaberkennung Gang 6 bei Feinstleckdiagnose" CURVE 0x81A7EC GklWUb 191.3 rel_ub_q0p75 0.00 191.3 FUNCTION_LIST DLDP IF_DATA DIM_X DIRECT 0x81A7EC
 /begin AXIS_DESCR COM_AXIS vfzg vfzg_ub_q1p25 6 0.00 318.8 AXIS_PTS_REF SVF06D_UB /end AXIS_DESCR
/end CHARACTERISTIC
/begin CHARACTERISTIC RL6GV "RL - Kennlinie Bergaberkennung Gang 6" CURVE 0x81A7F2 GklWUb 191.3 rel_ub_q0p75 0.00 191.3 FUNCTION_LIST DLDP IF_DATA DIM_X DIRECT 0x81A7F2
 /begin AXIS_DESCR COM_AXIS vfzg vfzg_ub_q1p25 6 0.00 318.8 AXIS_PTS_REF SVF06D_UB /end AXIS_DESCR
/end CHARACTERISTIC
/begin CHARACTERISTIC RLBABMX "Begrenzung Filter Bergaberkennung" VALUE 0x829DB8 KwUw 1535.977 rel_uw_q0p0234 0.00 1535.977 FUNCTION_LIST DLDP IF_DATA DIM_X DIRECT 0x829DB8 /end CHARACTERISTIC
/begin CHARACTERISTIC RLC_T_UM "Fehlertoleranzzeit für den rl-Vergleich mit der Funktion in der Funktionsüberw." VALUE 0x814069 KwUb 10200.0 t40ms_ub_b10200 0.00 10200.0 FUNCTION_LIST UFRLC IF_DATA DIM_X DIRECT 0x814069 /end CHARACTERISTIC
/begin CHARACTERISTIC RLDYNFA "Lastschwelle für Dynamikprüfung LSU bei Kurztest" VALUE 0x8186F5 KwUb 191.3 rel_ub_q0p75 0.00 191.3 FUNCTION_LIST DLSU IF_DATA DIM_X DIRECT 0x8186F5 /end CHARACTERISTIC
/begin CHARACTERISTIC RLDYNO "obere Lastschwelle für Dynamikprüfung LSU" VALUE 0x8186F6 KwUb 191.3 rel_ub_q0p75 0.00 191.3 FUNCTION_LIST DLSU IF_DATA DIM_X DIRECT 0x8186F6 /end CHARACTERISTIC
/begin CHARACTERISTIC RLDYNU "untere Lastschwelle für Dynamikprüfung LSU" VALUE 0x8186F7 KwUb 191.3 rel_ub_q0p75 0.00 191.3 FUNCTION_LIST DLSU IF_DATA DIM_X DIRECT 0x8186F7 /end CHARACTERISTIC
/begin CHARACTERISTIC RLIPFIL_UM "Filter-Zeitkonstante für verzögerte Lastinfo rlipt_um in d. Funktionsüberwachung" VALUE 0x81406A KwUb 10159.4 zk40ms_ub_b10200 40.6299 10200.0 FUNCTION_LIST UFRLC IF_DATA DIM_X DIRECT 0x81406A /end CHARACTERISTIC
/begin CHARACTERISTIC RLIPTV_UM "Verzugszeit für Lastinformation rlip_um in der Funktionsüberwachung" VALUE 0x81406B KwUb 320.000 t40ms_ub_b10200 0.00 320.000 FUNCTION_LIST UFRLC IF_DATA DIM_X DIRECT 0x81406B /end CHARACTERISTIC
/begin CHARACTERISTIC RLIP_T_UM "Fehlertoleranzzeit für den rl/rlip-Vergleich in der Funktionsüberwachg" VALUE 0x81406C KwUb 10200.0 t40ms_ub_b10200 0.00 10200.0 FUNCTION_LIST UFRLC IF_DATA DIM_X DIRECT 0x81406C /end CHARACTERISTIC
/begin CHARACTERISTIC RLKRLDA "Rl-Schwelle für langsamen LDR-Eingriff (Adaption)" CURVE 0x819DB3 GklWUb 191.3 rel_ub_q0p75 0.00 191.3 FUNCTION_LIST LDRLMX IF_DATA DIM_X DIRECT 0x819DB3
 /begin AXIS_DESCR COM_AXIS nmot nmot_ub_q40 8 0.00 10200. AXIS_PTS_REF SNM08LDUB /end AXIS_DESCR
/end CHARACTERISTIC
/begin CHARACTERISTIC RLLAMMN "RL-min Schwelle zur Anfettung wegen Brennbarkeit" CURVE 0x8192F4 GklWUb 191.3 rel_ub_q0p75 0.00 191.3 FUNCTION_LIST LAMFAW IF_DATA DIM_X DIRECT 0x8192F4
 /begin AXIS_DESCR COM_AXIS nmot nmot_ub_q40 7 0.00 10200. AXIS_PTS_REF SNM07ESUB /end AXIS_DESCR
/end CHARACTERISTIC
/begin CHARACTERISTIC RLLDPMX "Maximale Last bei Diagnose" VALUE 0x812785 KwUb 191.3 rel_ub_q0p75 0.00 191.3 FUNCTION_LIST DLDP IF_DATA DIM_X DIRECT 0x812785 /end CHARACTERISTIC
/begin CHARACTERISTIC RLLRHON "Kennlinie über nmot, obere rL Regelgrenze für Regler hinter KAT" CURVE 0x812739 GklWUb 191.3 rel_ub_q0p75 0.00 191.3 FUNCTION_LIST LRSHK IF_DATA DIM_X DIRECT 0x812739
 /begin AXIS_DESCR COM_AXIS nmot nmot_ub_q40 8 0.00 10200. AXIS_PTS_REF SNM08LHUB /end AXIS_DESCR
/end CHARACTERISTIC
/begin CHARACTERISTIC RLLRHUFA "rL Regelgrenze für Regler hinter KAT bei Funktionsanforderung B_fakat" VALUE 0x812741 KwUb 191.3 rel_ub_q0p75 0.00 191.3 FUNCTION_LIST LRSHK IF_DATA DIM_X DIRECT 0x812741 /end CHARACTERISTIC
/begin CHARACTERISTIC RLLRHUN "Kennlinie über nmot, untere rL Regelgrenze für Regler hinter KAT" CURVE 0x812742 GklWUb 191.3 rel_ub_q0p75 0.00 191.3 FUNCTION_LIST LRSHK IF_DATA DIM_X DIRECT 0x812742
 /begin AXIS_DESCR COM_AXIS nmot nmot_ub_q40 8 0.00 10200. AXIS_PTS_REF SNM08LHUB /end AXIS_DESCR
/end CHARACTERISTIC
/begin CHARACTERISTIC RLLRSHB "relative Lastschwelle, Abschalten LR bei SLS, in Verbindung mit LL und NLRSHB" VALUE 0x8126F2 KwUb 191.3 rel_ub_q0p75 0.00 191.3 FUNCTION_LIST LRSEB IF_DATA DIM_X DIRECT 0x8126F2 /end CHARACTERISTIC
/begin CHARACTERISTIC RLLRUN "Kennlinie über nmot, untere rL Regelgrenze für Regler vor KAT" CURVE 0x8126F3 KlAUbSstUbWUb 191.3 rel_ub_q0p75 0.00 191.3 FUNCTION_LIST LRSEB IF_DATA DIM_X DIRECT 0x8126F3 /begin AXIS_DESCR STD_AXIS nmot nmot_ub_q40 8 0.00 10200. DEPOSIT ABSOLUT /end AXIS_DESCR /end CHARACTERISTIC
/begin CHARACTERISTIC RLNOT "Notlauf rl bei E_DK und E_LM" CURVE 0x81D5CA KlAUbSstUbWUw 1535.977 rel_uw_q0p0234 0.00 1535.977 FUNCTION_LIST BGMSZS IF_DATA DIM_X DIRECT 0x81D5CA /begin AXIS_DESCR STD_AXIS nmot nmot_ub_q40 6 0.00 10200. DEPOSIT ABSOLUT /end AXIS_DESCR /end CHARACTERISTIC
/begin CHARACTERISTIC RLO2 "obere Lastschwelle Bereich 2" VALUE 0x81905D KwUb 191.3 rel_ub_q0p75 0.00 191.3 FUNCTION_LIST LRA IF_DATA DIM_X DIRECT 0x81905D /end CHARACTERISTIC
/begin CHARACTERISTIC RLO3 "obere rl - Schwelle Bereich 3" VALUE 0x81905E KwUb 191.3 rel_ub_q0p75 0.00 191.3 FUNCTION_LIST LRA IF_DATA DIM_X DIRECT 0x81905E /end CHARACTERISTIC
/begin CHARACTERISTIC RLO3AC "obere rl - Schwelle Bereich 3 mit kompressor" VALUE 0x81905F KwUb 191.3 rel_ub_q0p75 0.00 191.3 FUNCTION_LIST LRA IF_DATA DIM_X DIRECT 0x81905F /end CHARACTERISTIC
/begin CHARACTERISTIC RLPHERKMN "minimale Last für Phasensuche" VALUE 0x810FBC KwUb 191.3 rel_ub_q0p75 0.00 191.3 FUNCTION_LIST NLPH IF_DATA DIM_X DIRECT 0x810FBC /end CHARACTERISTIC
/begin CHARACTERISTIC RLPHERKMX "maximale Last für Phasensuche" VALUE 0x810FBD KwUb 191.3 rel_ub_q0p75 0.00 191.3 FUNCTION_LIST NLPH IF_DATA DIM_X DIRECT 0x810FBD /end CHARACTERISTIC
/begin CHARACTERISTIC RLSALUNG_0_A "Lastschwelle zur Schuberkennung für Ausblendung der Aussetzererkennung" MAP 0x810729 GkfWUb 191.3 rel_ub_q0p75 0.00 191.3 FUNCTION_LIST DMDSTP IF_DATA DIM_X INDIRECT 0x8173DC /begin AXIS_DESCR COM_AXIS gangi dez 8 0.00 255.0 AXIS_PTS_REF SGA08MDUB /end AXIS_DESCR
 /begin AXIS_DESCR COM_AXIS nmot nmot_ub_q40 8 0.00 10200. AXIS_PTS_REF SNM08DMUB /end AXIS_DESCR
/end CHARACTERISTIC
/begin CHARACTERISTIC RLSALUNG_1_A "Lastschwelle zur Schuberkennung für Ausblendung der Aussetzererkennung" MAP 0x810769 GkfWUb 191.3 rel_ub_q0p75 0.00 191.3 FUNCTION_LIST DMDSTP IF_DATA DIM_X INDIRECT 0x8173DE /begin AXIS_DESCR COM_AXIS gangi dez 8 0.00 255.0 AXIS_PTS_REF SGA08MDUB /end AXIS_DESCR
 /begin AXIS_DESCR COM_AXIS nmot nmot_ub_q40 8 0.00 10200. AXIS_PTS_REF SNM08DMUB /end AXIS_DESCR
/end CHARACTERISTIC
/begin CHARACTERISTIC RLSLSMN "min. rl für Freigabe Regelung während Sekundärluft" CURVE 0x812704 KlAUbSstUbWUb 191.3 rel_ub_q0p75 0.00 191.3 FUNCTION_LIST LRSEB IF_DATA DIM_X DIRECT 0x812704 /begin AXIS_DESCR STD_AXIS nmot nmot_ub_q40 4 0.00 10200. DEPOSIT ABSOLUT /end AXIS_DESCR /end CHARACTERISTIC
/begin CHARACTERISTIC RLU2 "untere rl - Schwelle Bereich 2" VALUE 0x819060 KwUb 191.3 rel_ub_q0p75 0.00 191.3 FUNCTION_LIST LRA IF_DATA DIM_X DIRECT 0x819060 /end CHARACTERISTIC
/begin CHARACTERISTIC RLU2AC "untere rl - Schwelle Bereich 2 mit Kompressor" VALUE 0x819061 KwUb 191.3 rel_ub_q0p75 0.00 191.3 FUNCTION_LIST LRA IF_DATA DIM_X DIRECT 0x819061 /end CHARACTERISTIC
/begin CHARACTERISTIC RLU3 "untere rl - Schwelle Bereich 3" VALUE 0x819062 KwUb 191.3 rel_ub_q0p75 0.00 191.3 FUNCTION_LIST LRA IF_DATA DIM_X DIRECT 0x819062 /end CHARACTERISTIC
/begin CHARACTERISTIC RLU4 "untere rl -Schwelle oberer multiplikativer Bereich" VALUE 0x819063 KwUb 191.3 rel_ub_q0p75 0.00 191.3 FUNCTION_LIST LRA IF_DATA DIM_X DIRECT 0x819063 /end CHARACTERISTIC
/begin CHARACTERISTIC RLU4AC "untere rl -Schwelle oberer multiplikativer Bereich mit Kompressor" VALUE 0x819064 KwUb 191.3 rel_ub_q0p75 0.00 191.3 FUNCTION_LIST LRA IF_DATA DIM_X DIRECT 0x819064 /end CHARACTERISTIC
/begin CHARACTERISTIC RLUKAO "obere Lastgrenze für ÜK-Adaption" VALUE 0x811BF4 KwUb 191.3 rel_ub_q0p75 0.00 191.3 FUNCTION_LIST ESUKAS IF_DATA DIM_X DIRECT 0x811BF4 /end CHARACTERISTIC
/begin CHARACTERISTIC RLUKAU "untere Lastgrenze für ÜK-Adaption" VALUE 0x811BF5 KwUb 191.3 rel_ub_q0p75 0.00 191.3 FUNCTION_LIST ESUKAS IF_DATA DIM_X DIRECT 0x811BF5 /end CHARACTERISTIC
/begin CHARACTERISTIC RLX_AOG "oberer Grenzwert Anpassung maximaler Ladedruck" VALUE 0x811C64 KwUb 0.9961 fak_ub_b1 0.00 0.9961 FUNCTION_LIST TKMWL KRACT IF_DATA DIM_X DIRECT 0x811C64 /end CHARACTERISTIC
/begin CHARACTERISTIC RLX_AUG "unterer Grenzwert Anpassung maximaler Ladedruck" VALUE 0x811C65 KwUb 0.9961 fak_ub_b1 0.00 0.9961 FUNCTION_LIST TKMWL KRACT IF_DATA DIM_X DIRECT 0x811C65 /end CHARACTERISTIC
/begin CHARACTERISTIC RL_BO_UM "Offset für Toleranzgerade f(rl_um) für rlipf_um in der Funktionsüberwachung" VALUE 0x81406D KwUb 191.3 rel_ub_q0p75 0.00 191.3 FUNCTION_LIST UFRLC IF_DATA DIM_X DIRECT 0x81406D /end CHARACTERISTIC
/begin CHARACTERISTIC RL_DAT_UC "" VAL_BLK 0x812473 KwbUb 191.3 rel_ub_q0p75 0.00 191.3 NUMBER 16 FUNCTION_LIST URCEIN IF_DATA DIM_X DIRECT 0x812473 /end CHARACTERISTIC
/begin CHARACTERISTIC RL_MO_UM "Steigung für Toleranzgerade f(rl_um) für rlipf_um in der Funktionsüberwachung" VALUE 0x81406E KwUb 255.0 dez 0.00 255.0 FUNCTION_LIST UFRLC IF_DATA DIM_X DIRECT 0x81406E /end CHARACTERISTIC
/begin CHARACTERISTIC RMSLMN "Diagnoseschwelle: verringerte Sekundärluftmasse (Fehlerhaft)" VALUE 0x81836C KwUb 1.992 fak_ub_b2 0.00 1.992 FUNCTION_LIST DSLSLRS IF_DATA DIM_X DIRECT 0x81836C /end CHARACTERISTIC
/begin CHARACTERISTIC RMSLMNK "Diagnoseschwelle Bandendetest: verringerte Sekundärluftmasse" VALUE 0x81836D KwUb 1.992 fak_ub_b2 0.00 1.992 FUNCTION_LIST DSLSLRS IF_DATA DIM_X DIRECT 0x81836D /end CHARACTERISTIC
/begin CHARACTERISTIC RMSLMNST "Diagnoseschwelle: verringerte Sekundärluftmasse für gefilterten rmslf" VALUE 0x81836E KwUb 1.992 fak_ub_b2 0.00 1.992 FUNCTION_LIST DSLSLRS IF_DATA DIM_X DIRECT 0x81836E /end CHARACTERISTIC
/begin CHARACTERISTIC RMSLMXST "Diagnoseschwelle: verringerte Sekundärluftmasse," VALUE 0x81836F KwUb 1.992 fak_ub_b2 0.00 1.992 FUNCTION_LIST DSLSLRS IF_DATA DIM_X DIRECT 0x81836F /end CHARACTERISTIC
/begin CHARACTERISTIC RMSLPMN "Diagnoseschwelle: Fehler Sekundärluftpumpe, nur Pulse Air" VALUE 0x818370 KwUb 1.992 fak_ub_b2 0.00 1.992 FUNCTION_LIST DSLSLRS IF_DATA DIM_X DIRECT 0x818370 /end CHARACTERISTIC
/begin CHARACTERISTIC RMSLTMN "Schwelle: sehr geringe Sekundärluftmasse, ohne Offset" VALUE 0x818371 KwUb 1.992 fak_ub_b2 0.00 1.992 FUNCTION_LIST DSLSLRS IF_DATA DIM_X DIRECT 0x818371 /end CHARACTERISTIC
/begin CHARACTERISTIC RMSTEVIO "Schwelle relativer Massenstrom für i.O. Erkennung" VALUE 0x829D22 KwUw 199.9969 rel_uw_b200 0.00 199.9969 FUNCTION_LIST DTEV IF_DATA DIM_X DIRECT 0x829D22 /end CHARACTERISTIC
/begin CHARACTERISTIC RMSTEVMN "Minimalwert relativer Massenstrom TEV" VALUE 0x829D24 KwSw 399.9939 rel_sw_b200 -200.0000 199.9939 FUNCTION_LIST DTEV IF_DATA DIM_X DIRECT 0x829D24 /end CHARACTERISTIC
/begin CHARACTERISTIC RMSTEVMX "Maximalwert relativer Massenstrom TEV" VALUE 0x829D26 KwSw 399.9939 rel_sw_b200 -200.0000 199.9939 FUNCTION_LIST DTEV IF_DATA DIM_X DIRECT 0x829D26 /end CHARACTERISTIC
/begin CHARACTERISTIC ROMRSTA_UM "maximale Anzahl Resets bei Fehlererkennung im ROM-Check in der Initialisierung" VALUE 0x814217 KwUb 255.0 dez 0.00 255.0 FUNCTION_LIST URROM IF_DATA DIM_X DIRECT 0x814217 /end CHARACTERISTIC
/begin CHARACTERISTIC SAFK1 "Filterkonstante 1 für Lambdasonden-Signalausgabe" VALUE 0x81DCCC KwUw 0.9999847 fak_uw_b1 0.00 0.9999847 FUNCTION_LIST DLSSA IF_DATA DIM_X DIRECT 0x81DCCC /end CHARACTERISTIC
/begin CHARACTERISTIC SALUNKH_0_A "dmrkh-abh. Nullastfaktoren bei Katheizen" CURVE 0x810265 KlAUbSstUbWUb 1.992 fak_ub_b2 0.00 1.992 FUNCTION_LIST DMDSTP_C IF_DATA DIM_X INDIRECT 0x81374A /begin AXIS_DESCR STD_AXIS dmrkh rel_ub_b99p6 4 0.00 99.61 DEPOSIT ABSOLUT /end AXIS_DESCR /end CHARACTERISTIC
/begin CHARACTERISTIC SALUNKH_1_A "dmrkh-abh. Nullastfaktoren bei Katheizen" CURVE 0x81026E KlAUbSstUbWUb 1.992 fak_ub_b2 0.00 1.992 FUNCTION_LIST DMDSTP_C IF_DATA DIM_X INDIRECT 0x81374C /begin AXIS_DESCR STD_AXIS dmrkh rel_ub_b99p6 4 0.00 99.61 DEPOSIT ABSOLUT /end AXIS_DESCR /end CHARACTERISTIC
/begin CHARACTERISTIC SDLAOF "Schwelle delta Lambda Offset Regler hinter Kat" VALUE 0x81C794 KwSw 1.999969 fak_sw_b1 -1.000000 0.9999695 FUNCTION_LIST DLSU IF_DATA DIM_X DIRECT 0x81C794 /end CHARACTERISTIC
/begin CHARACTERISTIC SDLDRAH "rl-Schwelle fuer DLDR zum Heilen von LDRA im i.O. Fall" VALUE 0x819E53 KwUb 191.3 rel_ub_q0p75 0.00 191.3 FUNCTION_LIST DLDR IF_DATA DIM_X DIRECT 0x819E53 /end CHARACTERISTIC
/begin CHARACTERISTIC SDLDRAS "rl-Schwelle fuer DLDR zum Setzen von LDRA im Fehlerfall" VALUE 0x819E54 KwUb 191.3 rel_ub_q0p75 0.00 191.3 FUNCTION_LIST DLDR IF_DATA DIM_X DIRECT 0x819E54 /end CHARACTERISTIC
/begin CHARACTERISTIC SDLDRL "Mindestfuellung LDR fuer DIA LDR maximal zulaessiger Druck" VALUE 0x819E55 KwUb 191.3 rel_ub_q0p75 0.00 191.3 FUNCTION_LIST DLDR IF_DATA DIM_X DIRECT 0x819E55 /end CHARACTERISTIC
/begin CHARACTERISTIC SDLDSUA "Schwelle für dynamische Schubumluftventilsteuerung aktiv" CURVE 0x816354 FklWUw 2559.961 p_uw_q0p039 0.00 2559.961 FUNCTION_LIST LDUVST IF_DATA DIM_X DIRECT 0x816354
 /begin AXIS_DESCR FIX_AXIS plmaxa_w p_uw_q0p039 16 0.00 2559.961 FIX_AXIS_PAR 0 12 16 /end AXIS_DESCR
/end CHARACTERISTIC
/begin AXIS_PTS SDZ08DMUB "SST-Verteilung in DMD, 8 Drehzahl-SST" 0x810234 nmot SstAUbSstUb 10200. nmot_ub_q40 8 0.00 10200. FUNCTION_LIST DMDFON DEPOSIT ABSOLUT IF_DATA DIM_X DIRECT 0x810234 /end AXIS_PTS
/begin AXIS_PTS SDZ08DMUB2 "SST-Verteilung in DMD, 8 Drehzahl-SST" 0x81023D nmot SstAUbSstUb 10200. nmot_ub_q40 8 0.00 10200. FUNCTION_LIST DMDFON DEPOSIT ABSOLUT IF_DATA DIM_X DIRECT 0x81023D /end AXIS_PTS
/begin AXIS_PTS SDZ08DMUB3 "SST-Verteilung in DMD, 8 Drehzahl-SST" 0x810246 nmot SstAUbSstUb 10200. nmot_ub_q40 8 0.00 10200. FUNCTION_LIST DMDFON DEPOSIT ABSOLUT IF_DATA DIM_X DIRECT 0x810246 /end AXIS_PTS
/begin CHARACTERISTIC SENZZYL0 "Klopfsensor für SW-Zylinderzähler 0" VALUE 0x8198EF KwUb 3.000 dezsub1 1.000 4.000 FUNCTION_LIST GGKS KRRA IF_DATA DIM_X DIRECT 0x8198EF /end CHARACTERISTIC
/begin CHARACTERISTIC SENZZYL1 "Klopfsensor für SW-Zylinderzähler 1" VALUE 0x8198F0 KwUb 3.000 dezsub1 1.000 4.000 FUNCTION_LIST GGKS IF_DATA DIM_X DIRECT 0x8198F0 /end CHARACTERISTIC
/begin CHARACTERISTIC SENZZYL2 "Klopfsensor für SW-Zylinderzähler 2" VALUE 0x8198F1 KwUb 3.000 dezsub1 1.000 4.000 FUNCTION_LIST GGKS IF_DATA DIM_X DIRECT 0x8198F1 /end CHARACTERISTIC
/begin CHARACTERISTIC SENZZYL3 "Klopfsensor für SW-Zylinderzähler 3" VALUE 0x8198F2 KwUb 3.000 dezsub1 1.000 4.000 FUNCTION_LIST GGKS IF_DATA DIM_X DIRECT 0x8198F2 /end CHARACTERISTIC
/begin CHARACTERISTIC SENZZYL4 "Klopfsensor für SW-Zylinderzähler 4" VALUE 0x8198F3 KwUb 3.000 dezsub1 1.000 4.000 FUNCTION_LIST GGKS IF_DATA DIM_X DIRECT 0x8198F3 /end CHARACTERISTIC
/begin CHARACTERISTIC SENZZYL5 "Klopfsensor für SW-Zylinderzähler 5" VALUE 0x8198F4 KwUb 3.000 dezsub1 1.000 4.000 FUNCTION_LIST GGKS IF_DATA DIM_X DIRECT 0x8198F4 /end CHARACTERISTIC
/begin CHARACTERISTIC SENZZYL6 "Klopfsensor für SW-Zylinderzähler 6" VALUE 0x8198F5 KwUb 3.000 dezsub1 1.000 4.000 FUNCTION_LIST GGKS IF_DATA DIM_X DIRECT 0x8198F5 /end CHARACTERISTIC
/begin CHARACTERISTIC SENZZYL7 "Klopfsensor für SW-Zylinderzähler 7" VALUE 0x8198F6 KwUb 3.000 dezsub1 1.000 4.000 FUNCTION_LIST GGKS IF_DATA DIM_X DIRECT 0x8198F6 /end CHARACTERISTIC
/begin CHARACTERISTIC SFLAGS_D_UC "" VAL_BLK 0x812483 KwbUb 255.0 dez 0.00 255.0 NUMBER 16 FUNCTION_LIST URCEIN IF_DATA DIM_X DIRECT 0x812483 /end CHARACTERISTIC
/begin CHARACTERISTIC SFONTM "Schwellwert tmot für fuel-on Adaption aktiv" VALUE 0x81020B KwUb 191.3 temp_ub_q0p75_o48 -48.00 143.3 FUNCTION_LIST DMDFON IF_DATA DIM_X DIRECT 0x81020B /end CHARACTERISTIC
/begin AXIS_PTS SGA08LLUB "Stützstellenverteilung für Ganginformation in Leerlaufregelung" 0x81A068 gangllr SstAUbSstUb 255.0 dez 8 0.00 255.0 FUNCTION_LIST LLRNS DEPOSIT ABSOLUT IF_DATA DIM_X DIRECT 0x81A068 /end AXIS_PTS
/begin AXIS_PTS SGA08MDUB "Stützstellenverteilung Ist Gang 8 Sst." 0x810060 gangi SstAUbSstUb 255.0 dez 8 0.00 255.0 FUNCTION_LIST SSTB BBSAWE DMDSTP MDFAW NMAXMD DEPOSIT ABSOLUT IF_DATA DIM_X DIRECT 0x810060 /end AXIS_PTS
/begin CHARACTERISTIC SGIDB1 "BOSCH-Hardwarenummer" ASCII 0x811C66 KwbUb 255.0 KennText 0.00 255.0 NUMBER 12 FUNCTION_LIST TKMWL K71SR KDIAG TC9MOD IF_DATA DIM_X DIRECT 0x811C66 /end CHARACTERISTIC
/begin CHARACTERISTIC SGIDB2 "BOSCH-Softwarenummer" ASCII 0x811C72 KwbUb 255.0 KennText 0.00 255.0 NUMBER 20 FUNCTION_LIST TKMWL K71SR KDIAG IF_DATA DIM_X DIRECT 0x811C72 /end CHARACTERISTIC
/begin CHARACTERISTIC SGIDB3 "Kunden-Teilenummer" ASCII 0x811C86 KwbUb 255.0 KennText 0.00 255.0 NUMBER 4 FUNCTION_LIST TKMWL K71SR KDIAG TC9MOD IF_DATA DIM_X DIRECT 0x811C86 /end CHARACTERISTIC
/begin CHARACTERISTIC SGIDB4 "Fertigungsdatum" ASCII 0x81839C KwbUb 255.0 KennText 0.00 255.0 NUMBER 10 FUNCTION_LIST KDIAG IF_DATA DIM_X DIRECT 0x81839C /end CHARACTERISTIC
/begin CHARACTERISTIC SGIDB5 "BOSCH-Software-Teilenummer = Typ-Teile-Nummer des Master EPROMs" ASCII 0x8183A6 KwbUb 255.0 KennText 0.00 255.0 NUMBER 10 FUNCTION_LIST KDIAG TUNING IF_DATA DIM_X DIRECT 0x8183A6 /end CHARACTERISTIC
/begin CHARACTERISTIC SGIDB6 "Nummer Teilsoftware" ASCII 0x8183B0 KtxC 255.0 defaultAscii 0.00 255.0 FUNCTION_LIST KDIAG NUMBER 7 IF_DATA DIM_X DIRECT 0x8183B0 /end CHARACTERISTIC
/begin CHARACTERISTIC SGIDB7 "Hardware Teilenummer" ASCII 0x8183B8 KtxC 255.0 defaultAscii 0.00 255.0 FUNCTION_LIST KDIAG OBPC_71 NUMBER 11 IF_DATA DIM_X DIRECT 0x8183B8 /end CHARACTERISTIC
/begin CHARACTERISTIC SGIDB8 "Baugruppe Hardware" ASCII 0x81A44F KtxC 255.0 defaultAscii 0.00 255.0 FUNCTION_LIST OBPC_71 NUMBER 3 IF_DATA DIM_X DIRECT 0x81A44F /end CHARACTERISTIC
/begin CHARACTERISTIC SGIDB9 "Sorte Hardware" ASCII 0x81A453 KtxC 255.0 defaultAscii 0.00 255.0 FUNCTION_LIST OBPC_71 NUMBER 2 IF_DATA DIM_X DIRECT 0x81A453 /end CHARACTERISTIC
/begin CHARACTERISTIC SGIDK1_DAT "Diagnose-Nummer" ASCII 0x8183C4 KtxC 255.0 defaultAscii 0.00 255.0 FUNCTION_LIST KDIAG NUMBER 5 IF_DATA DIM_X DIRECT 0x8183C4 /end CHARACTERISTIC
/begin CHARACTERISTIC SGSC_D_UC "" VAL_BLK 0x812493 KwbUb 255.0 dez 0.00 255.0 NUMBER 16 FUNCTION_LIST URCEIN IF_DATA DIM_X DIRECT 0x812493 /end CHARACTERISTIC
/begin CHARACTERISTIC SKA_DRHZ_UC "" VALUE 0x81267E KwUb 10200. nmot_ub_q40 0.00 10200. FUNCTION_LIST URCREAC IF_DATA DIM_X DIRECT 0x81267E /end CHARACTERISTIC
/begin CHARACTERISTIC SKA_DRHZ_UM "" VALUE 0x81420E KwUb 10200. nmot_ub_q40 0.00 10200. FUNCTION_LIST UFREAC IF_DATA DIM_X DIRECT 0x81420E /end CHARACTERISTIC
/begin CHARACTERISTIC SLFOO2N "Obere Schwelle (Schwellwert-KL) für Lernfilterwert bei fuel-on/-off Adaption" CURVE 0x81020C GklWUb 1.401 dtsegn_b720divZyl 0.00 1.401 FUNCTION_LIST DMDFON IF_DATA DIM_X DIRECT 0x81020C
 /begin AXIS_DESCR COM_AXIS nmot nmot_ub_q40 8 0.00 10200. AXIS_PTS_REF SDZ08DMUB2 /end AXIS_DESCR
/end CHARACTERISTIC
/begin CHARACTERISTIC SLFOO3N "Obere Schwelle (Schwellwert-KL) für Lernfilterwert bei fuel-on/-off Adaption" CURVE 0x810214 GklWUb 1.401 dtsegn_b720divZyl 0.00 1.401 FUNCTION_LIST DMDFON IF_DATA DIM_X DIRECT 0x810214
 /begin AXIS_DESCR COM_AXIS nmot nmot_ub_q40 8 0.00 10200. AXIS_PTS_REF SDZ08DMUB3 /end AXIS_DESCR
/end CHARACTERISTIC
/begin CHARACTERISTIC SLFOON "Obere Schwelle (Schwellwert-KL) für Lernfilterwert bei fuel-on/-off Adaption" CURVE 0x81021C GklWUb 1.401 dtsegn_b720divZyl 0.00 1.401 FUNCTION_LIST DMDFON IF_DATA DIM_X DIRECT 0x81021C
 /begin AXIS_DESCR COM_AXIS nmot nmot_ub_q40 8 0.00 10200. AXIS_PTS_REF SDZ08DMUB /end AXIS_DESCR
/end CHARACTERISTIC
/begin CHARACTERISTIC SLFOU "Untere Schwelle für Lernfilterwert bei fuel-on/-off Adaption" VALUE 0x813D3E KwSw 179.9945 dtsegn_b720divZyl 0.00 179.9945 FUNCTION_LIST DMDFON IF_DATA DIM_X DIRECT 0x813D3E /end CHARACTERISTIC
/begin CHARACTERISTIC SLOGIN "Login-Code für Entwicklung" VALUE 0x8161C4 KwUw 65535.00 dez 0.00 65535.00 FUNCTION_LIST TKMWL K71SR KDIAG KWPDATR IF_DATA DIM_X DIRECT 0x8161C4 /end CHARACTERISTIC
/begin AXIS_PTS SNM07ESUB "Stützstellenverteilung Drehzahl, 7 Sst." 0x818200 nmot SstAUbSstUb 10200. nmot_ub_q40 7 0.00 10200. FUNCTION_LIST SSTB ESUK LAMFAW DEPOSIT ABSOLUT IF_DATA DIM_X DIRECT 0x818200 /end AXIS_PTS
/begin AXIS_PTS SNM08DMUB "SST-Verteilung in DMD, 8 Drehzahl-SST" 0x81007C nmot SstAUbSstUb 10200. nmot_ub_q40 8 0.00 10200. FUNCTION_LIST SSTB DMDDLU DMDLU DMDLUA DMDMIL DMDSTP DEPOSIT ABSOLUT IF_DATA DIM_X DIRECT 0x81007C /end AXIS_PTS
/begin AXIS_PTS SNM08KOUB "Stützstellenverteilung für Klimakompressorsteuerung  8  nmot" 0x812D9A nmot SstAUbSstUb 10200. nmot_ub_q40 8 0.00 10200. FUNCTION_LIST KOS DEPOSIT ABSOLUT IF_DATA DIM_X DIRECT 0x812D9A /end AXIS_PTS
/begin AXIS_PTS SNM08LDUB "Stützstellenverteilung für Ladedruckregelung" 0x810085 nmot SstAUbSstUb 10200. nmot_ub_q40 8 0.00 10200. FUNCTION_LIST SSTB LDOB LDRLMX LDRPID DEPOSIT ABSOLUT IF_DATA DIM_X DIRECT 0x810085 /end AXIS_PTS
/begin AXIS_PTS SNM08LDUW "Stützstellenverteilung für Ladedruckregelung" 0x813A8A nmot_w SstAUwSstUw 16383.75 nmot_uw_q0p25 8 0.00 16383.75 FUNCTION_LIST SSTB BGPLGU LDRLMX LDRPID DEPOSIT ABSOLUT IF_DATA DIM_X DIRECT 0x813A8A /end AXIS_PTS
/begin AXIS_PTS SNM08LHUB "nmot abhängige Stützstellen (Anzahl 8)" 0x818211 nmot SstAUbSstUb 10200. nmot_ub_q40 8 0.00 10200. FUNCTION_LIST SSTB LRSHK DEPOSIT ABSOLUT IF_DATA DIM_X DIRECT 0x818211 /end AXIS_PTS
/begin AXIS_PTS SNM16KRUB "Stützstellenverteilung Drehzahl, 16 Sst." 0x818250 nmot SstAUbSstUb 10200. nmot_ub_q40 16 0.00 10200. FUNCTION_LIST SSTB DKRS GGKS KRDY KRKE KRRA DEPOSIT ABSOLUT IF_DATA DIM_X DIRECT 0x818250 /end AXIS_PTS
/begin CHARACTERISTIC SP12LL_UM "maximale Differenz zwischen SP1S und SP2S unterhalb der Vollgas-Schwelle" VALUE 0x81406F KwUb 4.9805 spg_ub_q0p019 0.00 4.9805 FUNCTION_LIST UFSPSC IF_DATA DIM_X DIRECT 0x81406F /end CHARACTERISTIC
/begin CHARACTERISTIC SP12VG_UM "maximale Differenz zwischen SP1S und SP2S oberhalb der Vollgas-Schwelle" VALUE 0x814070 KwUb 4.9805 spg_ub_q0p019 0.00 4.9805 FUNCTION_LIST UFSPSC IF_DATA DIM_X DIRECT 0x814070 /end CHARACTERISTIC
/begin CHARACTERISTIC SP1ADC_DIF "max. Diff. zw. Sollwertpoti1 & Sollwertpoti1 vom Überw.Modul im stationären Fall" VALUE 0x814210 KwUb 4.9805 spg_ub_q0p019 0.00 4.9805 FUNCTION_LIST URADCC IF_DATA DIM_X DIRECT 0x814210 /end CHARACTERISTIC
/begin CHARACTERISTIC SP1_STAT "Bandbreite für die Erkennung auf sp1s stationär" VALUE 0x814211 KwUb 4.9805 spg_ub_q0p019 0.00 4.9805 FUNCTION_LIST URADCC IF_DATA DIM_X DIRECT 0x814211 /end CHARACTERISTIC
/begin CHARACTERISTIC SP1_STAT_T "Zeit für die Erkennung auf sp1s stationär" VALUE 0x814212 KwUb 2.550 t10msxs_ub_b2p55 0.00 2.550 FUNCTION_LIST URADCC IF_DATA DIM_X DIRECT 0x814212 /end CHARACTERISTIC
/begin CHARACTERISTIC SPSC_MINUC "" VALUE 0x8124A3 KwUb 4.9805 spg_ub_q0p019 0.00 4.9805 FUNCTION_LIST URCEIN IF_DATA DIM_X DIRECT 0x8124A3 /end CHARACTERISTIC
/begin CHARACTERISTIC SPSC_MIN_UM "" VALUE 0x814071 KwUb 4.9805 spg_ub_q0p019 0.00 4.9805 FUNCTION_LIST UFSPSC IF_DATA DIM_X DIRECT 0x814071 /end CHARACTERISTIC
/begin CHARACTERISTIC SPSC_T_UM "Fehlerzeit bei zueinander unplausiblen Sollwerten in der Funktionsüberwachung" VALUE 0x814072 KwUb 10200.0 t40ms_ub_b10200 0.00 10200.0 FUNCTION_LIST UFSPSC IF_DATA DIM_X DIRECT 0x814072 /end CHARACTERISTIC
/begin CHARACTERISTIC SPSN_DAT_UC "" VAL_BLK 0x8124A4 KwbUb 4.9805 spg_ub_q0p019 0.00 4.9805 NUMBER 16 FUNCTION_LIST URCEIN IF_DATA DIM_X DIRECT 0x8124A4 /end CHARACTERISTIC
/begin CHARACTERISTIC SPSVG_UM "Vollgas-Sollwert-Schwelle zur Umschaltung der maximalen Differenz SP1S-SP2S" VALUE 0x814073 KwUb 4.9805 spg_ub_q0p019 0.00 4.9805 FUNCTION_LIST UFSPSC IF_DATA DIM_X DIRECT 0x814073 /end CHARACTERISTIC
/begin CHARACTERISTIC SRKTEVS "Saugrohrkonstante bei Schließen des Tankentlüftungsventil" VALUE 0x811DA7 KwUb 5.080 t20msxs_ub_b5p1 0.02000 5.100 FUNCTION_LIST LLRRM IF_DATA DIM_X DIRECT 0x811DA7 /end CHARACTERISTIC
/begin AXIS_PTS SRL08NXUB "Stützstellenverteilung relative Luftfüllung 8 Sst." 0x818278 rl SstAUbSstUb 191.3 rel_ub_q0p75 8 0.00 191.3 FUNCTION_LIST SSTB NMAXMD DEPOSIT ABSOLUT IF_DATA DIM_X DIRECT 0x818278 /end AXIS_PTS
/begin CHARACTERISTIC SRLLKH "Mindestfuellung zur Fehlerheilung Leck vor Drosselklappe" VALUE 0x819E56 KwUb 191.3 rel_ub_q0p75 0.00 191.3 FUNCTION_LIST DLDR IF_DATA DIM_X DIRECT 0x819E56 /end CHARACTERISTIC
/begin CHARACTERISTIC SRYAGR "Schwelle für Readiness-Bildung Abgasrückführungs-Diagnose" VALUE 0x818480 KwUb 255.0 dez 0.00 255.0 FUNCTION_LIST DIMCAGR IF_DATA DIM_X DIRECT 0x818480 /end CHARACTERISTIC
/begin CHARACTERISTIC SRYHS "Schwelle für Readiness-Bildung Sondenheizungs-Diagnose" VALUE 0x818481 KwUb 255.0 dez 0.00 255.0 FUNCTION_LIST DIMCHLS IF_DATA DIM_X DIRECT 0x818481 /end CHARACTERISTIC
/begin CHARACTERISTIC SRYKAT "Schwelle für Readiness-Bildung Katalysator-Diagnose" VALUE 0x818482 KwUb 255.0 dez 0.00 255.0 FUNCTION_LIST DIMCKAT IF_DATA DIM_X DIRECT 0x818482 /end CHARACTERISTIC
/begin CHARACTERISTIC SRYLS "Schwelle für Readiness-Bildung Lambdasonden-Diagnose" VALUE 0x818483 KwUb 255.0 dez 0.00 255.0 FUNCTION_LIST DIMCLSV IF_DATA DIM_X DIRECT 0x818483 /end CHARACTERISTIC
/begin CHARACTERISTIC SRYSLS "Schwelle für Readiness-Bildung Sekundärluft-Diagnose" VALUE 0x818484 KwUb 255.0 dez 0.00 255.0 FUNCTION_LIST DIMCSLS IF_DATA DIM_X DIRECT 0x818484 /end CHARACTERISTIC
/begin CHARACTERISTIC SRYTES "Schwelle für Readiness-Bildung Tankentlüftungs-Diagnose" VALUE 0x818485 KwUb 255.0 dez 0.00 255.0 FUNCTION_LIST DIMCTES IF_DATA DIM_X DIRECT 0x818485 /end CHARACTERISTIC
/begin CHARACTERISTIC STLDIA1 "Stützstelle1 für LDR Adaptionskennlinie" VALUE 0x819D42 KwUb 10200. nmot_ub_q40 0.00 10200. FUNCTION_LIST LDRPID IF_DATA DIM_X DIRECT 0x819D42 /end CHARACTERISTIC
/begin CHARACTERISTIC STLDIA2 "Stützstelle2 für LDR Adaptionskennlinie" VALUE 0x819D43 KwUb 10200. nmot_ub_q40 0.00 10200. FUNCTION_LIST LDRPID IF_DATA DIM_X DIRECT 0x819D43 /end CHARACTERISTIC
/begin CHARACTERISTIC STLDIA3 "Stützstelle3 für LDR Adaptionskennlinie" VALUE 0x819D44 KwUb 10200. nmot_ub_q40 0.00 10200. FUNCTION_LIST LDRPID IF_DATA DIM_X DIRECT 0x819D44 /end CHARACTERISTIC
/begin CHARACTERISTIC STLDIA4 "Stützstelle4 für LDR Adaptionskennlinie" VALUE 0x819D45 KwUb 10200. nmot_ub_q40 0.00 10200. FUNCTION_LIST LDRPID IF_DATA DIM_X DIRECT 0x819D45 /end CHARACTERISTIC
/begin AXIS_PTS STM05SAUB "Stützstellenverteilung" 0x81829D tmot SstAUbSstUb 191.3 temp_ub_q0p75_o48 5 -48.00 143.3 FUNCTION_LIST SSTB BBSAWE DEPOSIT ABSOLUT IF_DATA DIM_X DIRECT 0x81829D /end AXIS_PTS
/begin AXIS_PTS STM06LLUB "Stützstellenverteilung Motortemperatur, 6 Sst." 0x8182A9 tmot SstAUbSstUb 191.3 temp_ub_q0p75_o48 6 -48.00 143.3 FUNCTION_LIST SSTB LLRNS LLRRM DEPOSIT ABSOLUT IF_DATA DIM_X DIRECT 0x8182A9 /end AXIS_PTS
/begin AXIS_PTS STM09ESUB "Stützstellenverteilung Motortemperatur, 9 Sst." 0x8182C0 tmot SstAUbSstUb 191.3 temp_ub_q0p75_o48 9 -48.00 143.3 FUNCTION_LIST SSTB ESUK ESUKAS DEPOSIT ABSOLUT IF_DATA DIM_X DIRECT 0x8182C0 /end AXIS_PTS
/begin AXIS_PTS STS12ESUB "SST-Verteilung für Motorstarttemperatur" 0x810146 tmst SstAUbSstUb 191.3 temp_ub_q0p75_o48 12 -48.00 143.3 FUNCTION_LIST SSTB ESNSWL LANSWL DEPOSIT ABSOLUT IF_DATA DIM_X DIRECT 0x810146 /end AXIS_PTS
/begin CHARACTERISTIC SULSULUFT "Schwellwert für Plausibilitätsfehler LSU an Luft" VALUE 0x81C796 KwUw 319.9951 spg_uw_q0p00488 0.00 319.9951 FUNCTION_LIST DLSU IF_DATA DIM_X DIRECT 0x81C796 /end CHARACTERISTIC
/begin CHARACTERISTIC SULSUMX "Schwellwert für Plausibilitätsfehler CJ110" VALUE 0x81C798 KwUw 319.9951 spg_uw_q0p00488 0.00 319.9951 FUNCTION_LIST DLSU IF_DATA DIM_X DIRECT 0x81C798 /end CHARACTERISTIC
/begin AXIS_PTS SVF06D_UB "" 0x81A7F8 vfzg SstAUbSstUb 318.8 vfzg_ub_q1p25 6 0.00 318.8 FUNCTION_LIST DLDP DEPOSIT ABSOLUT IF_DATA DIM_X DIRECT 0x81A7F8 /end AXIS_PTS
/begin CHARACTERISTIC SZANSSM1_0_A "Absteuerungsfaktorumschaltschwelle 1 für Nachstartfaktor" CURVE 0x818F2A GklWUb 0.9961 fak_ub_b1 0.00 0.9961 FUNCTION_LIST ESNSWL IF_DATA DIM_X INDIRECT 0x813F92
 /begin AXIS_DESCR COM_AXIS tmst temp_ub_q0p75_o48 12 -48.00 143.3 AXIS_PTS_REF STS12ESUB /end AXIS_DESCR
/end CHARACTERISTIC
/begin CHARACTERISTIC SZANSSM1_1_A "Absteuerungsfaktorumschaltschwelle 1 für Nachstartfaktor" CURVE 0x818F36 GklWUb 0.9961 fak_ub_b1 0.00 0.9961 FUNCTION_LIST ESNSWL IF_DATA DIM_X INDIRECT 0x813F96
 /begin AXIS_DESCR COM_AXIS tmst temp_ub_q0p75_o48 12 -48.00 143.3 AXIS_PTS_REF STS12ESUB /end AXIS_DESCR
/end CHARACTERISTIC
/begin CHARACTERISTIC TABGBTS "Abgastemperaturschwelle für Bauteileschutz" VALUE 0x81E5D2 KwUw 1279.980 temp_uw_q0p0195_o50 -50.00000 1229.980 FUNCTION_LIST LAMBTS IF_DATA DIM_X DIRECT 0x81E5D2 /end CHARACTERISTIC
/begin CHARACTERISTIC TABGL "Zeit für LSU-Abgleich" VALUE 0x811021 KwUb 2.550 t10msxs_ub_b2p55 0.00 2.550 FUNCTION_LIST GGLSU IF_DATA DIM_X DIRECT 0x811021 /end CHARACTERISTIC
/begin CHARACTERISTIC TABGMEX "Abgastemperatur unterhalb der Kat-Anspringtemperatur" VALUE 0x818653 KwUb 1275. temp_ub_q5_o50 -50.00 1225. FUNCTION_LIST ATM IF_DATA DIM_X DIRECT 0x818653 /end CHARACTERISTIC
/begin CHARACTERISTIC TABGMHS "Abgastemperaturschwelle für die Sondenheizung LSU" VALUE 0x812684 KwUb 1275. temp_ub_q5_o50 -50.00 1225. FUNCTION_LIST HLSU IF_DATA DIM_X DIRECT 0x812684 /end CHARACTERISTIC
/begin CHARACTERISTIC TABGS "Zeit nach Start für LSU-Abgleich" VALUE 0x811022 KwUb 25.50 t100msxs_ub_b25p5 0.00 25.50 FUNCTION_LIST GGLSU IF_DATA DIM_X DIRECT 0x811022 /end CHARACTERISTIC
/begin CHARACTERISTIC TABLDOBN "Abregelzeit für LDR-Overboost" CURVE 0x819D88 GklWUb 12.7498039 zk50msxs_ub_b12p8 0.0501960784 12.8000000 FUNCTION_LIST LDOB IF_DATA DIM_X DIRECT 0x819D88
 /begin AXIS_DESCR COM_AXIS nmot nmot_ub_q40 8 0.00 10200. AXIS_PTS_REF SNM08LDUB /end AXIS_DESCR
/end CHARACTERISTIC
/begin CHARACTERISTIC TABSMADTM "Abstellzeit bis Abkühlung Motor für Diagnose TMOT" VALUE 0x81E970 KwUw 65535.00 t1sxs_uw_q1 0.00 65535.00 FUNCTION_LIST GGTFM IF_DATA DIM_X DIRECT 0x81E970 /end CHARACTERISTIC
/begin CHARACTERISTIC TABSTKH "Mindestabstellzeit für Freigabe Kat-Heizen" VALUE 0x81EDD0 KwUw 65535.00 t1sxs_uw_b65535 0.00 65535.00 FUNCTION_LIST BBKHZ IF_DATA DIM_X DIRECT 0x81EDD0 /end CHARACTERISTIC
/begin CHARACTERISTIC TADE "Ersatzgröße Lufttemperatur im Fehlerfall" VALUE 0x819718 KwUb 191.3 temp_ub_q0p75_o48 -48.00 143.3 FUNCTION_LIST GGTFA IF_DATA DIM_X DIRECT 0x819718 /end CHARACTERISTIC
/begin CHARACTERISTIC TADLLR "Ansauglufttemperaturschwelle für Diagnose Leerlaufsteller" VALUE 0x81A22B KwUb 191.3 temp_ub_q0p75_o48 -48.00 143.3 FUNCTION_LIST DLLR IF_DATA DIM_X DIRECT 0x81A22B /end CHARACTERISTIC
/begin CHARACTERISTIC TADMM "1. Stufenbreite (Zeit) für Motortemperaturmodell" VALUE 0x81E972 KwUw 6553.500 t100msxs_uw_b6553p5 0.00 6553.500 FUNCTION_LIST GGTFM IF_DATA DIM_X DIRECT 0x81E972 /end CHARACTERISTIC
/begin CHARACTERISTIC TADMN "Ansauglufttemperatur min." VALUE 0x819719 KwUb 191.3 temp_ub_q0p75_o48 -48.00 143.3 FUNCTION_LIST GGTFA IF_DATA DIM_X DIRECT 0x819719 /end CHARACTERISTIC
/begin CHARACTERISTIC TADMX "Ansauglufttemperatur max." VALUE 0x819725 KwUb 191.3 temp_ub_q0p75_o48 -48.00 143.3 FUNCTION_LIST GGTFA IF_DATA DIM_X DIRECT 0x819725 /end CHARACTERISTIC
/begin CHARACTERISTIC TADTEAMX "Kennlinie Max. tastverhältnis abhängig vom Integral Massenstrom TE nach TE Stop" CURVE 0x81A75C KlAUbSstUbWUb 99.61 rel_ub_b99p6 0.00 99.61 FUNCTION_LIST DTEV IF_DATA DIM_X DIRECT 0x81A75C
 /begin AXIS_DESCR STD_AXIS tdtesta t100msxs_ub_b25p5 14 0.00 25.50 DEPOSIT ABSOLUT /end AXIS_DESCR
/end CHARACTERISTIC
/begin CHARACTERISTIC TADTEMX "Tastverhältnisschwelle für aktive Prüfung" VALUE 0x81A779 KwUb 89.84 rel_ub_b99p6 9.766 99.61 FUNCTION_LIST DTEV IF_DATA DIM_X DIRECT 0x81A779 /end CHARACTERISTIC
/begin CHARACTERISTIC TAFFO "Obere tans-Schwelle für 0.5 mm - Diagnose" VALUE 0x81A7FF KwUb 191.3 temp_ub_q0p75_o48 -48.00 143.3 FUNCTION_LIST DLDP IF_DATA DIM_X DIRECT 0x81A7FF /end CHARACTERISTIC
/begin CHARACTERISTIC TAFLDPO "Obere TANS- Schwelle für Leckdiagnose bei Kurztrip" VALUE 0x81A800 KwUb 191.3 temp_ub_q0p75_o48 -48.00 143.3 FUNCTION_LIST DLDP IF_DATA DIM_X DIRECT 0x81A800 /end CHARACTERISTIC
/begin CHARACTERISTIC TAHLL "Ansauglufttemperaturschwelle für erhöhte Solldrehzahl im Heiß-Leerlauf" VALUE 0x81A078 KwUb 191.3 temp_ub_q0p75_o48 -48.00 143.3 FUNCTION_LIST LLRNS IF_DATA DIM_X DIRECT 0x81A078 /end CHARACTERISTIC
/begin CHARACTERISTIC TAIRCMX "Überwachungszeit für obere Grenze der Botschaftszählerdifferenz" VALUE 0x812DF5 KwUb 255.0 DEZ 0.00 255.0 FUNCTION_LIST GGCS IF_DATA DIM_X DIRECT 0x812DF5 /end CHARACTERISTIC
/begin CHARACTERISTIC TAIRCNU "Überwachungszeit für untere Grenze der Botschaftszählerdifferenz" VALUE 0x812DF6 KwUb 5.100 t20msxs_ub_b5p1 0.00 5.100 FUNCTION_LIST GGCS IF_DATA DIM_X DIRECT 0x812DF6 /end CHARACTERISTIC
/begin CHARACTERISTIC TALASMX "Abgastemperatur-Schwellwert für Prüfung Heizerkopplung" VALUE 0x81C79A KwUw 1535.977 temp_q0p0234_o273 -273.1500 1262.827 FUNCTION_LIST DLSU IF_DATA DIM_X DIRECT 0x81C79A /end CHARACTERISTIC
/begin CHARACTERISTIC TALDPO "Obere Ansaugtemperaturschwelle für Leckdiagnosemodul" VALUE 0x81A801 KwUb 191.3 temp_ub_q0p75_o48 -48.00 143.3 FUNCTION_LIST DLDP IF_DATA DIM_X DIRECT 0x81A801 /end CHARACTERISTIC
/begin CHARACTERISTIC TALDPU "Untere Ansaugtemperaturschwelle für Leckdiagnosemodul" VALUE 0x81A802 KwUb 191.3 temp_ub_q0p75_o48 -48.00 143.3 FUNCTION_LIST DLDP IF_DATA DIM_X DIRECT 0x81A802 /end CHARACTERISTIC
/begin CHARACTERISTIC TALDUVSE "Zeit bis zur Aktivierung LDR Umluftventilsteuerung nach Startende" VALUE 0x816374 KwUw 3276.750 t50msxs_uw_b3276p75 0.00 3276.750 FUNCTION_LIST LDUVST IF_DATA DIM_X DIRECT 0x816374 /end CHARACTERISTIC
/begin CHARACTERISTIC TALSUSMX "Maximaler Abgastemperatur-Schwellwert für die Plausibilitätsdiagnose" VALUE 0x81C79C KwUw 1535.977 temp_q0p0234_o273 -273.1500 1262.827 FUNCTION_LIST DLSU IF_DATA DIM_X DIRECT 0x81C79C /end CHARACTERISTIC
/begin CHARACTERISTIC TAMIALU "Minimale Ansauglufttemperatur für Ausblendung der Aussetzererkennung" VALUE 0x8107A9 KwUb 191.3 temp_ub_q0p75_o48 -48.00 143.3 FUNCTION_LIST DMDSTP IF_DATA DIM_X DIRECT 0x8107A9 /end CHARACTERISTIC
/begin CHARACTERISTIC TANDSLMN "min. Ansauglufttemperatur für SL- Diagnose" VALUE 0x818372 KwUb 191.3 temp_ub_q0p75_o48 -48.00 143.3 FUNCTION_LIST DSLSLRS IF_DATA DIM_X DIRECT 0x818372 /end CHARACTERISTIC
/begin CHARACTERISTIC TANDSLMX "max. Ansauglufttemperatur für SL- Diagnose" VALUE 0x818373 KwUb 191.3 temp_ub_q0p75_o48 -48.00 143.3 FUNCTION_LIST DSLSLRS IF_DATA DIM_X DIRECT 0x818373 /end CHARACTERISTIC
/begin CHARACTERISTIC TANDT "Schwelle Temperaturdifferenz Ansaugluft für Heißstart" CURVE 0x811BA8 KlAUbSstUbWUb 191.3 temp_ub_b191p25 0.00 191.3 FUNCTION_LIST ESSTT IF_DATA DIM_X DIRECT 0x811BA8
 /begin AXIS_DESCR STD_AXIS tansab temp_ub_q0p75_o48 8 -48.00 143.3 DEPOSIT ABSOLUT /end AXIS_DESCR
/end CHARACTERISTIC
/begin CHARACTERISTIC TANH "Ansauglufttemperatur - Schwelle heiß" VALUE 0x811BB9 KwUb 191.3 temp_ub_q0p75_o48 -48.00 143.3 FUNCTION_LIST ESSTT IF_DATA DIM_X DIRECT 0x811BB9 /end CHARACTERISTIC
/begin CHARACTERISTIC TANHKMMN "Kat-Temperatur für ausreichende Sondenheizung" VALUE 0x81C7B0 KwUw 1535.977 temp_q0p0234_o273 -273.1500 1262.827 FUNCTION_LIST HLSHK IF_DATA DIM_X DIRECT 0x81C7B0 /end CHARACTERISTIC
/begin CHARACTERISTIC TANSDHLSH "Ansauglufttemperaturschwelle für Ri- Diagnose hinter Kat" VALUE 0x81849E KwUb 191.3 temp_ub_q0p75_o48 -48.00 143.3 FUNCTION_LIST DHLSHK IF_DATA DIM_X DIRECT 0x81849E /end CHARACTERISTIC
/begin CHARACTERISTIC TANSELI "Temperatur Ansaugluft-Erfassung u. Linearisierung, Inverskennlinie" CURVE 0x819726 KlAUbSstUbWUb 191.3 temp_ub_q0p75_o48 -48.00 143.3 FUNCTION_LIST GGTFA IF_DATA DIM_X DIRECT 0x819726 /begin AXIS_DESCR STD_AXIS wtans spg_ub_b5 20 0.00 4.980 DEPOSIT ABSOLUT /end AXIS_DESCR /end CHARACTERISTIC
/begin CHARACTERISTIC TANSKOB "Ansauglufttemperaturschwelle für Kompressorabschaltung" VALUE 0x812DA3 KwUb 191.3 temp_ub_q0p75_o48 -48.00 143.3 FUNCTION_LIST KOS IF_DATA DIM_X DIRECT 0x812DA3 /end CHARACTERISTIC
/begin CHARACTERISTIC TANSMN "Ansauglufttemperaturschwelle zur Nachstartaufweitung" VALUE 0x81223E KwUb 191.3 temp_ub_q0p75_o48 -48.00 143.3 FUNCTION_LIST MDZUL IF_DATA DIM_X DIRECT 0x81223E /end CHARACTERISTIC
/begin CHARACTERISTIC TANSMN_UM "Ansauglufttemperaturschwelle zur Nachstartaufweitung in der Fkt.-Überwachung" VALUE 0x81400F KwUb 191.3 temp_ub_q0p75_o48 -48.00 143.3 FUNCTION_LIST UFNSC IF_DATA DIM_X DIRECT 0x81400F /end CHARACTERISTIC
/begin CHARACTERISTIC TANW "Ansauglufttemperaturschwelle für Nockenwellenverstellung" VALUE 0x81A824 KwUb 191.3 temp_ub_q0p75_o48 -48.00 143.3 FUNCTION_LIST BBNWS IF_DATA DIM_X DIRECT 0x81A824 /end CHARACTERISTIC
/begin CHARACTERISTIC TAPVLTM "Schwelle Abstellzeit für EKP-Vorlauf" CURVE 0x82B034 KlAUbSstUbWUw 65535.00 t1sxs_uw_q1 0.00 65535.00 FUNCTION_LIST AEKP IF_DATA DIM_X DIRECT 0x82B034
 /begin AXIS_DESCR STD_AXIS tmotab temp_ub_q0p75_o48 4 -48.00 143.3 DEPOSIT ABSOLUT /end AXIS_DESCR
/end CHARACTERISTIC
/begin CHARACTERISTIC TARA "Temperaturschwelle Ansaugluft" VALUE 0x811BEA KwUb 191.3 temp_ub_q0p75_o48 -48.00 143.3 FUNCTION_LIST LRAEB IF_DATA DIM_X DIRECT 0x811BEA /end CHARACTERISTIC
/begin CHARACTERISTIC TARAU "Ansauglufttemperaturschwelle für Einschalten der Lambda - Regelung" VALUE 0x81270D KwUb 191.3 temp_ub_q0p75_o48 -48.00 143.3 FUNCTION_LIST LRSEB IF_DATA DIM_X DIRECT 0x81270D /end CHARACTERISTIC
/begin CHARACTERISTIC TAREIN "Sperrzeit für Antiruckelfunktion" VALUE 0x811F15 KwUb 2.550 t10msxs_ub_b2p55 0.00 2.550 FUNCTION_LIST ARMD IF_DATA DIM_X DIRECT 0x811F15 /end CHARACTERISTIC
/begin CHARACTERISTIC TASHS "Schwelle Ansauglufttemp. für Auslösung TLRHS - Sperrzeit LR bei Heißstart" VALUE 0x81270E KwUb 191.3 temp_ub_q0p75_o48 -48.00 143.3 FUNCTION_LIST LRSEB IF_DATA DIM_X DIRECT 0x81270E /end CHARACTERISTIC
/begin CHARACTERISTIC TASIG "Zeit für Ausblendung von Störspitzen außerhalb Band für Erk. Signalunterbrechung" VALUE 0x811012 KwUb 5.100 t20msxs_ub_b5p1 0.00 5.100 FUNCTION_LIST DLSH IF_DATA DIM_X DIRECT 0x811012 /end CHARACTERISTIC
/begin CHARACTERISTIC TASLSO "obere Ansauglufttemperaturschwelle für Sekundärluftsystem" VALUE 0x81834D KwUb 191.3 temp_ub_q0p75_o48 -48.00 143.3 FUNCTION_LIST SLS IF_DATA DIM_X DIRECT 0x81834D /end CHARACTERISTIC
/begin CHARACTERISTIC TASLSU "untere Ansauglufttemperaturschwelle für Sekundärluftsystem" VALUE 0x81834E KwUb 191.3 temp_ub_q0p75_o48 -48.00 143.3 FUNCTION_LIST SLS IF_DATA DIM_X DIRECT 0x81834E /end CHARACTERISTIC
/begin CHARACTERISTIC TASTBFA "Modell-Temperatur vor Vorkatalysator Startwert bei B_faatm Anforderung" VALUE 0x818654 KwUb 1275. temp_ub_q5_o50 -50.00 1225. FUNCTION_LIST ATM IF_DATA DIM_X DIRECT 0x818654 /end CHARACTERISTIC
/begin CHARACTERISTIC TATEGMX "Maximales Tastverhältnis für getakteten Betrieb." VALUE 0x829CC8 KwUw 99.99847 rel_uw_b100 0.00 99.99847 FUNCTION_LIST ATEV IF_DATA DIM_X DIRECT 0x829CC8 /end CHARACTERISTIC
/begin CHARACTERISTIC TATEGRDO "Obere Schwelle Tastverhältnis TEV zur Erkennung eines neg. Gradienten tatesoll" VALUE 0x81A70A KwUb 99.61 rel_ub_b99p6 0.00 99.61 FUNCTION_LIST ATEV IF_DATA DIM_X DIRECT 0x81A70A /end CHARACTERISTIC
/begin CHARACTERISTIC TATEGRDU "Untere Schwelle Tastverhältnis TEV zur Erkennung eines neg. Gradienten tatesoll" VALUE 0x81A70B KwUb 99.61 rel_ub_b99p6 0.00 99.61 FUNCTION_LIST ATEV IF_DATA DIM_X DIRECT 0x81A70B /end CHARACTERISTIC
/begin CHARACTERISTIC TATELL "tans- Schwelle für Tankentlüfung bei B_ll = 1" VALUE 0x8191D7 KwUb 191.3 temp_ub_q0p75_o48 -48.00 143.3 FUNCTION_LIST BBTEGA IF_DATA DIM_X DIRECT 0x8191D7 /end CHARACTERISTIC
/begin CHARACTERISTIC TATEMSN "Kennlinie Tastverhältnis TEV abhängig vom gewünschten Massenstrom" CURVE 0x829CCA KlAUwSstUwWUw 99.99847 rel_uw_b100 0.00 99.99847 FUNCTION_LIST ATEV IF_DATA DIM_X DIRECT 0x829CCA
 /begin AXIS_DESCR STD_AXIS msntev_w m_uw_b25p6 10 0.00 25.59961 DEPOSIT ABSOLUT /end AXIS_DESCR
/end CHARACTERISTIC
/begin CHARACTERISTIC TATMKH "Abgastemperaturkorrektur bei Kat-Heizen aktiv" VALUE 0x818655 KwUb 1275. temp_q5 0.00 1275. FUNCTION_LIST ATM IF_DATA DIM_X DIRECT 0x818655 /end CHARACTERISTIC
/begin CHARACTERISTIC TATMKRSA "Abgastemperatur im Krümmer bei Schubabschalten" VALUE 0x818656 KwUb 1275. temp_ub_q5_o50 -50.00 1225. FUNCTION_LIST ATM IF_DATA DIM_X DIRECT 0x818656 /end CHARACTERISTIC
/begin CHARACTERISTIC TATMKW "Abgastemperaturkorrektur bei Kat warmhalten aktiv" VALUE 0x818657 KwUb 1275. temp_q5 0.00 1275. FUNCTION_LIST ATM IF_DATA DIM_X DIRECT 0x818657 /end CHARACTERISTIC
/begin CHARACTERISTIC TATMSA "Abgastemperatur bei Schubabschneiden" VALUE 0x818658 KwUb 1275. temp_ub_q5_o50 -50.00 1225. FUNCTION_LIST ATM IF_DATA DIM_X DIRECT 0x818658 /end CHARACTERISTIC
/begin CHARACTERISTIC TATMSAE "exotherme Temperaturerhöhung im Schub" VALUE 0x818659 KwUb 1275. temp_ub_q5_o50 -50.00 1225. FUNCTION_LIST ATM IF_DATA DIM_X DIRECT 0x818659 /end CHARACTERISTIC
/begin CHARACTERISTIC TATMSTI "Initialisierungswert für tabgm, tkatm Startwert bei Powerfail" VALUE 0x81865A KwUb 1275. temp_ub_q5_o50 -50.00 1225. FUNCTION_LIST ATM IF_DATA DIM_X DIRECT 0x81865A /end CHARACTERISTIC
/begin CHARACTERISTIC TATMTMOT "Motortemperatur warmer Motor , für Temperaturkorrektur beim Kaltstart" VALUE 0x81865B KwUb 191.3 temp_ub_q0p75_o48 -48.00 143.3 FUNCTION_LIST ATM IF_DATA DIM_X DIRECT 0x81865B /end CHARACTERISTIC
/begin CHARACTERISTIC TATMTP "Abgastaupunkttemperatur" VALUE 0x81865C KwUb 1275. temp_ub_q5_o50 -50.00 1225. FUNCTION_LIST ATM IF_DATA DIM_X DIRECT 0x81865C /end CHARACTERISTIC
/begin CHARACTERISTIC TATMTRKH "Abgastemperaturkorrektur bei Thermoreaktor-Katheizen" VALUE 0x81865D KwUb 1275. temp_q5 0.00 1275. FUNCTION_LIST ATM IF_DATA DIM_X DIRECT 0x81865D /end CHARACTERISTIC
/begin CHARACTERISTIC TATMWMK "Temperaturoffset  für Wärmemengenberechnung" VALUE 0x81865E KwSb 1275. temp_q5 -640.0 635.0 FUNCTION_LIST ATM IF_DATA DIM_X DIRECT 0x81865E /end CHARACTERISTIC
/begin CHARACTERISTIC TAUIDEC "Zeitkonstante Absteuern Integralanteil bei Grenzwertregelung LRS" VALUE 0x8174C6 KwUw 655.34999985 zk10msxs_uw_b655 0.010000152590 655.36000000 FUNCTION_LIST LRS IF_DATA DIM_X DIRECT 0x8174C6 /end CHARACTERISTIC
/begin CHARACTERISTIC TBKVP "Evakuierzeit der BKV-Pumpe" VALUE 0x81AFE0 KwUb 12.7498039 zk50msxs_ub_b12p8 0.0501960784 12.8000000 FUNCTION_LIST GGPBKV IF_DATA DIM_X DIRECT 0x81AFE0 /end CHARACTERISTIC
/begin CHARACTERISTIC TBLRH "Sperrzeit für Regelung hinter Kat nach Freigabe durch Regelung vor Kat" VALUE 0x81274A KwUb 25.50 t100msxs_ub_b25p5 0.00 25.50 FUNCTION_LIST LRSHK IF_DATA DIM_X DIRECT 0x81274A /end CHARACTERISTIC
/begin CHARACTERISTIC TBPWMCS "Wartezeit bis Signalunterbrechung erkannt" VALUE 0x81AFD7 KwUb 2.550 t10msxs_ub_b2p55 0.00 2.550 FUNCTION_LIST GGCS IF_DATA DIM_X DIRECT 0x81AFD7 /end CHARACTERISTIC
/begin CHARACTERISTIC TC6CSL "Mode 6: Component ID für Prüfung Sekundärluftsystem" VALUE 0x818374 KwUb 127.0 dez 0.00 127.0 FUNCTION_LIST DSLSLRS IF_DATA DIM_X DIRECT 0x818374 /end CHARACTERISTIC
/begin CHARACTERISTIC TC6CSLF "Mode 6: Component ID für Prüfung gefilterter Sekundärluftmittelwert" VALUE 0x818375 KwUb 127.0 dez 0.00 127.0 FUNCTION_LIST DSLSLRS IF_DATA DIM_X DIRECT 0x818375 /end CHARACTERISTIC
/begin CHARACTERISTIC TC6CSLK "Mode 6: Component ID für Prüfung Sekundärluftsystem; Kurztest" VALUE 0x818376 KwUb 127.0 dez 0.00 127.0 FUNCTION_LIST DSLSLRS IF_DATA DIM_X DIRECT 0x818376 /end CHARACTERISTIC
/begin CHARACTERISTIC TC6CSLN "Mode 6: Component ID für Prüfung minimale Sekundärluft in Phase 1" VALUE 0x818377 KwUb 127.0 dez 0.00 127.0 FUNCTION_LIST DSLSLRS IF_DATA DIM_X DIRECT 0x818377 /end CHARACTERISTIC
/begin CHARACTERISTIC TC6CSLV "Mode 6: Component ID für Prüfung Dichtheit SL-Ventil" VALUE 0x818378 KwUb 127.0 dez 0.00 127.0 FUNCTION_LIST DSLSLRS IF_DATA DIM_X DIRECT 0x818378 /end CHARACTERISTIC
/begin CHARACTERISTIC TC6CTHM "Mode 6: Component ID für Prüfung Kühlwasserthermostat" VALUE 0x8197D3 KwUb 126.0 dez 1.000 127.0 FUNCTION_LIST DTHM IF_DATA DIM_X DIRECT 0x8197D3 /end CHARACTERISTIC
/begin CHARACTERISTIC TC6LDPC1 "Mode 6 Component ID für Prüfung Grob-/Feinleck" VALUE 0x812786 KwUb 127.0 dez 0.00 127.0 FUNCTION_LIST DLDP IF_DATA DIM_X DIRECT 0x812786 /end CHARACTERISTIC
/begin CHARACTERISTIC TC6LDPC2 "Mode 6 Component ID für Prüfung 'Reed-Kontakt geschlossen'" VALUE 0x812787 KwUb 127.0 dez 0.00 127.0 FUNCTION_LIST DLDP IF_DATA DIM_X DIRECT 0x812787 /end CHARACTERISTIC
/begin CHARACTERISTIC TC6LDPC3 "Mode 6 Component ID für Prüfung 'Reed-Kontakt öffnet'" VALUE 0x812788 KwUb 127.0 dez 0.00 127.0 FUNCTION_LIST DLDP IF_DATA DIM_X DIRECT 0x812788 /end CHARACTERISTIC
/begin CHARACTERISTIC TC6LDPC4 "Mode 6 Component ID für Prüfung 'System dicht während Initialspülung'" VALUE 0x812789 KwUb 127.0 dez 0.00 127.0 FUNCTION_LIST DLDP IF_DATA DIM_X DIRECT 0x812789 /end CHARACTERISTIC
/begin CHARACTERISTIC TC6LDPC5 "" VALUE 0x81278A KwUb 127.0 dez 0.00 127.0 FUNCTION_LIST DLDP IF_DATA DIM_X DIRECT 0x81278A /end CHARACTERISTIC
/begin CHARACTERISTIC TC6TECI "Mode 6 Codewort für i.O. Prüfung des TEVs aus DLDP" VALUE 0x81A77A KwUb 127.0 dez 0.00 127.0 FUNCTION_LIST DTEV IF_DATA DIM_X DIRECT 0x81A77A /end CHARACTERISTIC
/begin CHARACTERISTIC TC6TECL "Mode 6 Codewort für i.O. Prüfung des TEVs aus Luft-Prüfung" VALUE 0x81A77B KwUb 127.0 dez 0.00 127.0 FUNCTION_LIST DTEV IF_DATA DIM_X DIRECT 0x81A77B /end CHARACTERISTIC
/begin CHARACTERISTIC TC6TECNL "Mode 6 Codewort für NICHT i.O. Prüfung des TEVs aus Luft-Prüfung" VALUE 0x81A77C KwUb 127.0 dez 0.00 127.0 FUNCTION_LIST DTEV IF_DATA DIM_X DIRECT 0x81A77C /end CHARACTERISTIC
/begin CHARACTERISTIC TC6TECP "Mode 6 Codewort für passive i.O. Prüfung des TEVs" VALUE 0x81A77D KwUb 127.0 dez 0.00 127.0 FUNCTION_LIST DTEV IF_DATA DIM_X DIRECT 0x81A77D /end CHARACTERISTIC
/begin CHARACTERISTIC TC6TECRF "Mode 6 Codewort für i.O. Prüfung des TEVs aus FR-Abweichung Richtung fett" VALUE 0x81A77E KwUb 127.0 dez 0.00 127.0 FUNCTION_LIST DTEV IF_DATA DIM_X DIRECT 0x81A77E /end CHARACTERISTIC
/begin CHARACTERISTIC TC6TECRM "Mode 6 Codewort für i.O. Prüfung des TEVs aus FR-Abweichung Richtung mager" VALUE 0x81A77F KwUb 127.0 dez 0.00 127.0 FUNCTION_LIST DTEV IF_DATA DIM_X DIRECT 0x81A77F /end CHARACTERISTIC
/begin CHARACTERISTIC TC6TECT "Mode 6 Codewort für i.O. Prüfung des TEVs aus DLDP" VALUE 0x81A780 KwUb 127.0 dez 0.00 127.0 FUNCTION_LIST DTEV IF_DATA DIM_X DIRECT 0x81A780 /end CHARACTERISTIC
/begin CHARACTERISTIC TCONT_HILO "Entprellzeit Signal Dauer- high- low" VALUE 0x812DF7 KwUb 1.270 t10msxs_ub_b2p55 0.00 1.270 FUNCTION_LIST GGCS IF_DATA DIM_X DIRECT 0x812DF7 /end CHARACTERISTIC
/begin CHARACTERISTIC TCRCAN "Filterzeit für Crash-CAN-Signal" VALUE 0x812DF8 KwUb 255.0 DEZ 0.00 255.0 FUNCTION_LIST GGCS IF_DATA DIM_X DIRECT 0x812DF8 /end CHARACTERISTIC
/begin CHARACTERISTIC TCSERC "Zeit zur sicheren Crash-CAN-Erkennung" VALUE 0x81AFD8 KwUb 12.75 t50msxs_ub_b12p75 0.00 12.75 FUNCTION_LIST GGCS IF_DATA DIM_X DIRECT 0x81AFD8 /end CHARACTERISTIC
/begin CHARACTERISTIC TCSERNPL "Zeit für fehlgeschlagene automatische Crashsignalerkennung" VALUE 0x81AFD9 KwUb 12.75 t50msxs_ub_b12p75 0.00 12.75 FUNCTION_LIST GGCS IF_DATA DIM_X DIRECT 0x81AFD9 /end CHARACTERISTIC
/begin CHARACTERISTIC TCSERP "Zeit zur sicheren Crash-PWM Erkennung" VALUE 0x81AFDA KwUb 12.75 t50msxs_ub_b12p75 0.00 12.75 FUNCTION_LIST GGCS IF_DATA DIM_X DIRECT 0x81AFDA /end CHARACTERISTIC
/begin CHARACTERISTIC TDABGLST "Zeitverzögerung Freigabe Abgleich nach Startende" VALUE 0x815892 KwUw 655.3500 t10msxs_uw_b655p35 0.00 655.3500 FUNCTION_LIST BGMSZS IF_DATA DIM_X DIRECT 0x815892 /end CHARACTERISTIC
/begin CHARACTERISTIC TDAPTUBR "Wartezeit für UBR-Fehler bei Abschaltpfadtest" VALUE 0x81870D KwUb 25.50 t100msxs_ub_b25p5 0.00 25.50 FUNCTION_LIST GGUBR IF_DATA DIM_X DIRECT 0x81870D /end CHARACTERISTIC
/begin CHARACTERISTIC TDASTAT "Zeitverzögerung bei Rücksetzen von B_astat" VALUE 0x818379 KwUb 25.50 t100msxs_ub_b25p5 0.00 25.50 FUNCTION_LIST DSLSLRS IF_DATA DIM_X DIRECT 0x818379 /end CHARACTERISTIC
/begin CHARACTERISTIC TDBBKVP "Einschaltverzögerung von B_bkvp für Diagnose" VALUE 0x81AFEE KwUb 25.50 t100msxs_ub_b25p5 0.00 25.50 FUNCTION_LIST DBKVP IF_DATA DIM_X DIRECT 0x81AFEE /end CHARACTERISTIC
/begin CHARACTERISTIC TDBKVKOMAB "Verzögerungszeit der Forderung Klimakompressor abschalten" VALUE 0x81AFE3 KwUb 5.100 t20msxs_ub_q0p02 0.00 5.100 FUNCTION_LIST BKV IF_DATA DIM_X DIRECT 0x81AFE3 /end CHARACTERISTIC
/begin CHARACTERISTIC TDBKVSTEND "Einschaltverzögerung BKV-Pumpe nach Startende" VALUE 0x81AFF0 KwUb 2.550 t10msxs_ub_b2p55 0.00 2.550 FUNCTION_LIST ABKVP IF_DATA DIM_X DIRECT 0x81AFF0 /end CHARACTERISTIC
/begin CHARACTERISTIC TDDBKVP "Zeit, in der das Druckdelta DPBKVP durch die Pumpe evakuiert werden kann" VALUE 0x81AFEF KwUb 25.50 t100msxs_ub_b25p5 0.00 25.50 FUNCTION_LIST DBKVP IF_DATA DIM_X DIRECT 0x81AFEF /end CHARACTERISTIC
/begin CHARACTERISTIC TDDFBKV "Entprellzeit für Fehlereintrag DS Bremskraftverstärker" VALUE 0x81AFF3 KwUb 25.50 t100msxs_ub_b25p5 0.00 25.50 FUNCTION_LIST DDSBKV IF_DATA DIM_X DIRECT 0x81AFF3 /end CHARACTERISTIC
/begin CHARACTERISTIC TDDFL "Entprellzeit für Fehlereintrag Drucksensor Ladedruck" VALUE 0x818899 KwUb 25.50 t100msxs_ub_b25p5 0.00 25.50 FUNCTION_LIST GGDSAS IF_DATA DIM_X DIRECT 0x818899 /end CHARACTERISTIC
/begin CHARACTERISTIC TDDFLUGD "Entprellzeit für Fehlereintrag Drucksensor Ladedruck" VALUE 0x81889A KwUb 25.50 t100msxs_ub_b25p5 0.00 25.50 FUNCTION_LIST GGDSAS IF_DATA DIM_X DIRECT 0x81889A /end CHARACTERISTIC
/begin CHARACTERISTIC TDDFU "Entprellzeit für Fehlereintrag Druckksensor Umgebung" VALUE 0x81889B KwUb 25.50 t100msxs_ub_b25p5 0.00 25.50 FUNCTION_LIST GGDSAS IF_DATA DIM_X DIRECT 0x81889B /end CHARACTERISTIC
/begin CHARACTERISTIC TDDFUELSAN "Zeitverzögerung nach unterschreiten einer Schwelle durch dfuelsan" VALUE 0x81131F KwUb 2.550 t10msxs_ub_b2p55 0.00 2.550 FUNCTION_LIST BGMSZS IF_DATA DIM_X DIRECT 0x81131F /end CHARACTERISTIC
/begin CHARACTERISTIC TDDFUUGD "Entprellzeit für Fehlereintrag Druckksensor Umgebung" VALUE 0x81889C KwUb 25.50 t100msxs_ub_b25p5 0.00 25.50 FUNCTION_LIST GGDSAS IF_DATA DIM_X DIRECT 0x81889C /end CHARACTERISTIC
/begin CHARACTERISTIC TDDHBKV "Entprellzeit für Setzen des Zyklusflags" VALUE 0x81AFF4 KwUb 25.50 t100msxs_ub_b25p5 0.00 25.50 FUNCTION_LIST DDSBKV IF_DATA DIM_X DIRECT 0x81AFF4 /end CHARACTERISTIC
/begin CHARACTERISTIC TDDNWSMNE "Entprellzeit für Setzen des min.-Fehlers der Einlaßnockenwelle" VALUE 0x81A904 KwUb 25.50 t100msxs_ub_b25p5 0.00 25.50 FUNCTION_LIST DNWSEIN IF_DATA DIM_X DIRECT 0x81A904 /end CHARACTERISTIC
/begin CHARACTERISTIC TDDSLA "Dauer Sekundärlufteinblasung für Adaptionsphase" VALUE 0x81834F KwUb 25.50 t100msxs_ub_b25p5 0.00 25.50 FUNCTION_LIST SLS IF_DATA DIM_X DIRECT 0x81834F /end CHARACTERISTIC
/begin CHARACTERISTIC TDDSLSFG "Zeitverzögerung für Freigabe der Zusatzdiagnose SLS (Bank1)" VALUE 0x81837A KwUb 25.50 t100msxs_ub_b25p5 0.00 25.50 FUNCTION_LIST DSLSLRS IF_DATA DIM_X DIRECT 0x81837A /end CHARACTERISTIC
/begin CHARACTERISTIC TDEGFEMN "Zeitverzögerung für Setzen des MIN-Fehlers" VALUE 0x818970 KwUb 255.0 t1sxs_ub_b255 0.00 255.0 FUNCTION_LIST DEGFE IF_DATA DIM_X DIRECT 0x818970 /end CHARACTERISTIC
/begin CHARACTERISTIC TDEGFEMX "Zeitverzögerung für Setzen des MAX-Fehlers" VALUE 0x818971 KwUb 255.0 t1sxs_ub_b255 0.00 255.0 FUNCTION_LIST DEGFE IF_DATA DIM_X DIRECT 0x818971 /end CHARACTERISTIC
/begin CHARACTERISTIC TDEGFENO "Zeitverzögerung für Setzen des NO-Fehlers" VALUE 0x818972 KwUb 255.0 t1sxs_ub_b255 0.00 255.0 FUNCTION_LIST DEGFE IF_DATA DIM_X DIRECT 0x818972 /end CHARACTERISTIC
/begin CHARACTERISTIC TDFGABGLGD "Zeitverzug für die Berücksichtigung von B_fgabglgd" VALUE 0x811320 KwUb 2.550 t10msxs_ub_b2p55 0.00 2.550 FUNCTION_LIST BGMSZS IF_DATA DIM_X DIRECT 0x811320 /end CHARACTERISTIC
/begin CHARACTERISTIC TDFGSLA "Zeitverzögerung für die Freigabe der Anforderung der Aktivdiagnose" VALUE 0x81837B KwUb 25.40 t100msxs_ub_b25p5 0.1000 25.50 FUNCTION_LIST DSLSLRS IF_DATA DIM_X DIRECT 0x81837B /end CHARACTERISTIC
/begin CHARACTERISTIC TDFGSZSLS "Zeitverzögerung für die Freigabe der Setzbedingung des Zyklusflags" VALUE 0x81837C KwUb 25.50 t100msxs_ub_b25p5 0.00 25.50 FUNCTION_LIST DSLSLRS IF_DATA DIM_X DIRECT 0x81837C /end CHARACTERISTIC
/begin CHARACTERISTIC TDFHS "Entprellzeit für Heizerendstufe" VALUE 0x81101D KwUb 2.550 t10msxs_ub_b2p55 0.00 2.550 FUNCTION_LIST DHLSU IF_DATA DIM_X DIRECT 0x81101D /end CHARACTERISTIC
/begin CHARACTERISTIC TDHLA "Entprellzeit für Klimatronik-Fehler" VALUE 0x81AC01 KwUb 25.50 t100msxs_ub_b25p5 0.00 25.50 FUNCTION_LIST GGHLA IF_DATA DIM_X DIRECT 0x81AC01 /end CHARACTERISTIC
/begin CHARACTERISTIC TDHREVAB "Entprellzeit für EV-Abschaltung bei Hauptrelais- bzw. -Kontakt-Fehler" VALUE 0x81870E KwUb 25.50 t100msxs_ub_b25p5 0.00 25.50 FUNCTION_LIST GGUBR IF_DATA DIM_X DIRECT 0x81870E /end CHARACTERISTIC
/begin CHARACTERISTIC TDKLAGDE "Zeitdelta für Fehlerzählerlöschung bei DK-Soll-/Istvergleich" VALUE 0x811204 KwUb 5.100 t20msxs_ub_b5p1 0.00 5.100 FUNCTION_LIST ADVE IF_DATA DIM_X DIRECT 0x811204 /end CHARACTERISTIC
/begin CHARACTERISTIC TDKPAW "Zeit für DK-Poti-Auswahl" VALUE 0x81110B KwUb 2.540 t10msxs_ub_b2p55 0.01000 2.550 FUNCTION_LIST GGDVE IF_DATA DIM_X DIRECT 0x81110B /end CHARACTERISTIC
/begin CHARACTERISTIC TDKUPNLLKH "Zeitverzug für umschalten auf seperate LL-Drehzahl nach Freigabe der Kupplung" VALUE 0x819840 KwUb 25.50 t100msxs_ub_b25p5 0.00 25.50 FUNCTION_LIST BBKHZ IF_DATA DIM_X DIRECT 0x819840 /end CHARACTERISTIC
/begin CHARACTERISTIC TDKUPNOG "Verzögerungszeit nach Gangwechsel bis erneute Gangwechselerk. möglich" VALUE 0x818719 KwUb 255.0 t1sxs_ub_b255 0.00 255.0 FUNCTION_LIST DKUPPL IF_DATA DIM_X DIRECT 0x818719 /end CHARACTERISTIC
/begin CHARACTERISTIC TDLDPE "Entprellzeit für Fehler setzen LDP-Endstufe" VALUE 0x8187E3 KwUb 25.50 t100msxs_ub_b25p5 0.00 25.50 FUNCTION_LIST DLDPE IF_DATA DIM_X DIRECT 0x8187E3 /end CHARACTERISTIC
/begin CHARACTERISTIC TDLDRA "Zeitschwelle für Dia LDR - Regelabweichung" VALUE 0x819E57 KwUb 12.75 t50msxs_ub_b12p75 0.00 12.75 FUNCTION_LIST DLDR IF_DATA DIM_X DIRECT 0x819E57 /end CHARACTERISTIC
/begin CHARACTERISTIC TDLDRA2 "Zeitschwelle für Dia LDR - Regelabweichung (B_mxldra)" VALUE 0x819E58 KwUb 12.75 t50msxs_ub_b12p75 0.00 12.75 FUNCTION_LIST DLDR IF_DATA DIM_X DIRECT 0x819E58 /end CHARACTERISTIC
/begin CHARACTERISTIC TDLKVDKH "Zeitverzögerung für löschen von E_lkvdk" VALUE 0x819E59 KwUb 12.75 t50msxs_ub_b12p75 0.00 12.75 FUNCTION_LIST DLDR IF_DATA DIM_X DIRECT 0x819E59 /end CHARACTERISTIC
/begin CHARACTERISTIC TDLKVDKL "Zeitverzögerung für setzen von E_lkvdk im Ladebetrieb" VALUE 0x819E5A KwUb 12.75 t50msxs_ub_b12p75 0.00 12.75 FUNCTION_LIST DLDR IF_DATA DIM_X DIRECT 0x819E5A /end CHARACTERISTIC
/begin CHARACTERISTIC TDLKVDKLL "Zeitverzögerung für setzen von E_lkvdk im Saugbetrieb untere Schwelle" VALUE 0x819E5B KwUb 12.75 t50msxs_ub_b12p75 0.00 12.75 FUNCTION_LIST DLDR IF_DATA DIM_X DIRECT 0x819E5B /end CHARACTERISTIC
/begin CHARACTERISTIC TDLKVDKS "Zeitverzögerung für setzen von E_lkvdk im Saugbetrieb" VALUE 0x819E5C KwUb 12.75 t50msxs_ub_b12p75 0.00 12.75 FUNCTION_LIST DLDR IF_DATA DIM_X DIRECT 0x819E5C /end CHARACTERISTIC
/begin CHARACTERISTIC TDLKVDKST "Zeitverzögerung für setzen von E_lkvdk nach Startende" VALUE 0x819E5D KwUb 12.75 t50msxs_ub_b12p75 0.00 12.75 FUNCTION_LIST DLDR IF_DATA DIM_X DIRECT 0x819E5D /end CHARACTERISTIC
/begin CHARACTERISTIC TDLRHAFTMX "Verweildauer für Aktivierung der Haftreibungsroutine" VALUE 0x81873A KwUb 12.75 t50msxs_q0p05 0.00 12.75 FUNCTION_LIST ADVE IF_DATA DIM_X DIRECT 0x81873A /end CHARACTERISTIC
/begin CHARACTERISTIC TDLRPIDMX "max. Zeit für PWM-Tastverhältnis des DLR bei temp. UMA-Adapt." VALUE 0x81114C KwUb 12.75 t50msxs_q0p05 0.00 12.75 FUNCTION_LIST BGDVE IF_DATA DIM_X DIRECT 0x81114C /end CHARACTERISTIC
/begin CHARACTERISTIC TDMFB "Zeit Diagnose für Erkennung Fehler in MIL-Fremdbestimmung" VALUE 0x818486 KwUb 255.0 t1sxs_ub_b255 0.00 255.0 FUNCTION_LIST DMFB IF_DATA DIM_X DIRECT 0x818486 /end CHARACTERISTIC
/begin CHARACTERISTIC TDMFBSA "Zeitkonstante PT1-Filter beim Schubabschalten" VALUE 0x817038 KwUw 655.34999985 zk10msxs_uw_b655 0.010000152590 655.36000000 FUNCTION_LIST MDFAW IF_DATA DIM_X DIRECT 0x817038 /end CHARACTERISTIC
/begin CHARACTERISTIC TDMFBWE "Zeitkonstante PT1-Filter beim weichen Wiedereinsetzen" VALUE 0x81703A KwUw 655.34999985 zk10msxs_uw_b655 0.010000152590 655.36000000 FUNCTION_LIST MDFAW IF_DATA DIM_X DIRECT 0x81703A /end CHARACTERISTIC
/begin CHARACTERISTIC TDMFNSG "Filterzeitkonstante bei Solldrehzahlanhebung CVT" VALUE 0x81703C KwUw 655.34999985 zk10msxs_uw_b655 0.010000152590 655.36000000 FUNCTION_LIST MDFAW IF_DATA DIM_X DIRECT 0x81703C /end CHARACTERISTIC
/begin CHARACTERISTIC TDMLHFM "Zeitverzögerung für das Setzen von B_ehfm" VALUE 0x811318 KwUb 2.550 t10msxs_ub_b2p55 0.00 2.550 FUNCTION_LIST DHFM IF_DATA DIM_X DIRECT 0x811318 /end CHARACTERISTIC
/begin CHARACTERISTIC TDMLMN "Entprellzeit HFM-(Hauptlastgeber-)Fehlererkennung Minimalwert" VALUE 0x81888C KwUb 25.50 t100msxs_ub_b25p5 0.00 25.50 FUNCTION_LIST DHFM IF_DATA DIM_X DIRECT 0x81888C /end CHARACTERISTIC
/begin CHARACTERISTIC TDMLMX "Entprellzeit HFM-(Hauptlastgeber-)Fehlererkennung Maximalwert" VALUE 0x81888D KwUb 25.50 t100msxs_ub_b25p5 0.00 25.50 FUNCTION_LIST DHFM IF_DATA DIM_X DIRECT 0x81888D /end CHARACTERISTIC
/begin CHARACTERISTIC TDMLNF "Entprellzeit HFM-(Hauptlastgeber-)Diagnose mit i.O.-Meldung" VALUE 0x81888E KwUb 25.50 t100msxs_ub_b25p5 0.00 25.50 FUNCTION_LIST DHFM IF_DATA DIM_X DIRECT 0x81888E /end CHARACTERISTIC
/begin CHARACTERISTIC TDMLNPL "Entprellzeit HFM-(Hauptlastgeber-)Fehlererkennung nicht plausibler Wert" VALUE 0x81888F KwUb 25.50 t100msxs_ub_b25p5 0.00 25.50 FUNCTION_LIST DHFM IF_DATA DIM_X DIRECT 0x81888F /end CHARACTERISTIC
/begin CHARACTERISTIC TDMLST "Entprellzeit HFM-(Hauptlastgeber-)Fehlererkennung im Start" VALUE 0x818890 KwUb 25.50 t100msxs_ub_b25p5 0.00 25.50 FUNCTION_LIST DHFM IF_DATA DIM_X DIRECT 0x818890 /end CHARACTERISTIC
/begin CHARACTERISTIC TDMRESLL "Sperrzeit für die erhöhte Momentenreserve nach dem Start" VALUE 0x811EF0 KwUb 51.00 t200msxs_ub_b51 0.00 51.00 FUNCTION_LIST LLRMR IF_DATA DIM_X DIRECT 0x811EF0 /end CHARACTERISTIC
/begin CHARACTERISTIC TDMSDKS "Zeitverzögerung bis das Bit B_fkmsdks wirksam wird" VALUE 0x811321 KwUb 2.550 t10msxs_ub_b2p55 0.00 2.550 FUNCTION_LIST BGMSZS IF_DATA DIM_X DIRECT 0x811321 /end CHARACTERISTIC
/begin CHARACTERISTIC TDMSLMN1 "Mindestmeßzeit Sekundärluftmasse, Phase 1" VALUE 0x81837D KwUb 25.50 t100msxs_ub_b25p5 0.00 25.50 FUNCTION_LIST DSLSLRS IF_DATA DIM_X DIRECT 0x81837D /end CHARACTERISTIC
/begin CHARACTERISTIC TDMSLMN4 "Mindestmeßzeit Sekundärluftmasse, Phase 4" VALUE 0x81837E KwUb 25.50 t100msxs_ub_b25p5 0.00 25.50 FUNCTION_LIST DSLSLRS IF_DATA DIM_X DIRECT 0x81837E /end CHARACTERISTIC
/begin CHARACTERISTIC TDMSLMNK "Mindestmeßzeit Sekundärluftmasse, Phase 1 bei Kurztest" VALUE 0x81837F KwUb 25.50 t100msxs_ub_b25p5 0.00 25.50 FUNCTION_LIST DSLSLRS IF_DATA DIM_X DIRECT 0x81837F /end CHARACTERISTIC
/begin CHARACTERISTIC TDMSLOF3 "Meßzeit Offset Sekundärluftmasse, Phase 3" VALUE 0x818380 KwUb 25.50 t100msxs_ub_b25p5 0.00 25.50 FUNCTION_LIST DSLSLRS IF_DATA DIM_X DIRECT 0x818380 /end CHARACTERISTIC
/begin CHARACTERISTIC TDMSLOF5 "Meßzeit Offset sekundärluftmasse, Phase 5" VALUE 0x818381 KwUb 25.50 t100msxs_ub_b25p5 0.00 25.50 FUNCTION_LIST DSLSLRS IF_DATA DIM_X DIRECT 0x818381 /end CHARACTERISTIC
/begin CHARACTERISTIC TDMSLOFK "Meßzeit Offset Sekundärluftmasse, Phase 3 bei Kurztest" VALUE 0x818382 KwUb 25.50 t100msxs_ub_b25p5 0.00 25.50 FUNCTION_LIST DSLSLRS IF_DATA DIM_X DIRECT 0x818382 /end CHARACTERISTIC
/begin CHARACTERISTIC TDMSLV "Messzeit für Ventildichtheitsprüfung" VALUE 0x818383 KwUb 25.50 t100msxs_ub_b25p5 0.00 25.50 FUNCTION_LIST DSLSLRS IF_DATA DIM_X DIRECT 0x818383 /end CHARACTERISTIC
/begin CHARACTERISTIC TDMSLVK "Meßzeit für Ventildichtheitsprüfung bei Kurztest" VALUE 0x818384 KwUb 25.50 t100msxs_ub_b25p5 0.00 25.50 FUNCTION_LIST DSLSLRS IF_DATA DIM_X DIRECT 0x818384 /end CHARACTERISTIC
/begin CHARACTERISTIC TDNSTA "Auspufferwärmzeit ab Start, für TANS - Diagnose" VALUE 0x819760 KwUb 255.0 t1sxs_ub_b255 0.00 255.0 FUNCTION_LIST GGTFA IF_DATA DIM_X DIRECT 0x819760 /end CHARACTERISTIC
/begin CHARACTERISTIC TDNSUB "Batterie - Erholzeit ab Start, für UBATT - Diagnose" VALUE 0x811027 KwUb 255.0 t100msxs_ub_b255 0.00 255.0 FUNCTION_LIST GGUB IF_DATA DIM_X DIRECT 0x811027 /end CHARACTERISTIC
/begin CHARACTERISTIC TDNWSP "Zeitverzögerung für Prüfung Nockenwellenverschiebung" VALUE 0x818499 KwUb 51.00 t200msxs_ub_b51 0.00 51.00 FUNCTION_LIST DNWKW IF_DATA DIM_X DIRECT 0x818499 /end CHARACTERISTIC
/begin CHARACTERISTIC TDPDK "Zeitkonstante Abregelung für Faktor fmvp_w" VALUE 0x8165B8 KwUw 655.34999985 zk10msxs_uw_b655 0.010000152590 655.36000000 FUNCTION_LIST LDRPLS IF_DATA DIM_X DIRECT 0x8165B8 /end CHARACTERISTIC
/begin CHARACTERISTIC TDPH2SLOF "Zeit Einschaltverzögerung von Phase 2 nach Phase 3" VALUE 0x818385 KwUb 25.50 t100msxs_ub_b25p5 0.00 25.50 FUNCTION_LIST DSLSLRS IF_DATA DIM_X DIRECT 0x818385 /end CHARACTERISTIC
/begin CHARACTERISTIC TDPHSLOF "Zeit Einschaltverzögerung Bit B_slsoff in Phase 2, 3 und 5 nach" VALUE 0x818386 KwUb 25.50 t100msxs_ub_b25p5 0.00 25.50 FUNCTION_LIST DSLSLRS IF_DATA DIM_X DIRECT 0x818386 /end CHARACTERISTIC
/begin CHARACTERISTIC TDPSSOL "Zeitverzögerung der Bedingung B_pssol für die Freigabe des schnellen Abgleichs" VALUE 0x815894 KwUw 655.3500 t10msxs_uw_b655p35 0.00 655.3500 FUNCTION_LIST BGMSZS IF_DATA DIM_X DIRECT 0x815894 /end CHARACTERISTIC
/begin CHARACTERISTIC TDRLMXLAM "Zeitverzögerung für Rücksetzen der max.Auswahl rl über Lambda-Soll" VALUE 0x811322 KwUb 2.550 t10msxs_ub_b2p55 0.00 2.550 FUNCTION_LIST BGMSZS IF_DATA DIM_X DIRECT 0x811322 /end CHARACTERISTIC
/begin CHARACTERISTIC TDRNLUBR "Entprellzeit Rücksetzen Nachlauf-Anforderung von GGUBR" VALUE 0x81870F KwUb 25.50 t100msxs_ub_b25p5 0.00 25.50 FUNCTION_LIST GGUBR IF_DATA DIM_X DIRECT 0x81870F /end CHARACTERISTIC
/begin CHARACTERISTIC TDSLKT "Dauer Kurztest Sekundärluftdiagnose für Massenmessung" VALUE 0x818350 KwUb 25.50 t100msxs_ub_b25p5 0.00 25.50 FUNCTION_LIST SLS IF_DATA DIM_X DIRECT 0x818350 /end CHARACTERISTIC
/begin CHARACTERISTIC TDSLMDRL "Einschaltverzögerung Delta-rl-Sperre bei Bildung B_dslmes" VALUE 0x818387 KwUb 25.50 t100msxs_ub_b25p5 0.00 25.50 FUNCTION_LIST DSLSLRS IF_DATA DIM_X DIRECT 0x818387 /end CHARACTERISTIC
/begin CHARACTERISTIC TDSLMVBA "Einschaltverzögerung BA-/VA-Sperre bei Bildung B_dslmes" VALUE 0x818388 KwUb 25.50 t100msxs_ub_b25p5 0.00 25.50 FUNCTION_LIST DSLSLRS IF_DATA DIM_X DIRECT 0x818388 /end CHARACTERISTIC
/begin CHARACTERISTIC TDSRLMX "Zeitverzögerung für Umschalten von Haupt- auf Nebenlastsignal" VALUE 0x811323 KwUb 2.550 t10msxs_ub_b2p55 0.00 2.550 FUNCTION_LIST BGMSZS IF_DATA DIM_X DIRECT 0x811323 /end CHARACTERISTIC
/begin CHARACTERISTIC TDTA "Entprellzeit Fehlererkennung TANS" VALUE 0x819761 KwUb 25.50 t100msxs_ub_b25p5 0.00 25.50 FUNCTION_LIST GGTFA IF_DATA DIM_X DIRECT 0x819761 /end CHARACTERISTIC
/begin CHARACTERISTIC TDTABGMK "Zeitverzögerung für modellierte Abgastemperatur bei Eintritt in den Katalysator" VALUE 0x819841 KwUb 254.996 zk1sxs_ub_b255 1.00392 256.000 FUNCTION_LIST BBKHZ IF_DATA DIM_X DIRECT 0x819841 /end CHARACTERISTIC
/begin CHARACTERISTIC TDTAL "TANS Fehlererkennung / Zeitsperre ab B_LL = 1" VALUE 0x819762 KwUb 255.0 t1sxs_ub_b255 0.00 255.0 FUNCTION_LIST GGTFA IF_DATA DIM_X DIRECT 0x819762 /end CHARACTERISTIC
/begin CHARACTERISTIC TDTEFA "Zeit für Sperre DTEV ab Start bei Testeranforderung" VALUE 0x829D28 KwUw 180.0000 t100msxs_uw_b6553p6 20.00000 200.0000 FUNCTION_LIST DTEV IF_DATA DIM_X DIRECT 0x829D28 /end CHARACTERISTIC
/begin CHARACTERISTIC TDTESZO "Zeit ab Startende für schnelle Spülratenabsteuerung DTEV bei B_ll = TRUE inaktiv" VALUE 0x829D2A KwUw 6553.500 t100msxs_uw_b6553p6 0.00 6553.500 FUNCTION_LIST DTEV IF_DATA DIM_X DIRECT 0x829D2A /end CHARACTERISTIC
/begin CHARACTERISTIC TDTESZU "Zeit ab Startende für Aktivierung Spülratenabsteuerung DTEV bei B_ll = TRUE" VALUE 0x829D2C KwUw 6553.500 t100msxs_uw_b6553p6 0.00 6553.500 FUNCTION_LIST DTEV IF_DATA DIM_X DIRECT 0x829D2C /end CHARACTERISTIC
/begin CHARACTERISTIC TDTEZAM "Zeit ab Start für aktive DTEV möglich" VALUE 0x829D2E KwUw 6553.500 t100msxs_uw_b6553p6 0.00 6553.500 FUNCTION_LIST DTEV IF_DATA DIM_X DIRECT 0x829D2E /end CHARACTERISTIC
/begin CHARACTERISTIC TDTHMO "obere Temp.-Schwelle (tans/tum) für Thermostatdiagnose" VALUE 0x8197D4 KwUb 191.3 temp_ub_q0p75_o48 -48.00 143.3 FUNCTION_LIST DTHM IF_DATA DIM_X DIRECT 0x8197D4 /end CHARACTERISTIC
/begin CHARACTERISTIC TDTHMU "untere Temp.-Schwelle (tans/tum) für Thermostatdiagnose" VALUE 0x8197D5 KwUb 191.3 temp_ub_q0p75_o48 -48.00 143.3 FUNCTION_LIST DTHM IF_DATA DIM_X DIRECT 0x8197D5 /end CHARACTERISTIC
/begin CHARACTERISTIC TDTKAUS "Entprellzeit Fehlererkennung Temperatur Kühlerausgang" VALUE 0x81AFA9 KwUb 25.50 t100msxs_ub_b25p5 0.00 25.50 FUNCTION_LIST GGTKA IF_DATA DIM_X DIRECT 0x81AFA9 /end CHARACTERISTIC
/begin CHARACTERISTIC TDTM "Entprellzeit Fehlererkennung TMOT" VALUE 0x81E974 KwUw 6553.500 t100msxs_uw_b6553p5 0.00 6553.500 FUNCTION_LIST GGTFM IF_DATA DIM_X DIRECT 0x81E974 /end CHARACTERISTIC
/begin CHARACTERISTIC TDTMMA "Verzögerungszeit Anfangswert Motortemperaturmodell" VALUE 0x815F86 KwUw 6553.500 t100msxs_uw_b6553p5 0.00 6553.500 FUNCTION_LIST GGTFM IF_DATA DIM_X DIRECT 0x815F86 /end CHARACTERISTIC
/begin CHARACTERISTIC TDTMNP "Entprellzeit Fehlererkennung Unplausibilität Signal TMOT" VALUE 0x815F88 KwUw 6553.500 t100msxs_uw_b6553p5 0.00 6553.500 FUNCTION_LIST GGTFM IF_DATA DIM_X DIRECT 0x815F88 /end CHARACTERISTIC
/begin CHARACTERISTIC TDTMNPO "Entprellzeit Fehlererkennung Unplausibilität oben TMOT" VALUE 0x81977D KwUb 25.50 t100msxs_ub_b25p5 0.00 25.50 FUNCTION_LIST GGTFM IF_DATA DIM_X DIRECT 0x81977D /end CHARACTERISTIC
/begin CHARACTERISTIC TDTMPOG "Entprellzeit Prüfung obere Unplausibilität gültig TMOT" VALUE 0x81977E KwUb 25.50 t100msxs_ub_b25p5 0.00 25.50 FUNCTION_LIST GGTFM IF_DATA DIM_X DIRECT 0x81977E /end CHARACTERISTIC
/begin CHARACTERISTIC TDTUM "Entprellzeit Fehlererkennung Umgebungslufttemperatur TUM" VALUE 0x81E4CE KwUw 65535.00 t1sxs_uw_q1 0.00 65535.00 FUNCTION_LIST BGTUMG IF_DATA DIM_X DIRECT 0x81E4CE /end CHARACTERISTIC
/begin CHARACTERISTIC TDUB "Wartezeit für UBATT-Diagnose" VALUE 0x811028 KwUb 25.50 t100msxs_ub_b25p5 0.00 25.50 FUNCTION_LIST GGUB IF_DATA DIM_X DIRECT 0x811028 /end CHARACTERISTIC
/begin CHARACTERISTIC TDUBHFM "Zeit für HFM-Diagnose mit u < UBHFM" VALUE 0x818891 KwUb 25.50 t100msxs_ub_b25p5 0.00 25.50 FUNCTION_LIST DHFM IF_DATA DIM_X DIRECT 0x818891 /end CHARACTERISTIC
/begin CHARACTERISTIC TDUBR "Entprellzeit für Diagnose UBR" VALUE 0x818710 KwUb 25.50 t100msxs_ub_b25p5 0.00 25.50 FUNCTION_LIST GGUBR IF_DATA DIM_X DIRECT 0x818710 /end CHARACTERISTIC
/begin CHARACTERISTIC TDUBRNL "Entprellzeit für Diagnose UBR im Nachlauf" VALUE 0x818711 KwUb 25.40 t100msxs_ub_b25p5 0.1000 25.50 FUNCTION_LIST GGUBR IF_DATA DIM_X DIRECT 0x818711 /end CHARACTERISTIC
/begin CHARACTERISTIC TDUHPOTI "Entprellzeit nach Klemme15_ein für Analogdiagnos" VALUE 0x81AC02 KwUb 25.50 t100msxs_ub_b25p5 0.00 25.50 FUNCTION_LIST GGHLA IF_DATA DIM_X DIRECT 0x81AC02 /end CHARACTERISTIC
/begin CHARACTERISTIC TDV "Fehlererkennung Tachosignal / Zeitdauer für Abfrage" VALUE 0x81870B KwUb 12.75 t50msxs_ub_b12p75 0.00 12.75 FUNCTION_LIST DVFZ IF_DATA DIM_X DIRECT 0x81870B /end CHARACTERISTIC
/begin CHARACTERISTIC TDVGDSLL "Verzögerungszeit für Drucksensorvergleich DSU/DSL im Leerlauf" VALUE 0x81889D KwUb 25.50 t100msxs_ub_b25p5 0.00 25.50 FUNCTION_LIST GGDSAS IF_DATA DIM_X DIRECT 0x81889D /end CHARACTERISTIC
/begin CHARACTERISTIC TDWPOPBP "Entprellzeit zur Deaktivierung der PWG/Brems-Plaus. über Pedalgradient" VALUE 0x81103E KwUb 2.550 t10msxs_ub_b2p55 0.00 2.550 FUNCTION_LIST GGPED IF_DATA DIM_X DIRECT 0x81103E /end CHARACTERISTIC
/begin CHARACTERISTIC TEBBREMS "Entprellzeit von B_brems" VALUE 0x81AFE1 KwUb 0.5000 t50msxs_q0p05 0.00 0.5000 FUNCTION_LIST GGPBKV IF_DATA DIM_X DIRECT 0x81AFE1 /end CHARACTERISTIC
/begin CHARACTERISTIC TEDTP "Einschaltdauer der LSU-Heizung während Kondenswasserphase" VALUE 0x812685 KwUb 2.550 t10msxs_ub_b2p55 0.00 2.550 FUNCTION_LIST HLSU IF_DATA DIM_X DIRECT 0x812685 /end CHARACTERISTIC
/begin CHARACTERISTIC TEEUHE "Entprellzeit für analogem Fenster" VALUE 0x81AC03 KwUb 25.50 t100msxs_ub_b25p5 0.00 25.50 FUNCTION_LIST GGHLA IF_DATA DIM_X DIRECT 0x81AC03 /end CHARACTERISTIC
/begin CHARACTERISTIC TEPBKVNB "Einschwingzeit der Bremskraftdruckreaktion nach Bremsen" VALUE 0x81AFF5 KwUb 25.50 t100msxs_ub_b25p5 0.00 25.50 FUNCTION_LIST DDSBKV IF_DATA DIM_X DIRECT 0x81AFF5 /end CHARACTERISTIC
/begin CHARACTERISTIC TEPBRKUP "Entprellzeit für Brems- und Kupplungsschalter" VALUE 0x811208 KwUb 5.100 t20msxs_ub_b5p1 0.00 5.100 FUNCTION_LIST GGEGAS IF_DATA DIM_X DIRECT 0x811208 /end CHARACTERISTIC
/begin CHARACTERISTIC TEPFGRH "Entprellzeit für FGR-Bedienhebel" VALUE 0x81871B KwUb 5.100 t20msxs_ub_b5p1 0.00 5.100 FUNCTION_LIST GGFGRH IF_DATA DIM_X DIRECT 0x81871B /end CHARACTERISTIC
/begin CHARACTERISTIC TETRST "Beginn Regelung Thermostat nach Start" VALUE 0x81AF3F KwUb 51.00 t200msxs_ub_b51 0.00 51.00 FUNCTION_LIST KMTR IF_DATA DIM_X DIRECT 0x81AF3F /end CHARACTERISTIC
/begin CHARACTERISTIC TEVCKMX "Maximale Spülzeit bei DLDP-TEV- Check" VALUE 0x817856 KwUw 655.3500 t10msxs_uw_b655p35 0.00 655.3500 FUNCTION_LIST DLDP IF_DATA DIM_X DIRECT 0x817856 /end CHARACTERISTIC
/begin CHARACTERISTIC TFASLAMN "Mindestzeit nach Katheizen für Testeranforderung Sekundärluftdiagnose" VALUE 0x81B1D8 KwUw 6553.500 t100msxs_uw_b6553p6 0.00 6553.500 FUNCTION_LIST SLS IF_DATA DIM_X DIRECT 0x81B1D8 /end CHARACTERISTIC
/begin CHARACTERISTIC TFGRABS "Zeitkonstante zum Entprellen der FGR-Abschaltung bei ABS-Bremsung" VALUE 0x8187F6 KwUb 0.4000 t20msxs_ub_b5p1 0.00 0.4000 FUNCTION_LIST FGRABED IF_DATA DIM_X DIRECT 0x8187F6 /end CHARACTERISTIC
/begin CHARACTERISTIC TFGRFDY "Toleranzzeit für Eingriffe von Fahrdynamikfunktionen im FGR-Betrieb" VALUE 0x81122A KwUb 5.100 t20msxs_ub_b5p1 0.00 5.100 FUNCTION_LIST FGRABED IF_DATA DIM_X DIRECT 0x81122A /end CHARACTERISTIC
/begin CHARACTERISTIC TFGRHE "Verzögerungszeit für Erkennung FGR-Bedienhebelfehler" VALUE 0x81871C KwUb 5.100 t20msxs_ub_b5p1 0.00 5.100 FUNCTION_LIST GGFGRH IF_DATA DIM_X DIRECT 0x81871C /end CHARACTERISTIC
/begin CHARACTERISTIC TFGRHSNP "Toleranzzeit für Unplausibilität FGR-Hauptschalter" VALUE 0x81871D KwUb 5.100 t20msxs_ub_b5p1 0.00 5.100 FUNCTION_LIST GGFGRH IF_DATA DIM_X DIRECT 0x81871D /end CHARACTERISTIC
/begin CHARACTERISTIC TFGRTIP "Zeit für Erkennung gehaltene FGR-Funktionstaste Beschleunigen oder Verzögern" VALUE 0x81871E KwUb 5.100 t20msxs_ub_b5p1 0.00 5.100 FUNCTION_LIST GGFGRH IF_DATA DIM_X DIRECT 0x81871E /end CHARACTERISTIC
/begin CHARACTERISTIC TFGRUM "Toleranzzeit für Erkennung FGR-Betrieb in der Funktionsüberwachung" VALUE 0x81122C KwUb 5.100 t20msxs_ub_b5p1 0.00 5.100 FUNCTION_LIST FGRABED IF_DATA DIM_X DIRECT 0x81122C /end CHARACTERISTIC
/begin CHARACTERISTIC TFGRUNUB "Toleranzzeit für Unterschreiten der unteren Beschl.schwelle im FGR-Betrieb" VALUE 0x81122D KwUb 5.100 t20msxs_ub_b5p1 0.00 5.100 FUNCTION_LIST FGRABED IF_DATA DIM_X DIRECT 0x81122D /end CHARACTERISTIC
/begin CHARACTERISTIC TFGRVRAB "FGR: Zeit für Geschwindigkeitsabschaltung über vroh =0" VALUE 0x81102F KwUb 5.100 t20msxs_ub_b5p1 0.00 5.100 FUNCTION_LIST GGVFZG IF_DATA DIM_X DIRECT 0x81102F /end CHARACTERISTIC
/begin CHARACTERISTIC TFIMSLI "Zeitkonstante für msli- und msln-Filter" VALUE 0x818389 KwUb 12.6996 zk100msxs_ub_b25p5 0.100392 12.8000 FUNCTION_LIST DSLSLRS IF_DATA DIM_X DIRECT 0x818389 /end CHARACTERISTIC
/begin CHARACTERISTIC TFIMSLIK "Zeitkonstante für msli- und msln-Filter bei Kurztest" VALUE 0x81838A KwUb 12.6996 zk100msxs_ub_b25p5 0.100392 12.8000 FUNCTION_LIST DSLSLRS IF_DATA DIM_X DIRECT 0x81838A /end CHARACTERISTIC
/begin CHARACTERISTIC TFIMSLO "Zeitkonstante für mslo- Filter" VALUE 0x81838B KwUb 12.6996 zk100msxs_ub_b25p5 0.100392 12.8000 FUNCTION_LIST DSLSLRS IF_DATA DIM_X DIRECT 0x81838B /end CHARACTERISTIC
/begin CHARACTERISTIC TFIMSLOK "Zeitkonstante für mslo- Filter bei Kurztest" VALUE 0x81838C KwUb 12.6996 zk100msxs_ub_b25p5 0.100392 12.8000 FUNCTION_LIST DSLSLRS IF_DATA DIM_X DIRECT 0x81838C /end CHARACTERISTIC
/begin CHARACTERISTIC TFIMSLV "Zeitkonstante für mslv- Filter" VALUE 0x81838D KwUb 12.6996 zk100msxs_ub_b25p5 0.100392 12.8000 FUNCTION_LIST DSLSLRS IF_DATA DIM_X DIRECT 0x81838D /end CHARACTERISTIC
/begin CHARACTERISTIC TFIMSLVK "Zeitkonstante für mslv- Filter bei Kurztest" VALUE 0x81838E KwUb 12.6996 zk100msxs_ub_b25p5 0.100392 12.8000 FUNCTION_LIST DSLSLRS IF_DATA DIM_X DIRECT 0x81838E /end CHARACTERISTIC
/begin CHARACTERISTIC TFLAGS_D_UC "" VAL_BLK 0x8124B4 KwbUb 255.0 dez 0.00 255.0 NUMBER 16 FUNCTION_LIST URCEIN IF_DATA DIM_X DIRECT 0x8124B4 /end CHARACTERISTIC
/begin CHARACTERISTIC TFLZLR "Verzögerung des B_fpld_ok  während Lüfterdeaktivierung" VALUE 0x81AF40 KwUb 25.50 t100msxs_ub_b25p5 0.00 25.50 FUNCTION_LIST KMTR IF_DATA DIM_X DIRECT 0x81AF40 /end CHARACTERISTIC
/begin CHARACTERISTIC TFMIZU "Filterzeitkonstante zur Filterung des zulässigen Moments" VALUE 0x81730A KwUw 655.34999985 zk10msxs_uw_b655 0.010000152590 655.36000000 FUNCTION_LIST MDZUL IF_DATA DIM_X DIRECT 0x81730A /end CHARACTERISTIC
/begin CHARACTERISTIC TFRA "Erkennungszeit für eingeschwungene Grundadaption von fra" VALUE 0x81954E KwUb 51.00 t200msxs_ub_b51 0.00 51.00 FUNCTION_LIST DKVS IF_DATA DIM_X DIRECT 0x81954E /end CHARACTERISTIC
/begin CHARACTERISTIC TFRAOZ "Verweilzeit in FRAO für Zyklusflag bei nicht eingeschw. Adaption" VALUE 0x81954F KwUb 51.00 t200msxs_ub_b51 0.00 51.00 FUNCTION_LIST DKVS IF_DATA DIM_X DIRECT 0x81954F /end CHARACTERISTIC
/begin CHARACTERISTIC TFRAUZ "Verweilzeit in FRAU für Zyklusflag bei nicht eingeschw. Adaption" VALUE 0x819550 KwUb 51.00 t200msxs_ub_b51 0.00 51.00 FUNCTION_LIST DKVS IF_DATA DIM_X DIRECT 0x819550 /end CHARACTERISTIC
/begin CHARACTERISTIC TFRMDTEE "Erkennungszeit für eingeschwungene frm" VALUE 0x81A781 KwUb 3.000 t100msxs_ub_b25p5 0.00 3.000 FUNCTION_LIST DTEV IF_DATA DIM_X DIRECT 0x81A781 /end CHARACTERISTIC
/begin CHARACTERISTIC TFRMST "Erkennungszeit für eingeschwungene Grundadaption von frm" VALUE 0x819551 KwUb 51.00 t200msxs_ub_b51 0.00 51.00 FUNCTION_LIST DKVS IF_DATA DIM_X DIRECT 0x819551 /end CHARACTERISTIC
/begin CHARACTERISTIC TFRMZST "Verweilzeit für unplausibles frm-Signal (Kurztest)" VALUE 0x819552 KwUb 51.00 t200msxs_ub_b51 0.00 51.00 FUNCTION_LIST DKVS IF_DATA DIM_X DIRECT 0x819552 /end CHARACTERISTIC
/begin CHARACTERISTIC TFTEINI "Zeit für Erkennung TE Stop" VALUE 0x817818 KwUw 6553.500 t100msxs_uw_b6553p5 0.00 6553.500 FUNCTION_LIST TEB IF_DATA DIM_X DIRECT 0x817818 /end CHARACTERISTIC
/begin CHARACTERISTIC TFUHPOTI "Entprellzeit nach Klemme15_ein" VALUE 0x81AC04 KwUb 25.50 t100msxs_ub_b25p5 0.00 25.50 FUNCTION_LIST GGHLA IF_DATA DIM_X DIRECT 0x81AC04 /end CHARACTERISTIC
/begin CHARACTERISTIC TFWDKPN "Zeitkonstante für Filterung der DK-Winkel vor Vergl. mit Ersatzwert aus Füllung" CURVE 0x81110C KlAUbSstUbWUb 2.54000 zk10msxs_ub_b2p55 0.0100000 2.55000 FUNCTION_LIST GGDVE IF_DATA DIM_X DIRECT 0x81110C /begin AXIS_DESCR STD_AXIS nmot nmot_ub_q40 6 0.00 10200. DEPOSIT ABSOLUT /end AXIS_DESCR /end CHARACTERISTIC
/begin CHARACTERISTIC TFWDKSOF "Zeit für Soll-Drosselklappenfilterung" VALUE 0x81132A KwUb 2.54000 zk10msxs_ub_b2p55 0.0100000 2.55000 FUNCTION_LIST FUEDK IF_DATA DIM_X DIRECT 0x81132A /end CHARACTERISTIC
/begin CHARACTERISTIC TFWDKSOM "Zeitkonstante für Drosselklappensollwinkelfilterung bei Kl15 aus" VALUE 0x81DC90 KwUw 655.34999985 zk10msxs_uw_b655 0.010000152590 655.36000000 FUNCTION_LIST WDKSOM IF_DATA DIM_X DIRECT 0x81DC90 /end CHARACTERISTIC
/begin CHARACTERISTIC TFWPFGR "Filterzeitkonstante für Berechnung wpfgr_w" VALUE 0x81D090 KwUw 1310.6999997 zk20msxs_uw_b1310p72 0.020000305180 1310.7200000 FUNCTION_LIST BGWPFGR IF_DATA DIM_X DIRECT 0x81D090 /end CHARACTERISTIC
/begin CHARACTERISTIC TGAALTWR "Zeit Zeitkonstante fürs Rücksetzen  der Gemischkorrektur auf letzten Tripwert" VALUE 0x81E044 KwUw 4.999924 zk200msxs_uw_b5 0.00 4.999924 FUNCTION_LIST LRA IF_DATA DIM_X DIRECT 0x81E044 /end CHARACTERISTIC
/begin CHARACTERISTIC TGAHBX "Zeit für GA-Anforderung nach erkannter unplausibler Beladung" VALUE 0x81E340 KwUw 6553.500 t100msxs_uw_b6553p6 0.00 6553.500 FUNCTION_LIST BBTEGA IF_DATA DIM_X DIRECT 0x81E340 /end CHARACTERISTIC
/begin CHARACTERISTIC TGGLS "Zeitdauer für ADC nach Interrupt im Funktionsrechner (Asic)" VALUE 0x811018 KwUb 2.000 t1msxms_q1 3.000 5.000 FUNCTION_LIST GGLSH IF_DATA DIM_X DIRECT 0x811018 /end CHARACTERISTIC
/begin CHARACTERISTIC TGRACMX "Überwachungszähler für obere Grenze der Botschaftszählerdifferenz GRA" VALUE 0x811230 KwUb 255.0 DEZ 0.00 255.0 FUNCTION_LIST GGCGRA IF_DATA DIM_X DIRECT 0x811230 /end CHARACTERISTIC
/begin CHARACTERISTIC TGRACNU "Überwachungszeit für untere Grenze der Botschaftszählerdifferenz GRA" VALUE 0x811231 KwUb 5.100 t20msxs_ub_b5p1 0.00 5.100 FUNCTION_LIST GGCGRA IF_DATA DIM_X DIRECT 0x811231 /end CHARACTERISTIC
/begin CHARACTERISTIC THDMB "Heilungs-Entprellzeit des Fehleintrags für dauerhafte Momentbegrenzung" VALUE 0x81A341 KwUb 255.0 t1sxs_ub_b255 0.00 255.0 FUNCTION_LIST MDKOG IF_DATA DIM_X DIRECT 0x81A341 /end CHARACTERISTIC
/begin CHARACTERISTIC THLDUVD "Haltezeit LDR Umluftventilsteuerung dynamisch" VALUE 0x816376 KwUw 3276.750 t50msxs_uw_b3276p75 0.00 3276.750 FUNCTION_LIST LDUVST IF_DATA DIM_X DIRECT 0x816376 /end CHARACTERISTIC
/begin CHARACTERISTIC THLKSLUE1 "Zeit zur Heilungsentprellung bei KS nach Masse" VALUE 0x81C7E4 KwUw 6553.500 fak_q0p1 0.00 6553.500 FUNCTION_LIST DKMTR IF_DATA DIM_X DIRECT 0x81C7E4 /end CHARACTERISTIC
/begin CHARACTERISTIC THLKSLUE2 "Zeit zum Zurücksetzten der Fehlerzähler wenn KS=0" VALUE 0x81C7E6 KwUw 6553.500 fak_q0p1 0.00 6553.500 FUNCTION_LIST DKMTR IF_DATA DIM_X DIRECT 0x81C7E6 /end CHARACTERISTIC
/begin CHARACTERISTIC THMDMIN "Mindest-Motortemperaturschwelle für Abfrage bei Thermostatdiagnose" VALUE 0x8197D6 KwUb 191.3 temp_ub_q0p75_o48 -48.00 143.3 FUNCTION_LIST DTHM IF_DATA DIM_X DIRECT 0x8197D6 /end CHARACTERISTIC
/begin CHARACTERISTIC THOPP1 "Fehlerzeit bei Hochohmigkeitsprüfung Poti 1" VALUE 0x81103F KwUb 2.550 t10msxs_ub_b2p55 0.00 2.550 FUNCTION_LIST GGPED IF_DATA DIM_X DIRECT 0x81103F /end CHARACTERISTIC
/begin CHARACTERISTIC THOPP2 "Fehlerzeit bei Hochohmigkeitsprüfung Poti 2" VALUE 0x811040 KwUb 2.550 t10msxs_ub_b2p55 0.00 2.550 FUNCTION_LIST GGPED IF_DATA DIM_X DIRECT 0x811040 /end CHARACTERISTIC
/begin CHARACTERISTIC THSHKTK "Kennlinie für die Ausschaltdauer der Sondenheizung abh. v.d. Abgastemp. h.Kat" CURVE 0x81C7B2 KlAUbSstUwWUb 2.550 t10msxs_q0p01_o0p05 -0.05000 2.500 FUNCTION_LIST HLSHK IF_DATA DIM_X DIRECT 0x81C7B2
 /begin AXIS_DESCR STD_AXIS tanhkm_w temp_q0p0234_o273 8 -273.1500 1262.827 DEPOSIT ABSOLUT /end AXIS_DESCR
/end CHARACTERISTIC
/begin CHARACTERISTIC THUHPOTI "Entprellzeit Fehlerheilung" VALUE 0x81AC05 KwUb 25.50 t100msxs_ub_b25p5 0.00 25.50 FUNCTION_LIST GGHLA IF_DATA DIM_X DIRECT 0x81AC05 /end CHARACTERISTIC
/begin CHARACTERISTIC TIDLEMAX "" VALUE 0x819CEE KwUb 0.00 t100msxs_ub_b25p5 10.00 10.00 FUNCTION_LIST K71MN IF_DATA DIM_X DIRECT 0x819CEE /end CHARACTERISTIC
/begin CHARACTERISTIC TIDLEMIN "" VALUE 0x819CEF KwUb 0.00 t100msxs_ub_b25p5 2.300 2.300 FUNCTION_LIST K71MN IF_DATA DIM_X DIRECT 0x819CEF /end CHARACTERISTIC
/begin CHARACTERISTIC TIKATMOE "Temperaturkorrektur im Kat ohne Exotherme tikatm" VALUE 0x81865F KwSb 1275. temp_q5 -640.0 635.0 FUNCTION_LIST ATM IF_DATA DIM_X DIRECT 0x81865F /end CHARACTERISTIC
/begin CHARACTERISTIC TIZUMN "Minimale Zeit für TEV-zu bei Initialspülung Leckdiagnose" VALUE 0x81A803 KwUb 255.0 t1sxs_ub_b255 0.00 255.0 FUNCTION_LIST DLDP IF_DATA DIM_X DIRECT 0x81A803 /end CHARACTERISTIC
/begin CHARACTERISTIC TKAELI "Temperatur Kühlerausgang Erfassung und Linearisierung" CURVE 0x81AFAA KlAUbSstUbWUb 191.3 temp_ub_q0p75_o48 -48.00 143.3 FUNCTION_LIST GGTKA IF_DATA DIM_X DIRECT 0x81AFAA /begin AXIS_DESCR STD_AXIS wtka spg_ub_b5 20 0.00 4.980 DEPOSIT ABSOLUT /end AXIS_DESCR /end CHARACTERISTIC
/begin CHARACTERISTIC TKATDSL "maximale Katalysatortemperatur für Freigabe SLS-Diagnose" VALUE 0x81838F KwUb 1275. temp_ub_q5_o50 -50.00 1225. FUNCTION_LIST DSLSLRS IF_DATA DIM_X DIRECT 0x81838F /end CHARACTERISTIC
/begin CHARACTERISTIC TKATMLRH "Einschaltschwelle Kat-Modelltemperatur  für Lambdaregelung hinter Kat" VALUE 0x81274B KwUb 1275. temp_ub_q5_o50 -50.00 1225. FUNCTION_LIST LRSHK IF_DATA DIM_X DIRECT 0x81274B /end CHARACTERISTIC
/begin CHARACTERISTIC TKATMN "Katalysatortemperaturregelschwelle für Kat warmhalten" VALUE 0x819842 KwUb 1275. temp_ub_q5_o50 -50.00 1225. FUNCTION_LIST BBKHZ IF_DATA DIM_X DIRECT 0x819842 /end CHARACTERISTIC
/begin CHARACTERISTIC TKATMOE "Temperaturkorrektur Kat ohne Exotherme tkatm" VALUE 0x818660 KwSb 1275. temp_q5 -640.0 635.0 FUNCTION_LIST ATM IF_DATA DIM_X DIRECT 0x818660 /end CHARACTERISTIC
/begin CHARACTERISTIC TKATSA "Katalysator-Temperaturschwelle für Schubabschalten" VALUE 0x819F29 KwUb 1275. temp_ub_q5_o50 -50.00 1225. FUNCTION_LIST BBSAWE IF_DATA DIM_X DIRECT 0x819F29 /end CHARACTERISTIC
/begin CHARACTERISTIC TKATSZA "Kat-Temperaturschwelle für Freigabe der Zwangsamplitude" VALUE 0x8174C8 KwUw 1279.980 temp_uw_q0p0195_o50 -50.00000 1229.980 FUNCTION_LIST LRS IF_DATA DIM_X DIRECT 0x8174C8 /end CHARACTERISTIC
/begin CHARACTERISTIC TKATVLSMN "Minimalwert-Soll-TKA" VALUE 0x81AF41 KwUb 191.3 temp_ub_q0p75_o48 -48.00 143.3 FUNCTION_LIST KMTR IF_DATA DIM_X DIRECT 0x81AF41 /end CHARACTERISTIC
/begin CHARACTERISTIC TKATVLSMX "Maximalwert-Soll-Tka" VALUE 0x81AF42 KwUb 191.3 temp_ub_q0p75_o48 -48.00 143.3 FUNCTION_LIST KMTR IF_DATA DIM_X DIRECT 0x81AF42 /end CHARACTERISTIC
/begin CHARACTERISTIC TKAUSDE "Ersatzgröße Temperatur Kühlerausgang im Fehlerfall" VALUE 0x81AFD3 KwUb 191.3 temp_ub_q0p75_o48 -48.00 143.3 FUNCTION_LIST GGTKA IF_DATA DIM_X DIRECT 0x81AFD3 /end CHARACTERISTIC
/begin CHARACTERISTIC TKAUSDMN "Min. Temperatur Kühlerausgang" VALUE 0x81AFD4 KwUb 191.3 temp_ub_q0p75_o48 -48.00 143.3 FUNCTION_LIST GGTKA IF_DATA DIM_X DIRECT 0x81AFD4 /end CHARACTERISTIC
/begin CHARACTERISTIC TKAUSDMX "Max. Temperatur Kühlerausgang" VALUE 0x81AFD5 KwUb 191.3 temp_ub_q0p75_o48 -48.00 143.3 FUNCTION_LIST GGTKA IF_DATA DIM_X DIRECT 0x81AFD5 /end CHARACTERISTIC
/begin CHARACTERISTIC TKD "Lernzeit für Kick-Down-Position" VALUE 0x81105B KwUb 2.550 t10msxs_ub_b2p55 0.00 2.550 FUNCTION_LIST BBKD IF_DATA DIM_X DIRECT 0x81105B /end CHARACTERISTIC
/begin CHARACTERISTIC TKHFSAB "Entprellzeit für Umschaltung auf Katheizdrehzahl bei Fahrstufe" VALUE 0x81EDD2 KwUw 6553.500 t100msxs_uw_b6553p5 0.00 6553.500 FUNCTION_LIST BBKHZ IF_DATA DIM_X DIRECT 0x81EDD2 /end CHARACTERISTIC
/begin CHARACTERISTIC TKHLL "Abbruchzeit Katheizen Leerlauf" VALUE 0x81EDD4 KwUw 6553.500 t100msxs_uw_b6553p5 0.00 6553.500 FUNCTION_LIST BBKHZ IF_DATA DIM_X DIRECT 0x81EDD4 /end CHARACTERISTIC
/begin CHARACTERISTIC TKHLLMX "Maximale Zeit für angehobene Katheiz-Drehzahl" VALUE 0x81EDD6 KwUw 655.3500 t10msxs_uw_b655p35 0.00 655.3500 FUNCTION_LIST BBKHZ IF_DATA DIM_X DIRECT 0x81EDD6 /end CHARACTERISTIC
/begin CHARACTERISTIC TKHMX "Maximale Einschaltdauer der Funktion Katheizen" VALUE 0x81EDD8 KwUw 655.3500 t10msxs_uw_b655p35 0.00 655.3500 FUNCTION_LIST BBKHZ IF_DATA DIM_X DIRECT 0x81EDD8 /end CHARACTERISTIC
/begin CHARACTERISTIC TKHNAB "Zeitdauer Absteuern Katheizdrehzahl" VALUE 0x81EDDA KwUw 6553.500 t100msxs_uw_b6553p5 0.00 6553.500 FUNCTION_LIST BBKHZ IF_DATA DIM_X DIRECT 0x81EDDA /end CHARACTERISTIC
/begin CHARACTERISTIC TKLIHDV "Totzeit für Lüfter schnell-Hochlauf" VALUE 0x81AF43 KwUb 255.0 t1sxs_ub_b255 0.00 255.0 FUNCTION_LIST KMTR IF_DATA DIM_X DIRECT 0x81AF43 /end CHARACTERISTIC
/begin CHARACTERISTIC TKOAMAD "Kompressorsperrzeit für Bedarfsadaption" VALUE 0x812DA4 KwUb 51.00 t200msxs_ub_b51 0.00 51.00 FUNCTION_LIST KOS IF_DATA DIM_X DIRECT 0x812DA4 /end CHARACTERISTIC
/begin CHARACTERISTIC TKOAMNN "Minimale Abschaltzeit des Klimakompressors" CURVE 0x817BF0 GklWUw 1310.700 t20msxs_uw_b1310 0.00 1310.700 FUNCTION_LIST KOS IF_DATA DIM_X DIRECT 0x817BF0
 /begin AXIS_DESCR COM_AXIS nmot nmot_ub_q40 8 0.00 10200. AXIS_PTS_REF SNM08KOUB /end AXIS_DESCR
/end CHARACTERISTIC
/begin CHARACTERISTIC TKOAMXN "Maximale Abschaltzeit des Klimakompressors" CURVE 0x812DA5 GklWUb 51.00 t200msxs_ub_b51 0.00 51.00 FUNCTION_LIST KOS IF_DATA DIM_X DIRECT 0x812DA5
 /begin AXIS_DESCR COM_AXIS nmot nmot_ub_q40 8 0.00 10200. AXIS_PTS_REF SNM08KOUB /end AXIS_DESCR
/end CHARACTERISTIC
/begin CHARACTERISTIC TKOBEMNN "Minimale Einschaltzeit des Kompres. nach Auslösung über B_kobped oder B_kobwped" CURVE 0x812DAD GklWUb 51.00 t200msxs_ub_b51 0.00 51.00 FUNCTION_LIST KOS IF_DATA DIM_X DIRECT 0x812DAD
 /begin AXIS_DESCR COM_AXIS nmot nmot_ub_q40 8 0.00 10200. AXIS_PTS_REF SNM08KOUB /end AXIS_DESCR
/end CHARACTERISTIC
/begin CHARACTERISTIC TKODPAMNN "minimale Abschaltzeit des Klimakompressors  bei Beschleunigung ( dwped )" CURVE 0x812DB5 GklWUb 51.00 t200msxs_ub_b51 0.00 51.00 FUNCTION_LIST KOS IF_DATA DIM_X DIRECT 0x812DB5
 /begin AXIS_DESCR COM_AXIS nmot nmot_ub_q40 8 0.00 10200. AXIS_PTS_REF SNM08KOUB /end AXIS_DESCR
/end CHARACTERISTIC
/begin CHARACTERISTIC TKODPAMXN "Maximale Ausschaltzeit bei Kompressorausschalten  über dwped" CURVE 0x812DBD GklWUb 51.00 t200msxs_ub_b51 0.00 51.00 FUNCTION_LIST KOS IF_DATA DIM_X DIRECT 0x812DBD
 /begin AXIS_DESCR COM_AXIS nmot nmot_ub_q40 8 0.00 10200. AXIS_PTS_REF SNM08KOUB /end AXIS_DESCR
/end CHARACTERISTIC
/begin CHARACTERISTIC TKOEMNN "Minimale Einschaltzeit des Klimakompressors" CURVE 0x812DC5 GklWUb 51.00 t200msxs_ub_b51 0.00 51.00 FUNCTION_LIST KOS IF_DATA DIM_X DIRECT 0x812DC5
 /begin AXIS_DESCR COM_AXIS nmot nmot_ub_q40 8 0.00 10200. AXIS_PTS_REF SNM08KOUB /end AXIS_DESCR
/end CHARACTERISTIC
/begin CHARACTERISTIC TKOMBKOA "Motortemperaturschwelle aus Kombiinstrument für Kompressorabschaltung" VALUE 0x812DCD KwUb 191.3 temp_ub_q0p75_o48 -48.00 143.3 FUNCTION_LIST KOS IF_DATA DIM_X DIRECT 0x812DCD /end CHARACTERISTIC
/begin CHARACTERISTIC TKOMBKOE "Motortemperaturschwelle aus Kombiinstrument für Kompressoreinschaltung" VALUE 0x812DCE KwUb 191.3 temp_ub_q0p75_o48 -48.00 143.3 FUNCTION_LIST KOS IF_DATA DIM_X DIRECT 0x812DCE /end CHARACTERISTIC
/begin CHARACTERISTIC TKOVKO "Überwachungzeit  zur Klimatasteerken. nach Reset von B_kov (bidrekt. Schnittst.)" VALUE 0x812DCF KwUb 5.100 t20msxs_ub_b5p1 0.00 5.100 FUNCTION_LIST KOS IF_DATA DIM_X DIRECT 0x812DCF /end CHARACTERISTIC
/begin CHARACTERISTIC TKOWPAMNN "Minimale Abschaltzeit bei Vollast (über wped)" CURVE 0x812DD0 GklWUb 51.00 t200msxs_ub_b51 0.00 51.00 FUNCTION_LIST KOS IF_DATA DIM_X DIRECT 0x812DD0
 /begin AXIS_DESCR COM_AXIS nmot nmot_ub_q40 8 0.00 10200. AXIS_PTS_REF SNM08KOUB /end AXIS_DESCR
/end CHARACTERISTIC
/begin CHARACTERISTIC TKOWPAMXN "maximale Ausschaltzeit bei Vollast (über wped)" CURVE 0x812DD8 GklWUb 51.00 t200msxs_ub_b51 0.00 51.00 FUNCTION_LIST KOS IF_DATA DIM_X DIRECT 0x812DD8
 /begin AXIS_DESCR COM_AXIS nmot nmot_ub_q40 8 0.00 10200. AXIS_PTS_REF SNM08KOUB /end AXIS_DESCR
/end CHARACTERISTIC
/begin CHARACTERISTIC TKSDLRSCTR "Entprellzeit Rücksetzen des Fehlerzählers" VALUE 0x8187F2 KwUb 25.50 t100msxs_ub_b25p5 0.00 25.50 FUNCTION_LIST DKMTR IF_DATA DIM_X DIRECT 0x8187F2 /end CHARACTERISTIC
/begin CHARACTERISTIC TKSTBFA "Modell-Temperatur hinter Hauptkat Startwert bei B_faatm Anforderun" VALUE 0x818661 KwUb 1275. temp_ub_q5_o50 -50.00 1225. FUNCTION_LIST ATM IF_DATA DIM_X DIRECT 0x818661 /end CHARACTERISTIC
/begin CHARACTERISTIC TKTDGRA "Zeit für Tempereraturgradientenmessung der Katdiagnose" VALUE 0x8186E7 KwUb 51.00 t_q0p2 0.00 51.00 FUNCTION_LIST DKATSPEB IF_DATA DIM_X DIRECT 0x8186E7 /end CHARACTERISTIC
/begin CHARACTERISTIC TKTDSP "Wartezeit in der Katdiagnose auf die Schubprüfung" VALUE 0x81C708 KwUw 13107.00 t_q0p2 0.00 13107.00 FUNCTION_LIST DKATSPEB IF_DATA DIM_X DIRECT 0x81C708 /end CHARACTERISTIC
/begin CHARACTERISTIC TKWFS "" VALUE 0x8197DC KwUb 14.00 fak_q0p0625 1.000 15.00 FUNCTION_LIST ims_501 IF_DATA DIM_X DIRECT 0x8197DC /end CHARACTERISTIC
/begin CHARACTERISTIC TLADEGFE "Zeitschwelle: Langsamer Abgleich eingeschwungen für DEGFE" VALUE 0x81D74E KwUw 65535.00 t1sxs_uw_b65535 0.00 65535.00 FUNCTION_LIST DEGFE IF_DATA DIM_X DIRECT 0x81D74E /end CHARACTERISTIC
/begin CHARACTERISTIC TLAED "Wartezeit bis Fehlerlampe aus nach Start" VALUE 0x81847F KwUb 51.00 t200msxs_ub_b51 0.00 51.00 FUNCTION_LIST DMIL IF_DATA DIM_X DIRECT 0x81847F /end CHARACTERISTIC
/begin CHARACTERISTIC TLAKAMN "Mindestdauer Bed. lamsbrs_w oder lamsons_w > 1.0 für Funktion Kat.-Ausräumen" VALUE 0x812750 KwUb 5.100 t20msxs_ub_b5p1 0.00 5.100 FUNCTION_LIST LRSKA IF_DATA DIM_X DIRECT 0x812750 /end CHARACTERISTIC
/begin CHARACTERISTIC TLDIAN "Entprellzeit für Nachführung I-Adaption negativ" VALUE 0x819D46 KwUb 12.75 t50msxs_ub_b12p75 0.00 12.75 FUNCTION_LIST LDRPID IF_DATA DIM_X DIRECT 0x819D46 /end CHARACTERISTIC
/begin CHARACTERISTIC TLDIAPN "Entprellzeit für Nachführung I-Adaption positiv" CURVE 0x819D47 GklWUb 12.75 t50msxs_ub_b12p75 0.00 12.75 FUNCTION_LIST LDRPID IF_DATA DIM_X DIRECT 0x819D47
 /begin AXIS_DESCR COM_AXIS nmot nmot_ub_q40 8 0.00 10200. AXIS_PTS_REF SNM08LDUB /end AXIS_DESCR
/end CHARACTERISTIC
/begin CHARACTERISTIC TLDOBAN "Zeit für LDR-Overboost aktiv" CURVE 0x819D90 GklWUb 255.0 t1sxs_ub_b255 0.00 255.0 FUNCTION_LIST LDOB IF_DATA DIM_X DIRECT 0x819D90
 /begin AXIS_DESCR COM_AXIS nmot nmot_ub_q40 8 0.00 10200. AXIS_PTS_REF SNM08LDUB /end AXIS_DESCR
/end CHARACTERISTIC
/begin CHARACTERISTIC TLDOBN "Sperrzeit für LDR-Overboost" CURVE 0x819D98 GklWUb 12.75 t50msxs_ub_b12p75 0.00 12.75 FUNCTION_LIST LDOB IF_DATA DIM_X DIRECT 0x819D98
 /begin AXIS_DESCR COM_AXIS nmot nmot_ub_q40 8 0.00 10200. AXIS_PTS_REF SNM08LDUB /end AXIS_DESCR
/end CHARACTERISTIC
/begin CHARACTERISTIC TLDP1SD "Zeitschwelle 1 für Erkennung System dicht bei Leckdiagnosemodul" VALUE 0x817858 KwUw 655.3500 t10msxs_uw_b655p35 0.00 655.3500 FUNCTION_LIST DLDP IF_DATA DIM_X DIRECT 0x817858 /end CHARACTERISTIC
/begin CHARACTERISTIC TLDP2SD "Zeitschwelle 2 für Erkennung System dicht bei Leckdiagnosemodul" VALUE 0x81785A KwUw 655.3500 t10msxs_uw_b655p35 0.00 655.3500 FUNCTION_LIST DLDP IF_DATA DIM_X DIRECT 0x81785A /end CHARACTERISTIC
/begin CHARACTERISTIC TLDPMN "Wartezeit nach Start für Freigabe Leckdiagnose" VALUE 0x829DBA KwUw 65535.00 t1sxs_uw_b65535 0.00 65535.00 FUNCTION_LIST DLDP IF_DATA DIM_X DIRECT 0x829DBA /end CHARACTERISTIC
/begin CHARACTERISTIC TLDPMX "Maximale Diagnosezeit nach Start" VALUE 0x829DBC KwUw 65535.00 t1sxs_uw_b65535 0.00 65535.00 FUNCTION_LIST DLDP IF_DATA DIM_X DIRECT 0x829DBC /end CHARACTERISTIC
/begin CHARACTERISTIC TLDPRKL "Zeit für 'Reed-Kontakt zu'-Erkennung Closed Check" VALUE 0x81785C KwUw 655.3500 t10msxs_uw_b655p35 0.00 655.3500 FUNCTION_LIST DLDP IF_DATA DIM_X DIRECT 0x81785C /end CHARACTERISTIC
/begin CHARACTERISTIC TLDPRKO "Zeit für ""Reed-Kontankt offen""-Erkennung bei Leckdiagnosemodul" VALUE 0x81785E KwUw 655.3500 t10msxs_uw_b655p35 0.00 655.3500 FUNCTION_LIST DLDP IF_DATA DIM_X DIRECT 0x81785E /end CHARACTERISTIC
/begin CHARACTERISTIC TLDPZMN "Minimale Zeit für TEV-zu vor Fortsetzung Leckdiagnose" VALUE 0x817860 KwUw 655.3500 t10msxs_uw_b655p35 0.00 655.3500 FUNCTION_LIST DLDP IF_DATA DIM_X DIRECT 0x817860 /end CHARACTERISTIC
/begin CHARACTERISTIC TLKRLDAB "Zeitkonstante für langsame LDR-Absenkung" CURVE 0x827F84 GklWUw 3276.7499992 zk50msxs_uw_b3276p8 0.050000762951 3276.8000000 FUNCTION_LIST LDRLMX IF_DATA DIM_X DIRECT 0x827F84
 /begin AXIS_DESCR COM_AXIS nmot_w nmot_uw_q0p25 8 0.00 16383.75 AXIS_PTS_REF SNM08LDUW /end AXIS_DESCR
/end CHARACTERISTIC
/begin CHARACTERISTIC TLKRLDAU "Zeitkonstante für langsame LDR-Aufregelung" CURVE 0x827F94 GklWUw 3276.7499992 zk50msxs_uw_b3276p8 0.050000762951 3276.8000000 FUNCTION_LIST LDRLMX IF_DATA DIM_X DIRECT 0x827F94
 /begin AXIS_DESCR COM_AXIS nmot_w nmot_uw_q0p25 8 0.00 16383.75 AXIS_PTS_REF SNM08LDUW /end AXIS_DESCR
/end CHARACTERISTIC
/begin CHARACTERISTIC TLLASH "Verzög.zeit um lamlash_w zu sperren wenn lamsons_w ungleich lamlash_w ist" VALUE 0x818670 KwUb 25.50 t100msxs_ub_b25p5 0.00 25.50 FUNCTION_LIST DLSAHK IF_DATA DIM_X DIRECT 0x818670 /end CHARACTERISTIC
/begin CHARACTERISTIC TLMSSLAB "Entprellzeit für Abbruch Sekundärluftanfettung" VALUE 0x818351 KwUb 25.40 t100msxs_ub_b25p5 0.1000 25.50 FUNCTION_LIST SLS IF_DATA DIM_X DIRECT 0x818351 /end CHARACTERISTIC
/begin CHARACTERISTIC TLMSSLMX "Maximale Zeit für Sekundärluftanfettung im Leerlauf" VALUE 0x818352 KwUb 255.0 t100msxs_ub_b255 0.00 255.0 FUNCTION_LIST SLS IF_DATA DIM_X DIRECT 0x818352 /end CHARACTERISTIC
/begin CHARACTERISTIC TLRBAM "Sperrzeit für Einschalten LR nach BA" CURVE 0x8174DA KlAUbSstUbWUw 655.3500 t10msxs_uw_b655p35 0.00 655.3500 FUNCTION_LIST LRSEB IF_DATA DIM_X DIRECT 0x8174DA
 /begin AXIS_DESCR STD_AXIS tmot temp_ub_q0p75_o48 8 -48.00 143.3 DEPOSIT ABSOLUT /end AXIS_DESCR
/end CHARACTERISTIC
/begin CHARACTERISTIC TLRHS "Sperrzeit LR bei Heißstart, ausgelöst über Schwellen TASHS und TMSHS" VALUE 0x81A4A4 KwUb 25.50 t100msxs_ub_b25p5 0.00 25.50 FUNCTION_LIST LRSEB IF_DATA DIM_X DIRECT 0x81A4A4 /end CHARACTERISTIC
/begin CHARACTERISTIC TLRSZWSA "Zeitdauer für LRS-Zwangseinschaltung nach Schubabschneiden" VALUE 0x829C14 KwUw 6553.500 t100msxs_uw_b6553p5 0.00 6553.500 FUNCTION_LIST LRSEB IF_DATA DIM_X DIRECT 0x829C14 /end CHARACTERISTIC
/begin CHARACTERISTIC TLRTMS "Sperrzeit LR nach Start, abhängig von der Motortemperatur bei Start" CURVE 0x829C16 KlAUbSstUbWUw 6553.500 t100msxs_uw_b6553p5 0.00 6553.500 FUNCTION_LIST LRSEB IF_DATA DIM_X DIRECT 0x829C16
 /begin AXIS_DESCR STD_AXIS tmst temp_ub_q0p75_o48 5 -48.00 143.3 DEPOSIT ABSOLUT /end AXIS_DESCR
/end CHARACTERISTIC
/begin CHARACTERISTIC TLRVAM "Sperrzeit für Einschalten LR nach VA" CURVE 0x8174F4 KlAUbSstUbWUw 655.3500 t10msxs_uw_b655p35 0.00 655.3500 FUNCTION_LIST LRSEB IF_DATA DIM_X DIRECT 0x8174F4
 /begin AXIS_DESCR STD_AXIS tmot temp_ub_q0p75_o48 8 -48.00 143.3 DEPOSIT ABSOLUT /end AXIS_DESCR
/end CHARACTERISTIC
/begin CHARACTERISTIC TLRZWTMS "Zeit für Zwangseinschaltung LR (CARB-Forderung) nach Start" CURVE 0x829C26 KlAUbSstUbWUw 6553.500 t100msxs_uw_b6553p5 0.00 6553.500 FUNCTION_LIST LRSEB IF_DATA DIM_X DIRECT 0x829C26
 /begin AXIS_DESCR STD_AXIS tmst temp_ub_q0p75_o48 4 -48.00 143.3 DEPOSIT ABSOLUT /end AXIS_DESCR
/end CHARACTERISTIC
/begin CHARACTERISTIC TLSUTA "Kennlinie für die Einschaltdauer der LSU-Heizung nach Start" CURVE 0x81A48A KlAUbSstUbWUb 2.550 t10msxs_ub_b2p55 0.00 2.550 FUNCTION_LIST HLSU IF_DATA DIM_X DIRECT 0x81A48A
 /begin AXIS_DESCR STD_AXIS tans temp_ub_q0p75_o48 4 -48.00 143.3 DEPOSIT ABSOLUT /end AXIS_DESCR
/end CHARACTERISTIC
/begin CHARACTERISTIC TLSUVH "Zeit für LSU vorheizen" VALUE 0x812686 KwUb 25.50 t100msxs_ub_b25p5 0.00 25.50 FUNCTION_LIST HLSU IF_DATA DIM_X DIRECT 0x812686 /end CHARACTERISTIC
/begin CHARACTERISTIC TLUEST "Beginn Regelung Lüfter nach Start" VALUE 0x81AF44 KwUb 51.00 t200msxs_ub_b51 0.00 51.00 FUNCTION_LIST KMTR IF_DATA DIM_X DIRECT 0x81AF44 /end CHARACTERISTIC
/begin CHARACTERISTIC TMADB0 "Motortemperaturbereich 0 für Berechnung Kaltstartanreicherung" VALUE 0x811644 KwUb 255.0 dez 0.00 255.0 FUNCTION_LIST STADAP IF_DATA DIM_X DIRECT 0x811644 /end CHARACTERISTIC
/begin CHARACTERISTIC TMADB1 "Motortemperaturbereich 1 für Berechnung Kaltstartanreicherung" VALUE 0x811645 KwUb 255.0 dez 0.00 255.0 FUNCTION_LIST STADAP IF_DATA DIM_X DIRECT 0x811645 /end CHARACTERISTIC
/begin CHARACTERISTIC TMADB2 "Motortemperaturbereich 2 für Berechnung Kaltstartanreicherung" VALUE 0x811646 KwUb 255.0 dez 0.00 255.0 FUNCTION_LIST STADAP IF_DATA DIM_X DIRECT 0x811646 /end CHARACTERISTIC
/begin CHARACTERISTIC TMAXKATA "Maximale Kat.-Temperatur für Ausräumprüfung bei Katdiagnose" VALUE 0x8186DC KwUb 1275. temp_ub_q5_o50 -50.00 1225. FUNCTION_LIST DKATSP IF_DATA DIM_X DIRECT 0x8186DC /end CHARACTERISTIC
/begin CHARACTERISTIC TMAXKATS "maximale Kat-Temperatur für Kat-diagnose" VALUE 0x8186E8 KwUb 1275. temp_ub_q5_o50 -50.00 1225. FUNCTION_LIST DKATSPEB IF_DATA DIM_X DIRECT 0x8186E8 /end CHARACTERISTIC
/begin CHARACTERISTIC TMAXKATSO "maximale Kat-Temperatur für Kat-diagnose, oberes Band" VALUE 0x8186E9 KwUb 1275. temp_ub_q5_o50 -50.00 1225. FUNCTION_LIST DKATSPEB IF_DATA DIM_X DIRECT 0x8186E9 /end CHARACTERISTIC
/begin CHARACTERISTIC TMBVH "Verzögerungszeit für Aktivierung Mißbrauchsverhinderung" VALUE 0x81C7D0 KwUw 6553.500 t100msxs_uw_b6553p5 0.00 6553.500 FUNCTION_LIST GGPED IF_DATA DIM_X DIRECT 0x81C7D0 /end CHARACTERISTIC
/begin CHARACTERISTIC TMCC650 "KR-testmode am Pin ADT des CC650" VALUE 0x8198F7 KwUb 255.0 dez 0.00 255.0 FUNCTION_LIST GGKS IF_DATA DIM_X DIRECT 0x8198F7 /end CHARACTERISTIC
/begin CHARACTERISTIC TMDLLR "Motortemperaturschwelle für Diagnose Leerlaufsteller" VALUE 0x81A22C KwUb 191.3 temp_ub_q0p75_o48 -48.00 143.3 FUNCTION_LIST DLLR IF_DATA DIM_X DIRECT 0x81A22C /end CHARACTERISTIC
/begin CHARACTERISTIC TMDMAD "Motortemperaturschwelle für Freigabe der Adaption des Verlustmoments" VALUE 0x81A0C4 KwUb 191.3 temp_ub_q0p75_o48 -48.00 143.3 FUNCTION_LIST MDVERAD IF_DATA DIM_X DIRECT 0x81A0C4 /end CHARACTERISTIC
/begin CHARACTERISTIC TMDMMA "Anfangstemperatur für Motortemperaturmodell" VALUE 0x819781 KwUb 191.3 temp_ub_q0p75_o48 -48.00 143.3 FUNCTION_LIST GGTFM IF_DATA DIM_X DIRECT 0x819781 /end CHARACTERISTIC
/begin CHARACTERISTIC TMDMMAT "Ersatztemperatur abh. Abstellzeit während TDTMMA" CURVE 0x81E976 KlAUwSstUwWUw 191.2500 temp_ub_q0p75_o48 -48.00000 143.2500 FUNCTION_LIST GGTFM IF_DATA DIM_X DIRECT 0x81E976
 /begin AXIS_DESCR STD_AXIS tabst_w t1sxs_uw_q1 3 0.00 65535.00 DEPOSIT ABSOLUT /end AXIS_DESCR
/end CHARACTERISTIC
/begin CHARACTERISTIC TMDMMAU "Unterster Anfangswert aus tans für Motortemperaturmodell" VALUE 0x819782 KwUb 191.3 temp_ub_q0p75_o48 -48.00 143.3 FUNCTION_LIST GGTFM IF_DATA DIM_X DIRECT 0x819782 /end CHARACTERISTIC
/begin CHARACTERISTIC TMDMMEE "Endtemperatur für Ersatzwert Motortemperatur" VALUE 0x819783 KwUb 191.3 temp_ub_q0p75_o48 -48.00 143.3 FUNCTION_LIST GGTFM IF_DATA DIM_X DIRECT 0x819783 /end CHARACTERISTIC
/begin CHARACTERISTIC TMDMMER "Endtemperatur für Referenzwert Motortemperatur" VALUE 0x819784 KwUb 191.3 temp_ub_q0p75_o48 -48.00 143.3 FUNCTION_LIST GGTFM IF_DATA DIM_X DIRECT 0x819784 /end CHARACTERISTIC
/begin CHARACTERISTIC TMDMN "Motortemperatur min." VALUE 0x819785 KwUb 191.3 temp_ub_q0p75_o48 -48.00 143.3 FUNCTION_LIST GGTFM IF_DATA DIM_X DIRECT 0x819785 /end CHARACTERISTIC
/begin CHARACTERISTIC TMDMX "Motortemperatur max." VALUE 0x819786 KwUb 191.3 temp_ub_q0p75_o48 -48.00 143.3 FUNCTION_LIST GGTFM IF_DATA DIM_X DIRECT 0x819786 /end CHARACTERISTIC
/begin CHARACTERISTIC TMDNWMN "Minimale Motortemperatur zur Freigabe der Nockenwellendiagnose" VALUE 0x81A86D KwUb 191.3 temp_ub_q0p75_o48 -48.00 143.3 FUNCTION_LIST BBDNWS IF_DATA DIM_X DIRECT 0x81A86D /end CHARACTERISTIC
/begin CHARACTERISTIC TMDNWMX "Maximale Motortemperatur zur Freigabe der Nockenwellendiagnose" VALUE 0x81A86E KwUb 191.3 temp_ub_q0p75_o48 -48.00 143.3 FUNCTION_LIST BBDNWS IF_DATA DIM_X DIRECT 0x81A86E /end CHARACTERISTIC
/begin CHARACTERISTIC TMDSLAMN "min. Motortemperatur für Zusatzdiagnose" VALUE 0x818390 KwUb 191.3 temp_ub_q0p75_o48 -48.00 143.3 FUNCTION_LIST DSLSLRS IF_DATA DIM_X DIRECT 0x818390 /end CHARACTERISTIC
/begin CHARACTERISTIC TMDSLMN "min. Motortemperatur für DSLS" VALUE 0x818391 KwUb 191.3 temp_ub_q0p75_o48 -48.00 143.3 FUNCTION_LIST DSLSLRS IF_DATA DIM_X DIRECT 0x818391 /end CHARACTERISTIC
/begin CHARACTERISTIC TMDSLMX "max. Motortemperatur für DSLS" VALUE 0x818392 KwUb 191.3 temp_ub_q0p75_o48 -48.00 143.3 FUNCTION_LIST DSLSLRS IF_DATA DIM_X DIRECT 0x818392 /end CHARACTERISTIC
/begin CHARACTERISTIC TMDTEU "Untere Motortemperaturschwelle für Tankentlüftungsdiagnose" VALUE 0x81A782 KwUb 63.75 temp_ub_q0p75_o48 27.00 90.75 FUNCTION_LIST DTEV IF_DATA DIM_X DIRECT 0x81A782 /end CHARACTERISTIC
/begin CHARACTERISTIC TMDV "Motortemperaturschwelle für Freigabe Fz-Geschwindigkeits-Diagnose" VALUE 0x81870C KwUb 191.3 temp_ub_q0p75_o48 -48.00 143.3 FUNCTION_LIST DVFZ IF_DATA DIM_X DIRECT 0x81870C /end CHARACTERISTIC
/begin CHARACTERISTIC TMDYNA "TMOT - Schwelle für Lastdynamikadaption aktiv" VALUE 0x811C43 KwUb 191.3 temp_ub_q0p75_o48 -48.00 143.3 FUNCTION_LIST KRDY IF_DATA DIM_X DIRECT 0x811C43 /end CHARACTERISTIC
/begin CHARACTERISTIC TMELIPU1 "Motor-Temperatur: Erfassung u. Linearisierung, Inverskennlinie 1, pullup aktiv" CURVE 0x81E984 KlAUwSstUwWUw 191.9971 temp_uw_q0p0029_o48 -48.00000 143.9971 FUNCTION_LIST GGTFM IF_DATA DIM_X DIRECT 0x81E984
 /begin AXIS_DESCR STD_AXIS wtmot_w spg_uw_q0p00488 20 0.00 319.9951 DEPOSIT ABSOLUT /end AXIS_DESCR
/end CHARACTERISTIC
/begin CHARACTERISTIC TMEWDTEU "Untere Temperaturschwelle für TE-Diagnose bezogen auf modellierte Motortemp." VALUE 0x81A783 KwUb 191.3 temp_ub_q0p75_o48 -48.00 143.3 FUNCTION_LIST DTEV IF_DATA DIM_X DIRECT 0x81A783 /end CHARACTERISTIC
/begin CHARACTERISTIC TMEWKMTR "KMTR Ersatzwert Motortemperatur" VALUE 0x81AF45 KwUb 191.3 temp_ub_q0p75_o48 -48.00 143.3 FUNCTION_LIST KMTR IF_DATA DIM_X DIRECT 0x81AF45 /end CHARACTERISTIC
/begin CHARACTERISTIC TMEWRAA "Einschalttemperatur LRA bezogen auf die modellierte Motortemperatur" VALUE 0x81930A KwUb 191.3 temp_ub_q0p75_o48 -48.00 143.3 FUNCTION_LIST LRAEB IF_DATA DIM_X DIRECT 0x81930A /end CHARACTERISTIC
/begin CHARACTERISTIC TMFASLMN "Motortemperaturschwelle Testeranforderung Sekundärluftdiagnose" VALUE 0x818353 KwUb 191.3 temp_ub_q0p75_o48 -48.00 143.3 FUNCTION_LIST SLS IF_DATA DIM_X DIRECT 0x818353 /end CHARACTERISTIC
/begin CHARACTERISTIC TMFFO "Obere tmot-Schwelle für 0.5 mm - Diagnose" VALUE 0x81A804 KwUb 191.3 temp_ub_q0p75_o48 -48.00 143.3 FUNCTION_LIST DLDP IF_DATA DIM_X DIRECT 0x81A804 /end CHARACTERISTIC
/begin CHARACTERISTIC TMFRATMN "minimale Temperatur bei der ftklra_w = 1 ist" VALUE 0x819065 KwUb 191.3 temp_ub_q0p75_o48 -48.00 143.3 FUNCTION_LIST LRA IF_DATA DIM_X DIRECT 0x819065 /end CHARACTERISTIC
/begin CHARACTERISTIC TMFRATUB "untere Temperaturschwelle  bei der ftklra_w Konstant bleibt" VALUE 0x819066 KwUb 191.3 temp_ub_q0p75_o48 -48.00 143.3 FUNCTION_LIST LRA IF_DATA DIM_X DIRECT 0x819066 /end CHARACTERISTIC
/begin CHARACTERISTIC TMFRST "Einschalttemperatur LR- Kurztest" VALUE 0x819553 KwUb 191.3 temp_ub_q0p75_o48 -48.00 143.3 FUNCTION_LIST DKVS IF_DATA DIM_X DIRECT 0x819553 /end CHARACTERISTIC
/begin CHARACTERISTIC TMH "Motortemperatur - Schwelle heiß" VALUE 0x811BBA KwUb 191.3 temp_ub_q0p75_o48 -48.00 143.3 FUNCTION_LIST ESSTT IF_DATA DIM_X DIRECT 0x811BBA /end CHARACTERISTIC
/begin CHARACTERISTIC TMHLL "Motortemperaturschwelle für erhöhte Solldrehzahl im Heiß-Leerlauf" VALUE 0x81A079 KwUb 191.3 temp_ub_q0p75_o48 -48.00 143.3 FUNCTION_LIST LLRNS IF_DATA DIM_X DIRECT 0x81A079 /end CHARACTERISTIC
/begin CHARACTERISTIC TMHSG "Motortemperatur Heißstartgrenze" VALUE 0x811BBB KwUb 191.3 temp_ub_q0p75_o48 -48.00 143.3 FUNCTION_LIST ESSTT IF_DATA DIM_X DIRECT 0x811BBB /end CHARACTERISTIC
/begin CHARACTERISTIC TMINKATS "Minimale Kat-Temperatur für Überwachung" VALUE 0x8186EA KwUb 1275. temp_ub_q5_o50 -50.00 1225. FUNCTION_LIST DKATSPEB IF_DATA DIM_X DIRECT 0x8186EA /end CHARACTERISTIC
/begin CHARACTERISTIC TMINKATSO "Minimale Kat-Temperatur für Überwachung, oberes Band" VALUE 0x8186EB KwUb 1275. temp_ub_q5_o50 -50.00 1225. FUNCTION_LIST DKATSPEB IF_DATA DIM_X DIRECT 0x8186EB /end CHARACTERISTIC
/begin CHARACTERISTIC TMK "Motortemperatur - Schwelle kalt" VALUE 0x811BBC KwUb 191.3 temp_ub_q0p75_o48 -48.00 143.3 FUNCTION_LIST ESSTT IF_DATA DIM_X DIRECT 0x811BBC /end CHARACTERISTIC
/begin CHARACTERISTIC TMKIMN "Temperaturschwelle für Umschaltung auf Ersatzsignal" VALUE 0x8197DA KwUb 191.3 temp_ub_q0p75_o48 -48.00 143.3 FUNCTION_LIST GGGTS IF_DATA DIM_X DIRECT 0x8197DA /end CHARACTERISTIC
/begin CHARACTERISTIC TMKOAO "Obere Motortemperaturschwelle für Kompressorabschaltung" VALUE 0x812DE0 KwUb 191.3 temp_ub_q0p75_o48 -48.00 143.3 FUNCTION_LIST KOS IF_DATA DIM_X DIRECT 0x812DE0 /end CHARACTERISTIC
/begin CHARACTERISTIC TMKOAU "Untere Motortemperaturschwelle für Kompressorabschaltung" VALUE 0x812DE1 KwUb 191.3 temp_ub_q0p75_o48 -48.00 143.3 FUNCTION_LIST KOS IF_DATA DIM_X DIRECT 0x812DE1 /end CHARACTERISTIC
/begin CHARACTERISTIC TMKR "Motortemperaturschwelle für Klopfregelung aktiv" VALUE 0x819B7F KwUb 191.3 temp_ub_q0p75_o48 -48.00 143.3 FUNCTION_LIST KRRA GGKS IF_DATA DIM_X DIRECT 0x819B7F /end CHARACTERISTIC
/begin CHARACTERISTIC TMKRA "Motortemperaturschwelle für adaptive Klopfregelung" VALUE 0x819B80 KwUb 191.3 temp_ub_q0p75_o48 -48.00 143.3 FUNCTION_LIST KRRA IF_DATA DIM_X DIRECT 0x819B80 /end CHARACTERISTIC
/begin CHARACTERISTIC TMKRAS "Temperaturschwelle für Freigabe Schreibzugriffe auf Adaptions-KF" VALUE 0x819B81 KwUb 191.3 temp_ub_q0p75_o48 -48.00 143.3 FUNCTION_LIST KRRA IF_DATA DIM_X DIRECT 0x819B81 /end CHARACTERISTIC
/begin CHARACTERISTIC TMLAST "Sperrzeit bis zum Auslösen des Ini der AR beim Verzögern" VALUE 0x811F16 KwUb 2.550 t10msxs_ub_b2p55 0.00 2.550 FUNCTION_LIST ARMD IF_DATA DIM_X DIRECT 0x811F16 /end CHARACTERISTIC
/begin CHARACTERISTIC TMLDPO "Obere Motortemperaturschwelle für Leckdiagnosemodul" VALUE 0x81A805 KwUb 191.3 temp_ub_q0p75_o48 -48.00 143.3 FUNCTION_LIST DLDP IF_DATA DIM_X DIRECT 0x81A805 /end CHARACTERISTIC
/begin CHARACTERISTIC TMLDPU "Untere Motortemperaturschwelle für Leckdiagnosemodul" VALUE 0x81A806 KwUb 191.3 temp_ub_q0p75_o48 -48.00 143.3 FUNCTION_LIST DLDP IF_DATA DIM_X DIRECT 0x81A806 /end CHARACTERISTIC
/begin CHARACTERISTIC TMLIM "TMOT Schwelle für  KSTAA aktiv im Nachstart" VALUE 0x811647 KwUb 191.3 temp_ub_q0p75_o48 -48.00 143.3 FUNCTION_LIST STADAP IF_DATA DIM_X DIRECT 0x811647 /end CHARACTERISTIC
/begin CHARACTERISTIC TMLLAMN "Entprellzeit für Erkennung  Bedingung lamsons_w > 1" VALUE 0x81A531 KwUb 25.50 t100msxs_ub_b25p5 0.00 25.50 FUNCTION_LIST LRSHK IF_DATA DIM_X DIRECT 0x81A531 /end CHARACTERISTIC
/begin CHARACTERISTIC TMLLX "Kochschutzschwelle" VALUE 0x81A07A KwUb 191.3 temp_ub_q0p75_o48 -48.00 143.3 FUNCTION_LIST LLRNS IF_DATA DIM_X DIRECT 0x81A07A /end CHARACTERISTIC
/begin CHARACTERISTIC TMLRZAMN "Minimale Motortemperatur für Zusatzamplitude" VALUE 0x8126EF KwUb 191.3 temp_ub_q0p75_o48 -48.00 143.3 FUNCTION_LIST LRS IF_DATA DIM_X DIRECT 0x8126EF /end CHARACTERISTIC
/begin CHARACTERISTIC TMMXRT "max. Motortemperatur f. Retrigg. Modelle (Blockheater-Erkennung)" VALUE 0x819787 KwUb 191.3 temp_ub_q0p75_o48 -48.00 143.3 FUNCTION_LIST GGTFM IF_DATA DIM_X DIRECT 0x819787 /end CHARACTERISTIC
/begin CHARACTERISTIC TMN1DlUE1 "Fehlererkennungszeit für Hauptlüfter defekt" VALUE 0x81C7E8 KwUw 599.2000 fak_q0p1 0.8000000 600.0000 FUNCTION_LIST DKMTR IF_DATA DIM_X DIRECT 0x81C7E8 /end CHARACTERISTIC
/begin CHARACTERISTIC TMN2DLUE1 "Fehlererkennungszeit fürZusatzlüfter defekt" VALUE 0x81C7EA KwUw 599.2000 fak_q0p1 0.8000000 600.0000 FUNCTION_LIST DKMTR IF_DATA DIM_X DIRECT 0x81C7EA /end CHARACTERISTIC
/begin CHARACTERISTIC TMN3DLUE1 "Fehlererkennungszeit für beide Lüfter defekt" VALUE 0x81C7EC KwUw 599.2000 fak_q0p1 0.8000000 600.0000 FUNCTION_LIST DKMTR IF_DATA DIM_X DIRECT 0x81C7EC /end CHARACTERISTIC
/begin CHARACTERISTIC TMNKATST "Minimale Kat-Temperatur für Überwachung bei Testerbetrieb" VALUE 0x8186EC KwUb 1275. temp_ub_q5_o50 -50.00 1225. FUNCTION_LIST DKATSPEB IF_DATA DIM_X DIRECT 0x8186EC /end CHARACTERISTIC
/begin CHARACTERISTIC TMNKSLUE1 "Fehlererkennungszeit für echten KS" VALUE 0x81C7EE KwUw 6553.500 fak_q0p1 0.00 6553.500 FUNCTION_LIST DKMTR IF_DATA DIM_X DIRECT 0x81C7EE /end CHARACTERISTIC
/begin CHARACTERISTIC TMNSMN "Motortemperaturschwelle für die Nachstartaufweitung" VALUE 0x81223F KwUb 191.3 temp_ub_q0p75_o48 -48.00 143.3 FUNCTION_LIST MDZUL IF_DATA DIM_X DIRECT 0x81223F /end CHARACTERISTIC
/begin CHARACTERISTIC TMNSMN_UM "Motortemperaturschwelle für die Nachstartaufweitung in der FKT.-Überwachung" VALUE 0x814010 KwUb 191.3 temp_ub_q0p75_o48 -48.00 143.3 FUNCTION_LIST UFNSC IF_DATA DIM_X DIRECT 0x814010 /end CHARACTERISTIC
/begin CHARACTERISTIC TMNUUKA "Minimalzeit zwischen 2 Adaptionsvorgängen (ÜK-Adaption)" VALUE 0x811BF6 KwUb 1.850 t10msxs_ub_b2p55 0.7000 2.550 FUNCTION_LIST ESUKAS IF_DATA DIM_X DIRECT 0x811BF6 /end CHARACTERISTIC
/begin CHARACTERISTIC TMNWKH "Temperaturschwelle für Freigabe Nockenwellenkatheizfunktionalität" VALUE 0x81A825 KwUb 191.3 temp_ub_q0p75_o48 -48.00 143.3 FUNCTION_LIST BBNWS IF_DATA DIM_X DIRECT 0x81A825 /end CHARACTERISTIC
/begin CHARACTERISTIC TMNWLLKHE "Motortemperaturschwelle zur Aktivierung Katheiz KF im Leerlauf Einlaßnockenwelle" VALUE 0x8127A4 KwUb 191.3 temp_ub_q0p75_o48 -48.00 143.3 FUNCTION_LIST NWSOLLE IF_DATA DIM_X DIRECT 0x8127A4 /end CHARACTERISTIC
/begin CHARACTERISTIC TMNWMN "Minimal Motortemperaturschwelle für Freigabe Nockenwellenverstellung" VALUE 0x81A826 KwUb 191.3 temp_ub_q0p75_o48 -48.00 143.3 FUNCTION_LIST BBNWS IF_DATA DIM_X DIRECT 0x81A826 /end CHARACTERISTIC
/begin CHARACTERISTIC TMNWMX "Maximal Motortemperaturschwelle für Freigabe Nockenwellenverstellung" VALUE 0x81A827 KwUb 191.3 temp_ub_q0p75_o48 -48.00 143.3 FUNCTION_LIST BBNWS IF_DATA DIM_X DIRECT 0x81A827 /end CHARACTERISTIC
/begin CHARACTERISTIC TMNWST "Motortemoeraturschwelle für Nockenwellenfreigabe im Start" VALUE 0x81A828 KwUb 191.3 temp_ub_q0p75_o48 -48.00 143.3 FUNCTION_LIST BBNWS IF_DATA DIM_X DIRECT 0x81A828 /end CHARACTERISTIC
/begin CHARACTERISTIC TMODT "Schwelle Temperaturdifferenz Wassertemperatur für Heißstart" CURVE 0x811BBD KlAUbSstUbWUb 191.3 temp_ub_b191p25 0.00 191.3 FUNCTION_LIST ESSTT IF_DATA DIM_X DIRECT 0x811BBD
 /begin AXIS_DESCR STD_AXIS tmotab temp_ub_q0p75_o48 3 -48.00 143.3 DEPOSIT ABSOLUT /end AXIS_DESCR
/end CHARACTERISTIC
/begin CHARACTERISTIC TMORSTE "Obere Temperaturschwelle resetieren B_stendes bei B_stend = false" VALUE 0x811BC4 KwUb 191.3 temp_ub_q0p75_o48 -48.00 143.3 FUNCTION_LIST ESSTT IF_DATA DIM_X DIRECT 0x811BC4 /end CHARACTERISTIC
/begin CHARACTERISTIC TMOTDQMX "Max. Kühlmitteltemperaturschwelle zur Ansteuerung Lüfter über TKA" VALUE 0x81AF46 KwUb 191.3 temp_ub_q0p75_o48 -48.00 143.3 FUNCTION_LIST KMTR IF_DATA DIM_X DIRECT 0x81AF46 /end CHARACTERISTIC
/begin CHARACTERISTIC TMOTDTEV "Maximale Temperatur für Lüfter nicht anschalten beim TEV-Diagnose" VALUE 0x81AF47 KwUb 191.3 temp_ub_q0p75_o48 -48.00 143.3 FUNCTION_LIST KMTR IF_DATA DIM_X DIRECT 0x81AF47 /end CHARACTERISTIC
/begin CHARACTERISTIC TMOTELI "Temperatur Motor Erfassung u. Linearisierung, Inverskennlinie" CURVE 0x81E9D6 KlAUwSstUwWUw 191.9971 temp_uw_q0p0029_o48 -48.00000 143.9971 FUNCTION_LIST GGTFM IF_DATA DIM_X DIRECT 0x81E9D6
 /begin AXIS_DESCR STD_AXIS wtmot_w spg_uw_q0p00488 20 0.00 319.9951 DEPOSIT ABSOLUT /end AXIS_DESCR
/end CHARACTERISTIC
/begin CHARACTERISTIC TMOTKRMN "Minimale Motortemperatur für" VALUE 0x81AF48 KwUb 191.3 temp_ub_q0p75_o48 -48.00 143.3 FUNCTION_LIST KMTR IF_DATA DIM_X DIRECT 0x81AF48 /end CHARACTERISTIC
/begin COMPU_METHOD DEZ "1 : 1 Umrechnug (dez/hex)" RAT_FUNC "%6.2" "" COEFFS 0 1 0 0 0 1 /end COMPU_METHOD
/begin COMPU_METHOD dez "1 : 1 Umrechnug (dez/hex)" RAT_FUNC "%6.2" "" COEFFS 0 1 0 0 0 1 /end COMPU_METHOD
/begin COMPU_METHOD dezsub1 "" RAT_FUNC "%6.2" "-" COEFFS 0 1 -1 0 0 1 /end COMPU_METHOD
/begin COMPU_METHOD dtsegn_b720divZyl "" RAT_FUNC "%6.4" "grad/KW" COEFFS 0 182.044 0 0 0 1 /end COMPU_METHOD
/begin COMPU_METHOD fak_q0p00153 "" RAT_FUNC "%6.4" "-" COEFFS 0 256 0 0 0 0.390625 /end COMPU_METHOD
/begin COMPU_METHOD fak_q0p0625 "" RAT_FUNC "%6.4" "-" COEFFS 0 16 0 0 0 1 /end COMPU_METHOD
/begin COMPU_METHOD fak_q0p1 "" RAT_FUNC "%6.3" "" COEFFS 0 1 0 0 0 0.1 /end COMPU_METHOD
/begin COMPU_METHOD fak_sw_b1 "" RAT_FUNC "%7.6" "-" COEFFS 0 65536 0 0 0 2 /end COMPU_METHOD
/begin COMPU_METHOD fak_ub_b1 "" RAT_FUNC "%6.4" "-" COEFFS 0 256 0 0 0 1 /end COMPU_METHOD
/begin COMPU_METHOD fak_ub_b2 "" RAT_FUNC "%6.4" "-" COEFFS 0 256 0 0 0 2 /end COMPU_METHOD
/begin COMPU_METHOD fak_uw_b1 "" RAT_FUNC "%7.6" "-" COEFFS 0 65536 0 0 0 1 /end COMPU_METHOD
/begin COMPU_METHOD fak_uw_b16 "" RAT_FUNC "%6.5" "-" COEFFS 0 65536 0 0 0 16 /end COMPU_METHOD
/begin COMPU_METHOD fak_uw_b2 "" RAT_FUNC "%7.6" "-" COEFFS 0 65536 0 0 0 2 /end COMPU_METHOD
/begin COMPU_METHOD grd_sw_q0p78 "" RAT_FUNC "%6.3" "hPa/s" COEFFS 0 65536 0 0 0 51200 /end COMPU_METHOD
/begin COMPU_METHOD KennText "" RAT_FUNC "%6.2" "" COEFFS 0 1 0 0 0 1 /end COMPU_METHOD
/begin COMPU_METHOD kw_q1 "" RAT_FUNC "%6.2" "°KW" COEFFS 0 1 0 0 0 1 /end COMPU_METHOD
/begin COMPU_METHOD kw_q6 "" RAT_FUNC "%6.2" "°KW" COEFFS 0 1 0 0 0 6 /end COMPU_METHOD
/begin COMPU_METHOD kw_tooth_sy "" RAT_FUNC "%6.2" "°KW" COEFFS 0 0.166667 0 0 0 1 /end COMPU_METHOD
/begin COMPU_METHOD m_uw_b25p6 "" RAT_FUNC "%6.5" "kg/h" COEFFS 0 65536 0 0 0 25.6 /end COMPU_METHOD
/begin COMPU_METHOD m_uw_b6553p5 "" RAT_FUNC "%6.3" "kg/h" COEFFS 0 1 0 0 0 0.1 /end COMPU_METHOD
/begin COMPU_METHOD nmotd_sb_q10 "" RAT_FUNC "%6.1" "U/min" COEFFS 0 1 0 0 0 10 /end COMPU_METHOD
/begin COMPU_METHOD nmotg_sb_q100 "" RAT_FUNC "%6.0" "U/min/s" COEFFS 0 1 0 0 0 100 /end COMPU_METHOD
/begin COMPU_METHOD nmotg_sw_q0p15625 "" RAT_FUNC "%6.3" "U/min/s" COEFFS 0 1 0 0 0 0.15625 /end COMPU_METHOD
/begin COMPU_METHOD nmotg_sw_q0p39 "" RAT_FUNC "%6.3" "U/min/s" COEFFS 0 1 0 0 0 0.39063 /end COMPU_METHOD
/begin COMPU_METHOD nmotg_ub_q100 "" RAT_FUNC "%6.0" "U/min/s" COEFFS 0 1 0 0 0 100 /end COMPU_METHOD
/begin COMPU_METHOD nmot_q10 "" RAT_FUNC "%6.1" "" COEFFS 0 1 0 0 0 10 /end COMPU_METHOD
/begin COMPU_METHOD nmot_sw_q0p25 "" RAT_FUNC "%6.3" "U/min" COEFFS 0 1 0 0 0 0.25 /end COMPU_METHOD
/begin COMPU_METHOD nmot_ub_q10 "" RAT_FUNC "%6.1" "U/min" COEFFS 0 1 0 0 0 10 /end COMPU_METHOD
/begin COMPU_METHOD nmot_ub_q20 "" RAT_FUNC "%6.1" "U/min" COEFFS 0 1 0 0 0 20 /end COMPU_METHOD
/begin COMPU_METHOD nmot_ub_q40 "" RAT_FUNC "%6.1" "Upm" COEFFS 0 1 0 0 0 40 /end COMPU_METHOD
/begin COMPU_METHOD nmot_uw_q0p25 "" RAT_FUNC "%6.3" "U/min" COEFFS 0 1 0 0 0 0.25 /end COMPU_METHOD
/begin COMPU_METHOD p_q0p2 "" RAT_FUNC "%6.3" "bar" COEFFS 0 5 0 0 0 1 /end COMPU_METHOD
/begin COMPU_METHOD p_sw_q0p039 "" RAT_FUNC "%6.4" "hPa" COEFFS 0 256 0 0 0 10 /end COMPU_METHOD
/begin COMPU_METHOD p_ub_q10 "" RAT_FUNC "%6.1" "hPa" COEFFS 0 1 0 0 0 10 /end COMPU_METHOD
/begin COMPU_METHOD p_ub_q5 "" RAT_FUNC "%6.2" "hPa" COEFFS 0 1 0 0 0 5 /end COMPU_METHOD
/begin COMPU_METHOD p_uw_q0p039 "" RAT_FUNC "%6.4" "hPa" COEFFS 0 256 0 0 0 10 /end COMPU_METHOD
/begin COMPU_METHOD qnv_uw_b512 "" RAT_FUNC "%6.4" "(U/min)/(km/h)" COEFFS 0 65536 0 0 0 512 /end COMPU_METHOD
/begin COMPU_METHOD relnmot_q0p0039 "" RAT_FUNC "%6.4" "%/(U/min)" COEFFS 0 256 0 0 0 1 /end COMPU_METHOD
/begin COMPU_METHOD relPED_ub_b100 "" RAT_FUNC "%6.3" "% PED" COEFFS 0 255 0 0 0 100 /end COMPU_METHOD
/begin COMPU_METHOD rel_sb_q0p02 "" RAT_FUNC "%6.4" "%" COEFFS 0 50 0 0 0 1 /end COMPU_METHOD
/begin COMPU_METHOD rel_sw_b1536 "" RAT_FUNC "%6.4" "%" COEFFS 0 65536 0 0 0 3072 /end COMPU_METHOD
/begin COMPU_METHOD rel_sw_b192 "" RAT_FUNC "%6.4" "%" COEFFS 0 65536 0 0 0 384 /end COMPU_METHOD
/begin COMPU_METHOD rel_sw_b200 "" RAT_FUNC "%6.4" "%" COEFFS 0 65536 0 0 0 400 /end COMPU_METHOD
/begin COMPU_METHOD rel_sw_q0p1875 "" RAT_FUNC "%6.3" "%" COEFFS 0 65536 0 0 0 12288 /end COMPU_METHOD
/begin COMPU_METHOD rel_ub_b99p6 "" RAT_FUNC "%6.3" "%" COEFFS 0 256 0 0 0 100 /end COMPU_METHOD
/begin COMPU_METHOD rel_ub_q0p00153 "" RAT_FUNC "%6.4" "%" COEFFS 0 256 0 0 0 0.3906 /end COMPU_METHOD
/begin COMPU_METHOD rel_ub_q0p3906 "" RAT_FUNC "%6.3" "%" COEFFS 0 256 0 0 0 100 /end COMPU_METHOD
/begin COMPU_METHOD rel_ub_q0p75 "" RAT_FUNC "%6.3" "%" COEFFS 0 1 0 0 0 0.75 /end COMPU_METHOD
/begin COMPU_METHOD rel_uw_b100 "" RAT_FUNC "%6.4" "%" COEFFS 0 65536 0 0 0 100 /end COMPU_METHOD
/begin COMPU_METHOD rel_uw_b200 "" RAT_FUNC "%6.4" "%" COEFFS 0 65536 0 0 0 200 /end COMPU_METHOD
/begin COMPU_METHOD rel_uw_q0p0234 "" RAT_FUNC "%6.4" "%" COEFFS 0 32 0 0 0 0.75 /end COMPU_METHOD
/begin COMPU_METHOD rkti_p_sy "" RAT_FUNC "%6.4" "%/ms" COEFFS 0 27.962 0 0 0 1 /end COMPU_METHOD
/begin COMPU_METHOD spg_sw_q0p001222 "" RAT_FUNC "%6.4" "V" COEFFS 0 1 0 0 0 0.001222 /end COMPU_METHOD
/begin COMPU_METHOD spg_sw_q0p00488 "" RAT_FUNC "%6.4" "V" COEFFS 0 1024 0 0 0 5 /end COMPU_METHOD
/begin COMPU_METHOD spg_ubatt_w "" RAT_FUNC "%6.4" "V" COEFFS 0 1 0 0 0 0.0176 /end COMPU_METHOD
/begin COMPU_METHOD spg_ub_b28p5_w "" RAT_FUNC "%6.4" "V" COEFFS 0 1 0 0 0 0.027825 /end COMPU_METHOD
/begin COMPU_METHOD spg_ub_b320 "" RAT_FUNC "%6.2" "V" COEFFS 0 1 0 0 0 1.25 /end COMPU_METHOD
/begin COMPU_METHOD spg_ub_b5 "" RAT_FUNC "%6.4" "V" COEFFS 0 256 0 0 0 5 /end COMPU_METHOD
/begin COMPU_METHOD spg_ub_q0p0098 "" RAT_FUNC "%6.4" "V" COEFFS 0 256 0 0 0 2.5 /end COMPU_METHOD
/begin COMPU_METHOD spg_ub_q0p019 "" RAT_FUNC "%6.4" "V" COEFFS 0 256 0 0 0 5 /end COMPU_METHOD
/begin COMPU_METHOD spg_uw_b1p33 "" RAT_FUNC "%7.6" "V" COEFFS 0 65535 0 0 0 1.33 /end COMPU_METHOD
/begin COMPU_METHOD spg_uw_b5 "" RAT_FUNC "%6.4" "V" COEFFS 0 1024 0 0 0 5 /end COMPU_METHOD
/begin COMPU_METHOD spg_uw_q0p001222 "" RAT_FUNC "%6.4" "V" COEFFS 0 1 0 0 0 0.001222 /end COMPU_METHOD
/begin COMPU_METHOD spg_uw_q0p00488 "" RAT_FUNC "%6.4" "V" COEFFS 0 1024 0 0 0 5 /end COMPU_METHOD
/begin COMPU_METHOD s_q1_km "" RAT_FUNC "%6.2" "km" COEFFS 0 1 0 0 0 1 /end COMPU_METHOD
/begin COMPU_METHOD s_q6_km "" RAT_FUNC "%6.2" "km" COEFFS 0 1 0 0 0 6 /end COMPU_METHOD
/begin COMPU_METHOD t100msxs_ub_b255 "" RAT_FUNC "%6.2" "s" COEFFS 0 1 0 0 0 1 /end COMPU_METHOD
/begin COMPU_METHOD t100msxs_ub_b25p5 "" RAT_FUNC "%6.3" "s" COEFFS 0 1 0 0 0 0.1 /end COMPU_METHOD
/begin COMPU_METHOD t100msxs_uw_b6553p5 "" RAT_FUNC "%6.3" "s" COEFFS 0 1 0 0 0 0.1 /end COMPU_METHOD
/begin COMPU_METHOD t100msxs_uw_b6553p6 "" RAT_FUNC "%6.3" "s" COEFFS 0 10 0 0 0 1 /end COMPU_METHOD
/begin COMPU_METHOD t10msxs_q0p01_o0p05 "" RAT_FUNC "%6.4" "s" COEFFS 0 1 0.05 0 0 0.01 /end COMPU_METHOD
/begin COMPU_METHOD t10msxs_ub_b2p55 "" RAT_FUNC "%6.4" "s" COEFFS 0 1 0 0 0 0.01 /end COMPU_METHOD
/begin COMPU_METHOD t10msxs_uw_b655p35 "" RAT_FUNC "%6.4" "s" COEFFS 0 1 0 0 0 0.01 /end COMPU_METHOD
/begin COMPU_METHOD t1msxms_q1 "" RAT_FUNC "%6.2" "ms" COEFFS 0 1 0 0 0 1 /end COMPU_METHOD
/begin COMPU_METHOD t1sxs_ub_b255 "" RAT_FUNC "%6.2" "s" COEFFS 0 1 0 0 0 1 /end COMPU_METHOD
/begin COMPU_METHOD t1sxs_uw_b65535 "" RAT_FUNC "%6.2" "s" COEFFS 0 1 0 0 0 1 /end COMPU_METHOD
/begin COMPU_METHOD t1sxs_uw_q1 "" RAT_FUNC "%6.2" "s" COEFFS 0 1 0 0 0 1 /end COMPU_METHOD
/begin COMPU_METHOD t200msxs_sb_b25p5 "" RAT_FUNC "%6.3" "s" COEFFS 0 1 0 0 0 0.2 /end COMPU_METHOD
/begin COMPU_METHOD t200msxs_ub_b51 "" RAT_FUNC "%6.3" "s" COEFFS 0 1 0 0 0 0.2 /end COMPU_METHOD
/begin COMPU_METHOD t20msxs_q40p96 "" RAT_FUNC "%6.1" "s" COEFFS 0 1 0 0 0 40.96 /end COMPU_METHOD
/begin COMPU_METHOD t20msxs_ub_b5p1 "" RAT_FUNC "%6.4" "s" COEFFS 0 1 0 0 0 0.02 /end COMPU_METHOD
/begin COMPU_METHOD t20msxs_ub_q0p02 "" RAT_FUNC "%6.4" "s" COEFFS 0 50 0 0 0 1 /end COMPU_METHOD
/begin COMPU_METHOD t20msxs_uw_b1310 "" RAT_FUNC "%6.4" "s" COEFFS 0 1 0 0 0 0.02 /end COMPU_METHOD
/begin COMPU_METHOD t40msxs_uw_q0p04 "" RAT_FUNC "%6.4" "s" COEFFS 0 1 0 0 0 0.04 /end COMPU_METHOD
/begin COMPU_METHOD t40ms_ub_b10200 "" RAT_FUNC "%7.2" "ms" COEFFS 0 1 0 0 0 40 /end COMPU_METHOD
/begin COMPU_METHOD t40usxus_q40 "" RAT_FUNC "%6.1" "us" COEFFS 0 1 0 0 0 40 /end COMPU_METHOD
/begin COMPU_METHOD t50msxs_q0p05 "" RAT_FUNC "%6.4" "s" COEFFS 0 1 0 0 0 0.05 /end COMPU_METHOD
/begin COMPU_METHOD t50msxs_ub_b12p75 "" RAT_FUNC "%6.4" "s" COEFFS 0 1 0 0 0 0.05 /end COMPU_METHOD
/begin COMPU_METHOD t50msxs_uw_b3276p75 "" RAT_FUNC "%6.4" "s" COEFFS 0 1 0 0 0 0.05 /end COMPU_METHOD
/begin COMPU_METHOD temp_q0p0195 "" RAT_FUNC "%6.4" "Grad C" COEFFS 0 256 0 0 0 5 /end COMPU_METHOD
/begin COMPU_METHOD temp_q0p0234 "" RAT_FUNC "%6.4" "K" COEFFS 0 256 0 0 0 6 /end COMPU_METHOD
/begin COMPU_METHOD temp_q0p0234_o273 "" RAT_FUNC "%6.1" "Grad C" COEFFS 0 1 273.15 0 0 0.0234375 /end COMPU_METHOD
/begin COMPU_METHOD temp_q5 "" RAT_FUNC "%6.2" "Grad C" COEFFS 0 1 0 0 0 5 /end COMPU_METHOD
/begin COMPU_METHOD temp_q6_o273 "" RAT_FUNC "%6.1" "Grad C" COEFFS 0 1 273.15 0 0 6 /end COMPU_METHOD
/begin COMPU_METHOD temp_ub_b191p25 "" RAT_FUNC "%6.3" "Grad C" COEFFS 0 1 0 0 0 0.75 /end COMPU_METHOD
/begin COMPU_METHOD temp_ub_q0p75_o48 "" RAT_FUNC "%6.2" "Grad C" COEFFS 0 1 48 0 0 0.75 /end COMPU_METHOD
/begin COMPU_METHOD temp_ub_q1_o40 "" RAT_FUNC "%6.2" "Grad C" COEFFS 0 1 40 0 0 1 /end COMPU_METHOD
/begin COMPU_METHOD temp_ub_q5_o50 "" RAT_FUNC "%6.2" "Grad C" COEFFS 0 1 50 0 0 5 /end COMPU_METHOD
/begin COMPU_METHOD temp_uw_q0p0029_o48 "" RAT_FUNC "%6.2" "Grad C" COEFFS 0 256 12288 0 0 0.75 /end COMPU_METHOD
/begin COMPU_METHOD temp_uw_q0p0195_o50 "" RAT_FUNC "%6.2" "Grad C" COEFFS 0 256 12800 0 0 5 /end COMPU_METHOD
/begin COMPU_METHOD t_q0p2 "" RAT_FUNC "%6.3" "s" COEFFS 0 10 0 0 0 2 /end COMPU_METHOD
/begin COMPU_METHOD vfzg_ub_q1p25 "" RAT_FUNC "%6.2" "km/h" COEFFS 0 1 0 0 0 1.25 /end COMPU_METHOD
/begin COMPU_METHOD vs_q0p1 "" RAT_FUNC "%6.3" "mL/dT" COEFFS 0 1 0 0 0 0.1 /end COMPU_METHOD
/begin COMPU_METHOD zk100msxs_ub_b25p5 "" RAT_FUNC "%6.3" "s" COEFFS 0 0 256 0 10 0 /end COMPU_METHOD
/begin COMPU_METHOD zk10msxs_ub_b2p55 "" RAT_FUNC "%6.4" "s" COEFFS 0 0 255 0 100 0 /end COMPU_METHOD
/begin COMPU_METHOD zk10msxs_uw_b655 "" RAT_FUNC "%12.5" "s" COEFFS 0 0 65536 0 100 0 /end COMPU_METHOD
/begin COMPU_METHOD zk1sxs_ub_b255 "" RAT_FUNC "%6.2" "s" COEFFS 0 0 256 0 1 0 /end COMPU_METHOD
/begin COMPU_METHOD zk200msxs_uw_b5 "" RAT_FUNC "%7.6" "1/s" COEFFS 0 65536 0 0 0 5 /end COMPU_METHOD
/begin COMPU_METHOD zk20msxs_uw_b1310p72 "" RAT_FUNC "%12.4" "s" COEFFS 0 0 32768 0 25 0 /end COMPU_METHOD
/begin COMPU_METHOD zk40ms_ub_b10200 "" RAT_FUNC "%6.1" "ms" COEFFS 0 0 10240 0 1 40 /end COMPU_METHOD
/begin COMPU_METHOD zk50msxs_ub_b12p8 "" RAT_FUNC "%10.5" "s" COEFFS 0 0 128 0 10 0 /end COMPU_METHOD
/begin COMPU_METHOD zk50msxs_uw_b3276p8 "" RAT_FUNC "%12.4" "s" COEFFS 0 0 65536 0 20 0 /end COMPU_METHOD
/begin COMPU_METHOD defaultAscii "" RAT_FUNC "%6.2" "" COEFFS 0 1 0 0 0 1 /end COMPU_METHOD
/begin RECORD_LAYOUT FkfNoShNoOffWUb FNC_VALUES 1 UBYTE COLUMN_DIR DIRECT /end RECORD_LAYOUT
/begin RECORD_LAYOUT FklWSw FNC_VALUES 1 SWORD COLUMN_DIR DIRECT /end RECORD_LAYOUT
/begin RECORD_LAYOUT FklWUb FNC_VALUES 1 UBYTE COLUMN_DIR DIRECT /end RECORD_LAYOUT
/begin RECORD_LAYOUT FklWUw FNC_VALUES 1 UWORD COLUMN_DIR DIRECT /end RECORD_LAYOUT
/begin RECORD_LAYOUT GkfWUb FNC_VALUES 1 UBYTE COLUMN_DIR DIRECT /end RECORD_LAYOUT
/begin RECORD_LAYOUT GklWSw FNC_VALUES 1 SWORD COLUMN_DIR DIRECT /end RECORD_LAYOUT
/begin RECORD_LAYOUT GklWUb FNC_VALUES 1 UBYTE COLUMN_DIR DIRECT /end RECORD_LAYOUT
/begin RECORD_LAYOUT GklWUw FNC_VALUES 1 UWORD COLUMN_DIR DIRECT /end RECORD_LAYOUT
/begin RECORD_LAYOUT KfWUb FNC_VALUES 1 UBYTE COLUMN_DIR DIRECT /end RECORD_LAYOUT
/begin RECORD_LAYOUT KlAUbSstSbWUb NO_AXIS_PTS_X 1 UBYTE AXIS_PTS_X 2 SBYTE INDEX_INCR DIRECT FNC_VALUES 3 UBYTE COLUMN_DIR DIRECT /end RECORD_LAYOUT
/begin RECORD_LAYOUT KlAUbSstUbWUb NO_AXIS_PTS_X 1 UBYTE AXIS_PTS_X 2 UBYTE INDEX_INCR DIRECT FNC_VALUES 3 UBYTE COLUMN_DIR DIRECT /end RECORD_LAYOUT
/begin RECORD_LAYOUT KlAUbSstUbWUw NO_AXIS_PTS_X 1 UBYTE AXIS_PTS_X 2 UBYTE INDEX_INCR DIRECT FNC_VALUES 3 UWORD COLUMN_DIR DIRECT /end RECORD_LAYOUT
/begin RECORD_LAYOUT KlAUbSstUwWUb NO_AXIS_PTS_X 1 UWORD AXIS_PTS_X 2 UWORD INDEX_INCR DIRECT FNC_VALUES 3 UBYTE COLUMN_DIR DIRECT /end RECORD_LAYOUT
/begin RECORD_LAYOUT KlAUwSstUwWUw NO_AXIS_PTS_X 1 UWORD AXIS_PTS_X 2 UWORD INDEX_INCR DIRECT FNC_VALUES 3 UWORD COLUMN_DIR DIRECT /end RECORD_LAYOUT
/begin RECORD_LAYOUT KtxC FNC_VALUES 1 UBYTE COLUMN_DIR DIRECT /end RECORD_LAYOUT
/begin RECORD_LAYOUT KwbUb FNC_VALUES 1 UBYTE COLUMN_DIR DIRECT /end RECORD_LAYOUT
/begin RECORD_LAYOUT KwbUw FNC_VALUES 1 UWORD COLUMN_DIR DIRECT /end RECORD_LAYOUT
/begin RECORD_LAYOUT KwSb FNC_VALUES 1 SBYTE COLUMN_DIR DIRECT /end RECORD_LAYOUT
/begin RECORD_LAYOUT KwSw FNC_VALUES 1 SWORD COLUMN_DIR DIRECT /end RECORD_LAYOUT
/begin RECORD_LAYOUT KwUb FNC_VALUES 1 UBYTE COLUMN_DIR DIRECT /end RECORD_LAYOUT
/begin RECORD_LAYOUT KwUw FNC_VALUES 1 UWORD COLUMN_DIR DIRECT /end RECORD_LAYOUT
/begin RECORD_LAYOUT SstAUbSstUb NO_AXIS_PTS_X 1 UBYTE AXIS_PTS_X 2 UBYTE INDEX_INCR DIRECT /end RECORD_LAYOUT
/begin RECORD_LAYOUT SstAUwSstUw NO_AXIS_PTS_X 1 UWORD AXIS_PTS_X 2 UWORD INDEX_INCR DIRECT /end RECORD_LAYOUT
/end MODULE
/end PROJECT
