ASAP2_VERSION 1 3
/begin PROJECT S1103A_25G5_0 "S1103A"
/begin HEADER "" VERSION "S1103A_25G5_0" PROJECT_NO S1103A_25G5_0 /end HEADER
/begin MODULE DIM ""
/begin MOD_COMMON "" BYTE_ORDER MSB_LAST ALIGNMENT_BYTE 1 ALIGNMENT_WORD 2 ALIGNMENT_LONG 2 /end MOD_COMMON
/begin CHARACTERISTIC AHEAGW "" VALUE 0x8FD9E0 KwUw 65535.00 dez 0.00 65535.00 FORMAT "%8.2" /end CHARACTERISTIC
/begin CHARACTERISTIC AHEAGWS "" VALUE 0x8FD9E2 KwUw 65535.00 dez 0.00 65535.00 FORMAT "%8.2" /end CHARACTERISTIC
/begin CHARACTERISTIC AHEARV "" VALUE 0x8FD9E4 KwUw 65535.00 dez 0.00 65535.00 FORMAT "%8.2" /end CHARACTERISTIC
/begin CHARACTERISTIC AHEKA "" VALUE 0x8FD9E6 KwUw 65535.00 dez 0.00 65535.00 FORMAT "%8.2" /end CHARACTERISTIC
/begin CHARACTERISTIC AHEKS1B1 "" VALUE 0x8FD9E8 KwUw 65535.00 dez 0.00 65535.00 FORMAT "%8.2" /end CHARACTERISTIC
/begin CHARACTERISTIC AHEKS1B2 "" VALUE 0x8FD9EA KwUw 65535.00 dez 0.00 65535.00 FORMAT "%8.2" /end CHARACTERISTIC
/begin CHARACTERISTIC AHEKSB1 "" VALUE 0x8FD9EC KwUw 65535.00 dez 0.00 65535.00 FORMAT "%8.2" /end CHARACTERISTIC
/begin CHARACTERISTIC AHEKSB2 "" VALUE 0x8FD9EE KwUw 65535.00 dez 0.00 65535.00 FORMAT "%8.2" /end CHARACTERISTIC
/begin CHARACTERISTIC AINTKAN "" CURVE 0x8E05AD GklWUb 255.0 dez 0.00 255.0 FORMAT "%5.1"
 /begin AXIS_DESCR COM_AXIS nmot nmot_ub_q40 8 0.00 10200. FORMAT "%5.0" AXIS_PTS_REF SNM08DMUB /end AXIS_DESCR
/end CHARACTERISTIC
/begin CHARACTERISTIC ALFO "" VALUE 0x8FD914 KwUw 323.3710 luquant 0.00 323.3710 FORMAT "%8.4" /end CHARACTERISTIC
/begin CHARACTERISTIC ALFOF "" VALUE 0x8FD980 KwSw 5.899658 kw_dmdfof2 0.09887695 5.998535 FORMAT "%8.6" /end CHARACTERISTIC
/begin CHARACTERISTIC ANALUN "" CURVE 0x8E05A3 GklWUb 126.0 dez 1.000 127.0 FORMAT "%5.1"
 /begin AXIS_DESCR COM_AXIS nmot nmot_ub_q40 8 0.00 10200. FORMAT "%5.0" AXIS_PTS_REF SNM08DMUB /end AXIS_DESCR
/end CHARACTERISTIC
/begin CHARACTERISTIC ANALUST "" VALUE 0x8E05AB KwUb 255.0 dez 0.00 255.0 FORMAT "%5.1" /end CHARACTERISTIC
/begin CHARACTERISTIC ANWFOHE "" VALUE 0x8FCD93 KwUb 243.0 dez 12.00 255.0 FORMAT "%5.1" /end CHARACTERISTIC
/begin CHARACTERISTIC ANWFOST "" VALUE 0x8FCDDD KwUb 255.0 dez 0.00 255.0 FORMAT "%5.1" /end CHARACTERISTIC
/begin CHARACTERISTIC ANWSTP "" VALUE 0x8FD982 KwUw 65535.00 dez 0.00 65535.00 FORMAT "%8.2" /end CHARACTERISTIC
/begin CHARACTERISTIC ANZDYNSH "" VALUE 0x8E0C92 KwUb 255.0 dez 0.00 255.0 FORMAT "%5.1" /end CHARACTERISTIC
/begin CHARACTERISTIC ANZHZKH "" VALUE 0x8FCE6C KwUb 255.0 dez 0.00 255.0 FORMAT "%5.1" /end CHARACTERISTIC
/begin CHARACTERISTIC ANZHZOFFH "" VALUE 0x8FCE6D KwUb 255.0 dez 0.00 255.0 FORMAT "%5.1" /end CHARACTERISTIC
/begin CHARACTERISTIC ANZRMSL "" VALUE 0x8E5C84 KwUw 65535.00 dez 0.00 65535.00 FORMAT "%8.2" /end CHARACTERISTIC
/begin CHARACTERISTIC AVRALU "" VALUE 0x8FCDF1 KwUb 20.00 dez 0.00 20.00 FORMAT "%5.2" /end CHARACTERISTIC
/begin CHARACTERISTIC AZSTLU "" VALUE 0x8FCDF2 KwUb 255.0 dez 0.00 255.0 FORMAT "%5.1" /end CHARACTERISTIC
/begin CHARACTERISTIC AZSTPON "" VALUE 0x8FD9DA KwUw 65535.00 dez 0.00 65535.00 FORMAT "%8.2" /end CHARACTERISTIC
/begin CHARACTERISTIC AZYTIAB "" VALUE 0x8FCDF6 KwUb 255.0 dez 0.00 255.0 FORMAT "%5.1" /end CHARACTERISTIC
/begin CHARACTERISTIC CDFO "" VALUE 0x8FCDDE KwUb 255.0 dez 0.00 255.0 FORMAT "%5.1" /end CHARACTERISTIC
/begin CHARACTERISTIC CDFOMOD "" VALUE 0x8FCDDF KwUb 1.000 dez 0.00 1.000 FORMAT "%5.3" /end CHARACTERISTIC
/begin CHARACTERISTIC CWDALA "" VALUE 0x8FCDF7 KwUb 255.0 dez 0.00 255.0 FORMAT "%5.1" /end CHARACTERISTIC
/begin CHARACTERISTIC CWDLSAHK "" VALUE 0x8E0C93 KwUb 255.0 dez 0.00 255.0 FORMAT "%5.1" /end CHARACTERISTIC
/begin CHARACTERISTIC CWDLSHV "" VALUE 0x8E0D77 KwUb 255.0 dez 0.00 255.0 FORMAT "%5.1" /end CHARACTERISTIC
/begin CHARACTERISTIC CWDLSUV "" VALUE 0x8E36F8 KwUb 255.0 dez 0.00 255.0 FORMAT "%5.1" /end CHARACTERISTIC
/begin CHARACTERISTIC CWDMDE "" VALUE 0x8E05B5 KwUb 255.0 dez 0.00 255.0 FORMAT "%5.1" /end CHARACTERISTIC
/begin CHARACTERISTIC CWDMDZAG "" VALUE 0x8E05E9 KwUb 255.0 dez 0.00 255.0 FORMAT "%5.1" /end CHARACTERISTIC
/begin CHARACTERISTIC CWDNMAX "" VALUE 0x8FCE6A KwUb 255.0 dez 0.00 255.0 FORMAT "%5.1" /end CHARACTERISTIC
/begin CHARACTERISTIC CWDSLSA "" VALUE 0x8E035D KwUb 255.0 dez 0.00 255.0 FORMAT "%5.1" /end CHARACTERISTIC
/begin CHARACTERISTIC CWDSLSAD "" VALUE 0x8E035E KwUb 255.0 dez 0.00 255.0 FORMAT "%5.1" /end CHARACTERISTIC
/begin CHARACTERISTIC CWDSLSY "" VALUE 0x8E035F KwUb 255.0 dez 0.00 255.0 FORMAT "%5.1" /end CHARACTERISTIC
/begin CHARACTERISTIC CWPLLSU "" VALUE 0x8E0D5D KwUb 255.0 dez 0.00 255.0 FORMAT "%5.1" /end CHARACTERISTIC
/begin CHARACTERISTIC CWSTDMD "" VALUE 0x8FCDF3 KwUb 255.0 dez 0.00 255.0 FORMAT "%5.1" /end CHARACTERISTIC
/begin CHARACTERISTIC CWSTPCNF "" VALUE 0x8FCDF4 KwUb 255.0 dez 0.00 255.0 FORMAT "%5.1" /end CHARACTERISTIC
/begin CHARACTERISTIC DFRMOFNML "" CURVE 0x8E5C86 KlAUwSstUwWSw 1.999969 fak_sw_b1 -1.000000 0.9999695 FORMAT "%8.6"
 /begin AXIS_DESCR STD_AXIS ml_w m_uw_b6553p5 6 0.00 6553.500 FORMAT "%8.3" DEPOSIT ABSOLUTE /end AXIS_DESCR
/end CHARACTERISTIC
/begin CHARACTERISTIC DFRMOFNXKT "" VALUE 0x8E5CA0 KwSw 1.999969 fak_sw_b1 -1.000000 0.9999695 FORMAT "%8.6" /end CHARACTERISTIC
/begin CHARACTERISTIC DFRMOFPML "" CURVE 0x8E5CA2 KlAUwSstUwWSw 1.999969 fak_sw_b1 -1.000000 0.9999695 FORMAT "%8.6"
 /begin AXIS_DESCR STD_AXIS ml_w m_uw_b6553p5 6 0.00 6553.500 FORMAT "%8.3" DEPOSIT ABSOLUTE /end AXIS_DESCR
/end CHARACTERISTIC
/begin CHARACTERISTIC DFRMOFPXKT "" VALUE 0x8E5CBC KwSw 1.999969 fak_sw_b1 -1.000000 0.9999695 FORMAT "%8.6" /end CHARACTERISTIC
/begin CHARACTERISTIC DFRMSLS "" VALUE 0x8E5CBE KwUw 1.999969 fak_uw_b2 0.00 1.999969 FORMAT "%8.6" /end CHARACTERISTIC
/begin CHARACTERISTIC DFSEFO1N "" VAL_BLK 0x8E5FBC KwbUw 323.3710 luquant 0.00 323.3710 FORMAT "%8.4" NUMBER 8 /end CHARACTERISTIC
/begin CHARACTERISTIC DFSEFO2N "" VAL_BLK 0x8E5FCC KwbUw 323.3710 luquant 0.00 323.3710 FORMAT "%8.4" NUMBER 8 /end CHARACTERISTIC
/begin CHARACTERISTIC DFSEFO3N "" VAL_BLK 0x8E5FDC KwbUw 323.3710 luquant 0.00 323.3710 FORMAT "%8.4" NUMBER 8 /end CHARACTERISTIC
/begin CHARACTERISTIC DFSERES "" VALUE 0x8FD916 KwUw 323.3710 luquant 0.00 323.3710 FORMAT "%8.4" /end CHARACTERISTIC
/begin CHARACTERISTIC DLAHISATO "" VALUE 0x8E167B KwUb 0.09961 fak_ub_b0p1_o0p05 -0.05000 0.04961 FORMAT "%7.5" /end CHARACTERISTIC
/begin CHARACTERISTIC DLAHISATU "" VALUE 0x8E167C KwUb 0.09961 fak_ub_b0p1_o0p05 -0.05000 0.04961 FORMAT "%7.5" /end CHARACTERISTIC
/begin CHARACTERISTIC DLAHPPLMN "" VALUE 0x8E8130 KwSw 1.999969 fak_sw_b1 -1.000000 0.9999695 FORMAT "%8.6" /end CHARACTERISTIC
/begin CHARACTERISTIC DLAHPPLMN2 "" VALUE 0x8E8132 KwSw 1.999969 fak_sw_b1 -1.000000 0.9999695 FORMAT "%8.6" /end CHARACTERISTIC
/begin CHARACTERISTIC DLAMELSH "" VALUE 0x8E8000 KwUw 15.99976 fak_uw_b16 0.00 15.99976 FORMAT "%8.5" /end CHARACTERISTIC
/begin CHARACTERISTIC DLAMHVF "" VALUE 0x8E823A KwUw 15.99976 fak_uw_b16 0.00 15.99976 FORMAT "%8.5" /end CHARACTERISTIC
/begin CHARACTERISTIC DLAMHVM "" VALUE 0x8E823C KwUw 15.99976 fak_uw_b16 0.00 15.99976 FORMAT "%8.5" /end CHARACTERISTIC
/begin CHARACTERISTIC DLAMLASHF "" VALUE 0x8E802A KwUw 15.99976 fak_uw_b16 0.00 15.99976 FORMAT "%8.5" /end CHARACTERISTIC
/begin CHARACTERISTIC DLAMLASHM "" VALUE 0x8E802C KwUw 15.99976 fak_uw_b16 0.00 15.99976 FORMAT "%8.5" /end CHARACTERISTIC
/begin CHARACTERISTIC DLURMIN "" CURVE 0x8E6082 GklWSw 323.3710 luquant -161.6879 161.6830 FORMAT "%8.4"
 /begin AXIS_DESCR COM_AXIS nmot nmot_ub_q40 8 0.00 10200. FORMAT "%5.0" AXIS_PTS_REF SNM08DMUB /end AXIS_DESCR
/end CHARACTERISTIC
/begin CHARACTERISTIC DMRLASH "" VALUE 0x8E802E KwUw 99.99847 rel_uw_b100 0.00 99.99847 FORMAT "%8.5" /end CHARACTERISTIC
/begin CHARACTERISTIC DMRLSH "" VALUE 0x8E8002 KwUw 99.99847 rel_uw_b100 0.00 99.99847 FORMAT "%8.5" /end CHARACTERISTIC
/begin CHARACTERISTIC DMSDRLTM "" CURVE 0x8E5CC0 KlAUbSstUbWUw 1535.977 rel_uw_q0p0234 0.00 1535.977 FORMAT "%8.3"
 /begin AXIS_DESCR STD_AXIS tmot temp_ub_q0p75_o48 4 -48.00 143.3 FORMAT "%5.1" DEPOSIT ABSOLUTE /end AXIS_DESCR
/end CHARACTERISTIC
/begin CHARACTERISTIC DMXRDL "" VALUE 0x8FD9D2 KwSw 323.3710 luquant -161.6879 161.6830 FORMAT "%8.4" /end CHARACTERISTIC
/begin CHARACTERISTIC DMXRFL "" VALUE 0x8FD9D8 KwUw 323.3710 luquant 0.00 323.3710 FORMAT "%8.4" /end CHARACTERISTIC
/begin CHARACTERISTIC DMXRLU "" VALUE 0x8FD9D4 KwSw 323.3710 luquant -161.6879 161.6830 FORMAT "%8.4" /end CHARACTERISTIC
/begin CHARACTERISTIC DRISIGH "" VALUE 0x8E8004 KwUw 131070.0 r_uw_q2 0.00 131070.0 FORMAT "%8.1" /end CHARACTERISTIC
/begin CHARACTERISTIC DRLSOLA "" CURVE 0x8E6910 GklWUw 1535.977 relNWU_q0p0234 0.00 1535.977 FORMAT "%8.3"
 /begin AXIS_DESCR COM_AXIS midmd rel_ub_b99p6 8 0.00 99.61 FORMAT "%5.2" AXIS_PTS_REF SMI08DMUB /end AXIS_DESCR
/end CHARACTERISTIC
/begin CHARACTERISTIC DRLSOLST "" VALUE 0x8E6920 KwUw 1535.977 relNWU_q0p0234 0.00 1535.977 FORMAT "%8.3" /end CHARACTERISTIC
/begin CHARACTERISTIC DSLVFZMN "" VALUE 0x8E0360 KwUb 318.8 vfzg_ub_q1p25 0.00 318.8 FORMAT "%5.1" /end CHARACTERISTIC
/begin CHARACTERISTIC DTMDSLA "" VALUE 0x8E0361 KwUb 191.3 temp_ub_b191p25 0.00 191.3 FORMAT "%5.1" /end CHARACTERISTIC
/begin CHARACTERISTIC DUSHKHZK "" VALUE 0x8FDC26 KwUw 319.9951 spg_uw_q0p00488 0.00 319.9951 FORMAT "%8.4" /end CHARACTERISTIC
/begin CHARACTERISTIC DWNWDHYSA "" VALUE 0x8EFF3C KwUw 255.0000 kw_uw_q0p0078 0.00 255.0000 FORMAT "%8.4" /end CHARACTERISTIC
/begin CHARACTERISTIC DWNWDHYSE "" VALUE 0x8EFE52 KwUw 255.0000 kw_uw_q0p0078 0.00 255.0000 FORMAT "%8.4" /end CHARACTERISTIC
/begin CHARACTERISTIC DYNLSUTO "" VALUE 0x8E167D KwUb 4.980 fak_q0p0195 0.00 4.980 FORMAT "%5.3" /end CHARACTERISTIC
/begin CHARACTERISTIC DYNLSUTU "" VALUE 0x8E167E KwUb 4.980 fak_q0p0195 0.00 4.980 FORMAT "%5.3" /end CHARACTERISTIC
/begin CHARACTERISTIC FABSALU "" VALUE 0x8FD279 KwUb 553.4 accgrd_ub_b555p55 0.00 553.4 FORMAT "%5.1" /end CHARACTERISTIC
/begin CHARACTERISTIC FAINTEN "" VALUE 0x8E05B6 KwUb 255.0 dez 0.00 255.0 FORMAT "%5.1" /end CHARACTERISTIC
/begin CHARACTERISTIC FASKIV1 "" VALUE 0x8FCDF8 KwUb 4.000 dez 1.000 5.000 FORMAT "%5.3" /end CHARACTERISTIC
/begin CHARACTERISTIC FBWRMSL "" VALUE 0x8E0362 KwUb 0.9961 fak_ub_b1 0.00 0.9961 /end CHARACTERISTIC
/begin CHARACTERISTIC FHODSL "" VALUE 0x8E5CCE KwUw 3.999939 fak_uw_b4 0.00 3.999939 FORMAT "%8.6" /end CHARACTERISTIC
/begin CHARACTERISTIC FIAMALU "" VALUE 0x8FCDF0 KwUb 3.984 fak_ub_b4 0.00 3.984 FORMAT "%5.3" /end CHARACTERISTIC
/begin CHARACTERISTIC FIBSALU "" VALUE 0x8FD27A KwUb 0.9961 fak_ub_b1 0.00 0.9961 /end CHARACTERISTIC
/begin CHARACTERISTIC FIMALU "" VALUE 0x8FD9D6 KwUw 0.9999847 fak_uw_b1 0.00 0.9999847 FORMAT "%9.7" /end CHARACTERISTIC
/begin CHARACTERISTIC FLFO "" VALUE 0x8FD918 KwUw 0.9999847 fak_uw_b1 0.00 0.9999847 FORMAT "%9.7" /end CHARACTERISTIC
/begin CHARACTERISTIC FLFOF "" VALUE 0x8FD984 KwUw 0.9999847 fak_uw_b1 0.00 0.9999847 FORMAT "%9.7" /end CHARACTERISTIC
/begin CHARACTERISTIC FLUTN "" VALUE 0x8E607C KwUw 0.9999847 fak_uw_b1 0.00 0.9999847 FORMAT "%9.7" /end CHARACTERISTIC
/begin CHARACTERISTIC FLUV1 "" VALUE 0x8FCDED KwUb 255.0 dez 0.00 255.0 FORMAT "%5.1" /end CHARACTERISTIC
/begin CHARACTERISTIC FMSLAMN "" VALUE 0x8E0363 KwUb 1.992 fak_ub_b2 0.00 1.992 FORMAT "%5.3" /end CHARACTERISTIC
/begin CHARACTERISTIC FMSLAMX "" VALUE 0x8E0364 KwUb 1.992 fak_ub_b2 0.00 1.992 FORMAT "%5.3" /end CHARACTERISTIC
/begin CHARACTERISTIC FOFAKT "" VALUE 0x8FCDE0 KwUb 255.0 dez 0.00 255.0 FORMAT "%5.1" /end CHARACTERISTIC
/begin CHARACTERISTIC FRDO "" VALUE 0x8EE7B4 KwUw 1.999969 fak_uw_b2 0.00 1.999969 FORMAT "%8.6" /end CHARACTERISTIC
/begin CHARACTERISTIC FRDU "" VALUE 0x8EE7B6 KwUw 1.999969 fak_uw_b2 0.00 1.999969 FORMAT "%8.6" /end CHARACTERISTIC
/begin CHARACTERISTIC FS1FO "" VALUE 0x8FD91A KwUw 0.9999847 fak_uw_b1 0.00 0.9999847 FORMAT "%9.7" /end CHARACTERISTIC
/begin CHARACTERISTIC FS1FOF "" VALUE 0x8FD986 KwUw 0.9999847 fak_uw_b1 0.00 0.9999847 FORMAT "%9.7" /end CHARACTERISTIC
/begin CHARACTERISTIC FS2FO "" VALUE 0x8FD91C KwUw 0.9999847 fak_uw_b1 0.00 0.9999847 FORMAT "%9.7" /end CHARACTERISTIC
/begin CHARACTERISTIC FS2FOF "" VALUE 0x8FD988 KwUw 0.9999847 fak_uw_b1 0.00 0.9999847 FORMAT "%9.7" /end CHARACTERISTIC
/begin CHARACTERISTIC FSWALUV "" CURVE 0x8E36FB KlAUbSstUbWUb 55.34 acc_ub_b55p55 0.00 55.34 FORMAT "%5.2"
 /begin AXIS_DESCR STD_AXIS vfzg vfzg_ub_q1p25 4 0.00 318.8 FORMAT "%5.1" DEPOSIT ABSOLUTE /end AXIS_DESCR
/end CHARACTERISTIC
/begin CHARACTERISTIC IMLATDSL "" VALUE 0x8E5CD0 KwUw 23.30133 m_uw_b23p3 0.00 23.30133 FORMAT "%8.5" /end CHARACTERISTIC
/begin CHARACTERISTIC IMLATDSLK "" VALUE 0x8E5CD2 KwUw 23.30133 m_uw_b23p3 0.00 23.30133 FORMAT "%8.5" /end CHARACTERISTIC
/begin CHARACTERISTIC IMLDSL "" VALUE 0x8E0365 KwUb 0.9961 fak_ub_b1 0.00 0.9961 /end CHARACTERISTIC
/begin CHARACTERISTIC IMLHEMN "" VALUE 0x8E8134 KwUw 1.820417 m_q2p777Em5_kg 0.00 1.820417 FORMAT "%8.6" /end CHARACTERISTIC
/begin CHARACTERISTIC IMLHEMN2 "" VALUE 0x8E8136 KwUw 1.820417 m_q2p777Em5_kg 0.00 1.820417 FORMAT "%8.6" /end CHARACTERISTIC
/begin CHARACTERISTIC IMLHEMNFA "" VALUE 0x8E8138 KwUw 1.820417 m_q2p777Em5_kg 0.00 1.820417 FORMAT "%8.6" /end CHARACTERISTIC
/begin CHARACTERISTIC IMLHEMNFA2 "" VALUE 0x8E813A KwUw 1.820417 m_q2p777Em5_kg 0.00 1.820417 FORMAT "%8.6" /end CHARACTERISTIC
/begin CHARACTERISTIC IMLPLCMN "" VALUE 0x8E813C KwUw 1.820417 m_q2p777Em5_kg 0.00 1.820417 FORMAT "%8.6" /end CHARACTERISTIC
/begin CHARACTERISTIC IMLPLCMN2 "" VALUE 0x8E813E KwUw 1.820417 m_q2p777Em5_kg 0.00 1.820417 FORMAT "%8.6" /end CHARACTERISTIC
/begin CHARACTERISTIC IMLPLCMNB "" VALUE 0x8E8140 KwUw 1.820417 m_q2p777Em5_kg 0.00 1.820417 FORMAT "%8.6" /end CHARACTERISTIC
/begin CHARACTERISTIC IMLPLCMNB2 "" VALUE 0x8E8142 KwUw 1.820417 m_q2p777Em5_kg 0.00 1.820417 FORMAT "%8.6" /end CHARACTERISTIC
/begin CHARACTERISTIC KAMFZ "" VALUE 0x8E0086 KwSb 1530. kw_tooth_sy -768.0 762.0 FORMAT "%5.1" /end CHARACTERISTIC
/begin CHARACTERISTIC KFAMAL "" MAP 0x8E04CF GkfWUb 0.9961 fak_ub_b1 0.00 0.9961
 /begin AXIS_DESCR COM_AXIS midmd rel_ub_b99p6 8 0.00 99.61 FORMAT "%5.2" AXIS_PTS_REF SMI08DMUB /end AXIS_DESCR
 /begin AXIS_DESCR COM_AXIS nmot nmot_ub_q40 8 0.00 10200. FORMAT "%5.0" AXIS_PTS_REF SNM08DMUB /end AXIS_DESCR
/end CHARACTERISTIC
/begin CHARACTERISTIC KFAMAL1 "" MAP 0x8E050F GkfWUb 0.9961 fak_ub_b1 0.00 0.9961
 /begin AXIS_DESCR COM_AXIS midmd rel_ub_b99p6 8 0.00 99.61 FORMAT "%5.2" AXIS_PTS_REF SMI08DMUB /end AXIS_DESCR
 /begin AXIS_DESCR COM_AXIS nmot nmot_ub_q40 8 0.00 10200. FORMAT "%5.0" AXIS_PTS_REF SNM08DMUB /end AXIS_DESCR
/end CHARACTERISTIC
/begin CHARACTERISTIC KFAMAL2 "" MAP 0x8E054F GkfWUb 0.9961 fak_ub_b1 0.00 0.9961
 /begin AXIS_DESCR COM_AXIS midmd rel_ub_b99p6 8 0.00 99.61 FORMAT "%5.2" AXIS_PTS_REF SMI08DMUB /end AXIS_DESCR
 /begin AXIS_DESCR COM_AXIS nmot nmot_ub_q40 8 0.00 10200. FORMAT "%5.0" AXIS_PTS_REF SNM08DMUB /end AXIS_DESCR
/end CHARACTERISTIC
/begin CHARACTERISTIC KFCFO1 "" MAP 0x8FCD94 FkfNoShNoOffWUb 255.0 dez 0.00 255.0 FORMAT "%5.1"
 /begin AXIS_DESCR FIX_AXIS idxfomi dez 3 0.00 2.000 FORMAT "%5.3" FIX_AXIS_PAR 0 0 3 /end AXIS_DESCR
 /begin AXIS_DESCR FIX_AXIS idxfon dez 8 0.00 7.000 FORMAT "%5.3" FIX_AXIS_PAR 0 0 8 /end AXIS_DESCR
/end CHARACTERISTIC
/begin CHARACTERISTIC KFCFO2 "" MAP 0x8FCDAC FkfNoShNoOffWUb 255.0 dez 0.00 255.0 FORMAT "%5.1"
 /begin AXIS_DESCR FIX_AXIS idxfomi dez 3 0.00 2.000 FORMAT "%5.3" FIX_AXIS_PAR 0 0 3 /end AXIS_DESCR
 /begin AXIS_DESCR FIX_AXIS idxfon dez 8 0.00 7.000 FORMAT "%5.3" FIX_AXIS_PAR 0 0 8 /end AXIS_DESCR
/end CHARACTERISTIC
/begin CHARACTERISTIC KFCFO3 "" MAP 0x8FCDC4 FkfNoShNoOffWUb 255.0 dez 0.00 255.0 FORMAT "%5.1"
 /begin AXIS_DESCR FIX_AXIS idxfomi dez 3 0.00 2.000 FORMAT "%5.3" FIX_AXIS_PAR 0 0 3 /end AXIS_DESCR
 /begin AXIS_DESCR FIX_AXIS idxfon dez 8 0.00 7.000 FORMAT "%5.3" FIX_AXIS_PAR 0 0 8 /end AXIS_DESCR
/end CHARACTERISTIC
/begin CHARACTERISTIC KFDLUR "" MAP 0x8E6092 GkfWSw 323.3710 luquant -161.6879 161.6830 FORMAT "%8.4"
 /begin AXIS_DESCR COM_AXIS midmd rel_ub_b99p6 8 0.00 99.61 FORMAT "%5.2" AXIS_PTS_REF SMI08DMUB /end AXIS_DESCR
 /begin AXIS_DESCR COM_AXIS nmot nmot_ub_q40 8 0.00 10200. FORMAT "%5.0" AXIS_PTS_REF SNM08DMUB /end AXIS_DESCR
/end CHARACTERISTIC
/begin CHARACTERISTIC KFDLUR1 "" MAP 0x8E6112 GkfWSw 323.3710 luquant -161.6879 161.6830 FORMAT "%8.4"
 /begin AXIS_DESCR COM_AXIS midmd rel_ub_b99p6 8 0.00 99.61 FORMAT "%5.2" AXIS_PTS_REF SMI08DMUB /end AXIS_DESCR
 /begin AXIS_DESCR COM_AXIS nmot nmot_ub_q40 8 0.00 10200. FORMAT "%5.0" AXIS_PTS_REF SNM08DMUB /end AXIS_DESCR
/end CHARACTERISTIC
/begin CHARACTERISTIC KFDLUR2 "" MAP 0x8E6192 GkfWSw 323.3710 luquant -161.6879 161.6830 FORMAT "%8.4"
 /begin AXIS_DESCR COM_AXIS midmd rel_ub_b99p6 8 0.00 99.61 FORMAT "%5.2" AXIS_PTS_REF SMI08DMUB /end AXIS_DESCR
 /begin AXIS_DESCR COM_AXIS nmot nmot_ub_q40 8 0.00 10200. FORMAT "%5.0" AXIS_PTS_REF SNM08DMUB /end AXIS_DESCR
/end CHARACTERISTIC
/begin CHARACTERISTIC KFDLURS "" MAP 0x8E6212 GkfWSw 323.3710 luquant -161.6879 161.6830 FORMAT "%8.4"
 /begin AXIS_DESCR COM_AXIS midmd rel_ub_b99p6 8 0.00 99.61 FORMAT "%5.2" AXIS_PTS_REF SMI08DM1UB /end AXIS_DESCR
 /begin AXIS_DESCR COM_AXIS nmot nmot_ub_q40 8 0.00 10200. FORMAT "%5.0" AXIS_PTS_REF SNM08DM3UB /end AXIS_DESCR
/end CHARACTERISTIC
/begin CHARACTERISTIC KFDWNWDMXA "" MAP 0x8EFF3E KfAxUwAyUwSstxUwSstyUwWUw 511.9922 kw_uw_q0p0078 0.00 511.9922 FORMAT "%8.4"
 /begin AXIS_DESCR STD_AXIS toelk_w temp_q0p0234_o273 5 -273.1500 1262.827 FORMAT "%8.3" DEPOSIT ABSOLUTE /end AXIS_DESCR
 /begin AXIS_DESCR STD_AXIS nmot_w nmot_uw_q0p25 6 0.00 16383.75 FORMAT "%8.2" DEPOSIT ABSOLUTE /end AXIS_DESCR
/end CHARACTERISTIC
/begin CHARACTERISTIC KFDWNWDMXE "" MAP 0x8EFE54 KfAxUwAyUwSstxUwSstyUwWUw 511.9922 kw_uw_q0p0078 0.00 511.9922 FORMAT "%8.4"
 /begin AXIS_DESCR STD_AXIS toelk_w temp_q0p0234_o273 5 -273.1500 1262.827 FORMAT "%8.3" DEPOSIT ABSOLUTE /end AXIS_DESCR
 /begin AXIS_DESCR STD_AXIS nmot_w nmot_uw_q0p25 6 0.00 16383.75 FORMAT "%8.2" DEPOSIT ABSOLUTE /end AXIS_DESCR
/end CHARACTERISTIC
/begin CHARACTERISTIC KFKSWF "" MAP 0x8E05B7 KfAxUbAyUbSstxUbSstyUbWUb 255.0 dez 0.00 255.0 FORMAT "%5.1"
 /begin AXIS_DESCR STD_AXIS nmot nmot_ub_q40 6 0.00 10200. FORMAT "%5.0" DEPOSIT ABSOLUTE /end AXIS_DESCR
 /begin AXIS_DESCR STD_AXIS midmd rel_ub_b99p6 6 0.00 99.61 FORMAT "%5.2" DEPOSIT ABSOLUTE /end AXIS_DESCR
/end CHARACTERISTIC
/begin CHARACTERISTIC KFLUAR "" MAP 0x8E6690 GkfWUw 323.3710 luquant 0.00 323.3710 FORMAT "%8.4"
 /begin AXIS_DESCR COM_AXIS midmd rel_ub_b99p6 8 0.00 99.61 FORMAT "%5.2" AXIS_PTS_REF SMI08DMUB /end AXIS_DESCR
 /begin AXIS_DESCR COM_AXIS nmot nmot_ub_q40 8 0.00 10200. FORMAT "%5.0" AXIS_PTS_REF SNM08DMUB /end AXIS_DESCR
/end CHARACTERISTIC
/begin CHARACTERISTIC KFLUAR1 "" MAP 0x8E6710 GkfWUw 323.3710 luquant 0.00 323.3710 FORMAT "%8.4"
 /begin AXIS_DESCR COM_AXIS midmd rel_ub_b99p6 8 0.00 99.61 FORMAT "%5.2" AXIS_PTS_REF SMI08DMUB /end AXIS_DESCR
 /begin AXIS_DESCR COM_AXIS nmot nmot_ub_q40 8 0.00 10200. FORMAT "%5.0" AXIS_PTS_REF SNM08DMUB /end AXIS_DESCR
/end CHARACTERISTIC
/begin CHARACTERISTIC KFLUAR2 "" MAP 0x8E6790 GkfWUw 323.3710 luquant 0.00 323.3710 FORMAT "%8.4"
 /begin AXIS_DESCR COM_AXIS midmd rel_ub_b99p6 8 0.00 99.61 FORMAT "%5.2" AXIS_PTS_REF SMI08DMUB /end AXIS_DESCR
 /begin AXIS_DESCR COM_AXIS nmot nmot_ub_q40 8 0.00 10200. FORMAT "%5.0" AXIS_PTS_REF SNM08DMUB /end AXIS_DESCR
/end CHARACTERISTIC
/begin CHARACTERISTIC KFLUARS "" MAP 0x8E6810 GkfWUw 323.3710 luquant 0.00 323.3710 FORMAT "%8.4"
 /begin AXIS_DESCR COM_AXIS midmd rel_ub_b99p6 8 0.00 99.61 FORMAT "%5.2" AXIS_PTS_REF SMI08DM1UB /end AXIS_DESCR
 /begin AXIS_DESCR COM_AXIS nmot nmot_ub_q40 8 0.00 10200. FORMAT "%5.0" AXIS_PTS_REF SNM08DM3UB /end AXIS_DESCR
/end CHARACTERISTIC
/begin CHARACTERISTIC KFLUARV "" MAP 0x8E6890 GkfWUw 323.3710 luquant 0.00 323.3710 FORMAT "%8.4"
 /begin AXIS_DESCR COM_AXIS midmd rel_ub_b99p6 8 0.00 99.61 FORMAT "%5.2" AXIS_PTS_REF SMI08DM1UB /end AXIS_DESCR
 /begin AXIS_DESCR COM_AXIS nmot nmot_ub_q40 8 0.00 10200. FORMAT "%5.0" AXIS_PTS_REF SNM08DM3UB /end AXIS_DESCR
/end CHARACTERISTIC
/begin CHARACTERISTIC KFLURB "" MAP 0x8E6292 GkfWSw 323.3710 luquant -161.6879 161.6830 FORMAT "%8.4"
 /begin AXIS_DESCR COM_AXIS midmd rel_ub_b99p6 8 0.00 99.61 FORMAT "%5.2" AXIS_PTS_REF SMI08DMUB /end AXIS_DESCR
 /begin AXIS_DESCR COM_AXIS nmot nmot_ub_q40 8 0.00 10200. FORMAT "%5.0" AXIS_PTS_REF SNM08DMUB /end AXIS_DESCR
/end CHARACTERISTIC
/begin CHARACTERISTIC KFLURB1 "" MAP 0x8E6312 GkfWSw 323.3710 luquant -161.6879 161.6830 FORMAT "%8.4"
 /begin AXIS_DESCR COM_AXIS midmd rel_ub_b99p6 8 0.00 99.61 FORMAT "%5.2" AXIS_PTS_REF SMI08DMUB /end AXIS_DESCR
 /begin AXIS_DESCR COM_AXIS nmot nmot_ub_q40 8 0.00 10200. FORMAT "%5.0" AXIS_PTS_REF SNM08DMUB /end AXIS_DESCR
/end CHARACTERISTIC
/begin CHARACTERISTIC KFLURB2 "" MAP 0x8E6392 GkfWSw 323.3710 luquant -161.6879 161.6830 FORMAT "%8.4"
 /begin AXIS_DESCR COM_AXIS midmd rel_ub_b99p6 8 0.00 99.61 FORMAT "%5.2" AXIS_PTS_REF SMI08DMUB /end AXIS_DESCR
 /begin AXIS_DESCR COM_AXIS nmot nmot_ub_q40 8 0.00 10200. FORMAT "%5.0" AXIS_PTS_REF SNM08DMUB /end AXIS_DESCR
/end CHARACTERISTIC
/begin CHARACTERISTIC KFLURBS "" MAP 0x8E6412 GkfWSw 323.3710 luquant -161.6879 161.6830 FORMAT "%8.4"
 /begin AXIS_DESCR COM_AXIS midmd rel_ub_b99p6 8 0.00 99.61 FORMAT "%5.2" AXIS_PTS_REF SMI08DM1UB /end AXIS_DESCR
 /begin AXIS_DESCR COM_AXIS nmot nmot_ub_q40 8 0.00 10200. FORMAT "%5.0" AXIS_PTS_REF SNM08DM3UB /end AXIS_DESCR
/end CHARACTERISTIC
/begin CHARACTERISTIC KFLURBV "" MAP 0x8E6492 GkfWSw 323.3710 luquant -161.6879 161.6830 FORMAT "%8.4"
 /begin AXIS_DESCR COM_AXIS midmd rel_ub_b99p6 8 0.00 99.61 FORMAT "%5.2" AXIS_PTS_REF SMI08DM1UB /end AXIS_DESCR
 /begin AXIS_DESCR COM_AXIS nmot nmot_ub_q40 8 0.00 10200. FORMAT "%5.0" AXIS_PTS_REF SNM08DM3UB /end AXIS_DESCR
/end CHARACTERISTIC
/begin CHARACTERISTIC KFLURM "" MAP 0x8E6512 GkfWSw 323.3710 luquant -161.6879 161.6830 FORMAT "%8.4"
 /begin AXIS_DESCR COM_AXIS midmd rel_ub_b99p6 8 0.00 99.61 FORMAT "%5.2" AXIS_PTS_REF SMI08DMUB /end AXIS_DESCR
 /begin AXIS_DESCR COM_AXIS nmot nmot_ub_q40 8 0.00 10200. FORMAT "%5.0" AXIS_PTS_REF SNM08DMUB /end AXIS_DESCR
/end CHARACTERISTIC
/begin CHARACTERISTIC KFLURM1 "" MAP 0x8E6592 GkfWSw 323.3710 luquant -161.6879 161.6830 FORMAT "%8.4"
 /begin AXIS_DESCR COM_AXIS midmd rel_ub_b99p6 8 0.00 99.61 FORMAT "%5.2" AXIS_PTS_REF SMI08DMUB /end AXIS_DESCR
 /begin AXIS_DESCR COM_AXIS nmot nmot_ub_q40 8 0.00 10200. FORMAT "%5.0" AXIS_PTS_REF SNM08DMUB /end AXIS_DESCR
/end CHARACTERISTIC
/begin CHARACTERISTIC KFMODI "" MAP 0x8FD9F0 FkfNoShNoOffWUb 255.0 dez 0.00 255.0 FORMAT "%5.1"
 /begin AXIS_DESCR FIX_AXIS xkfmodi dez 6 0.00 5.000 FORMAT "%5.3" FIX_AXIS_PAR 0 0 6 /end AXIS_DESCR
 /begin AXIS_DESCR FIX_AXIS ykfmodi dez 8 0.00 7.000 FORMAT "%5.3" FIX_AXIS_PAR 0 0 8 /end AXIS_DESCR
/end CHARACTERISTIC
/begin CHARACTERISTIC KFTDDNWNPA "" MAP 0x8EFF94 KfAxUwAyUwSstxUwSstyUwWUw 6553.500 t100msxs_uw_b6553p5 0.00 6553.500 FORMAT "%8.3"
 /begin AXIS_DESCR STD_AXIS toelk_w temp_q0p0234_o273 5 -273.1500 1262.827 FORMAT "%8.3" DEPOSIT ABSOLUTE /end AXIS_DESCR
 /begin AXIS_DESCR STD_AXIS nmot_w nmot_uw_q0p25 4 0.00 16383.75 FORMAT "%8.2" DEPOSIT ABSOLUTE /end AXIS_DESCR
/end CHARACTERISTIC
/begin CHARACTERISTIC KFTDDNWNPE "" MAP 0x8EFEAA KfAxUwAyUwSstxUwSstyUwWUw 6553.500 t100msxs_uw_b6553p5 0.00 6553.500 FORMAT "%8.3"
 /begin AXIS_DESCR STD_AXIS toelk_w temp_q0p0234_o273 5 -273.1500 1262.827 FORMAT "%8.3" DEPOSIT ABSOLUTE /end AXIS_DESCR
 /begin AXIS_DESCR STD_AXIS nmot_w nmot_uw_q0p25 4 0.00 16383.75 FORMAT "%8.2" DEPOSIT ABSOLUTE /end AXIS_DESCR
/end CHARACTERISTIC
/begin CHARACTERISTIC KLCFOF1N "" VAL_BLK 0x8FCDE1 KwbUb 2.000 dez 0.00 2.000 FORMAT "%5.3" NUMBER 4 /end CHARACTERISTIC
/begin CHARACTERISTIC KLCFOF2N "" VAL_BLK 0x8FCDE5 KwbUb 2.000 dez 0.00 2.000 FORMAT "%5.3" NUMBER 4 /end CHARACTERISTIC
/begin CHARACTERISTIC KLCFOF3N "" VAL_BLK 0x8FCDE9 KwbUb 2.000 dez 0.00 2.000 FORMAT "%5.3" NUMBER 4 /end CHARACTERISTIC
/begin CHARACTERISTIC KLMISALULL "" CURVE 0x8E058F GklWUb 99.61 rel_ub_b99p6 0.00 99.61 FORMAT "%5.2"
 /begin AXIS_DESCR COM_AXIS nmot nmot_ub_q40 8 0.00 10200. FORMAT "%5.0" AXIS_PTS_REF SNM08DMUB /end AXIS_DESCR
/end CHARACTERISTIC
/begin CHARACTERISTIC KLMLDSLAMX "" CURVE 0x8E5CD4 KlAUwSstUwWUw 6553.500 m_q0p1 0.00 6553.500 FORMAT "%8.3"
 /begin AXIS_DESCR STD_AXIS fho_w fak_uw_b4 5 0.00 3.999939 FORMAT "%8.6" DEPOSIT ABSOLUTE /end AXIS_DESCR
/end CHARACTERISTIC
/begin CHARACTERISTIC KLMLDSLKMX "" CURVE 0x8E5CEA KlAUwSstUwWUw 6553.500 m_q0p1 0.00 6553.500 FORMAT "%8.3"
 /begin AXIS_DESCR STD_AXIS fho_w fak_uw_b4 5 0.00 3.999939 FORMAT "%8.6" DEPOSIT ABSOLUTE /end AXIS_DESCR
/end CHARACTERISTIC
/begin CHARACTERISTIC KLMLDSLMX "" CURVE 0x8E5D00 KlAUwSstUwWUw 6553.500 m_q0p1 0.00 6553.500 FORMAT "%8.3"
 /begin AXIS_DESCR STD_AXIS fho_w fak_uw_b4 5 0.00 3.999939 FORMAT "%8.6" DEPOSIT ABSOLUTE /end AXIS_DESCR
/end CHARACTERISTIC
/begin CHARACTERISTIC KLMLDSLOMX "" CURVE 0x8E5D16 KlAUwSstUwWUw 6553.500 m_q0p1 0.00 6553.500 FORMAT "%8.3"
 /begin AXIS_DESCR STD_AXIS fho_w fak_uw_b4 5 0.00 3.999939 FORMAT "%8.6" DEPOSIT ABSOLUTE /end AXIS_DESCR
/end CHARACTERISTIC
/begin CHARACTERISTIC KLTALUST "" CURVE 0x8E6922 KlAUbSstUbWUw 655.3500 t_q0p01 0.00 655.3500 FORMAT "%8.4"
 /begin AXIS_DESCR STD_AXIS tmst temp_ub_q0p75_o48 4 -48.00 143.3 FORMAT "%5.1" DEPOSIT ABSOLUTE /end AXIS_DESCR
/end CHARACTERISTIC
/begin CHARACTERISTIC KLTKTSTOER "" CURVE 0x8E823E KlAUbSstUbWUw 6553.500 t100msxs_uw_b6553p5 0.00 6553.500 FORMAT "%8.3" /begin AXIS_DESCR STD_AXIS avkatfm fak_ub_b1 4 0.00 0.9961 DEPOSIT ABSOLUTE /end AXIS_DESCR /end CHARACTERISTIC
/begin CHARACTERISTIC KLTUSHKV "" CURVE 0x8E824C KlAUbSstUbWUw 6553.500 t100msxs_uw_b6553p5 0.00 6553.500 FORMAT "%8.3" /begin AXIS_DESCR STD_AXIS avkatfm fak_ub_b1 4 0.00 0.9961 DEPOSIT ABSOLUTE /end AXIS_DESCR /end CHARACTERISTIC
/begin CHARACTERISTIC KMXSTG "" VALUE 0x8E8030 KwUw 0.9999847 fak_uw_b1 0.00 0.9999847 FORMAT "%9.7" /end CHARACTERISTIC
/begin CHARACTERISTIC KTLAMSTEIG "" VALUE 0x8E8032 KwUw 0.9999847 fak_uw_b1 0.00 0.9999847 FORMAT "%9.7" /end CHARACTERISTIC
/begin CHARACTERISTIC LAMLASHMIN "" VALUE 0x8E8034 KwUw 15.99976 fak_uw_b16 0.00 15.99976 FORMAT "%8.5" /end CHARACTERISTIC
/begin CHARACTERISTIC LAMMN "" VALUE 0x8E8144 KwUw 15.99976 fak_uw_b16 0.00 15.99976 FORMAT "%8.5" /end CHARACTERISTIC
/begin CHARACTERISTIC LAMMX "" VALUE 0x8E8146 KwUw 15.99976 fak_uw_b16 0.00 15.99976 FORMAT "%8.5" /end CHARACTERISTIC
/begin CHARACTERISTIC LAMSONSVL "" VALUE 0x8E8036 KwUw 15.99976 fak_uw_b16 0.00 15.99976 FORMAT "%8.5" /end CHARACTERISTIC
/begin CHARACTERISTIC LAMSSAMN "" VALUE 0x8E167F KwUb 1.992 fak_ub_b2 0.00 1.992 FORMAT "%5.3" /end CHARACTERISTIC
/begin CHARACTERISTIC LAMSSAMX "" VALUE 0x8E1680 KwUb 1.992 fak_ub_b2 0.00 1.992 FORMAT "%5.3" /end CHARACTERISTIC
/begin CHARACTERISTIC LAMSTEIG "" VALUE 0x8E8038 KwUw 0.9999847 fak_uw_b1 0.00 0.9999847 FORMAT "%9.7" /end CHARACTERISTIC
/begin CHARACTERISTIC LASPLCFT "" VALUE 0x8E8148 KwUw 15.99976 fak_uw_b16 0.00 15.99976 FORMAT "%8.5" /end CHARACTERISTIC
/begin CHARACTERISTIC LASPLCMR "" VALUE 0x8E814A KwUw 15.99976 fak_uw_b16 0.00 15.99976 FORMAT "%8.5" /end CHARACTERISTIC
/begin CHARACTERISTIC LSUNAMN "" VALUE 0x8E814C KwUw 15.99976 fak_uw_b16 0.00 15.99976 FORMAT "%8.5" /end CHARACTERISTIC
/begin CHARACTERISTIC LSUNAMX "" VALUE 0x8E814E KwUw 15.99976 fak_uw_b16 0.00 15.99976 FORMAT "%8.5" /end CHARACTERISTIC
/begin CHARACTERISTIC LURBMI "" CURVE 0x8E6612 KlAUwSstUwWSw 323.3710 luquant -161.6879 161.6830 FORMAT "%8.4"
 /begin AXIS_DESCR STD_AXIS midmd_w rel_uw_b100 4 0.00 99.99847 FORMAT "%8.5" DEPOSIT ABSOLUTE /end AXIS_DESCR
/end CHARACTERISTIC
/begin CHARACTERISTIC LURFOST "" VALUE 0x8FD98A KwUw 323.3710 luquant 0.00 323.3710 FORMAT "%8.4" /end CHARACTERISTIC
/begin CHARACTERISTIC LURKTM "" CURVE 0x8E6624 KlASwSstSwWSw 323.3710 luquant -161.6879 161.6830 FORMAT "%8.4"
 /begin AXIS_DESCR STD_AXIS tmot temp_ub_q0p75_o48 8 -48.00 143.3 FORMAT "%5.1" DEPOSIT ABSOLUTE /end AXIS_DESCR
/end CHARACTERISTIC
/begin CHARACTERISTIC LURMIN1 "" CURVE 0x8E6646 GklWSw 323.3710 luquant -161.6879 161.6830 FORMAT "%8.4"
 /begin AXIS_DESCR COM_AXIS nmot nmot_ub_q40 8 0.00 10200. FORMAT "%5.0" AXIS_PTS_REF SNM08DMUB /end AXIS_DESCR
/end CHARACTERISTIC
/begin CHARACTERISTIC LURMIN2 "" CURVE 0x8E6656 GklWSw 323.3710 luquant -161.6879 161.6830 FORMAT "%8.4"
 /begin AXIS_DESCR COM_AXIS nmot nmot_ub_q40 8 0.00 10200. FORMAT "%5.0" AXIS_PTS_REF SNM08DMUB /end AXIS_DESCR
/end CHARACTERISTIC
/begin CHARACTERISTIC LURMIN3 "" CURVE 0x8E6666 GklWSw 323.3710 luquant -161.6879 161.6830 FORMAT "%8.4"
 /begin AXIS_DESCR COM_AXIS nmot nmot_ub_q40 8 0.00 10200. FORMAT "%5.0" AXIS_PTS_REF SNM08DMUB /end AXIS_DESCR
/end CHARACTERISTIC
/begin CHARACTERISTIC LURST "" CURVE 0x8E6676 KlAUwSstUwWUw 1.999969 fak_uw_b2 0.00 1.999969 FORMAT "%8.6"
 /begin AXIS_DESCR STD_AXIS tnst_w t10msxs_uw_b655p35 6 0.00 655.3500 FORMAT "%8.4" DEPOSIT ABSOLUTE /end AXIS_DESCR
/end CHARACTERISTIC
/begin CHARACTERISTIC MDERFOKH "" VALUE 0x8FD91E KwUw 65535.00 dez 0.00 65535.00 FORMAT "%8.2" /end CHARACTERISTIC
/begin CHARACTERISTIC MDERKFON "" VALUE 0x8FD920 KwUw 65535.00 dez 0.00 65535.00 FORMAT "%8.2" /end CHARACTERISTIC
/begin CHARACTERISTIC MILANTI "" VALUE 0x8FCDF9 KwUb 1.000 dez 0.00 1.000 FORMAT "%5.3" /end CHARACTERISTIC
/begin CHARACTERISTIC MISALUN "" CURVE 0x8E0597 GklWUb 99.61 rel_ub_b99p6 0.00 99.61 FORMAT "%5.2"
 /begin AXIS_DESCR COM_AXIS nmot nmot_ub_q40 8 0.00 10200. FORMAT "%5.0" AXIS_PTS_REF SNM08DMUB /end AXIS_DESCR
/end CHARACTERISTIC
/begin CHARACTERISTIC MLLASH "" VALUE 0x8E803A KwUw 6553.500 m_q0p1 0.00 6553.500 FORMAT "%8.3" /end CHARACTERISTIC
/begin CHARACTERISTIC MLOKTV "" VALUE 0x8E825A KwUw 6553.500 m_uw_b6553p5 0.00 6553.500 FORMAT "%8.3" /end CHARACTERISTIC
/begin CHARACTERISTIC MLOSHKVERT "" VALUE 0x8E825C KwUw 6553.500 m_uw_b6553p5 0.00 6553.500 FORMAT "%8.3" /end CHARACTERISTIC
/begin CHARACTERISTIC MLOSTEST "" VALUE 0x8E803C KwUw 6553.500 m_q0p1 0.00 6553.500 FORMAT "%8.3" /end CHARACTERISTIC
/begin CHARACTERISTIC MLUKTV "" VALUE 0x8E825E KwUw 6553.500 m_uw_b6553p5 0.00 6553.500 FORMAT "%8.3" /end CHARACTERISTIC
/begin CHARACTERISTIC MLUSHKVERT "" VALUE 0x8E8260 KwUw 6553.500 m_uw_b6553p5 0.00 6553.500 FORMAT "%8.3" /end CHARACTERISTIC
/begin CHARACTERISTIC MLUSSTG "" VALUE 0x8FDC3E KwUw 6553.500 m_q0p1 0.00 6553.500 FORMAT "%8.3" /end CHARACTERISTIC
/begin CHARACTERISTIC MLUSTEST "" VALUE 0x8E803E KwUw 6553.500 m_q0p1 0.00 6553.500 FORMAT "%8.3" /end CHARACTERISTIC
/begin CHARACTERISTIC MLUSVL "" VALUE 0x8E8040 KwUw 6553.500 m_q0p1 0.00 6553.500 FORMAT "%8.3" /end CHARACTERISTIC
/begin CHARACTERISTIC MLWDSLAMN "" VALUE 0x8E5D2C KwUw 6553.500 m_uw_b6553p5 0.00 6553.500 FORMAT "%8.3" /end CHARACTERISTIC
/begin CHARACTERISTIC MLWDSLKMN "" VALUE 0x8E5D2E KwUw 6553.500 m_uw_b6553p5 0.00 6553.500 FORMAT "%8.3" /end CHARACTERISTIC
/begin CHARACTERISTIC MLWDSLMN "" VALUE 0x8E5D30 KwUw 6553.500 m_uw_b6553p5 0.00 6553.500 FORMAT "%8.3" /end CHARACTERISTIC
/begin CHARACTERISTIC MLWDSLOMN "" VALUE 0x8E5D32 KwUw 6553.500 m_uw_b6553p5 0.00 6553.500 FORMAT "%8.3" /end CHARACTERISTIC
/begin CHARACTERISTIC MSLBAS "" VALUE 0x8E0366 KwUb 102.0 m_q0p4 0.00 102.0 FORMAT "%5.1" /end CHARACTERISTIC
/begin CHARACTERISTIC MSLVMX "" VALUE 0x8E5D34 KwUw 102.3984 m_q0p0015625 0.00 102.3984 FORMAT "%8.4" /end CHARACTERISTIC
/begin CHARACTERISTIC MSLVMXK "" VALUE 0x8E5D36 KwUw 102.3984 m_q0p0015625 0.00 102.3984 FORMAT "%8.4" /end CHARACTERISTIC
/begin CHARACTERISTIC MSLVMXX "" VALUE 0x8E5D38 KwUw 102.3984 m_q0p0015625 0.00 102.3984 FORMAT "%8.4" /end CHARACTERISTIC
/begin CHARACTERISTIC MSLVMXXK "" VALUE 0x8E5D3A KwUw 102.3984 m_q0p0015625 0.00 102.3984 FORMAT "%8.4" /end CHARACTERISTIC
/begin CHARACTERISTIC NFLUV "" VALUE 0x8FCDEE KwUb 10200. nmot_ub_q40 0.00 10200. FORMAT "%5.0" /end CHARACTERISTIC
/begin CHARACTERISTIC NGALUN "" CURVE 0x8E6930 GklWUw 25599.94 nmotg_sw_q0p39 0.00 25599.94 FORMAT "%8.2"
 /begin AXIS_DESCR COM_AXIS nmot nmot_ub_q40 8 0.00 10200. FORMAT "%5.0" AXIS_PTS_REF SNM08DMUB /end AXIS_DESCR
/end CHARACTERISTIC
/begin CHARACTERISTIC NGALUST "" VALUE 0x8FD9DC KwUw 25599.94 nmotg_sw_q0p39 0.00 25599.94 FORMAT "%8.2" /end CHARACTERISTIC
/begin CHARACTERISTIC NINITSK "" VALUE 0x8E607E KwUw 6650.000 nmot_uw_q0p25 350.0000 7000.000 FORMAT "%8.3" /end CHARACTERISTIC
/begin CHARACTERISTIC NLRFKEFDMX "" VALUE 0x8E0D5E KwUb 255.0 dez 0.00 255.0 FORMAT "%5.1" /end CHARACTERISTIC
/begin CHARACTERISTIC NMAXF "" VALUE 0x8FDC24 KwUw 16383.75 nmot_uw_q0p25 0.00 16383.75 FORMAT "%8.2" /end CHARACTERISTIC
/begin CHARACTERISTIC NMIALU "" VALUE 0x8E059F KwUb 10200. nmot_ub_q40 0.00 10200. FORMAT "%5.0" /end CHARACTERISTIC
/begin CHARACTERISTIC NMIDLU "" VALUE 0x8FCDEF KwUb 10200. nmot_ub_q40 0.00 10200. FORMAT "%5.0" /end CHARACTERISTIC
/begin CHARACTERISTIC NMNFSE "" VALUE 0x8FCDDC KwUb 10200. nmot_ub_q40 0.00 10200. FORMAT "%5.0" /end CHARACTERISTIC
/begin CHARACTERISTIC NMNTKOMP "" VALUE 0x8E6080 KwUw 6650.000 nmot_uw_q0p25 350.0000 7000.000 FORMAT "%8.3" /end CHARACTERISTIC
/begin CHARACTERISTIC NMXALU "" VALUE 0x8E05A0 KwUb 10200. nmot_ub_q40 0.00 10200. FORMAT "%5.0" /end CHARACTERISTIC
/begin CHARACTERISTIC NSTDMD "" VALUE 0x8FD9DE KwUw 16383.75 nmot_uw_q0p25 0.00 16383.75 FORMAT "%8.2" /end CHARACTERISTIC
/begin CHARACTERISTIC NWFDECA "" VALUE 0x8E3D0F KwUb 255.0 dez 0.00 255.0 FORMAT "%5.1" /end CHARACTERISTIC
/begin CHARACTERISTIC NWFDECE "" VALUE 0x8E3C0E KwUb 255.0 dez 0.00 255.0 FORMAT "%5.1" /end CHARACTERISTIC
/begin CHARACTERISTIC NWFINCA "" VALUE 0x8E3D10 KwUb 255.0 dez 0.00 255.0 FORMAT "%5.1" /end CHARACTERISTIC
/begin CHARACTERISTIC NWFINCE "" VALUE 0x8E3C0F KwUb 255.0 dez 0.00 255.0 FORMAT "%5.1" /end CHARACTERISTIC
/begin CHARACTERISTIC NWFMXA "" VALUE 0x8E3D11 KwUb 255.0 dez 0.00 255.0 FORMAT "%5.1" /end CHARACTERISTIC
/begin CHARACTERISTIC NWFMXE "" VALUE 0x8E3C10 KwUb 255.0 dez 0.00 255.0 FORMAT "%5.1" /end CHARACTERISTIC
/begin CHARACTERISTIC NWFSPLA "" VALUE 0x8E3D12 KwUb 255.0 dez 0.00 255.0 FORMAT "%5.1" /end CHARACTERISTIC
/begin CHARACTERISTIC NWFSPLE "" VALUE 0x8E3C11 KwUb 255.0 dez 0.00 255.0 FORMAT "%5.1" /end CHARACTERISTIC
/begin CHARACTERISTIC PHNOKA "" VALUE 0x8FCE0B KwUb 255.0 dez 0.00 255.0 FORMAT "%5.1" /end CHARACTERISTIC
/begin CHARACTERISTIC RANDSEED "" VALUE 0x8E6940 KwUw 65535.00 dez 0.00 65535.00 FORMAT "%8.2" /end CHARACTERISTIC
/begin CHARACTERISTIC RISIGRESH "" VALUE 0x8E8006 KwUw 131070.0 r_uw_q2 0.00 131070.0 FORMAT "%8.1" /end CHARACTERISTIC
/begin CHARACTERISTIC RMSLMN "" VALUE 0x8E0367 KwUb 1.992 fak_ub_b2 0.00 1.992 FORMAT "%5.3" /end CHARACTERISTIC
/begin CHARACTERISTIC RMSLMNK "" VALUE 0x8E0368 KwUb 1.992 fak_ub_b2 0.00 1.992 FORMAT "%5.3" /end CHARACTERISTIC
/begin CHARACTERISTIC RMSLMNST "" VALUE 0x8E0369 KwUb 1.992 fak_ub_b2 0.00 1.992 FORMAT "%5.3" /end CHARACTERISTIC
/begin CHARACTERISTIC RMSLMXST "" VALUE 0x8E036A KwUb 1.992 fak_ub_b2 0.00 1.992 FORMAT "%5.3" /end CHARACTERISTIC
/begin CHARACTERISTIC RMSLPMN "" VALUE 0x8E036B KwUb 1.992 fak_ub_b2 0.00 1.992 FORMAT "%5.3" /end CHARACTERISTIC
/begin CHARACTERISTIC RMSLTMN "" VALUE 0x8E036C KwUb 1.992 fak_ub_b2 0.00 1.992 FORMAT "%5.3" /end CHARACTERISTIC
/begin CHARACTERISTIC SAFK1 "" VALUE 0x8EA266 KwUw 0.9999847 fak_uw_b1 0.00 0.9999847 FORMAT "%9.7" /end CHARACTERISTIC
/begin CHARACTERISTIC SDLAOFMN "" VALUE 0x8E8150 KwSw 1.999969 fak_sw_b1 -1.000000 0.9999695 FORMAT "%8.6" /end CHARACTERISTIC
/begin CHARACTERISTIC SDLAOFMN2 "" VALUE 0x8E8152 KwSw 1.999969 fak_sw_b1 -1.000000 0.9999695 FORMAT "%8.6" /end CHARACTERISTIC
/begin CHARACTERISTIC SDLAOFMX "" VALUE 0x8E8154 KwSw 1.999969 fak_sw_b1 -1.000000 0.9999695 FORMAT "%8.6" /end CHARACTERISTIC
/begin CHARACTERISTIC SDLAOFMX2 "" VALUE 0x8E8156 KwSw 1.999969 fak_sw_b1 -1.000000 0.9999695 FORMAT "%8.6" /end CHARACTERISTIC
/begin CHARACTERISTIC SFONTM "" VALUE 0x8E05A1 KwUb 191.3 temp_ub_q0p75_o48 -48.00 143.3 FORMAT "%5.1" /end CHARACTERISTIC
/begin CHARACTERISTIC SLFOFO1N "" CURVE 0x8E604C GklWSw 239.9963 kw_dmdfof2 -120.0000 119.9963 FORMAT "%8.4"
 /begin AXIS_DESCR COM_AXIS nmot nmot_ub_q40 4 0.00 10200. FORMAT "%5.0" AXIS_PTS_REF SNM04DM1UB /end AXIS_DESCR
/end CHARACTERISTIC
/begin CHARACTERISTIC SLFOFO2N "" CURVE 0x8E6054 GklWSw 239.9963 kw_dmdfof2 -120.0000 119.9963 FORMAT "%8.4"
 /begin AXIS_DESCR COM_AXIS nmot nmot_ub_q40 4 0.00 10200. FORMAT "%5.0" AXIS_PTS_REF SNM04DM2UB /end AXIS_DESCR
/end CHARACTERISTIC
/begin CHARACTERISTIC SLFOFO3N "" CURVE 0x8E605C GklWSw 239.9963 kw_dmdfof2 -120.0000 119.9963 FORMAT "%8.4"
 /begin AXIS_DESCR COM_AXIS nmot nmot_ub_q40 4 0.00 10200. FORMAT "%5.0" AXIS_PTS_REF SNM04DM2UB /end AXIS_DESCR
/end CHARACTERISTIC
/begin CHARACTERISTIC SLFOFU1N "" CURVE 0x8E6064 GklWSw 239.9963 kw_dmdfof2 -120.0000 119.9963 FORMAT "%8.4"
 /begin AXIS_DESCR COM_AXIS nmot nmot_ub_q40 4 0.00 10200. FORMAT "%5.0" AXIS_PTS_REF SNM04DM1UB /end AXIS_DESCR
/end CHARACTERISTIC
/begin CHARACTERISTIC SLFOFU2N "" CURVE 0x8E606C GklWSw 239.9963 kw_dmdfof2 -120.0000 119.9963 FORMAT "%8.4"
 /begin AXIS_DESCR COM_AXIS nmot nmot_ub_q40 4 0.00 10200. FORMAT "%5.0" AXIS_PTS_REF SNM04DM2UB /end AXIS_DESCR
/end CHARACTERISTIC
/begin CHARACTERISTIC SLFOFU3N "" CURVE 0x8E6074 GklWSw 239.9963 kw_dmdfof2 -120.0000 119.9963 FORMAT "%8.4"
 /begin AXIS_DESCR COM_AXIS nmot nmot_ub_q40 4 0.00 10200. FORMAT "%5.0" AXIS_PTS_REF SNM04DM2UB /end AXIS_DESCR
/end CHARACTERISTIC
/begin CHARACTERISTIC SLFOO1N "" CURVE 0x8E5FEC GklWSw 323.3710 luquant -161.6879 161.6830 FORMAT "%8.4"
 /begin AXIS_DESCR COM_AXIS nmot nmot_ub_q40 8 0.00 10200. FORMAT "%5.0" AXIS_PTS_REF SNM08DM1UB /end AXIS_DESCR
/end CHARACTERISTIC
/begin CHARACTERISTIC SLFOO2N "" CURVE 0x8E5FFC GklWSw 323.3710 luquant -161.6879 161.6830 FORMAT "%8.4"
 /begin AXIS_DESCR COM_AXIS nmot nmot_ub_q40 8 0.00 10200. FORMAT "%5.0" AXIS_PTS_REF SNM08DM2UB /end AXIS_DESCR
/end CHARACTERISTIC
/begin CHARACTERISTIC SLFOO3N "" CURVE 0x8E600C GklWSw 323.3710 luquant -161.6879 161.6830 FORMAT "%8.4"
 /begin AXIS_DESCR COM_AXIS nmot nmot_ub_q40 8 0.00 10200. FORMAT "%5.0" AXIS_PTS_REF SNM08DM4UB /end AXIS_DESCR
/end CHARACTERISTIC
/begin CHARACTERISTIC SLFOU1N "" CURVE 0x8E601C GklWSw 323.3710 luquant -161.6879 161.6830 FORMAT "%8.4"
 /begin AXIS_DESCR COM_AXIS nmot nmot_ub_q40 8 0.00 10200. FORMAT "%5.0" AXIS_PTS_REF SNM08DM1UB /end AXIS_DESCR
/end CHARACTERISTIC
/begin CHARACTERISTIC SLFOU2N "" CURVE 0x8E602C GklWSw 323.3710 luquant -161.6879 161.6830 FORMAT "%8.4"
 /begin AXIS_DESCR COM_AXIS nmot nmot_ub_q40 8 0.00 10200. FORMAT "%5.0" AXIS_PTS_REF SNM08DM2UB /end AXIS_DESCR
/end CHARACTERISTIC
/begin CHARACTERISTIC SLFOU3N "" CURVE 0x8E603C GklWSw 323.3710 luquant -161.6879 161.6830 FORMAT "%8.4"
 /begin AXIS_DESCR COM_AXIS nmot nmot_ub_q40 8 0.00 10200. FORMAT "%5.0" AXIS_PTS_REF SNM08DM4UB /end AXIS_DESCR
/end CHARACTERISTIC
/begin AXIS_PTS SMI08DM1UB "" 0x8E0451 midmd SstAUbSstUb 99.61 rel_ub_b99p6 8 0.00 99.61 FORMAT "%5.2" DEPOSIT ABSOLUTE /end AXIS_PTS
/begin AXIS_PTS SMI08DMUB "" 0x8E045A midmd SstAUbSstUb 99.61 rel_ub_b99p6 8 0.00 99.61 FORMAT "%5.2" DEPOSIT ABSOLUTE /end AXIS_PTS
/begin CHARACTERISTIC SMLDYN "" VALUE 0x8E8042 KwUw 182.0417 m_q0p00277 0.00 182.0417 FORMAT "%8.4" /end CHARACTERISTIC
/begin AXIS_PTS SNM04DM1UB "" 0x8E0463 nmot SstAUbSstUb 10200. nmot_ub_q40 4 0.00 10200. FORMAT "%5.0" DEPOSIT ABSOLUTE /end AXIS_PTS
/begin AXIS_PTS SNM04DM2UB "" 0x8E0468 nmot SstAUbSstUb 10200. nmot_ub_q40 4 0.00 10200. FORMAT "%5.0" DEPOSIT ABSOLUTE /end AXIS_PTS
/begin AXIS_PTS SNM08DM1UB "" 0x8E0484 nmot SstAUbSstUb 10200. nmot_ub_q40 8 0.00 10200. FORMAT "%5.0" DEPOSIT ABSOLUTE /end AXIS_PTS
/begin AXIS_PTS SNM08DM2UB "" 0x8E048D nmot SstAUbSstUb 10200. nmot_ub_q40 8 0.00 10200. FORMAT "%5.0" DEPOSIT ABSOLUTE /end AXIS_PTS
/begin AXIS_PTS SNM08DM3UB "" 0x8E0496 nmot SstAUbSstUb 10200. nmot_ub_q40 8 0.00 10200. FORMAT "%5.0" DEPOSIT ABSOLUTE /end AXIS_PTS
/begin AXIS_PTS SNM08DM4UB "" 0x8E049F nmot SstAUbSstUb 10200. nmot_ub_q40 8 0.00 10200. FORMAT "%5.0" DEPOSIT ABSOLUTE /end AXIS_PTS
/begin AXIS_PTS SNM08DMUB "" 0x8E04A8 nmot SstAUbSstUb 10200. nmot_ub_q40 8 0.00 10200. FORMAT "%5.0" DEPOSIT ABSOLUTE /end AXIS_PTS
/begin CHARACTERISTIC TABGSTGK "" VALUE 0x8FDC40 KwUw 1535.977 temp_q0p0234_o273 -273.1500 1262.827 FORMAT "%8.3" /end CHARACTERISTIC
/begin CHARACTERISTIC TAMDOGH "" VALUE 0x8E8008 KwUw 1535.977 temp_q0p0234_o273 -273.1500 1262.827 FORMAT "%8.3" /end CHARACTERISTIC
/begin CHARACTERISTIC TAMDUGH "" VALUE 0x8E800A KwUw 1535.977 temp_q0p0234_o273 -273.1500 1262.827 FORMAT "%8.3" /end CHARACTERISTIC
/begin CHARACTERISTIC TAMIALU "" VALUE 0x8E05A2 KwUb 191.3 temp_ub_q0p75_o48 -48.00 143.3 FORMAT "%5.1" /end CHARACTERISTIC
/begin CHARACTERISTIC TAMSIGH "" VALUE 0x8E800C KwUw 1535.977 temp_q0p0234_o273 -273.1500 1262.827 FORMAT "%8.3" /end CHARACTERISTIC
/begin CHARACTERISTIC TANDSLMN "" VALUE 0x8E036D KwUb 191.3 temp_ub_q0p75_o48 -48.00 143.3 FORMAT "%5.1" /end CHARACTERISTIC
/begin CHARACTERISTIC TANDSLMX "" VALUE 0x8E036E KwUb 191.3 temp_ub_q0p75_o48 -48.00 143.3 FORMAT "%5.1" /end CHARACTERISTIC
/begin CHARACTERISTIC TANWESTMN "" VALUE 0x8E3C14 KwUb 99.61 tv_ub_b100 0.00 99.61 FORMAT "%5.2" /end CHARACTERISTIC
/begin CHARACTERISTIC TANWESTMX "" VALUE 0x8E3C15 KwUb 99.61 tv_ub_b100 0.00 99.61 FORMAT "%5.2" /end CHARACTERISTIC
/begin CHARACTERISTIC TASIG "" VALUE 0x8FCE6E KwUb 5.100 t20msxs_ub_b5p1 0.00 5.100 FORMAT "%5.3" /end CHARACTERISTIC
/begin CHARACTERISTIC TC6CSL "" VALUE 0x8E036F KwUb 127.0 dez 0.00 127.0 FORMAT "%5.1" /end CHARACTERISTIC
/begin CHARACTERISTIC TC6CSL2 "" VALUE 0x8E0370 KwUb 127.0 dez 0.00 127.0 FORMAT "%5.1" /end CHARACTERISTIC
/begin CHARACTERISTIC TC6CSLF "" VALUE 0x8E0371 KwUb 127.0 dez 0.00 127.0 FORMAT "%5.1" /end CHARACTERISTIC
/begin CHARACTERISTIC TC6CSLF2 "" VALUE 0x8E0372 KwUb 127.0 dez 0.00 127.0 FORMAT "%5.1" /end CHARACTERISTIC
/begin CHARACTERISTIC TC6CSLK "" VALUE 0x8E0373 KwUb 127.0 dez 0.00 127.0 FORMAT "%5.1" /end CHARACTERISTIC
/begin CHARACTERISTIC TC6CSLK2 "" VALUE 0x8E0374 KwUb 127.0 dez 0.00 127.0 FORMAT "%5.1" /end CHARACTERISTIC
/begin CHARACTERISTIC TC6CSLN "" VALUE 0x8E0375 KwUb 127.0 dez 0.00 127.0 FORMAT "%5.1" /end CHARACTERISTIC
/begin CHARACTERISTIC TC6CSLN2 "" VALUE 0x8E0376 KwUb 127.0 dez 0.00 127.0 FORMAT "%5.1" /end CHARACTERISTIC
/begin CHARACTERISTIC TC6CSLV "" VALUE 0x8E0377 KwUb 127.0 dez 0.00 127.0 FORMAT "%5.1" /end CHARACTERISTIC
/begin CHARACTERISTIC TC6CSLV2 "" VALUE 0x8E0378 KwUb 127.0 dez 0.00 127.0 FORMAT "%5.1" /end CHARACTERISTIC
/begin CHARACTERISTIC TDASTAT "" VALUE 0x8E0379 KwUb 25.50 t100msxs_ub_b25p5 0.00 25.50 FORMAT "%5.2" /end CHARACTERISTIC
/begin CHARACTERISTIC TDDSLSFG "" VALUE 0x8E037A KwUb 25.50 t100msxs_ub_b25p5 0.00 25.50 FORMAT "%5.2" /end CHARACTERISTIC
/begin CHARACTERISTIC TDFGSLA "" VALUE 0x8E037B KwUb 25.40 t100msxs_ub_b25p5 0.1000 25.50 FORMAT "%5.2" /end CHARACTERISTIC
/begin CHARACTERISTIC TDFGSZSLS "" VALUE 0x8E037C KwUb 25.50 t100msxs_ub_b25p5 0.00 25.50 FORMAT "%5.2" /end CHARACTERISTIC
/begin CHARACTERISTIC TDLSVV "" VALUE 0x8E36F9 KwUb 25.50 t_q0p1 0.00 25.50 FORMAT "%5.2" /end CHARACTERISTIC
/begin CHARACTERISTIC TDMFB "" VALUE 0x8E08F9 KwUb 255.0 t1sxs_ub_b255 0.00 255.0 FORMAT "%5.1" /end CHARACTERISTIC
/begin CHARACTERISTIC TDMSLMN1 "" VALUE 0x8E037D KwUb 25.50 t100msxs_ub_b25p5 0.00 25.50 FORMAT "%5.2" /end CHARACTERISTIC
/begin CHARACTERISTIC TDMSLMN4 "" VALUE 0x8E037E KwUb 25.50 t100msxs_ub_b25p5 0.00 25.50 FORMAT "%5.2" /end CHARACTERISTIC
/begin CHARACTERISTIC TDMSLMNK "" VALUE 0x8E037F KwUb 25.50 t100msxs_ub_b25p5 0.00 25.50 FORMAT "%5.2" /end CHARACTERISTIC
/begin CHARACTERISTIC TDMSLOF3 "" VALUE 0x8E0380 KwUb 25.50 t100msxs_ub_b25p5 0.00 25.50 FORMAT "%5.2" /end CHARACTERISTIC
/begin CHARACTERISTIC TDMSLOF5 "" VALUE 0x8E0381 KwUb 25.50 t100msxs_ub_b25p5 0.00 25.50 FORMAT "%5.2" /end CHARACTERISTIC
/begin CHARACTERISTIC TDMSLOFK "" VALUE 0x8E0382 KwUb 25.50 t100msxs_ub_b25p5 0.00 25.50 FORMAT "%5.2" /end CHARACTERISTIC
/begin CHARACTERISTIC TDMSLV "" VALUE 0x8E0383 KwUb 25.50 t100msxs_ub_b25p5 0.00 25.50 FORMAT "%5.2" /end CHARACTERISTIC
/begin CHARACTERISTIC TDMSLVK "" VALUE 0x8E0384 KwUb 25.50 t100msxs_ub_b25p5 0.00 25.50 FORMAT "%5.2" /end CHARACTERISTIC
/begin CHARACTERISTIC TDNWSP "" VALUE 0x8E0912 KwUb 51.00 t200msxs_ub_b51 0.00 51.00 FORMAT "%5.2" /end CHARACTERISTIC
/begin CHARACTERISTIC TDNX "" VALUE 0x8FCE6B KwUb 2.550 t10msxs_ub_b2p55 0.00 2.550 FORMAT "%5.3" /end CHARACTERISTIC
/begin CHARACTERISTIC TDPH2SLOF "" VALUE 0x8E0385 KwUb 25.50 t100msxs_ub_b25p5 0.00 25.50 FORMAT "%5.2" /end CHARACTERISTIC
/begin CHARACTERISTIC TDPHSLOF "" VALUE 0x8E0386 KwUb 25.50 t100msxs_ub_b25p5 0.00 25.50 FORMAT "%5.2" /end CHARACTERISTIC
/begin CHARACTERISTIC TDSLMDRL "" VALUE 0x8E0387 KwUb 25.50 t100msxs_ub_b25p5 0.00 25.50 FORMAT "%5.2" /end CHARACTERISTIC
/begin CHARACTERISTIC TDSLMVBA "" VALUE 0x8E0388 KwUb 25.50 t100msxs_ub_b25p5 0.00 25.50 FORMAT "%5.2" /end CHARACTERISTIC
/begin CHARACTERISTIC TDWLSVV "" VALUE 0x8E36FA KwUb 25.50 t_q0p1 0.00 25.50 FORMAT "%5.2" /end CHARACTERISTIC
/begin CHARACTERISTIC TFIMSLI "" VALUE 0x8E0389 KwUb 12.6996 zk100msxs_ub_b25p5 0.100392 12.8000 FORMAT "%7.4" /end CHARACTERISTIC
/begin CHARACTERISTIC TFIMSLIK "" VALUE 0x8E038A KwUb 12.6996 zk100msxs_ub_b25p5 0.100392 12.8000 FORMAT "%7.4" /end CHARACTERISTIC
/begin CHARACTERISTIC TFIMSLO "" VALUE 0x8E038B KwUb 12.6996 zk100msxs_ub_b25p5 0.100392 12.8000 FORMAT "%7.4" /end CHARACTERISTIC
/begin CHARACTERISTIC TFIMSLOK "" VALUE 0x8E038C KwUb 12.6996 zk100msxs_ub_b25p5 0.100392 12.8000 FORMAT "%7.4" /end CHARACTERISTIC
/begin CHARACTERISTIC TFIMSLV "" VALUE 0x8E038D KwUb 12.6996 zk100msxs_ub_b25p5 0.100392 12.8000 FORMAT "%7.4" /end CHARACTERISTIC
/begin CHARACTERISTIC TFIMSLVK "" VALUE 0x8E038E KwUb 12.6996 zk100msxs_ub_b25p5 0.100392 12.8000 FORMAT "%7.4" /end CHARACTERISTIC
/begin CHARACTERISTIC TKATDSL "" VALUE 0x8E038F KwUb 1275. temp_ub_q5_o50 -50.00 1225. FORMAT "%5.0" /end CHARACTERISTIC
/begin CHARACTERISTIC TLAMVERG "" VALUE 0x8E8262 KwUw 6553.500 t100msxs_uw_b6553p5 0.00 6553.500 FORMAT "%8.3" /end CHARACTERISTIC
/begin CHARACTERISTIC TLLASH "" VALUE 0x8E0C94 KwUb 25.50 t100msxs_ub_b25p5 0.00 25.50 FORMAT "%5.2" /end CHARACTERISTIC
/begin CHARACTERISTIC TLRHKPAKT "" VALUE 0x8E8264 KwUw 6553.500 t100msxs_uw_b6553p5 0.00 6553.500 FORMAT "%8.3" /end CHARACTERISTIC
/begin CHARACTERISTIC TLSHVER "" VALUE 0x8E8266 KwUw 6553.500 t100msxs_uw_b6553p5 0.00 6553.500 FORMAT "%8.3" /end CHARACTERISTIC
/begin CHARACTERISTIC TLSHVOK "" VALUE 0x8E8268 KwUw 6553.500 t100msxs_uw_b6553p5 0.00 6553.500 FORMAT "%8.3" /end CHARACTERISTIC
/begin CHARACTERISTIC TLUE1ZYF "" VALUE 0x8E0EC1 KwUb 25.50 t_q0p1 0.00 25.50 FORMAT "%5.2" /end CHARACTERISTIC
/begin CHARACTERISTIC TMASKIV1 "" VALUE 0x8FCDFA KwUb 191.3 temp_ub_q0p75_o48 -48.00 143.3 FORMAT "%5.1" /end CHARACTERISTIC
/begin CHARACTERISTIC TMDSLAMN "" VALUE 0x8E0390 KwUb 191.3 temp_ub_q0p75_o48 -48.00 143.3 FORMAT "%5.1" /end CHARACTERISTIC
/begin CHARACTERISTIC TMDSLMN "" VALUE 0x8E0391 KwUb 191.3 temp_ub_q0p75_o48 -48.00 143.3 FORMAT "%5.1" /end CHARACTERISTIC
/begin CHARACTERISTIC TMDSLMX "" VALUE 0x8E0392 KwUb 191.3 temp_ub_q0p75_o48 -48.00 143.3 FORMAT "%5.1" /end CHARACTERISTIC
/begin CHARACTERISTIC TMLUSTESTH "" VALUE 0x8E0C95 KwUb 25.50 t100msxs_ub_b25p5 0.00 25.50 FORMAT "%5.2" /end CHARACTERISTIC
/begin CHARACTERISTIC TMSH "" VALUE 0x8E0C89 KwUb 191.3 temp_ub_q0p75_o48 -48.00 143.3 FORMAT "%5.1" /end CHARACTERISTIC
/begin CHARACTERISTIC TMSHA "" VALUE 0x8E0C8A KwUb 191.3 temp_ub_q0p75_o48 -48.00 143.3 FORMAT "%5.1" /end CHARACTERISTIC
/begin CHARACTERISTIC TMSLADAP "" VALUE 0x8E5D3C KwUw 6553.500 t100msxs_uw_b6553p5 0.00 6553.500 FORMAT "%8.3" /end CHARACTERISTIC
/begin CHARACTERISTIC TMSLIFT "" VALUE 0x8E5D3E KwUw 6553.500 t100msxs_uw_b6553p5 0.00 6553.500 FORMAT "%8.3" /end CHARACTERISTIC
/begin CHARACTERISTIC TMSLIFT1 "" VALUE 0x8E5D40 KwUw 6553.500 t100msxs_uw_b6553p5 0.00 6553.500 FORMAT "%8.3" /end CHARACTERISTIC
/begin CHARACTERISTIC TMSLIFTK "" VALUE 0x8E5D42 KwUw 6553.500 t100msxs_uw_b6553p5 0.00 6553.500 FORMAT "%8.3" /end CHARACTERISTIC
/begin CHARACTERISTIC TNALU "" VALUE 0x8E05AC KwUb 126.0 dez 1.000 127.0 FORMAT "%5.1" /end CHARACTERISTIC
/begin CHARACTERISTIC TNOMF2 "" VALUE 0x8E0393 KwUb 25.50 t100msxs_ub_b25p5 0.00 25.50 FORMAT "%5.2" /end CHARACTERISTIC
/begin CHARACTERISTIC TNOMF3 "" VALUE 0x8E0394 KwUb 25.50 t100msxs_ub_b25p5 0.00 25.50 FORMAT "%5.2" /end CHARACTERISTIC
/begin CHARACTERISTIC TNOMF5 "" VALUE 0x8E0395 KwUb 25.50 t100msxs_ub_b25p5 0.00 25.50 FORMAT "%5.2" /end CHARACTERISTIC
/begin CHARACTERISTIC TNSTDNH "" VALUE 0x8FCE6F KwUb 5.100 t20msxs_ub_b5p1 0.00 5.100 FORMAT "%5.3" /end CHARACTERISTIC
/begin CHARACTERISTIC TNSTDSL "" VALUE 0x8E5D44 KwUw 6553.500 t100msxs_uw_b6553p5 0.00 6553.500 FORMAT "%8.3" /end CHARACTERISTIC
/begin CHARACTERISTIC TNSTFON "" VALUE 0x8FD922 KwUw 655.3500 t_q0p01 0.00 655.3500 FORMAT "%8.4" /end CHARACTERISTIC
/begin CHARACTERISTIC TRIPFASH "" VALUE 0x8E8044 KwUw 6553.500 t100msxs_uw_b6553p5 0.00 6553.500 FORMAT "%8.3" /end CHARACTERISTIC
/begin CHARACTERISTIC TRIPLSHV "" VALUE 0x8E826A KwUw 6553.500 t100msxs_uw_b6553p5 0.00 6553.500 FORMAT "%8.3" /end CHARACTERISTIC
/begin CHARACTERISTIC TRSAFA "" VALUE 0x8E800E KwUw 6553.500 t100msxs_uw_q100 0.00 6553.500 FORMAT "%8.3" /end CHARACTERISTIC
/begin CHARACTERISTIC TRSAH "" VALUE 0x8E8010 KwUw 6553.500 t100msxs_uw_q100 0.00 6553.500 FORMAT "%8.3" /end CHARACTERISTIC
/begin CHARACTERISTIC TRSE "" VALUE 0x8E0C8B KwUb 25.50 t100msxs_ub_b25p5 0.00 25.50 FORMAT "%5.2" /end CHARACTERISTIC
/begin CHARACTERISTIC TSALASH "" VALUE 0x8E0C96 KwUb 25.50 t100msxs_ub_b25p5 0.00 25.50 FORMAT "%5.2" /end CHARACTERISTIC
/begin CHARACTERISTIC TSBVDSLTMS "" CURVE 0x8E5D46 KlAUbSstUbWUw 6553.500 t100msxs_uw_b6553p5 0.00 6553.500 FORMAT "%8.3"
 /begin AXIS_DESCR STD_AXIS tmst temp_ub_q0p75_o48 6 -48.00 143.3 FORMAT "%5.1" DEPOSIT ABSOLUTE /end AXIS_DESCR
/end CHARACTERISTIC
/begin CHARACTERISTIC TTBMH "" VALUE 0x8E8012 KwUw 6553.500 t100msxs_uw_q100 0.00 6553.500 FORMAT "%8.3" /end CHARACTERISTIC
/begin CHARACTERISTIC TTLASH "" VALUE 0x8E8046 KwUw 6553.500 t100msxs_uw_b6553p5 0.00 6553.500 FORMAT "%8.3" /end CHARACTERISTIC
/begin CHARACTERISTIC TUSCHUB "" VALUE 0x8E0C97 KwUb 25.50 t100msxs_ub_b25p5 0.00 25.50 FORMAT "%5.2" /end CHARACTERISTIC
/begin CHARACTERISTIC TUSEHKH "" VALUE 0x8E8014 KwUw 6553.500 t100msxs_uw_q100 0.00 6553.500 FORMAT "%8.3" /end CHARACTERISTIC
/begin CHARACTERISTIC TUSENLASH "" VALUE 0x8E8048 KwUw 6553.500 t100msxs_uw_b6553p5 0.00 6553.500 FORMAT "%8.3" /end CHARACTERISTIC
/begin CHARACTERISTIC TUSHKRFM "" VALUE 0x8E804A KwUw 6553.500 t100msxs_uw_b6553p5 0.00 6553.500 FORMAT "%8.3" /end CHARACTERISTIC
/begin CHARACTERISTIC TUSHKVL "" VALUE 0x8E0C98 KwUb 25.50 t100msxs_ub_b25p5 0.00 25.50 FORMAT "%5.2" /end CHARACTERISTIC
/begin CHARACTERISTIC TUSHSMIN "" VALUE 0x8E0C99 KwUb 25.50 t100msxs_ub_b25p5 0.00 25.50 FORMAT "%5.2" /end CHARACTERISTIC
/begin CHARACTERISTIC TUSHZFH "" VALUE 0x8FCE70 KwUb 2.550 t10msxs_ub_b2p55 0.00 2.550 FORMAT "%5.3" /end CHARACTERISTIC
/begin CHARACTERISTIC TUSKS "" VALUE 0x8FCE71 KwUb 5.100 t20msxs_ub_b5p1 0.00 5.100 FORMAT "%5.3" /end CHARACTERISTIC
/begin CHARACTERISTIC TUSLASH "" VALUE 0x8E804C KwUw 6553.500 t100msxs_uw_b6553p5 0.00 6553.500 FORMAT "%8.3" /end CHARACTERISTIC
/begin CHARACTERISTIC TUSLSHV "" VALUE 0x8E826C KwUw 6553.500 t100msxs_uw_b6553p5 0.00 6553.500 FORMAT "%8.3" /end CHARACTERISTIC
/begin CHARACTERISTIC TUSMAX "" VALUE 0x8E0C8C KwUb 25.50 t100msxs_ub_b25p5 0.00 25.50 FORMAT "%5.2" /end CHARACTERISTIC
/begin CHARACTERISTIC TUSMSVL "" VALUE 0x8E0C9A KwUb 25.50 t100msxs_ub_b25p5 0.00 25.50 FORMAT "%5.2" /end CHARACTERISTIC
/begin CHARACTERISTIC TUSSA "" VALUE 0x8E0C9B KwUb 25.50 t100msxs_ub_b25p5 0.00 25.50 FORMAT "%5.2" /end CHARACTERISTIC
/begin CHARACTERISTIC TUSTAL "" VALUE 0x8E8016 KwUw 6553.500 t100msxs_uw_q100 0.00 6553.500 FORMAT "%8.3" /end CHARACTERISTIC
/begin CHARACTERISTIC TUSTALLASH "" VALUE 0x8E804E KwUw 6553.500 t100msxs_uw_b6553p5 0.00 6553.500 FORMAT "%8.3" /end CHARACTERISTIC
/begin CHARACTERISTIC TVHELSUF "" VALUE 0x8E0D5F KwUb 25.50 t100msxs_ub_b25p5 0.00 25.50 FORMAT "%5.2" /end CHARACTERISTIC
/begin CHARACTERISTIC TVLSUEK "" VALUE 0x8E8158 KwUw 6553.500 t100msxs_uw_b6553p5 0.00 6553.500 FORMAT "%8.3" /end CHARACTERISTIC
/begin CHARACTERISTIC TVLSUEK2 "" VALUE 0x8E815A KwUw 6553.500 t100msxs_uw_b6553p5 0.00 6553.500 FORMAT "%8.3" /end CHARACTERISTIC
/begin CHARACTERISTIC TVLSUOF "" VALUE 0x8E815C KwUw 6553.500 t100msxs_uw_b6553p5 0.00 6553.500 FORMAT "%8.3" /end CHARACTERISTIC
/begin CHARACTERISTIC TVLSUOF2 "" VALUE 0x8E815E KwUw 6553.500 t100msxs_uw_b6553p5 0.00 6553.500 FORMAT "%8.3" /end CHARACTERISTIC
/begin CHARACTERISTIC TVLSUPER "" VALUE 0x8E0D60 KwUb 25.50 t100msxs_ub_b25p5 0.00 25.50 FORMAT "%5.2" /end CHARACTERISTIC
/begin CHARACTERISTIC TVLSUPER2 "" VALUE 0x8E0D61 KwUb 25.50 t100msxs_ub_b25p5 0.00 25.50 FORMAT "%5.2" /end CHARACTERISTIC
/begin CHARACTERISTIC TVLUES1MN "" VALUE 0x8E0EC2 KwUb 99.61 tv_ub_b100 0.00 99.61 FORMAT "%5.2" /end CHARACTERISTIC
/begin CHARACTERISTIC TVLUES1MX "" VALUE 0x8E0EC3 KwUb 99.61 tv_ub_b100 0.00 99.61 FORMAT "%5.2" /end CHARACTERISTIC
/begin CHARACTERISTIC TVSNPF "" VALUE 0x8E0D62 KwUb 25.50 t100msxs_ub_b25p5 0.00 25.50 FORMAT "%5.2" /end CHARACTERISTIC
/begin CHARACTERISTIC TVSNPF2 "" VALUE 0x8E0D63 KwUb 25.50 t100msxs_ub_b25p5 0.00 25.50 FORMAT "%5.2" /end CHARACTERISTIC
/begin CHARACTERISTIC TWDLSSA "" VALUE 0x8EA268 KwUw 3276.750 t50msxs_uw_b3276p75 0.00 3276.750 FORMAT "%8.3" /end CHARACTERISTIC
/begin CHARACTERISTIC TWDSLTM "" VALUE 0x8E0396 KwUb 25.40 t100msxs_ub_b25p5 0.1000 25.50 FORMAT "%5.2" /end CHARACTERISTIC
/begin CHARACTERISTIC TWHLSLP "" VALUE 0x8E0397 KwUb 25.50 t100msxs_ub_b25p5 0.00 25.50 FORMAT "%5.2" /end CHARACTERISTIC
/begin CHARACTERISTIC TWMLFE "" VALUE 0x8E0398 KwUb 25.50 t100msxs_ub_b25p5 0.00 25.50 FORMAT "%5.2" /end CHARACTERISTIC
/begin CHARACTERISTIC TWMSLMIN "" VALUE 0x8E0399 KwUb 25.50 t100msxs_ub_b25p5 0.00 25.50 FORMAT "%5.2" /end CHARACTERISTIC
/begin CHARACTERISTIC UBDLS "" VALUE 0x8E0C8D KwUb 17.95 spg_ubatt 0.00 17.95 FORMAT "%5.2" /end CHARACTERISTIC
/begin CHARACTERISTIC USHKFT "" VALUE 0x8E8160 KwUw 319.9951 spg_uw_q0p00488_o1 -1.000000 318.9951 FORMAT "%8.4" /end CHARACTERISTIC
/begin CHARACTERISTIC USHKMR "" VALUE 0x8E8162 KwUw 319.9951 spg_uw_q0p00488_o1 -1.000000 318.9951 FORMAT "%8.4" /end CHARACTERISTIC
/begin CHARACTERISTIC USHKVERTO "" VALUE 0x8FDC4A KwUw 319.9951 spg_uw_q0p00488_o1 -1.000000 318.9951 FORMAT "%8.4" /end CHARACTERISTIC
/begin CHARACTERISTIC USHKVERTU "" VALUE 0x8FDC4C KwUw 319.9951 spg_uw_q0p00488_o1 -1.000000 318.9951 FORMAT "%8.4" /end CHARACTERISTIC
/begin CHARACTERISTIC USHKVL "" VALUE 0x8E0C9C KwUb 1.330 spg_ub_q0p0052_o0p2 -0.2000 1.130 FORMAT "%5.3" /end CHARACTERISTIC
/begin CHARACTERISTIC USHLEAN "" VALUE 0x8FCE74 KwUb 1.330 spg_ub_q0p0052_o0p2 -0.2000 1.130 FORMAT "%5.3" /end CHARACTERISTIC
/begin CHARACTERISTIC USHRICH "" VALUE 0x8FCE75 KwUb 1.330 spg_ub_q0p0052_o0p2 -0.2000 1.130 FORMAT "%5.3" /end CHARACTERISTIC
/begin CHARACTERISTIC USHSTGMX "" VALUE 0x8E0C9D KwUb 132.6 spgg_q0p52 0.00 132.6 FORMAT "%5.1" /end CHARACTERISTIC
/begin CHARACTERISTIC USHSTSOLL "" VALUE 0x8E0C9E KwUb 132.6 spgg_q0p52 0.00 132.6 FORMAT "%5.1" /end CHARACTERISTIC
/begin CHARACTERISTIC USHVO "" VALUE 0x8E826E KwUw 319.9951 spg_uw_q0p00488_o1 -1.000000 318.9951 FORMAT "%8.4" /end CHARACTERISTIC
/begin CHARACTERISTIC USHVU "" VALUE 0x8E8270 KwUw 319.9951 spg_uw_q0p00488_o1 -1.000000 318.9951 FORMAT "%8.4" /end CHARACTERISTIC
/begin CHARACTERISTIC USIVMAXH "" VALUE 0x8E1681 KwUb 1.330 spg_ub_b1p33 0.00 1.330 FORMAT "%5.3" /end CHARACTERISTIC
/begin CHARACTERISTIC USIVMINH "" VALUE 0x8E1682 KwUb 1.330 spg_ub_b1p33 0.00 1.330 FORMAT "%5.3" /end CHARACTERISTIC
/begin CHARACTERISTIC USMAX "" VALUE 0x8FDC28 KwUw 319.9951 spg_uw_q0p00488_o1 -1.000000 318.9951 FORMAT "%8.4" /end CHARACTERISTIC
/begin CHARACTERISTIC USMIN "" VALUE 0x8FDC2A KwUw 319.9951 spg_uw_q0p00488_o1 -1.000000 318.9951 FORMAT "%8.4" /end CHARACTERISTIC
/begin CHARACTERISTIC USMNSHMN "" VALUE 0x8E1683 KwUb 1.330 spg_ub_b1p33 0.00 1.330 FORMAT "%5.3" /end CHARACTERISTIC
/begin CHARACTERISTIC USMNSHMX "" VALUE 0x8E1684 KwUb 1.330 spg_ub_b1p33 0.00 1.330 FORMAT "%5.3" /end CHARACTERISTIC
/begin CHARACTERISTIC USMXSHMN "" VALUE 0x8E1685 KwUb 1.330 spg_ub_b1p33 0.00 1.330 FORMAT "%5.3" /end CHARACTERISTIC
/begin CHARACTERISTIC USMXSHMX "" VALUE 0x8E1686 KwUb 1.330 spg_ub_b1p33 0.00 1.330 FORMAT "%5.3" /end CHARACTERISTIC
/begin CHARACTERISTIC USREFH "" VALUE 0x8E8018 KwUw 319.9951 spg_uw_q0p00488_o1 -1.000000 318.9951 FORMAT "%8.4" /end CHARACTERISTIC
/begin CHARACTERISTIC USREFHKLT "" VALUE 0x8E801A KwUw 319.9951 spg_uw_q0p00488_o1 -1.000000 318.9951 FORMAT "%8.4" /end CHARACTERISTIC
/begin CHARACTERISTIC USREMH "" VALUE 0x8FDC2C KwUw 319.9951 spg_uw_q0p00488_o1 -1.000000 318.9951 FORMAT "%8.4" /end CHARACTERISTIC
/begin CHARACTERISTIC USRHKSHJ "" VALUE 0x8E1687 KwUb 1.330 spg_ub_b1p33 0.00 1.330 FORMAT "%5.3" /end CHARACTERISTIC
/begin CHARACTERISTIC USRJ "" VALUE 0x8E1688 KwUb 1.330 spg_ub_b1p33 0.00 1.330 FORMAT "%5.3" /end CHARACTERISTIC
/begin CHARACTERISTIC USSCHUB "" VALUE 0x8E0C9F KwUb 1.330 spg_ub_q0p0052_o0p2 -0.2000 1.130 FORMAT "%5.3" /end CHARACTERISTIC
/begin CHARACTERISTIC WNWHA "" VALUE 0x8EFFD2 KwSw 511.0000 kw_sw_q0p0078 -256.0000 255.0000 FORMAT "%8.4" /end CHARACTERISTIC
/begin CHARACTERISTIC WNWHE "" VALUE 0x8EFEE8 KwSw 511.0000 kw_sw_q0p0078 -256.0000 255.0000 FORMAT "%8.4" /end CHARACTERISTIC
/begin CHARACTERISTIC WNWSPMN "" VALUE 0x8E7D74 KwSw 1023.984 kw_q0p0156 -512.0000 511.9844 FORMAT "%8.4" /end CHARACTERISTIC
/begin CHARACTERISTIC WNWSPMX "" VALUE 0x8E7D76 KwSw 1023.984 kw_q0p0156 -512.0000 511.9844 FORMAT "%8.4" /end CHARACTERISTIC
/begin CHARACTERISTIC ZAGRUN "" VALUE 0x8E05EA KwUb 255.0 dez 0.00 255.0 FORMAT "%5.1" /end CHARACTERISTIC
/begin CHARACTERISTIC ZDSLAMX "" VALUE 0x8E039A KwUb 255.0 dez 0.00 255.0 FORMAT "%5.1" /end CHARACTERISTIC
/begin CHARACTERISTIC ZKFRMSLS "" VALUE 0x8E039B KwUb 25.4996 zk100msxs_ub_b25p5 0.100392 25.6000 FORMAT "%7.4" /end CHARACTERISTIC
/begin CHARACTERISTIC ZKNWVDA "" VALUE 0x8E3D13 KwUb 25.4000 zk100msxs_q0p1 0.100000 25.5000 FORMAT "%7.4" /end CHARACTERISTIC
/begin CHARACTERISTIC ZKNWVDE "" VALUE 0x8E3C12 KwUb 25.4000 zk100msxs_q0p1 0.100000 25.5000 FORMAT "%7.4" /end CHARACTERISTIC
/begin CHARACTERISTIC ZKNWVDSA "" VALUE 0x8E3D14 KwUb 25.4000 zk100msxs_q0p1 0.100000 25.5000 FORMAT "%7.4" /end CHARACTERISTIC
/begin CHARACTERISTIC ZKNWVDSE "" VALUE 0x8E3C13 KwUb 25.4000 zk100msxs_q0p1 0.100000 25.5000 FORMAT "%7.4" /end CHARACTERISTIC
/begin CHARACTERISTIC ZLAMFT "" VALUE 0x8FDC44 KwUw 6553.4999985 zk100msxs_uw_b6553 0.10000152590 6553.6000000 FORMAT "%12.7" /end CHARACTERISTIC
/begin CHARACTERISTIC ZYLKOR "" VALUE 0x8FCD1D KwUb 5.000 dez 0.00 5.000 FORMAT "%5.3" /end CHARACTERISTIC
/begin MEASUREMENT afmimn "" UBYTE rel_ub_b99p6 1 100 0.00 99.61 FORMAT "%5.2" ECU_ADDRESS 0x38202C /end MEASUREMENT
/begin MEASUREMENT afmimx "" UBYTE rel_ub_b99p6 1 100 0.00 99.61 FORMAT "%5.2" ECU_ADDRESS 0x38202D /end MEASUREMENT
/begin MEASUREMENT afnmn "" UBYTE nmot_ub_q40 1 100 0.00 10200. FORMAT "%5.0" ECU_ADDRESS 0x38202E /end MEASUREMENT
/begin MEASUREMENT afnmx "" UBYTE nmot_ub_q40 1 100 0.00 10200. FORMAT "%5.0" ECU_ADDRESS 0x38202F /end MEASUREMENT
/begin MEASUREMENT aftmimn "" UBYTE rel_ub_b99p6 1 100 0.00 99.61 FORMAT "%5.2" ECU_ADDRESS 0xF06B3 /end MEASUREMENT
/begin MEASUREMENT aftmimx "" UBYTE rel_ub_b99p6 1 100 0.00 99.61 FORMAT "%5.2" ECU_ADDRESS 0xF06B4 /end MEASUREMENT
/begin MEASUREMENT aftnmn "" UBYTE nmot_ub_q40 1 100 0.00 10200. FORMAT "%5.0" ECU_ADDRESS 0xF06B5 /end MEASUREMENT
/begin MEASUREMENT aftnmx "" UBYTE nmot_ub_q40 1 100 0.00 10200. FORMAT "%5.0" ECU_ADDRESS 0xF06B6 /end MEASUREMENT
/begin MEASUREMENT ahearv_w "" UWORD dez 1 100 0.00 65535.00 FORMAT "%8.2" ECU_ADDRESS 0xF1560 /end MEASUREMENT
/begin MEASUREMENT aint "" UBYTE dez 1 100 0.00 255.0 FORMAT "%5.1" ARRAY_SIZE 6 ECU_ADDRESS 0xF06B7 /end MEASUREMENT
/begin MEASUREMENT aintkamin "" UBYTE dez 1 100 0.00 255.0 FORMAT "%5.1" ECU_ADDRESS 0xF4040 /end MEASUREMENT
/begin MEASUREMENT anwfofs "" UBYTE dez 1 100 0.00 255.0 FORMAT "%5.1" ECU_ADDRESS 0xF06A9 /end MEASUREMENT
/begin MEASUREMENT anwfoh "" UBYTE dez 1 100 0.00 255.0 FORMAT "%5.1" ECU_ADDRESS 0xF06A1 /end MEASUREMENT
/begin MEASUREMENT anwfos "" UBYTE dez 1 100 0.00 255.0 FORMAT "%5.1" ECU_ADDRESS 0xF06A2 /end MEASUREMENT
/begin MEASUREMENT anwst "" UWORD dez 1 100 0.00 65535.00 FORMAT "%8.2" ECU_ADDRESS 0xF14A2 /end MEASUREMENT
/begin MEASUREMENT anzainten "" UBYTE dez 1 100 0.00 255.0 FORMAT "%5.1" ECU_ADDRESS 0xF4041 /end MEASUREMENT
/begin MEASUREMENT anzmsls2_w "" UWORD dez 1 100 0.00 65535.00 FORMAT "%8.2" ECU_ADDRESS 0x38404E /end MEASUREMENT
/begin MEASUREMENT anzmsls_w "" UWORD dez 1 100 0.00 65535.00 FORMAT "%8.2" ECU_ADDRESS 0x384050 /end MEASUREMENT
/begin MEASUREMENT arimean_w "" SWORD tsquant 1 100 -26214.40 26213.60 FORMAT "%8.2" ECU_ADDRESS 0xF14D4 /end MEASUREMENT
/begin MEASUREMENT avkatfm "" UBYTE fak_ub_b1 1 100 0.00 0.9961 ECU_ADDRESS 0xF40A3 /end MEASUREMENT
/begin MEASUREMENT azycnt "" UBYTE dez 1 100 0.00 255.0 FORMAT "%5.1" ECU_ADDRESS 0xF06BD /end MEASUREMENT
/begin MEASUREMENT bbdmdmil "" UBYTE dez 1 100 0.00 255.0 FORMAT "%5.1" ECU_ADDRESS 0x382030 /end MEASUREMENT
/begin MEASUREMENT bbsp1 "" UBYTE dez 1 100 0.00 255.0 FORMAT "%5.1" ECU_ADDRESS 0xF06BE /end MEASUREMENT
/begin MEASUREMENT bbsp2 "" UBYTE dez 1 100 0.00 255.0 FORMAT "%5.1" ECU_ADDRESS 0xF06BF /end MEASUREMENT
/begin MEASUREMENT bfmimn "" UBYTE rel_ub_b99p6 1 100 0.00 99.61 FORMAT "%5.2" ECU_ADDRESS 0xF06C0 /end MEASUREMENT
/begin MEASUREMENT bfmimx "" UBYTE rel_ub_b99p6 1 100 0.00 99.61 FORMAT "%5.2" ECU_ADDRESS 0xF06C1 /end MEASUREMENT
/begin MEASUREMENT bfnmn "" UBYTE nmot_ub_q40 1 100 0.00 10200. FORMAT "%5.0" ECU_ADDRESS 0xF06C2 /end MEASUREMENT
/begin MEASUREMENT bfnmx "" UBYTE nmot_ub_q40 1 100 0.00 10200. FORMAT "%5.0" ECU_ADDRESS 0xF06C3 /end MEASUREMENT
/begin MEASUREMENT bssp "" UWORD acc_uw_b55p55 1 100 0.00 55.55471 FORMAT "%8.5" ECU_ADDRESS 0xF2A02 /end MEASUREMENT
/begin MEASUREMENT B_abgien "" UBYTE B_TRUE 1 100 0.00 1.00000000000 BIT_MASK 0x40 FORMAT "%13.11" ECU_ADDRESS 0x382030 /end MEASUREMENT
/begin MEASUREMENT B_abgstg "" UBYTE B_TRUE 1 100 0.00 1.00000000000 BIT_MASK 0x1 FORMAT "%13.11" ECU_ADDRESS 0xF075B /end MEASUREMENT
/begin MEASUREMENT B_abgstg2 "" UBYTE B_TRUE 1 100 0.00 1.00000000000 BIT_MASK 0x10 FORMAT "%13.11" ECU_ADDRESS 0xF075B /end MEASUREMENT
/begin MEASUREMENT B_adsh "" UBYTE B_TRUE 1 100 0.00 1.00000000000 BIT_MASK 0x4 FORMAT "%13.11" ECU_ADDRESS 0xF0728 /end MEASUREMENT
/begin MEASUREMENT B_adsh2 "" UBYTE B_TRUE 1 100 0.00 1.00000000000 BIT_MASK 0x4 FORMAT "%13.11" ECU_ADDRESS 0xF0729 /end MEASUREMENT
/begin MEASUREMENT B_adshs "" UBYTE B_TRUE 1 100 0.00 1.00000000000 BIT_MASK 0x8 FORMAT "%13.11" ECU_ADDRESS 0xF0728 /end MEASUREMENT
/begin MEASUREMENT B_adshs2 "" UBYTE B_TRUE 1 100 0.00 1.00000000000 BIT_MASK 0x8 FORMAT "%13.11" ECU_ADDRESS 0xF0729 /end MEASUREMENT
/begin MEASUREMENT B_afklt "" UBYTE B_TRUE 1 100 0.00 1.00000000000 BIT_MASK 0x2 FORMAT "%13.11" ECU_ADDRESS 0x382030 /end MEASUREMENT
/begin MEASUREMENT B_aftklt "" UBYTE B_TRUE 1 100 0.00 1.00000000000 BIT_MASK 0x8 FORMAT "%13.11" ECU_ADDRESS 0x382030 /end MEASUREMENT
/begin MEASUREMENT B_aftwrm "" UBYTE B_TRUE 1 100 0.00 1.00000000000 BIT_MASK 0x4 FORMAT "%13.11" ECU_ADDRESS 0x382030 /end MEASUREMENT
/begin MEASUREMENT B_afwrm "" UBYTE B_TRUE 1 100 0.00 1.00000000000 BIT_MASK 0x1 FORMAT "%13.11" ECU_ADDRESS 0x382030 /end MEASUREMENT
/begin MEASUREMENT B_analu "" UWORD B_TRUE 1 100 0.00 1.00000000000 BIT_MASK 0x1000 FORMAT "%13.11" ECU_ADDRESS 0xFD3A /end MEASUREMENT
/begin MEASUREMENT B_anwsea "" UBYTE B_TRUE 1 100 0.00 1.00000000000 BIT_MASK 0x1 FORMAT "%13.11" ECU_ADDRESS 0xF41A8 /end MEASUREMENT
/begin MEASUREMENT B_anzhzkh "" UWORD B_TRUE 1 100 0.00 1.00000000000 BIT_MASK 0x20 FORMAT "%13.11" ECU_ADDRESS 0xFD4C /end MEASUREMENT
/begin MEASUREMENT B_anzhzkh2 "" UWORD B_TRUE 1 100 0.00 1.00000000000 BIT_MASK 0x40 FORMAT "%13.11" ECU_ADDRESS 0xFD4C /end MEASUREMENT
/begin MEASUREMENT B_anzhzoh "" UWORD B_TRUE 1 100 0.00 1.00000000000 BIT_MASK 0x80 FORMAT "%13.11" ECU_ADDRESS 0xFD4C /end MEASUREMENT
/begin MEASUREMENT B_anzhzoh2 "" UWORD B_TRUE 1 100 0.00 1.00000000000 BIT_MASK 0x100 FORMAT "%13.11" ECU_ADDRESS 0xFD4C /end MEASUREMENT
/begin MEASUREMENT B_anzsls "" UBYTE B_TRUE 1 100 0.00 1.00000000000 BIT_MASK 0x4 FORMAT "%13.11" ECU_ADDRESS 0xF05ED /end MEASUREMENT
/begin MEASUREMENT B_anzsls2 "" UBYTE B_TRUE 1 100 0.00 1.00000000000 BIT_MASK 0x8 FORMAT "%13.11" ECU_ADDRESS 0xF05EF /end MEASUREMENT
/begin MEASUREMENT B_astat "" UBYTE B_TRUE 1 100 0.00 1.00000000000 BIT_MASK 0x8 FORMAT "%13.11" ECU_ADDRESS 0xF05ED /end MEASUREMENT
/begin MEASUREMENT B_astat2 "" UBYTE B_TRUE 1 100 0.00 1.00000000000 BIT_MASK 0x10 FORMAT "%13.11" ECU_ADDRESS 0xF05EF /end MEASUREMENT
/begin MEASUREMENT B_bfklt "" UBYTE B_TRUE 1 100 0.00 1.00000000000 BIT_MASK 0x20 FORMAT "%13.11" ECU_ADDRESS 0x382030 /end MEASUREMENT
/begin MEASUREMENT B_bfwrm "" UBYTE B_TRUE 1 100 0.00 1.00000000000 BIT_MASK 0x10 FORMAT "%13.11" ECU_ADDRESS 0x382030 /end MEASUREMENT
/begin MEASUREMENT B_blkmd "" UWORD B_TRUE 1 100 0.00 1.00000000000 BIT_MASK 0x8000 FORMAT "%13.11" ECU_ADDRESS 0xFD3A /end MEASUREMENT
/begin MEASUREMENT B_com1 "" UWORD B_TRUE 1 100 0.00 1.00000000000 BIT_MASK 0x100 FORMAT "%13.11" ECU_ADDRESS 0xFD38 /end MEASUREMENT
/begin MEASUREMENT B_com2 "" UWORD B_TRUE 1 100 0.00 1.00000000000 BIT_MASK 0x200 FORMAT "%13.11" ECU_ADDRESS 0xFD38 /end MEASUREMENT
/begin MEASUREMENT B_com3 "" UWORD B_TRUE 1 100 0.00 1.00000000000 BIT_MASK 0x400 FORMAT "%13.11" ECU_ADDRESS 0xFD38 /end MEASUREMENT
/begin MEASUREMENT B_cwdslt "" UBYTE B_TRUE 1 100 0.00 1.00000000000 BIT_MASK 0x1 FORMAT "%13.11" ECU_ADDRESS 0xF05E5 /end MEASUREMENT
/begin MEASUREMENT B_cwdsltfa "" UBYTE B_TRUE 1 100 0.00 1.00000000000 BIT_MASK 0x10 FORMAT "%13.11" ECU_ADDRESS 0xF05EE /end MEASUREMENT
/begin MEASUREMENT B_cwdslty "" UBYTE B_TRUE 1 100 0.00 1.00000000000 BIT_MASK 0x1 FORMAT "%13.11" ECU_ADDRESS 0xF05E2 /end MEASUREMENT
/begin MEASUREMENT B_cwsla "" UBYTE B_TRUE 1 100 0.00 1.00000000000 BIT_MASK 0x1 FORMAT "%13.11" ECU_ADDRESS 0xF05E7 /end MEASUREMENT
/begin MEASUREMENT B_ddylash "" UBYTE B_TRUE 1 100 0.00 1.00000000000 BIT_MASK 0x40 FORMAT "%13.11" ECU_ADDRESS 0xF0767 /end MEASUREMENT
/begin MEASUREMENT B_ddylash2 "" UBYTE B_TRUE 1 100 0.00 1.00000000000 BIT_MASK 0x40 FORMAT "%13.11" ECU_ADDRESS 0xF0768 /end MEASUREMENT
/begin MEASUREMENT B_dfrmoe "" UBYTE B_TRUE 1 100 0.00 1.00000000000 BIT_MASK 0x1 FORMAT "%13.11" ECU_ADDRESS 0xF05ED /end MEASUREMENT
/begin MEASUREMENT B_dfrmoe2 "" UBYTE B_TRUE 1 100 0.00 1.00000000000 BIT_MASK 0x2 FORMAT "%13.11" ECU_ADDRESS 0xF05EC /end MEASUREMENT
/begin MEASUREMENT B_dfrmoff "" UBYTE B_TRUE 1 100 0.00 1.00000000000 BIT_MASK 0x80 FORMAT "%13.11" ECU_ADDRESS 0xF05E9 /end MEASUREMENT
/begin MEASUREMENT B_dfrmoff2 "" UBYTE B_TRUE 1 100 0.00 1.00000000000 BIT_MASK 0x1 FORMAT "%13.11" ECU_ADDRESS 0xF05EA /end MEASUREMENT
/begin MEASUREMENT B_dlahimn "" UBYTE B_TRUE 1 100 0.00 1.00000000000 BIT_MASK 0x1 FORMAT "%13.11" ECU_ADDRESS 0xF07C1 /end MEASUREMENT
/begin MEASUREMENT B_dlahimn2 "" UBYTE B_TRUE 1 100 0.00 1.00000000000 BIT_MASK 0x1 FORMAT "%13.11" ECU_ADDRESS 0xF07C0 /end MEASUREMENT
/begin MEASUREMENT B_dlahimx "" UBYTE B_TRUE 1 100 0.00 1.00000000000 BIT_MASK 0x2 FORMAT "%13.11" ECU_ADDRESS 0xF07C1 /end MEASUREMENT
/begin MEASUREMENT B_dlahimx2 "" UBYTE B_TRUE 1 100 0.00 1.00000000000 BIT_MASK 0x2 FORMAT "%13.11" ECU_ADDRESS 0xF07C0 /end MEASUREMENT
/begin MEASUREMENT B_dlams "" UBYTE B_TRUE 1 100 0.00 1.00000000000 BIT_MASK 0x2 FORMAT "%13.11" ECU_ADDRESS 0xF0764 /end MEASUREMENT
/begin MEASUREMENT B_dlams2 "" UBYTE B_TRUE 1 100 0.00 1.00000000000 BIT_MASK 0x40 FORMAT "%13.11" ECU_ADDRESS 0xF0764 /end MEASUREMENT
/begin MEASUREMENT B_dlash "" UBYTE B_TRUE 1 100 0.00 1.00000000000 BIT_MASK 0x10 FORMAT "%13.11" ECU_ADDRESS 0xF0754 /end MEASUREMENT
/begin MEASUREMENT B_dlash2 "" UBYTE B_TRUE 1 100 0.00 1.00000000000 BIT_MASK 0x10 FORMAT "%13.11" ECU_ADDRESS 0xF0755 /end MEASUREMENT
/begin MEASUREMENT B_dluerk "" UWORD B_TRUE 1 100 0.00 1.00000000000 BIT_MASK 0x20 FORMAT "%13.11" ECU_ADDRESS 0xFD38 /end MEASUREMENT
/begin MEASUREMENT B_dshen "" UBYTE B_TRUE 1 100 0.00 1.00000000000 BIT_MASK 0x2 FORMAT "%13.11" ECU_ADDRESS 0xF072A /end MEASUREMENT
/begin MEASUREMENT B_dshen2 "" UBYTE B_TRUE 1 100 0.00 1.00000000000 BIT_MASK 0x2 FORMAT "%13.11" ECU_ADDRESS 0xF072B /end MEASUREMENT
/begin MEASUREMENT B_dshk "" UBYTE B_TRUE 1 100 0.00 1.00000000000 BIT_MASK 0x2 FORMAT "%13.11" ECU_ADDRESS 0xF075C /end MEASUREMENT
/begin MEASUREMENT B_dshk2 "" UBYTE B_TRUE 1 100 0.00 1.00000000000 BIT_MASK 0x2 FORMAT "%13.11" ECU_ADDRESS 0xF075D /end MEASUREMENT
/begin MEASUREMENT B_dsl "" UBYTE B_TRUE 1 100 0.00 1.00000000000 BIT_MASK 0x20 FORMAT "%13.11" ECU_ADDRESS 0xF05E6 /end MEASUREMENT
/begin MEASUREMENT B_dsl1 "" UBYTE B_TRUE 1 100 0.00 1.00000000000 BIT_MASK 0x2 FORMAT "%13.11" ECU_ADDRESS 0xF05E2 /end MEASUREMENT
/begin MEASUREMENT B_dsl1ab "" UBYTE B_TRUE 1 100 0.00 1.00000000000 BIT_MASK 0x20 FORMAT "%13.11" ECU_ADDRESS 0xF05E7 /end MEASUREMENT
/begin MEASUREMENT B_dsl1e "" UBYTE B_TRUE 1 100 0.00 1.00000000000 BIT_MASK 0x40 FORMAT "%13.11" ECU_ADDRESS 0xF05E7 /end MEASUREMENT
/begin MEASUREMENT B_dsl2 "" UBYTE B_TRUE 1 100 0.00 1.00000000000 BIT_MASK 0x80 FORMAT "%13.11" ECU_ADDRESS 0xF05E7 /end MEASUREMENT
/begin MEASUREMENT B_dsl2ab "" UBYTE B_TRUE 1 100 0.00 1.00000000000 BIT_MASK 0x1 FORMAT "%13.11" ECU_ADDRESS 0xF05E8 /end MEASUREMENT
/begin MEASUREMENT B_dsl2e "" UBYTE B_TRUE 1 100 0.00 1.00000000000 BIT_MASK 0x2 FORMAT "%13.11" ECU_ADDRESS 0xF05E8 /end MEASUREMENT
/begin MEASUREMENT B_dsl3 "" UBYTE B_TRUE 1 100 0.00 1.00000000000 BIT_MASK 0x4 FORMAT "%13.11" ECU_ADDRESS 0xF05E8 /end MEASUREMENT
/begin MEASUREMENT B_dsl3ab "" UBYTE B_TRUE 1 100 0.00 1.00000000000 BIT_MASK 0x8 FORMAT "%13.11" ECU_ADDRESS 0xF05E8 /end MEASUREMENT
/begin MEASUREMENT B_dsl3e "" UBYTE B_TRUE 1 100 0.00 1.00000000000 BIT_MASK 0x10 FORMAT "%13.11" ECU_ADDRESS 0xF05E8 /end MEASUREMENT
/begin MEASUREMENT B_dsl4 "" UBYTE B_TRUE 1 100 0.00 1.00000000000 BIT_MASK 0x4 FORMAT "%13.11" ECU_ADDRESS 0xF05E2 /end MEASUREMENT
/begin MEASUREMENT B_dsl45 "" UBYTE B_TRUE 1 100 0.00 1.00000000000 BIT_MASK 0x4 FORMAT "%13.11" ECU_ADDRESS 0xF05EA /end MEASUREMENT
/begin MEASUREMENT B_dsl4ab "" UBYTE B_TRUE 1 100 0.00 1.00000000000 BIT_MASK 0x80 FORMAT "%13.11" ECU_ADDRESS 0xF05E8 /end MEASUREMENT
/begin MEASUREMENT B_dsl4e "" UBYTE B_TRUE 1 100 0.00 1.00000000000 BIT_MASK 0x1 FORMAT "%13.11" ECU_ADDRESS 0xF05E9 /end MEASUREMENT
/begin MEASUREMENT B_dsl5 "" UBYTE B_TRUE 1 100 0.00 1.00000000000 BIT_MASK 0x2 FORMAT "%13.11" ECU_ADDRESS 0xF05E9 /end MEASUREMENT
/begin MEASUREMENT B_dsl5ab "" UBYTE B_TRUE 1 100 0.00 1.00000000000 BIT_MASK 0x4 FORMAT "%13.11" ECU_ADDRESS 0xF05E9 /end MEASUREMENT
/begin MEASUREMENT B_dsl5dly "" UBYTE B_TRUE 1 100 0.00 1.00000000000 BIT_MASK 0x2 FORMAT "%13.11" ECU_ADDRESS 0xF05EA /end MEASUREMENT
/begin MEASUREMENT B_dsl5e "" UBYTE B_TRUE 1 100 0.00 1.00000000000 BIT_MASK 0x8 FORMAT "%13.11" ECU_ADDRESS 0xF05E9 /end MEASUREMENT
/begin MEASUREMENT B_dsla "" UWORD B_TRUE 1 100 0.00 1.00000000000 BIT_MASK 0x10 FORMAT "%13.11" ECU_ADDRESS 0xFD1A /end MEASUREMENT
/begin MEASUREMENT B_dslerr "" UBYTE B_TRUE 1 100 0.00 1.00000000000 BIT_MASK 0x8 FORMAT "%13.11" ECU_ADDRESS 0xF05E5 /end MEASUREMENT
/begin MEASUREMENT B_dslfa "" UBYTE B_TRUE 1 100 0.00 1.00000000000 BIT_MASK 0x4 FORMAT "%13.11" ECU_ADDRESS 0xF05E3 /end MEASUREMENT
/begin MEASUREMENT B_dslfrg "" UBYTE B_TRUE 1 100 0.00 1.00000000000 BIT_MASK 0x2 FORMAT "%13.11" ECU_ADDRESS 0xF05ED /end MEASUREMENT
/begin MEASUREMENT B_dslfrg12 "" UBYTE B_TRUE 1 100 0.00 1.00000000000 BIT_MASK 0x20 FORMAT "%13.11" ECU_ADDRESS 0xF05E3 /end MEASUREMENT
/begin MEASUREMENT B_dslfrg2 "" UBYTE B_TRUE 1 100 0.00 1.00000000000 BIT_MASK 0x4 FORMAT "%13.11" ECU_ADDRESS 0xF05EC /end MEASUREMENT
/begin MEASUREMENT B_dslm "" UBYTE B_TRUE 1 100 0.00 1.00000000000 BIT_MASK 0x10 FORMAT "%13.11" ECU_ADDRESS 0xF05E5 /end MEASUREMENT
/begin MEASUREMENT B_dslmab "" UBYTE B_TRUE 1 100 0.00 1.00000000000 BIT_MASK 0x20 FORMAT "%13.11" ECU_ADDRESS 0xF05E5 /end MEASUREMENT
/begin MEASUREMENT B_dslme "" UBYTE B_TRUE 1 100 0.00 1.00000000000 BIT_MASK 0x40 FORMAT "%13.11" ECU_ADDRESS 0xF05E5 /end MEASUREMENT
/begin MEASUREMENT B_dslmes "" UBYTE B_TRUE 1 100 0.00 1.00000000000 BIT_MASK 0x80 FORMAT "%13.11" ECU_ADDRESS 0xF05E5 /end MEASUREMENT
/begin MEASUREMENT B_dslo "" UBYTE B_TRUE 1 100 0.00 1.00000000000 BIT_MASK 0x1 FORMAT "%13.11" ECU_ADDRESS 0xF05E6 /end MEASUREMENT
/begin MEASUREMENT B_dsloab "" UBYTE B_TRUE 1 100 0.00 1.00000000000 BIT_MASK 0x2 FORMAT "%13.11" ECU_ADDRESS 0xF05E6 /end MEASUREMENT
/begin MEASUREMENT B_dsloe "" UBYTE B_TRUE 1 100 0.00 1.00000000000 BIT_MASK 0x4 FORMAT "%13.11" ECU_ADDRESS 0xF05E6 /end MEASUREMENT
/begin MEASUREMENT B_dslp4 "" UBYTE B_TRUE 1 100 0.00 1.00000000000 BIT_MASK 0x8 FORMAT "%13.11" ECU_ADDRESS 0xF05E6 /end MEASUREMENT
/begin MEASUREMENT B_dslp42 "" UBYTE B_TRUE 1 100 0.00 1.00000000000 BIT_MASK 0x1 FORMAT "%13.11" ECU_ADDRESS 0xF05EC /end MEASUREMENT
/begin MEASUREMENT B_dsls "" UWORD B_TRUE 1 100 0.00 1.00000000000 BIT_MASK 0x20 FORMAT "%13.11" ECU_ADDRESS 0xFD1A /end MEASUREMENT
/begin MEASUREMENT B_dslsp4 "" UBYTE B_TRUE 1 100 0.00 1.00000000000 BIT_MASK 0x1 FORMAT "%13.11" ECU_ADDRESS 0xF05E3 /end MEASUREMENT
/begin MEASUREMENT B_dsltab "" UBYTE B_TRUE 1 100 0.00 1.00000000000 BIT_MASK 0x80 FORMAT "%13.11" ECU_ADDRESS 0xF05E6 /end MEASUREMENT
/begin MEASUREMENT B_dslte "" UBYTE B_TRUE 1 100 0.00 1.00000000000 BIT_MASK 0x2 FORMAT "%13.11" ECU_ADDRESS 0xF05E7 /end MEASUREMENT
/begin MEASUREMENT B_dspe "" UBYTE B_TRUE 1 100 0.00 1.00000000000 BIT_MASK 0x8 FORMAT "%13.11" ECU_ADDRESS 0xF05E2 /end MEASUREMENT
/begin MEASUREMENT B_dsper "" UBYTE B_TRUE 1 100 0.00 1.00000000000 BIT_MASK 0x4 FORMAT "%13.11" ECU_ADDRESS 0xF05E7 /end MEASUREMENT
/begin MEASUREMENT B_dspes "" UBYTE B_TRUE 1 100 0.00 1.00000000000 BIT_MASK 0x8 FORMAT "%13.11" ECU_ADDRESS 0xF05E7 /end MEASUREMENT
/begin MEASUREMENT B_dushkvl "" UBYTE B_TRUE 1 100 0.00 1.00000000000 BIT_MASK 0x40 FORMAT "%13.11" ECU_ADDRESS 0xF0759 /end MEASUREMENT
/begin MEASUREMENT B_dushkvl2 "" UBYTE B_TRUE 1 100 0.00 1.00000000000 BIT_MASK 0x40 FORMAT "%13.11" ECU_ADDRESS 0xF075A /end MEASUREMENT
/begin MEASUREMENT B_dushsch "" UBYTE B_TRUE 1 100 0.00 1.00000000000 BIT_MASK 0x20 FORMAT "%13.11" ECU_ADDRESS 0xF0754 /end MEASUREMENT
/begin MEASUREMENT B_dushsch2 "" UBYTE B_TRUE 1 100 0.00 1.00000000000 BIT_MASK 0x20 FORMAT "%13.11" ECU_ADDRESS 0xF0755 /end MEASUREMENT
/begin MEASUREMENT B_dylash "" UBYTE B_TRUE 1 100 0.00 1.00000000000 BIT_MASK 0x1 FORMAT "%13.11" ECU_ADDRESS 0x384012 /end MEASUREMENT
/begin MEASUREMENT B_dylash2 "" UBYTE B_TRUE 1 100 0.00 1.00000000000 BIT_MASK 0x2 FORMAT "%13.11" ECU_ADDRESS 0x384012 /end MEASUREMENT
/begin MEASUREMENT B_ehfs "" UWORD B_TRUE 1 100 0.00 1.00000000000 BIT_MASK 0x10 FORMAT "%13.11" ECU_ADDRESS 0xFD6C /end MEASUREMENT
/begin MEASUREMENT B_elaof "" UBYTE B_TRUE 1 100 0.00 1.00000000000 BIT_MASK 0x1 FORMAT "%13.11" ECU_ADDRESS 0xF07BB /end MEASUREMENT
/begin MEASUREMENT B_elaof2 "" UBYTE B_TRUE 1 100 0.00 1.00000000000 BIT_MASK 0x8 FORMAT "%13.11" ECU_ADDRESS 0xF07BB /end MEASUREMENT
/begin MEASUREMENT B_elaofmn "" UBYTE B_TRUE 1 100 0.00 1.00000000000 BIT_MASK 0x40 FORMAT "%13.11" ECU_ADDRESS 0xF07BE /end MEASUREMENT
/begin MEASUREMENT B_elaofmn2 "" UBYTE B_TRUE 1 100 0.00 1.00000000000 BIT_MASK 0x40 FORMAT "%13.11" ECU_ADDRESS 0xF07BF /end MEASUREMENT
/begin MEASUREMENT B_elaofmx "" UBYTE B_TRUE 1 100 0.00 1.00000000000 BIT_MASK 0x80 FORMAT "%13.11" ECU_ADDRESS 0xF07BE /end MEASUREMENT
/begin MEASUREMENT B_elaofmx2 "" UBYTE B_TRUE 1 100 0.00 1.00000000000 BIT_MASK 0x80 FORMAT "%13.11" ECU_ADDRESS 0xF07BF /end MEASUREMENT
/begin MEASUREMENT B_elshbb "" UBYTE B_TRUE 1 100 0.00 1.00000000000 BIT_MASK 0x1 FORMAT "%13.11" ECU_ADDRESS 0xF072A /end MEASUREMENT
/begin MEASUREMENT B_elshbb2 "" UBYTE B_TRUE 1 100 0.00 1.00000000000 BIT_MASK 0x1 FORMAT "%13.11" ECU_ADDRESS 0xF072B /end MEASUREMENT
/begin MEASUREMENT B_elshv "" UBYTE B_TRUE 1 100 0.00 1.00000000000 BIT_MASK 0x4 FORMAT "%13.11" ECU_ADDRESS 0xF072A /end MEASUREMENT
/begin MEASUREMENT B_elshv2 "" UBYTE B_TRUE 1 100 0.00 1.00000000000 BIT_MASK 0x4 FORMAT "%13.11" ECU_ADDRESS 0xF072B /end MEASUREMENT
/begin MEASUREMENT B_elsuv "" UBYTE B_TRUE 1 100 0.00 1.00000000000 BIT_MASK 0x1 FORMAT "%13.11" ECU_ADDRESS 0xF0BA5 /end MEASUREMENT
/begin MEASUREMENT B_enfmst "" UBYTE B_TRUE 1 100 0.00 1.00000000000 BIT_MASK 0x80 FORMAT "%13.11" ECU_ADDRESS 0xF0767 /end MEASUREMENT
/begin MEASUREMENT B_enfmst2 "" UBYTE B_TRUE 1 100 0.00 1.00000000000 BIT_MASK 0x80 FORMAT "%13.11" ECU_ADDRESS 0xF0768 /end MEASUREMENT
/begin MEASUREMENT B_enlash "" UBYTE B_TRUE 1 100 0.00 1.00000000000 BIT_MASK 0x4 FORMAT "%13.11" ECU_ADDRESS 0xF0754 /end MEASUREMENT
/begin MEASUREMENT B_enlash2 "" UBYTE B_TRUE 1 100 0.00 1.00000000000 BIT_MASK 0x4 FORMAT "%13.11" ECU_ADDRESS 0xF0755 /end MEASUREMENT
/begin MEASUREMENT B_enlues "" UBYTE B_TRUE 1 100 0.00 1.00000000000 BIT_MASK 0x1 FORMAT "%13.11" ECU_ADDRESS 0xF088A /end MEASUREMENT
/begin MEASUREMENT B_enlues1 "" UBYTE B_TRUE 1 100 0.00 1.00000000000 BIT_MASK 0x2 FORMAT "%13.11" ECU_ADDRESS 0xF088A /end MEASUREMENT
/begin MEASUREMENT B_enmaxla "" UBYTE B_TRUE 1 100 0.00 1.00000000000 BIT_MASK 0x2 FORMAT "%13.11" ECU_ADDRESS 0xF0765 /end MEASUREMENT
/begin MEASUREMENT B_enmaxla2 "" UBYTE B_TRUE 1 100 0.00 1.00000000000 BIT_MASK 0x20 FORMAT "%13.11" ECU_ADDRESS 0xF0765 /end MEASUREMENT
/begin MEASUREMENT B_enramph "" UBYTE B_TRUE 1 100 0.00 1.00000000000 BIT_MASK 0x40 FORMAT "%13.11" ECU_ADDRESS 0xF0766 /end MEASUREMENT
/begin MEASUREMENT B_enramph2 "" UBYTE B_TRUE 1 100 0.00 1.00000000000 BIT_MASK 0x80 FORMAT "%13.11" ECU_ADDRESS 0xF0766 /end MEASUREMENT
/begin MEASUREMENT B_entest "" UBYTE B_TRUE 1 100 0.00 1.00000000000 BIT_MASK 0x40 FORMAT "%13.11" ECU_ADDRESS 0xF0754 /end MEASUREMENT
/begin MEASUREMENT B_entest2 "" UBYTE B_TRUE 1 100 0.00 1.00000000000 BIT_MASK 0x40 FORMAT "%13.11" ECU_ADDRESS 0xF0755 /end MEASUREMENT
/begin MEASUREMENT B_enws "" UBYTE B_TRUE 1 100 0.00 1.00000000000 BIT_MASK 0x1 FORMAT "%13.11" ECU_ADDRESS 0xF0BDC /end MEASUREMENT
/begin MEASUREMENT B_enwsa "" UBYTE B_TRUE 1 100 0.00 1.00000000000 BIT_MASK 0x10 FORMAT "%13.11" ECU_ADDRESS 0xF0BDC /end MEASUREMENT
/begin MEASUREMENT B_enwse "" UBYTE B_TRUE 1 100 0.00 1.00000000000 BIT_MASK 0x4 FORMAT "%13.11" ECU_ADDRESS 0xF0BDC /end MEASUREMENT
/begin MEASUREMENT B_enwsea "" UBYTE B_TRUE 1 100 0.00 1.00000000000 BIT_MASK 0x1 FORMAT "%13.11" ECU_ADDRESS 0xF41A4 /end MEASUREMENT
/begin MEASUREMENT B_enwsva "" UBYTE B_TRUE 1 100 0.00 1.00000000000 BIT_MASK 0x1 FORMAT "%13.11" ECU_ADDRESS 0xF0C32 /end MEASUREMENT
/begin MEASUREMENT B_enwsve "" UBYTE B_TRUE 1 100 0.00 1.00000000000 BIT_MASK 0x1 FORMAT "%13.11" ECU_ADDRESS 0xF0C1A /end MEASUREMENT
/begin MEASUREMENT B_errmsl "" UBYTE B_TRUE 1 100 0.00 1.00000000000 BIT_MASK 0x10 FORMAT "%13.11" ECU_ADDRESS 0xF05ED /end MEASUREMENT
/begin MEASUREMENT B_errmsl2 "" UBYTE B_TRUE 1 100 0.00 1.00000000000 BIT_MASK 0x1 FORMAT "%13.11" ECU_ADDRESS 0xF05EF /end MEASUREMENT
/begin MEASUREMENT B_errofs "" UBYTE B_TRUE 1 100 0.00 1.00000000000 BIT_MASK 0x10 FORMAT "%13.11" ECU_ADDRESS 0xF05E7 /end MEASUREMENT
/begin MEASUREMENT B_errofs2 "" UBYTE B_TRUE 1 100 0.00 1.00000000000 BIT_MASK 0x1 FORMAT "%13.11" ECU_ADDRESS 0xF05EB /end MEASUREMENT
/begin MEASUREMENT B_esls "" UWORD B_TRUE 1 100 0.00 1.00000000000 BIT_MASK 0x40 FORMAT "%13.11" ECU_ADDRESS 0xFD1A /end MEASUREMENT
/begin MEASUREMENT B_eslsp "" UBYTE B_TRUE 1 100 0.00 1.00000000000 BIT_MASK 0x10 FORMAT "%13.11" ECU_ADDRESS 0xF05EA /end MEASUREMENT
/begin MEASUREMENT B_eslsp2 "" UBYTE B_TRUE 1 100 0.00 1.00000000000 BIT_MASK 0x8 FORMAT "%13.11" ECU_ADDRESS 0xF05EB /end MEASUREMENT
/begin MEASUREMENT B_eslvp "" UBYTE B_TRUE 1 100 0.00 1.00000000000 BIT_MASK 0x20 FORMAT "%13.11" ECU_ADDRESS 0xF05E8 /end MEASUREMENT
/begin MEASUREMENT B_eslvp2 "" UBYTE B_TRUE 1 100 0.00 1.00000000000 BIT_MASK 0x40 FORMAT "%13.11" ECU_ADDRESS 0xF05EB /end MEASUREMENT
/begin MEASUREMENT B_fanwtza "" UBYTE B_TRUE 1 100 0.00 1.00000000000 BIT_MASK 0x4 FORMAT "%13.11" ECU_ADDRESS 0xF0C33 /end MEASUREMENT
/begin MEASUREMENT B_fanwtze "" UBYTE B_TRUE 1 100 0.00 1.00000000000 BIT_MASK 0x4 FORMAT "%13.11" ECU_ADDRESS 0xF0C1B /end MEASUREMENT
/begin MEASUREMENT B_faslarq "" UBYTE B_TRUE 1 100 0.00 1.00000000000 BIT_MASK 0x40 FORMAT "%13.11" ECU_ADDRESS 0xF05E9 /end MEASUREMENT
/begin MEASUREMENT B_faslaset "" UBYTE B_TRUE 1 100 0.00 1.00000000000 BIT_MASK 0x8 FORMAT "%13.11" ECU_ADDRESS 0xF05EE /end MEASUREMENT
/begin MEASUREMENT B_fedkb "" UWORD B_TRUE 1 100 0.00 1.00000000000 BIT_MASK 0x20 FORMAT "%13.11" ECU_ADDRESS 0xFD6C /end MEASUREMENT
/begin MEASUREMENT B_fgadllfr "" UBYTE B_TRUE 1 100 0.00 1.00000000000 BIT_MASK 0x10 FORMAT "%13.11" ECU_ADDRESS 0xF05E3 /end MEASUREMENT
/begin MEASUREMENT B_fgszsla "" UBYTE B_TRUE 1 100 0.00 1.00000000000 BIT_MASK 0x2 FORMAT "%13.11" ECU_ADDRESS 0xF05EE /end MEASUREMENT
/begin MEASUREMENT B_fgszsla2 "" UBYTE B_TRUE 1 100 0.00 1.00000000000 BIT_MASK 0x80 FORMAT "%13.11" ECU_ADDRESS 0xF05EF /end MEASUREMENT
/begin MEASUREMENT B_fgszsls "" UBYTE B_TRUE 1 100 0.00 1.00000000000 BIT_MASK 0x1 FORMAT "%13.11" ECU_ADDRESS 0xF05EE /end MEASUREMENT
/begin MEASUREMENT B_fgszsls2 "" UBYTE B_TRUE 1 100 0.00 1.00000000000 BIT_MASK 0x40 FORMAT "%13.11" ECU_ADDRESS 0xF05EF /end MEASUREMENT
/begin MEASUREMENT B_fhfs "" UWORD B_TRUE 1 100 0.00 1.00000000000 BIT_MASK 0x40 FORMAT "%13.11" ECU_ADDRESS 0xFD6C /end MEASUREMENT
/begin MEASUREMENT B_fktlshv "" UBYTE B_TRUE 1 100 0.00 1.00000000000 BIT_MASK 0x1 FORMAT "%13.11" ECU_ADDRESS 0xF07E7 /end MEASUREMENT
/begin MEASUREMENT B_fnwaktv "" UBYTE B_TRUE 1 100 0.00 1.00000000000 BIT_MASK 0x2 FORMAT "%13.11" ECU_ADDRESS 0xF0BDC /end MEASUREMENT
/begin MEASUREMENT B_fnwaktva "" UBYTE B_TRUE 1 100 0.00 1.00000000000 BIT_MASK 0x20 FORMAT "%13.11" ECU_ADDRESS 0xF0BDC /end MEASUREMENT
/begin MEASUREMENT B_fnwaktve "" UBYTE B_TRUE 1 100 0.00 1.00000000000 BIT_MASK 0x8 FORMAT "%13.11" ECU_ADDRESS 0xF0BDC /end MEASUREMENT
/begin MEASUREMENT B_fnwstva "" UBYTE B_TRUE 1 100 0.00 1.00000000000 BIT_MASK 0x1 FORMAT "%13.11" ECU_ADDRESS 0xF0C33 /end MEASUREMENT
/begin MEASUREMENT B_fnwstve "" UBYTE B_TRUE 1 100 0.00 1.00000000000 BIT_MASK 0x1 FORMAT "%13.11" ECU_ADDRESS 0xF0C1B /end MEASUREMENT
/begin MEASUREMENT B_fodon "" UWORD B_TRUE 1 100 0.00 1.00000000000 BIT_MASK 0x800 FORMAT "%13.11" ECU_ADDRESS 0xFD34 /end MEASUREMENT
/begin MEASUREMENT B_fofd "" UWORD B_TRUE 1 100 0.00 1.00000000000 BIT_MASK 0x100 FORMAT "%13.11" ECU_ADDRESS 0xFD36 /end MEASUREMENT
/begin MEASUREMENT B_fofdis "" UWORD B_TRUE 1 100 0.00 1.00000000000 BIT_MASK 0x200 FORMAT "%13.11" ECU_ADDRESS 0xFD36 /end MEASUREMENT
/begin MEASUREMENT B_fofdr "" UBYTE B_TRUE 1 100 0.00 1.00000000000 BIT_MASK 0x80 FORMAT "%13.11" ECU_ADDRESS 0x382029 /end MEASUREMENT
/begin MEASUREMENT B_fofr "" UWORD B_TRUE 1 100 0.00 1.00000000000 BIT_MASK 0x400 FORMAT "%13.11" ECU_ADDRESS 0xFD36 /end MEASUREMENT
/begin MEASUREMENT B_fofr1 "" UBYTE B_TRUE 1 100 0.00 1.00000000000 BIT_MASK 0x1 FORMAT "%13.11" ECU_ADDRESS 0x382029 /end MEASUREMENT
/begin MEASUREMENT B_fofr2 "" UBYTE B_TRUE 1 100 0.00 1.00000000000 BIT_MASK 0x2 FORMAT "%13.11" ECU_ADDRESS 0x382029 /end MEASUREMENT
/begin MEASUREMENT B_fofr3 "" UBYTE B_TRUE 1 100 0.00 1.00000000000 BIT_MASK 0x4 FORMAT "%13.11" ECU_ADDRESS 0x382029 /end MEASUREMENT
/begin MEASUREMENT B_fofr4 "" UBYTE B_TRUE 1 100 0.00 1.00000000000 BIT_MASK 0x8 FORMAT "%13.11" ECU_ADDRESS 0x382029 /end MEASUREMENT
/begin MEASUREMENT B_fofrset "" UWORD B_TRUE 1 100 0.00 1.00000000000 BIT_MASK 0x800 FORMAT "%13.11" ECU_ADDRESS 0xFD36 /end MEASUREMENT
/begin MEASUREMENT B_fofrun "" UWORD B_TRUE 1 100 0.00 1.00000000000 BIT_MASK 0x1000 FORMAT "%13.11" ECU_ADDRESS 0xFD36 /end MEASUREMENT
/begin MEASUREMENT B_fofrun0 "" UWORD B_TRUE 1 100 0.00 1.00000000000 BIT_MASK 0x2000 FORMAT "%13.11" ECU_ADDRESS 0xFD36 /end MEASUREMENT
/begin MEASUREMENT B_fofstp "" UWORD B_TRUE 1 100 0.00 1.00000000000 BIT_MASK 0x800 FORMAT "%13.11" ECU_ADDRESS 0xFD38 /end MEASUREMENT
/begin MEASUREMENT B_fohe "" UWORD B_TRUE 1 100 0.00 1.00000000000 BIT_MASK 0x1000 FORMAT "%13.11" ECU_ADDRESS 0xFD34 /end MEASUREMENT
/begin MEASUREMENT B_fohold "" UWORD B_TRUE 1 100 0.00 1.00000000000 BIT_MASK 0x2000 FORMAT "%13.11" ECU_ADDRESS 0xFD34 /end MEASUREMENT
/begin MEASUREMENT B_fokstp "" UWORD B_TRUE 1 100 0.00 1.00000000000 BIT_MASK 0x1000 FORMAT "%13.11" ECU_ADDRESS 0xFD38 /end MEASUREMENT
/begin MEASUREMENT B_folunw "" UWORD B_TRUE 1 100 0.00 1.00000000000 BIT_MASK 0x4000 FORMAT "%13.11" ECU_ADDRESS 0xFD36 /end MEASUREMENT
/begin MEASUREMENT B_fomod "" UBYTE B_TRUE 1 100 0.00 1.00000000000 BIT_MASK 0x1 FORMAT "%13.11" ECU_ADDRESS 0x382028 /end MEASUREMENT
/begin MEASUREMENT B_fondis "" UWORD B_TRUE 1 100 0.00 1.00000000000 BIT_MASK 0x4000 FORMAT "%13.11" ECU_ADDRESS 0xFD34 /end MEASUREMENT
/begin MEASUREMENT B_fonresd "" UWORD B_TRUE 1 100 0.00 1.00000000000 BIT_MASK 0x8000 FORMAT "%13.11" ECU_ADDRESS 0xFD36 /end MEASUREMENT
/begin MEASUREMENT B_fonresf "" UWORD B_TRUE 1 100 0.00 1.00000000000 BIT_MASK 0x8000 FORMAT "%13.11" ECU_ADDRESS 0xFD34 /end MEASUREMENT
/begin MEASUREMENT B_fonrset "" UWORD B_TRUE 1 100 0.00 1.00000000000 BIT_MASK 0x1 FORMAT "%13.11" ECU_ADDRESS 0xFD36 /end MEASUREMENT
/begin MEASUREMENT B_fonstp "" UWORD B_TRUE 1 100 0.00 1.00000000000 BIT_MASK 0x2000 FORMAT "%13.11" ECU_ADDRESS 0xFD38 /end MEASUREMENT
/begin MEASUREMENT B_fontm "" UWORD B_TRUE 1 100 0.00 1.00000000000 BIT_MASK 0x4000 FORMAT "%13.11" ECU_ADDRESS 0xFD38 /end MEASUREMENT
/begin MEASUREMENT B_for "" UWORD B_TRUE 1 100 0.00 1.00000000000 BIT_MASK 0x2 FORMAT "%13.11" ECU_ADDRESS 0xFD36 /end MEASUREMENT
/begin MEASUREMENT B_for00 "" UBYTE B_TRUE 1 100 0.00 1.00000000000 BIT_MASK 0x1 FORMAT "%13.11" ECU_ADDRESS 0x382023 /end MEASUREMENT
/begin MEASUREMENT B_for01 "" UBYTE B_TRUE 1 100 0.00 1.00000000000 BIT_MASK 0x1 FORMAT "%13.11" ECU_ADDRESS 0x382024 /end MEASUREMENT
/begin MEASUREMENT B_for02 "" UBYTE B_TRUE 1 100 0.00 1.00000000000 BIT_MASK 0x1 FORMAT "%13.11" ECU_ADDRESS 0x382025 /end MEASUREMENT
/begin MEASUREMENT B_for03 "" UBYTE B_TRUE 1 100 0.00 1.00000000000 BIT_MASK 0x2 FORMAT "%13.11" ECU_ADDRESS 0x382023 /end MEASUREMENT
/begin MEASUREMENT B_for04 "" UBYTE B_TRUE 1 100 0.00 1.00000000000 BIT_MASK 0x2 FORMAT "%13.11" ECU_ADDRESS 0x382024 /end MEASUREMENT
/begin MEASUREMENT B_for05 "" UBYTE B_TRUE 1 100 0.00 1.00000000000 BIT_MASK 0x2 FORMAT "%13.11" ECU_ADDRESS 0x382025 /end MEASUREMENT
/begin MEASUREMENT B_for06 "" UBYTE B_TRUE 1 100 0.00 1.00000000000 BIT_MASK 0x4 FORMAT "%13.11" ECU_ADDRESS 0x382023 /end MEASUREMENT
/begin MEASUREMENT B_for07 "" UBYTE B_TRUE 1 100 0.00 1.00000000000 BIT_MASK 0x4 FORMAT "%13.11" ECU_ADDRESS 0x382024 /end MEASUREMENT
/begin MEASUREMENT B_for08 "" UBYTE B_TRUE 1 100 0.00 1.00000000000 BIT_MASK 0x4 FORMAT "%13.11" ECU_ADDRESS 0x382025 /end MEASUREMENT
/begin MEASUREMENT B_for09 "" UBYTE B_TRUE 1 100 0.00 1.00000000000 BIT_MASK 0x8 FORMAT "%13.11" ECU_ADDRESS 0x382023 /end MEASUREMENT
/begin MEASUREMENT B_for10 "" UBYTE B_TRUE 1 100 0.00 1.00000000000 BIT_MASK 0x8 FORMAT "%13.11" ECU_ADDRESS 0x382024 /end MEASUREMENT
/begin MEASUREMENT B_for11 "" UBYTE B_TRUE 1 100 0.00 1.00000000000 BIT_MASK 0x8 FORMAT "%13.11" ECU_ADDRESS 0x382025 /end MEASUREMENT
/begin MEASUREMENT B_for12 "" UBYTE B_TRUE 1 100 0.00 1.00000000000 BIT_MASK 0x10 FORMAT "%13.11" ECU_ADDRESS 0x382023 /end MEASUREMENT
/begin MEASUREMENT B_for13 "" UBYTE B_TRUE 1 100 0.00 1.00000000000 BIT_MASK 0x10 FORMAT "%13.11" ECU_ADDRESS 0x382024 /end MEASUREMENT
/begin MEASUREMENT B_for14 "" UBYTE B_TRUE 1 100 0.00 1.00000000000 BIT_MASK 0x10 FORMAT "%13.11" ECU_ADDRESS 0x382025 /end MEASUREMENT
/begin MEASUREMENT B_for15 "" UBYTE B_TRUE 1 100 0.00 1.00000000000 BIT_MASK 0x20 FORMAT "%13.11" ECU_ADDRESS 0x382023 /end MEASUREMENT
/begin MEASUREMENT B_for16 "" UBYTE B_TRUE 1 100 0.00 1.00000000000 BIT_MASK 0x20 FORMAT "%13.11" ECU_ADDRESS 0x382024 /end MEASUREMENT
/begin MEASUREMENT B_for17 "" UBYTE B_TRUE 1 100 0.00 1.00000000000 BIT_MASK 0x20 FORMAT "%13.11" ECU_ADDRESS 0x382025 /end MEASUREMENT
/begin MEASUREMENT B_for18 "" UBYTE B_TRUE 1 100 0.00 1.00000000000 BIT_MASK 0x40 FORMAT "%13.11" ECU_ADDRESS 0x382023 /end MEASUREMENT
/begin MEASUREMENT B_for19 "" UBYTE B_TRUE 1 100 0.00 1.00000000000 BIT_MASK 0x40 FORMAT "%13.11" ECU_ADDRESS 0x382024 /end MEASUREMENT
/begin MEASUREMENT B_for20 "" UBYTE B_TRUE 1 100 0.00 1.00000000000 BIT_MASK 0x40 FORMAT "%13.11" ECU_ADDRESS 0x382025 /end MEASUREMENT
/begin MEASUREMENT B_for21 "" UBYTE B_TRUE 1 100 0.00 1.00000000000 BIT_MASK 0x80 FORMAT "%13.11" ECU_ADDRESS 0x382023 /end MEASUREMENT
/begin MEASUREMENT B_for22 "" UBYTE B_TRUE 1 100 0.00 1.00000000000 BIT_MASK 0x80 FORMAT "%13.11" ECU_ADDRESS 0x382024 /end MEASUREMENT
/begin MEASUREMENT B_for23 "" UBYTE B_TRUE 1 100 0.00 1.00000000000 BIT_MASK 0x80 FORMAT "%13.11" ECU_ADDRESS 0x382025 /end MEASUREMENT
/begin MEASUREMENT B_fordo "" UWORD B_TRUE 1 100 0.00 1.00000000000 BIT_MASK 0x4 FORMAT "%13.11" ECU_ADDRESS 0xFD36 /end MEASUREMENT
/begin MEASUREMENT B_forn "" UWORD B_TRUE 1 100 0.00 1.00000000000 BIT_MASK 0x8 FORMAT "%13.11" ECU_ADDRESS 0xFD36 /end MEASUREMENT
/begin MEASUREMENT B_forn01 "" UBYTE B_TRUE 1 100 0.00 1.00000000000 BIT_MASK 0x1 FORMAT "%13.11" ECU_ADDRESS 0x382026 /end MEASUREMENT
/begin MEASUREMENT B_forn02 "" UBYTE B_TRUE 1 100 0.00 1.00000000000 BIT_MASK 0x2 FORMAT "%13.11" ECU_ADDRESS 0x382026 /end MEASUREMENT
/begin MEASUREMENT B_forn03 "" UBYTE B_TRUE 1 100 0.00 1.00000000000 BIT_MASK 0x4 FORMAT "%13.11" ECU_ADDRESS 0x382026 /end MEASUREMENT
/begin MEASUREMENT B_forn04 "" UBYTE B_TRUE 1 100 0.00 1.00000000000 BIT_MASK 0x8 FORMAT "%13.11" ECU_ADDRESS 0x382026 /end MEASUREMENT
/begin MEASUREMENT B_forn05 "" UBYTE B_TRUE 1 100 0.00 1.00000000000 BIT_MASK 0x10 FORMAT "%13.11" ECU_ADDRESS 0x382026 /end MEASUREMENT
/begin MEASUREMENT B_forn06 "" UBYTE B_TRUE 1 100 0.00 1.00000000000 BIT_MASK 0x20 FORMAT "%13.11" ECU_ADDRESS 0x382026 /end MEASUREMENT
/begin MEASUREMENT B_forn07 "" UBYTE B_TRUE 1 100 0.00 1.00000000000 BIT_MASK 0x40 FORMAT "%13.11" ECU_ADDRESS 0x382026 /end MEASUREMENT
/begin MEASUREMENT B_forn08 "" UBYTE B_TRUE 1 100 0.00 1.00000000000 BIT_MASK 0x80 FORMAT "%13.11" ECU_ADDRESS 0x382026 /end MEASUREMENT
/begin MEASUREMENT B_forun "" UWORD B_TRUE 1 100 0.00 1.00000000000 BIT_MASK 0x10 FORMAT "%13.11" ECU_ADDRESS 0xFD36 /end MEASUREMENT
/begin MEASUREMENT B_forun0 "" UWORD B_TRUE 1 100 0.00 1.00000000000 BIT_MASK 0x20 FORMAT "%13.11" ECU_ADDRESS 0xFD36 /end MEASUREMENT
/begin MEASUREMENT B_helsuf "" UBYTE B_TRUE 1 100 0.00 1.00000000000 BIT_MASK 0x1 FORMAT "%13.11" ECU_ADDRESS 0xF07BC /end MEASUREMENT
/begin MEASUREMENT B_helsuf2 "" UBYTE B_TRUE 1 100 0.00 1.00000000000 BIT_MASK 0x1 FORMAT "%13.11" ECU_ADDRESS 0xF07BD /end MEASUREMENT
/begin MEASUREMENT B_hepllsu "" UBYTE B_TRUE 1 100 0.00 1.00000000000 BIT_MASK 0x2 FORMAT "%13.11" ECU_ADDRESS 0xF07BC /end MEASUREMENT
/begin MEASUREMENT B_hepllsu2 "" UBYTE B_TRUE 1 100 0.00 1.00000000000 BIT_MASK 0x2 FORMAT "%13.11" ECU_ADDRESS 0xF07BD /end MEASUREMENT
/begin MEASUREMENT B_hlanws "" UBYTE B_TRUE 1 100 0.00 1.00000000000 BIT_MASK 0x2 FORMAT "%13.11" ECU_ADDRESS 0xF0C32 /end MEASUREMENT
/begin MEASUREMENT B_hlenws "" UBYTE B_TRUE 1 100 0.00 1.00000000000 BIT_MASK 0x2 FORMAT "%13.11" ECU_ADDRESS 0xF0C1A /end MEASUREMENT
/begin MEASUREMENT B_hpllsue "" UBYTE B_TRUE 1 100 0.00 1.00000000000 BIT_MASK 0x4 FORMAT "%13.11" ECU_ADDRESS 0xF07C1 /end MEASUREMENT
/begin MEASUREMENT B_hpllsue2 "" UBYTE B_TRUE 1 100 0.00 1.00000000000 BIT_MASK 0x4 FORMAT "%13.11" ECU_ADDRESS 0xF07C0 /end MEASUREMENT
/begin MEASUREMENT B_hshtpk "" UBYTE B_TRUE 1 100 0.00 1.00000000000 BIT_MASK 0x4 FORMAT "%13.11" ECU_ADDRESS 0xF0767 /end MEASUREMENT
/begin MEASUREMENT B_hshtpk2 "" UBYTE B_TRUE 1 100 0.00 1.00000000000 BIT_MASK 0x4 FORMAT "%13.11" ECU_ADDRESS 0xF0768 /end MEASUREMENT
/begin MEASUREMENT B_hzkfh "" UWORD B_TRUE 1 100 0.00 1.00000000000 BIT_MASK 0x200 FORMAT "%13.11" ECU_ADDRESS 0xFD4C /end MEASUREMENT
/begin MEASUREMENT B_hzkfh2 "" UWORD B_TRUE 1 100 0.00 1.00000000000 BIT_MASK 0x400 FORMAT "%13.11" ECU_ADDRESS 0xFD4C /end MEASUREMENT
/begin MEASUREMENT B_hzkhzyk "" UWORD B_TRUE 1 100 0.00 1.00000000000 BIT_MASK 0x800 FORMAT "%13.11" ECU_ADDRESS 0xFD4C /end MEASUREMENT
/begin MEASUREMENT B_hzkhzyk2 "" UWORD B_TRUE 1 100 0.00 1.00000000000 BIT_MASK 0x1000 FORMAT "%13.11" ECU_ADDRESS 0xFD4C /end MEASUREMENT
/begin MEASUREMENT B_hzoffh "" UWORD B_TRUE 1 100 0.00 1.00000000000 BIT_MASK 0x100 FORMAT "%13.11" ECU_ADDRESS 0xFD4A /end MEASUREMENT
/begin MEASUREMENT B_hzoffh2 "" UWORD B_TRUE 1 100 0.00 1.00000000000 BIT_MASK 0x200 FORMAT "%13.11" ECU_ADDRESS 0xFD4A /end MEASUREMENT
/begin MEASUREMENT B_ktrlash "" UBYTE B_TRUE 1 100 0.00 1.00000000000 BIT_MASK 0x80 FORMAT "%13.11" ECU_ADDRESS 0xF0754 /end MEASUREMENT
/begin MEASUREMENT B_ktrlash2 "" UBYTE B_TRUE 1 100 0.00 1.00000000000 BIT_MASK 0x80 FORMAT "%13.11" ECU_ADDRESS 0xF0755 /end MEASUREMENT
/begin MEASUREMENT B_ktrshv "" UBYTE B_TRUE 1 100 0.00 1.00000000000 BIT_MASK 0x2 FORMAT "%13.11" ECU_ADDRESS 0xF07E7 /end MEASUREMENT
/begin MEASUREMENT B_ktrshv2 "" UBYTE B_TRUE 1 100 0.00 1.00000000000 BIT_MASK 0x4 FORMAT "%13.11" ECU_ADDRESS 0xF07E7 /end MEASUREMENT
/begin MEASUREMENT B_ktzykhv "" UBYTE B_TRUE 1 100 0.00 1.00000000000 BIT_MASK 0x8 FORMAT "%13.11" ECU_ADDRESS 0xF07E7 /end MEASUREMENT
/begin MEASUREMENT B_ktzykhv2 "" UBYTE B_TRUE 1 100 0.00 1.00000000000 BIT_MASK 0x10 FORMAT "%13.11" ECU_ADDRESS 0xF07E7 /end MEASUREMENT
/begin MEASUREMENT B_lamend "" UBYTE B_TRUE 1 100 0.00 1.00000000000 BIT_MASK 0x1 FORMAT "%13.11" ECU_ADDRESS 0xF075C /end MEASUREMENT
/begin MEASUREMENT B_lamend2 "" UBYTE B_TRUE 1 100 0.00 1.00000000000 BIT_MASK 0x1 FORMAT "%13.11" ECU_ADDRESS 0xF075D /end MEASUREMENT
/begin MEASUREMENT B_lamlash "" UBYTE B_TRUE 1 100 0.00 1.00000000000 BIT_MASK 0x1 FORMAT "%13.11" ECU_ADDRESS 0xF0759 /end MEASUREMENT
/begin MEASUREMENT B_lamlash2 "" UBYTE B_TRUE 1 100 0.00 1.00000000000 BIT_MASK 0x1 FORMAT "%13.11" ECU_ADDRESS 0xF075A /end MEASUREMENT
/begin MEASUREMENT B_lamlshv "" UWORD B_TRUE 1 100 0.00 1.00000000000 BIT_MASK 0x80 FORMAT "%13.11" ECU_ADDRESS 0xFD52 /end MEASUREMENT
/begin MEASUREMENT B_lamlshv2 "" UWORD B_TRUE 1 100 0.00 1.00000000000 BIT_MASK 0x100 FORMAT "%13.11" ECU_ADDRESS 0xFD52 /end MEASUREMENT
/begin MEASUREMENT B_lamverg "" UBYTE B_TRUE 1 100 0.00 1.00000000000 BIT_MASK 0x8 FORMAT "%13.11" ECU_ADDRESS 0xF0754 /end MEASUREMENT
/begin MEASUREMENT B_lamverg2 "" UBYTE B_TRUE 1 100 0.00 1.00000000000 BIT_MASK 0x8 FORMAT "%13.11" ECU_ADDRESS 0xF0755 /end MEASUREMENT
/begin MEASUREMENT B_lcnpanw "" UBYTE B_TRUE 1 100 0.00 1.00000000000 BIT_MASK 0x10 FORMAT "%13.11" ECU_ADDRESS 0xF0C32 /end MEASUREMENT
/begin MEASUREMENT B_lcnpenw "" UBYTE B_TRUE 1 100 0.00 1.00000000000 BIT_MASK 0x10 FORMAT "%13.11" ECU_ADDRESS 0xF0C1A /end MEASUREMENT
/begin MEASUREMENT B_lfzyl1 "" UWORD B_TRUE 1 100 0.00 1.00000000000 BIT_MASK 0x4 FORMAT "%13.11" ECU_ADDRESS 0xFD38 /end MEASUREMENT
/begin MEASUREMENT B_lsahksp "" UBYTE B_TRUE 1 100 0.00 1.00000000000 BIT_MASK 0x2 FORMAT "%13.11" ECU_ADDRESS 0xF0759 /end MEASUREMENT
/begin MEASUREMENT B_lsahksp2 "" UBYTE B_TRUE 1 100 0.00 1.00000000000 BIT_MASK 0x2 FORMAT "%13.11" ECU_ADDRESS 0xF075A /end MEASUREMENT
/begin MEASUREMENT B_lshklt "" UWORD B_TRUE 1 100 0.00 1.00000000000 BIT_MASK 0x400 FORMAT "%13.11" ECU_ADDRESS 0xFD4A /end MEASUREMENT
/begin MEASUREMENT B_lshkpft "" UBYTE B_TRUE 1 100 0.00 1.00000000000 BIT_MASK 0x8 FORMAT "%13.11" ECU_ADDRESS 0xF07BC /end MEASUREMENT
/begin MEASUREMENT B_lshkpft2 "" UBYTE B_TRUE 1 100 0.00 1.00000000000 BIT_MASK 0x8 FORMAT "%13.11" ECU_ADDRESS 0xF07BD /end MEASUREMENT
/begin MEASUREMENT B_lshkpmr "" UBYTE B_TRUE 1 100 0.00 1.00000000000 BIT_MASK 0x10 FORMAT "%13.11" ECU_ADDRESS 0xF07BC /end MEASUREMENT
/begin MEASUREMENT B_lshkpmr2 "" UBYTE B_TRUE 1 100 0.00 1.00000000000 BIT_MASK 0x10 FORMAT "%13.11" ECU_ADDRESS 0xF07BD /end MEASUREMENT
/begin MEASUREMENT B_lshkspe "" UBYTE B_TRUE 1 100 0.00 1.00000000000 BIT_MASK 0x2 FORMAT "%13.11" ECU_ADDRESS 0xF0767 /end MEASUREMENT
/begin MEASUREMENT B_lshkspe2 "" UBYTE B_TRUE 1 100 0.00 1.00000000000 BIT_MASK 0x2 FORMAT "%13.11" ECU_ADDRESS 0xF0768 /end MEASUREMENT
/begin MEASUREMENT B_lshswok "" UBYTE B_TRUE 1 100 0.00 1.00000000000 BIT_MASK 0x1 FORMAT "%13.11" ECU_ADDRESS 0xF0754 /end MEASUREMENT
/begin MEASUREMENT B_lshswok2 "" UBYTE B_TRUE 1 100 0.00 1.00000000000 BIT_MASK 0x1 FORMAT "%13.11" ECU_ADDRESS 0xF0755 /end MEASUREMENT
/begin MEASUREMENT B_lsuft "" UBYTE B_TRUE 1 100 0.00 1.00000000000 BIT_MASK 0x20 FORMAT "%13.11" ECU_ADDRESS 0xF07BC /end MEASUREMENT
/begin MEASUREMENT B_lsuft2 "" UBYTE B_TRUE 1 100 0.00 1.00000000000 BIT_MASK 0x20 FORMAT "%13.11" ECU_ADDRESS 0xF07BD /end MEASUREMENT
/begin MEASUREMENT B_lsufta "" UBYTE B_TRUE 1 100 0.00 1.00000000000 BIT_MASK 0x40 FORMAT "%13.11" ECU_ADDRESS 0xF07BC /end MEASUREMENT
/begin MEASUREMENT B_lsufta2 "" UBYTE B_TRUE 1 100 0.00 1.00000000000 BIT_MASK 0x40 FORMAT "%13.11" ECU_ADDRESS 0xF07BD /end MEASUREMENT
/begin MEASUREMENT B_lsuftb "" UBYTE B_TRUE 1 100 0.00 1.00000000000 BIT_MASK 0x80 FORMAT "%13.11" ECU_ADDRESS 0xF07BC /end MEASUREMENT
/begin MEASUREMENT B_lsuftb2 "" UBYTE B_TRUE 1 100 0.00 1.00000000000 BIT_MASK 0x80 FORMAT "%13.11" ECU_ADDRESS 0xF07BD /end MEASUREMENT
/begin MEASUREMENT B_lsulash "" UBYTE B_TRUE 1 100 0.00 1.00000000000 BIT_MASK 0x8 FORMAT "%13.11" ECU_ADDRESS 0xF0767 /end MEASUREMENT
/begin MEASUREMENT B_lsulash2 "" UBYTE B_TRUE 1 100 0.00 1.00000000000 BIT_MASK 0x8 FORMAT "%13.11" ECU_ADDRESS 0xF0768 /end MEASUREMENT
/begin MEASUREMENT B_lsulone "" UBYTE B_TRUE 1 100 0.00 1.00000000000 BIT_MASK 0x4 FORMAT "%13.11" ECU_ADDRESS 0xF07BB /end MEASUREMENT
/begin MEASUREMENT B_lsulone2 "" UBYTE B_TRUE 1 100 0.00 1.00000000000 BIT_MASK 0x20 FORMAT "%13.11" ECU_ADDRESS 0xF07BB /end MEASUREMENT
/begin MEASUREMENT B_lsumr "" UBYTE B_TRUE 1 100 0.00 1.00000000000 BIT_MASK 0x1 FORMAT "%13.11" ECU_ADDRESS 0xF07BE /end MEASUREMENT
/begin MEASUREMENT B_lsumr2 "" UBYTE B_TRUE 1 100 0.00 1.00000000000 BIT_MASK 0x1 FORMAT "%13.11" ECU_ADDRESS 0xF07BF /end MEASUREMENT
/begin MEASUREMENT B_lsumra "" UBYTE B_TRUE 1 100 0.00 1.00000000000 BIT_MASK 0x2 FORMAT "%13.11" ECU_ADDRESS 0xF07BE /end MEASUREMENT
/begin MEASUREMENT B_lsumra2 "" UBYTE B_TRUE 1 100 0.00 1.00000000000 BIT_MASK 0x2 FORMAT "%13.11" ECU_ADDRESS 0xF07BF /end MEASUREMENT
/begin MEASUREMENT B_lsumrb "" UBYTE B_TRUE 1 100 0.00 1.00000000000 BIT_MASK 0x4 FORMAT "%13.11" ECU_ADDRESS 0xF07BE /end MEASUREMENT
/begin MEASUREMENT B_lsumrb2 "" UBYTE B_TRUE 1 100 0.00 1.00000000000 BIT_MASK 0x4 FORMAT "%13.11" ECU_ADDRESS 0xF07BF /end MEASUREMENT
/begin MEASUREMENT B_lsuoffe "" UBYTE B_TRUE 1 100 0.00 1.00000000000 BIT_MASK 0x8 FORMAT "%13.11" ECU_ADDRESS 0xF07C1 /end MEASUREMENT
/begin MEASUREMENT B_lsuoffe2 "" UBYTE B_TRUE 1 100 0.00 1.00000000000 BIT_MASK 0x8 FORMAT "%13.11" ECU_ADDRESS 0xF07C0 /end MEASUREMENT
/begin MEASUREMENT B_lsuoffs "" UBYTE B_TRUE 1 100 0.00 1.00000000000 BIT_MASK 0x8 FORMAT "%13.11" ECU_ADDRESS 0xF07BE /end MEASUREMENT
/begin MEASUREMENT B_lsuoffs2 "" UBYTE B_TRUE 1 100 0.00 1.00000000000 BIT_MASK 0x8 FORMAT "%13.11" ECU_ADDRESS 0xF07BF /end MEASUREMENT
/begin MEASUREMENT B_lsupft "" UBYTE B_TRUE 1 100 0.00 1.00000000000 BIT_MASK 0x10 FORMAT "%13.11" ECU_ADDRESS 0xF07BE /end MEASUREMENT
/begin MEASUREMENT B_lsupft2 "" UBYTE B_TRUE 1 100 0.00 1.00000000000 BIT_MASK 0x10 FORMAT "%13.11" ECU_ADDRESS 0xF07BF /end MEASUREMENT
/begin MEASUREMENT B_lsupmr "" UBYTE B_TRUE 1 100 0.00 1.00000000000 BIT_MASK 0x20 FORMAT "%13.11" ECU_ADDRESS 0xF07BE /end MEASUREMENT
/begin MEASUREMENT B_lsupmr2 "" UBYTE B_TRUE 1 100 0.00 1.00000000000 BIT_MASK 0x20 FORMAT "%13.11" ECU_ADDRESS 0xF07BF /end MEASUREMENT
/begin MEASUREMENT B_luaerk "" UWORD B_TRUE 1 100 0.00 1.00000000000 BIT_MASK 0x80 FORMAT "%13.11" ECU_ADDRESS 0xFD38 /end MEASUREMENT
/begin MEASUREMENT B_luerk "" UWORD B_TRUE 1 100 0.00 1.00000000000 BIT_MASK 0x40 FORMAT "%13.11" ECU_ADDRESS 0xFD38 /end MEASUREMENT
/begin MEASUREMENT B_lustop "" UWORD B_TRUE 1 100 0.00 1.00000000000 BIT_MASK 0x8000 FORMAT "%13.11" ECU_ADDRESS 0xFD38 /end MEASUREMENT
/begin MEASUREMENT B_maxflsh "" UBYTE B_TRUE 1 100 0.00 1.00000000000 BIT_MASK 0x1 FORMAT "%13.11" ECU_ADDRESS 0xF072C /end MEASUREMENT
/begin MEASUREMENT B_maxla "" UBYTE B_TRUE 1 100 0.00 1.00000000000 BIT_MASK 0x4 FORMAT "%13.11" ECU_ADDRESS 0xF0765 /end MEASUREMENT
/begin MEASUREMENT B_maxla2 "" UBYTE B_TRUE 1 100 0.00 1.00000000000 BIT_MASK 0x40 FORMAT "%13.11" ECU_ADDRESS 0xF0765 /end MEASUREMENT
/begin MEASUREMENT B_maxlash "" UBYTE B_TRUE 1 100 0.00 1.00000000000 BIT_MASK 0x1 FORMAT "%13.11" ECU_ADDRESS 0xF0757 /end MEASUREMENT
/begin MEASUREMENT B_maxlash2 "" UBYTE B_TRUE 1 100 0.00 1.00000000000 BIT_MASK 0x1 FORMAT "%13.11" ECU_ADDRESS 0xF0758 /end MEASUREMENT
/begin MEASUREMENT B_maxlavh "" UBYTE B_TRUE 1 100 0.00 1.00000000000 BIT_MASK 0x80 FORMAT "%13.11" ECU_ADDRESS 0xF0759 /end MEASUREMENT
/begin MEASUREMENT B_maxlavh2 "" UBYTE B_TRUE 1 100 0.00 1.00000000000 BIT_MASK 0x80 FORMAT "%13.11" ECU_ADDRESS 0xF075A /end MEASUREMENT
/begin MEASUREMENT B_mdarv "" UWORD B_TRUE 1 100 0.00 1.00000000000 BIT_MASK 0x1 FORMAT "%13.11" ECU_ADDRESS 0xFD3C /end MEASUREMENT
/begin MEASUREMENT B_mdarvb1 "" UWORD B_TRUE 1 100 0.00 1.00000000000 BIT_MASK 0x2 FORMAT "%13.11" ECU_ADDRESS 0xFD3C /end MEASUREMENT
/begin MEASUREMENT B_mdarvb2 "" UWORD B_TRUE 1 100 0.00 1.00000000000 BIT_MASK 0x4 FORMAT "%13.11" ECU_ADDRESS 0xFD3C /end MEASUREMENT
/begin MEASUREMENT B_mddrla "" UWORD B_TRUE 1 100 0.00 1.00000000000 BIT_MASK 0x1 FORMAT "%13.11" ECU_ADDRESS 0xFD3A /end MEASUREMENT
/begin MEASUREMENT B_mdend "" UWORD B_TRUE 1 100 0.00 1.00000000000 BIT_MASK 0x80 FORMAT "%13.11" ECU_ADDRESS 0xFD3C /end MEASUREMENT
/begin MEASUREMENT B_mderk "" UWORD B_TRUE 1 100 0.00 1.00000000000 BIT_MASK 0x2000 FORMAT "%13.11" ECU_ADDRESS 0xFD3A /end MEASUREMENT
/begin MEASUREMENT B_mdkat "" UWORD B_TRUE 1 100 0.00 1.00000000000 BIT_MASK 0x8 FORMAT "%13.11" ECU_ADDRESS 0xFD3C /end MEASUREMENT
/begin MEASUREMENT B_mdkatb1 "" UWORD B_TRUE 1 100 0.00 1.00000000000 BIT_MASK 0x10 FORMAT "%13.11" ECU_ADDRESS 0xFD3C /end MEASUREMENT
/begin MEASUREMENT B_mdkatb2 "" UWORD B_TRUE 1 100 0.00 1.00000000000 BIT_MASK 0x20 FORMAT "%13.11" ECU_ADDRESS 0xFD3C /end MEASUREMENT
/begin MEASUREMENT B_mdmi "" UWORD B_TRUE 1 100 0.00 1.00000000000 BIT_MASK 0x2 FORMAT "%13.11" ECU_ADDRESS 0xFD3A /end MEASUREMENT
/begin MEASUREMENT B_mdng "" UWORD B_TRUE 1 100 0.00 1.00000000000 BIT_MASK 0x4 FORMAT "%13.11" ECU_ADDRESS 0xFD3A /end MEASUREMENT
/begin MEASUREMENT B_mdnmn "" UWORD B_TRUE 1 100 0.00 1.00000000000 BIT_MASK 0x8 FORMAT "%13.11" ECU_ADDRESS 0xFD3A /end MEASUREMENT
/begin MEASUREMENT B_mdnmx "" UWORD B_TRUE 1 100 0.00 1.00000000000 BIT_MASK 0x10 FORMAT "%13.11" ECU_ADDRESS 0xFD3A /end MEASUREMENT
/begin MEASUREMENT B_mdstim "" UWORD B_TRUE 1 100 0.00 1.00000000000 BIT_MASK 0x8 FORMAT "%13.11" ECU_ADDRESS 0xFD38 /end MEASUREMENT
/begin MEASUREMENT B_mdstop "" UWORD B_TRUE 1 100 0.00 1.00000000000 BIT_MASK 0x20 FORMAT "%13.11" ECU_ADDRESS 0xFD3A /end MEASUREMENT
/begin MEASUREMENT B_mdtnst "" UWORD B_TRUE 1 100 0.00 1.00000000000 BIT_MASK 0x40 FORMAT "%13.11" ECU_ADDRESS 0xFD3A /end MEASUREMENT
/begin MEASUREMENT B_mdzag "" UWORD B_TRUE 1 100 0.00 1.00000000000 BIT_MASK 0x100 FORMAT "%13.11" ECU_ADDRESS 0xFD3C /end MEASUREMENT
/begin MEASUREMENT B_mdzgstp "" UWORD B_TRUE 1 100 0.00 1.00000000000 BIT_MASK 0x80 FORMAT "%13.11" ECU_ADDRESS 0xFD3A /end MEASUREMENT
/begin MEASUREMENT B_mdzyl1 "" UWORD B_TRUE 1 100 0.00 1.00000000000 BIT_MASK 0x1 FORMAT "%13.11" ECU_ADDRESS 0xFD38 /end MEASUREMENT
/begin MEASUREMENT B_meaoper "" UBYTE B_TRUE 1 100 0.00 1.00000000000 BIT_MASK 0x80 FORMAT "%13.11" ECU_ADDRESS 0xF05EA /end MEASUREMENT
/begin MEASUREMENT B_mesausw "" UBYTE B_TRUE 1 100 0.00 1.00000000000 BIT_MASK 0x40 FORMAT "%13.11" ECU_ADDRESS 0xF05ED /end MEASUREMENT
/begin MEASUREMENT B_mesausw2 "" UBYTE B_TRUE 1 100 0.00 1.00000000000 BIT_MASK 0x2 FORMAT "%13.11" ECU_ADDRESS 0xF05EF /end MEASUREMENT
/begin MEASUREMENT B_mess "" UBYTE B_TRUE 1 100 0.00 1.00000000000 BIT_MASK 0x20 FORMAT "%13.11" ECU_ADDRESS 0xF05ED /end MEASUREMENT
/begin MEASUREMENT B_mess2 "" UBYTE B_TRUE 1 100 0.00 1.00000000000 BIT_MASK 0x4 FORMAT "%13.11" ECU_ADDRESS 0xF05EF /end MEASUREMENT
/begin MEASUREMENT B_milmd "" UWORD B_TRUE 1 100 0.00 1.00000000000 BIT_MASK 0x40 FORMAT "%13.11" ECU_ADDRESS 0xFD3C /end MEASUREMENT
/begin MEASUREMENT B_milstp "" UWORD B_TRUE 1 100 0.00 1.00000000000 BIT_MASK 0x100 FORMAT "%13.11" ECU_ADDRESS 0xFD3A /end MEASUREMENT
/begin MEASUREMENT B_minflsh "" UBYTE B_TRUE 1 100 0.00 1.00000000000 BIT_MASK 0x2 FORMAT "%13.11" ECU_ADDRESS 0xF0728 /end MEASUREMENT
/begin MEASUREMENT B_minflsh2 "" UBYTE B_TRUE 1 100 0.00 1.00000000000 BIT_MASK 0x2 FORMAT "%13.11" ECU_ADDRESS 0xF0729 /end MEASUREMENT
/begin MEASUREMENT B_minlash "" UBYTE B_TRUE 1 100 0.00 1.00000000000 BIT_MASK 0x20 FORMAT "%13.11" ECU_ADDRESS 0xF0767 /end MEASUREMENT
/begin MEASUREMENT B_minlash2 "" UBYTE B_TRUE 1 100 0.00 1.00000000000 BIT_MASK 0x20 FORMAT "%13.11" ECU_ADDRESS 0xF0768 /end MEASUREMENT
/begin MEASUREMENT B_mldyn "" UBYTE B_TRUE 1 100 0.00 1.00000000000 BIT_MASK 0x1 FORMAT "%13.11" ECU_ADDRESS 0xF0756 /end MEASUREMENT
/begin MEASUREMENT B_mlktv "" UBYTE B_TRUE 1 100 0.00 1.00000000000 BIT_MASK 0x20 FORMAT "%13.11" ECU_ADDRESS 0xF07E7 /end MEASUREMENT
/begin MEASUREMENT B_mlustest "" UBYTE B_TRUE 1 100 0.00 1.00000000000 BIT_MASK 0x2 FORMAT "%13.11" ECU_ADDRESS 0xF0756 /end MEASUREMENT
/begin MEASUREMENT B_mnslspr "" UBYTE B_TRUE 1 100 0.00 1.00000000000 BIT_MASK 0x8 FORMAT "%13.11" ECU_ADDRESS 0xF05EA /end MEASUREMENT
/begin MEASUREMENT B_mnslspr2 "" UBYTE B_TRUE 1 100 0.00 1.00000000000 BIT_MASK 0x4 FORMAT "%13.11" ECU_ADDRESS 0xF05EB /end MEASUREMENT
/begin MEASUREMENT B_mntkomp "" UWORD B_TRUE 1 100 0.00 1.00000000000 BIT_MASK 0x10 FORMAT "%13.11" ECU_ADDRESS 0xFD38 /end MEASUREMENT
/begin MEASUREMENT B_mslmin "" UBYTE B_TRUE 1 100 0.00 1.00000000000 BIT_MASK 0x2 FORMAT "%13.11" ECU_ADDRESS 0xF05E5 /end MEASUREMENT
/begin MEASUREMENT B_mslmin2 "" UBYTE B_TRUE 1 100 0.00 1.00000000000 BIT_MASK 0x2 FORMAT "%13.11" ECU_ADDRESS 0xF05EB /end MEASUREMENT
/begin MEASUREMENT B_mslmn "" UBYTE B_TRUE 1 100 0.00 1.00000000000 BIT_MASK 0x10 FORMAT "%13.11" ECU_ADDRESS 0xF05E2 /end MEASUREMENT
/begin MEASUREMENT B_mslpmn "" UBYTE B_TRUE 1 100 0.00 1.00000000000 BIT_MASK 0x2 FORMAT "%13.11" ECU_ADDRESS 0xF05E3 /end MEASUREMENT
/begin MEASUREMENT B_mslpmn2 "" UBYTE B_TRUE 1 100 0.00 1.00000000000 BIT_MASK 0x1 FORMAT "%13.11" ECU_ADDRESS 0xF05E4 /end MEASUREMENT
/begin MEASUREMENT B_mxslvpr "" UBYTE B_TRUE 1 100 0.00 1.00000000000 BIT_MASK 0x40 FORMAT "%13.11" ECU_ADDRESS 0xF05EA /end MEASUREMENT
/begin MEASUREMENT B_mxslvpr2 "" UBYTE B_TRUE 1 100 0.00 1.00000000000 BIT_MASK 0x20 FORMAT "%13.11" ECU_ADDRESS 0xF05EB /end MEASUREMENT
/begin MEASUREMENT B_nlphdly "" UWORD B_TRUE 1 100 0.00 1.00000000000 BIT_MASK 0x1000 FORMAT "%13.11" ECU_ADDRESS 0xFD0E /end MEASUREMENT
/begin MEASUREMENT B_noadsh "" UBYTE B_TRUE 1 100 0.00 1.00000000000 BIT_MASK 0x1 FORMAT "%13.11" ECU_ADDRESS 0xF072D /end MEASUREMENT
/begin MEASUREMENT B_noadsh2 "" UBYTE B_TRUE 1 100 0.00 1.00000000000 BIT_MASK 0x10 FORMAT "%13.11" ECU_ADDRESS 0xF072D /end MEASUREMENT
/begin MEASUREMENT B_nolash "" UBYTE B_TRUE 1 100 0.00 1.00000000000 BIT_MASK 0x10 FORMAT "%13.11" ECU_ADDRESS 0xF0767 /end MEASUREMENT
/begin MEASUREMENT B_nolash2 "" UBYTE B_TRUE 1 100 0.00 1.00000000000 BIT_MASK 0x10 FORMAT "%13.11" ECU_ADDRESS 0xF0768 /end MEASUREMENT
/begin MEASUREMENT B_nolavh "" UBYTE B_TRUE 1 100 0.00 1.00000000000 BIT_MASK 0x1 FORMAT "%13.11" ECU_ADDRESS 0xF0767 /end MEASUREMENT
/begin MEASUREMENT B_nolavh2 "" UBYTE B_TRUE 1 100 0.00 1.00000000000 BIT_MASK 0x1 FORMAT "%13.11" ECU_ADDRESS 0xF0768 /end MEASUREMENT
/begin MEASUREMENT B_nolsh "" UWORD B_TRUE 1 100 0.00 1.00000000000 BIT_MASK 0x800 FORMAT "%13.11" ECU_ADDRESS 0xFD4A /end MEASUREMENT
/begin MEASUREMENT B_nolsh2 "" UWORD B_TRUE 1 100 0.00 1.00000000000 BIT_MASK 0x1000 FORMAT "%13.11" ECU_ADDRESS 0xFD4A /end MEASUREMENT
/begin MEASUREMENT B_nolshv "" UBYTE B_TRUE 1 100 0.00 1.00000000000 BIT_MASK 0x40 FORMAT "%13.11" ECU_ADDRESS 0xF07E7 /end MEASUREMENT
/begin MEASUREMENT B_nophnldg "" UWORD B_TRUE 1 100 0.00 1.00000000000 BIT_MASK 0x400 FORMAT "%13.11" ECU_ADDRESS 0xFD40 /end MEASUREMENT
/begin MEASUREMENT B_nplflsh "" UBYTE B_TRUE 1 100 0.00 1.00000000000 BIT_MASK 0x10 FORMAT "%13.11" ECU_ADDRESS 0xF0728 /end MEASUREMENT
/begin MEASUREMENT B_nplflsh2 "" UBYTE B_TRUE 1 100 0.00 1.00000000000 BIT_MASK 0x10 FORMAT "%13.11" ECU_ADDRESS 0xF0729 /end MEASUREMENT
/begin MEASUREMENT B_npllash "" UBYTE B_TRUE 1 100 0.00 1.00000000000 BIT_MASK 0x4 FORMAT "%13.11" ECU_ADDRESS 0xF0766 /end MEASUREMENT
/begin MEASUREMENT B_npllash2 "" UBYTE B_TRUE 1 100 0.00 1.00000000000 BIT_MASK 0x8 FORMAT "%13.11" ECU_ADDRESS 0xF0766 /end MEASUREMENT
/begin MEASUREMENT B_npllshv "" UBYTE B_TRUE 1 100 0.00 1.00000000000 BIT_MASK 0x80 FORMAT "%13.11" ECU_ADDRESS 0xF07E7 /end MEASUREMENT
/begin MEASUREMENT B_nwkv "" UBYTE B_TRUE 1 100 0.00 1.00000000000 BIT_MASK 0x1 FORMAT "%13.11" ECU_ADDRESS 0x382041 /end MEASUREMENT
/begin MEASUREMENT B_nwnpoka "" UBYTE B_TRUE 1 100 0.00 1.00000000000 BIT_MASK 0x2 FORMAT "%13.11" ECU_ADDRESS 0xF0C34 /end MEASUREMENT
/begin MEASUREMENT B_nwnpoke "" UBYTE B_TRUE 1 100 0.00 1.00000000000 BIT_MASK 0x2 FORMAT "%13.11" ECU_ADDRESS 0xF0C1C /end MEASUREMENT
/begin MEASUREMENT B_phend "" UBYTE B_TRUE 1 100 0.00 1.00000000000 BIT_MASK 0x40 FORMAT "%13.11" ECU_ADDRESS 0xF05EE /end MEASUREMENT
/begin MEASUREMENT B_phexor "" UBYTE B_TRUE 1 100 0.00 1.00000000000 BIT_MASK 0x1 FORMAT "%13.11" ECU_ADDRESS 0xF06FA /end MEASUREMENT
/begin MEASUREMENT B_phexor2 "" UBYTE B_TRUE 1 100 0.00 1.00000000000 BIT_MASK 0x10 FORMAT "%13.11" ECU_ADDRESS 0xF06FA /end MEASUREMENT
/begin MEASUREMENT B_phregok "" UBYTE B_TRUE 1 100 0.00 1.00000000000 BIT_MASK 0x2 FORMAT "%13.11" ECU_ADDRESS 0xF06FA /end MEASUREMENT
/begin MEASUREMENT B_phregok2 "" UBYTE B_TRUE 1 100 0.00 1.00000000000 BIT_MASK 0x20 FORMAT "%13.11" ECU_ADDRESS 0xF06FA /end MEASUREMENT
/begin MEASUREMENT B_phsok "" UWORD B_TRUE 1 100 0.00 1.00000000000 BIT_MASK 0x800 FORMAT "%13.11" ECU_ADDRESS 0xFD40 /end MEASUREMENT
/begin MEASUREMENT B_phsok2 "" UWORD B_TRUE 1 100 0.00 1.00000000000 BIT_MASK 0x1000 FORMAT "%13.11" ECU_ADDRESS 0xFD40 /end MEASUREMENT
/begin MEASUREMENT B_plenvh "" UBYTE B_TRUE 1 100 0.00 1.00000000000 BIT_MASK 0x4 FORMAT "%13.11" ECU_ADDRESS 0xF07BC /end MEASUREMENT
/begin MEASUREMENT B_plenvh2 "" UBYTE B_TRUE 1 100 0.00 1.00000000000 BIT_MASK 0x4 FORMAT "%13.11" ECU_ADDRESS 0xF07BD /end MEASUREMENT
/begin MEASUREMENT B_plok "" UWORD B_TRUE 1 100 0.00 1.00000000000 BIT_MASK 0x40 FORMAT "%13.11" ECU_ADDRESS 0xFD36 /end MEASUREMENT
/begin MEASUREMENT B_plok01 "" UBYTE B_TRUE 1 100 0.00 1.00000000000 BIT_MASK 0x1 FORMAT "%13.11" ECU_ADDRESS 0x382027 /end MEASUREMENT
/begin MEASUREMENT B_plok02 "" UBYTE B_TRUE 1 100 0.00 1.00000000000 BIT_MASK 0x2 FORMAT "%13.11" ECU_ADDRESS 0x382027 /end MEASUREMENT
/begin MEASUREMENT B_plok03 "" UBYTE B_TRUE 1 100 0.00 1.00000000000 BIT_MASK 0x4 FORMAT "%13.11" ECU_ADDRESS 0x382027 /end MEASUREMENT
/begin MEASUREMENT B_plok04 "" UBYTE B_TRUE 1 100 0.00 1.00000000000 BIT_MASK 0x8 FORMAT "%13.11" ECU_ADDRESS 0x382027 /end MEASUREMENT
/begin MEASUREMENT B_plok05 "" UBYTE B_TRUE 1 100 0.00 1.00000000000 BIT_MASK 0x10 FORMAT "%13.11" ECU_ADDRESS 0x382027 /end MEASUREMENT
/begin MEASUREMENT B_plok06 "" UBYTE B_TRUE 1 100 0.00 1.00000000000 BIT_MASK 0x20 FORMAT "%13.11" ECU_ADDRESS 0x382027 /end MEASUREMENT
/begin MEASUREMENT B_plok07 "" UBYTE B_TRUE 1 100 0.00 1.00000000000 BIT_MASK 0x40 FORMAT "%13.11" ECU_ADDRESS 0x382027 /end MEASUREMENT
/begin MEASUREMENT B_plok08 "" UBYTE B_TRUE 1 100 0.00 1.00000000000 BIT_MASK 0x80 FORMAT "%13.11" ECU_ADDRESS 0x382027 /end MEASUREMENT
/begin MEASUREMENT B_plokn "" UWORD B_TRUE 1 100 0.00 1.00000000000 BIT_MASK 0x80 FORMAT "%13.11" ECU_ADDRESS 0xFD36 /end MEASUREMENT
/begin MEASUREMENT B_reini "" UWORD B_TRUE 1 100 0.00 1.00000000000 BIT_MASK 0x200 FORMAT "%13.11" ECU_ADDRESS 0xFD3C /end MEASUREMENT
/begin MEASUREMENT B_reset_ushsch2 "" UBYTE B_TRUE 1 100 0.00 1.00000000000 BIT_MASK 0x10 FORMAT "%13.11" ECU_ADDRESS 0xF0766 /end MEASUREMENT
/begin MEASUREMENT B_risigh "" UWORD B_TRUE 1 100 0.00 1.00000000000 BIT_MASK 0x2000 FORMAT "%13.11" ECU_ADDRESS 0xFD4A /end MEASUREMENT
/begin MEASUREMENT B_risigh2 "" UWORD B_TRUE 1 100 0.00 1.00000000000 BIT_MASK 0x4000 FORMAT "%13.11" ECU_ADDRESS 0xFD4A /end MEASUREMENT
/begin MEASUREMENT B_rmsl "" UBYTE B_TRUE 1 100 0.00 1.00000000000 BIT_MASK 0x80 FORMAT "%13.11" ECU_ADDRESS 0xF05ED /end MEASUREMENT
/begin MEASUREMENT B_rmsl2 "" UBYTE B_TRUE 1 100 0.00 1.00000000000 BIT_MASK 0x20 FORMAT "%13.11" ECU_ADDRESS 0xF05EF /end MEASUREMENT
/begin MEASUREMENT B_saagr "" UBYTE B_TRUE 1 100 0.00 1.00000000000 BIT_MASK 0x20 FORMAT "%13.11" ECU_ADDRESS 0xF0766 /end MEASUREMENT
/begin MEASUREMENT B_sbbhk "" UWORD B_TRUE 1 100 0.00 1.00000000000 BIT_MASK 0x8000 FORMAT "%13.11" ECU_ADDRESS 0xFD4A /end MEASUREMENT
/begin MEASUREMENT B_sbbhk2 "" UWORD B_TRUE 1 100 0.00 1.00000000000 BIT_MASK 0x1 FORMAT "%13.11" ECU_ADDRESS 0xFD4C /end MEASUREMENT
/begin MEASUREMENT B_sbbhkre "" UBYTE B_TRUE 1 100 0.00 1.00000000000 BIT_MASK 0x2 FORMAT "%13.11" ECU_ADDRESS 0xF072D /end MEASUREMENT
/begin MEASUREMENT B_sbbhkre2 "" UBYTE B_TRUE 1 100 0.00 1.00000000000 BIT_MASK 0x20 FORMAT "%13.11" ECU_ADDRESS 0xF072D /end MEASUREMENT
/begin MEASUREMENT B_sbbhkv "" UBYTE B_TRUE 1 100 0.00 1.00000000000 BIT_MASK 0x2 FORMAT "%13.11" ECU_ADDRESS 0xF0754 /end MEASUREMENT
/begin MEASUREMENT B_sbbhkv2 "" UBYTE B_TRUE 1 100 0.00 1.00000000000 BIT_MASK 0x2 FORMAT "%13.11" ECU_ADDRESS 0xF0755 /end MEASUREMENT
/begin MEASUREMENT B_sigflsh "" UBYTE B_TRUE 1 100 0.00 1.00000000000 BIT_MASK 0x20 FORMAT "%13.11" ECU_ADDRESS 0xF0728 /end MEASUREMENT
/begin MEASUREMENT B_sigflsh2 "" UBYTE B_TRUE 1 100 0.00 1.00000000000 BIT_MASK 0x20 FORMAT "%13.11" ECU_ADDRESS 0xF0729 /end MEASUREMENT
/begin MEASUREMENT B_siglash "" UBYTE B_TRUE 1 100 0.00 1.00000000000 BIT_MASK 0x1 FORMAT "%13.11" ECU_ADDRESS 0xF0766 /end MEASUREMENT
/begin MEASUREMENT B_siglash2 "" UBYTE B_TRUE 1 100 0.00 1.00000000000 BIT_MASK 0x2 FORMAT "%13.11" ECU_ADDRESS 0xF0766 /end MEASUREMENT
/begin MEASUREMENT B_sla "" UBYTE B_TRUE 1 100 0.00 1.00000000000 BIT_MASK 0x8 FORMAT "%13.11" ECU_ADDRESS 0xF05E3 /end MEASUREMENT
/begin MEASUREMENT B_slar "" UBYTE B_TRUE 1 100 0.00 1.00000000000 BIT_MASK 0x20 FORMAT "%13.11" ECU_ADDRESS 0xF05E9 /end MEASUREMENT
/begin MEASUREMENT B_slarq "" UBYTE B_TRUE 1 100 0.00 1.00000000000 BIT_MASK 0x40 FORMAT "%13.11" ECU_ADDRESS 0xF05E6 /end MEASUREMENT
/begin MEASUREMENT B_slas "" UBYTE B_TRUE 1 100 0.00 1.00000000000 BIT_MASK 0x10 FORMAT "%13.11" ECU_ADDRESS 0xF05E9 /end MEASUREMENT
/begin MEASUREMENT B_slsofw "" UBYTE B_TRUE 1 100 0.00 1.00000000000 BIT_MASK 0x40 FORMAT "%13.11" ECU_ADDRESS 0xF05E8 /end MEASUREMENT
/begin MEASUREMENT B_sp1 "" UBYTE B_TRUE 1 100 0.00 1.00000000000 BIT_MASK 0x1 FORMAT "%13.11" ECU_ADDRESS 0xF06BE /end MEASUREMENT
/begin MEASUREMENT B_sp2 "" UBYTE B_TRUE 1 100 0.00 1.00000000000 BIT_MASK 0x1 FORMAT "%13.11" ECU_ADDRESS 0xF06BF /end MEASUREMENT
/begin MEASUREMENT B_stdmd "" UWORD B_TRUE 1 100 0.00 1.00000000000 BIT_MASK 0x200 FORMAT "%13.11" ECU_ADDRESS 0xFD3A /end MEASUREMENT
/begin MEASUREMENT B_steigm "" UBYTE B_TRUE 1 100 0.00 1.00000000000 BIT_MASK 0x2 FORMAT "%13.11" ECU_ADDRESS 0xF075B /end MEASUREMENT
/begin MEASUREMENT B_steigm2 "" UBYTE B_TRUE 1 100 0.00 1.00000000000 BIT_MASK 0x20 FORMAT "%13.11" ECU_ADDRESS 0xF075B /end MEASUREMENT
/begin MEASUREMENT B_stpon "" UWORD B_TRUE 1 100 0.00 1.00000000000 BIT_MASK 0x400 FORMAT "%13.11" ECU_ADDRESS 0xFD3A /end MEASUREMENT
/begin MEASUREMENT B_swe "" UWORD B_TRUE 1 100 0.00 1.00000000000 BIT_MASK 0x800 FORMAT "%13.11" ECU_ADDRESS 0xFD3A /end MEASUREMENT
/begin MEASUREMENT B_swe_c "" UWORD B_TRUE 1 100 0.00 1.00000000000 BIT_MASK 0x400 FORMAT "%13.11" ECU_ADDRESS 0xFDB8 /end MEASUREMENT
/begin MEASUREMENT B_switchpg "" UWORD B_TRUE 1 100 0.00 1.00000000000 BIT_MASK 0x2000 FORMAT "%13.11" ECU_ADDRESS 0xFD40 /end MEASUREMENT
/begin MEASUREMENT B_szsls "" UBYTE B_TRUE 1 100 0.00 1.00000000000 BIT_MASK 0x10 FORMAT "%13.11" ECU_ADDRESS 0xF05E6 /end MEASUREMENT
/begin MEASUREMENT B_telshv "" UBYTE B_TRUE 1 100 0.00 1.00000000000 BIT_MASK 0x1 FORMAT "%13.11" ECU_ADDRESS 0xF07E8 /end MEASUREMENT
/begin MEASUREMENT B_telshv2 "" UBYTE B_TRUE 1 100 0.00 1.00000000000 BIT_MASK 0x2 FORMAT "%13.11" ECU_ADDRESS 0xF07E8 /end MEASUREMENT
/begin MEASUREMENT B_teslash "" UBYTE B_TRUE 1 100 0.00 1.00000000000 BIT_MASK 0x4 FORMAT "%13.11" ECU_ADDRESS 0xF0759 /end MEASUREMENT
/begin MEASUREMENT B_teslash2 "" UBYTE B_TRUE 1 100 0.00 1.00000000000 BIT_MASK 0x4 FORMAT "%13.11" ECU_ADDRESS 0xF075A /end MEASUREMENT
/begin MEASUREMENT B_tiab0 "" UBYTE B_TRUE 1 100 0.00 1.00000000000 BIT_MASK 0x1 FORMAT "%13.11" ECU_ADDRESS 0xF06C5 /end MEASUREMENT
/begin MEASUREMENT B_tiab1 "" UBYTE B_TRUE 1 100 0.00 1.00000000000 BIT_MASK 0x2 FORMAT "%13.11" ECU_ADDRESS 0xF06C5 /end MEASUREMENT
/begin MEASUREMENT B_tiab2 "" UBYTE B_TRUE 1 100 0.00 1.00000000000 BIT_MASK 0x4 FORMAT "%13.11" ECU_ADDRESS 0xF06C5 /end MEASUREMENT
/begin MEASUREMENT B_tiab3 "" UBYTE B_TRUE 1 100 0.00 1.00000000000 BIT_MASK 0x8 FORMAT "%13.11" ECU_ADDRESS 0xF06C5 /end MEASUREMENT
/begin MEASUREMENT B_tiab4 "" UBYTE B_TRUE 1 100 0.00 1.00000000000 BIT_MASK 0x10 FORMAT "%13.11" ECU_ADDRESS 0xF06C5 /end MEASUREMENT
/begin MEASUREMENT B_tiab5 "" UBYTE B_TRUE 1 100 0.00 1.00000000000 BIT_MASK 0x20 FORMAT "%13.11" ECU_ADDRESS 0xF06C5 /end MEASUREMENT
/begin MEASUREMENT B_tnalu "" UWORD B_TRUE 1 100 0.00 1.00000000000 BIT_MASK 0x4000 FORMAT "%13.11" ECU_ADDRESS 0xFD3A /end MEASUREMENT
/begin MEASUREMENT B_trfash "" UBYTE B_TRUE 1 100 0.00 1.00000000000 BIT_MASK 0x8 FORMAT "%13.11" ECU_ADDRESS 0xF0759 /end MEASUREMENT
/begin MEASUREMENT B_trfash2 "" UBYTE B_TRUE 1 100 0.00 1.00000000000 BIT_MASK 0x8 FORMAT "%13.11" ECU_ADDRESS 0xF075A /end MEASUREMENT
/begin MEASUREMENT B_trfasla "" UBYTE B_TRUE 1 100 0.00 1.00000000000 BIT_MASK 0x4 FORMAT "%13.11" ECU_ADDRESS 0xF05EE /end MEASUREMENT
/begin MEASUREMENT B_trsah "" UBYTE B_TRUE 1 100 0.00 1.00000000000 BIT_MASK 0x1 FORMAT "%13.11" ECU_ADDRESS 0xF0728 /end MEASUREMENT
/begin MEASUREMENT B_trsah2 "" UBYTE B_TRUE 1 100 0.00 1.00000000000 BIT_MASK 0x1 FORMAT "%13.11" ECU_ADDRESS 0xF0729 /end MEASUREMENT
/begin MEASUREMENT B_trzfasla "" UBYTE B_TRUE 1 100 0.00 1.00000000000 BIT_MASK 0x20 FORMAT "%13.11" ECU_ADDRESS 0xF05EE /end MEASUREMENT
/begin MEASUREMENT B_tsroov "" UWORD B_TRUE 1 100 0.00 1.00000000000 BIT_MASK 0x2000 FORMAT "%13.11" ECU_ADDRESS 0xFD0E /end MEASUREMENT
/begin MEASUREMENT B_ttbmhh "" UWORD B_TRUE 1 100 0.00 1.00000000000 BIT_MASK 0x2 FORMAT "%13.11" ECU_ADDRESS 0xFD4C /end MEASUREMENT
/begin MEASUREMENT B_ttbmhh2 "" UWORD B_TRUE 1 100 0.00 1.00000000000 BIT_MASK 0x4 FORMAT "%13.11" ECU_ADDRESS 0xFD4C /end MEASUREMENT
/begin MEASUREMENT B_tushzfh "" UWORD B_TRUE 1 100 0.00 1.00000000000 BIT_MASK 0x8 FORMAT "%13.11" ECU_ADDRESS 0xFD4C /end MEASUREMENT
/begin MEASUREMENT B_tushzfh2 "" UWORD B_TRUE 1 100 0.00 1.00000000000 BIT_MASK 0x10 FORMAT "%13.11" ECU_ADDRESS 0xFD4C /end MEASUREMENT
/begin MEASUREMENT B_uhsig "" UBYTE B_TRUE 1 100 0.00 1.00000000000 BIT_MASK 0x8 FORMAT "%13.11" ECU_ADDRESS 0xF072A /end MEASUREMENT
/begin MEASUREMENT B_uhsig2 "" UBYTE B_TRUE 1 100 0.00 1.00000000000 BIT_MASK 0x8 FORMAT "%13.11" ECU_ADDRESS 0xF072B /end MEASUREMENT
/begin MEASUREMENT B_uscherf "" UBYTE B_TRUE 1 100 0.00 1.00000000000 BIT_MASK 0x1 FORMAT "%13.11" ECU_ADDRESS 0xF0765 /end MEASUREMENT
/begin MEASUREMENT B_uscherf2 "" UBYTE B_TRUE 1 100 0.00 1.00000000000 BIT_MASK 0x10 FORMAT "%13.11" ECU_ADDRESS 0xF0765 /end MEASUREMENT
/begin MEASUREMENT B_ushkf "" UBYTE B_TRUE 1 100 0.00 1.00000000000 BIT_MASK 0x10 FORMAT "%13.11" ECU_ADDRESS 0xF0759 /end MEASUREMENT
/begin MEASUREMENT B_ushkf2 "" UBYTE B_TRUE 1 100 0.00 1.00000000000 BIT_MASK 0x10 FORMAT "%13.11" ECU_ADDRESS 0xF075A /end MEASUREMENT
/begin MEASUREMENT B_ushkm "" UBYTE B_TRUE 1 100 0.00 1.00000000000 BIT_MASK 0x20 FORMAT "%13.11" ECU_ADDRESS 0xF0759 /end MEASUREMENT
/begin MEASUREMENT B_ushkm2 "" UBYTE B_TRUE 1 100 0.00 1.00000000000 BIT_MASK 0x20 FORMAT "%13.11" ECU_ADDRESS 0xF075A /end MEASUREMENT
/begin MEASUREMENT B_ushkmf "" UBYTE B_TRUE 1 100 0.00 1.00000000000 BIT_MASK 0x8 FORMAT "%13.11" ECU_ADDRESS 0xF0765 /end MEASUREMENT
/begin MEASUREMENT B_ushkmf2 "" UBYTE B_TRUE 1 100 0.00 1.00000000000 BIT_MASK 0x80 FORMAT "%13.11" ECU_ADDRESS 0xF0765 /end MEASUREMENT
/begin MEASUREMENT B_ushkrfm "" UBYTE B_TRUE 1 100 0.00 1.00000000000 BIT_MASK 0x8 FORMAT "%13.11" ECU_ADDRESS 0xF0764 /end MEASUREMENT
/begin MEASUREMENT B_ushkrfm2 "" UBYTE B_TRUE 1 100 0.00 1.00000000000 BIT_MASK 0x80 FORMAT "%13.11" ECU_ADDRESS 0xF0764 /end MEASUREMENT
/begin MEASUREMENT B_ushsch "" UBYTE B_TRUE 1 100 0.00 1.00000000000 BIT_MASK 0x4 FORMAT "%13.11" ECU_ADDRESS 0x384012 /end MEASUREMENT
/begin MEASUREMENT B_ushsch2 "" UBYTE B_TRUE 1 100 0.00 1.00000000000 BIT_MASK 0x8 FORMAT "%13.11" ECU_ADDRESS 0x384012 /end MEASUREMENT
/begin MEASUREMENT B_usrhkmx "" UBYTE B_TRUE 1 100 0.00 1.00000000000 BIT_MASK 0x10 FORMAT "%13.11" ECU_ADDRESS 0x384012 /end MEASUREMENT
/begin MEASUREMENT B_usrhkmx2 "" UBYTE B_TRUE 1 100 0.00 1.00000000000 BIT_MASK 0x20 FORMAT "%13.11" ECU_ADDRESS 0x384012 /end MEASUREMENT
/begin MEASUREMENT B_vereph "" UBYTE B_TRUE 1 100 0.00 1.00000000000 BIT_MASK 0x1 FORMAT "%13.11" ECU_ADDRESS 0x38203D /end MEASUREMENT
/begin MEASUREMENT B_vereph2 "" UBYTE B_TRUE 1 100 0.00 1.00000000000 BIT_MASK 0x2 FORMAT "%13.11" ECU_ADDRESS 0x38203D /end MEASUREMENT
/begin MEASUREMENT B_vlsufm "" UBYTE B_TRUE 1 100 0.00 1.00000000000 BIT_MASK 0x1 FORMAT "%13.11" ECU_ADDRESS 0xF0764 /end MEASUREMENT
/begin MEASUREMENT B_vlsufm2 "" UBYTE B_TRUE 1 100 0.00 1.00000000000 BIT_MASK 0x20 FORMAT "%13.11" ECU_ADDRESS 0xF0764 /end MEASUREMENT
/begin MEASUREMENT B_vlsuftb "" UBYTE B_TRUE 1 100 0.00 1.00000000000 BIT_MASK 0x1 FORMAT "%13.11" ECU_ADDRESS 0x382058 /end MEASUREMENT
/begin MEASUREMENT B_vlsuftb2 "" UBYTE B_TRUE 1 100 0.00 1.00000000000 BIT_MASK 0x10 FORMAT "%13.11" ECU_ADDRESS 0x382058 /end MEASUREMENT
/begin MEASUREMENT B_vlsumrb "" UBYTE B_TRUE 1 100 0.00 1.00000000000 BIT_MASK 0x2 FORMAT "%13.11" ECU_ADDRESS 0x382058 /end MEASUREMENT
/begin MEASUREMENT B_vlsumrb2 "" UBYTE B_TRUE 1 100 0.00 1.00000000000 BIT_MASK 0x20 FORMAT "%13.11" ECU_ADDRESS 0x382058 /end MEASUREMENT
/begin MEASUREMENT B_vlsunp "" UBYTE B_TRUE 1 100 0.00 1.00000000000 BIT_MASK 0x2 FORMAT "%13.11" ECU_ADDRESS 0xF07BB /end MEASUREMENT
/begin MEASUREMENT B_vlsunp2 "" UBYTE B_TRUE 1 100 0.00 1.00000000000 BIT_MASK 0x10 FORMAT "%13.11" ECU_ADDRESS 0xF07BB /end MEASUREMENT
/begin MEASUREMENT B_zagrun "" UWORD B_TRUE 1 100 0.00 1.00000000000 BIT_MASK 0x400 FORMAT "%13.11" ECU_ADDRESS 0xFD3C /end MEASUREMENT
/begin MEASUREMENT B_zagstp "" UWORD B_TRUE 1 100 0.00 1.00000000000 BIT_MASK 0x800 FORMAT "%13.11" ECU_ADDRESS 0xFD3C /end MEASUREMENT
/begin MEASUREMENT B_zlshv "" UBYTE B_TRUE 1 100 0.00 1.00000000000 BIT_MASK 0x10 FORMAT "%13.11" ECU_ADDRESS 0xF072A /end MEASUREMENT
/begin MEASUREMENT B_zlshv2 "" UBYTE B_TRUE 1 100 0.00 1.00000000000 BIT_MASK 0x10 FORMAT "%13.11" ECU_ADDRESS 0xF072B /end MEASUREMENT
/begin MEASUREMENT B_zslsp "" UBYTE B_TRUE 1 100 0.00 1.00000000000 BIT_MASK 0x20 FORMAT "%13.11" ECU_ADDRESS 0xF05EA /end MEASUREMENT
/begin MEASUREMENT B_zslsp2 "" UBYTE B_TRUE 1 100 0.00 1.00000000000 BIT_MASK 0x10 FORMAT "%13.11" ECU_ADDRESS 0xF05EB /end MEASUREMENT
/begin MEASUREMENT B_zslvp "" UBYTE B_TRUE 1 100 0.00 1.00000000000 BIT_MASK 0x4 FORMAT "%13.11" ECU_ADDRESS 0xF05E5 /end MEASUREMENT
/begin MEASUREMENT B_zslvp2 "" UBYTE B_TRUE 1 100 0.00 1.00000000000 BIT_MASK 0x80 FORMAT "%13.11" ECU_ADDRESS 0xF05EB /end MEASUREMENT
/begin MEASUREMENT B_zylind "" UWORD B_TRUE 1 100 0.00 1.00000000000 BIT_MASK 0x2 FORMAT "%13.11" ECU_ADDRESS 0xFD38 /end MEASUREMENT
/begin MEASUREMENT cfof "" UBYTE dez 1 100 0.00 255.0 FORMAT "%5.1" ECU_ADDRESS 0xF06AA /end MEASUREMENT
/begin MEASUREMENT cfoxx "" UBYTE dez 1 100 0.00 255.0 FORMAT "%5.1" ECU_ADDRESS 0xF06A3 /end MEASUREMENT
/begin MEASUREMENT dfrmoff2_w "" SWORD fak_sw_b1 1 100 -1.000000 0.9999695 FORMAT "%8.6" ECU_ADDRESS 0xF4334 /end MEASUREMENT
/begin MEASUREMENT dfrmoff_w "" SWORD fak_sw_b1 1 100 -1.000000 0.9999695 FORMAT "%8.6" ECU_ADDRESS 0xF4336 /end MEASUREMENT
/begin MEASUREMENT dfse "" SWORD luquant 1 100 -161.6879 161.6830 FORMAT "%8.4" ARRAY_SIZE 8 ECU_ADDRESS 0xF1456 /end MEASUREMENT
/begin MEASUREMENT dfseresz "" UBYTE dez 1 100 0.00 255.0 FORMAT "%5.1" ECU_ADDRESS 0x382022 /end MEASUREMENT
/begin MEASUREMENT dlahisa "" UBYTE fak_ub_b0p1_o0p05 1 100 -0.05000 0.04961 FORMAT "%7.5" ECU_ADDRESS 0xF40D0 /end MEASUREMENT
/begin MEASUREMENT dlahisa2 "" UBYTE fak_ub_b0p1_o0p05 1 100 -0.05000 0.04961 FORMAT "%7.5" ECU_ADDRESS 0xF40D1 /end MEASUREMENT
/begin MEASUREMENT dlams2_w "" UWORD fak_uw_b16 1 100 0.00 15.99976 FORMAT "%8.5" ECU_ADDRESS 0xF4484 /end MEASUREMENT
/begin MEASUREMENT dlams_w "" UWORD fak_uw_b16 1 100 0.00 15.99976 FORMAT "%8.5" ECU_ADDRESS 0xF4486 /end MEASUREMENT
/begin MEASUREMENT dlsuvAusbits "" UBYTE dez 1 100 0.00 255.0 FORMAT "%5.1" ECU_ADDRESS 0xF0BA5 /end MEASUREMENT
/begin MEASUREMENT dlues1eAusBits "" UBYTE dez 1 100 0.00 255.0 FORMAT "%5.1" ECU_ADDRESS 0xF088A /end MEASUREMENT
/begin MEASUREMENT dlurs_w "" SWORD luquant 1 100 -161.6879 161.6830 FORMAT "%8.4" ECU_ADDRESS 0xF14FC /end MEASUREMENT
/begin MEASUREMENT dlutsk_w "" SWORD luquant 1 100 -161.6879 161.6830 FORMAT "%8.4" ECU_ADDRESS 0xF153A /end MEASUREMENT
/begin MEASUREMENT dluts_w "" SWORD luquant 1 100 -161.6879 161.6830 FORMAT "%8.4" ECU_ADDRESS 0xF14D6 /end MEASUREMENT
/begin MEASUREMENT dmrlash_w "" UWORD rel_uw_b100 1 100 0.00 99.99847 FORMAT "%8.5" ECU_ADDRESS 0xF4488 /end MEASUREMENT
/begin MEASUREMENT dmrlsh_w "" UWORD rel_uw_b100 1 100 0.00 99.99847 FORMAT "%8.5" ECU_ADDRESS 0xF444A /end MEASUREMENT
/begin MEASUREMENT dmsldrl_w "" UWORD rel_uw_q0p0234 1 100 0.00 1535.977 FORMAT "%8.3" ECU_ADDRESS 0xF4338 /end MEASUREMENT
/begin MEASUREMENT dnwkwNvBits "" UBYTE dez 1 100 0.00 255.0 FORMAT "%5.1" ECU_ADDRESS 0x382041 /end MEASUREMENT
/begin MEASUREMENT dnwszfausbits0 "" UBYTE dez 1 100 0.00 255.0 FORMAT "%5.1" ECU_ADDRESS 0xF0BDC /end MEASUREMENT
/begin MEASUREMENT dphBits "" UBYTE dez 1 100 0.00 255.0 FORMAT "%5.1" ECU_ADDRESS 0xF06FA /end MEASUREMENT
/begin MEASUREMENT DSLSLRSausbits "" UBYTE dez 1 100 0.00 255.0 FORMAT "%5.1" ECU_ADDRESS 0xF05E2 /end MEASUREMENT
/begin MEASUREMENT DSLSLRSausbits2 "" UBYTE dez 1 100 0.00 255.0 FORMAT "%5.1" ECU_ADDRESS 0xF05E3 /end MEASUREMENT
/begin MEASUREMENT DSLSLRSausbits3 "" UBYTE dez 1 100 0.00 255.0 FORMAT "%5.1" ECU_ADDRESS 0xF05E4 /end MEASUREMENT
/begin MEASUREMENT DSLSLRSLokBits1 "" UBYTE dez 1 100 0.00 255.0 FORMAT "%5.1" ECU_ADDRESS 0xF05E5 /end MEASUREMENT
/begin MEASUREMENT DSLSLRSLokBits1a "" UBYTE dez 1 100 0.00 255.0 FORMAT "%5.1" ECU_ADDRESS 0xF05E6 /end MEASUREMENT
/begin MEASUREMENT DSLSLRSLokBits2 "" UBYTE dez 1 100 0.00 255.0 FORMAT "%5.1" ECU_ADDRESS 0xF05E7 /end MEASUREMENT
/begin MEASUREMENT DSLSLRSLokBits2a "" UBYTE dez 1 100 0.00 255.0 FORMAT "%5.1" ECU_ADDRESS 0xF05E8 /end MEASUREMENT
/begin MEASUREMENT DSLSLRSLokBits3 "" UBYTE dez 1 100 0.00 255.0 FORMAT "%5.1" ECU_ADDRESS 0xF05E9 /end MEASUREMENT
/begin MEASUREMENT DSLSLRSLokBits3a "" UBYTE dez 1 100 0.00 255.0 FORMAT "%5.1" ECU_ADDRESS 0xF05EA /end MEASUREMENT
/begin MEASUREMENT DSLSLRSLokBits4 "" UBYTE dez 1 100 0.00 255.0 FORMAT "%5.1" ECU_ADDRESS 0xF05EB /end MEASUREMENT
/begin MEASUREMENT DSLSLRSLokBits4a "" UBYTE dez 1 100 0.00 255.0 FORMAT "%5.1" ECU_ADDRESS 0xF05EC /end MEASUREMENT
/begin MEASUREMENT DSLSLRSLokBits5 "" UBYTE dez 1 100 0.00 255.0 FORMAT "%5.1" ECU_ADDRESS 0xF05ED /end MEASUREMENT
/begin MEASUREMENT DSLSLRSLokBits5a "" UBYTE dez 1 100 0.00 255.0 FORMAT "%5.1" ECU_ADDRESS 0xF05EE /end MEASUREMENT
/begin MEASUREMENT DSLSLRSLokBits_6 "" UBYTE dez 1 100 0.00 255.0 FORMAT "%5.1" ECU_ADDRESS 0xF05EF /end MEASUREMENT
/begin MEASUREMENT dwnwdmxa_w "" UWORD kw_uw_q0p0078 1 100 0.00 511.9922 FORMAT "%8.4" ECU_ADDRESS 0xF4FA0 /end MEASUREMENT
/begin MEASUREMENT dwnwdmxe_w "" UWORD kw_uw_q0p0078 1 100 0.00 511.9922 FORMAT "%8.4" ECU_ADDRESS 0xF4F7A /end MEASUREMENT
/begin MEASUREMENT dwnwfda_w "" SWORD kw_sw_q0p0078 1 100 -256.0000 255.9922 FORMAT "%8.4" ECU_ADDRESS 0xF4FA2 /end MEASUREMENT
/begin MEASUREMENT dwnwfde_w "" SWORD kw_sw_q0p0078 1 100 -256.0000 255.9922 FORMAT "%8.4" ECU_ADDRESS 0xF4F7C /end MEASUREMENT
/begin MEASUREMENT dwnwsp2_w "" SWORD kw_q0p0156 1 100 -512.0000 511.9844 FORMAT "%8.4" ECU_ADDRESS 0xF441A /end MEASUREMENT
/begin MEASUREMENT dwnwsp_w "" SWORD kw_q0p0156 1 100 -512.0000 511.9844 FORMAT "%8.4" ECU_ADDRESS 0xF441C /end MEASUREMENT
/begin MEASUREMENT dynlsusa "" UBYTE fak_q0p0195 1 100 0.00 4.980 FORMAT "%5.3" ECU_ADDRESS 0xF40D2 /end MEASUREMENT
/begin MEASUREMENT dynlsusa2 "" UBYTE fak_q0p0195 1 100 0.00 4.980 FORMAT "%5.3" ECU_ADDRESS 0xF40D3 /end MEASUREMENT
/begin MEASUREMENT famal "" UBYTE fak_ub_b1 1 100 0.00 0.9961 ECU_ADDRESS 0xF403F /end MEASUREMENT
/begin MEASUREMENT fanalun "" UBYTE dez 1 100 0.00 255.0 FORMAT "%5.1" ECU_ADDRESS 0xF06B2 /end MEASUREMENT
/begin MEASUREMENT favralu "" UBYTE dez 1 100 0.00 255.0 FORMAT "%5.1" ECU_ADDRESS 0xF06B1 /end MEASUREMENT
/begin MEASUREMENT fdmd "" UBYTE dez 1 100 0.00 255.0 FORMAT "%5.1" ECU_ADDRESS 0xF06C7 /end MEASUREMENT
/begin MEASUREMENT ffof1 "" UBYTE dez 1 100 0.00 255.0 FORMAT "%5.1" ECU_ADDRESS 0xF06C8 /end MEASUREMENT
/begin MEASUREMENT ffof2 "" UBYTE dez 1 100 0.00 255.0 FORMAT "%5.1" ECU_ADDRESS 0xF06C9 /end MEASUREMENT
/begin MEASUREMENT ffon1 "" UBYTE dez 1 100 0.00 255.0 FORMAT "%5.1" ECU_ADDRESS 0xF06CA /end MEASUREMENT
/begin MEASUREMENT ffon2 "" UBYTE dez 1 100 0.00 255.0 FORMAT "%5.1" ECU_ADDRESS 0xF06CB /end MEASUREMENT
/begin MEASUREMENT fivzabg "" UBYTE dez 1 100 0.00 255.0 FORMAT "%5.1" ECU_ADDRESS 0xF06C4 /end MEASUREMENT
/begin MEASUREMENT flg "" UBYTE dez 1 100 0.00 255.0 FORMAT "%5.1" ECU_ADDRESS 0xF06CC /end MEASUREMENT
/begin MEASUREMENT flgkat_w "" UWORD dez 1 100 0.00 65535.00 FORMAT "%8.2" ECU_ADDRESS 0xF1562 /end MEASUREMENT
/begin MEASUREMENT flgstign_w "" UWORD dez 1 100 0.00 65535.00 FORMAT "%8.2" ECU_ADDRESS 0xF15B2 /end MEASUREMENT
/begin MEASUREMENT flgstinj_w "" UWORD dez 1 100 0.00 65535.00 FORMAT "%8.2" ECU_ADDRESS 0xF15B4 /end MEASUREMENT
/begin MEASUREMENT flgst_w "" UWORD dez 1 100 0.00 65535.00 FORMAT "%8.2" ECU_ADDRESS 0xF15B6 /end MEASUREMENT
/begin MEASUREMENT flgtiab "" UBYTE dez 1 100 0.00 255.0 FORMAT "%5.1" ECU_ADDRESS 0xF06C5 /end MEASUREMENT
/begin MEASUREMENT flmxof_w "" UWORD kw_dmdfof2 1 100 0.00 239.9963 FORMAT "%8.4" ECU_ADDRESS 0xF14A4 /end MEASUREMENT
/begin MEASUREMENT flmx_w "" UWORD luquant 1 100 0.00 323.3710 FORMAT "%8.4" ECU_ADDRESS 0xF1466 /end MEASUREMENT
/begin MEASUREMENT fln0 "" SWORD luquant 1 100 -161.6879 161.6830 FORMAT "%8.4" ARRAY_SIZE 24 ECU_ADDRESS 0x38217C /end MEASUREMENT
/begin MEASUREMENT fln1 "" SWORD luquant 1 100 -161.6879 161.6830 FORMAT "%8.4" ARRAY_SIZE 24 ECU_ADDRESS 0x3821DC /end MEASUREMENT
/begin MEASUREMENT fln2 "" SWORD luquant 1 100 -161.6879 161.6830 FORMAT "%8.4" ARRAY_SIZE 24 ECU_ADDRESS 0x38223C /end MEASUREMENT
/begin MEASUREMENT fln3 "" SWORD luquant 1 100 -161.6879 161.6830 FORMAT "%8.4" ARRAY_SIZE 24 ECU_ADDRESS 0x38229C /end MEASUREMENT
/begin MEASUREMENT fln4 "" SWORD luquant 1 100 -161.6879 161.6830 FORMAT "%8.4" ARRAY_SIZE 24 ECU_ADDRESS 0x3822FC /end MEASUREMENT
/begin MEASUREMENT fln5 "" SWORD luquant 1 100 -161.6879 161.6830 FORMAT "%8.4" ARRAY_SIZE 24 ECU_ADDRESS 0x38235C /end MEASUREMENT
/begin MEASUREMENT flnof1 "" SWORD kw_dmdfof2 1 100 -120.0000 119.9963 FORMAT "%8.4" ARRAY_SIZE 4 ECU_ADDRESS 0x38295E /end MEASUREMENT
/begin MEASUREMENT flnof2 "" SWORD kw_dmdfof2 1 100 -120.0000 119.9963 FORMAT "%8.4" ARRAY_SIZE 4 ECU_ADDRESS 0x38296E /end MEASUREMENT
/begin MEASUREMENT flnof3 "" SWORD kw_dmdfof2 1 100 -120.0000 119.9963 FORMAT "%8.4" ARRAY_SIZE 4 ECU_ADDRESS 0x38297E /end MEASUREMENT
/begin MEASUREMENT flnof4 "" SWORD kw_dmdfof2 1 100 -120.0000 119.9963 FORMAT "%8.4" ARRAY_SIZE 4 ECU_ADDRESS 0x38298E /end MEASUREMENT
/begin MEASUREMENT flnof5 "" SWORD kw_dmdfof2 1 100 -120.0000 119.9963 FORMAT "%8.4" ARRAY_SIZE 4 ECU_ADDRESS 0x38299E /end MEASUREMENT
/begin MEASUREMENT flp0 "" SWORD luquant 1 100 -161.6879 161.6830 FORMAT "%8.4" ARRAY_SIZE 24 ECU_ADDRESS 0x3823BC /end MEASUREMENT
/begin MEASUREMENT flp1 "" SWORD luquant 1 100 -161.6879 161.6830 FORMAT "%8.4" ARRAY_SIZE 24 ECU_ADDRESS 0x38241C /end MEASUREMENT
/begin MEASUREMENT flp2 "" SWORD luquant 1 100 -161.6879 161.6830 FORMAT "%8.4" ARRAY_SIZE 24 ECU_ADDRESS 0x38247C /end MEASUREMENT
/begin MEASUREMENT flp3 "" SWORD luquant 1 100 -161.6879 161.6830 FORMAT "%8.4" ARRAY_SIZE 24 ECU_ADDRESS 0x3824DC /end MEASUREMENT
/begin MEASUREMENT flp4 "" SWORD luquant 1 100 -161.6879 161.6830 FORMAT "%8.4" ARRAY_SIZE 24 ECU_ADDRESS 0x38253C /end MEASUREMENT
/begin MEASUREMENT flp5 "" SWORD luquant 1 100 -161.6879 161.6830 FORMAT "%8.4" ARRAY_SIZE 24 ECU_ADDRESS 0x38259C /end MEASUREMENT
/begin MEASUREMENT flpof1 "" SWORD kw_dmdfof2 1 100 -120.0000 119.9963 FORMAT "%8.4" ARRAY_SIZE 4 ECU_ADDRESS 0x3829AE /end MEASUREMENT
/begin MEASUREMENT flpof2 "" SWORD kw_dmdfof2 1 100 -120.0000 119.9963 FORMAT "%8.4" ARRAY_SIZE 4 ECU_ADDRESS 0x3829BE /end MEASUREMENT
/begin MEASUREMENT flpof3 "" SWORD kw_dmdfof2 1 100 -120.0000 119.9963 FORMAT "%8.4" ARRAY_SIZE 4 ECU_ADDRESS 0x3829CE /end MEASUREMENT
/begin MEASUREMENT flpof4 "" SWORD kw_dmdfof2 1 100 -120.0000 119.9963 FORMAT "%8.4" ARRAY_SIZE 4 ECU_ADDRESS 0x3829DE /end MEASUREMENT
/begin MEASUREMENT flpof5 "" SWORD kw_dmdfof2 1 100 -120.0000 119.9963 FORMAT "%8.4" ARRAY_SIZE 4 ECU_ADDRESS 0x3829EE /end MEASUREMENT
/begin MEASUREMENT flurb_w "" SWORD luquant 1 100 -161.6879 161.6830 FORMAT "%8.4" ECU_ADDRESS 0xF43EA /end MEASUREMENT
/begin MEASUREMENT flurktm_w "" SWORD luquant 1 100 -161.6879 161.6830 FORMAT "%8.4" ECU_ADDRESS 0xF43EC /end MEASUREMENT
/begin MEASUREMENT flurmin_w "" SWORD luquant 1 100 -161.6879 161.6830 FORMAT "%8.4" ECU_ADDRESS 0xF1502 /end MEASUREMENT
/begin MEASUREMENT flutskzy_w "" SWORD luquant 1 100 -161.6879 161.6830 FORMAT "%8.4" ARRAY_SIZE 6 ECU_ADDRESS 0xF153C /end MEASUREMENT
/begin MEASUREMENT flutsk_w "" SWORD luquant 1 100 -161.6879 161.6830 FORMAT "%8.4" ECU_ADDRESS 0xF1548 /end MEASUREMENT
/begin MEASUREMENT flutszyl_w "" SWORD luquant 1 100 -161.6879 161.6830 FORMAT "%8.4" ARRAY_SIZE 6 ECU_ADDRESS 0xF14D8 /end MEASUREMENT
/begin MEASUREMENT fluts_w "" SWORD luquant 1 100 -161.6879 161.6830 FORMAT "%8.4" ECU_ADDRESS 0xF14E4 /end MEASUREMENT
/begin MEASUREMENT fmsla "" UBYTE fak_ub_b2 1 100 0.00 1.992 FORMAT "%5.3" ECU_ADDRESS 0xF4014 /end MEASUREMENT
/begin MEASUREMENT fmsla2 "" UBYTE fak_ub_b2 1 100 0.00 1.992 FORMAT "%5.3" ECU_ADDRESS 0xF4015 /end MEASUREMENT
/begin MEASUREMENT fmslav "" UBYTE fak_ub_b2 1 100 0.00 1.992 FORMAT "%5.3" ECU_ADDRESS 0x382015 /end MEASUREMENT
/begin MEASUREMENT fmslav2 "" UBYTE fak_ub_b2 1 100 0.00 1.992 FORMAT "%5.3" ECU_ADDRESS 0x382016 /end MEASUREMENT
/begin MEASUREMENT fofresz "" UBYTE dez 1 100 0.00 255.0 FORMAT "%5.1" ECU_ADDRESS 0x38202A /end MEASUREMENT
/begin MEASUREMENT fofstat "" UBYTE dez 1 100 0.00 255.0 FORMAT "%5.1" ECU_ADDRESS 0xF06AB /end MEASUREMENT
/begin MEASUREMENT fonstat "" UBYTE dez 1 100 0.00 255.0 FORMAT "%5.1" ECU_ADDRESS 0xF06A4 /end MEASUREMENT
/begin MEASUREMENT forbits1 "" UBYTE dez 1 100 0.00 255.0 FORMAT "%5.1" ECU_ADDRESS 0x382023 /end MEASUREMENT
/begin MEASUREMENT forbits2 "" UBYTE dez 1 100 0.00 255.0 FORMAT "%5.1" ECU_ADDRESS 0x382024 /end MEASUREMENT
/begin MEASUREMENT forbits3 "" UBYTE dez 1 100 0.00 255.0 FORMAT "%5.1" ECU_ADDRESS 0x382025 /end MEASUREMENT
/begin MEASUREMENT fornbits "" UBYTE dez 1 100 0.00 255.0 FORMAT "%5.1" ECU_ADDRESS 0x382026 /end MEASUREMENT
/begin MEASUREMENT frm2frz_w "" UWORD fak_uw_b2 1 100 0.00 1.999969 FORMAT "%8.6" ECU_ADDRESS 0xF433A /end MEASUREMENT
/begin MEASUREMENT frmfrz_w "" UWORD fak_uw_b2 1 100 0.00 1.999969 FORMAT "%8.6" ECU_ADDRESS 0xF433C /end MEASUREMENT
/begin MEASUREMENT frmshv2_w "" UWORD fak_uw_b2 1 100 0.00 1.999969 FORMAT "%8.6" ECU_ADDRESS 0xF4536 /end MEASUREMENT
/begin MEASUREMENT frmshv_w "" UWORD fak_uw_b2 1 100 0.00 1.999969 FORMAT "%8.6" ECU_ADDRESS 0xF4538 /end MEASUREMENT
/begin MEASUREMENT fs0 "" SWORD luquant 1 100 -161.6879 161.6830 FORMAT "%8.4" ARRAY_SIZE 24 ECU_ADDRESS 0x3825FC /end MEASUREMENT
/begin MEASUREMENT fs1 "" SWORD luquant 1 100 -161.6879 161.6830 FORMAT "%8.4" ARRAY_SIZE 24 ECU_ADDRESS 0x38265C /end MEASUREMENT
/begin MEASUREMENT fs2 "" SWORD luquant 1 100 -161.6879 161.6830 FORMAT "%8.4" ARRAY_SIZE 24 ECU_ADDRESS 0x3826BC /end MEASUREMENT
/begin MEASUREMENT fs3 "" SWORD luquant 1 100 -161.6879 161.6830 FORMAT "%8.4" ARRAY_SIZE 24 ECU_ADDRESS 0x38271C /end MEASUREMENT
/begin MEASUREMENT fs4 "" SWORD luquant 1 100 -161.6879 161.6830 FORMAT "%8.4" ARRAY_SIZE 24 ECU_ADDRESS 0x38277C /end MEASUREMENT
/begin MEASUREMENT fs5 "" SWORD luquant 1 100 -161.6879 161.6830 FORMAT "%8.4" ARRAY_SIZE 24 ECU_ADDRESS 0x3827DC /end MEASUREMENT
/begin MEASUREMENT fse0 "" SWORD luquant 1 100 -161.6879 161.6830 FORMAT "%8.4" ARRAY_SIZE 24 ECU_ADDRESS 0x38283C /end MEASUREMENT
/begin MEASUREMENT fse1 "" SWORD luquant 1 100 -161.6879 161.6830 FORMAT "%8.4" ARRAY_SIZE 24 ECU_ADDRESS 0x38286C /end MEASUREMENT
/begin MEASUREMENT fse2 "" SWORD luquant 1 100 -161.6879 161.6830 FORMAT "%8.4" ARRAY_SIZE 24 ECU_ADDRESS 0x38289C /end MEASUREMENT
/begin MEASUREMENT fse3 "" SWORD luquant 1 100 -161.6879 161.6830 FORMAT "%8.4" ARRAY_SIZE 24 ECU_ADDRESS 0x3828CC /end MEASUREMENT
/begin MEASUREMENT fse4 "" SWORD luquant 1 100 -161.6879 161.6830 FORMAT "%8.4" ARRAY_SIZE 24 ECU_ADDRESS 0x3828FC /end MEASUREMENT
/begin MEASUREMENT fse5 "" SWORD luquant 1 100 -161.6879 161.6830 FORMAT "%8.4" ARRAY_SIZE 24 ECU_ADDRESS 0x38292C /end MEASUREMENT
/begin MEASUREMENT fseof1 "" UWORD kw_dmdfof1 1 100 -120.0000 119.9963 FORMAT "%8.4" ARRAY_SIZE 4 ECU_ADDRESS 0x3829FE /end MEASUREMENT
/begin MEASUREMENT fseof2 "" UWORD kw_dmdfof1 1 100 -120.0000 119.9963 FORMAT "%8.4" ARRAY_SIZE 4 ECU_ADDRESS 0x382A06 /end MEASUREMENT
/begin MEASUREMENT fseof3 "" UWORD kw_dmdfof1 1 100 -120.0000 119.9963 FORMAT "%8.4" ARRAY_SIZE 4 ECU_ADDRESS 0x382A0E /end MEASUREMENT
/begin MEASUREMENT fseof4 "" UWORD kw_dmdfof1 1 100 -120.0000 119.9963 FORMAT "%8.4" ARRAY_SIZE 4 ECU_ADDRESS 0x382A16 /end MEASUREMENT
/begin MEASUREMENT fseof5 "" UWORD kw_dmdfof1 1 100 -120.0000 119.9963 FORMAT "%8.4" ARRAY_SIZE 4 ECU_ADDRESS 0x382A1E /end MEASUREMENT
/begin MEASUREMENT fseof_w "" UWORD kw_dmdfof1 1 100 -120.0000 119.9963 FORMAT "%8.4" ECU_ADDRESS 0xF14A6 /end MEASUREMENT
/begin MEASUREMENT fse_w "" SWORD luquant 1 100 -161.6879 161.6830 FORMAT "%8.4" ECU_ADDRESS 0xF1468 /end MEASUREMENT
/begin MEASUREMENT fsof1 "" UWORD kw_dmdfof1 1 100 -120.0000 119.9963 FORMAT "%8.4" ARRAY_SIZE 4 ECU_ADDRESS 0x382A26 /end MEASUREMENT
/begin MEASUREMENT fsof2 "" UWORD kw_dmdfof1 1 100 -120.0000 119.9963 FORMAT "%8.4" ARRAY_SIZE 4 ECU_ADDRESS 0x382A36 /end MEASUREMENT
/begin MEASUREMENT fsof3 "" UWORD kw_dmdfof1 1 100 -120.0000 119.9963 FORMAT "%8.4" ARRAY_SIZE 4 ECU_ADDRESS 0x382A46 /end MEASUREMENT
/begin MEASUREMENT fsof4 "" UWORD kw_dmdfof1 1 100 -120.0000 119.9963 FORMAT "%8.4" ARRAY_SIZE 4 ECU_ADDRESS 0x382A56 /end MEASUREMENT
/begin MEASUREMENT fsof5 "" UWORD kw_dmdfof1 1 100 -120.0000 119.9963 FORMAT "%8.4" ARRAY_SIZE 4 ECU_ADDRESS 0x382A66 /end MEASUREMENT
/begin MEASUREMENT fswares "" UBYTE acc_ub_b55p55 1 100 0.00 55.34 FORMAT "%5.2" ECU_ADDRESS 0xF0BA7 /end MEASUREMENT
/begin MEASUREMENT fzabgs_w "" UWORD dez 1 100 0.00 65535.00 FORMAT "%8.2" ECU_ADDRESS 0xF1564 /end MEASUREMENT
/begin MEASUREMENT fzabg_w "" UWORD dez 1 100 0.00 65535.00 FORMAT "%8.2" ARRAY_SIZE 6 ECU_ADDRESS 0xF1566 /end MEASUREMENT
/begin MEASUREMENT fzarv_w "" UWORD dez 1 100 0.00 65535.00 FORMAT "%8.2" ECU_ADDRESS 0xF1572 /end MEASUREMENT
/begin MEASUREMENT fzkats1_w "" UWORD dez 1 100 0.00 65535.00 FORMAT "%8.2" ECU_ADDRESS 0xF1574 /end MEASUREMENT
/begin MEASUREMENT fzkats2_w "" UWORD dez 1 100 0.00 65535.00 FORMAT "%8.2" ECU_ADDRESS 0xF1576 /end MEASUREMENT
/begin MEASUREMENT fzkats_w "" UWORD dez 1 100 0.00 65535.00 FORMAT "%8.2" ECU_ADDRESS 0xF1578 /end MEASUREMENT
/begin MEASUREMENT fzkat_w "" UWORD dez 1 100 0.00 65535.00 FORMAT "%8.2" ARRAY_SIZE 6 ECU_ADDRESS 0xF157A /end MEASUREMENT
/begin MEASUREMENT fzmd "" UWORD dez 1 100 0.00 65535.00 FORMAT "%8.2" ARRAY_SIZE 6 ECU_ADDRESS 0x382A7A /end MEASUREMENT
/begin MEASUREMENT idxfob "" UBYTE dez 1 100 0.00 255.0 FORMAT "%5.1" ECU_ADDRESS 0xF06A5 /end MEASUREMENT
/begin MEASUREMENT idxfofl "" UBYTE dez 1 100 0.00 255.0 FORMAT "%5.1" ECU_ADDRESS 0xF06AC /end MEASUREMENT
/begin MEASUREMENT idxfofn "" UBYTE dez 1 100 0.00 255.0 FORMAT "%5.1" ECU_ADDRESS 0xF06AD /end MEASUREMENT
/begin MEASUREMENT idxfol "" UBYTE dez 1 100 0.00 255.0 FORMAT "%5.1" ECU_ADDRESS 0xF06A6 /end MEASUREMENT
/begin MEASUREMENT idxfomi "" UBYTE dez 1 100 0.00 255.0 FORMAT "%5.1" ECU_ADDRESS 0xF06A7 /end MEASUREMENT
/begin MEASUREMENT idxfon "" UBYTE dez 1 100 0.00 255.0 FORMAT "%5.1" ECU_ADDRESS 0xF06A8 /end MEASUREMENT
/begin MEASUREMENT ignitioz_w "" UWORD dez 1 100 0.00 65535.00 FORMAT "%8.2" ECU_ADDRESS 0xF15B8 /end MEASUREMENT
/begin MEASUREMENT imlfta2_w "" UWORD m_q2p777Em5_kg 1 100 0.00 1.820417 FORMAT "%8.6" ECU_ADDRESS 0xF4506 /end MEASUREMENT
/begin MEASUREMENT imlfta_w "" UWORD m_q2p777Em5_kg 1 100 0.00 1.820417 FORMAT "%8.6" ECU_ADDRESS 0xF4508 /end MEASUREMENT
/begin MEASUREMENT imlftb2_w "" UWORD m_q2p777Em5_kg 1 100 0.00 1.820417 FORMAT "%8.6" ECU_ADDRESS 0x384064 /end MEASUREMENT
/begin MEASUREMENT imlftb_w "" UWORD m_q2p777Em5_kg 1 100 0.00 1.820417 FORMAT "%8.6" ECU_ADDRESS 0x384066 /end MEASUREMENT
/begin MEASUREMENT imlmra2_w "" UWORD m_q2p777Em5_kg 1 100 0.00 1.820417 FORMAT "%8.6" ECU_ADDRESS 0xF450A /end MEASUREMENT
/begin MEASUREMENT imlmra_w "" UWORD m_q2p777Em5_kg 1 100 0.00 1.820417 FORMAT "%8.6" ECU_ADDRESS 0xF450C /end MEASUREMENT
/begin MEASUREMENT imlmrb2_w "" UWORD m_q2p777Em5_kg 1 100 0.00 1.820417 FORMAT "%8.6" ECU_ADDRESS 0x384068 /end MEASUREMENT
/begin MEASUREMENT imlmrb_w "" UWORD m_q2p777Em5_kg 1 100 0.00 1.820417 FORMAT "%8.6" ECU_ADDRESS 0x38406A /end MEASUREMENT
/begin MEASUREMENT imlplhe2_w "" UWORD m_q2p777Em5_kg 1 100 0.00 1.820417 FORMAT "%8.6" ECU_ADDRESS 0xF450E /end MEASUREMENT
/begin MEASUREMENT imlplhe_w "" UWORD m_q2p777Em5_kg 1 100 0.00 1.820417 FORMAT "%8.6" ECU_ADDRESS 0xF4510 /end MEASUREMENT
/begin MEASUREMENT intlash2_w "" UWORD fak_uw_b16 1 100 0.00 15.99976 FORMAT "%8.5" ECU_ADDRESS 0xF448A /end MEASUREMENT
/begin MEASUREMENT intlash_w "" UWORD fak_uw_b16 1 100 0.00 15.99976 FORMAT "%8.5" ECU_ADDRESS 0xF448C /end MEASUREMENT
/begin MEASUREMENT ivzabg_w "" UWORD dez 1 100 0.00 65535.00 FORMAT "%8.2" ECU_ADDRESS 0xF1586 /end MEASUREMENT
/begin MEASUREMENT ivzaint_w "" UWORD dez 1 100 0.00 65535.00 FORMAT "%8.2" ECU_ADDRESS 0xF1588 /end MEASUREMENT
/begin MEASUREMENT ivzarv_w "" UWORD dez 1 100 0.00 65535.00 FORMAT "%8.2" ECU_ADDRESS 0xF158A /end MEASUREMENT
/begin MEASUREMENT ivzkat_w "" UWORD dez 1 100 0.00 65535.00 FORMAT "%8.2" ECU_ADDRESS 0xF158C /end MEASUREMENT
/begin MEASUREMENT kswf "" UBYTE dez 1 100 0.00 255.0 FORMAT "%5.1" ECU_ADDRESS 0xF06C6 /end MEASUREMENT
/begin MEASUREMENT lamelsh2_w "" UWORD fak_uw_b16 1 100 0.00 15.99976 FORMAT "%8.5" ECU_ADDRESS 0xF181A /end MEASUREMENT
/begin MEASUREMENT lamelsh_w "" UWORD fak_uw_b16 1 100 0.00 15.99976 FORMAT "%8.5" ECU_ADDRESS 0xF181C /end MEASUREMENT
/begin MEASUREMENT lamfrmv2_w "" UWORD fak_uw_b16 1 100 0.00 15.99976 FORMAT "%8.5" ECU_ADDRESS 0xF453A /end MEASUREMENT
/begin MEASUREMENT lamfrmv_w "" UWORD fak_uw_b16 1 100 0.00 15.99976 FORMAT "%8.5" ECU_ADDRESS 0xF453C /end MEASUREMENT
/begin MEASUREMENT lamlash2_w "" UWORD fak_uw_b16 1 100 0.00 15.99976 FORMAT "%8.5" ECU_ADDRESS 0xF448E /end MEASUREMENT
/begin MEASUREMENT lamlash_w "" UWORD fak_uw_b16 1 100 0.00 15.99976 FORMAT "%8.5" ECU_ADDRESS 0xF4490 /end MEASUREMENT
/begin MEASUREMENT lamlshv2_w "" UWORD fak_uw_b16 1 100 0.00 15.99976 FORMAT "%8.5" ECU_ADDRESS 0xF1A4E /end MEASUREMENT
/begin MEASUREMENT lamlshv_w "" UWORD fak_uw_b16 1 100 0.00 15.99976 FORMAT "%8.5" ECU_ADDRESS 0xF1A50 /end MEASUREMENT
/begin MEASUREMENT lamsisa "" UBYTE fak_ub_b2 1 100 0.00 1.992 FORMAT "%5.3" ECU_ADDRESS 0xF40D4 /end MEASUREMENT
/begin MEASUREMENT lamsisa2 "" UBYTE fak_ub_b2 1 100 0.00 1.992 FORMAT "%5.3" ECU_ADDRESS 0xF40D5 /end MEASUREMENT
/begin MEASUREMENT lamsosa "" UBYTE fak_ub_b2 1 100 0.00 1.992 FORMAT "%5.3" ECU_ADDRESS 0xF40D6 /end MEASUREMENT
/begin MEASUREMENT lamsosa2 "" UBYTE fak_ub_b2 1 100 0.00 1.992 FORMAT "%5.3" ECU_ADDRESS 0xF40D7 /end MEASUREMENT
/begin MEASUREMENT lamtrip2_w "" UWORD fak_uw_b16 1 100 0.00 15.99976 FORMAT "%8.5" ECU_ADDRESS 0xF4492 /end MEASUREMENT
/begin MEASUREMENT lamtrip_w "" UWORD fak_uw_b16 1 100 0.00 15.99976 FORMAT "%8.5" ECU_ADDRESS 0xF4494 /end MEASUREMENT
/begin MEASUREMENT lastmodz_w "" UWORD dez 1 100 0.00 65535.00 FORMAT "%8.2" ECU_ADDRESS 0xF15BA /end MEASUREMENT
/begin MEASUREMENT lokBits_anwsea "" UBYTE dez 1 100 0.00 255.0 FORMAT "%5.1" ECU_ADDRESS 0xF41A8 /end MEASUREMENT
/begin MEASUREMENT lokBits_enwsea "" UBYTE dez 1 100 0.00 255.0 FORMAT "%5.1" ECU_ADDRESS 0xF41A4 /end MEASUREMENT
/begin MEASUREMENT luarmn_w "" SWORD luquant 1 100 -161.6879 161.6830 FORMAT "%8.4" ECU_ADDRESS 0xF151E /end MEASUREMENT
/begin MEASUREMENT luaroff_w "" UWORD luquant 1 100 0.00 323.3710 FORMAT "%8.4" ECU_ADDRESS 0xF1520 /end MEASUREMENT
/begin MEASUREMENT luar_w "" SWORD luquant 1 100 -161.6879 161.6830 FORMAT "%8.4" ECU_ADDRESS 0xF1522 /end MEASUREMENT
/begin MEASUREMENT lums_w "" SWORD luquant 1 100 -161.6879 161.6830 FORMAT "%8.4" ECU_ADDRESS 0xF1504 /end MEASUREMENT
/begin MEASUREMENT lunw_w "" UWORD luquant 1 100 0.00 323.3710 FORMAT "%8.4" ECU_ADDRESS 0xF14E6 /end MEASUREMENT
/begin MEASUREMENT lurms_w "" SWORD luquant 1 100 -161.6879 161.6830 FORMAT "%8.4" ECU_ADDRESS 0xF1506 /end MEASUREMENT
/begin MEASUREMENT lurs_w "" SWORD luquant 1 100 -161.6879 161.6830 FORMAT "%8.4" ECU_ADDRESS 0xF1508 /end MEASUREMENT
/begin MEASUREMENT lutskzyl_w "" SWORD luquant 1 100 -161.6879 161.6830 FORMAT "%8.4" ARRAY_SIZE 6 ECU_ADDRESS 0xF154A /end MEASUREMENT
/begin MEASUREMENT lutsk_w "" SWORD luquant 1 100 -161.6879 161.6830 FORMAT "%8.4" ECU_ADDRESS 0xF1556 /end MEASUREMENT
/begin MEASUREMENT lutszyl_w "" SWORD luquant 1 100 -161.6879 161.6830 FORMAT "%8.4" ARRAY_SIZE 6 ECU_ADDRESS 0xF14E8 /end MEASUREMENT
/begin MEASUREMENT luts_w "" SWORD luquant 1 100 -161.6879 161.6830 FORMAT "%8.4" ECU_ADDRESS 0xF14F4 /end MEASUREMENT
/begin MEASUREMENT m6amsl "" UBYTE dez 1 100 0.00 255.0 FORMAT "%5.1" ECU_ADDRESS 0x382017 /end MEASUREMENT
/begin MEASUREMENT m6cmsl "" UBYTE dez 1 100 0.00 255.0 FORMAT "%5.1" ECU_ADDRESS 0x382018 /end MEASUREMENT
/begin MEASUREMENT m6cmsl2 "" UBYTE dez 1 100 0.00 255.0 FORMAT "%5.1" ECU_ADDRESS 0x382019 /end MEASUREMENT
/begin MEASUREMENT m6cmslv "" UBYTE dez 1 100 0.00 255.0 FORMAT "%5.1" ECU_ADDRESS 0x38201A /end MEASUREMENT
/begin MEASUREMENT m6cmslv2 "" UBYTE dez 1 100 0.00 255.0 FORMAT "%5.1" ECU_ADDRESS 0x38201B /end MEASUREMENT
/begin MEASUREMENT m6smsl2_w "" UWORD dez 1 100 0.00 65535.00 FORMAT "%8.2" ECU_ADDRESS 0x38216C /end MEASUREMENT
/begin MEASUREMENT m6smslv2_w "" UWORD dez 1 100 0.00 65535.00 FORMAT "%8.2" ECU_ADDRESS 0x38216E /end MEASUREMENT
/begin MEASUREMENT m6smslv_w "" UWORD dez 1 100 0.00 65535.00 FORMAT "%8.2" ECU_ADDRESS 0x382170 /end MEASUREMENT
/begin MEASUREMENT m6smsl_w "" UWORD dez 1 100 0.00 65535.00 FORMAT "%8.2" ECU_ADDRESS 0x382172 /end MEASUREMENT
/begin MEASUREMENT m6wmsl2_w "" UWORD dez 1 100 0.00 65535.00 FORMAT "%8.2" ECU_ADDRESS 0x382174 /end MEASUREMENT
/begin MEASUREMENT m6wmslv2_w "" UWORD dez 1 100 0.00 65535.00 FORMAT "%8.2" ECU_ADDRESS 0x382176 /end MEASUREMENT
/begin MEASUREMENT m6wmslv_w "" UWORD dez 1 100 0.00 65535.00 FORMAT "%8.2" ECU_ADDRESS 0x382178 /end MEASUREMENT
/begin MEASUREMENT m6wmsl_w "" UWORD dez 1 100 0.00 65535.00 FORMAT "%8.2" ECU_ADDRESS 0x38217A /end MEASUREMENT
/begin MEASUREMENT misfirez_w "" UWORD dez 1 100 0.00 65535.00 FORMAT "%8.2" ECU_ADDRESS 0xF15BC /end MEASUREMENT
/begin MEASUREMENT mldyn_w "" UWORD m_q0p00277 1 100 0.00 182.0417 FORMAT "%8.4" ECU_ADDRESS 0xF4496 /end MEASUREMENT
/begin MEASUREMENT modez_w "" UWORD dez 1 100 0.00 65535.00 FORMAT "%8.2" ECU_ADDRESS 0xF15BE /end MEASUREMENT
/begin MEASUREMENT mslift "" UBYTE m_q0p4 1 100 0.00 102.0 FORMAT "%5.1" ECU_ADDRESS 0xF4016 /end MEASUREMENT
/begin MEASUREMENT mslift2 "" UBYTE m_q0p4 1 100 0.00 102.0 FORMAT "%5.1" ECU_ADDRESS 0xF4017 /end MEASUREMENT
/begin MEASUREMENT mslnenn "" UBYTE m_q0p4 1 100 0.00 102.0 FORMAT "%5.1" ECU_ADDRESS 0x38201C /end MEASUREMENT
/begin MEASUREMENT mslnenn2 "" UBYTE m_q0p4 1 100 0.00 102.0 FORMAT "%5.1" ECU_ADDRESS 0x38201D /end MEASUREMENT
/begin MEASUREMENT mslnf "" UBYTE m_q0p4 1 100 0.00 102.0 FORMAT "%5.1" ECU_ADDRESS 0xF4018 /end MEASUREMENT
/begin MEASUREMENT mslnf2 "" UBYTE m_q0p4 1 100 0.00 102.0 FORMAT "%5.1" ECU_ADDRESS 0xF4019 /end MEASUREMENT
/begin MEASUREMENT mslnt "" UBYTE m_q0p4 1 100 0.00 102.0 FORMAT "%5.1" ECU_ADDRESS 0xF401A /end MEASUREMENT
/begin MEASUREMENT mslnt2 "" UBYTE m_q0p4 1 100 0.00 102.0 FORMAT "%5.1" ECU_ADDRESS 0xF401B /end MEASUREMENT
/begin MEASUREMENT mslt2_w "" UWORD m_uw_b6553p5 1 100 0.00 6553.500 FORMAT "%8.3" ECU_ADDRESS 0xF433E /end MEASUREMENT
/begin MEASUREMENT mslt_w "" UWORD m_uw_b6553p5 1 100 0.00 6553.500 FORMAT "%8.3" ECU_ADDRESS 0xF4340 /end MEASUREMENT
/begin MEASUREMENT mslv2_w "" UWORD m_q0p0015625 1 100 0.00 102.3984 FORMAT "%8.4" ECU_ADDRESS 0xF4342 /end MEASUREMENT
/begin MEASUREMENT mslvft2_w "" SWORD m_q0p0015625 1 100 -51.20000 51.19844 FORMAT "%8.5" ECU_ADDRESS 0xF4344 /end MEASUREMENT
/begin MEASUREMENT mslvft_w "" SWORD m_q0p0015625 1 100 -51.20000 51.19844 FORMAT "%8.5" ECU_ADDRESS 0xF4346 /end MEASUREMENT
/begin MEASUREMENT mslvt2_w "" SWORD m_sw_q0p1 1 100 -3276.800 3276.700 FORMAT "%8.3" ECU_ADDRESS 0xF4348 /end MEASUREMENT
/begin MEASUREMENT mslvt_w "" SWORD m_sw_q0p1 1 100 -3276.800 3276.700 FORMAT "%8.3" ECU_ADDRESS 0xF434A /end MEASUREMENT
/begin MEASUREMENT mslv_w "" UWORD m_q0p0015625 1 100 0.00 102.3984 FORMAT "%8.4" ECU_ADDRESS 0xF434C /end MEASUREMENT
/begin MEASUREMENT nmaxfc_w "" UWORD dez 1 100 0.00 65535.00 FORMAT "%8.2" ECU_ADDRESS 0x384062 /end MEASUREMENT
/begin MEASUREMENT nwfctrnpa "" UBYTE dez 1 100 0.00 255.0 FORMAT "%5.1" ECU_ADDRESS 0x38402B /end MEASUREMENT
/begin MEASUREMENT nwfctrnpe "" UBYTE dez 1 100 0.00 255.0 FORMAT "%5.1" ECU_ADDRESS 0x38402A /end MEASUREMENT
/begin MEASUREMENT nwnumbz_w "" UWORD dez 1 100 0.00 65535.00 FORMAT "%8.2" ECU_ADDRESS 0xF15C0 /end MEASUREMENT
/begin MEASUREMENT pausez_w "" UWORD dez 1 100 0.00 65535.00 FORMAT "%8.2" ECU_ADDRESS 0xF15C2 /end MEASUREMENT
/begin MEASUREMENT phpw "" UBYTE dez 1 100 0.00 255.0 FORMAT "%5.1" ECU_ADDRESS 0xF06FB /end MEASUREMENT
/begin MEASUREMENT phpw2 "" UBYTE dez 1 100 0.00 255.0 FORMAT "%5.1" ECU_ADDRESS 0xF06FC /end MEASUREMENT
/begin MEASUREMENT plokbits "" UBYTE dez 1 100 0.00 255.0 FORMAT "%5.1" ECU_ADDRESS 0x382027 /end MEASUREMENT
/begin MEASUREMENT randreg_w "" UWORD dez 1 100 0.00 65535.00 FORMAT "%8.2" ECU_ADDRESS 0xF15C4 /end MEASUREMENT
/begin MEASUREMENT rmsl "" UBYTE fak_ub_b2 1 100 0.00 1.992 FORMAT "%5.3" ECU_ADDRESS 0xF401C /end MEASUREMENT
/begin MEASUREMENT rmsl2 "" UBYTE fak_ub_b2 1 100 0.00 1.992 FORMAT "%5.3" ECU_ADDRESS 0xF401D /end MEASUREMENT
/begin MEASUREMENT rmslf "" UBYTE fak_ub_b2 1 100 0.00 1.992 FORMAT "%5.3" ECU_ADDRESS 0x384002 /end MEASUREMENT
/begin MEASUREMENT rmslf2 "" UBYTE fak_ub_b2 1 100 0.00 1.992 FORMAT "%5.3" ECU_ADDRESS 0x384003 /end MEASUREMENT
/begin MEASUREMENT rmslt "" UBYTE fak_ub_b2 1 100 0.00 1.992 FORMAT "%5.3" ECU_ADDRESS 0xF401E /end MEASUREMENT
/begin MEASUREMENT rmslt2 "" UBYTE fak_ub_b2 1 100 0.00 1.992 FORMAT "%5.3" ECU_ADDRESS 0xF401F /end MEASUREMENT
/begin MEASUREMENT slfofo_w "" UWORD tsquant 1 100 0.00 52428.00 FORMAT "%8.2" ECU_ADDRESS 0xF14A8 /end MEASUREMENT
/begin MEASUREMENT slfofu_w "" UWORD tsquant 1 100 0.00 52428.00 FORMAT "%8.2" ECU_ADDRESS 0xF14AA /end MEASUREMENT
/begin MEASUREMENT tddnwnpa_w "" UWORD t100msxs_uw_b6553p5 1 100 0.00 6553.500 FORMAT "%8.3" ECU_ADDRESS 0xF4FA4 /end MEASUREMENT
/begin MEASUREMENT tddnwnpe_w "" UWORD t100msxs_uw_b6553p5 1 100 0.00 6553.500 FORMAT "%8.3" ECU_ADDRESS 0xF4F7E /end MEASUREMENT
/begin MEASUREMENT tkomp_w "" SWORD tsquant 1 100 -26214.40 26213.60 FORMAT "%8.2" ECU_ADDRESS 0xF14F6 /end MEASUREMENT
/begin MEASUREMENT tktstoer_w "" UWORD t100msxs_uw_b6553p5 1 100 0.00 6553.500 FORMAT "%8.3" ECU_ADDRESS 0xF453E /end MEASUREMENT
/begin MEASUREMENT tskdelay "" UBYTE dez 1 100 0.00 255.0 FORMAT "%5.1" ECU_ADDRESS 0xF06AE /end MEASUREMENT
/begin MEASUREMENT tskx3exp "" SBYTE dez 1 100 -128.0 127.0 FORMAT "%5.1" ECU_ADDRESS 0xF06AF /end MEASUREMENT
/begin MEASUREMENT tskx3_w "" UWORD dez 1 100 0.00 65535.00 FORMAT "%8.2" ECU_ADDRESS 0xF14F8 /end MEASUREMENT
/begin MEASUREMENT tsk_w "" UWORD tsquant 1 100 0.00 52428.00 FORMAT "%8.2" ECU_ADDRESS 0xF14B8 /end MEASUREMENT
/begin MEASUREMENT tsmxkomp_w "" UWORD tsquant 1 100 0.00 52428.00 FORMAT "%8.2" ECU_ADDRESS 0xF14FA /end MEASUREMENT
/begin MEASUREMENT tsroh_w "" UWORD tsquant 1 100 0.00 52428.00 FORMAT "%8.2" ECU_ADDRESS 0xF129E /end MEASUREMENT
/begin MEASUREMENT tushkv_w "" UWORD t100msxs_uw_b6553p5 1 100 0.00 6553.500 FORMAT "%8.3" ECU_ADDRESS 0xF4540 /end MEASUREMENT
/begin MEASUREMENT twdlssh2_w "" UWORD t50msxs_uw_b3276p75 1 100 0.00 3276.750 FORMAT "%8.3" ECU_ADDRESS 0xF4616 /end MEASUREMENT
/begin MEASUREMENT twdlssh_w "" UWORD t50msxs_uw_b3276p75 1 100 0.00 3276.750 FORMAT "%8.3" ECU_ADDRESS 0xF4618 /end MEASUREMENT
/begin MEASUREMENT ushfmxstg "" UBYTE spgg_q0p52 1 100 0.00 132.6 FORMAT "%5.1" ECU_ADDRESS 0x38204C /end MEASUREMENT
/begin MEASUREMENT ushfmxstg2 "" UBYTE spgg_q0p52 1 100 0.00 132.6 FORMAT "%5.1" ECU_ADDRESS 0x38204D /end MEASUREMENT
/begin MEASUREMENT ushkj "" UBYTE spg_ub_b1p33 1 100 0.00 1.330 FORMAT "%5.3" ECU_ADDRESS 0xF40D8 /end MEASUREMENT
/begin MEASUREMENT ushkj2 "" UBYTE spg_ub_b1p33 1 100 0.00 1.330 FORMAT "%5.3" ECU_ADDRESS 0xF40D9 /end MEASUREMENT
/begin MEASUREMENT ushkjf2_w "" UWORD spg_uw_b1p33 1 100 0.00 1.330000 FORMAT "%8.6" ECU_ADDRESS 0xF461A /end MEASUREMENT
/begin MEASUREMENT ushkjf_w "" UWORD spg_uw_b1p33 1 100 0.00 1.330000 FORMAT "%8.6" ECU_ADDRESS 0xF461C /end MEASUREMENT
/begin MEASUREMENT ushkmxstg "" UBYTE spgg_q0p52 1 100 0.00 132.6 FORMAT "%5.1" ECU_ADDRESS 0xF0769 /end MEASUREMENT
/begin MEASUREMENT ushkmxstg2 "" UBYTE spgg_q0p52 1 100 0.00 132.6 FORMAT "%5.1" ECU_ADDRESS 0xF076A /end MEASUREMENT
/begin MEASUREMENT ushksteig "" UBYTE spgg_q0p52 1 100 0.00 132.6 FORMAT "%5.1" ECU_ADDRESS 0xF076B /end MEASUREMENT
/begin MEASUREMENT ushksteig2 "" UBYTE spgg_q0p52 1 100 0.00 132.6 FORMAT "%5.1" ECU_ADDRESS 0xF076C /end MEASUREMENT
/begin MEASUREMENT usmnsha "" UBYTE spg_ub_b1p33 1 100 0.00 1.330 FORMAT "%5.3" ECU_ADDRESS 0xF40DA /end MEASUREMENT
/begin MEASUREMENT usmnsha2 "" UBYTE spg_ub_b1p33 1 100 0.00 1.330 FORMAT "%5.3" ECU_ADDRESS 0xF40DB /end MEASUREMENT
/begin MEASUREMENT usmnshn "" UBYTE spg_ub_b1p33 1 100 0.00 1.330 FORMAT "%5.3" ECU_ADDRESS 0x384016 /end MEASUREMENT
/begin MEASUREMENT usmnshn2 "" UBYTE spg_ub_b1p33 1 100 0.00 1.330 FORMAT "%5.3" ECU_ADDRESS 0x384017 /end MEASUREMENT
/begin MEASUREMENT usmxsha "" UBYTE spg_ub_b1p33 1 100 0.00 1.330 FORMAT "%5.3" ECU_ADDRESS 0xF40DC /end MEASUREMENT
/begin MEASUREMENT usmxsha2 "" UBYTE spg_ub_b1p33 1 100 0.00 1.330 FORMAT "%5.3" ECU_ADDRESS 0xF40DD /end MEASUREMENT
/begin MEASUREMENT usmxshn "" UBYTE spg_ub_b1p33 1 100 0.00 1.330 FORMAT "%5.3" ECU_ADDRESS 0x384018 /end MEASUREMENT
/begin MEASUREMENT usmxshn2 "" UBYTE spg_ub_b1p33 1 100 0.00 1.330 FORMAT "%5.3" ECU_ADDRESS 0x384019 /end MEASUREMENT
/begin MEASUREMENT usrhkmx "" UBYTE spg_ub_q0p0052_o0p2 1 100 -0.2000 1.130 FORMAT "%5.3" ECU_ADDRESS 0x384013 /end MEASUREMENT
/begin MEASUREMENT usrhkmx2 "" UBYTE spg_ub_q0p0052_o0p2 1 100 -0.2000 1.130 FORMAT "%5.3" ECU_ADDRESS 0x384014 /end MEASUREMENT
/begin MEASUREMENT usrhks "" UBYTE spg_ub_q0p0052_o0p2 1 100 -0.2000 1.130 FORMAT "%5.3" ECU_ADDRESS 0xF4084 /end MEASUREMENT
/begin MEASUREMENT usrhks2 "" UBYTE spg_ub_q0p0052_o0p2 1 100 -0.2000 1.130 FORMAT "%5.3" ECU_ADDRESS 0xF4085 /end MEASUREMENT
/begin MEASUREMENT wlustop_w "" UWORD dez 1 100 0.00 65535.00 FORMAT "%8.2" ECU_ADDRESS 0xF1528 /end MEASUREMENT
/begin MEASUREMENT wmilstp_w "" UWORD dez 1 100 0.00 65535.00 FORMAT "%8.2" ECU_ADDRESS 0xF152A /end MEASUREMENT
/begin MEASUREMENT wnwfda_w "" SWORD kw_sw_q0p0078 1 100 -256.0000 255.9922 FORMAT "%8.4" ECU_ADDRESS 0xF4FA6 /end MEASUREMENT
/begin MEASUREMENT wnwfde_w "" SWORD kw_sw_q0p0078 1 100 -256.0000 255.9922 FORMAT "%8.4" ECU_ADDRESS 0xF4F80 /end MEASUREMENT
/begin MEASUREMENT wnwsanp_w "" SWORD kw_sw_q0p0078 1 100 -256.0000 255.9922 FORMAT "%8.4" ECU_ADDRESS 0x384094 /end MEASUREMENT
/begin MEASUREMENT wnwsenp_w "" SWORD kw_sw_q0p0078 1 100 -256.0000 255.9922 FORMAT "%8.4" ECU_ADDRESS 0x384092 /end MEASUREMENT
/begin MEASUREMENT wnwsfda_w "" SWORD kw_sw_q0p0078 1 100 -256.0000 255.9922 FORMAT "%8.4" ECU_ADDRESS 0xF4FA8 /end MEASUREMENT
/begin MEASUREMENT wnwsfde_w "" SWORD kw_sw_q0p0078 1 100 -256.0000 255.9922 FORMAT "%8.4" ECU_ADDRESS 0xF4F82 /end MEASUREMENT
/begin MEASUREMENT xkfmodi "" UBYTE dez 1 100 0.00 255.0 FORMAT "%5.1" ECU_ADDRESS 0xF06CD /end MEASUREMENT
/begin MEASUREMENT xs "" UWORD kw_dmdfof1 1 100 -120.0000 119.9963 FORMAT "%8.4" ARRAY_SIZE 5 ECU_ADDRESS 0xF14BA /end MEASUREMENT
/begin MEASUREMENT ykfmodi "" UBYTE dez 1 100 0.00 255.0 FORMAT "%5.1" ECU_ADDRESS 0xF06CE /end MEASUREMENT
/begin MEASUREMENT zgstresz "" UWORD dez 1 100 0.00 65535.00 FORMAT "%8.2" ECU_ADDRESS 0x38295C /end MEASUREMENT
/begin MEASUREMENT zhzkh "" UBYTE dez 1 100 0.00 255.0 FORMAT "%5.1" ECU_ADDRESS 0xF072E /end MEASUREMENT
/begin MEASUREMENT zhzkh2 "" UBYTE dez 1 100 0.00 255.0 FORMAT "%5.1" ECU_ADDRESS 0xF072F /end MEASUREMENT
/begin MEASUREMENT zhzoffh "" UBYTE dez 1 100 0.00 255.0 FORMAT "%5.1" ECU_ADDRESS 0xF0730 /end MEASUREMENT
/begin MEASUREMENT zhzoffh2 "" UBYTE dez 1 100 0.00 255.0 FORMAT "%5.1" ECU_ADDRESS 0xF0731 /end MEASUREMENT
/begin MEASUREMENT zlash2_w "" UWORD t100msxs_uw_b6553p5 1 100 0.00 6553.500 FORMAT "%8.3" ECU_ADDRESS 0xF1898 /end MEASUREMENT
/begin MEASUREMENT zlash_w "" UWORD t100msxs_uw_b6553p5 1 100 0.00 6553.500 FORMAT "%8.3" ECU_ADDRESS 0xF189A /end MEASUREMENT
/begin MEASUREMENT zlshver_w "" UWORD t100msxs_uw_b6553p5 1 100 0.00 6553.500 FORMAT "%8.3" ECU_ADDRESS 0xF4542 /end MEASUREMENT
/begin MEASUREMENT zlshvok_w "" UWORD t100msxs_uw_b6553p5 1 100 0.00 6553.500 FORMAT "%8.3" ECU_ADDRESS 0xF4544 /end MEASUREMENT
/begin MEASUREMENT zphnok "" UBYTE dez 1 100 0.00 255.0 FORMAT "%5.1" ECU_ADDRESS 0xF06FD /end MEASUREMENT
/begin MEASUREMENT zphnok2 "" UBYTE dez 1 100 0.00 255.0 FORMAT "%5.1" ECU_ADDRESS 0xF06FE /end MEASUREMENT
/begin MEASUREMENT zwdynsh "" UBYTE dez 1 100 0.00 255.0 FORMAT "%5.1" ECU_ADDRESS 0xF4086 /end MEASUREMENT
/begin MEASUREMENT zwdynsh2 "" UBYTE dez 1 100 0.00 255.0 FORMAT "%5.1" ECU_ADDRESS 0xF4087 /end MEASUREMENT
/begin MEASUREMENT zzuend "" UWORD dez 1 100 0.00 65535.00 FORMAT "%8.2" ARRAY_SIZE 2 ECU_ADDRESS 0x382A76 /end MEASUREMENT
/begin MEASUREMENT zzyldmd "" UBYTE dez 1 100 0.00 255.0 FORMAT "%5.1" ECU_ADDRESS 0xF05C4 /end MEASUREMENT
/begin MEASUREMENT zzyllfb "" UBYTE dez 1 100 0.00 255.0 FORMAT "%5.1" ECU_ADDRESS 0xF06B0 /end MEASUREMENT
/begin FUNCTION DLSAHK "12.190"
 /begin DEF_CHARACTERISTIC ANZDYNSH CWDLSAHK DLAMLASHF DLAMLASHM DMRLASH KMXSTG KTLAMSTEIG LAMLASHMIN LAMSONSVL LAMSTEIG MLLASH MLOSTEST MLUSSTG MLUSTEST MLUSVL SMLDYN TABGSTGK TLLASH TMLUSTESTH TRIPFASH TSALASH TTLASH TUSCHUB TUSENLASH TUSHKRFM TUSHKVL TUSHSMIN TUSLASH TUSMSVL TUSSA TUSTALLASH USHKVL USHLEAN USHRICH USHSTGMX USHSTSOLL USSCHUB /end DEF_CHARACTERISTIC
 /begin IN_MEASUREMENT B_atmtpk B_atmtpk2 B_cdlash B_cwlshdyn B_cwlshsch B_cwlshvl B_dsls B_dtest B_edkvs B_edkvs2 B_evloc B_fa B_fash B_fash2 B_hsha B_hsha2 B_lr B_lr2 B_lrhk B_lrhk2 B_lrhkp B_lrhkp2 B_lsh B_lsh2 B_mdarv B_minflsh B_minflsh2 B_pwf B_sa B_sbbhk B_sbbhk2 B_stend B_tal B_talval B_vlsuftb B_vlsuftb2 B_vlsumrb B_vlsumrb2 lamsbg2_w lamsbg_w lamsons2_w lamsons_w ml_w tahsom2_w tahsom_w ushk ushk2 usrhk usrhk2 /end IN_MEASUREMENT
 /begin OUT_MEASUREMENT B_dlash B_dlash2 B_dushkvl B_dushkvl2 B_dushsch B_dushsch2 B_enlash B_enlash2 B_entest B_entest2 B_ktrlash B_ktrlash2 B_lamlash B_lamlash2 B_lamverg B_lamverg2 B_lsahksp B_lsahksp2 B_lshswok B_lshswok2 B_maxlash B_maxlash2 B_maxlavh B_maxlavh2 B_mldyn B_mlustest B_sbbhkv B_sbbhkv2 B_teslash B_teslash2 B_trfash B_trfash2 B_ushkf B_ushkf2 B_ushkm B_ushkm2 dmrlash_w lamlash2_w lamlash_w mldyn_w ushfmxstg ushfmxstg2 ushkmxstg ushkmxstg2 ushksteig zlash2_w zlash_w zwdynsh zwdynsh2 /end OUT_MEASUREMENT
 /begin LOC_MEASUREMENT B_abgstg B_abgstg2 B_ddylash B_ddylash2 B_dlams B_dlams2 B_dshk B_dshk2 B_dylash B_dylash2 B_enfmst B_enfmst2 B_enmaxla B_enmaxla2 B_enramph B_enramph2 B_hshtpk B_hshtpk2 B_lamend B_lamend2 B_lshkspe B_lshkspe2 B_lsulash B_lsulash2 B_maxla B_maxla2 B_minlash B_minlash2 B_nolash B_nolash2 B_nolavh B_nolavh2 B_npllash B_npllash2 B_reset_ushsch2 B_saagr B_siglash B_siglash2 B_steigm B_steigm2 B_uscherf B_uscherf2 B_ushkmf B_ushkmf2 B_ushkrfm B_ushkrfm2 B_ushsch B_ushsch2 B_usrhkmx B_usrhkmx2 B_vlsufm B_vlsufm2 dlams2_w dlams_w intlash2_w intlash_w lamtrip2_w lamtrip_w ushksteig2 usrhkmx usrhkmx2 usrhks usrhks2 /end LOC_MEASUREMENT
/end FUNCTION
/begin FUNCTION DLSH "26.240"
 /begin DEF_CHARACTERISTIC ANZHZKH ANZHZOFFH DLAMELSH DMRLSH DRISIGH DUSHKHZK RISIGRESH TAMDOGH TAMDUGH TAMSIGH TASIG TMSH TMSHA TNSTDNH TRSAFA TRSAH TRSE TTBMH TUSEHKH TUSHZFH TUSKS TUSMAX TUSTAL UBDLS USMAX USMIN USREFH USREFHKLT USREMH /end DEF_CHARACTERISTIC
 /begin IN_MEASUREMENT B_atmtpk B_atmtpk2 B_cdlsh B_fa B_falsh B_falsh2 B_hsha B_hsha2 B_hshe B_hshe2 B_lsh B_lsh2 B_maxlash B_maxlash2 B_nmot B_st B_tal B_talval rinh2_w rinh_w tahsom2_w tahsom_w tmot tmotab ub ushk2_w ushk_w /end IN_MEASUREMENT
 /begin OUT_MEASUREMENT B_adsh B_adsh2 B_adshs B_adshs2 B_anzhzkh B_anzhzkh2 B_anzhzoh B_anzhzoh2 B_dshen B_dshen2 B_elshbb B_elshbb2 B_elshv B_elshv2 B_hzkfh B_hzkfh2 B_hzkhzyk B_hzkhzyk2 B_minflsh B_minflsh2 B_nplflsh B_nplflsh2 B_risigh B_risigh2 B_sbbhk B_sbbhk2 B_sigflsh B_sigflsh2 B_trsah B_trsah2 B_ttbmhh B_ttbmhh2 B_uhsig B_uhsig2 B_zlshv B_zlshv2 dmrlsh_w lamelsh2_w lamelsh_w zhzkh zhzkh2 zhzoffh zhzoffh2 /end OUT_MEASUREMENT
 /begin LOC_MEASUREMENT B_hzoffh B_hzoffh2 B_lshklt B_maxflsh B_noadsh B_noadsh2 B_nolsh B_nolsh2 B_sbbhkre B_sbbhkre2 B_tushzfh B_tushzfh2 /end LOC_MEASUREMENT
/end FUNCTION
/begin FUNCTION DLSHV "2.80"
 /begin DEF_CHARACTERISTIC CWDLSHV DLAMHVF DLAMHVM KLTKTSTOER KLTUSHKV MLOKTV MLOSHKVERT MLUKTV MLUSHKVERT TLAMVERG TLRHKPAKT TLSHVER TLSHVOK TRIPLSHV TUSLSHV USHKVERTO USHKVERTU USHVO USHVU /end DEF_CHARACTERISTIC
 /begin IN_MEASUREMENT avkatf avkatf2 B_cdlshv B_fa B_falshv B_lr B_lr2 B_lrhkp B_lrhkp2 B_sbbhkv B_sbbhkv2 frm2_w frm_w lamsbg2_w lamsbg_w ml_w ushk2_w ushk_w /end IN_MEASUREMENT
 /begin OUT_MEASUREMENT B_lamlshv B_lamlshv2 lamlshv2_w lamlshv_w /end OUT_MEASUREMENT
 /begin LOC_MEASUREMENT avkatfm B_fktlshv B_ktrshv B_ktrshv2 B_ktzykhv B_ktzykhv2 B_mlktv B_nolshv B_npllshv B_telshv B_telshv2 frmshv2_w frmshv_w lamfrmv2_w lamfrmv_w tktstoer_w tushkv_w zlshver_w zlshvok_w /end LOC_MEASUREMENT
/end FUNCTION
/begin FUNCTION DLSSA "14.90"
 /begin DEF_CHARACTERISTIC DLAHISATO DLAHISATU DYNLSUTO DYNLSUTU LAMSSAMN LAMSSAMX SAFK1 TWDLSSA USIVMAXH USIVMINH USMNSHMN USMNSHMX USMXSHMN USMXSHMX USRHKSHJ USRJ /end DEF_CHARACTERISTIC
 /begin IN_MEASUREMENT B_lrhk B_lrhk2 B_pwf dlahi2_w dlahi_w dynlsu2_w dynlsu_w lamsoni2_w lamsoni_w lamsons2_w lamsons_w ushk ushk2 /end IN_MEASUREMENT
 /begin OUT_MEASUREMENT dlahisa dlahisa2 dynlsusa dynlsusa2 lamsisa lamsisa2 lamsosa lamsosa2 ushkj ushkj2 usmnshn usmnshn2 usmxshn usmxshn2 /end OUT_MEASUREMENT
 /begin LOC_MEASUREMENT twdlssh2_w twdlssh_w ushkjf2_w ushkjf_w usmnsha usmnsha2 usmxsha usmxsha2 /end LOC_MEASUREMENT
/end FUNCTION
/begin FUNCTION DLSUV "1.90" /begin DEF_CHARACTERISTIC CWDLSUV FRDO FRDU TDLSVV TDWLSVV /end DEF_CHARACTERISTIC /begin IN_MEASUREMENT B_cdlsvv B_fa B_lrs B_lrs2 frm2_w frmn_w frmx_w frm_w /end IN_MEASUREMENT /begin OUT_MEASUREMENT B_elsuv dlsuvAusbits /end OUT_MEASUREMENT /end FUNCTION
/begin FUNCTION DLUES1E "1.40" /begin DEF_CHARACTERISTIC TLUE1ZYF TVLUES1MN TVLUES1MX /end DEF_CHARACTERISTIC /begin IN_MEASUREMENT B_desee tvlues1 /end IN_MEASUREMENT /begin OUT_MEASUREMENT B_enlues B_enlues1 dlues1eAusBits /end OUT_MEASUREMENT /end FUNCTION
/begin FUNCTION DMDAPP "1.30"
 /begin IN_MEASUREMENT B_analu B_dluerk B_fodon B_fofd B_fofdis B_fofdr B_fofr B_fofr1 B_fofr2 B_fofr3 B_fofr4 B_fofrun B_fofrun0 B_fofstp B_fohe B_fohold B_fondis B_fonstp B_for B_forn B_forun B_forun0 B_lfzyl1 B_luaerk B_luerk B_lustop B_mddrla B_mdmi B_mdng B_mdnmn B_mdnmx B_mdstim B_mdstop B_mdtnst B_milstp B_plok B_tnalu B_zylind /end IN_MEASUREMENT
 /begin LOC_MEASUREMENT fdmd ffof1 ffof2 ffon1 ffon2 flg /end LOC_MEASUREMENT
/end FUNCTION
/begin FUNCTION DMDDLU "8.40" /begin DEF_CHARACTERISTIC DLURMIN DMXRDL KFDLUR KFDLUR1 KFDLUR2 KFDLURS NMIDLU /end DEF_CHARACTERISTIC /begin REF_CHARACTERISTIC SMI08DM1UB SMI08DMUB SNM08DM3UB SNM08DMUB /end REF_CHARACTERISTIC
 /begin IN_MEASUREMENT B_analu B_lustop B_mdstop B_wk B_wkr dlutsk_w esst_smi08dm1ub esst_smi08dmub esst_snm08dm3ub esst_snm08dmub flurktm_w fofstat fonstat midmd nmot /end IN_MEASUREMENT
 /begin OUT_MEASUREMENT B_dluerk /end OUT_MEASUREMENT
 /begin LOC_MEASUREMENT dlurs_w /end LOC_MEASUREMENT
/end FUNCTION
/begin FUNCTION DMDFOF "1.30"
 /begin DEF_CHARACTERISTIC ALFOF ANWFOST ANWSTP CDFO CDFOMOD FLFOF FOFAKT FS1FOF FS2FOF KLCFOF1N KLCFOF2N KLCFOF3N LURFOST SLFOFO1N SLFOFO2N SLFOFO3N SLFOFU1N SLFOFU2N SLFOFU3N /end DEF_CHARACTERISTIC
 /begin REF_CHARACTERISTIC SNM04DM1UB SNM04DM2UB /end REF_CHARACTERISTIC
 /begin IN_MEASUREMENT B_autget B_cdmd B_cvt B_fofstp B_fonresf B_mdzgstp B_pwf esst_snm04dm1ub esst_snm04dm2ub esst_snm04dm3ub esst_snm05dm1ub esst_snm05dm2ub esst_snm05dm3ub lunw_w nmot tsroh_w zzyldmd /end IN_MEASUREMENT
 /begin OUT_MEASUREMENT B_fofd B_fofdis B_fofdr B_fofr B_fofr1 B_fofr2 B_fofr3 B_fofr4 B_fofrset B_fofrun B_fofrun0 B_folunw B_fomod B_fonresd B_zylind fofstat tsk_w /end OUT_MEASUREMENT
 /begin LOC_MEASUREMENT anwfofs anwst B_mdzyl1 cfof flmxof_w flnof1 flnof2 flnof3 flnof4 flnof5 flpof1 flpof2 flpof3 flpof4 flpof5 fofresz fseof1 fseof2 fseof3 fseof4 fseof5 fseof_w fsof1 fsof2 fsof3 fsof4 fsof5 idxfofl idxfofn slfofo_w slfofu_w xs /end LOC_MEASUREMENT
/end FUNCTION
/begin FUNCTION DMDFON "8.40"
 /begin DEF_CHARACTERISTIC ALFO ANWFOHE DFSEFO1N DFSEFO2N DFSEFO3N DFSERES FLFO FS1FO FS2FO KFCFO1 KFCFO2 KFCFO3 MDERFOKH MDERKFON NMNFSE SLFOO1N SLFOO2N SLFOO3N SLFOU1N SLFOU2N SLFOU3N TNSTFON /end DEF_CHARACTERISTIC
 /begin REF_CHARACTERISTIC ANWFOST CDFO SNM08DM1UB SNM08DM2UB SNM08DM4UB /end REF_CHARACTERISTIC
 /begin IN_MEASUREMENT B_autget B_cdmd B_cvt B_fofr1 B_folunw B_fomod B_fonresd B_fonresz B_fonstp B_kh B_mderk B_mdstop B_pwf esst_smi03dm1ub esst_smi03dm2ub esst_smi03dm3ub esst_smi04dm1ub esst_smi04dm2ub esst_smi04dm3ub esst_snm08dm1ub esst_snm08dm2ub esst_snm08dm4ub esst_snm09dm1ub esst_snm09dm2ub esst_snm09dm3ub fzabgs_w lunw_w luts_w nmot nmot_w tnst_w zzyllfb /end IN_MEASUREMENT
 /begin OUT_MEASUREMENT B_fodon B_fohe B_fohold B_fondis B_fonresf B_fonrset B_for B_forn B_forun B_forun0 B_plok fonstat fse_w /end OUT_MEASUREMENT
 /begin LOC_MEASUREMENT anwfoh anwfos B_for00 B_for01 B_for02 B_for03 B_for04 B_for05 B_for06 B_for07 B_for08 B_for09 B_for10 B_for11 B_for12 B_for13 B_for14 B_for15 B_for16 B_for17 B_for18 B_for19 B_for20 B_for21 B_for22 B_for23 B_fordo B_forn01 B_forn02 B_forn03 B_forn04 B_forn05 B_forn06 B_forn07 B_forn08 B_plok01 B_plok02 B_plok03 B_plok04 B_plok05 B_plok06 B_plok07 B_plok08 B_plokn cfoxx dfse dfseresz flmx_w fln0 fln1 fln2 fln3 fln4 fln5 flp0 flp1 flp2 flp3 flp4 flp5 forbits1 forbits2 forbits3 fornbits fs0 fs1 fs2 fs3 fs4 fs5 fse0 fse1 fse2 fse3 fse4 fse5 idxfob idxfol idxfomi idxfon plokbits zgstresz /end LOC_MEASUREMENT
/end FUNCTION
/begin FUNCTION DMDLAD "6.40" /begin DEF_CHARACTERISTIC ANALUN ANALUST TNALU /end DEF_CHARACTERISTIC /begin REF_CHARACTERISTIC SNM08DMUB /end REF_CHARACTERISTIC
 /begin IN_MEASUREMENT B_dluerk B_dopzue B_luaerk B_luerk B_lustop B_mdstop B_milstp B_optpherk B_stpon esst_snm08dmub nmot zzyllfb /end IN_MEASUREMENT
 /begin OUT_MEASUREMENT B_analu B_mderk B_tnalu /end OUT_MEASUREMENT
 /begin LOC_MEASUREMENT fanalun /end LOC_MEASUREMENT
/end FUNCTION
/begin FUNCTION DMDLFB "1.30" /begin DEF_CHARACTERISTIC FLUTN FLUV1 NFLUV NINITSK NMNTKOMP /end DEF_CHARACTERISTIC
 /begin IN_MEASUREMENT B_lustop B_mdzag B_mdzgstp nmot nmot_w tnst_w tsk_w zzyldmd /end IN_MEASUREMENT
 /begin OUT_MEASUREMENT B_lfzyl1 B_mdstim dluts_w flutszyl_w fluts_w lunw_w lutszyl_w luts_w tskdelay tskx3exp tskx3_w zzyllfb /end OUT_MEASUREMENT
 /begin LOC_MEASUREMENT arimean_w B_mntkomp tkomp_w tsmxkomp_w /end LOC_MEASUREMENT
/end FUNCTION
/begin FUNCTION DMDLFK "1.40"
 /begin IN_MEASUREMENT B_fokstp B_mdstop dluts_w flutszyl_w fse_w lutszyl_w zzyllfb /end IN_MEASUREMENT
 /begin OUT_MEASUREMENT dlutsk_w flutskzy_w flutsk_w lutskzyl_w lutsk_w /end OUT_MEASUREMENT
/end FUNCTION
/begin FUNCTION DMDLU "6.40"
 /begin DEF_CHARACTERISTIC DMXRLU FIAMALU FIMALU KFAMAL KFAMAL1 KFAMAL2 KFLURB KFLURB1 KFLURB2 KFLURBS KFLURBV KFLURM KFLURM1 LURBMI LURKTM LURMIN1 LURMIN2 LURMIN3 LURST /end DEF_CHARACTERISTIC
 /begin REF_CHARACTERISTIC SMI08DM1UB SMI08DMUB SNM08DM3UB SNM08DMUB /end REF_CHARACTERISTIC
 /begin IN_MEASUREMENT B_analu B_faan B_fan B_fokstp B_ll B_lustop B_mdstop B_wk B_wkr esst_smi08dm1ub esst_smi08dmub esst_snm08dm3ub esst_snm08dmub fofstat fonstat lutsk_w midmd midmd_w nmot tmot tnst_w tskx3exp tskx3_w vfzg /end IN_MEASUREMENT
 /begin OUT_MEASUREMENT B_luerk flurktm_w flurmin_w /end OUT_MEASUREMENT
 /begin LOC_MEASUREMENT famal flurb_w lums_w lurms_w lurs_w /end LOC_MEASUREMENT
/end FUNCTION
/begin FUNCTION DMDLUA "5.40" /begin DEF_CHARACTERISTIC DMXRFL KFLUAR KFLUAR1 KFLUAR2 KFLUARS KFLUARV /end DEF_CHARACTERISTIC /begin REF_CHARACTERISTIC SMI08DM1UB SMI08DMUB SNM08DM3UB SNM08DMUB /end REF_CHARACTERISTIC
 /begin IN_MEASUREMENT B_lustop B_mdstop B_wk B_wkr esst_smi08dm1ub esst_smi08dmub esst_snm08dm3ub esst_snm08dmub flurmin_w flutsk_w midmd nmot zzyllfb /end IN_MEASUREMENT
 /begin OUT_MEASUREMENT B_luaerk /end OUT_MEASUREMENT
 /begin LOC_MEASUREMENT luarmn_w luaroff_w luar_w /end LOC_MEASUREMENT
/end FUNCTION
/begin FUNCTION DMDMIL "11.10"
 /begin DEF_CHARACTERISTIC AHEAGW AHEAGWS AHEARV AHEKA AHEKS1B1 AHEKS1B2 AHEKSB1 AHEKSB2 AINTKAN AZYTIAB CWDALA CWDMDE FAINTEN FASKIV1 KFKSWF MILANTI TMASKIV1 /end DEF_CHARACTERISTIC
 /begin REF_CHARACTERISTIC SNM08DMUB TMWUC /end REF_CHARACTERISTIC
 /begin IN_MEASUREMENT bbdcy B_cdmd B_milstp B_pwf B_synph esst_snm08dmub esst_stm06llub midmd nmot nstat tmot /end IN_MEASUREMENT
 /begin OUT_MEASUREMENT afmimn afmimx afnmn afnmx aftmimn aftmimx aftnmn aftnmx ahearv_w aint azycnt bbdmdmil bbsp1 bbsp2 bfmimn bfmimx bfnmn bfnmx B_abgien B_afklt B_aftklt B_aftwrm B_afwrm B_bfklt B_bfwrm B_blkmd B_mdarv B_mdarvb1 B_mdarvb2 B_mdkat B_mdkatb1 B_mdkatb2 B_milmd B_sp1 B_sp2 B_tiab0 B_tiab1 B_tiab2 B_tiab3 B_tiab4 B_tiab5 flgtiab fzabgs_w fzabg_w fzarv_w fzkats1_w fzkats2_w fzkats_w fzkat_w ivzabg_w ivzaint_w ivzarv_w ivzkat_w kswf /end OUT_MEASUREMENT
 /begin LOC_MEASUREMENT aintkamin anzainten fivzabg flgkat_w fzmd zzuend /end LOC_MEASUREMENT
/end FUNCTION
/begin FUNCTION DMDSTP "13.70"
 /begin DEF_CHARACTERISTIC AVRALU AZSTLU AZSTPON CWSTDMD CWSTPCNF DRLSOLA DRLSOLST KLMISALULL KLTALUST MISALUN NGALUN NGALUST NMIALU NMXALU NSTDMD SFONTM TAMIALU /end DEF_CHARACTERISTIC
 /begin REF_CHARACTERISTIC SMI08DMUB SNM08DMUB /end REF_CHARACTERISTIC
 /begin IN_MEASUREMENT B_asc_reg B_autget B_cdmd B_dkpu B_dtest B_edkvs B_edkvs2 B_eev B_enws B_evasel B_evloc B_fbm B_fofrset B_fomod B_fonrset B_koe B_kuppl B_ll B_mdarv B_mdein B_mderk B_nldg B_nws B_phsnl B_sa B_st B_su B_swe_c B_synph B_tehb B_tsroov B_wk B_wkr esst_smi08dmub esst_snm08dmub midmd ngfil_w nmot nmot_w rlgas_w tadtea tans tmot tmst tnst_w tskdelay vfzg /end IN_MEASUREMENT
 /begin OUT_MEASUREMENT B_fofstp B_fokstp B_fonstp B_lustop B_mdstop B_mdzgstp B_milstp B_stdmd B_stpon B_swe /end OUT_MEASUREMENT
 /begin LOC_MEASUREMENT B_com1 B_com2 B_com3 B_fontm B_mddrla B_mdmi B_mdng B_mdnmn B_mdnmx B_mdtnst favralu wlustop_w wmilstp_w /end LOC_MEASUREMENT
/end FUNCTION
/begin FUNCTION DMDTSB "6.40" /begin DEF_CHARACTERISTIC KAMFZ ZYLKOR /end DEF_CHARACTERISTIC /begin IN_MEASUREMENT B_trev_inc trevovCtr zzyl /end IN_MEASUREMENT /begin OUT_MEASUREMENT B_nlphdly B_tsroov tsroh_w zzyldmd /end OUT_MEASUREMENT /end FUNCTION
/begin FUNCTION DMDZAG "2.20" /begin DEF_CHARACTERISTIC CWDMDZAG KFMODI RANDSEED ZAGRUN /end DEF_CHARACTERISTIC /begin IN_MEASUREMENT B_mdstop zzyl /end IN_MEASUREMENT
 /begin OUT_MEASUREMENT B_mdzag B_reini B_zagrun B_zagstp flgstign_w flgstinj_w flgst_w ignitioz_w lastmodz_w misfirez_w modez_w nwnumbz_w pausez_w randreg_w /end OUT_MEASUREMENT
 /begin LOC_MEASUREMENT B_mdend xkfmodi ykfmodi /end LOC_MEASUREMENT
/end FUNCTION
/begin FUNCTION DMFB "16.10" /begin DEF_CHARACTERISTIC TDMFB /end DEF_CHARACTERISTIC /begin IN_MEASUREMENT B_milfb B_stend /end IN_MEASUREMENT /end FUNCTION
/begin FUNCTION DNMAX "4.23" /begin DEF_CHARACTERISTIC CWDNMAX NMAXF TDNX /end DEF_CHARACTERISTIC /begin IN_MEASUREMENT nmot_w /end IN_MEASUREMENT /begin OUT_MEASUREMENT nmaxfc_w /end OUT_MEASUREMENT /end FUNCTION
/begin FUNCTION DNWKW "5.41" /begin DEF_CHARACTERISTIC TDNWSP WNWSPMN WNWSPMX /end DEF_CHARACTERISTIC /begin REF_CHARACTERISTIC WNWRPS WNWRPS2 /end REF_CHARACTERISTIC /begin IN_MEASUREMENT B_phad B_phad2 B_spsa B_spsa2 wnwsp2_w wnwsp_w /end IN_MEASUREMENT /begin OUT_MEASUREMENT B_nwkv dnwkwNvBits /end OUT_MEASUREMENT /begin LOC_MEASUREMENT dwnwsp2_w dwnwsp_w /end LOC_MEASUREMENT /end FUNCTION
/begin FUNCTION DNWSAUS "4.80"
 /begin DEF_CHARACTERISTIC DWNWDHYSA KFDWNWDMXA KFTDDNWNPA NWFDECA NWFINCA NWFMXA NWFSPLA WNWHA ZKNWVDA ZKNWVDSA /end DEF_CHARACTERISTIC
 /begin IN_MEASUREMENT B_cdanws B_dnwsa B_fanwftva B_fanwstaa B_fanwta nmot_w toelk_w wnwa_w wnwsa_w /end IN_MEASUREMENT
 /begin OUT_MEASUREMENT B_enwsva B_fanwtza B_fnwstva B_hlanws B_lcnpanw nwfctrnpa /end OUT_MEASUREMENT
 /begin LOC_MEASUREMENT B_nwnpoka dwnwdmxa_w dwnwfda_w tddnwnpa_w wnwfda_w wnwsanp_w wnwsfda_w /end LOC_MEASUREMENT
/end FUNCTION
/begin FUNCTION DNWSEAUS "1.30" /begin REF_CHARACTERISTIC TANWESTMN TANWESTMX /end REF_CHARACTERISTIC /begin IN_MEASUREMENT B_desee tanwra /end IN_MEASUREMENT /begin LOC_MEASUREMENT B_anwsea lokBits_anwsea /end LOC_MEASUREMENT /end FUNCTION
/begin FUNCTION DNWSEEIN "1.30" /begin DEF_CHARACTERISTIC TANWESTMN TANWESTMX /end DEF_CHARACTERISTIC /begin IN_MEASUREMENT B_desee tanwre /end IN_MEASUREMENT /begin LOC_MEASUREMENT B_enwsea lokBits_enwsea /end LOC_MEASUREMENT /end FUNCTION
/begin FUNCTION DNWSEIN "4.80"
 /begin DEF_CHARACTERISTIC DWNWDHYSE KFDWNWDMXE KFTDDNWNPE NWFDECE NWFINCE NWFMXE NWFSPLE WNWHE ZKNWVDE ZKNWVDSE /end DEF_CHARACTERISTIC
 /begin IN_MEASUREMENT B_cdenws B_dnwse B_fanwftve B_fanwstae B_fanwte nmot_w toelk_w wnwe_w wnwse_w /end IN_MEASUREMENT
 /begin OUT_MEASUREMENT B_enwsve B_fanwtze B_fnwstve B_hlenws B_lcnpenw nwfctrnpe /end OUT_MEASUREMENT
 /begin LOC_MEASUREMENT B_nwnpoke dwnwdmxe_w dwnwfde_w tddnwnpe_w wnwfde_w wnwsenp_w wnwsfde_w /end LOC_MEASUREMENT
/end FUNCTION
/begin FUNCTION DNWSZF "1.20" /begin IN_MEASUREMENT B_fnwstva B_fnwstve /end IN_MEASUREMENT
 /begin OUT_MEASUREMENT B_enws B_enwsa B_enwse B_fnwaktv B_fnwaktva B_fnwaktve dnwszfausbits0 /end OUT_MEASUREMENT
/end FUNCTION
/begin FUNCTION DPH "22.30" /begin DEF_CHARACTERISTIC PHNOKA /end DEF_CHARACTERISTIC
 /begin IN_MEASUREMENT B_motstop B_nldg B_phad B_phad2 B_phas2 B_phase B_pwf B_st B_stend B_zztab zrph zrph2 /end IN_MEASUREMENT
 /begin OUT_MEASUREMENT B_nophnldg B_phsok B_phsok2 B_switchpg B_vereph B_vereph2 phpw phpw2 zphnok zphnok2 /end OUT_MEASUREMENT
 /begin LOC_MEASUREMENT B_phexor B_phexor2 B_phregok B_phregok2 dphBits /end LOC_MEASUREMENT
/end FUNCTION
/begin FUNCTION DPLLSU "1.90"
 /begin DEF_CHARACTERISTIC CWPLLSU DLAHPPLMN DLAHPPLMN2 IMLHEMN IMLHEMN2 IMLHEMNFA IMLHEMNFA2 IMLPLCMN IMLPLCMN2 IMLPLCMNB IMLPLCMNB2 LAMMN LAMMX LASPLCFT LASPLCMR LSUNAMN LSUNAMX NLRFKEFDMX SDLAOFMN SDLAOFMN2 SDLAOFMX SDLAOFMX2 TVHELSUF TVLSUEK TVLSUEK2 TVLSUOF TVLSUOF2 TVLSUPER TVLSUPER2 TVSNPF TVSNPF2 USHKFT USHKMR ZLAMFT /end DEF_CHARACTERISTIC
 /begin IN_MEASUREMENT B_cdpllsu B_fa B_fapllsu B_frmax B_frmax2 B_frmin B_frmin2 B_lamverg B_lamverg2 B_lrhk B_lrhk2 B_lrhkp B_lrhkp2 B_lrka B_lrka2 B_lrs B_lrs2 B_lshswok B_lshswok2 B_lsudip B_lsudip2 B_maxlavh B_maxlavh2 B_sbbhk B_sbbhk2 B_sbbvk B_sbbvk2 B_stend dlahi2_w dlahi_w dlahp2_w dlahp_w lamsoni2_w lamsoni_w lamsons2_w lamsons_w msabg2_w msabg_w ushk2_w ushk_w /end IN_MEASUREMENT
 /begin OUT_MEASUREMENT B_elaof B_elaof2 B_lsulone B_lsulone2 B_vlsuftb B_vlsuftb2 B_vlsumrb B_vlsumrb2 B_vlsunp B_vlsunp2 /end OUT_MEASUREMENT
 /begin LOC_MEASUREMENT B_dlahimn B_dlahimn2 B_dlahimx B_dlahimx2 B_elaofmn B_elaofmn2 B_elaofmx B_elaofmx2 B_helsuf B_helsuf2 B_hepllsu B_hepllsu2 B_hpllsue B_hpllsue2 B_lshkpft B_lshkpft2 B_lshkpmr B_lshkpmr2 B_lsuft B_lsuft2 B_lsufta B_lsufta2 B_lsuftb B_lsuftb2 B_lsumr B_lsumr2 B_lsumra B_lsumra2 B_lsumrb B_lsumrb2 B_lsuoffe B_lsuoffe2 B_lsuoffs B_lsuoffs2 B_lsupft B_lsupft2 B_lsupmr B_lsupmr2 B_plenvh B_plenvh2 imlfta2_w imlfta_w imlftb2_w imlftb_w imlmra2_w imlmra_w imlmrb2_w imlmrb_w imlplhe2_w imlplhe_w /end LOC_MEASUREMENT
/end FUNCTION
/begin FUNCTION DPS "" /begin IN_MEASUREMENT B_dbuken /end IN_MEASUREMENT /end FUNCTION
/begin FUNCTION DSELHFS "2.10"
 /begin IN_MEASUREMENT B_dssakt B_ehfm B_heahfmlm B_hfm B_mnhfmlm B_mszsdkb B_mxhfmlm B_nplhfmlm /end IN_MEASUREMENT
 /begin OUT_MEASUREMENT B_ehfs B_fedkb B_fhfs /end OUT_MEASUREMENT
/end FUNCTION
/begin FUNCTION DSGEEP "20.10" /end FUNCTION
/begin FUNCTION DSLPE "9.20" /begin IN_MEASUREMENT B_desee B_slp /end IN_MEASUREMENT /end FUNCTION
/begin FUNCTION DSLSLRS "4.370"
 /begin DEF_CHARACTERISTIC ANZRMSL CWDSLSA CWDSLSAD CWDSLSY DFRMOFNML DFRMOFNXKT DFRMOFPML DFRMOFPXKT DFRMSLS DMSDRLTM DSLVFZMN DTMDSLA FBWRMSL FHODSL FMSLAMN FMSLAMX IMLATDSL IMLATDSLK IMLDSL KLMLDSLAMX KLMLDSLKMX KLMLDSLMX KLMLDSLOMX MLWDSLAMN MLWDSLKMN MLWDSLMN MLWDSLOMN MSLBAS MSLVMX MSLVMXK MSLVMXX MSLVMXXK RMSLMN RMSLMNK RMSLMNST RMSLMXST RMSLPMN RMSLTMN TANDSLMN TANDSLMX TC6CSL TC6CSL2 TC6CSLF TC6CSLF2 TC6CSLK TC6CSLK2 TC6CSLN TC6CSLN2 TC6CSLV TC6CSLV2 TDASTAT TDDSLSFG TDFGSLA TDFGSZSLS TDMSLMN1 TDMSLMN4 TDMSLMNK TDMSLOF3 TDMSLOF5 TDMSLOFK TDMSLV TDMSLVK TDPH2SLOF TDPHSLOF TDSLMDRL TDSLMVBA TFIMSLI TFIMSLIK TFIMSLO TFIMSLOK TFIMSLV TFIMSLVK TKATDSL TMDSLAMN TMDSLMN TMDSLMX TMSLADAP TMSLIFT TMSLIFT1 TMSLIFTK TNOMF2 TNOMF3 TNOMF5 TNSTDSL TSBVDSLTMS TWDSLTM TWHLSLP TWMLFE TWMSLMIN ZDSLAMX ZKFRMSLS /end DEF_CHARACTERISTIC
 /begin IN_MEASUREMENT B_bag B_bkvleer B_cdsls B_edkvs B_edkvs2 B_evloc B_fa B_fasla B_hag B_kh B_kha B_ll B_lrs B_lrs2 B_mdarv B_nmot B_pwf B_sbblsu B_sbblsu2 B_slp B_sls B_slsadap B_slsfz B_slsoff B_st B_stend B_te B_vag E_lm E_slpe E_slve E_ta E_tes E_tm fho_w frm2_w frm_w imlatm_w imlpr lamsbg2_w lamsbg_w lamsoni2_w lamsoni_w mlbb2_w mlbb_w ml_w msl msl2 rl_w tans tikatm tkatm tmot tmotab tmst tnse_w vfzg /end IN_MEASUREMENT
 /begin OUT_MEASUREMENT B_cwdslty B_dsl1 B_dsl4 B_dsla B_dslfa B_dslfrg12 B_dsls B_dslsp4 B_dspe B_esls B_fgadllfr B_mslmn B_mslpmn B_mslpmn2 B_sla DSLSLRSausbits DSLSLRSausbits2 DSLSLRSausbits3 fmsla fmsla2 m6amsl m6cmsl m6cmsl2 m6cmslv m6cmslv2 m6smsl2_w m6smslv2_w m6smslv_w m6smsl_w m6wmsl2_w m6wmslv2_w m6wmslv_w m6wmsl_w /end OUT_MEASUREMENT
 /begin LOC_MEASUREMENT anzmsls2_w anzmsls_w B_anzsls B_anzsls2 B_astat B_astat2 B_cwdslt B_cwdsltfa B_cwsla B_dfrmoe B_dfrmoe2 B_dfrmoff B_dfrmoff2 B_dsl B_dsl1ab B_dsl1e B_dsl2 B_dsl2ab B_dsl2e B_dsl3 B_dsl3ab B_dsl3e B_dsl45 B_dsl4ab B_dsl4e B_dsl5 B_dsl5ab B_dsl5dly B_dsl5e B_dslerr B_dslfrg B_dslfrg2 B_dslm B_dslmab B_dslme B_dslmes B_dslo B_dsloab B_dsloe B_dslp4 B_dslp42 B_dsltab B_dslte B_dsper B_dspes B_errmsl B_errmsl2 B_errofs B_errofs2 B_eslsp B_eslsp2 B_eslvp B_eslvp2 B_faslarq B_faslaset B_fgszsla B_fgszsla2 B_fgszsls B_fgszsls2 B_meaoper B_mesausw B_mesausw2 B_mess B_mess2 B_mnslspr B_mnslspr2 B_mslmin B_mslmin2 B_mxslvpr B_mxslvpr2 B_phend B_rmsl B_rmsl2 B_slar B_slarq B_slas B_slsofw B_szsls B_trfasla B_trzfasla B_zslsp B_zslsp2 B_zslvp B_zslvp2 dfrmoff2_w dfrmoff_w dmsldrl_w DSLSLRSLokBits1 DSLSLRSLokBits1a DSLSLRSLokBits2 DSLSLRSLokBits2a DSLSLRSLokBits3 DSLSLRSLokBits3a DSLSLRSLokBits4 DSLSLRSLokBits4a DSLSLRSLokBits5 DSLSLRSLokBits5a DSLSLRSLokBits_6 fmslav fmslav2 frm2frz_w frmfrz_w mslift mslift2 mslnenn mslnenn2 mslnf mslnf2 mslnt mslnt2 mslt2_w mslt_w mslv2_w mslvft2_w mslvft_w mslvt2_w mslvt_w mslv_w rmsl rmsl2 rmslf rmslf2 rmslt rmslt2 /end LOC_MEASUREMENT
/end FUNCTION
/begin FUNCTION DSLVE "11.10" /begin IN_MEASUREMENT B_desee B_slv /end IN_MEASUREMENT /end FUNCTION
/begin FUNCTION DSWEC "5.20" /begin DEF_CHARACTERISTIC FABSALU FIBSALU FSWALUV /end DEF_CHARACTERISTIC /begin IN_MEASUREMENT bsc B_cdswe cd_bits1_w vfzg /end IN_MEASUREMENT /begin OUT_MEASUREMENT B_swe_c /end OUT_MEASUREMENT /begin LOC_MEASUREMENT bssp fswares /end LOC_MEASUREMENT /end FUNCTION
/begin COMPU_METHOD accgrd_ub_b555p55 "" RAT_FUNC "%6.2" "m/(s^3)" COEFFS 0 1 0 0 0 2.17 /end COMPU_METHOD
/begin COMPU_METHOD acc_ub_b55p55 "" RAT_FUNC "%6.3" "m/(s^2)" COEFFS 0 1 0 0 0 0.217 /end COMPU_METHOD
/begin COMPU_METHOD acc_uw_b55p55 "" RAT_FUNC "%6.5" "m/(s^2)" COEFFS 0 147456 0 0 0 125 /end COMPU_METHOD
/begin COMPU_METHOD B_TRUE "" TAB_VERB "%6.3" "" COMPU_TAB_REF B_TRUE /end COMPU_METHOD
/begin COMPU_VTAB B_TRUE "" TAB_VERB 2 0 "----" 1 "TRUE" /end COMPU_VTAB
/begin COMPU_METHOD dez "" RAT_FUNC "%6.2" "" COEFFS 0 1 0 0 0 1 /end COMPU_METHOD
/begin COMPU_METHOD fak_q0p0195 "" RAT_FUNC "%6.4" "-" COEFFS 0 256 0 0 0 5 /end COMPU_METHOD
/begin COMPU_METHOD fak_sw_b1 "" RAT_FUNC "%7.6" "-" COEFFS 0 65536 0 0 0 2 /end COMPU_METHOD
/begin COMPU_METHOD fak_ub_b0p1_o0p05 "" RAT_FUNC "%8.7" "-" COEFFS 0 256 12.8 0 0 0.1 /end COMPU_METHOD
/begin COMPU_METHOD fak_ub_b1 "" RAT_FUNC "%6.4" "-" COEFFS 0 256 0 0 0 1 /end COMPU_METHOD
/begin COMPU_METHOD fak_ub_b2 "" RAT_FUNC "%6.4" "-" COEFFS 0 256 0 0 0 2 /end COMPU_METHOD
/begin COMPU_METHOD fak_ub_b4 "" RAT_FUNC "%6.4" "-" COEFFS 0 256 0 0 0 4 /end COMPU_METHOD
/begin COMPU_METHOD fak_uw_b1 "" RAT_FUNC "%7.6" "-" COEFFS 0 65536 0 0 0 1 /end COMPU_METHOD
/begin COMPU_METHOD fak_uw_b16 "" RAT_FUNC "%6.5" "-" COEFFS 0 65536 0 0 0 16 /end COMPU_METHOD
/begin COMPU_METHOD fak_uw_b2 "" RAT_FUNC "%7.6" "-" COEFFS 0 65536 0 0 0 2 /end COMPU_METHOD
/begin COMPU_METHOD fak_uw_b4 "" RAT_FUNC "%7.6" "-" COEFFS 0 65536 0 0 0 4 /end COMPU_METHOD
/begin COMPU_METHOD kw_dmdfof1 "" RAT_FUNC "%6.1" "°KW" COEFFS 0 273.066666666667 32768 0 0 1 /end COMPU_METHOD
/begin COMPU_METHOD kw_dmdfof2 "" RAT_FUNC "%6.4" "°KW" COEFFS 0 273.066666666667 0 0 0 1 /end COMPU_METHOD
/begin COMPU_METHOD kw_q0p0156 "" RAT_FUNC "%6.4" "Grad KW" COEFFS 0 64 0 0 0 1 /end COMPU_METHOD
/begin COMPU_METHOD kw_sw_q0p0078 "" RAT_FUNC "%6.4" "Grad KW" COEFFS 0 128 0 0 0 1 /end COMPU_METHOD
/begin COMPU_METHOD kw_tooth_sy "" RAT_FUNC "%6.2" "°KW" COEFFS 0 0.166666666666667 0 0 0 1 /end COMPU_METHOD
/begin COMPU_METHOD kw_uw_q0p0078 "" RAT_FUNC "%6.4" "Grad KW" COEFFS 0 128 0 0 0 1 /end COMPU_METHOD
/begin COMPU_METHOD luquant "" RAT_FUNC "%6.4" "(Umdr./sec)^2" COEFFS 0 202.661983231672 0 0 0 1 /end COMPU_METHOD
/begin COMPU_METHOD m_q0p0015625 "" RAT_FUNC "%6.4" "kg/h" COEFFS 0 640 0 0 0 1 /end COMPU_METHOD
/begin COMPU_METHOD m_q0p00277 "" RAT_FUNC "%6.4" "g" COEFFS 0 360 0 0 0 1 /end COMPU_METHOD
/begin COMPU_METHOD m_q0p1 "" RAT_FUNC "%6.3" "kg/h" COEFFS 0 10 0 0 0 1 /end COMPU_METHOD
/begin COMPU_METHOD m_q0p4 "" RAT_FUNC "%6.3" "kg/h" COEFFS 0 1 0 0 0 0.4 /end COMPU_METHOD
/begin COMPU_METHOD m_q2p777Em5_kg "" RAT_FUNC "%7.6" "kg" COEFFS 0 3600 0 0 0 0.1 /end COMPU_METHOD
/begin COMPU_METHOD m_sw_q0p1 "" RAT_FUNC "%6.3" "kg/h" COEFFS 0 1 0 0 0 0.1 /end COMPU_METHOD
/begin COMPU_METHOD m_uw_b23p3 "" RAT_FUNC "%6.5" "kg" COEFFS 0 2812.5 0 0 0 1 /end COMPU_METHOD
/begin COMPU_METHOD m_uw_b6553p5 "" RAT_FUNC "%6.3" "kg/h" COEFFS 0 1 0 0 0 0.1 /end COMPU_METHOD
/begin COMPU_METHOD nmotg_sw_q0p39 "" RAT_FUNC "%6.3" "1/min/s" COEFFS 0 1 0 0 0 0.39063 /end COMPU_METHOD
/begin COMPU_METHOD nmot_ub_q40 "" RAT_FUNC "%6.1" "1/min" COEFFS 0 1 0 0 0 40 /end COMPU_METHOD
/begin COMPU_METHOD nmot_uw_q0p25 "" RAT_FUNC "%6.3" "1/min" COEFFS 0 1 0 0 0 0.25 /end COMPU_METHOD
/begin COMPU_METHOD relNWU_q0p0234 "" RAT_FUNC "%6.4" "%/NWU" COEFFS 0 32 0 0 0 0.75 /end COMPU_METHOD
/begin COMPU_METHOD rel_ub_b99p6 "" RAT_FUNC "%6.3" "%" COEFFS 0 256 0 0 0 100 /end COMPU_METHOD
/begin COMPU_METHOD rel_uw_b100 "" RAT_FUNC "%6.4" "%" COEFFS 0 65536 0 0 0 100 /end COMPU_METHOD
/begin COMPU_METHOD rel_uw_q0p0234 "" RAT_FUNC "%6.4" "%" COEFFS 0 32 0 0 0 0.75 /end COMPU_METHOD
/begin COMPU_METHOD r_uw_q2 "" RAT_FUNC "%6.2" "Ohm" COEFFS 0 1 0 0 0 2 /end COMPU_METHOD
/begin COMPU_METHOD spgg_q0p52 "" RAT_FUNC "%6.3" "mV/ms" COEFFS 0 1 0 0 0 0.52 /end COMPU_METHOD
/begin COMPU_METHOD spg_ubatt "" RAT_FUNC "%6.4" "V" COEFFS 0 1 0 0 0 0.0704 /end COMPU_METHOD
/begin COMPU_METHOD spg_ub_b1p33 "" RAT_FUNC "%6.4" "V" COEFFS 0 255 0 0 0 1.33 /end COMPU_METHOD
/begin COMPU_METHOD spg_ub_q0p0052_o0p2 "" RAT_FUNC "%6.3" "V" COEFFS 0 255 51 0 0 1.33 /end COMPU_METHOD
/begin COMPU_METHOD spg_uw_b1p33 "" RAT_FUNC "%7.6" "V" COEFFS 0 65535 0 0 0 1.33 /end COMPU_METHOD
/begin COMPU_METHOD spg_uw_q0p00488 "" RAT_FUNC "%6.4" "V" COEFFS 0 1024 0 0 0 5 /end COMPU_METHOD
/begin COMPU_METHOD spg_uw_q0p00488_o1 "" RAT_FUNC "%6.3" "V" COEFFS 0 1024 1024 0 0 5 /end COMPU_METHOD
/begin COMPU_METHOD t100msxs_ub_b25p5 "" RAT_FUNC "%6.3" "s" COEFFS 0 1 0 0 0 0.1 /end COMPU_METHOD
/begin COMPU_METHOD t100msxs_uw_b6553p5 "" RAT_FUNC "%6.3" "s" COEFFS 0 1 0 0 0 0.1 /end COMPU_METHOD
/begin COMPU_METHOD t100msxs_uw_q100 "" RAT_FUNC "%6.3" "s" COEFFS 0 1 0 0 0 0.1 /end COMPU_METHOD
/begin COMPU_METHOD t10msxs_ub_b2p55 "" RAT_FUNC "%6.4" "s" COEFFS 0 1 0 0 0 0.01 /end COMPU_METHOD
/begin COMPU_METHOD t10msxs_uw_b655p35 "" RAT_FUNC "%6.4" "s" COEFFS 0 1 0 0 0 0.01 /end COMPU_METHOD
/begin COMPU_METHOD t1sxs_ub_b255 "" RAT_FUNC "%6.2" "s" COEFFS 0 1 0 0 0 1 /end COMPU_METHOD
/begin COMPU_METHOD t200msxs_ub_b51 "" RAT_FUNC "%6.3" "s" COEFFS 0 1 0 0 0 0.2 /end COMPU_METHOD
/begin COMPU_METHOD t20msxs_ub_b5p1 "" RAT_FUNC "%6.4" "s" COEFFS 0 1 0 0 0 0.02 /end COMPU_METHOD
/begin COMPU_METHOD t50msxs_uw_b3276p75 "" RAT_FUNC "%6.4" "s" COEFFS 0 1 0 0 0 0.05 /end COMPU_METHOD
/begin COMPU_METHOD temp_q0p0234_o273 "" RAT_FUNC "%6.1" "Grad C" COEFFS 0 1 273.15 0 0 0.0234375 /end COMPU_METHOD
/begin COMPU_METHOD temp_ub_b191p25 "" RAT_FUNC "%6.3" "Grad C" COEFFS 0 1 0 0 0 0.75 /end COMPU_METHOD
/begin COMPU_METHOD temp_ub_q0p75_o48 "" RAT_FUNC "%6.2" "Grad C" COEFFS 0 1 48 0 0 0.75 /end COMPU_METHOD
/begin COMPU_METHOD temp_ub_q5_o50 "" RAT_FUNC "%6.2" "Grad C" COEFFS 0 1 50 0 0 5 /end COMPU_METHOD
/begin COMPU_METHOD tsquant "" RAT_FUNC "%6.2" "us" COEFFS 0 1.25 0 0 0 1 /end COMPU_METHOD
/begin COMPU_METHOD tv_ub_b100 "" RAT_FUNC "%6.3" "%TV" COEFFS 0 256 0 0 0 100 /end COMPU_METHOD
/begin COMPU_METHOD t_q0p01 "" RAT_FUNC "%6.4" "s" COEFFS 0 100 0 0 0 1 /end COMPU_METHOD
/begin COMPU_METHOD t_q0p1 "" RAT_FUNC "%6.3" "s" COEFFS 0 10 0 0 0 1 /end COMPU_METHOD
/begin COMPU_METHOD vfzg_ub_q1p25 "" RAT_FUNC "%6.2" "km/h" COEFFS 0 1 0 0 0 1.25 /end COMPU_METHOD
/begin COMPU_METHOD zk100msxs_q0p1 "" RAT_FUNC "%6.3" "" COEFFS 0 0 255 0 10 0 /end COMPU_METHOD
/begin COMPU_METHOD zk100msxs_ub_b25p5 "" RAT_FUNC "%6.3" "s" COEFFS 0 0 256 0 10 0 /end COMPU_METHOD
/begin COMPU_METHOD zk100msxs_uw_b6553 "" RAT_FUNC "%6.1" "s" COEFFS 0 0 65536 0 10 0 /end COMPU_METHOD
/begin RECORD_LAYOUT FkfNoShNoOffWUb FNC_VALUES 1 UBYTE COLUMN_DIR DIRECT /end RECORD_LAYOUT
/begin RECORD_LAYOUT GkfWSw FNC_VALUES 1 SWORD COLUMN_DIR DIRECT /end RECORD_LAYOUT
/begin RECORD_LAYOUT GkfWUb FNC_VALUES 1 UBYTE COLUMN_DIR DIRECT /end RECORD_LAYOUT
/begin RECORD_LAYOUT GkfWUw FNC_VALUES 1 UWORD COLUMN_DIR DIRECT /end RECORD_LAYOUT
/begin RECORD_LAYOUT GklWSw FNC_VALUES 1 SWORD COLUMN_DIR DIRECT /end RECORD_LAYOUT
/begin RECORD_LAYOUT GklWUb FNC_VALUES 1 UBYTE COLUMN_DIR DIRECT /end RECORD_LAYOUT
/begin RECORD_LAYOUT GklWUw FNC_VALUES 1 UWORD COLUMN_DIR DIRECT /end RECORD_LAYOUT
/begin RECORD_LAYOUT KfAxUbAyUbSstxUbSstyUbWUb NO_AXIS_PTS_X 1 UBYTE NO_AXIS_PTS_Y 2 UBYTE AXIS_PTS_X 3 UBYTE INDEX_INCR DIRECT AXIS_PTS_Y 4 UBYTE INDEX_INCR DIRECT FNC_VALUES 5 UBYTE COLUMN_DIR DIRECT /end RECORD_LAYOUT
/begin RECORD_LAYOUT KfAxUwAyUwSstxUwSstyUwWUw NO_AXIS_PTS_X 1 UWORD NO_AXIS_PTS_Y 2 UWORD AXIS_PTS_X 3 UWORD INDEX_INCR DIRECT AXIS_PTS_Y 4 UWORD INDEX_INCR DIRECT FNC_VALUES 5 UWORD COLUMN_DIR DIRECT /end RECORD_LAYOUT
/begin RECORD_LAYOUT KlASwSstSwWSw NO_AXIS_PTS_X 1 SWORD AXIS_PTS_X 2 SWORD INDEX_INCR DIRECT FNC_VALUES 3 SWORD COLUMN_DIR DIRECT /end RECORD_LAYOUT
/begin RECORD_LAYOUT KlAUbSstUbWUb NO_AXIS_PTS_X 1 UBYTE AXIS_PTS_X 2 UBYTE INDEX_INCR DIRECT FNC_VALUES 3 UBYTE COLUMN_DIR DIRECT /end RECORD_LAYOUT
/begin RECORD_LAYOUT KlAUbSstUbWUw NO_AXIS_PTS_X 1 UBYTE AXIS_PTS_X 2 UBYTE INDEX_INCR DIRECT FNC_VALUES 3 UWORD COLUMN_DIR DIRECT /end RECORD_LAYOUT
/begin RECORD_LAYOUT KlAUwSstUwWSw NO_AXIS_PTS_X 1 UWORD AXIS_PTS_X 2 UWORD INDEX_INCR DIRECT FNC_VALUES 3 SWORD COLUMN_DIR DIRECT /end RECORD_LAYOUT
/begin RECORD_LAYOUT KlAUwSstUwWUw NO_AXIS_PTS_X 1 UWORD AXIS_PTS_X 2 UWORD INDEX_INCR DIRECT FNC_VALUES 3 UWORD COLUMN_DIR DIRECT /end RECORD_LAYOUT
/begin RECORD_LAYOUT KwbUb FNC_VALUES 1 UBYTE COLUMN_DIR DIRECT /end RECORD_LAYOUT
/begin RECORD_LAYOUT KwbUw FNC_VALUES 1 UWORD COLUMN_DIR DIRECT /end RECORD_LAYOUT
/begin RECORD_LAYOUT KwSb FNC_VALUES 1 SBYTE COLUMN_DIR DIRECT /end RECORD_LAYOUT
/begin RECORD_LAYOUT KwSw FNC_VALUES 1 SWORD COLUMN_DIR DIRECT /end RECORD_LAYOUT
/begin RECORD_LAYOUT KwUb FNC_VALUES 1 UBYTE COLUMN_DIR DIRECT /end RECORD_LAYOUT
/begin RECORD_LAYOUT KwUw FNC_VALUES 1 UWORD COLUMN_DIR DIRECT /end RECORD_LAYOUT
/begin RECORD_LAYOUT SstAUbSstUb NO_AXIS_PTS_X 1 UBYTE AXIS_PTS_X 2 UBYTE INDEX_INCR DIRECT /end RECORD_LAYOUT
/end MODULE
/end PROJECT
