ASAP2_VERSION 1 3
/begin PROJECT X505P_24HG_1 "X505P"
/begin HEADER "" VERSION "X505P_24HG_1" PROJECT_NO X505P_24HG_1 /end HEADER
/begin MODULE DIM ""
/begin MOD_COMMON "" BYTE_ORDER MSB_LAST ALIGNMENT_BYTE 1 ALIGNMENT_WORD 2 ALIGNMENT_LONG 2 /end MOD_COMMON
/begin CHARACTERISTIC APDKGMN "Anzahl Schritte zur Berechnung Minimalwert apdkg_w" VALUE 0x81D17E KwUw 65535.00 dez 0.00 65535.00 FORMAT "%8.2" /end CHARACTERISTIC
/begin CHARACTERISTIC BUSOFFCTR "Zähler für Bus-off-Flanken bis Fehlerspeichereintrag" VALUE 0x810168 KwUb 255.0 DEZ 0.00 255.0 FORMAT "%5.1" /end CHARACTERISTIC
/begin CHARACTERISTIC BUSOFFTIME "Entprellzeit zum Rücksetzen von Bus-off-Fehler" VALUE 0x810169 KwUb 2.550 t10msxs_ub_b2p55 0.00 2.550 FORMAT "%5.3" /end CHARACTERISTIC
/begin CHARACTERISTIC CANVERS "CAN-Versionsbezeichnung" VALUE 0x81016A KwUb 255.0 DEZ 0.00 255.0 FORMAT "%5.1" /end CHARACTERISTIC
/begin CHARACTERISTIC CCMKBI "Kombiausgabe Hubraum" VALUE 0x8183CD KwUb 25.50 vol_q0p1_l 0.00 25.50 FORMAT "%5.2" /end CHARACTERISTIC
/begin CHARACTERISTIC CDCATR "CARB Code Abgastemperaturregelung" VAL_BLK 0x814274 KwbUw 65535.00 dez 0.00 65535.00 FORMAT "%8.2" NUMBER 4 /end CHARACTERISTIC
/begin CHARACTERISTIC CDCATR2 "CARB Code Abgastemperaturregelung Bank 2" VAL_BLK 0x81427C KwbUw 65535.00 dez 0.00 65535.00 FORMAT "%8.2" NUMBER 4 /end CHARACTERISTIC
/begin CHARACTERISTIC CDCATRD "" VAL_BLK 0x814284 KwbUw 65535.00 dez 0.00 65535.00 FORMAT "%8.2" NUMBER 4 /end CHARACTERISTIC
/begin CHARACTERISTIC CDCATRD2 "" VAL_BLK 0x81428C KwbUw 65535.00 dez 0.00 65535.00 FORMAT "%8.2" NUMBER 4 /end CHARACTERISTIC
/begin CHARACTERISTIC CDCATS "CARB Code Abgastemperatursensor" VAL_BLK 0x814294 KwbUw 65535.00 dez 0.00 65535.00 FORMAT "%8.2" NUMBER 4 /end CHARACTERISTIC
/begin CHARACTERISTIC CDCATS2 "CARB Code Abgastemperatursensor Bank 2" VAL_BLK 0x81429C KwbUw 65535.00 dez 0.00 65535.00 FORMAT "%8.2" NUMBER 4 /end CHARACTERISTIC
/begin CHARACTERISTIC CDCBKVP "" VAL_BLK 0x8142A4 KwbUw 65535.00 dez 0.00 65535.00 FORMAT "%8.2" NUMBER 4 /end CHARACTERISTIC
/begin CHARACTERISTIC CDCBM "Codewort CARB: Bezugsmarkengeber" VAL_BLK 0x8142B4 KwbUw 65535.00 dez 0.00 65535.00 FORMAT "%8.2" NUMBER 4 /end CHARACTERISTIC
/begin CHARACTERISTIC CDCCAIR "Codewort CARB: Airbag-Botschaft" VAL_BLK 0x8142CC KwbUw 65535.00 dez 0.00 65535.00 FORMAT "%8.2" NUMBER 4 /end CHARACTERISTIC
/begin CHARACTERISTIC CDCCAS "Codewort CARB: CAN-Schnittstelle, Timeout ASC" VAL_BLK 0x8142DC KwbUw 65535.00 dez 0.00 65535.00 FORMAT "%8.2" NUMBER 4 /end CHARACTERISTIC
/begin CHARACTERISTIC CDCCAT "Codewort CARB: CAN-Schnittstelle, Timeout ASR" VAL_BLK 0x8142E4 KwbUw 65535.00 dez 0.00 65535.00 FORMAT "%8.2" NUMBER 4 /end CHARACTERISTIC
/begin CHARACTERISTIC CDCCGE "Codewort CARB: CAN-Schnittstelle, Timeout EGS" VAL_BLK 0x8142EC KwbUw 65535.00 dez 0.00 65535.00 FORMAT "%8.2" NUMBER 4 /end CHARACTERISTIC
/begin CHARACTERISTIC CDCCGRA "Codewort CARB: GRA-Botschaft (Empfang)" VAL_BLK 0x8142F4 KwbUw 65535.00 dez 0.00 65535.00 FORMAT "%8.2" NUMBER 4 /end CHARACTERISTIC
/begin CHARACTERISTIC CDCCIF "Codewort CARB: CAN-Schnittstelle, interner Fehler" VAL_BLK 0x8142FC KwbUw 65535.00 dez 0.00 65535.00 FORMAT "%8.2" NUMBER 4 /end CHARACTERISTIC
/begin CHARACTERISTIC CDCCINS "Codewort CARB: CAN-Schnittstelle, Timeout Instrument" VAL_BLK 0x814304 KwbUw 65535.00 dez 0.00 65535.00 FORMAT "%8.2" NUMBER 4 /end CHARACTERISTIC
/begin CHARACTERISTIC CDCCKLA "Codewort CARB: CAN-Schnittstelle, Timeout Klima" VAL_BLK 0x81430C KwbUw 65535.00 dez 0.00 65535.00 FORMAT "%8.2" NUMBER 4 /end CHARACTERISTIC
/begin CHARACTERISTIC CDCCLWS "Codewort CARB: CAN-Schnittstelle, Timeout Botschaft Lenkwinkelsensor" VAL_BLK 0x814314 KwbUw 65535.00 dez 0.00 65535.00 FORMAT "%8.2" NUMBER 4 /end CHARACTERISTIC
/begin CHARACTERISTIC CDCDKVM "Codewort CARB: Drosselklappenverschmutzung" VAL_BLK 0x814334 KwbUw 65535.00 dez 0.00 65535.00 FORMAT "%8.2" NUMBER 4 /end CHARACTERISTIC
/begin CHARACTERISTIC CDCN "Codewort CARB: Drehzahlsignalgeber" VAL_BLK 0x8145AC KwbUw 65535.00 dez 0.00 65535.00 FORMAT "%8.2" NUMBER 4 /end CHARACTERISTIC
/begin CHARACTERISTIC CDCTOL "Codewort CARB: Öltemperatur" VAL_BLK 0x81468C KwbUw 65535.00 dez 0.00 65535.00 FORMAT "%8.2" NUMBER 4 /end CHARACTERISTIC
/begin CHARACTERISTIC CDCTUM "Codewort CARB: Umgebungs(-luft)-Temperatur TUM" VAL_BLK 0x814694 KwbUw 65535.00 dez 0.00 65535.00 FORMAT "%8.2" NUMBER 4 /end CHARACTERISTIC
/begin CHARACTERISTIC CDKATR "Codewort Kunde: Abgastemperaturregelung Bank 2" VAL_BLK 0x81473C KwbUw 65535.00 dez 0.00 65535.00 FORMAT "%8.2" NUMBER 4 /end CHARACTERISTIC
/begin CHARACTERISTIC CDKATR2 "" VAL_BLK 0x814744 KwbUw 65535.00 dez 0.00 65535.00 FORMAT "%8.2" NUMBER 4 /end CHARACTERISTIC
/begin CHARACTERISTIC CDKATRD "" VAL_BLK 0x81474C KwbUw 65535.00 dez 0.00 65535.00 FORMAT "%8.2" NUMBER 4 /end CHARACTERISTIC
/begin CHARACTERISTIC CDKATRD2 "" VAL_BLK 0x814754 KwbUw 65535.00 dez 0.00 65535.00 FORMAT "%8.2" NUMBER 4 /end CHARACTERISTIC
/begin CHARACTERISTIC CDKATS "Codewort Kunde: Abgastemperaturesensor" VAL_BLK 0x81475C KwbUw 65535.00 dez 0.00 65535.00 FORMAT "%8.2" NUMBER 4 /end CHARACTERISTIC
/begin CHARACTERISTIC CDKATS2 "Codewort Kunde: Abgastemperatursensor bank 2" VAL_BLK 0x814764 KwbUw 65535.00 dez 0.00 65535.00 FORMAT "%8.2" NUMBER 4 /end CHARACTERISTIC
/begin CHARACTERISTIC CDKBKVP "" VAL_BLK 0x81476C KwbUw 65535.00 dez 0.00 65535.00 FORMAT "%8.2" NUMBER 4 /end CHARACTERISTIC
/begin CHARACTERISTIC CDKBM "Codewort Kunde: Bezugsmarkengeber" VAL_BLK 0x81477C KwbUw 65535.00 dez 0.00 65535.00 FORMAT "%8.2" NUMBER 4 /end CHARACTERISTIC
/begin CHARACTERISTIC CDKCAIR "Codewort Kunde: Airbag-Botschaft" VAL_BLK 0x814794 KwbUw 65535.00 dez 0.00 65535.00 FORMAT "%8.2" NUMBER 4 /end CHARACTERISTIC
/begin CHARACTERISTIC CDKCAS "Codewort Kunde: CAN-Schnittstelle, Timeout ASC" VAL_BLK 0x8147A4 KwbUw 65535.00 dez 0.00 65535.00 FORMAT "%8.2" NUMBER 4 /end CHARACTERISTIC
/begin CHARACTERISTIC CDKCAT "Codewort Kunde: CAN-Schnittstelle, Timeout ASR" VAL_BLK 0x8147AC KwbUw 65535.00 dez 0.00 65535.00 FORMAT "%8.2" NUMBER 4 /end CHARACTERISTIC
/begin CHARACTERISTIC CDKCGE "Codewort Kunde: CAN-Schnittstelle, Timeout EGS" VAL_BLK 0x8147B4 KwbUw 65535.00 dez 0.00 65535.00 FORMAT "%8.2" NUMBER 4 /end CHARACTERISTIC
/begin CHARACTERISTIC CDKCGRA "Codewort Kunde: GRA-Botschaft (Empfang)" VAL_BLK 0x8147BC KwbUw 65535.00 dez 0.00 65535.00 FORMAT "%8.2" NUMBER 4 /end CHARACTERISTIC
/begin CHARACTERISTIC CDKCIF "Codewort Kunde: CAN-Schnittstelle, interner Fehler" VAL_BLK 0x8147C4 KwbUw 65535.00 dez 0.00 65535.00 FORMAT "%8.2" NUMBER 4 /end CHARACTERISTIC
/begin CHARACTERISTIC CDKCINS "Codewort Kunde: CAN- timeout, Instrumente" VAL_BLK 0x8147CC KwbUw 65535.00 dez 0.00 65535.00 FORMAT "%8.2" NUMBER 4 /end CHARACTERISTIC
/begin CHARACTERISTIC CDKCKLA "Codewort Kunde: CAN-Schnittstelle, Timeout Klima" VAL_BLK 0x8147D4 KwbUw 65535.00 dez 0.00 65535.00 FORMAT "%8.2" NUMBER 4 /end CHARACTERISTIC
/begin CHARACTERISTIC CDKCLWS "Codewort Kunde: CAN-Schnittstelle, Timeout Botschaft Lenkwinkelsensor" VAL_BLK 0x8147DC KwbUw 65535.00 dez 0.00 65535.00 FORMAT "%8.2" NUMBER 4 /end CHARACTERISTIC
/begin CHARACTERISTIC CDKDKVM "Codewort Kunde: Drosselklappenverschmutzung" VAL_BLK 0x8147FC KwbUw 65535.00 dez 0.00 65535.00 FORMAT "%8.2" NUMBER 4 /end CHARACTERISTIC
/begin CHARACTERISTIC CDKN "Codewort Kunde: Drehzahlsignalgeber" VAL_BLK 0x814A74 KwbUw 65535.00 dez 0.00 65535.00 FORMAT "%8.2" NUMBER 4 /end CHARACTERISTIC
/begin CHARACTERISTIC CDKTOL "Codewort Kunde: Öltemperatur" VAL_BLK 0x814B54 KwbUw 65535.00 dez 0.00 65535.00 FORMAT "%8.2" NUMBER 4 /end CHARACTERISTIC
/begin CHARACTERISTIC CDKTUM "Codewort Kunde: Umgebungstemperatur" VAL_BLK 0x814B5C KwbUw 65535.00 dez 0.00 65535.00 FORMAT "%8.2" NUMBER 4 /end CHARACTERISTIC
/begin CHARACTERISTIC CDTATR "Fehlerpfadcode Abgastemperaturregelung" VALUE 0x814BEC KwUw 65535.00 dez 0.00 65535.00 FORMAT "%8.2" /end CHARACTERISTIC
/begin CHARACTERISTIC CDTATR2 "Fehlerpfadcode Abgastemperaturregelung Bank 2" VALUE 0x814BEE KwUw 65535.00 dez 0.00 65535.00 FORMAT "%8.2" /end CHARACTERISTIC
/begin CHARACTERISTIC CDTATRD "" VALUE 0x814BF0 KwUw 65535.00 dez 0.00 65535.00 FORMAT "%8.2" /end CHARACTERISTIC
/begin CHARACTERISTIC CDTATRD2 "" VALUE 0x814BF2 KwUw 65535.00 dez 0.00 65535.00 FORMAT "%8.2" /end CHARACTERISTIC
/begin CHARACTERISTIC CDTATS "Codewort Tester: Abgastemperatursensor" VALUE 0x814BF4 KwUw 65535.00 dez 0.00 65535.00 FORMAT "%8.2" /end CHARACTERISTIC
/begin CHARACTERISTIC CDTATS2 "Codewort Tester: Abgastemperatursensor Bank 2" VALUE 0x814BF6 KwUw 65535.00 dez 0.00 65535.00 FORMAT "%8.2" /end CHARACTERISTIC
/begin CHARACTERISTIC CDTBKVP "" VALUE 0x814BF8 KwUw 65535.00 dez 0.00 65535.00 FORMAT "%8.2" /end CHARACTERISTIC
/begin CHARACTERISTIC CDTBM "Codewort Tester: Bezugsmarkengeber" VALUE 0x814BFC KwUw 65535.00 dez 0.00 65535.00 FORMAT "%8.2" /end CHARACTERISTIC
/begin CHARACTERISTIC CDTCAIR "Codewort Tester: Airbag-Botschaft" VALUE 0x814C02 KwUw 65535.00 dez 0.00 65535.00 FORMAT "%8.2" /end CHARACTERISTIC
/begin CHARACTERISTIC CDTCAS "Codewort Tester: CAN-Schnittstelle, Timeout ASC" VALUE 0x814C06 KwUw 65535.00 dez 0.00 65535.00 FORMAT "%8.2" /end CHARACTERISTIC
/begin CHARACTERISTIC CDTCAT "Codewort Tester: CAN-Schnittstelle, Timeout ASR" VALUE 0x814C08 KwUw 65535.00 dez 0.00 65535.00 FORMAT "%8.2" /end CHARACTERISTIC
/begin CHARACTERISTIC CDTCGE "Codewort Tester: CAN-Schnittstelle, Timeout EGS" VALUE 0x814C0A KwUw 65535.00 dez 0.00 65535.00 FORMAT "%8.2" /end CHARACTERISTIC
/begin CHARACTERISTIC CDTCGRA "Codewort Tester: GRA-Botschaft (Empfang)" VALUE 0x814C0C KwUw 65535.00 dez 0.00 65535.00 FORMAT "%8.2" /end CHARACTERISTIC
/begin CHARACTERISTIC CDTCIF "Codewort Tester: CAN-Schnittstelle, interner Fehler" VALUE 0x814C0E KwUw 65535.00 dez 0.00 65535.00 FORMAT "%8.2" /end CHARACTERISTIC
/begin CHARACTERISTIC CDTCINS "Codewort Tester: CAN-Timeout, Instrumente" VALUE 0x814C10 KwUw 65535.00 dez 0.00 65535.00 FORMAT "%8.2" /end CHARACTERISTIC
/begin CHARACTERISTIC CDTCKLA "Codewort Tester: CAN-Schnittstelle, Timeout Klima" VALUE 0x814C12 KwUw 65535.00 dez 0.00 65535.00 FORMAT "%8.2" /end CHARACTERISTIC
/begin CHARACTERISTIC CDTCLWS "Codewort Tester: Lenkwinkel-Botschaft" VALUE 0x814C14 KwUw 65535.00 dez 0.00 65535.00 FORMAT "%8.2" /end CHARACTERISTIC
/begin CHARACTERISTIC CDTDKVM "Codewort Tester: Drosselklappenverschmutzung" VALUE 0x814C1C KwUw 65535.00 dez 0.00 65535.00 FORMAT "%8.2" /end CHARACTERISTIC
/begin CHARACTERISTIC CDTN "Codewort Tester: Drehzahlsignalgeber" VALUE 0x814CBA KwUw 65535.00 dez 0.00 65535.00 FORMAT "%8.2" /end CHARACTERISTIC
/begin CHARACTERISTIC CDTTOL "Codewort Tester: Öltemperatur" VALUE 0x814CF2 KwUw 65535.00 dez 0.00 65535.00 FORMAT "%8.2" /end CHARACTERISTIC
/begin CHARACTERISTIC CDTTUM "Codewort Tester: Umgebungstemperatur TUM" VALUE 0x814CF4 KwUw 65535.00 dez 0.00 65535.00 FORMAT "%8.2" /end CHARACTERISTIC
/begin CHARACTERISTIC CL30LINE "30. Linie der Klassentabelle" VAL_BLK 0x81BD44 KwbUb 255.0 dez 0.00 255.0 FORMAT "%5.1" NUMBER 14 /end CHARACTERISTIC
/begin CHARACTERISTIC CL31LINE "31. Linie der Klassentabelle" VAL_BLK 0x81BD52 KwbUb 255.0 dez 0.00 255.0 FORMAT "%5.1" NUMBER 14 /end CHARACTERISTIC
/begin CHARACTERISTIC CL32LINE "32. Linie der Klassentabelle" VAL_BLK 0x81BD60 KwbUb 255.0 dez 0.00 255.0 FORMAT "%5.1" NUMBER 14 /end CHARACTERISTIC
/begin CHARACTERISTIC CL33LINE "33. Linie der Klassentabelle" VAL_BLK 0x81BD6E KwbUb 255.0 dez 0.00 255.0 FORMAT "%5.1" NUMBER 14 /end CHARACTERISTIC
/begin CHARACTERISTIC CL34LINE "34. Linie der Klassentabelle" VAL_BLK 0x81BD7C KwbUb 255.0 dez 0.00 255.0 FORMAT "%5.1" NUMBER 14 /end CHARACTERISTIC
/begin CHARACTERISTIC CL35LINE "35. Linie der Klassentabelle" VAL_BLK 0x81BD8A KwbUb 255.0 dez 0.00 255.0 FORMAT "%5.1" NUMBER 14 /end CHARACTERISTIC
/begin CHARACTERISTIC CL36LINE "36. Linie der Klassentabelle" VAL_BLK 0x81BD98 KwbUb 255.0 dez 0.00 255.0 FORMAT "%5.1" NUMBER 14 /end CHARACTERISTIC
/begin CHARACTERISTIC CL37LINE "37. Linie der Klassentabelle" VAL_BLK 0x81BDA6 KwbUb 255.0 dez 0.00 255.0 FORMAT "%5.1" NUMBER 14 /end CHARACTERISTIC
/begin CHARACTERISTIC CL38LINE "38. Linie der Klassentabelle" VAL_BLK 0x81BDB4 KwbUb 255.0 dez 0.00 255.0 FORMAT "%5.1" NUMBER 14 /end CHARACTERISTIC
/begin CHARACTERISTIC CL39LINE "39. Linie der Klassentabelle" VAL_BLK 0x81BDC2 KwbUb 255.0 dez 0.00 255.0 FORMAT "%5.1" NUMBER 14 /end CHARACTERISTIC
/begin CHARACTERISTIC CLAATR "Fehlerklasse Abgastemperaturregelung" VALUE 0x8108D4 KwUb 255.0 dez 0.00 255.0 FORMAT "%5.1" /end CHARACTERISTIC
/begin CHARACTERISTIC CLAATR2 "Fehlerklasse Abgastemperaturregelung Bank 2" VALUE 0x8108D5 KwUb 255.0 dez 0.00 255.0 FORMAT "%5.1" /end CHARACTERISTIC
/begin CHARACTERISTIC CLAATRD "Fehlerklasse: Bankdifferenz ATR" VALUE 0x8108D6 KwUb 255.0 dez 0.00 255.0 FORMAT "%5.1" /end CHARACTERISTIC
/begin CHARACTERISTIC CLAATRD2 "Fehlerklasse: Bankdifferenz ATR, Bank 2" VALUE 0x8108D7 KwUb 255.0 dez 0.00 255.0 FORMAT "%5.1" /end CHARACTERISTIC
/begin CHARACTERISTIC CLAATS "Fehlerklasse Abgastemperatursensor" VALUE 0x8108D8 KwUb 255.0 dez 0.00 255.0 FORMAT "%5.1" /end CHARACTERISTIC
/begin CHARACTERISTIC CLAATS2 "Fehlerklasse Abgastemperatursensor Bank 2" VALUE 0x8108D9 KwUb 255.0 dez 0.00 255.0 FORMAT "%5.1" /end CHARACTERISTIC
/begin CHARACTERISTIC CLABKVP "Fehlerklasse: BKV-Pumpe" VALUE 0x8108DA KwUb 255.0 dez 0.00 255.0 FORMAT "%5.1" /end CHARACTERISTIC
/begin CHARACTERISTIC CLABM "Fehlerklasse: Bezugsmarkengeber" VALUE 0x8108DC KwUb 255.0 dez 0.00 255.0 FORMAT "%5.1" /end CHARACTERISTIC
/begin CHARACTERISTIC CLACAIR "Fehlerklasse: Airbag-Botschaft" VALUE 0x8108DF KwUb 255.0 dez 0.00 255.0 FORMAT "%5.1" /end CHARACTERISTIC
/begin CHARACTERISTIC CLACAS "Fehlerklasse: CAN-Timeout ASC-Botschaft" VALUE 0x8108E1 KwUb 255.0 dez 0.00 255.0 FORMAT "%5.1" /end CHARACTERISTIC
/begin CHARACTERISTIC CLACAT "Fehlerklasse: CAN-Schnittstelle, Timeout ASR" VALUE 0x8108E2 KwUb 255.0 dez 0.00 255.0 FORMAT "%5.1" /end CHARACTERISTIC
/begin CHARACTERISTIC CLACGE "Fehlerklasse: CAN-Timeout EGS-Botschaft" VALUE 0x8108E3 KwUb 255.0 dez 0.00 255.0 FORMAT "%5.1" /end CHARACTERISTIC
/begin CHARACTERISTIC CLACGRA "Fehlerklasse: GRA-Botschaft (Empfang)" VALUE 0x8108E4 KwUb 255.0 dez 0.00 255.0 FORMAT "%5.1" /end CHARACTERISTIC
/begin CHARACTERISTIC CLACIF "Fehlerklasse: CAN-Schnittstelle, interner Fehler" VALUE 0x8108E5 KwUb 255.0 dez 0.00 255.0 FORMAT "%5.1" /end CHARACTERISTIC
/begin CHARACTERISTIC CLACINS "Fehlerklasse: CAN-Timeout Botschaft Kombiinstrument" VALUE 0x8108E6 KwUb 255.0 dez 0.00 255.0 FORMAT "%5.1" /end CHARACTERISTIC
/begin CHARACTERISTIC CLACKLA "Fehlerklasse: Botschaft Klima (CAN)" VALUE 0x8108E7 KwUb 255.0 dez 0.00 255.0 FORMAT "%5.1" /end CHARACTERISTIC
/begin CHARACTERISTIC CLACLWS "Fehlerklasse: CAN-Schnittstelle, Timeout Botschaft Lenkwinkelsensor" VALUE 0x8108E8 KwUb 255.0 dez 0.00 255.0 FORMAT "%5.1" /end CHARACTERISTIC
/begin CHARACTERISTIC CLADKVM "Fehlerklasse: Drosselklappenverschmutzung" VALUE 0x8108EC KwUb 255.0 dez 0.00 255.0 FORMAT "%5.1" /end CHARACTERISTIC
/begin CHARACTERISTIC CLAN "Fehlerklasse: Drehzahlgeber" VALUE 0x81093B KwUb 255.0 dez 0.00 255.0 FORMAT "%5.1" /end CHARACTERISTIC
/begin CHARACTERISTIC CLATOL "Fehlerklasse: (Motor-) Oeltemperatur TOL" VALUE 0x810957 KwUb 255.0 dez 0.00 255.0 FORMAT "%5.1" /end CHARACTERISTIC
/begin CHARACTERISTIC CLATUM "Fehlerklasse: Umgebungstemperatur TUM" VALUE 0x810958 KwUb 255.0 dez 0.00 255.0 FORMAT "%5.1" /end CHARACTERISTIC
/begin CHARACTERISTIC CORTINC "Wert der bei Zahnkorrektur aufaddiert wird" VALUE 0x810B3D KwUb 255.0 dez 0.00 255.0 FORMAT "%5.1" /end CHARACTERISTIC
/begin CHARACTERISTIC CORTINIT "Initialisierungswert für Zähler Zahnkorrektur" VALUE 0x818463 KwUb 255.0 dez 0.00 255.0 FORMAT "%5.1" /end CHARACTERISTIC
/begin CHARACTERISTIC CORTMX "Maximal zulässiger Wert für den Zahnkorrekturzähler" VALUE 0x810B3E KwUb 255.0 dez 0.00 255.0 FORMAT "%5.1" /end CHARACTERISTIC
/begin CHARACTERISTIC CSAIR "Soll-Checksumme der Airbagbotschaft" VALUE 0x81016B KwUb 255.0 DEZ 0.00 255.0 FORMAT "%5.1" /end CHARACTERISTIC
/begin CHARACTERISTIC CWBBDECJ "Codewort Abwürgeschutz DECJ aktiv" VALUE 0x8187BF KwUb 255.0 dez 0.00 255.0 FORMAT "%5.1" /end CHARACTERISTIC
/begin CHARACTERISTIC CWCANKBI "Codewort für automatische Kombi-Botschafts-Erkennung" VALUE 0x81016C KwUb 255.0 DEZ 0.00 255.0 FORMAT "%5.1" /end CHARACTERISTIC
/begin CHARACTERISTIC CWCANLWS "Codewort für automatische Erkennung LWS-Botschaft" VALUE 0x81016D KwUb 255.0 DEZ 0.00 255.0 FORMAT "%5.1" /end CHARACTERISTIC
/begin CHARACTERISTIC CWCANMD "Codewort zur Bildung der CAN-Ausgabe Momentenangaben ungenau" VALUE 0x81016E KwUb 255.0 DEZ 0.00 255.0 FORMAT "%5.1" /end CHARACTERISTIC
/begin CHARACTERISTIC CWCAUVW "Codewort für Audi/VW CAN-Ausgabe" VALUE 0x81016F KwUb 255.0 DEZ 0.00 255.0 FORMAT "%5.1" /end CHARACTERISTIC
/begin CHARACTERISTIC CWCDCUM "Codewort zur Umschaltung der CDCs auf den jeweiligen Markt" VALUE 0x818462 KwUb 255.0 dez 0.00 255.0 FORMAT "%5.1" /end CHARACTERISTIC
/begin CHARACTERISTIC CWCFS "Codewort zum Bilden von S_fs" VALUE 0x810170 KwUb 255.0 DEZ 0.00 255.0 FORMAT "%5.1" /end CHARACTERISTIC
/begin CHARACTERISTIC CWCSER "Codewort für Auswertung der Airbag-Botschaft" VALUE 0x810171 KwUb 255.0 DEZ 0.00 255.0 FORMAT "%5.1" /end CHARACTERISTIC
/begin CHARACTERISTIC CWDDKV "Codewort DDKV" VALUE 0x818849 KwUb 255.0 dez 0.00 255.0 FORMAT "%5.1" /end CHARACTERISTIC
/begin CHARACTERISTIC CWFLC "Codewort für Steuerung MIL-ON entsprechend OBDII / EOBD" VALUE 0x810B3A KwUb 255.0 dez 0.00 255.0 FORMAT "%5.1" /end CHARACTERISTIC
/begin CHARACTERISTIC CWGC_0_A "Getriebe-Codierung (CAN)" VALUE 0x8136EE KwUb 255.0 DEZ 0.00 255.0 FORMAT "%5.1" /end CHARACTERISTIC
/begin CHARACTERISTIC CWGC_1_A "Getriebe-Codierung (CAN)" VALUE 0x8136EF KwUb 255.0 DEZ 0.00 255.0 FORMAT "%5.1" /end CHARACTERISTIC
/begin CHARACTERISTIC CWGC_2_A "Getriebe-Codierung (CAN)" VALUE 0x8136F0 KwUb 255.0 DEZ 0.00 255.0 FORMAT "%5.1" /end CHARACTERISTIC
/begin CHARACTERISTIC CWGC_3_A "Getriebe-Codierung (CAN)" VALUE 0x8136F1 KwUb 255.0 DEZ 0.00 255.0 FORMAT "%5.1" /end CHARACTERISTIC
/begin CHARACTERISTIC CWGC_4_A "Getriebe-Codierung (CAN)" VALUE 0x8136F2 KwUb 255.0 DEZ 0.00 255.0 FORMAT "%5.1" /end CHARACTERISTIC
/begin CHARACTERISTIC CWGC_5_A "Getriebe-Codierung (CAN)" VALUE 0x8136F3 KwUb 255.0 DEZ 0.00 255.0 FORMAT "%5.1" /end CHARACTERISTIC
/begin CHARACTERISTIC CWGC_6_A "Getriebe-Codierung (CAN)" VALUE 0x8136F4 KwUb 255.0 DEZ 0.00 255.0 FORMAT "%5.1" /end CHARACTERISTIC
/begin CHARACTERISTIC CWGC_7_A "Getriebe-Codierung (CAN)" VALUE 0x8136F5 KwUb 255.0 DEZ 0.00 255.0 FORMAT "%5.1" /end CHARACTERISTIC
/begin CHARACTERISTIC CWGEEIN "Codewort für Übernahme der Getriebeanforderung" VALUE 0x810172 KwUb 255.0 DEZ 0.00 255.0 FORMAT "%5.1" /end CHARACTERISTIC
/begin CHARACTERISTIC CW_CAN_C "Codewort für Kodierfehlerüberwachung" VALUE 0x810173 KwUb 255.0 DEZ 0.00 255.0 FORMAT "%5.1" /end CHARACTERISTIC
/begin CHARACTERISTIC CW_CAN_R_0___A "Codewort für CAN-Empfangskonfiguration" VALUE 0x8136CE KwUw 65535.00 DEZ 0.00 65535.00 FORMAT "%8.2" /end CHARACTERISTIC
/begin CHARACTERISTIC CW_CAN_R_1___A "Codewort für CAN-Empfangskonfiguration" VALUE 0x8136D0 KwUw 65535.00 DEZ 0.00 65535.00 FORMAT "%8.2" /end CHARACTERISTIC
/begin CHARACTERISTIC CW_CAN_R_2___A "Codewort für CAN-Empfangskonfiguration" VALUE 0x8136D2 KwUw 65535.00 DEZ 0.00 65535.00 FORMAT "%8.2" /end CHARACTERISTIC
/begin CHARACTERISTIC CW_CAN_R_3___A "Codewort für CAN-Empfangskonfiguration" VALUE 0x8136D4 KwUw 65535.00 DEZ 0.00 65535.00 FORMAT "%8.2" /end CHARACTERISTIC
/begin CHARACTERISTIC CW_CAN_R_4___A "Codewort für CAN-Empfangskonfiguration" VALUE 0x8136D6 KwUw 65535.00 DEZ 0.00 65535.00 FORMAT "%8.2" /end CHARACTERISTIC
/begin CHARACTERISTIC CW_CAN_R_5___A "Codewort für CAN-Empfangskonfiguration" VALUE 0x8136D8 KwUw 65535.00 DEZ 0.00 65535.00 FORMAT "%8.2" /end CHARACTERISTIC
/begin CHARACTERISTIC CW_CAN_R_6___A "Codewort für CAN-Empfangskonfiguration" VALUE 0x8136DA KwUw 65535.00 DEZ 0.00 65535.00 FORMAT "%8.2" /end CHARACTERISTIC
/begin CHARACTERISTIC CW_CAN_R_7___A "Codewort für CAN-Empfangskonfiguration" VALUE 0x8136DC KwUw 65535.00 DEZ 0.00 65535.00 FORMAT "%8.2" /end CHARACTERISTIC
/begin CHARACTERISTIC CW_CAN_S_0___A "Codewort für CAN-Sendekonfiguration" VALUE 0x8136DE KwUw 65535.00 DEZ 0.00 65535.00 FORMAT "%8.2" /end CHARACTERISTIC
/begin CHARACTERISTIC CW_CAN_S_1___A "Codewort für CAN-Sendekonfiguration" VALUE 0x8136E0 KwUw 65535.00 DEZ 0.00 65535.00 FORMAT "%8.2" /end CHARACTERISTIC
/begin CHARACTERISTIC CW_CAN_S_2___A "Codewort für CAN-Sendekonfiguration" VALUE 0x8136E2 KwUw 65535.00 DEZ 0.00 65535.00 FORMAT "%8.2" /end CHARACTERISTIC
/begin CHARACTERISTIC CW_CAN_S_3___A "Codewort für CAN-Sendekonfiguration" VALUE 0x8136E4 KwUw 65535.00 DEZ 0.00 65535.00 FORMAT "%8.2" /end CHARACTERISTIC
/begin CHARACTERISTIC CW_CAN_S_4___A "Codewort für CAN-Sendekonfiguration" VALUE 0x8136E6 KwUw 65535.00 DEZ 0.00 65535.00 FORMAT "%8.2" /end CHARACTERISTIC
/begin CHARACTERISTIC CW_CAN_S_5___A "Codewort für CAN-Sendekonfiguration" VALUE 0x8136E8 KwUw 65535.00 DEZ 0.00 65535.00 FORMAT "%8.2" /end CHARACTERISTIC
/begin CHARACTERISTIC CW_CAN_S_6___A "Codewort für CAN-Sendekonfiguration" VALUE 0x8136EA KwUw 65535.00 DEZ 0.00 65535.00 FORMAT "%8.2" /end CHARACTERISTIC
/begin CHARACTERISTIC CW_CAN_S_7___A "Codewort für CAN-Sendekonfiguration" VALUE 0x8136EC KwUw 65535.00 DEZ 0.00 65535.00 FORMAT "%8.2" /end CHARACTERISTIC
/begin CHARACTERISTIC DDKVFZMN "Anzahl verschmutzte DK erkannt, Minimalwert" VALUE 0x81884A KwUb 255.0 dez 0.00 255.0 FORMAT "%5.1" /end CHARACTERISTIC
/begin CHARACTERISTIC DDKVHZMN "Anzahl DK ohne erkannte Verschmutzung, Minimalwert" VALUE 0x81884B KwUb 255.0 dez 0.00 255.0 FORMAT "%5.1" /end CHARACTERISTIC
/begin CHARACTERISTIC DFEMPOS "Delta Schwelle für oberen Anschlag des mult. Anteils des Füllungsabgleichs" VALUE 0x81D2CE KwUw 3.999939 fak_uw_b4 0.00 3.999939 FORMAT "%8.6" /end CHARACTERISTIC
/begin CHARACTERISTIC DFEMPUS "Delta Schwelle für unteren Anschlag des mult. Anteils des Füllungsabgleichs" VALUE 0x81D2D0 KwUw 3.999939 fak_uw_b4 0.00 3.999939 FORMAT "%8.6" /end CHARACTERISTIC
/begin CHARACTERISTIC DFPSLBIT "Selektionsbits für Kennzeichnung der aktivierten Fehlerpfade" VAL_BLK 0x81BDD0 KwbUw 65535.00 dez 0.00 65535.00 FORMAT "%8.2" NUMBER 16 /end CHARACTERISTIC
/begin CHARACTERISTIC DFRAOS "Delta Schwelle für oberen Anschlag des mult. Anteils der Gemischadaption" VALUE 0x81D2D2 KwUw 3.999939 fak_uw_b4 0.00 3.999939 FORMAT "%8.6" /end CHARACTERISTIC
/begin CHARACTERISTIC DFRAUS "Delta Schwelle für unteren Anschlag des mult. Anteils der Gemischadaption" VALUE 0x81D2D4 KwUw 3.999939 fak_uw_b4 0.00 3.999939 FORMAT "%8.6" /end CHARACTERISTIC
/begin CHARACTERISTIC DFUELSANMX "Delta Füllungssensor zu Alpha/n-System Betragsmaximalwert" VALUE 0x81D180 KwUw 1.999969 fak_uw_b2 0.00 1.999969 FORMAT "%8.6" /end CHARACTERISTIC
/begin CHARACTERISTIC DLATRNP "Schwelle Delta Lambda für Erkennung unplausible Bankabweichung ATR" VALUE 0x819659 KwSb 1.992 fak_sb_b1 -1.000 0.9922 FORMAT "%5.3" /end CHARACTERISTIC
/begin CHARACTERISTIC DLEATRN "Schwelle Delta Lambda für Erkennung Fehler Abgastemperaturregelung" CURVE 0x81DD9A KlAUbSstUbWSb 1.992 fak_sb_b1 -1.000 0.9922 FORMAT "%5.3"
 /begin AXIS_DESCR STD_AXIS nmot nmot_ub_q40 5 0.00 10200. FORMAT "%5.0" DEPOSIT ABSOLUTE /end AXIS_DESCR
/end CHARACTERISTIC
/begin CHARACTERISTIC DPBKVLE "zulässiger Druckanstieg bei Leckage" VALUE 0x82912E KwSw 2559.961 p_sw_q0p039 -1280.000 1279.961 FORMAT "%8.3" /end CHARACTERISTIC
/begin CHARACTERISTIC DPBKVP "Druckdelta, das in der Zeit TDDBKVP evakuiert werden kann" VALUE 0x829126 KwUw 2559.961 p_uw_q0p039 0.00 2559.961 FORMAT "%8.3" /end CHARACTERISTIC
/begin CHARACTERISTIC DPBKVPMN "Toleranz von pubkv_w*FBKVP (min. Pump-Druck) und Toleranz Drucksensor im BKV" VALUE 0x829128 KwUw 2559.961 p_uw_q0p039 0.00 2559.961 FORMAT "%8.3" /end CHARACTERISTIC
/begin CHARACTERISTIC DPSBKV "Delta Druck für Plausibilität von Bremskraftverstärkerdruck mit Saugrohrdruck" VALUE 0x829130 KwUw 2559.961 p_uw_q0p039 0.00 2559.961 FORMAT "%8.3" /end CHARACTERISTIC
/begin CHARACTERISTIC DPSPBKVNPH "min. Druckdifferenz zw. ps und pbkv für Heilung npl-Fehler(Leckage)" VALUE 0x829132 KwSw 2559.961 p_sw_q0p039 -1280.000 1279.961 FORMAT "%8.3" /end CHARACTERISTIC
/begin CHARACTERISTIC DPSPUBKVH "Delta zwischen Saugrohrdruck und Umgebungsdruck für DSBKV-Healing" VALUE 0x829134 KwSw 2559.961 p_sw_q0p039 -1280.000 1279.961 FORMAT "%8.3" /end CHARACTERISTIC
/begin CHARACTERISTIC DPUBKV "Delta Druck für Plaus. von Bremskraftverstärkerdruck mit Umgebungsdruck" VALUE 0x829136 KwUw 2559.961 p_uw_q0p039 0.00 2559.961 FORMAT "%8.3" /end CHARACTERISTIC
/begin CHARACTERISTIC DTPATS "Toleranz Periodendauer Abgastemperatursensor" VALUE 0x819655 KwUb 255.0 t100msxms_ub_b255 0.00 255.0 FORMAT "%5.1" /end CHARACTERISTIC
/begin CHARACTERISTIC ESKONF_0_A "Konfiguration Endstufen" VAL_BLK 0x810DA7 KwbUb 255.0 dez 0.00 255.0 FORMAT "%5.1" NUMBER 7 /end CHARACTERISTIC
/begin CHARACTERISTIC ESKONF_1_A "Konfiguration Endstufen" VAL_BLK 0x810DAE KwbUb 255.0 dez 0.00 255.0 FORMAT "%5.1" NUMBER 7 /end CHARACTERISTIC
/begin CHARACTERISTIC FDKVDELTA "Faktor Drosselklappenverschmutzung Delta Hysterese" VALUE 0x81D182 KwUw 99.99847 rel_uw_b100 0.00 99.99847 FORMAT "%8.5" /end CHARACTERISTIC
/begin CHARACTERISTIC FDKVMX "Faktor Drosselklappenverschmutzung Maximalwert" VALUE 0x81D184 KwUw 99.99847 rel_uw_b100 0.00 99.99847 FORMAT "%8.5" /end CHARACTERISTIC
/begin CHARACTERISTIC FEMPOS "Schwelle für oberen Anschlag des mult. Anteils des Füllungsabgleichs" VALUE 0x81D2D6 KwUw 3.999939 fak_uw_b4 0.00 3.999939 FORMAT "%8.6" /end CHARACTERISTIC
/begin CHARACTERISTIC FEMPUS "Schwelle für unteren Anschlag des mult. Anteils des Füllungsabgleichs" VALUE 0x81D2D8 KwUw 3.999939 fak_uw_b4 0.00 3.999939 FORMAT "%8.6" /end CHARACTERISTIC
/begin CHARACTERISTIC FFTATR "Tabelle der Umweltbed. Abgastemperaturregelung" VAL_BLK 0x810971 KwbUb 255.0 dez 0.00 255.0 FORMAT "%5.1" NUMBER 2 /end CHARACTERISTIC
/begin CHARACTERISTIC FFTATR2 "Tabelle der Umweltbed. Abgastemperaturregelung Bank 2" VAL_BLK 0x810973 KwbUb 255.0 dez 0.00 255.0 FORMAT "%5.1" NUMBER 2 /end CHARACTERISTIC
/begin CHARACTERISTIC FFTATRD "" VAL_BLK 0x810975 KwbUb 255.0 dez 0.00 255.0 FORMAT "%5.1" NUMBER 2 /end CHARACTERISTIC
/begin CHARACTERISTIC FFTATRD2 "" VAL_BLK 0x810977 KwbUb 255.0 dez 0.00 255.0 FORMAT "%5.1" NUMBER 2 /end CHARACTERISTIC
/begin CHARACTERISTIC FFTATS "Tabelle der Umweltbed. Abgastemperatursensor" VAL_BLK 0x810979 KwbUb 255.0 dez 0.00 255.0 FORMAT "%5.1" NUMBER 2 /end CHARACTERISTIC
/begin CHARACTERISTIC FFTATS2 "Tabelle der Umweltbed. Abgastemperatursensor Bank 2" VAL_BLK 0x81097B KwbUb 255.0 dez 0.00 255.0 FORMAT "%5.1" NUMBER 2 /end CHARACTERISTIC
/begin CHARACTERISTIC FFTBKVP "" VAL_BLK 0x81097D KwbUb 255.0 dez 0.00 255.0 FORMAT "%5.1" NUMBER 2 /end CHARACTERISTIC
/begin CHARACTERISTIC FFTBM "Freeze Frame Tabelle: Bezugsmarkengeber" VAL_BLK 0x810981 KwbUb 255.0 dez 0.00 255.0 FORMAT "%5.1" NUMBER 2 /end CHARACTERISTIC
/begin CHARACTERISTIC FFTCAIR "Freeze Frame Tabelle: Airbag-Botschaft" VAL_BLK 0x810987 KwbUb 255.0 dez 0.00 255.0 FORMAT "%5.1" NUMBER 2 /end CHARACTERISTIC
/begin CHARACTERISTIC FFTCAS "Freeze Frame Tabelle: CAN-Timeout ASC-Botschaft" VAL_BLK 0x81098B KwbUb 255.0 dez 0.00 255.0 FORMAT "%5.1" NUMBER 2 /end CHARACTERISTIC
/begin CHARACTERISTIC FFTCAT "Freeze Frame Tabelle: CAN-Schnittstelle, Timeout ASR" VAL_BLK 0x81098D KwbUb 255.0 dez 0.00 255.0 FORMAT "%5.1" NUMBER 2 /end CHARACTERISTIC
/begin CHARACTERISTIC FFTCGE "Freeze Frame Tabelle: CAN-Timeout EGS-Botschaft" VAL_BLK 0x81098F KwbUb 255.0 dez 0.00 255.0 FORMAT "%5.1" NUMBER 2 /end CHARACTERISTIC
/begin CHARACTERISTIC FFTCGRA "Freeze Frame Tabelle: GRA-Botschaft (Empfang)" VAL_BLK 0x810991 KwbUb 255.0 dez 0.00 255.0 FORMAT "%5.1" NUMBER 2 /end CHARACTERISTIC
/begin CHARACTERISTIC FFTCIF "Freeze Frame Tabelle: CAN-Schnittstelle, interner Fehler" VAL_BLK 0x810993 KwbUb 255.0 dez 0.00 255.0 FORMAT "%5.1" NUMBER 2 /end CHARACTERISTIC
/begin CHARACTERISTIC FFTCINS "Freeze Frame Tabelle: CAN-Timeout Instr.-Botschaft" VAL_BLK 0x810995 KwbUb 255.0 dez 0.00 255.0 FORMAT "%5.1" NUMBER 2 /end CHARACTERISTIC
/begin CHARACTERISTIC FFTCKLA "" VAL_BLK 0x810997 KwbUb 255.0 dez 0.00 255.0 FORMAT "%5.1" NUMBER 2 /end CHARACTERISTIC
/begin CHARACTERISTIC FFTCLWS "Freeze Frame Tabelle: CAN-Schnittstelle, Timeout Botschaft Lenkwinkelsensor" VAL_BLK 0x810999 KwbUb 255.0 dez 0.00 255.0 FORMAT "%5.1" NUMBER 2 /end CHARACTERISTIC
/begin CHARACTERISTIC FFTDKVM "Freeze Frame Tabelle: Drosselklappenverschmutzung" VAL_BLK 0x8109A1 KwbUb 255.0 dez 0.00 255.0 FORMAT "%5.1" NUMBER 2 /end CHARACTERISTIC
/begin CHARACTERISTIC FFTN "Freeze Frame Tabelle: Drehzahlgeber" VAL_BLK 0x810A3F KwbUb 255.0 dez 0.00 255.0 FORMAT "%5.1" NUMBER 2 /end CHARACTERISTIC
/begin CHARACTERISTIC FFTTOL "Freeze Frame Tabelle: (Motor-) Oeltemperatur TOL" VAL_BLK 0x810A77 KwbUb 255.0 dez 0.00 255.0 FORMAT "%5.1" NUMBER 2 /end CHARACTERISTIC
/begin CHARACTERISTIC FFTTUM "Freeze Frame Tabelle: Umgebungstemperatur TUM" VAL_BLK 0x810A79 KwbUb 255.0 dez 0.00 255.0 FORMAT "%5.1" NUMBER 2 /end CHARACTERISTIC
/begin CHARACTERISTIC FMOTC "Motor-Codierung (CAN)" VALUE 0x810174 KwUb 255.0 DEZ 0.00 255.0 FORMAT "%5.1" /end CHARACTERISTIC
/begin CHARACTERISTIC FRAOS "Schwelle für oberen Anschlag des mult. Anteils der Gemischadaption" VALUE 0x81D2DA KwUw 3.999939 fak_uw_b4_no1 -1.000000 2.999939 FORMAT "%8.6" /end CHARACTERISTIC
/begin CHARACTERISTIC FRAUDDKVMN "multiplikativer Gemischadaptionsfaktor unterer mult. Bereich Minimalwert" VALUE 0x81D186 KwUw 1.999969 fak_uw_b2 0.00 1.999969 FORMAT "%8.6" /end CHARACTERISTIC
/begin CHARACTERISTIC FRAUDDKVMX "multiplikativer Gemischadaptionsfaktor unterer mult. Bereich Maximalwert" VALUE 0x81D188 KwUw 1.999969 fak_uw_b2 0.00 1.999969 FORMAT "%8.6" /end CHARACTERISTIC
/begin CHARACTERISTIC FRAUS "Schwelle für unteren Anschlag des mult. Anteils der Gemischadaption" VALUE 0x81D2DC KwUw 3.999939 fak_uw_b4_no1 -1.000000 2.999939 FORMAT "%8.6" /end CHARACTERISTIC
/begin CHARACTERISTIC FWCBFT "Bewertungsfaktor Turbo für CAN-Ausgabe" VALUE 0x810175 KwUb 25.50 fak_q0p1 0.00 25.50 FORMAT "%5.2" /end CHARACTERISTIC
/begin CHARACTERISTIC FWCSBK "Steigung der Befüllungskennlinie für CAN-Ausgabe" VALUE 0x810176 KwUb 255.0 dez 0.00 255.0 FORMAT "%5.1" /end CHARACTERISTIC
/begin CHARACTERISTIC FWTMUEBO "Tmot-Schwelle zum Setzen Temperaturüberschutz" VALUE 0x8183CE KwUb 255.0 temp_ub_q0p75_o48 0.00 255.0 FORMAT "%5.1" /end CHARACTERISTIC
/begin CHARACTERISTIC FWTMUEBU "Tmot-Schwelle zum Rücksetzen Temperaturüberschutz" VALUE 0x8183CF KwUb 255.0 temp_ub_q0p75_o48 0.00 255.0 FORMAT "%5.1" /end CHARACTERISTIC
/begin CHARACTERISTIC FWTOUEBO "Töl-Schwelle zum Setzen Temperaturüberschutz" VALUE 0x81BB5E KwUw 65535.00 temp_q0p0234_o273 -0.009375000 65534.99 FORMAT "%8.2" /end CHARACTERISTIC
/begin CHARACTERISTIC FWTOUEBU "Töl-Schwelle zum Rücksetzen Temperaturüberschutz" VALUE 0x81BB60 KwUw 65535.00 temp_q0p0234_o273 -0.009375000 65534.99 FORMAT "%8.2" /end CHARACTERISTIC
/begin CHARACTERISTIC KFOELKBI "Ölniveauschwelle für Ausgabe an Kombi" MAP 0x8183D0 KfAxUbAyUbSstxUbSstyUbWUb 63.75 s_q63p75 0.00 63.75 FORMAT "%5.2"
 /begin AXIS_DESCR STD_AXIS kfoelkbi_nmot nmot_ub_q40 8 0.00 10200. FORMAT "%5.0" DEPOSIT ABSOLUTE /end AXIS_DESCR
 /begin AXIS_DESCR STD_AXIS tolc temp_ub_q1_o60 8 -60.00 195.0 FORMAT "%5.1" DEPOSIT ABSOLUTE /end AXIS_DESCR
/end CHARACTERISTIC
/begin CHARACTERISTIC KLMIGENL "Kennlinie für Getriebeeingriff bei Ausfall der Getriebe-Botschaft" CURVE 0x810177 KlAUbSstUbWUb 99.61 rel_ub_b99p6 0.00 99.61 FORMAT "%5.2"
 /begin AXIS_DESCR STD_AXIS tmot temp_ub_q0p75_o48 5 -48.00 143.3 FORMAT "%5.1" DEPOSIT ABSOLUTE /end AXIS_DESCR
/end CHARACTERISTIC
/begin CHARACTERISTIC KVNPZ "normierter Krafstoffverbrauch pro Zylinder für Kombiausgabe" VALUE 0x810182 KwUb 5100. kva_ub_q20 0.00 5100. FORMAT "%5.0" /end CHARACTERISTIC
/begin CHARACTERISTIC LBMINC "Wert der bei Bezugsmarkenverlust hinzuaddiert wird" VALUE 0x81393C KwUw 65535.00 dez 0.00 65535.00 FORMAT "%8.2" /end CHARACTERISTIC
/begin CHARACTERISTIC LBMINIT "Initialisierungswert des Zählers Bezugsmarkenverlust, wenn SG zuvor im NLDG war" VALUE 0x81393E KwUw 65535.00 dez 0.00 65535.00 FORMAT "%8.2" /end CHARACTERISTIC
/begin CHARACTERISTIC LBMMX "Maximalwert für Zähler Bezugsmarkenverlust" VALUE 0x813940 KwUw 65535.00 dez 0.00 65535.00 FORMAT "%8.2" /end CHARACTERISTIC
/begin CHARACTERISTIC LBMSUB "Differenzwert zwischen der Fehlereintragsschwelle und der Notlaufanforderung" VALUE 0x81C200 KwUw 65535.00 dez 0.00 65535.00 FORMAT "%8.2" /end CHARACTERISTIC
/begin CHARACTERISTIC MDMAXKBI "maximales Drehmoment für Ausgabe an Kombi" VALUE 0x810183 KwUb 2550. md_ub_q10 0.00 2550. FORMAT "%5.0" /end CHARACTERISTIC
/begin CHARACTERISTIC MDNORM "Maximales indiziertes Motormoment für Moment-Normierung" VALUE 0x810184 KwUb 2550. md_ub_q10 0.00 2550. FORMAT "%5.0" /end CHARACTERISTIC
/begin CHARACTERISTIC MOTTYP "Motortyp für Ausgabe an Kombi" VALUE 0x810185 KwUb 255.0 DEZ 0.00 255.0 FORMAT "%5.1" /end CHARACTERISTIC
/begin CHARACTERISTIC MXNLN "Mindestanzahl von Zahnsignalen zur Heilung des NLDG" VALUE 0x818464 KwUb 255.0 dez 0.00 255.0 FORMAT "%5.1" /end CHARACTERISTIC
/begin CHARACTERISTIC NMAXKBI "Drehzahl bei maximalem Moment für Ausgabe an Kombi" VALUE 0x810186 KwUb 25500. nmotg_ub_q100 0.00 25500. FORMAT "%5.0" /end CHARACTERISTIC
/begin CHARACTERISTIC NOBMINC "Wert der bei nicht erkannter Bezugsmarke aufaddiert wird" VALUE 0x818465 KwUb 255.0 dez 0.00 255.0 FORMAT "%5.1" /end CHARACTERISTIC
/begin CHARACTERISTIC NOBMINIT "Initialisierungswert für Zähler Bezugsmarkenverlust" VALUE 0x818466 KwUb 255.0 dez 0.00 255.0 FORMAT "%5.1" /end CHARACTERISTIC
/begin CHARACTERISTIC NOBMSTMX "Maximalwert für nicht erkannte Bezugsmarken im Start" VALUE 0x818467 KwUb 255.0 dez 0.00 255.0 FORMAT "%5.1" /end CHARACTERISTIC
/begin CHARACTERISTIC OELKBI "Kombiausgabe Oelniveauschwelle" VALUE 0x810187 KwUb 63.75 s_q63p75 0.00 63.75 FORMAT "%5.2" /end CHARACTERISTIC
/begin CHARACTERISTIC OFMSNDKVMN "Offset normierter Massenstrom über Drosselklappe Minimalwert" VALUE 0x81D18A KwSw 6553.500 m_sw_b3276p8 -3276.800 3276.700 FORMAT "%8.3" /end CHARACTERISTIC
/begin CHARACTERISTIC PBKVMN "min. möglicher Druck im Bremskraftverstärker" VALUE 0x829138 KwUw 2559.961 p_uw_q0p039 0.00 2559.961 FORMAT "%8.3" /end CHARACTERISTIC
/begin CHARACTERISTIC PBKVMX "max. möglicher Druck im Bremskraftverstärker" VALUE 0x82913A KwUw 2559.961 p_uw_q0p039 0.00 2559.961 FORMAT "%8.3" /end CHARACTERISTIC
/begin CHARACTERISTIC PGFLNL "Anzahl an Phasenflanken bis NLDG aufgerufen wird bei eingetragenem E_n" VALUE 0x818468 KwUb 255.0 dez 0.00 255.0 FORMAT "%5.1" /end CHARACTERISTIC
/begin CHARACTERISTIC PGFLWA "Anzahl PG-Flankenwechsel für DG-Fehler B_signal" VALUE 0x810B3F KwUb 255.0 dez 0.00 255.0 FORMAT "%5.1" /end CHARACTERISTIC
/begin CHARACTERISTIC PMAXKBI "Kombiausgabe maximale Leistung" VALUE 0x8136C6 KwUw 511.0000 kw_q1 0.00 511.0000 FORMAT "%8.4" /end CHARACTERISTIC
/begin CHARACTERISTIC RKATDDKVMN "additive Gemischkorrektur (pro Zeit) der Gemischdaption Minimalwert" VALUE 0x81D18C KwSw 3071.953 rel_sw_b1536 -1536.000 1535.953 FORMAT "%8.3" /end CHARACTERISTIC
/begin CHARACTERISTIC RKATDDKVMX "additive Gemischkorrektur (pro Zeit) der Gemischdaption Maximalwert" VALUE 0x81D18E KwSw 3071.953 rel_sw_b1536 -1536.000 1535.953 FORMAT "%8.3" /end CHARACTERISTIC
/begin CHARACTERISTIC TATSMN "Temperaturschwelle für Min-Fehler Abgastemperatursensor" VALUE 0x81DD92 KwUw 1279.980 temp_uw_q0p0195_o50 -50.00000 1229.980 FORMAT "%8.3" /end CHARACTERISTIC
/begin CHARACTERISTIC TATSMX "Temperaturschwelle für Max-Fehler Abgastemperatursensor" VALUE 0x81DD94 KwUw 1279.980 temp_uw_q0p0195_o50 -50.00000 1229.980 FORMAT "%8.3" /end CHARACTERISTIC
/begin CHARACTERISTIC TATSNP "Temperaturschwelle für Nicht-Plausibel-Fehler Abgastemperatursensor" VALUE 0x81DD96 KwUw 1279.980 temp_uw_q0p0195_o50 -50.00000 1229.980 FORMAT "%8.3" /end CHARACTERISTIC
/begin CHARACTERISTIC TDATSO "Obergrenze Abgastemperaturmodell für Diagnose Abgastemperatursensor" VALUE 0x81DD98 KwUw 1279.980 temp_uw_q0p0195_o50 -50.00000 1229.980 FORMAT "%8.3" /end CHARACTERISTIC
/begin CHARACTERISTIC TDBBKVP "Einschaltverzögerung von B_bkvp für Diagnose" VALUE 0x81AD42 KwUb 25.50 t100msxs_ub_b25p5 0.00 25.50 FORMAT "%5.2" /end CHARACTERISTIC
/begin CHARACTERISTIC TDDBKVP "Zeit, in der das Druckdelta DPBKVP durch die Pumpe evakuiert werden kann" VALUE 0x81AD43 KwUb 25.50 t100msxs_ub_b25p5 0.00 25.50 FORMAT "%5.2" /end CHARACTERISTIC
/begin CHARACTERISTIC TDDFBKV "Entprellzeit für Fehlereintrag DS Bremskraftverstärker" VALUE 0x81AD47 KwUb 25.50 t100msxs_ub_b25p5 0.00 25.50 FORMAT "%5.2" /end CHARACTERISTIC
/begin CHARACTERISTIC TDDHBKV "Entprellzeit für Setzen des Zyklusflags" VALUE 0x81AD48 KwUb 25.50 t100msxs_ub_b25p5 0.00 25.50 FORMAT "%5.2" /end CHARACTERISTIC
/begin CHARACTERISTIC TDEGFEMN "Zeitverzögerung für Setzen des MIN-Fehlers" VALUE 0x818928 KwUb 255.0 t1sxs_ub_b255 0.00 255.0 FORMAT "%5.1" /end CHARACTERISTIC
/begin CHARACTERISTIC TDEGFEMX "Zeitverzögerung für Setzen des MAX-Fehlers" VALUE 0x818929 KwUb 255.0 t1sxs_ub_b255 0.00 255.0 FORMAT "%5.1" /end CHARACTERISTIC
/begin CHARACTERISTIC TDEGFENO "Zeitverzögerung für Setzen des NO-Fehlers" VALUE 0x81892A KwUb 255.0 t1sxs_ub_b255 0.00 255.0 FORMAT "%5.1" /end CHARACTERISTIC
/begin CHARACTERISTIC TEGA "Zeitschwelle für Einschwingen der Gemischadaption" VALUE 0x813D34 KwUw 655.3500 t10msxs_uw_b655p35 0.00 655.3500 FORMAT "%8.4" /end CHARACTERISTIC
/begin CHARACTERISTIC TEPBKVNB "Einschwingzeit der Bremskraftdruckreaktion nach Bremsen" VALUE 0x81AD49 KwUb 25.50 t100msxs_ub_b25p5 0.00 25.50 FORMAT "%5.2" /end CHARACTERISTIC
/begin CHARACTERISTIC TEPCL "Zeit ab Motorlauf bis EPCL-Testansteuerung Ende" VALUE 0x810B38 KwUb 51.00 t200msxs_ub_b51 0.00 51.00 FORMAT "%5.2" /end CHARACTERISTIC
/begin CHARACTERISTIC TEPCLI "Zeit ab INI bis EPCL-Testansteuerung Ende" VALUE 0x810B39 KwUb 51.00 t200msxs_ub_b51 0.00 51.00 FORMAT "%5.2" /end CHARACTERISTIC
/begin CHARACTERISTIC TLADEGFE "Zeitschwelle: Langsamer Abgleich eingeschwungen für DEGFE" VALUE 0x81D2DE KwUw 65535.00 t1sxs_uw_b65535 0.00 65535.00 FORMAT "%8.2" /end CHARACTERISTIC
/begin CHARACTERISTIC TMOTNLDG "Temperaturschwelle für Drehzahlgeber-Notlauf" VALUE 0x818469 KwUb 191.3 temp_ub_q0p75_o48 -48.00 143.3 FORMAT "%5.1" /end CHARACTERISTIC
/begin CHARACTERISTIC TNSTBKV "Zeit nach Startende und nichtfreigabe bis die Pumpe aktiv angesteuert wird" VALUE 0x82912A KwUw 655.3500 t10msxs_uw_b655p35 0.00 655.3500 FORMAT "%8.4" /end CHARACTERISTIC
/begin CHARACTERISTIC TPNSE "Prüfzeit nach Startende für DVE-Diagnose" VALUE 0x81871F KwUb 25.40 t100msxs_ub_b25p5 0.1000 25.50 FORMAT "%5.2" /end CHARACTERISTIC
/begin CHARACTERISTIC TPSATS "Sollwert Periodendauer Abgastemperatursensor" VALUE 0x819656 KwUb 255.0 t100msxms_ub_b255 0.00 255.0 FORMAT "%5.1" /end CHARACTERISTIC
/begin CHARACTERISTIC TSFATR "Fehlerschwere Abgastemperaturregelung" VALUE 0x810A9F KwUb 255.0 dez 0.00 255.0 FORMAT "%5.1" /end CHARACTERISTIC
/begin CHARACTERISTIC TSFATR2 "Fehlerschwere Abgastemperaturregelung Bank 2" VALUE 0x810AA0 KwUb 255.0 dez 0.00 255.0 FORMAT "%5.1" /end CHARACTERISTIC
/begin CHARACTERISTIC TSFATRD "" VALUE 0x810AA1 KwUb 255.0 dez 0.00 255.0 FORMAT "%5.1" /end CHARACTERISTIC
/begin CHARACTERISTIC TSFATRD2 "" VALUE 0x810AA2 KwUb 255.0 dez 0.00 255.0 FORMAT "%5.1" /end CHARACTERISTIC
/begin CHARACTERISTIC TSFATS "Fehlerschwere Abgastemperatursensor" VALUE 0x810AA3 KwUb 255.0 dez 0.00 255.0 FORMAT "%5.1" /end CHARACTERISTIC
/begin CHARACTERISTIC TSFATS2 "Fehlerschwere Abgastemperatursensor Bank 2" VALUE 0x810AA4 KwUb 255.0 dez 0.00 255.0 FORMAT "%5.1" /end CHARACTERISTIC
/begin CHARACTERISTIC TSFBKVP "" VALUE 0x810AA5 KwUb 255.0 dez 0.00 255.0 FORMAT "%5.1" /end CHARACTERISTIC
/begin CHARACTERISTIC TSFBM "Fehlersummenzeit: Bezugsmarkengeber" VALUE 0x810AA7 KwUb 255.0 dez 0.00 255.0 FORMAT "%5.1" /end CHARACTERISTIC
/begin CHARACTERISTIC TSFCAIR "Fehlersummenzeit: Airbag-Botschaft" VALUE 0x810AAA KwUb 255.0 dez 0.00 255.0 FORMAT "%5.1" /end CHARACTERISTIC
/begin CHARACTERISTIC TSFCAS "Fehlersummenzeit: CAN-Schnittstelle, Timeout ASC" VALUE 0x810AAC KwUb 255.0 dez 0.00 255.0 FORMAT "%5.1" /end CHARACTERISTIC
/begin CHARACTERISTIC TSFCAT "Fehlersummenzeit: CAN-Schnittstelle, Timeout ASR" VALUE 0x810AAD KwUb 255.0 dez 0.00 255.0 FORMAT "%5.1" /end CHARACTERISTIC
/begin CHARACTERISTIC TSFCGE "Fehlersummenzeit: CAN-Schnittstelle, Timeout EGS" VALUE 0x810AAE KwUb 255.0 dez 0.00 255.0 FORMAT "%5.1" /end CHARACTERISTIC
/begin CHARACTERISTIC TSFCGRA "Fehlersummenzeit: GRA-Botschaft (Empfang)" VALUE 0x810AAF KwUb 255.0 dez 0.00 255.0 FORMAT "%5.1" /end CHARACTERISTIC
/begin CHARACTERISTIC TSFCIF "Fehlersummenzeit: CAN-Schnittstelle, interner Fehler" VALUE 0x810AB0 KwUb 255.0 dez 0.00 255.0 FORMAT "%5.1" /end CHARACTERISTIC
/begin CHARACTERISTIC TSFCINS "Fehlersummenzeit: CAN-Schnittstelle, Timeout Instrument" VALUE 0x810AB1 KwUb 255.0 dez 0.00 255.0 FORMAT "%5.1" /end CHARACTERISTIC
/begin CHARACTERISTIC TSFCKLA "" VALUE 0x810AB2 KwUb 255.0 dez 0.00 255.0 FORMAT "%5.1" /end CHARACTERISTIC
/begin CHARACTERISTIC TSFCLWS "Fehlersummenzeit: CAN-Schnittstelle, Timeout Botschaft Lenkwinkelsensor" VALUE 0x810AB3 KwUb 255.0 dez 0.00 255.0 FORMAT "%5.1" /end CHARACTERISTIC
/begin CHARACTERISTIC TSFDKVM "Fehlersummenzeit: Drosselklappenverschmutzung" VALUE 0x810AB7 KwUb 255.0 dez 0.00 255.0 FORMAT "%5.1" /end CHARACTERISTIC
/begin CHARACTERISTIC TSFN "Fehlersummenzeit: Drehzahlgeber" VALUE 0x810B06 KwUb 255.0 dez 0.00 255.0 FORMAT "%5.1" /end CHARACTERISTIC
/begin CHARACTERISTIC TSFTOL "Fehlersummenzeit: Öltemperatur" VALUE 0x810B22 KwUb 255.0 dez 0.00 255.0 FORMAT "%5.1" /end CHARACTERISTIC
/begin CHARACTERISTIC TSFTUM "Fehlersummenzeit: Umgebungstemperatur TUM" VALUE 0x810B23 KwUb 255.0 dez 0.00 255.0 FORMAT "%5.1" /end CHARACTERISTIC
/begin CHARACTERISTIC TTBRL "Zeit zwischen Betätigung der Bremse und setzen von B_brems=true (Leckage)" VALUE 0x82913C KwUw 3276.7499992 tz100msxs_uw_b3276p8 0.050000762951 3276.8000000 FORMAT "%12.7" /end CHARACTERISTIC
/begin CHARACTERISTIC TVBATRF "Verzögerungszeit für Bedingung Fehler Abgastemperaturregelung" VALUE 0x81965A KwUb 25.50 t100msxs_ub_b25p5 0.00 25.50 FORMAT "%5.2" /end CHARACTERISTIC
/begin CHARACTERISTIC TVEATRDR "Verzögerungszeit für Rücksetzen Fehler Bankunterschied ATR" VALUE 0x81965B KwUb 25.50 t100msxs_ub_b25p5 0.00 25.50 FORMAT "%5.2" /end CHARACTERISTIC
/begin CHARACTERISTIC TVEATRDS "Verzögerungszeit für Setzen Fehler Bankunterschied ATR" VALUE 0x81965C KwUb 25.50 t100msxs_ub_b25p5 0.00 25.50 FORMAT "%5.2" /end CHARACTERISTIC
/begin CHARACTERISTIC TVEATRR "Verzögerungszeit für Rücksetzen Fehler Abgastemperaturregelung" VALUE 0x81965D KwUb 25.50 t100msxs_ub_b25p5 0.00 25.50 FORMAT "%5.2" /end CHARACTERISTIC
/begin CHARACTERISTIC TVEATRS "Verzögerungszeit für Setzen Fehler Abgastemperaturregelung" VALUE 0x81965E KwUb 25.50 t100msxs_ub_b25p5 0.00 25.50 FORMAT "%5.2" /end CHARACTERISTIC
/begin CHARACTERISTIC TVEATSR "Verzögerungszeit für Erkennung fehlerfreier Abgastemperatursensor" VALUE 0x819657 KwUb 25.50 t100msxs_ub_b25p5 0.00 25.50 FORMAT "%5.2" /end CHARACTERISTIC
/begin CHARACTERISTIC TVEATSS "Verzögerungszeit für Erkennung fehlerhafter Abgastemperatursensor" VALUE 0x819658 KwUb 25.50 t100msxs_ub_b25p5 0.00 25.50 FORMAT "%5.2" /end CHARACTERISTIC
/begin CHARACTERISTIC TVFKMSDK "Zeitverzögerung bis min. oder max. fkmsdk-Anschlag weitergegeben werden" VALUE 0x810EB6 KwUb 2.550 t10msxs_ub_b2p55 0.00 2.550 FORMAT "%5.3" /end CHARACTERISTIC
/begin CHARACTERISTIC TVPBKVNB "Verzögerungszeit der Bremskraftdruckreaktion nach Bremsen" VALUE 0x81AD4A KwUb 25.50 t100msxs_ub_b25p5 0.00 25.50 FORMAT "%5.2" /end CHARACTERISTIC
/begin CHARACTERISTIC TWBDCY "Wartezeit für Erkennung Bedingung 'driving cycle'" VALUE 0x81BB9C KwUw 13107.00 t200msxs_uw_q0p2 0.00 13107.00 FORMAT "%8.2" /end CHARACTERISTIC
/begin CHARACTERISTIC T_GEUEW "Überwachungszeit für Getriebeeingriff (nur ZW-Eingriff)" VALUE 0x8136C8 KwUw 655.3500 t10msxs_uw_b655p35 0.00 655.3500 FORMAT "%8.4" /end CHARACTERISTIC
/begin CHARACTERISTIC T_KLIMADEADCTR "" VALUE 0x810188 KwUb 255.0 dez 0.00 255.0 FORMAT "%5.1" /end CHARACTERISTIC
/begin CHARACTERISTIC T_KOM1CLDEAD "" VALUE 0x810189 KwUb 255.0 dez 0.00 255.0 FORMAT "%5.1" /end CHARACTERISTIC
/begin CHARACTERISTIC T_NOMAIR "Timeoutzeit für Airbagbotschaft" VALUE 0x81018A KwUb 5.100 t20msxs_ub_b5p1 0.00 5.100 FORMAT "%5.3" /end CHARACTERISTIC
/begin CHARACTERISTIC T_NOMAIRTA "verlängerte Timeoutzeit für Airbagbotschaft" VALUE 0x81018B KwUb 5.100 t20msxs_ub_b5p1 0.00 5.100 FORMAT "%5.3" /end CHARACTERISTIC
/begin CHARACTERISTIC T_NOMBSG "Timeoutzeit BSG-Botschaft" VALUE 0x818422 KwUb 25.50 t100msxs_ub_b25p5 0.00 25.50 FORMAT "%5.2" /end CHARACTERISTIC
/begin CHARACTERISTIC T_NOMEGS "Filterzeit bis Erkennung der Kommunikationsunterbrechung zu Knoten EGS" VALUE 0x81018C KwUb 2.550 t10msxs_ub_b2p55 0.00 2.550 FORMAT "%5.3" /end CHARACTERISTIC
/begin CHARACTERISTIC T_NOMKBI "DCAN Timeoutzeit Kombi Botschaft" VALUE 0x818423 KwUb 25.50 t100msxs_ub_b25p5 0.00 25.50 FORMAT "%5.2" /end CHARACTERISTIC
/begin CHARACTERISTIC T_NOMKBI1 "Timeoutzeit Botschaft Kombi1" VALUE 0x81018D KwUb 5.100 t20msxs_ub_b5p1 0.00 5.100 FORMAT "%5.3" /end CHARACTERISTIC
/begin CHARACTERISTIC T_NOMKBI23 "Timeoutzeit Botschaft Kombi2 und 3" VALUE 0x818424 KwUb 102.0 t400msxs_ub_b102 0.00 102.0 FORMAT "%5.1" /end CHARACTERISTIC
/begin CHARACTERISTIC T_NOMKLA "Timeoutzeit Botschaft Clima1" VALUE 0x818425 KwUb 25.50 t100msxs_ub_b25p5 0.00 25.50 FORMAT "%5.2" /end CHARACTERISTIC
/begin CHARACTERISTIC T_NOMLWS "CAN Timeoutzeit Lenkwinkelsensor Botschaft" VALUE 0x81018E KwUb 2.550 t10msxs_ub_b2p55 0.00 2.550 FORMAT "%5.3" /end CHARACTERISTIC
/begin CHARACTERISTIC T_NOMNOX "Timeoutzeit Nox Botschaft" VALUE 0x81018F KwUb 2.550 t10msxs_ub_b2p55 0.00 2.550 FORMAT "%5.3" /end CHARACTERISTIC
/begin CHARACTERISTIC T_SFSEN "Zeit nach Startende für Auswertung Fahrstufe S_fs" VALUE 0x8136CA KwUw 655.3500 t10msxs_uw_b655p35 0.00 655.3500 FORMAT "%8.4" /end CHARACTERISTIC
/begin CHARACTERISTIC UBDEKPMN "Batteriespannungsschwelle Prüfpulse" VALUE 0x8187C0 KwUb 17.95 spg_ubatt 0.00 17.95 FORMAT "%5.2" /end CHARACTERISTIC
/begin CHARACTERISTIC UDSBKVMN "min. Spannungswert für Diagnose DS Bremskraftverstärker" VALUE 0x81AD4B KwUb 4.980 spg_ub_b5 0.00 4.980 FORMAT "%5.3" /end CHARACTERISTIC
/begin CHARACTERISTIC UDSBKVMX "max. Spannungswert für Diagnose DS Bremskraftverstärker" VALUE 0x81AD4C KwUb 4.980 spg_ub_b5 0.00 4.980 FORMAT "%5.3" /end CHARACTERISTIC
/begin CHARACTERISTIC VANZKBI "Kombiausgabe Anzahl Ventil" VALUE 0x810190 KwUb 255.0 DEZ 0.00 255.0 FORMAT "%5.1" /end CHARACTERISTIC
/begin CHARACTERISTIC VGNL "Geschwindigkeitsschwelle für Momenteneingriff bei Ausfall der Getriebe-Botschaft" VALUE 0x818426 KwUb 318.8 vfzg_ub_q1p25 0.00 318.8 FORMAT "%5.1" /end CHARACTERISTIC
/begin CHARACTERISTIC ZCANAIR "Zähler für Codierfehlererkennung der Airbagbotschaft" VALUE 0x810191 KwUb 5.100 t20msxs_ub_b5p1 0.00 5.100 FORMAT "%5.3" /end CHARACTERISTIC
/begin CHARACTERISTIC ZKGAFRANM "Zeitkonstante für Mittelwertsbildung von dgafra" CURVE 0x81D2E0 KlAUwSstUwWUw 65534.000000 zk1sxs_uw_b65535 1.0000000000 65535.000000 FORMAT "%12.6"
 /begin AXIS_DESCR STD_AXIS pspvds_w fak_uw_b2 8 0.00 1.999969 FORMAT "%8.6" DEPOSIT ABSOLUTE /end AXIS_DESCR
/end CHARACTERISTIC
/begin CHARACTERISTIC ZTOELKBI "Zeitkonstante für nmot-Filter" VALUE 0x8136CC KwUw 655.3500 t10msxs_uw_b655p35 0.00 655.3500 FORMAT "%8.4" /end CHARACTERISTIC
/begin MEASUREMENT apdkg_w "Anzahl Prüfungen Drosselklappe gesamt" UWORD dez 1 100 0 65535 FORMAT "%8.2" ECU_ADDRESS 0x384AB6 /end MEASUREMENT
/begin MEASUREMENT apdkv_w "Anzahl Prüfungen Drosselklappe verschmutzt" UWORD dez 1 100 0 65535 FORMAT "%8.2" ECU_ADDRESS 0x384AB8 /end MEASUREMENT
/begin MEASUREMENT bbd2ctr "" UBYTE dez 1 100 0 255 FORMAT "%5.1" ECU_ADDRESS 0x384823 /end MEASUREMENT
/begin MEASUREMENT bbdcy "Byte für Bedingung B_dcy als Triggerevent in DCLA" UBYTE dez 1 100 0 255 FORMAT "%5.1" ECU_ADDRESS 0x3808F9 /end MEASUREMENT
/begin MEASUREMENT bbno "Byte für Bedingung B_no  als Triggerevent in DCLA" UBYTE dez 1 100 0 255 FORMAT "%5.1" ECU_ADDRESS 0x38330A /end MEASUREMENT
/begin MEASUREMENT bbsp3 "Byte für Bedingung B_sp3 als Triggerevent in DCLA" UBYTE dez 1 100 0 255 FORMAT "%5.1" ECU_ADDRESS 0x38330B /end MEASUREMENT
/begin MEASUREMENT bbtim "Byte für Bedingung B_tim als Triggerevent in DCLA" UBYTE dez 1 100 0 255 FORMAT "%5.1" ECU_ADDRESS 0x3808FA /end MEASUREMENT
/begin MEASUREMENT bfgrsc "FGR-Sollbeschleunigung für CAN-Ausgabe" UBYTE bfgrsc_ub_q0p024_o3p984 1 100 -3.984 2.136 FORMAT "%5.3" ECU_ADDRESS 0x3808BF /end MEASUREMENT
/begin MEASUREMENT bkvpea_ctr "" UBYTE dez 1 100 0 255 FORMAT "%5.1" ECU_ADDRESS 0x384970 /end MEASUREMENT
/begin MEASUREMENT bkvpena_ctr "" UWORD dez 1 100 0 1 BIT_MASK 0x1 FORMAT "%5.3" ECU_ADDRESS 0x384971 /end MEASUREMENT
/begin MEASUREMENT bz_air "Botschaftszähler der Airbag-Botschaft" UBYTE DEZ 1 100 0 255 FORMAT "%5.1" ECU_ADDRESS 0x3808C0 /end MEASUREMENT
/begin MEASUREMENT bz_cang1 "Botschaftszähler der Botschaft Getriebe 1" UBYTE DEZ 1 100 0 255 FORMAT "%5.1" ECU_ADDRESS 0x3808C1 /end MEASUREMENT
/begin MEASUREMENT bz_cmf "Botschaftszähler für Botschaft Motor Flexia" UBYTE DEZ 1 100 0 255 FORMAT "%5.1" ECU_ADDRESS 0x3808C2 /end MEASUREMENT
/begin MEASUREMENT B_aircan "Bedingung Crash vom Airbag-SG" UWORD B_TRUE 1 100 0 1 BIT_MASK 0x2000 FORMAT "%13.11" ECU_ADDRESS 0xFD10 /end MEASUREMENT
/begin MEASUREMENT B_airnbot "Bedingung keine Airbagbotschaft empfangen" UWORD B_TRUE 1 100 0 1 BIT_MASK 0x4000 FORMAT "%13.11" ECU_ADDRESS 0xFD10 /end MEASUREMENT
/begin MEASUREMENT B_amsrbot "Bedingung Botschaft Bremse 1 wird empfangen" UWORD B_TRUE 1 100 0 1 BIT_MASK 0x8000 FORMAT "%13.11" ECU_ADDRESS 0xFD10 /end MEASUREMENT
/begin MEASUREMENT B_amsrnbot "Bedingung keine neue ASR/MSR-Botschaft erhalten" UWORD B_TRUE 1 100 0 1 BIT_MASK 0x1 FORMAT "%13.11" ECU_ADDRESS 0xFD12 /end MEASUREMENT
/begin MEASUREMENT B_anlasc "Bedingung Anlasser Ausspuren (CAN)" UWORD B_TRUE 1 100 0 1 BIT_MASK 0x2 FORMAT "%13.11" ECU_ADDRESS 0xFD12 /end MEASUREMENT
/begin MEASUREMENT B_anlfr "Bedingung Anlasser Freigabe (CAN)" UWORD B_TRUE 1 100 0 1 BIT_MASK 0x4 FORMAT "%13.11" ECU_ADDRESS 0xFD12 /end MEASUREMENT
/begin MEASUREMENT B_atrd "Bedingung: Abgastemperaturregelung Differenz" UWORD B_TRUE 1 100 0 1 BIT_MASK 0x8000 FORMAT "%13.11" ECU_ADDRESS 0xFD66 /end MEASUREMENT
/begin MEASUREMENT B_atrd2 "Bedingung: Abgastemperaturregelung Differenz Bank 2" UWORD B_TRUE 1 100 0 1 BIT_MASK 0x1 FORMAT "%13.11" ECU_ADDRESS 0xFD68 /end MEASUREMENT
/begin MEASUREMENT B_atrf "Bedingung Fehler Abgastemperaturregelung" UWORD B_TRUE 1 100 0 1 BIT_MASK 0x2 FORMAT "%13.11" ECU_ADDRESS 0xFD68 /end MEASUREMENT
/begin MEASUREMENT B_avcair "" UWORD B_TRUE 1 100 0 1 BIT_MASK 0x1000 FORMAT "%13.11" ECU_ADDRESS 0x383B24 /end MEASUREMENT
/begin MEASUREMENT B_avcas "" UWORD B_TRUE 1 100 0 1 BIT_MASK 0x1000 FORMAT "%13.11" ECU_ADDRESS 0x383B28 /end MEASUREMENT
/begin MEASUREMENT B_avcat "" UWORD B_TRUE 1 100 0 1 BIT_MASK 0x1000 FORMAT "%13.11" ECU_ADDRESS 0x383B2A /end MEASUREMENT
/begin MEASUREMENT B_avcge "" UWORD B_TRUE 1 100 0 1 BIT_MASK 0x1000 FORMAT "%13.11" ECU_ADDRESS 0x383B2C /end MEASUREMENT
/begin MEASUREMENT B_avcgra "" UWORD B_TRUE 1 100 0 1 BIT_MASK 0x1000 FORMAT "%13.11" ECU_ADDRESS 0x383B2E /end MEASUREMENT
/begin MEASUREMENT B_avcif "" UWORD B_TRUE 1 100 0 1 BIT_MASK 0x1000 FORMAT "%13.11" ECU_ADDRESS 0x383B30 /end MEASUREMENT
/begin MEASUREMENT B_avcins "" UWORD B_TRUE 1 100 0 1 BIT_MASK 0x1000 FORMAT "%13.11" ECU_ADDRESS 0x383B32 /end MEASUREMENT
/begin MEASUREMENT B_avckla "" UWORD B_TRUE 1 100 0 1 BIT_MASK 0x1000 FORMAT "%13.11" ECU_ADDRESS 0x383B34 /end MEASUREMENT
/begin MEASUREMENT B_avclws "" UWORD B_TRUE 1 100 0 1 BIT_MASK 0x1000 FORMAT "%13.11" ECU_ADDRESS 0x383B36 /end MEASUREMENT
/begin MEASUREMENT B_avtol "" UWORD B_TRUE 1 100 0 1 BIT_MASK 0x1000 FORMAT "%13.11" ECU_ADDRESS 0x383C14 /end MEASUREMENT
/begin MEASUREMENT B_bbdecj "Bedingung Abwürgschutz DECJ" UWORD B_TRUE 1 100 0 1 BIT_MASK 0x400 FORMAT "%13.11" ECU_ADDRESS 0xFD4C /end MEASUREMENT
/begin MEASUREMENT B_bbubr "Bedingung Betriebsbereich Endstufendiagnose durch Versorgungsfehler abschaltbar" UWORD B_TRUE 1 100 0 1 BIT_MASK 0x800 FORMAT "%13.11" ECU_ADDRESS 0xFD4C /end MEASUREMENT
/begin MEASUREMENT B_beatr "" UWORD B_TRUE 1 100 0 1 BIT_MASK 0x20 FORMAT "%13.11" ECU_ADDRESS 0x383B0E /end MEASUREMENT
/begin MEASUREMENT B_beatr2 "" UWORD B_TRUE 1 100 0 1 BIT_MASK 0x20 FORMAT "%13.11" ECU_ADDRESS 0x383B10 /end MEASUREMENT
/begin MEASUREMENT B_beatrd "" UWORD B_TRUE 1 100 0 1 BIT_MASK 0x20 FORMAT "%13.11" ECU_ADDRESS 0x383B12 /end MEASUREMENT
/begin MEASUREMENT B_beatrd2 "" UWORD B_TRUE 1 100 0 1 BIT_MASK 0x20 FORMAT "%13.11" ECU_ADDRESS 0x383B14 /end MEASUREMENT
/begin MEASUREMENT B_beats "Bedingung: Bandendefunktionanford. für Temperatursensor" UWORD B_TRUE 1 100 0 1 BIT_MASK 0x20 FORMAT "%13.11" ECU_ADDRESS 0x383B16 /end MEASUREMENT
/begin MEASUREMENT B_beats2 "Bedingung: Bandendefunktionanford. für Temperatursensor, Bank 2" UWORD B_TRUE 1 100 0 1 BIT_MASK 0x20 FORMAT "%13.11" ECU_ADDRESS 0x383B18 /end MEASUREMENT
/begin MEASUREMENT B_bebkvp "Bedingung Bandende-Funktionsanforderung BKV-Pumpe" UWORD B_TRUE 1 100 0 1 BIT_MASK 0x20 FORMAT "%13.11" ECU_ADDRESS 0x383B1A /end MEASUREMENT
/begin MEASUREMENT B_bebm "Bedingung Bandende-Funktionsanforderung Bezugsmarke erkannt" UWORD B_TRUE 1 100 0 1 BIT_MASK 0x20 FORMAT "%13.11" ECU_ADDRESS 0x383B1E /end MEASUREMENT
/begin MEASUREMENT B_becair "Bedingung Bandende Funktionsanforderung : Airbag-Botschaft" UWORD B_TRUE 1 100 0 1 BIT_MASK 0x20 FORMAT "%13.11" ECU_ADDRESS 0x383B24 /end MEASUREMENT
/begin MEASUREMENT B_becas "Bedingung Bandende-Funktionsanforderung: CAN-Schnittstelle ABS" UWORD B_TRUE 1 100 0 1 BIT_MASK 0x20 FORMAT "%13.11" ECU_ADDRESS 0x383B28 /end MEASUREMENT
/begin MEASUREMENT B_becat "Bedingung Bandende Funktionsanforderung : CAN-Schnittstelle, Timeout ASR" UWORD B_TRUE 1 100 0 1 BIT_MASK 0x20 FORMAT "%13.11" ECU_ADDRESS 0x383B2A /end MEASUREMENT
/begin MEASUREMENT B_becge "Bedingung Bandende-Funktionsanforderung: CAN-Schnittstelle TCM" UWORD B_TRUE 1 100 0 1 BIT_MASK 0x20 FORMAT "%13.11" ECU_ADDRESS 0x383B2C /end MEASUREMENT
/begin MEASUREMENT B_becgra "Bedingung: Bandendefunktionanford. für Signalfehler CAN-Timeout Botschaft GRA" UWORD B_TRUE 1 100 0 1 BIT_MASK 0x20 FORMAT "%13.11" ECU_ADDRESS 0x383B2E /end MEASUREMENT
/begin MEASUREMENT B_becif "Bedingung Bandende-Funktionsanforderung CAN-Schnittstelle interner Fehler" UWORD B_TRUE 1 100 0 1 BIT_MASK 0x20 FORMAT "%13.11" ECU_ADDRESS 0x383B30 /end MEASUREMENT
/begin MEASUREMENT B_becins "Bedingung Bandende Funktionsanforderung : Botschaft Kombi" UWORD B_TRUE 1 100 0 1 BIT_MASK 0x20 FORMAT "%13.11" ECU_ADDRESS 0x383B32 /end MEASUREMENT
/begin MEASUREMENT B_beckla "Bedingung Bandende Funktionsanforderung : Botschaft Klima" UWORD B_TRUE 1 100 0 1 BIT_MASK 0x20 FORMAT "%13.11" ECU_ADDRESS 0x383B34 /end MEASUREMENT
/begin MEASUREMENT B_beclws "Bedingung Bandende Funktionsanforderung : Lenkwinkel-Botschaft" UWORD B_TRUE 1 100 0 1 BIT_MASK 0x20 FORMAT "%13.11" ECU_ADDRESS 0x383B36 /end MEASUREMENT
/begin MEASUREMENT B_bedkvm "Bedingung Bandendeanforderung  für Drosselklappenverschmutzung" UWORD B_TRUE 1 100 0 1 BIT_MASK 0x20 FORMAT "%13.11" ECU_ADDRESS 0x383B3E /end MEASUREMENT
/begin MEASUREMENT B_ben "" UWORD B_TRUE 1 100 0 1 BIT_MASK 0x20 FORMAT "%13.11" ECU_ADDRESS 0x383BDC /end MEASUREMENT
/begin MEASUREMENT B_betol "Bedingung Bandende-Funktionsanforderung" UWORD B_TRUE 1 100 0 1 BIT_MASK 0x20 FORMAT "%13.11" ECU_ADDRESS 0x383C14 /end MEASUREMENT
/begin MEASUREMENT B_betum "Bedingung Bandende-Funktionsanforderung Umgebungstemperatur" UWORD B_TRUE 1 100 0 1 BIT_MASK 0x20 FORMAT "%13.11" ECU_ADDRESS 0x383C16 /end MEASUREMENT
/begin MEASUREMENT B_bkatr "Bedingung Ersatzwert aktiv Abgastemperaturregelung" UWORD B_TRUE 1 100 0 1 BIT_MASK 0x40 FORMAT "%13.11" ECU_ADDRESS 0x383B0E /end MEASUREMENT
/begin MEASUREMENT B_bkatr2 "Bedingung Ersatzwert aktiv Abgastemperaturregelung Bank 2" UWORD B_TRUE 1 100 0 1 BIT_MASK 0x40 FORMAT "%13.11" ECU_ADDRESS 0x383B10 /end MEASUREMENT
/begin MEASUREMENT B_bkatrd "" UWORD B_TRUE 1 100 0 1 BIT_MASK 0x40 FORMAT "%13.11" ECU_ADDRESS 0x383B12 /end MEASUREMENT
/begin MEASUREMENT B_bkatrd2 "" UWORD B_TRUE 1 100 0 1 BIT_MASK 0x40 FORMAT "%13.11" ECU_ADDRESS 0x383B14 /end MEASUREMENT
/begin MEASUREMENT B_bkats "Bedingung Ersatzwert aktiv Abgastemperatursensor" UWORD B_TRUE 1 100 0 1 BIT_MASK 0x40 FORMAT "%13.11" ECU_ADDRESS 0x383B16 /end MEASUREMENT
/begin MEASUREMENT B_bkats2 "Bedingung Ersatzwert aktiv Abgastemperatursensor Bank 2" UWORD B_TRUE 1 100 0 1 BIT_MASK 0x40 FORMAT "%13.11" ECU_ADDRESS 0x383B18 /end MEASUREMENT
/begin MEASUREMENT B_bkbkvp "Bedingung Ersatzwert aktiv: BKV-Pumpe" UWORD B_TRUE 1 100 0 1 BIT_MASK 0x40 FORMAT "%13.11" ECU_ADDRESS 0x383B1A /end MEASUREMENT
/begin MEASUREMENT B_bkbm "Bedingung Ersatzwert aktiv: Bezugsmarke" UWORD B_TRUE 1 100 0 1 BIT_MASK 0x40 FORMAT "%13.11" ECU_ADDRESS 0x383B1E /end MEASUREMENT
/begin MEASUREMENT B_bkcair "Bedingung : Airbag-Botschaft" UWORD B_TRUE 1 100 0 1 BIT_MASK 0x40 FORMAT "%13.11" ECU_ADDRESS 0x383B24 /end MEASUREMENT
/begin MEASUREMENT B_bkcas "Bedingung: CAN-Schnittstelle, Timeout ASC" UWORD B_TRUE 1 100 0 1 BIT_MASK 0x40 FORMAT "%13.11" ECU_ADDRESS 0x383B28 /end MEASUREMENT
/begin MEASUREMENT B_bkcat "Bedingung: CAN-Schnittstelle, Timeout ASR" UWORD B_TRUE 1 100 0 1 BIT_MASK 0x40 FORMAT "%13.11" ECU_ADDRESS 0x383B2A /end MEASUREMENT
/begin MEASUREMENT B_bkcge "Bedingung: CAN-Schnittstelle, Timeout EGS" UWORD B_TRUE 1 100 0 1 BIT_MASK 0x40 FORMAT "%13.11" ECU_ADDRESS 0x383B2C /end MEASUREMENT
/begin MEASUREMENT B_bkcgra "Bedingung: CAN-Schnittstelle, Timeout Botschaft GRA" UWORD B_TRUE 1 100 0 1 BIT_MASK 0x40 FORMAT "%13.11" ECU_ADDRESS 0x383B2E /end MEASUREMENT
/begin MEASUREMENT B_bkcif "Bedingung: CAN-Schnittstelle, interner Fehler" UWORD B_TRUE 1 100 0 1 BIT_MASK 0x40 FORMAT "%13.11" ECU_ADDRESS 0x383B30 /end MEASUREMENT
/begin MEASUREMENT B_bkcins "Bedingung: CAN-Schnittstelle, Timeout Instrument" UWORD B_TRUE 1 100 0 1 BIT_MASK 0x40 FORMAT "%13.11" ECU_ADDRESS 0x383B32 /end MEASUREMENT
/begin MEASUREMENT B_bkckla "Bedingung : Botschaft Klima" UWORD B_TRUE 1 100 0 1 BIT_MASK 0x40 FORMAT "%13.11" ECU_ADDRESS 0x383B34 /end MEASUREMENT
/begin MEASUREMENT B_bkclws "Bedingung: CAN-Schnittstelle, Timeout Botschaft Lenkwinkelsensor" UWORD B_TRUE 1 100 0 1 BIT_MASK 0x40 FORMAT "%13.11" ECU_ADDRESS 0x383B36 /end MEASUREMENT
/begin MEASUREMENT B_bkdkvm "Bedingung Ersatzwert aktiv: Drosselklappenverschmutzung" UWORD B_TRUE 1 100 0 1 BIT_MASK 0x40 FORMAT "%13.11" ECU_ADDRESS 0x383B3E /end MEASUREMENT
/begin MEASUREMENT B_bkn "Bedingung: Drehzahlsignalgeber aktiv" UWORD B_TRUE 1 100 0 1 BIT_MASK 0x40 FORMAT "%13.11" ECU_ADDRESS 0x383BDC /end MEASUREMENT
/begin MEASUREMENT B_bktol "Bedingung Ersatzwert für (Motor-)Oel-Temperatur" UWORD B_TRUE 1 100 0 1 BIT_MASK 0x40 FORMAT "%13.11" ECU_ADDRESS 0x383C14 /end MEASUREMENT
/begin MEASUREMENT B_bktum "Bedingung Ersatzwert für Umgebumgstemperatur" UWORD B_TRUE 1 100 0 1 BIT_MASK 0x40 FORMAT "%13.11" ECU_ADDRESS 0x383C16 /end MEASUREMENT
/begin MEASUREMENT B_bkvnpler "Bedingung: Npl-Fehler BKV" UBYTE B_TRUE 1 100 0 1 BIT_MASK 0x1 FORMAT "%13.11" ECU_ADDRESS 0x38496F /end MEASUREMENT
/begin MEASUREMENT B_bkvnplh "Bedingung: Healing npl-Fehler" UBYTE B_TRUE 1 100 0 1 BIT_MASK 0x4 FORMAT "%13.11" ECU_ADDRESS 0x38496F /end MEASUREMENT
/begin MEASUREMENT B_bkvpea "Bedingung: Endstufe BKV Pumpe angesteuert" UBYTE B_TRUE 1 100 0 1 BIT_MASK 0x1 FORMAT "%13.11" ECU_ADDRESS 0x380B92 /end MEASUREMENT
/begin MEASUREMENT B_bkvpena "Bedingung: Endstufe BKV-Pumpe nicht angesteuert" UBYTE B_TRUE 1 100 0 1 BIT_MASK 0x2 FORMAT "%13.11" ECU_ADDRESS 0x380B92 /end MEASUREMENT
/begin MEASUREMENT B_br3bot "Bedingung Botschaft Bremse 3 wurde empfangen" UWORD B_TRUE 1 100 0 1 BIT_MASK 0x8 FORMAT "%13.11" ECU_ADDRESS 0xFD12 /end MEASUREMENT
/begin MEASUREMENT B_cankbi "Bedingung Kombi-Botschaft erkannt" UBYTE B_TRUE 1 100 0 1 BIT_MASK 0x1 FORMAT "%13.11" ECU_ADDRESS 0x383254 /end MEASUREMENT
/begin MEASUREMENT B_canlws "Bedingung LWS-Botschaft erkannt (bei autom. Erkennung)" UBYTE B_TRUE 1 100 0 1 BIT_MASK 0x4 FORMAT "%13.11" ECU_ADDRESS 0x383254 /end MEASUREMENT
/begin MEASUREMENT B_cdma "Bedingung Ausgabe doppelte Momente auf CAN" UWORD B_TRUE 1 100 0 1 BIT_MASK 0x10 FORMAT "%13.11" ECU_ADDRESS 0xFD12 /end MEASUREMENT
/begin MEASUREMENT B_ckien "Bedingung CAN-Übertragung vom Kombiinstrument enable" UWORD B_TRUE 1 100 0 1 BIT_MASK 0x20 FORMAT "%13.11" ECU_ADDRESS 0xFD12 /end MEASUREMENT
/begin MEASUREMENT B_clatr "Bedingung: Fehler Abgastemperaturregelung löschen" UWORD B_TRUE 1 100 0 1 BIT_MASK 0x80 FORMAT "%13.11" ECU_ADDRESS 0x383B0E /end MEASUREMENT
/begin MEASUREMENT B_clatr2 "Bedingung: Fehler Abgastemperaturregelung Bank 2 löschen" UWORD B_TRUE 1 100 0 1 BIT_MASK 0x80 FORMAT "%13.11" ECU_ADDRESS 0x383B10 /end MEASUREMENT
/begin MEASUREMENT B_clatrd "" UWORD B_TRUE 1 100 0 1 BIT_MASK 0x80 FORMAT "%13.11" ECU_ADDRESS 0x383B12 /end MEASUREMENT
/begin MEASUREMENT B_clatrd2 "" UWORD B_TRUE 1 100 0 1 BIT_MASK 0x80 FORMAT "%13.11" ECU_ADDRESS 0x383B14 /end MEASUREMENT
/begin MEASUREMENT B_clats "Bedingung: Fehler Abgastemperatursensor löschen" UWORD B_TRUE 1 100 0 1 BIT_MASK 0x80 FORMAT "%13.11" ECU_ADDRESS 0x383B16 /end MEASUREMENT
/begin MEASUREMENT B_clats2 "Bedingung: Fehler Abgastemperatursensor Bank 2 löschen" UWORD B_TRUE 1 100 0 1 BIT_MASK 0x80 FORMAT "%13.11" ECU_ADDRESS 0x383B18 /end MEASUREMENT
/begin MEASUREMENT B_clbkvp "Bedingung: Fehlerpfad Bremskraftverstärker-Pumpe löschen" UWORD B_TRUE 1 100 0 1 BIT_MASK 0x80 FORMAT "%13.11" ECU_ADDRESS 0x383B1A /end MEASUREMENT
/begin MEASUREMENT B_clbm "Bedingung Fehlerpfad Bezugsmarkengeber löschen" UWORD B_TRUE 1 100 0 1 BIT_MASK 0x80 FORMAT "%13.11" ECU_ADDRESS 0x383B1E /end MEASUREMENT
/begin MEASUREMENT B_clcair "Bedingung Fehlerpfad  cair löschen" UWORD B_TRUE 1 100 0 1 BIT_MASK 0x80 FORMAT "%13.11" ECU_ADDRESS 0x383B24 /end MEASUREMENT
/begin MEASUREMENT B_clcas "Bedingung Fehlerpfad CAS löschen" UWORD B_TRUE 1 100 0 1 BIT_MASK 0x80 FORMAT "%13.11" ECU_ADDRESS 0x383B28 /end MEASUREMENT
/begin MEASUREMENT B_clcat "Bedingung Fehlerpfad CAT löschen" UWORD B_TRUE 1 100 0 1 BIT_MASK 0x80 FORMAT "%13.11" ECU_ADDRESS 0x383B2A /end MEASUREMENT
/begin MEASUREMENT B_clcge "Bedingung Fehlerpfad CGE löschen" UWORD B_TRUE 1 100 0 1 BIT_MASK 0x80 FORMAT "%13.11" ECU_ADDRESS 0x383B2C /end MEASUREMENT
/begin MEASUREMENT B_clcgra "Bedingung Fehlerpfad  cgra löschen" UWORD B_TRUE 1 100 0 1 BIT_MASK 0x80 FORMAT "%13.11" ECU_ADDRESS 0x383B2E /end MEASUREMENT
/begin MEASUREMENT B_clcif "Bedingung Fehlerpfad CIF löschen" UWORD B_TRUE 1 100 0 1 BIT_MASK 0x80 FORMAT "%13.11" ECU_ADDRESS 0x383B30 /end MEASUREMENT
/begin MEASUREMENT B_clcins "Bedingung Fehlerpfad CINS löschen" UWORD B_TRUE 1 100 0 1 BIT_MASK 0x80 FORMAT "%13.11" ECU_ADDRESS 0x383B32 /end MEASUREMENT
/begin MEASUREMENT B_clckla "Bedingung Fehlerpfad  ckla löschen" UWORD B_TRUE 1 100 0 1 BIT_MASK 0x80 FORMAT "%13.11" ECU_ADDRESS 0x383B34 /end MEASUREMENT
/begin MEASUREMENT B_clclws "Bedingung CAN-Schnittstelle, Timeout Botschaft Lenkwinkelsensor löschen" UWORD B_TRUE 1 100 0 1 BIT_MASK 0x80 FORMAT "%13.11" ECU_ADDRESS 0x383B36 /end MEASUREMENT
/begin MEASUREMENT B_cldkvm "Bedingung Fehlerpfad Drosselklappenverschmutzung löschen" UWORD B_TRUE 1 100 0 1 BIT_MASK 0x80 FORMAT "%13.11" ECU_ADDRESS 0x383B3E /end MEASUREMENT
/begin MEASUREMENT B_cln "Bedingung Fehlerpfad Drehzahlgeber löschen" UWORD B_TRUE 1 100 0 1 BIT_MASK 0x80 FORMAT "%13.11" ECU_ADDRESS 0x383BDC /end MEASUREMENT
/begin MEASUREMENT B_cltol "Bedingung Fehlerpfad (Motor-)Oeltemperatur TOL löschen" UWORD B_TRUE 1 100 0 1 BIT_MASK 0x80 FORMAT "%13.11" ECU_ADDRESS 0x383C14 /end MEASUREMENT
/begin MEASUREMENT B_cltum "Bedingung Fehlerpfad Umgebungstemperatur TUM  löschen" UWORD B_TRUE 1 100 0 1 BIT_MASK 0x80 FORMAT "%13.11" ECU_ADDRESS 0x383C16 /end MEASUREMENT
/begin MEASUREMENT B_csair "Bedingung Checksummenfehler in der Airbag-Botschaft" UWORD B_TRUE 1 100 0 1 BIT_MASK 0x40 FORMAT "%13.11" ECU_ADDRESS 0xFD12 /end MEASUREMENT
/begin MEASUREMENT B_ctout "Bedingung: CAN-timeout Prüfung" UWORD B_TRUE 1 100 0 1 BIT_MASK 0x80 FORMAT "%13.11" ECU_ADDRESS 0xFD12 /end MEASUREMENT
/begin MEASUREMENT B_cvtad "Bedingung Adaptionsfreigabe bei CVT-Getriebe" UWORD B_TRUE 1 100 0 1 BIT_MASK 0x100 FORMAT "%13.11" ECU_ADDRESS 0xFD12 /end MEASUREMENT
/begin MEASUREMENT B_dbkvpa "Bedingung: Diagnose BKV-Pumpe aktiv" UBYTE B_TRUE 1 100 0 1 BIT_MASK 0x1 FORMAT "%13.11" ECU_ADDRESS 0x38496E /end MEASUREMENT
/begin MEASUREMENT B_dcy "Bedingung 'driving cycle' erkannt" UBYTE B_TRUE 1 100 0 1 BIT_MASK 0x1 FORMAT "%13.11" ECU_ADDRESS 0x3808F9 /end MEASUREMENT
/begin MEASUREMENT B_ddkvstp "Verriegelung der Funktion DDKV nach dem Fehlereintrag" UBYTE B_TRUE 1 100 0 1 BIT_MASK 0x4 FORMAT "%13.11" ECU_ADDRESS 0x3809CC /end MEASUREMENT
/begin MEASUREMENT B_desee "Diagnose Endstufe: Eingangsbedingungen erfüllt" UWORD B_TRUE 1 100 0 1 BIT_MASK 0x1000 FORMAT "%13.11" ECU_ADDRESS 0xFD4C /end MEASUREMENT
/begin MEASUREMENT B_dkve "Prüfung Drosselklappenverschmutzung eingeschaltet" UBYTE B_TRUE 1 100 0 1 BIT_MASK 0x1 FORMAT "%13.11" ECU_ADDRESS 0x3809CC /end MEASUREMENT
/begin MEASUREMENT B_ebkvl "Bedingung: Leckage bei BKV-DS" UBYTE B_TRUE 1 100 0 1 BIT_MASK 0x8 FORMAT "%13.11" ECU_ADDRESS 0x38496F /end MEASUREMENT
/begin MEASUREMENT B_ectal "Bedingung Tankinfo vom Kombi ist fehlerhaft" UWORD B_TRUE 1 100 0 1 BIT_MASK 0x200 FORMAT "%13.11" ECU_ADDRESS 0xFD12 /end MEASUREMENT
/begin MEASUREMENT B_eev "Bedingung Endstufenfehler EV" UWORD B_TRUE 1 100 0 1 BIT_MASK 0x4000 FORMAT "%13.11" ECU_ADDRESS 0xFD4C /end MEASUREMENT
/begin MEASUREMENT B_ehfmfe "Bedingung: Fehlerverdacht HFM aus DEGFE" UBYTE B_TRUE 1 100 0 1 BIT_MASK 0x80 FORMAT "%13.11" ECU_ADDRESS 0x3809D0 /end MEASUREMENT
/begin MEASUREMENT B_enabddg "Ausblendung der Drehzahlgeberdiagnose für E_bm" UBYTE B_TRUE 1 100 0 1 BIT_MASK 0x1 FORMAT "%13.11" ECU_ADDRESS 0x380915 /end MEASUREMENT
/begin MEASUREMENT B_epcden "Bedingung Endstufendiagnose EPCL erlaubt" UBYTE B_TRUE 1 100 0 1 BIT_MASK 0x2 FORMAT "%13.11" ECU_ADDRESS 0x383254 /end MEASUREMENT
/begin MEASUREMENT B_epcl "Bedingung für Ansteuerung EGAS-Fehlerlampe" UWORD B_TRUE 1 100 0 1 BIT_MASK 0x1 FORMAT "%13.11" ECU_ADDRESS 0xFD28 /end MEASUREMENT
/begin MEASUREMENT B_esdia "Endstufendiagnose aktiv" UWORD B_TRUE 1 100 0 1 BIT_MASK 0x2000 FORMAT "%13.11" ECU_ADDRESS 0xFD4C /end MEASUREMENT
/begin MEASUREMENT B_fatr "Bedingung Fehler Abgastemperaturregelung Bank 1" UWORD B_TRUE 1 100 0 1 BIT_MASK 0x4 FORMAT "%13.11" ECU_ADDRESS 0xFD68 /end MEASUREMENT
/begin MEASUREMENT B_fatr2 "Bedingung Fehler Abgastemperaturregelung Bank 2" UWORD B_TRUE 1 100 0 1 BIT_MASK 0x8 FORMAT "%13.11" ECU_ADDRESS 0xFD68 /end MEASUREMENT
/begin MEASUREMENT B_fdbkvp "Bedingung: Freigabe Diagnose Bremskraftverstärker-Pumpe" UBYTE B_TRUE 1 100 0 1 BIT_MASK 0x2 FORMAT "%13.11" ECU_ADDRESS 0x38496D /end MEASUREMENT
/begin MEASUREMENT B_fdkv "Fehler DK-Verschmutzung" UBYTE B_TRUE 1 100 0 1 BIT_MASK 0x2 FORMAT "%13.11" ECU_ADDRESS 0x3809CC /end MEASUREMENT
/begin MEASUREMENT B_fempos "Bedingung multiplikativer Anteil des Füllungsabgleichs im oberen Anschlag" UBYTE B_TRUE 1 100 0 1 BIT_MASK 0x4 FORMAT "%13.11" ECU_ADDRESS 0x3809D0 /end MEASUREMENT
/begin MEASUREMENT B_fempus "Bedingung multiplikativer Anteil des Füllungsabgleichs im unteren Anschlag" UBYTE B_TRUE 1 100 0 1 BIT_MASK 0x8 FORMAT "%13.11" ECU_ADDRESS 0x3809D0 /end MEASUREMENT
/begin MEASUREMENT B_fku "Bedingung Kupplungsfehler aus Botschaft Getriebe 2" UWORD B_TRUE 1 100 0 1 BIT_MASK 0x400 FORMAT "%13.11" ECU_ADDRESS 0xFD12 /end MEASUREMENT
/begin MEASUREMENT B_fpbkvmx "Freigabe: BKV-Druck genügend gross" UBYTE B_TRUE 1 100 0 1 BIT_MASK 0x4 FORMAT "%13.11" ECU_ADDRESS 0x38496D /end MEASUREMENT
/begin MEASUREMENT B_fstcanok "CAN: Bedingung Tankfuellstands-Message okay" UWORD B_TRUE 1 100 0 1 BIT_MASK 0x800 FORMAT "%13.11" ECU_ADDRESS 0xFD12 /end MEASUREMENT
/begin MEASUREMENT B_ftatr "" UWORD B_TRUE 1 100 0 1 BIT_MASK 0x10 FORMAT "%13.11" ECU_ADDRESS 0x383B0E /end MEASUREMENT
/begin MEASUREMENT B_ftatr2 "" UWORD B_TRUE 1 100 0 1 BIT_MASK 0x10 FORMAT "%13.11" ECU_ADDRESS 0x383B10 /end MEASUREMENT
/begin MEASUREMENT B_ftatrd "" UWORD B_TRUE 1 100 0 1 BIT_MASK 0x10 FORMAT "%13.11" ECU_ADDRESS 0x383B12 /end MEASUREMENT
/begin MEASUREMENT B_ftatrd2 "" UWORD B_TRUE 1 100 0 1 BIT_MASK 0x10 FORMAT "%13.11" ECU_ADDRESS 0x383B14 /end MEASUREMENT
/begin MEASUREMENT B_ftats "Bedingung Fehlereintrag durch Tester für Abgastemperatursensorsignal" UWORD B_TRUE 1 100 0 1 BIT_MASK 0x10 FORMAT "%13.11" ECU_ADDRESS 0x383B16 /end MEASUREMENT
/begin MEASUREMENT B_ftats2 "Bedingung Fehlereintrag durch Tester für Abgastemperatursensorsignal, Bank2" UWORD B_TRUE 1 100 0 1 BIT_MASK 0x10 FORMAT "%13.11" ECU_ADDRESS 0x383B18 /end MEASUREMENT
/begin MEASUREMENT B_ftbkvp "Bedingung: Fehlereintrag durch Tester für BKV-Pumpe" UWORD B_TRUE 1 100 0 1 BIT_MASK 0x10 FORMAT "%13.11" ECU_ADDRESS 0x383B1A /end MEASUREMENT
/begin MEASUREMENT B_ftbm "" UWORD B_TRUE 1 100 0 1 BIT_MASK 0x10 FORMAT "%13.11" ECU_ADDRESS 0x383B1E /end MEASUREMENT
/begin MEASUREMENT B_ftcair "Bedingung Fehlereintrag durch Tester : Airbag-Botschaft" UWORD B_TRUE 1 100 0 1 BIT_MASK 0x10 FORMAT "%13.11" ECU_ADDRESS 0x383B24 /end MEASUREMENT
/begin MEASUREMENT B_ftcas "Bedingung Fehlereintrag durch Tester: CAN-Schnittstelle ABS" UWORD B_TRUE 1 100 0 1 BIT_MASK 0x10 FORMAT "%13.11" ECU_ADDRESS 0x383B28 /end MEASUREMENT
/begin MEASUREMENT B_ftcat "Bedingung Fehlereintrag durch Tester : CAN-Schnittstelle, Timeout ASR" UWORD B_TRUE 1 100 0 1 BIT_MASK 0x10 FORMAT "%13.11" ECU_ADDRESS 0x383B2A /end MEASUREMENT
/begin MEASUREMENT B_ftcge "Bedingung Fehlereintrag durch Tester: CAN-Schnittstelle TCM" UWORD B_TRUE 1 100 0 1 BIT_MASK 0x10 FORMAT "%13.11" ECU_ADDRESS 0x383B2C /end MEASUREMENT
/begin MEASUREMENT B_ftcgra "Bedingung Fehlereintrag durch Tester für CAN-Timeout Botschaft GRA" UWORD B_TRUE 1 100 0 1 BIT_MASK 0x10 FORMAT "%13.11" ECU_ADDRESS 0x383B2E /end MEASUREMENT
/begin MEASUREMENT B_ftcif "Bedingung Fehlereintrag durch Tester : CAN im Zustand Bus-Off" UWORD B_TRUE 1 100 0 1 BIT_MASK 0x10 FORMAT "%13.11" ECU_ADDRESS 0x383B30 /end MEASUREMENT
/begin MEASUREMENT B_ftcins "Bedingung Fehlereintrag durch Tester : Botschaft Kombi" UWORD B_TRUE 1 100 0 1 BIT_MASK 0x10 FORMAT "%13.11" ECU_ADDRESS 0x383B32 /end MEASUREMENT
/begin MEASUREMENT B_ftckla "Bedingung Fehlereintrag durch Tester : Botschaft Klima" UWORD B_TRUE 1 100 0 1 BIT_MASK 0x10 FORMAT "%13.11" ECU_ADDRESS 0x383B34 /end MEASUREMENT
/begin MEASUREMENT B_ftclws "Bedingung Fehlereintrag durch Tester : Lenkwinkel-Botschaft" UWORD B_TRUE 1 100 0 1 BIT_MASK 0x10 FORMAT "%13.11" ECU_ADDRESS 0x383B36 /end MEASUREMENT
/begin MEASUREMENT B_ftdkvm "Bedingung: Fehlereintrag durch Tester für Drosselklappenverschmutzung" UWORD B_TRUE 1 100 0 1 BIT_MASK 0x10 FORMAT "%13.11" ECU_ADDRESS 0x383B3E /end MEASUREMENT
/begin MEASUREMENT B_ftn "" UWORD B_TRUE 1 100 0 1 BIT_MASK 0x10 FORMAT "%13.11" ECU_ADDRESS 0x383BDC /end MEASUREMENT
/begin MEASUREMENT B_fttol "Bedingung: Fehlereintrag durch Tester" UWORD B_TRUE 1 100 0 1 BIT_MASK 0x10 FORMAT "%13.11" ECU_ADDRESS 0x383C14 /end MEASUREMENT
/begin MEASUREMENT B_fttum "Bedingung: Fehlereintrag durch Tester" UWORD B_TRUE 1 100 0 1 BIT_MASK 0x10 FORMAT "%13.11" ECU_ADDRESS 0x383C16 /end MEASUREMENT
/begin MEASUREMENT B_gaedegfe "Bedingung Gemischadaption für Zuweisung eines Fehlers in der FE eingeschwungen" UBYTE B_TRUE 1 100 0 1 BIT_MASK 0x10 FORMAT "%13.11" ECU_ADDRESS 0x3809D0 /end MEASUREMENT
/begin MEASUREMENT B_gafraos "Bedingung Faktor fra aus Gemischadaption am oberen Anschlag" UBYTE B_TRUE 1 100 0 1 BIT_MASK 0x1 FORMAT "%13.11" ECU_ADDRESS 0x38332D /end MEASUREMENT
/begin MEASUREMENT B_gafraus "Bedingung Faktor fra aus Gemischadaption am unteren Anschlag" UBYTE B_TRUE 1 100 0 1 BIT_MASK 0x2 FORMAT "%13.11" ECU_ADDRESS 0x38332D /end MEASUREMENT
/begin MEASUREMENT B_gekoa "Bedingung Kompressor wegen Getriebeeingriff abschalten" UWORD B_TRUE 1 100 0 1 BIT_MASK 0x1000 FORMAT "%13.11" ECU_ADDRESS 0xFD12 /end MEASUREMENT
/begin MEASUREMENT B_ges "Bedingung Getriebeschutz über Zylinderausblendung" UWORD B_TRUE 1 100 0 1 BIT_MASK 0x2000 FORMAT "%13.11" ECU_ADDRESS 0xFD12 /end MEASUREMENT
/begin MEASUREMENT B_geuew "Bedingung Zeitüberwachung Getriebeeingriff (CAN)" UWORD B_TRUE 1 100 0 1 BIT_MASK 0x4000 FORMAT "%13.11" ECU_ADDRESS 0xFD12 /end MEASUREMENT
/begin MEASUREMENT B_grabot "Bedingung GRA-Botschaft empfangen" UWORD B_TRUE 1 100 0 1 BIT_MASK 0x8000 FORMAT "%13.11" ECU_ADDRESS 0xFD12 /end MEASUREMENT
/begin MEASUREMENT B_gsaf "Bedingung Getriebe-Schalteingriff-Anforderung" UWORD B_TRUE 1 100 0 1 BIT_MASK 0x1 FORMAT "%13.11" ECU_ADDRESS 0xFD14 /end MEASUREMENT
/begin MEASUREMENT B_gsch "Bedingung Getriebeschaltung aktiv" UWORD B_TRUE 1 100 0 1 BIT_MASK 0x2 FORMAT "%13.11" ECU_ADDRESS 0xFD14 /end MEASUREMENT
/begin MEASUREMENT B_hbkvl "Bedingung: es liegt kein npl. Fehler durch Leckage in BKV vor" UBYTE B_TRUE 1 100 0 1 BIT_MASK 0x2 FORMAT "%13.11" ECU_ADDRESS 0x38496F /end MEASUREMENT
/begin MEASUREMENT B_kooffc "Bedingung für hartes Kompressorabschalten aus Bordnetz über CAN" UWORD B_TRUE 1 100 0 1 BIT_MASK 0x4 FORMAT "%13.11" ECU_ADDRESS 0xFD14 /end MEASUREMENT
/begin MEASUREMENT B_laedegfe "Bedingung: Langsamer Abgleich eingeschwungen für DEGFE" UBYTE B_TRUE 1 100 0 1 BIT_MASK 0x20 FORMAT "%13.11" ECU_ADDRESS 0x3809D0 /end MEASUREMENT
/begin MEASUREMENT B_lowra "Bedingung Zwischengelege für Low Range zugeschaltet" UWORD B_TRUE 1 100 0 1 BIT_MASK 0x8 FORMAT "%13.11" ECU_ADDRESS 0xFD14 /end MEASUREMENT
/begin MEASUREMENT B_luesscb "Bedingung Lüftersteuerung aus Klimabotschaft auswertbar" UWORD B_TRUE 1 100 0 1 BIT_MASK 0x10 FORMAT "%13.11" ECU_ADDRESS 0xFD14 /end MEASUREMENT
/begin MEASUREMENT B_lwsbot "Bedingung LWS-Botschaft empfangen" UWORD B_TRUE 1 100 0 1 BIT_MASK 0x20 FORMAT "%13.11" ECU_ADDRESS 0xFD14 /end MEASUREMENT
/begin MEASUREMENT B_lwser "Fehler im Lenkwinkelsensorpfad" UWORD B_TRUE 1 100 0 1 BIT_MASK 0x40 FORMAT "%13.11" ECU_ADDRESS 0xFD14 /end MEASUREMENT
/begin MEASUREMENT B_lwsok "Bedingung LWS-Caninfo ist fehlerfrei" UWORD B_TRUE 1 100 0 1 BIT_MASK 0x80 FORMAT "%13.11" ECU_ADDRESS 0xFD14 /end MEASUREMENT
/begin MEASUREMENT B_mdwaner "Bedingung Fehler auf mdwan_w" UWORD B_TRUE 1 100 0 1 BIT_MASK 0x100 FORMAT "%13.11" ECU_ADDRESS 0xFD14 /end MEASUREMENT
/begin MEASUREMENT B_mgbget "Bedingung Momentengradientenbegrenzung aktiv" UWORD B_TRUE 1 100 0 1 BIT_MASK 0x200 FORMAT "%13.11" ECU_ADDRESS 0xFD14 /end MEASUREMENT
/begin MEASUREMENT B_milfb "MIL-Ansteuerung fremdbestimmt durch externes SG" UWORD B_TRUE 1 100 0 1 BIT_MASK 0x400 FORMAT "%13.11" ECU_ADDRESS 0xFD14 /end MEASUREMENT
/begin MEASUREMENT B_milfbg "Bedingung MIL-Ansteuerung vom Getriebe" UWORD B_TRUE 1 100 0 1 BIT_MASK 0x800 FORMAT "%13.11" ECU_ADDRESS 0xFD14 /end MEASUREMENT
/begin MEASUREMENT B_mnatr "Bedingung: Min-Fehler Abgastemperaturregelung" UWORD B_TRUE 1 100 0 1 BIT_MASK 0x200 FORMAT "%13.11" ECU_ADDRESS 0x383B0E /end MEASUREMENT
/begin MEASUREMENT B_mnatr2 "Bedingung: Min-Fehler Abgastemperaturregelung Bank 2" UWORD B_TRUE 1 100 0 1 BIT_MASK 0x200 FORMAT "%13.11" ECU_ADDRESS 0x383B10 /end MEASUREMENT
/begin MEASUREMENT B_mnatrd "" UWORD B_TRUE 1 100 0 1 BIT_MASK 0x200 FORMAT "%13.11" ECU_ADDRESS 0x383B12 /end MEASUREMENT
/begin MEASUREMENT B_mnatrd2 "" UWORD B_TRUE 1 100 0 1 BIT_MASK 0x200 FORMAT "%13.11" ECU_ADDRESS 0x383B14 /end MEASUREMENT
/begin MEASUREMENT B_mnats "Fehlerart:  Min-Fehler Abgastemperatursensor" UWORD B_TRUE 1 100 0 1 BIT_MASK 0x200 FORMAT "%13.11" ECU_ADDRESS 0x383B16 /end MEASUREMENT
/begin MEASUREMENT B_mnats2 "Fehlerart:  Min-Fehler Abgastemperatursensor Bank 2" UWORD B_TRUE 1 100 0 1 BIT_MASK 0x200 FORMAT "%13.11" ECU_ADDRESS 0x383B18 /end MEASUREMENT
/begin MEASUREMENT B_mnbkvp "Bedingung: min. Fehler BKV-Pumpe" UWORD B_TRUE 1 100 0 1 BIT_MASK 0x200 FORMAT "%13.11" ECU_ADDRESS 0x383B1A /end MEASUREMENT
/begin MEASUREMENT B_mnbm "Fehlertyp: häufige Korrektur bei einem Zahn zuwenig" UWORD B_TRUE 1 100 0 1 BIT_MASK 0x200 FORMAT "%13.11" ECU_ADDRESS 0x383B1E /end MEASUREMENT
/begin MEASUREMENT B_mncair "Fehlertyp min. : Airbag-Botschaft" UWORD B_TRUE 1 100 0 1 BIT_MASK 0x200 FORMAT "%13.11" ECU_ADDRESS 0x383B24 /end MEASUREMENT
/begin MEASUREMENT B_mncas "Fehlertyp min.: CAN-Schnittstelle, Timeout ASC" UWORD B_TRUE 1 100 0 1 BIT_MASK 0x200 FORMAT "%13.11" ECU_ADDRESS 0x383B28 /end MEASUREMENT
/begin MEASUREMENT B_mncat "Fehlertyp min.: CAN-Schnittstelle, Timeout ASR" UWORD B_TRUE 1 100 0 1 BIT_MASK 0x200 FORMAT "%13.11" ECU_ADDRESS 0x383B2A /end MEASUREMENT
/begin MEASUREMENT B_mncge "Fehlertyp min.: CAN-Schnittstelle, Timeout EGS" UWORD B_TRUE 1 100 0 1 BIT_MASK 0x200 FORMAT "%13.11" ECU_ADDRESS 0x383B2C /end MEASUREMENT
/begin MEASUREMENT B_mncgra "Fehlertyp : Min-Fehler GRA-Botschaft" UWORD B_TRUE 1 100 0 1 BIT_MASK 0x200 FORMAT "%13.11" ECU_ADDRESS 0x383B2E /end MEASUREMENT
/begin MEASUREMENT B_mncif "Fehlertyp min.: CAN-Schnittstelle, interner Fehler" UWORD B_TRUE 1 100 0 1 BIT_MASK 0x200 FORMAT "%13.11" ECU_ADDRESS 0x383B30 /end MEASUREMENT
/begin MEASUREMENT B_mncins "Fehlertyp min.: CAN-Schnittstelle, Timeout Instrument" UWORD B_TRUE 1 100 0 1 BIT_MASK 0x200 FORMAT "%13.11" ECU_ADDRESS 0x383B32 /end MEASUREMENT
/begin MEASUREMENT B_mnckla "Fehlertyp min. : Botschaft Klima" UWORD B_TRUE 1 100 0 1 BIT_MASK 0x200 FORMAT "%13.11" ECU_ADDRESS 0x383B34 /end MEASUREMENT
/begin MEASUREMENT B_mnclws "Fehlertyp min.: CAN-Schnittstelle, Timeout Botschaft Lenkwinkelsensor" UWORD B_TRUE 1 100 0 1 BIT_MASK 0x200 FORMAT "%13.11" ECU_ADDRESS 0x383B36 /end MEASUREMENT
/begin MEASUREMENT B_mndkvm "Fehlertyp min.: Drosselklappenverschmutzung" UWORD B_TRUE 1 100 0 1 BIT_MASK 0x200 FORMAT "%13.11" ECU_ADDRESS 0x383B3E /end MEASUREMENT
/begin MEASUREMENT B_mnn "Fehlerart: Synchronisationsmarke häufig nicht gefunden" UWORD B_TRUE 1 100 0 1 BIT_MASK 0x200 FORMAT "%13.11" ECU_ADDRESS 0x383BDC /end MEASUREMENT
/begin MEASUREMENT B_mntol "Fehlertyp: Minimalwertunterschreitung (Motor-) Oeltemperatur" UWORD B_TRUE 1 100 0 1 BIT_MASK 0x200 FORMAT "%13.11" ECU_ADDRESS 0x383C14 /end MEASUREMENT
/begin MEASUREMENT B_mntum "Fehlertyp: Minimalwertunterschreitung Umgebungstemperatur" UWORD B_TRUE 1 100 0 1 BIT_MASK 0x200 FORMAT "%13.11" ECU_ADDRESS 0x383C16 /end MEASUREMENT
/begin MEASUREMENT B_motaus "CAN-Signal: ""Motor AUS""-Anforderung vom F1-Getriebe (KUP)" UWORD B_TRUE 1 100 0 1 BIT_MASK 0x1000 FORMAT "%13.11" ECU_ADDRESS 0xFD14 /end MEASUREMENT
/begin MEASUREMENT B_mxatr "Maxfehler Abgastemperaturregelung" UWORD B_TRUE 1 100 0 1 BIT_MASK 0x100 FORMAT "%13.11" ECU_ADDRESS 0x383B0E /end MEASUREMENT
/begin MEASUREMENT B_mxatr2 "Maxfehler Abgastemperaturregelung Bank 2" UWORD B_TRUE 1 100 0 1 BIT_MASK 0x100 FORMAT "%13.11" ECU_ADDRESS 0x383B10 /end MEASUREMENT
/begin MEASUREMENT B_mxatrd "" UWORD B_TRUE 1 100 0 1 BIT_MASK 0x100 FORMAT "%13.11" ECU_ADDRESS 0x383B12 /end MEASUREMENT
/begin MEASUREMENT B_mxatrd2 "" UWORD B_TRUE 1 100 0 1 BIT_MASK 0x100 FORMAT "%13.11" ECU_ADDRESS 0x383B14 /end MEASUREMENT
/begin MEASUREMENT B_mxats "Fehlerart:  Max-Fehler Abgastemperatursensor" UWORD B_TRUE 1 100 0 1 BIT_MASK 0x100 FORMAT "%13.11" ECU_ADDRESS 0x383B16 /end MEASUREMENT
/begin MEASUREMENT B_mxats2 "Fehlerart:  Max-Fehler Abgastemperatursensor Bank 2" UWORD B_TRUE 1 100 0 1 BIT_MASK 0x100 FORMAT "%13.11" ECU_ADDRESS 0x383B18 /end MEASUREMENT
/begin MEASUREMENT B_mxbkvp "Bedingung: max. Fehler BKV-Pumpe" UWORD B_TRUE 1 100 0 1 BIT_MASK 0x100 FORMAT "%13.11" ECU_ADDRESS 0x383B1A /end MEASUREMENT
/begin MEASUREMENT B_mxbm "Fehlertyp: häufige Korrektur bei einem Zahn zuviel" UWORD B_TRUE 1 100 0 1 BIT_MASK 0x100 FORMAT "%13.11" ECU_ADDRESS 0x383B1E /end MEASUREMENT
/begin MEASUREMENT B_mxcair "Fehlertyp max. : Airbag-Botschaft" UWORD B_TRUE 1 100 0 1 BIT_MASK 0x100 FORMAT "%13.11" ECU_ADDRESS 0x383B24 /end MEASUREMENT
/begin MEASUREMENT B_mxcas "Fehlertyp max.: CAN-Schnittstelle, Timeout Botschaft ASC" UWORD B_TRUE 1 100 0 1 BIT_MASK 0x100 FORMAT "%13.11" ECU_ADDRESS 0x383B28 /end MEASUREMENT
/begin MEASUREMENT B_mxcat "Fehlertyp max.: CAN-Schnittstelle, Timeout ASR" UWORD B_TRUE 1 100 0 1 BIT_MASK 0x100 FORMAT "%13.11" ECU_ADDRESS 0x383B2A /end MEASUREMENT
/begin MEASUREMENT B_mxcge "Fehlertyp max.: CAN-Schnittstelle, Timeout EGS" UWORD B_TRUE 1 100 0 1 BIT_MASK 0x100 FORMAT "%13.11" ECU_ADDRESS 0x383B2C /end MEASUREMENT
/begin MEASUREMENT B_mxcgra "Fehlertyp : Max-Fehler GRA-Botschaft" UWORD B_TRUE 1 100 0 1 BIT_MASK 0x100 FORMAT "%13.11" ECU_ADDRESS 0x383B2E /end MEASUREMENT
/begin MEASUREMENT B_mxcif "Fehlertyp max.: CAN-Schnittstelle, interner Fehler            2" UWORD B_TRUE 1 100 0 1 BIT_MASK 0x100 FORMAT "%13.11" ECU_ADDRESS 0x383B30 /end MEASUREMENT
/begin MEASUREMENT B_mxcins "Fehlertyp max.: CAN-Schnittstelle, Timeout Instrument" UWORD B_TRUE 1 100 0 1 BIT_MASK 0x100 FORMAT "%13.11" ECU_ADDRESS 0x383B32 /end MEASUREMENT
/begin MEASUREMENT B_mxckla "Fehlertyp max. : Botschaft Klima" UWORD B_TRUE 1 100 0 1 BIT_MASK 0x100 FORMAT "%13.11" ECU_ADDRESS 0x383B34 /end MEASUREMENT
/begin MEASUREMENT B_mxclws "Fehlertyp max.: CAN-Schnittstelle, Timeout Botschaft Lenkwinkelsensor" UWORD B_TRUE 1 100 0 1 BIT_MASK 0x100 FORMAT "%13.11" ECU_ADDRESS 0x383B36 /end MEASUREMENT
/begin MEASUREMENT B_mxdkvm "Fehlertyp max.: Drosselklappenverschmutzung" UWORD B_TRUE 1 100 0 1 BIT_MASK 0x100 FORMAT "%13.11" ECU_ADDRESS 0x383B3E /end MEASUREMENT
/begin MEASUREMENT B_mxn "Fehlerart: häufiger Lückenverlust beim Lückencheck" UWORD B_TRUE 1 100 0 1 BIT_MASK 0x100 FORMAT "%13.11" ECU_ADDRESS 0x383BDC /end MEASUREMENT
/begin MEASUREMENT B_mxtol "Fehlertyp: Maximalwertüberschreitung (Motor-) Oeltemperatur" UWORD B_TRUE 1 100 0 1 BIT_MASK 0x100 FORMAT "%13.11" ECU_ADDRESS 0x383C14 /end MEASUREMENT
/begin MEASUREMENT B_mxtum "Fehlertyp: Maximalwertüberschreitung Umgebungstemperatur" UWORD B_TRUE 1 100 0 1 BIT_MASK 0x100 FORMAT "%13.11" ECU_ADDRESS 0x383C16 /end MEASUREMENT
/begin MEASUREMENT B_nlbm "Bedingung für NLDG wenn Bezugsmarke häufig verloren wird" UWORD B_TRUE 1 100 0 1 BIT_MASK 0x80 FORMAT "%13.11" ECU_ADDRESS 0xFD28 /end MEASUREMENT
/begin MEASUREMENT B_nlbzanf "Anforderung von Bordnetzmangement zur Anhebung der Leerlaufdrehzahl" UWORD B_TRUE 1 100 0 1 BIT_MASK 0x2000 FORMAT "%13.11" ECU_ADDRESS 0xFD14 /end MEASUREMENT
/begin MEASUREMENT B_nldg "Bedingung Drehzahlgeber-Notlauf ist aktiv" UWORD B_TRUE 1 100 0 1 BIT_MASK 0x100 FORMAT "%13.11" ECU_ADDRESS 0xFD28 /end MEASUREMENT
/begin MEASUREMENT B_nlnobm "Bedingung für NLDG wenn keine Bezugsmarke gefunden wurde" UWORD B_TRUE 1 100 0 1 BIT_MASK 0x200 FORMAT "%13.11" ECU_ADDRESS 0xFD28 /end MEASUREMENT
/begin MEASUREMENT B_nlnon "Bedingung für NLDG wenn keine Zahnsignale vorhanden sind" UWORD B_TRUE 1 100 0 1 BIT_MASK 0x400 FORMAT "%13.11" ECU_ADDRESS 0xFD28 /end MEASUREMENT
/begin MEASUREMENT B_no "unendlich-Trigger für Fehlerpfadmanagement" UBYTE B_TRUE 1 100 0 1 BIT_MASK 0x1 FORMAT "%13.11" ECU_ADDRESS 0x38330A /end MEASUREMENT
/begin MEASUREMENT B_nobmflr1 "Es liegen keine Bezugsmarkenverluste vor" UWORD B_TRUE 1 100 0 1 BIT_MASK 0x800 FORMAT "%13.11" ECU_ADDRESS 0xFD28 /end MEASUREMENT
/begin MEASUREMENT B_nobmflr2 "Bezugsmarke wurde im Start richtig erkannt" UWORD B_TRUE 1 100 0 1 BIT_MASK 0x1000 FORMAT "%13.11" ECU_ADDRESS 0xFD28 /end MEASUREMENT
/begin MEASUREMENT B_nocorflr "Es wurden keine Zahnkorrekturen vorgenommen" UWORD B_TRUE 1 100 0 1 BIT_MASK 0x2000 FORMAT "%13.11" ECU_ADDRESS 0xFD28 /end MEASUREMENT
/begin MEASUREMENT B_nohts "Bedingung Sondenheizung auf Temperatursollwert" UWORD B_TRUE 1 100 0 1 BIT_MASK 0x4000 FORMAT "%13.11" ECU_ADDRESS 0xFD14 /end MEASUREMENT
/begin MEASUREMENT B_noip0s "Bedingung Ip0 eingeschwungen, NOx-Sensor-Controller" UWORD B_TRUE 1 100 0 1 BIT_MASK 0x8000 FORMAT "%13.11" ECU_ADDRESS 0xFD14 /end MEASUREMENT
/begin MEASUREMENT B_noip1s "Bedingung Ip1 eingeschwungen, NOx-Sensor-Controller" UWORD B_TRUE 1 100 0 1 BIT_MASK 0x1 FORMAT "%13.11" ECU_ADDRESS 0xFD16 /end MEASUREMENT
/begin MEASUREMENT B_noip2s "Bedingung Ip2 eingeschwungen, NOx-Sensor-Controller" UWORD B_TRUE 1 100 0 1 BIT_MASK 0x2 FORMAT "%13.11" ECU_ADDRESS 0xFD16 /end MEASUREMENT
/begin MEASUREMENT B_nooke "Bedingung Offsetkorrektur erfolgreich, Nox-Sensor-Controller" UWORD B_TRUE 1 100 0 1 BIT_MASK 0x4 FORMAT "%13.11" ECU_ADDRESS 0xFD16 /end MEASUREMENT
/begin MEASUREMENT B_npatr "Nicht plausibel Fehler Abgastemperaturregelung" UWORD B_TRUE 1 100 0 1 BIT_MASK 0x800 FORMAT "%13.11" ECU_ADDRESS 0x383B0E /end MEASUREMENT
/begin MEASUREMENT B_npatr2 "Nicht plausible Fehler Abgastemperaturregelung Bank 2" UWORD B_TRUE 1 100 0 1 BIT_MASK 0x800 FORMAT "%13.11" ECU_ADDRESS 0x383B10 /end MEASUREMENT
/begin MEASUREMENT B_npatrd "Bedingung: Unplausible Bankabweichung ATR" UWORD B_TRUE 1 100 0 1 BIT_MASK 0x800 FORMAT "%13.11" ECU_ADDRESS 0x383B12 /end MEASUREMENT
/begin MEASUREMENT B_npatrd2 "Bedingung: Unplausible Bankabweichung ATR Bank 2" UWORD B_TRUE 1 100 0 1 BIT_MASK 0x800 FORMAT "%13.11" ECU_ADDRESS 0x383B14 /end MEASUREMENT
/begin MEASUREMENT B_npats "Fehlerart:  Nichtplausibel Fehler Abgastemperatursensor" UWORD B_TRUE 1 100 0 1 BIT_MASK 0x800 FORMAT "%13.11" ECU_ADDRESS 0x383B16 /end MEASUREMENT
/begin MEASUREMENT B_npats2 "Fehlerart:  Nichtplausibel Fehler Abgastemperatursensor Bank 2" UWORD B_TRUE 1 100 0 1 BIT_MASK 0x800 FORMAT "%13.11" ECU_ADDRESS 0x383B18 /end MEASUREMENT
/begin MEASUREMENT B_npbkvp "Fehlertyp unplaus.: Bremskraftverstärler-Pumpe" UWORD B_TRUE 1 100 0 1 BIT_MASK 0x800 FORMAT "%13.11" ECU_ADDRESS 0x383B1A /end MEASUREMENT
/begin MEASUREMENT B_npbm "Fehlertyp: Bezugsmarkenfehler beim Lückencheck" UWORD B_TRUE 1 100 0 1 BIT_MASK 0x800 FORMAT "%13.11" ECU_ADDRESS 0x383B1E /end MEASUREMENT
/begin MEASUREMENT B_npcair "Fehlertyp : Airbag-Botschaft" UWORD B_TRUE 1 100 0 1 BIT_MASK 0x800 FORMAT "%13.11" ECU_ADDRESS 0x383B24 /end MEASUREMENT
/begin MEASUREMENT B_npcas "Fehlertyp: CAN-Schnittstelle, Timeout ASC" UWORD B_TRUE 1 100 0 1 BIT_MASK 0x800 FORMAT "%13.11" ECU_ADDRESS 0x383B28 /end MEASUREMENT
/begin MEASUREMENT B_npcat "Fehlertyp: CAN-Schnittstelle Timeout ASR" UWORD B_TRUE 1 100 0 1 BIT_MASK 0x800 FORMAT "%13.11" ECU_ADDRESS 0x383B2A /end MEASUREMENT
/begin MEASUREMENT B_npcge "Fehlerart:CAN-Schnittstelle, Timeout EGS" UWORD B_TRUE 1 100 0 1 BIT_MASK 0x800 FORMAT "%13.11" ECU_ADDRESS 0x383B2C /end MEASUREMENT
/begin MEASUREMENT B_npcgra "Fehlertyp : unplausibles Signal in der GRA-Botschaft" UWORD B_TRUE 1 100 0 1 BIT_MASK 0x800 FORMAT "%13.11" ECU_ADDRESS 0x383B2E /end MEASUREMENT
/begin MEASUREMENT B_npcif "Fehlertyp: nicht plausibles Signal vom CAN (bus-off)" UWORD B_TRUE 1 100 0 1 BIT_MASK 0x800 FORMAT "%13.11" ECU_ADDRESS 0x383B30 /end MEASUREMENT
/begin MEASUREMENT B_npcins "Fehlerart:CAN-Schnittstelle, Timeout Instrument" UWORD B_TRUE 1 100 0 1 BIT_MASK 0x800 FORMAT "%13.11" ECU_ADDRESS 0x383B32 /end MEASUREMENT
/begin MEASUREMENT B_npckla "Bedingung Plausibilitätsfehler der Clima-CAN-Botschaft" UWORD B_TRUE 1 100 0 1 BIT_MASK 0x800 FORMAT "%13.11" ECU_ADDRESS 0x383B34 /end MEASUREMENT
/begin MEASUREMENT B_npclws "Fehlertyp: LWS-Botschaft" UWORD B_TRUE 1 100 0 1 BIT_MASK 0x800 FORMAT "%13.11" ECU_ADDRESS 0x383B36 /end MEASUREMENT
/begin MEASUREMENT B_npdkvm "Fehlertyp nicht plausibel: Drosselklappenverschmutzung" UWORD B_TRUE 1 100 0 1 BIT_MASK 0x800 FORMAT "%13.11" ECU_ADDRESS 0x383B3E /end MEASUREMENT
/begin MEASUREMENT B_npn "Fehlerart: häufiger Bezugsmarkenfehler beim Lückencheck" UWORD B_TRUE 1 100 0 1 BIT_MASK 0x800 FORMAT "%13.11" ECU_ADDRESS 0x383BDC /end MEASUREMENT
/begin MEASUREMENT B_nptol "Nicht plausibler Fehler: Öltemperatur" UWORD B_TRUE 1 100 0 1 BIT_MASK 0x800 FORMAT "%13.11" ECU_ADDRESS 0x383C14 /end MEASUREMENT
/begin MEASUREMENT B_nptum "Fehlerart: Signal Umgebungstemperatur unplausibel" UWORD B_TRUE 1 100 0 1 BIT_MASK 0x800 FORMAT "%13.11" ECU_ADDRESS 0x383C16 /end MEASUREMENT
/begin MEASUREMENT B_nuair "Bedingung Nachrichtenunterbrechung Airbag-Botschaft" UWORD B_TRUE 1 100 0 1 BIT_MASK 0x8 FORMAT "%13.11" ECU_ADDRESS 0xFD16 /end MEASUREMENT
/begin MEASUREMENT B_nukla "Bedingung Nachrichtenunterbrechung Klima-Botschaft" UWORD B_TRUE 1 100 0 1 BIT_MASK 0x10 FORMAT "%13.11" ECU_ADDRESS 0xFD16 /end MEASUREMENT
/begin MEASUREMENT B_pycair "" UWORD B_TRUE 1 100 0 1 BIT_MASK 0x2000 FORMAT "%13.11" ECU_ADDRESS 0x383B24 /end MEASUREMENT
/begin MEASUREMENT B_pycas "" UWORD B_TRUE 1 100 0 1 BIT_MASK 0x2000 FORMAT "%13.11" ECU_ADDRESS 0x383B28 /end MEASUREMENT
/begin MEASUREMENT B_pycat "" UWORD B_TRUE 1 100 0 1 BIT_MASK 0x2000 FORMAT "%13.11" ECU_ADDRESS 0x383B2A /end MEASUREMENT
/begin MEASUREMENT B_pycge "" UWORD B_TRUE 1 100 0 1 BIT_MASK 0x2000 FORMAT "%13.11" ECU_ADDRESS 0x383B2C /end MEASUREMENT
/begin MEASUREMENT B_pycgra "" UWORD B_TRUE 1 100 0 1 BIT_MASK 0x2000 FORMAT "%13.11" ECU_ADDRESS 0x383B2E /end MEASUREMENT
/begin MEASUREMENT B_pycif "" UWORD B_TRUE 1 100 0 1 BIT_MASK 0x2000 FORMAT "%13.11" ECU_ADDRESS 0x383B30 /end MEASUREMENT
/begin MEASUREMENT B_pycins "" UWORD B_TRUE 1 100 0 1 BIT_MASK 0x2000 FORMAT "%13.11" ECU_ADDRESS 0x383B32 /end MEASUREMENT
/begin MEASUREMENT B_pyckla "" UWORD B_TRUE 1 100 0 1 BIT_MASK 0x2000 FORMAT "%13.11" ECU_ADDRESS 0x383B34 /end MEASUREMENT
/begin MEASUREMENT B_pyclws "" UWORD B_TRUE 1 100 0 1 BIT_MASK 0x2000 FORMAT "%13.11" ECU_ADDRESS 0x383B36 /end MEASUREMENT
/begin MEASUREMENT B_pytol "" UWORD B_TRUE 1 100 0 1 BIT_MASK 0x2000 FORMAT "%13.11" ECU_ADDRESS 0x383C14 /end MEASUREMENT
/begin MEASUREMENT B_rdbkvp "Bedingung: Rücksetzen der Diagnose BKV-Pumpe" UBYTE B_TRUE 1 100 0 1 BIT_MASK 0x2 FORMAT "%13.11" ECU_ADDRESS 0x38496E /end MEASUREMENT
/begin MEASUREMENT B_rdbkvpps "Bedingung: Rücksetzen der Diagnose BKV-Pumpe, da ps BKV evakuiert" UBYTE B_TRUE 1 100 0 1 BIT_MASK 0x8 FORMAT "%13.11" ECU_ADDRESS 0x38496E /end MEASUREMENT
/begin MEASUREMENT B_rtdbkvl "Bedingung: Rücksetzen der Leckagediagnose des BKV" UBYTE B_TRUE 1 100 0 1 BIT_MASK 0x10 FORMAT "%13.11" ECU_ADDRESS 0x38496F /end MEASUREMENT
/begin MEASUREMENT B_rtdbkvp "Bedingung: Reset getriggert von Diagnose BKV-Pumpe" UBYTE B_TRUE 1 100 0 1 BIT_MASK 0x4 FORMAT "%13.11" ECU_ADDRESS 0x38496E /end MEASUREMENT
/begin MEASUREMENT B_sacc "Bedingung Klima-Anforderung aktiv aus CAN-Botschaft Clima1" UWORD B_TRUE 1 100 0 1 BIT_MASK 0x20 FORMAT "%13.11" ECU_ADDRESS 0xFD16 /end MEASUREMENT
/begin MEASUREMENT B_sacvt "Bedingung Schubabschaltunterstützung für CVT-Getriebe" UWORD B_TRUE 1 100 0 1 BIT_MASK 0x40 FORMAT "%13.11" ECU_ADDRESS 0xFD16 /end MEASUREMENT
/begin MEASUREMENT B_sccair "" UWORD B_TRUE 1 100 0 1 BIT_MASK 0x4000 FORMAT "%13.11" ECU_ADDRESS 0x383B24 /end MEASUREMENT
/begin MEASUREMENT B_sccas "" UWORD B_TRUE 1 100 0 1 BIT_MASK 0x4000 FORMAT "%13.11" ECU_ADDRESS 0x383B28 /end MEASUREMENT
/begin MEASUREMENT B_sccat "" UWORD B_TRUE 1 100 0 1 BIT_MASK 0x4000 FORMAT "%13.11" ECU_ADDRESS 0x383B2A /end MEASUREMENT
/begin MEASUREMENT B_sccge "" UWORD B_TRUE 1 100 0 1 BIT_MASK 0x4000 FORMAT "%13.11" ECU_ADDRESS 0x383B2C /end MEASUREMENT
/begin MEASUREMENT B_sccgra "" UWORD B_TRUE 1 100 0 1 BIT_MASK 0x4000 FORMAT "%13.11" ECU_ADDRESS 0x383B2E /end MEASUREMENT
/begin MEASUREMENT B_sccif "" UWORD B_TRUE 1 100 0 1 BIT_MASK 0x4000 FORMAT "%13.11" ECU_ADDRESS 0x383B30 /end MEASUREMENT
/begin MEASUREMENT B_sccins "" UWORD B_TRUE 1 100 0 1 BIT_MASK 0x4000 FORMAT "%13.11" ECU_ADDRESS 0x383B32 /end MEASUREMENT
/begin MEASUREMENT B_scckla "" UWORD B_TRUE 1 100 0 1 BIT_MASK 0x4000 FORMAT "%13.11" ECU_ADDRESS 0x383B34 /end MEASUREMENT
/begin MEASUREMENT B_scclws "" UWORD B_TRUE 1 100 0 1 BIT_MASK 0x4000 FORMAT "%13.11" ECU_ADDRESS 0x383B36 /end MEASUREMENT
/begin MEASUREMENT B_sctol "" UWORD B_TRUE 1 100 0 1 BIT_MASK 0x4000 FORMAT "%13.11" ECU_ADDRESS 0x383C14 /end MEASUREMENT
/begin MEASUREMENT B_siatr "Signalfehler Abgastemperaturregelung" UWORD B_TRUE 1 100 0 1 BIT_MASK 0x400 FORMAT "%13.11" ECU_ADDRESS 0x383B0E /end MEASUREMENT
/begin MEASUREMENT B_siatr2 "Signalfehler Abgastemperaturregelung Bank 2" UWORD B_TRUE 1 100 0 1 BIT_MASK 0x400 FORMAT "%13.11" ECU_ADDRESS 0x383B10 /end MEASUREMENT
/begin MEASUREMENT B_siatrd "" UWORD B_TRUE 1 100 0 1 BIT_MASK 0x400 FORMAT "%13.11" ECU_ADDRESS 0x383B12 /end MEASUREMENT
/begin MEASUREMENT B_siatrd2 "" UWORD B_TRUE 1 100 0 1 BIT_MASK 0x400 FORMAT "%13.11" ECU_ADDRESS 0x383B14 /end MEASUREMENT
/begin MEASUREMENT B_siats "Fehlerart:  Signalfehler Abgastemperatursensor" UWORD B_TRUE 1 100 0 1 BIT_MASK 0x400 FORMAT "%13.11" ECU_ADDRESS 0x383B16 /end MEASUREMENT
/begin MEASUREMENT B_siats2 "Fehlerart:  Signalfehler Abgastemperatursensor Bank 2" UWORD B_TRUE 1 100 0 1 BIT_MASK 0x400 FORMAT "%13.11" ECU_ADDRESS 0x383B18 /end MEASUREMENT
/begin MEASUREMENT B_sibkvp "Fehlerart: Bremskraftverstärker-Pumpe" UWORD B_TRUE 1 100 0 1 BIT_MASK 0x400 FORMAT "%13.11" ECU_ADDRESS 0x383B1A /end MEASUREMENT
/begin MEASUREMENT B_sibm "Fehlertyp: keine Bezugsmarke im Start gefunden" UWORD B_TRUE 1 100 0 1 BIT_MASK 0x400 FORMAT "%13.11" ECU_ADDRESS 0x383B1E /end MEASUREMENT
/begin MEASUREMENT B_sicair "Fehlertyp : Airbag-Botschaft" UWORD B_TRUE 1 100 0 1 BIT_MASK 0x400 FORMAT "%13.11" ECU_ADDRESS 0x383B24 /end MEASUREMENT
/begin MEASUREMENT B_sicas "Signalfehler CAN-Timeout ASC-Botschaften" UWORD B_TRUE 1 100 0 1 BIT_MASK 0x400 FORMAT "%13.11" ECU_ADDRESS 0x383B28 /end MEASUREMENT
/begin MEASUREMENT B_sicat "Fehlertyp: ASR/MSR Codierfehler" UWORD B_TRUE 1 100 0 1 BIT_MASK 0x400 FORMAT "%13.11" ECU_ADDRESS 0x383B2A /end MEASUREMENT
/begin MEASUREMENT B_sicge "Signalfehler CAN-Timeout EGS-Botschaft" UWORD B_TRUE 1 100 0 1 BIT_MASK 0x400 FORMAT "%13.11" ECU_ADDRESS 0x383B2C /end MEASUREMENT
/begin MEASUREMENT B_sicgra "Bedingung Signalfehler GRA-Botschaft" UWORD B_TRUE 1 100 0 1 BIT_MASK 0x400 FORMAT "%13.11" ECU_ADDRESS 0x383B2E /end MEASUREMENT
/begin MEASUREMENT B_sicif "Signalfehler CAN-Schnittstelle (Bus off)" UWORD B_TRUE 1 100 0 1 BIT_MASK 0x400 FORMAT "%13.11" ECU_ADDRESS 0x383B30 /end MEASUREMENT
/begin MEASUREMENT B_sicins "Signalfehler CAN-Timeout Botschaft Kombi-Instruments" UWORD B_TRUE 1 100 0 1 BIT_MASK 0x400 FORMAT "%13.11" ECU_ADDRESS 0x383B32 /end MEASUREMENT
/begin MEASUREMENT B_sickla "Fehlertyp sig. : Botschaft Klima" UWORD B_TRUE 1 100 0 1 BIT_MASK 0x400 FORMAT "%13.11" ECU_ADDRESS 0x383B34 /end MEASUREMENT
/begin MEASUREMENT B_siclws "Signalfehler CAN-Timeout Botschaft Lenkwinkelsensor" UWORD B_TRUE 1 100 0 1 BIT_MASK 0x400 FORMAT "%13.11" ECU_ADDRESS 0x383B36 /end MEASUREMENT
/begin MEASUREMENT B_sidkvm "Fehlertyp signal: Drosselklappenverschmutzung" UWORD B_TRUE 1 100 0 1 BIT_MASK 0x400 FORMAT "%13.11" ECU_ADDRESS 0x383B3E /end MEASUREMENT
/begin MEASUREMENT B_sin "Fehlertyp: kein Drehzahlsignal vorhanden" UWORD B_TRUE 1 100 0 1 BIT_MASK 0x400 FORMAT "%13.11" ECU_ADDRESS 0x383BDC /end MEASUREMENT
/begin MEASUREMENT B_sitol "Fehlertyp: Öltemperatur" UWORD B_TRUE 1 100 0 1 BIT_MASK 0x400 FORMAT "%13.11" ECU_ADDRESS 0x383C14 /end MEASUREMENT
/begin MEASUREMENT B_situm "Fehlerart: Signal Umgebungstemperatur inaktiv" UWORD B_TRUE 1 100 0 1 BIT_MASK 0x400 FORMAT "%13.11" ECU_ADDRESS 0x383C16 /end MEASUREMENT
/begin MEASUREMENT B_skoc "Bedingung Kompressoranforderung aktiv aus CAN-Botschaft Clima 1" UWORD B_TRUE 1 100 0 1 BIT_MASK 0x80 FORMAT "%13.11" ECU_ADDRESS 0xFD16 /end MEASUREMENT
/begin MEASUREMENT B_sksc "Bedingung heizb. Heckscheibe eingeschaltet aus CAN-Botschaft Clima1" UWORD B_TRUE 1 100 0 1 BIT_MASK 0x100 FORMAT "%13.11" ECU_ADDRESS 0xFD16 /end MEASUREMENT
/begin MEASUREMENT B_sp3 "Spezial-Bereichs-Trigger der Diagnose Kraftstoffversorgungssystem" UBYTE B_TRUE 1 100 0 1 BIT_MASK 0x1 FORMAT "%13.11" ECU_ADDRESS 0x38330B /end MEASUREMENT
/begin MEASUREMENT B_statbr "Status Bremseneingriff über CAN" UWORD B_TRUE 1 100 0 1 BIT_MASK 0x200 FORMAT "%13.11" ECU_ADDRESS 0xFD16 /end MEASUREMENT
/begin MEASUREMENT B_statge "Status Getriebeeingriff über CAN" UWORD B_TRUE 1 100 0 1 BIT_MASK 0x400 FORMAT "%13.11" ECU_ADDRESS 0xFD16 /end MEASUREMENT
/begin MEASUREMENT B_statgec "Bedingung Getriebestatus für CAN-Ausgabe" UWORD B_TRUE 1 100 0 1 BIT_MASK 0x800 FORMAT "%13.11" ECU_ADDRESS 0xFD16 /end MEASUREMENT
/begin MEASUREMENT B_statmd "Status Momentensignale für CAN" UWORD B_TRUE 1 100 0 1 BIT_MASK 0x1000 FORMAT "%13.11" ECU_ADDRESS 0xFD16 /end MEASUREMENT
/begin MEASUREMENT B_statmdc "Bedingung Momentenstatus für CAN-Ausgabe" UWORD B_TRUE 1 100 0 1 BIT_MASK 0x2000 FORMAT "%13.11" ECU_ADDRESS 0xFD16 /end MEASUREMENT
/begin MEASUREMENT B_statme "Bedingung Momenteneingriff ASR/MSR/ESP statisch nicht erfüllbar" UWORD B_TRUE 1 100 0 1 BIT_MASK 0x4000 FORMAT "%13.11" ECU_ADDRESS 0xFD16 /end MEASUREMENT
/begin MEASUREMENT B_statme_t "Bedingung Momentenstatus vom Master für Slave" UWORD B_TRUE 1 100 0 1 BIT_MASK 0x8000 FORMAT "%13.11" ECU_ADDRESS 0xFD16 /end MEASUREMENT
/begin MEASUREMENT B_statnb "Bedingung Normalbetrieb (für CAN-Ausgabe)" UWORD B_TRUE 1 100 0 1 BIT_MASK 0x1 FORMAT "%13.11" ECU_ADDRESS 0xFD18 /end MEASUREMENT
/begin MEASUREMENT B_statto "Bedingung ASR-Timeout erkannt (für CAN-Ausgabe)" UWORD B_TRUE 1 100 0 1 BIT_MASK 0x2 FORMAT "%13.11" ECU_ADDRESS 0xFD18 /end MEASUREMENT
/begin MEASUREMENT B_stattoc "Status Bremsen-SG für CAN-Ausgabe" UWORD B_TRUE 1 100 0 1 BIT_MASK 0x4 FORMAT "%13.11" ECU_ADDRESS 0xFD18 /end MEASUREMENT
/begin MEASUREMENT B_syserr "Bedingung für mind. 1 Fehler (E_abc) im System erkannt (maskiert)" UBYTE B_TRUE 1 100 0 1 BIT_MASK 0x2 FORMAT "%13.11" ECU_ADDRESS 0x384823 /end MEASUREMENT
/begin MEASUREMENT B_syserrk "Bedingung für mind. 1 Fehler (E_abc) im System erkannt (unmaskiert)" UBYTE B_TRUE 1 100 0 1 BIT_MASK 0x4 FORMAT "%13.11" ECU_ADDRESS 0x384823 /end MEASUREMENT
/begin MEASUREMENT B_tabcan "Fehlerstatus Standzeit" UWORD B_TRUE 1 100 0 1 BIT_MASK 0x8 FORMAT "%13.11" ECU_ADDRESS 0xFD18 /end MEASUREMENT
/begin MEASUREMENT B_talcan "Bedingung Tank leer aus Kombi-Botschaft" UWORD B_TRUE 1 100 0 1 BIT_MASK 0x10 FORMAT "%13.11" ECU_ADDRESS 0xFD18 /end MEASUREMENT
/begin MEASUREMENT B_talkbi "Bedingung Tank leer vom Kombi" UWORD B_TRUE 1 100 0 1 BIT_MASK 0x20 FORMAT "%13.11" ECU_ADDRESS 0xFD18 /end MEASUREMENT
/begin MEASUREMENT B_tdats "Bedingung: modellierte Abgastemperatur im Bereich für Diagnose ATS" UWORD B_TRUE 1 100 0 1 BIT_MASK 0x80 FORMAT "%13.11" ECU_ADDRESS 0xFD66 /end MEASUREMENT
/begin MEASUREMENT B_tepvb "Bedingung Tankentlüftungsphase verboten" UWORD B_TRUE 1 100 0 1 BIT_MASK 0x4 FORMAT "%13.11" ECU_ADDRESS 0xFD56 /end MEASUREMENT
/begin MEASUREMENT B_tfstok "CAN: Fuellstandssignal Geber 1 okay" UWORD B_TRUE 1 100 0 1 BIT_MASK 0x40 FORMAT "%13.11" ECU_ADDRESS 0xFD18 /end MEASUREMENT
/begin MEASUREMENT B_tim "Zeit-Trigger für Fehlerpfadmanagement" UBYTE B_TRUE 1 100 0 1 BIT_MASK 0x1 FORMAT "%13.11" ECU_ADDRESS 0x3808FA /end MEASUREMENT
/begin MEASUREMENT B_tippg "Bedingung Wählhebel in Stellung ""Tippgasse""" UWORD B_TRUE 1 100 0 1 BIT_MASK 0x80 FORMAT "%13.11" ECU_ADDRESS 0xFD18 /end MEASUREMENT
/begin MEASUREMENT B_tmkicb "Bedingung Motortemperatur aus Kombibotschaft auswertbar" UWORD B_TRUE 1 100 0 1 BIT_MASK 0x100 FORMAT "%13.11" ECU_ADDRESS 0xFD18 /end MEASUREMENT
/begin MEASUREMENT B_tolcb "Bed. Fehlerstatus Öltemperatur aus Kombibotschaft od. aus COWIV abhängig von LH" UWORD B_TRUE 1 100 0 1 BIT_MASK 0x200 FORMAT "%13.11" ECU_ADDRESS 0xFD18 /end MEASUREMENT
/begin MEASUREMENT B_tolueb "Bedingung Öltemperaturschutz" UWORD B_TRUE 1 100 0 1 BIT_MASK 0x400 FORMAT "%13.11" ECU_ADDRESS 0xFD18 /end MEASUREMENT
/begin MEASUREMENT B_trip "Flag für erfüllten 'trip'" UBYTE B_TRUE 1 100 0 1 BIT_MASK 0x1 FORMAT "%13.11" ECU_ADDRESS 0x384823 /end MEASUREMENT
/begin MEASUREMENT B_tumcb "Bedingung kein Fehler in CAN-Umgebungstemperaturinformation" UWORD B_TRUE 1 100 0 1 BIT_MASK 0x800 FORMAT "%13.11" ECU_ADDRESS 0xFD18 /end MEASUREMENT
/begin MEASUREMENT B_wk "Bedingung: Wandlerkupplung überbrückt" UWORD B_TRUE 1 100 0 1 BIT_MASK 0x1000 FORMAT "%13.11" ECU_ADDRESS 0xFD18 /end MEASUREMENT
/begin MEASUREMENT B_wkauf "Bedingung Wandlerkupplung offen" UWORD B_TRUE 1 100 0 1 BIT_MASK 0x2000 FORMAT "%13.11" ECU_ADDRESS 0xFD18 /end MEASUREMENT
/begin MEASUREMENT B_wkr "Bedingung für Wandlerkupplung geregelt" UWORD B_TRUE 1 100 0 1 BIT_MASK 0x4000 FORMAT "%13.11" ECU_ADDRESS 0xFD18 /end MEASUREMENT
/begin MEASUREMENT B_zbkvtest "Bedingung: Zyklusflag noch nicht gesetzt, daher aktive BKV-Pumpen-Test" UBYTE B_TRUE 1 100 0 1 BIT_MASK 0x1 FORMAT "%13.11" ECU_ADDRESS 0x38496D /end MEASUREMENT
/begin MEASUREMENT B_zges "Bedingung Zwischengasanforderung vom Getriebe-SG" UWORD B_TRUE 1 100 0 1 BIT_MASK 0x8000 FORMAT "%13.11" ECU_ADDRESS 0xFD18 /end MEASUREMENT
/begin MEASUREMENT B_zhfmfe "Bedingung: Fehlerbit HFM aus DEGFE gültig" UBYTE B_TRUE 1 100 0 1 BIT_MASK 0x40 FORMAT "%13.11" ECU_ADDRESS 0x3809D0 /end MEASUREMENT
/begin MEASUREMENT can_nv_bits "" UBYTE dez 1 100 0 255 FORMAT "%5.1" ECU_ADDRESS 0x383254 /end MEASUREMENT
/begin MEASUREMENT cs_air "Checksumme in der Botschaft Airbag" UBYTE DEZ 1 100 0 255 FORMAT "%5.1" ECU_ADDRESS 0x3808C3 /end MEASUREMENT
/begin MEASUREMENT ctrerf1 "Zähler für Anzahl  Fehlerflags E_dfp = 1 im System seit powerfail (gefiltert)" UBYTE dez 1 100 0 255 FORMAT "%5.1" ECU_ADDRESS 0x384824 /end MEASUREMENT
/begin MEASUREMENT ctrerfk1 "Zähler für Anzahl  Fehlerflags E_dfp = 1 im System seit powerfail (ungefiltert)" UBYTE dez 1 100 0 255 FORMAT "%5.1" ECU_ADDRESS 0x384825 /end MEASUREMENT
/begin MEASUREMENT ctrrdy1 "Zähler für Anzahl geprüfter Fehlerpfade im System seit powerfail" UBYTE dez 1 100 0 255 FORMAT "%5.1" ECU_ADDRESS 0x384826 /end MEASUREMENT
/begin MEASUREMENT ctrsfp "Zähler für Anzahl Fehlerpfade im System" UBYTE dez 1 100 0 255 FORMAT "%5.1" ECU_ADDRESS 0x384827 /end MEASUREMENT
/begin MEASUREMENT ctrzyf0 "Zähler für Anzahl ungeprüfter Fehlerpfade im System seit Start" UBYTE dez 1 100 0 255 FORMAT "%5.1" ECU_ADDRESS 0x384828 /end MEASUREMENT
/begin MEASUREMENT ctrzyf1 "Zähler für Anzahl geprüfter Fehlerpfade im System seit Start" UBYTE dez 1 100 0 255 FORMAT "%5.1" ECU_ADDRESS 0x384829 /end MEASUREMENT
/begin MEASUREMENT dbkvpelokbits "" UBYTE dez 1 100 0 255 FORMAT "%5.1" ECU_ADDRESS 0x380B92 /end MEASUREMENT
/begin MEASUREMENT dcycnt "Driving cycle - counter" UWORD dez 1 100 0 65535 FORMAT "%8.2" ECU_ADDRESS 0x384030 /end MEASUREMENT
/begin MEASUREMENT ddkvfz "Anzahl verschmutzte DK erkannt" UBYTE dez 1 100 0 255 FORMAT "%5.1" ECU_ADDRESS 0x384018 /end MEASUREMENT
/begin MEASUREMENT ddkvhz "Anzahl DK ohne erkannte Verschmutzung" UBYTE dez 1 100 0 255 FORMAT "%5.1" ECU_ADDRESS 0x384019 /end MEASUREMENT
/begin MEASUREMENT ddkvLokBitsKoop "" UBYTE dez 1 100 0 255 FORMAT "%5.1" ECU_ADDRESS 0x3809CC /end MEASUREMENT
/begin MEASUREMENT DEGFEintbits "" UBYTE dez 1 100 0 255 FORMAT "%5.1" ECU_ADDRESS 0x38332D /end MEASUREMENT
/begin MEASUREMENT degfe_bits1 "" UBYTE dez 1 100 0 255 FORMAT "%5.1" ECU_ADDRESS 0x3809D0 /end MEASUREMENT
/begin MEASUREMENT dfcmFcm "plausibisierter FCM-EIntrag (aktiver Eintrag)" UBYTE dez 1 100 0 255 FORMAT "%5.1" ECU_ADDRESS 0x38330C /end MEASUREMENT
/begin MEASUREMENT dfcmNo "plausibilisierter FCM-EIntrag (leer)" UBYTE dez 1 100 0 255 FORMAT "%5.1" ECU_ADDRESS 0x38330D /end MEASUREMENT
/begin MEASUREMENT dfcmSfp "plausibilisierter Fehlerpfad" UBYTE dez 1 100 0 255 FORMAT "%5.1" ECU_ADDRESS 0x38330E /end MEASUREMENT
/begin MEASUREMENT dfpmEpclState "" UWORD dez 1 100 0 65535 FORMAT "%8.2" ECU_ADDRESS 0x38385C /end MEASUREMENT
/begin MEASUREMENT dfpmMilState "" UWORD dez 1 100 0 65535 FORMAT "%8.2" ECU_ADDRESS 0x38385D /end MEASUREMENT
/begin MEASUREMENT dfp_ap "aktueller Fehler für Dauerlaufmessung" UBYTE dez 1 100 0 255 FORMAT "%5.1" ECU_ADDRESS 0x38330F /end MEASUREMENT
/begin MEASUREMENT dgafram_w "Gemischfehler multiplikativer Anteil (Mittelwert)" UWORD fak_uw_b4_no1 1 100 -1 2.99994 FORMAT "%8.6" ECU_ADDRESS 0x384056 /end MEASUREMENT
/begin MEASUREMENT dgafra_w "Gemischfehler multiplikativer Anteil" UWORD fak_uw_b4_no1 1 100 -1 2.99994 FORMAT "%8.6" ECU_ADDRESS 0x384058 /end MEASUREMENT
/begin MEASUREMENT dleatr "Schwelle Delta Lambda für Erkennung Fehler Abgastemperaturregelung" SBYTE fak_sb_b1 1 100 -1 0.992188 FORMAT "%5.3" ECU_ADDRESS 0x3848A2 /end MEASUREMENT
/begin MEASUREMENT dlws_w "Lenkwinkelgeschwindigkeit  über CAN" SWORD dlw_sw_q0p04375 1 100 -1434.04 1434 FORMAT "%8.3" ECU_ADDRESS 0x380E94 /end MEASUREMENT
/begin MEASUREMENT dpbkvae_w "Differenz des Drucks bei nichtbetätigter Bremse" SWORD p_sw_q0p039 1 100 -1280 1279.96 FORMAT "%8.3" ECU_ADDRESS 0x3853E8 /end MEASUREMENT
/begin MEASUREMENT dpbkvpa_w "Druckdelta zw.  aktuellem  BKV-Druck und BKV-Druck beim Einschalten der Pumpe" UWORD p_uw_q0p039 1 100 0 2559.96 FORMAT "%8.3" ECU_ADDRESS 0x3853DE /end MEASUREMENT
/begin MEASUREMENT E_atr "Errorflag Abgastemperaturregelung" UWORD B_TRUE 1 100 0 1 BIT_MASK 0x1 FORMAT "%13.11" ECU_ADDRESS 0x383B0E /end MEASUREMENT
/begin MEASUREMENT E_atr2 "Errorflag Abgastemperaturregelung Bank 2" UWORD B_TRUE 1 100 0 1 BIT_MASK 0x1 FORMAT "%13.11" ECU_ADDRESS 0x383B10 /end MEASUREMENT
/begin MEASUREMENT E_atrd "Errorflag: Bankdifferenz ATR" UWORD B_TRUE 1 100 0 1 BIT_MASK 0x1 FORMAT "%13.11" ECU_ADDRESS 0x383B12 /end MEASUREMENT
/begin MEASUREMENT E_atrd2 "Errorflag: Bankdifferenz ATR Bank 2" UWORD B_TRUE 1 100 0 1 BIT_MASK 0x1 FORMAT "%13.11" ECU_ADDRESS 0x383B14 /end MEASUREMENT
/begin MEASUREMENT E_ats "Errorflag Abgastemperatursensor" UWORD B_TRUE 1 100 0 1 BIT_MASK 0x1 FORMAT "%13.11" ECU_ADDRESS 0x383B16 /end MEASUREMENT
/begin MEASUREMENT E_ats2 "Fehlerflag: Abgastemperatursensor2 (Bank1)" UWORD B_TRUE 1 100 0 1 BIT_MASK 0x1 FORMAT "%13.11" ECU_ADDRESS 0x383B18 /end MEASUREMENT
/begin MEASUREMENT E_bkvp "Fehlerflag: BKV-Pumpe" UWORD B_TRUE 1 100 0 1 BIT_MASK 0x1 FORMAT "%13.11" ECU_ADDRESS 0x383B1A /end MEASUREMENT
/begin MEASUREMENT E_bm "Errorflag: Bezugsmarkengeber" UWORD B_TRUE 1 100 0 1 BIT_MASK 0x1 FORMAT "%13.11" ECU_ADDRESS 0x383B1E /end MEASUREMENT
/begin MEASUREMENT E_cair "Fehlerflag : Timeout Airbag-Botschaft" UWORD B_TRUE 1 100 0 1 BIT_MASK 0x1 FORMAT "%13.11" ECU_ADDRESS 0x383B24 /end MEASUREMENT
/begin MEASUREMENT E_cas "Errorflag: CAN-Schnittstelle, Timeout ASC" UWORD B_TRUE 1 100 0 1 BIT_MASK 0x1 FORMAT "%13.11" ECU_ADDRESS 0x383B28 /end MEASUREMENT
/begin MEASUREMENT E_cat "Errorflag: CAN-Schnittstelle, Timeout Bremsbotschaft setzen" UWORD B_TRUE 1 100 0 1 BIT_MASK 0x1 FORMAT "%13.11" ECU_ADDRESS 0x383B2A /end MEASUREMENT
/begin MEASUREMENT E_cge "Errorflag: CAN-Schnittstelle, Timeout EGS" UWORD B_TRUE 1 100 0 1 BIT_MASK 0x1 FORMAT "%13.11" ECU_ADDRESS 0x383B2C /end MEASUREMENT
/begin MEASUREMENT E_cgra "Errorflag : Timeout GRA-Botschaft" UWORD B_TRUE 1 100 0 1 BIT_MASK 0x1 FORMAT "%13.11" ECU_ADDRESS 0x383B2E /end MEASUREMENT
/begin MEASUREMENT E_cif "Errorflag: CAN-Schnittstelle, interner Fehler" UWORD B_TRUE 1 100 0 1 BIT_MASK 0x1 FORMAT "%13.11" ECU_ADDRESS 0x383B30 /end MEASUREMENT
/begin MEASUREMENT E_cins "Errorflag: CAN-Schnittstelle, Timeout Instrument" UWORD B_TRUE 1 100 0 1 BIT_MASK 0x1 FORMAT "%13.11" ECU_ADDRESS 0x383B32 /end MEASUREMENT
/begin MEASUREMENT E_ckla "Errorflag: CAN-Kommunikation zum KLA-SG gestört" UWORD B_TRUE 1 100 0 1 BIT_MASK 0x1 FORMAT "%13.11" ECU_ADDRESS 0x383B34 /end MEASUREMENT
/begin MEASUREMENT E_clws "Errorflag: CAN-Schnittstelle, Timeout Botschaft Lenkwinkelsensor" UWORD B_TRUE 1 100 0 1 BIT_MASK 0x1 FORMAT "%13.11" ECU_ADDRESS 0x383B36 /end MEASUREMENT
/begin MEASUREMENT E_dkvm "Errorflag: Drosselklappenverschmutzung" UWORD B_TRUE 1 100 0 1 BIT_MASK 0x1 FORMAT "%13.11" ECU_ADDRESS 0x383B3E /end MEASUREMENT
/begin MEASUREMENT E_n "Errorflag: Drehzahlsignalgeber" UWORD B_TRUE 1 100 0 1 BIT_MASK 0x1 FORMAT "%13.11" ECU_ADDRESS 0x383BDC /end MEASUREMENT
/begin MEASUREMENT E_tol "Errorflag: Öltemperatur" UWORD B_TRUE 1 100 0 1 BIT_MASK 0x1 FORMAT "%13.11" ECU_ADDRESS 0x383C14 /end MEASUREMENT
/begin MEASUREMENT E_tum "Errorflag:  Umgebungstemperatur tumg" UWORD B_TRUE 1 100 0 1 BIT_MASK 0x1 FORMAT "%13.11" ECU_ADDRESS 0x383C16 /end MEASUREMENT
/begin MEASUREMENT fawifgr "Fahrwiderstand für FGR" SBYTE rel_q0p25 1 100 -32 31.75 FORMAT "%5.2" ECU_ADDRESS 0x3808C4 /end MEASUREMENT
/begin MEASUREMENT fcmEnd "Anzahl Einträge im Fehlerspeicher" UBYTE dez 1 100 0 255 FORMAT "%5.1" ECU_ADDRESS 0x383310 /end MEASUREMENT
/begin MEASUREMENT FCMTab "Fehlerspeichertabelle" UWORD dez 1 100 0 65535 FORMAT "%8.2" ECU_ADDRESS 0x38385E /end MEASUREMENT
/begin MEASUREMENT fdkv_w "Faktor Drosselklappenverschmutzung" UWORD rel_uw_b100 1 100 0 99.9985 FORMAT "%8.5" ECU_ADDRESS 0x384ABA /end MEASUREMENT
/begin MEASUREMENT flgddg "" UBYTE dez 1 100 0 255 FORMAT "%5.1" ECU_ADDRESS 0x380915 /end MEASUREMENT
/begin MEASUREMENT fram_w "Mittelwertsbildung für Gemisch-Adaptionsfaktoren bei 2-Bank Systemen" UWORD fak_uw_b4 1 100 0 3.99994 FORMAT "%8.6" ECU_ADDRESS 0x384AD8 /end MEASUREMENT
/begin MEASUREMENT fra_u "multiplikative Gemischkorrektur der Gemischadaption (Byte)" UBYTE fak_ub_b2 1 100 0 1.99219 FORMAT "%5.3" ECU_ADDRESS 0x380900 /end MEASUREMENT
/begin MEASUREMENT frmm_w "Mittelwertsbildung für Lambdaabweichungen bei 2-Bank Systemen" UWORD fak_uw_b4 1 100 0 3.99994 FORMAT "%8.6" ECU_ADDRESS 0x384ADA /end MEASUREMENT
/begin MEASUREMENT fr_u "Lambda-Regler-Ausgang (Byte)" UBYTE fak_ub_b2 1 100 0 1.99219 FORMAT "%5.3" ECU_ADDRESS 0x380901 /end MEASUREMENT
/begin MEASUREMENT gangauti "bei Automatikgetriebe über CAN empfangener aktueller Gang" UBYTE DEZ 1 100 0 255 FORMAT "%5.1" ECU_ADDRESS 0x3808C5 /end MEASUREMENT
/begin MEASUREMENT gwhpos "Getriebe-Wählhebelposition" UBYTE DEZ 1 100 0 255 FORMAT "%5.1" ECU_ADDRESS 0x3808C6 /end MEASUREMENT
/begin MEASUREMENT kfoelkbi_nmot "" UBYTE nmot_ub_q40 1 100 0 10200 FORMAT "%5.0" ECU_ADDRESS 0x3808C7 /end MEASUREMENT
/begin MEASUREMENT klahc "Angeforderte Kühlleistungsanhebung über CAN" UBYTE DEZ 1 100 0 255 FORMAT "%5.1" ECU_ADDRESS 0x3808C8 /end MEASUREMENT
/begin MEASUREMENT km01tr "Triggersignal vom Kombi (Quantisierung 1km)" UWORD s_q1_km 1 100 0 65535 FORMAT "%8.2" ECU_ADDRESS 0x3849FE /end MEASUREMENT
/begin MEASUREMENT kmstand_w "Fahrstrecke des Fahrzeugs als Information über CAN" UWORD s_q6_km 1 100 0 393210 FORMAT "%8.1" ECU_ADDRESS 0x384A00 /end MEASUREMENT
/begin MEASUREMENT lws_w "Lenkwinkel" SWORD lw_sw_q0p04375 1 100 -1434.04 1434 FORMAT "%8.3" ECU_ADDRESS 0x380E96 /end MEASUREMENT
/begin MEASUREMENT mdgbeg "Momentengradientenbegrenzung durch Getriebe" UBYTE md_ub_q10 1 100 0 2550 FORMAT "%5.0" ECU_ADDRESS 0x3808C9 /end MEASUREMENT
/begin MEASUREMENT mdgrad_w "Momentengradientenbegrenzung durch Getriebe" UWORD rel_uw_b728 1 100 0 9999.85 FORMAT "%4.0" ECU_ADDRESS 0x380E98 /end MEASUREMENT
/begin MEASUREMENT mdverlc "Verlustmoment für CAN-Ausgabe" UBYTE rel_ub_b100 1 100 0 99.6094 FORMAT "%5.2" ECU_ADDRESS 0x3808CA /end MEASUREMENT
/begin MEASUREMENT mdwancan "Drehmomentaufnahme des Wandlers über CAN" UBYTE rel_ub_b99p6 1 100 0 99.6094 FORMAT "%5.2" ECU_ADDRESS 0x3808CB /end MEASUREMENT
/begin MEASUREMENT miautgetc "Istmoment für Getriebe (CAN-Ausgabe)" UBYTE rel_ub_b100 1 100 0 99.6094 FORMAT "%5.2" ECU_ADDRESS 0x3808CC /end MEASUREMENT
/begin MEASUREMENT miautgsc "Sollmoment Für Getriebe (CAN-Ausgbae)" UBYTE rel_ub_b100 1 100 0 99.6094 FORMAT "%5.2" ECU_ADDRESS 0x3808CD /end MEASUREMENT
/begin MEASUREMENT miges_w "Indiziertes Soll-Motormoment für Getriebeschutz" UWORD rel_uw_b100 1 100 0 99.9985 FORMAT "%8.5" ECU_ADDRESS 0x380E9A /end MEASUREMENT
/begin MEASUREMENT migs_can "Indiziertes Sollmoment für Getriebeeingriff (CAN-Signal)" UWORD rel_uw_b100 1 100 0 99.9985 FORMAT "%8.5" ECU_ADDRESS 0x380E9C /end MEASUREMENT
/begin MEASUREMENT migs_w "Indiziertes Soll-Motormoment GS für schnellen Eingriff" UWORD rel_uw_b100 1 100 0 99.9985 FORMAT "%8.5" ECU_ADDRESS 0x380E9E /end MEASUREMENT
/begin MEASUREMENT miistc "indiziertes Motormoment Hochdruckphase Istwert für Ausgabe auf CAN-Bus" UBYTE rel_ub_b100 1 100 0 99.6094 FORMAT "%5.2" ECU_ADDRESS 0x38481B /end MEASUREMENT
/begin MEASUREMENT mizsolv_u "Indiziertes resultierendes Sollmoment für ZW-Eingriff vor Momentenbegrenzung" UBYTE rel_ub_b100 1 100 0 99.6094 FORMAT "%5.2" ECU_ADDRESS 0x380902 /end MEASUREMENT
/begin MEASUREMENT mizwmnc "indiziertes Motormoment beim spätesten Zündwinkel für CAN-Ausgabe" UBYTE rel_ub_b100 1 100 0 99.6094 FORMAT "%5.2" ECU_ADDRESS 0x3808CE /end MEASUREMENT
/begin MEASUREMENT mkllsc "Kompressorlüfterlastsignal aus CAN-Botschaft Clima 1" UBYTE rel_q0p39 1 100 0 99.6094 FORMAT "%5.2" ECU_ADDRESS 0x3808CF /end MEASUREMENT
/begin MEASUREMENT mkolsc "Kompressorlastsignal aus CAN-Botschaft Clima1" UBYTE md_q0p25 1 100 0 63.75 FORMAT "%5.2" ECU_ADDRESS 0x3808D0 /end MEASUREMENT
/begin MEASUREMENT nllcvt1 "Drehzahlvorgabe aus CVT-Getriebe" UBYTE nmot_ub_q10 1 100 0 2550 FORMAT "%5.0" ECU_ADDRESS 0x3808D1 /end MEASUREMENT
/begin MEASUREMENT nohknoc_w "NOx-Konzentration hinter Kat, NOx-Sensor-Controller" UWORD dez 1 100 0 65535 FORMAT "%8.2" ECU_ADDRESS 0x380EA0 /end MEASUREMENT
/begin MEASUREMENT o2hknoc_w "lineares O2-Signal hinter Kat, NOx-Sensor-Controller" UWORD dez 1 100 0 65535 FORMAT "%8.2" ECU_ADDRESS 0x380EA2 /end MEASUREMENT
/begin MEASUREMENT pbkva_w "Druck beim Loslassen der Bremse im BKV" UWORD p_uw_q0p039 1 100 0 2559.96 FORMAT "%8.3" ECU_ADDRESS 0x3853EA /end MEASUREMENT
/begin MEASUREMENT pbkvel_w "Druck beim Betätigen der Bremse (Leckage)" UWORD p_uw_q0p039 1 100 0 2559.96 FORMAT "%8.3" ECU_ADDRESS 0x3853EC /end MEASUREMENT
/begin MEASUREMENT pbkvpaus_w "Ausschaltschwelle der BKV-Pumpe" UWORD p_uw_q0p039 1 100 0 2559.96 FORMAT "%8.3" ECU_ADDRESS 0x3853E0 /end MEASUREMENT
/begin MEASUREMENT pbkvpdf_w "Druck der durch BKV-Pumpe erreicht werden kann, für Diagnosenfreigabe" UWORD p_uw_q0p039 1 100 0 2559.96 FORMAT "%8.3" ECU_ADDRESS 0x3853E2 /end MEASUREMENT
/begin MEASUREMENT pbkvprd_w "Druck der durch BKV-Pumpe erreicht werden kann, für Sperren der Diagnose" UWORD p_uw_q0p039 1 100 0 2559.96 FORMAT "%8.3" ECU_ADDRESS 0x3853E4 /end MEASUREMENT
/begin MEASUREMENT pbkvp_w "gespeicherter BKV-Druck, wenn Diagnose freigegeben wird" UWORD p_uw_q0p039 1 100 0 2559.96 FORMAT "%8.3" ECU_ADDRESS 0x3853E6 /end MEASUREMENT
/begin MEASUREMENT pkodrc "Kompressordrucksignal" UBYTE p_q0p2 1 100 0 51 FORMAT "%5.2" ECU_ADDRESS 0x3808D2 /end MEASUREMENT
/begin MEASUREMENT rinh_u "Istwert (Byte) Innenwiderstand Ri-Nernstzelle der Lambdasonde hinter KAT" UBYTE r_ub_q64 1 100 0 16320 FORMAT "%5.0" ECU_ADDRESS 0x380903 /end MEASUREMENT
/begin MEASUREMENT rl_u "relative Luftfüllung (Byte) für Fehlerspeicher-Umwelten" UBYTE rel_ub_b100 1 100 0 99.6094 FORMAT "%5.2" ECU_ADDRESS 0x380904 /end MEASUREMENT
/begin MEASUREMENT sbmcorm "Summierer für Lückenkorrektur um minus einen Zahn" UBYTE dez 1 100 0 255 FORMAT "%5.1" ECU_ADDRESS 0x380916 /end MEASUREMENT
/begin MEASUREMENT sbmcorp "Summierer für Lückenkorrektur um plus einen Zahn" UBYTE dez 1 100 0 255 FORMAT "%5.1" ECU_ADDRESS 0x380917 /end MEASUREMENT
/begin MEASUREMENT sbmlos_w "Summierer für Bezugsmarkenverluste" UWORD dez 1 100 0 65535 FORMAT "%8.2" ECU_ADDRESS 0x383C40 /end MEASUREMENT
/begin MEASUREMENT sfpatr "Status Fehlerpfad Abgastemperaturregelung" UWORD dez 1 100 0 65535 FORMAT "%8.2" ECU_ADDRESS 0x383B0E /end MEASUREMENT
/begin MEASUREMENT sfpatr2 "Status Fehlerpfad Abgastemperaturregelung Bank 2" UWORD dez 1 100 0 65535 FORMAT "%8.2" ECU_ADDRESS 0x383B10 /end MEASUREMENT
/begin MEASUREMENT sfpatrd "" UWORD dez 1 100 0 65535 FORMAT "%8.2" ECU_ADDRESS 0x383B12 /end MEASUREMENT
/begin MEASUREMENT sfpatrd2 "" UWORD dez 1 100 0 65535 FORMAT "%8.2" ECU_ADDRESS 0x383B14 /end MEASUREMENT
/begin MEASUREMENT sfpats "Status Fehlerpfad Abgastemperatursensor" UWORD dez 1 100 0 65535 FORMAT "%8.2" ECU_ADDRESS 0x383B16 /end MEASUREMENT
/begin MEASUREMENT sfpats2 "Status Fehlerpfad Abgastemperatursensor Bank 2" UWORD dez 1 100 0 65535 FORMAT "%8.2" ECU_ADDRESS 0x383B18 /end MEASUREMENT
/begin MEASUREMENT sfpbkvp "Status Fehlerpfad:  Bremskraftverstärker-Pumpe" UWORD default 1 100 0 65535 FORMAT "%8.2" ECU_ADDRESS 0x383B1A /end MEASUREMENT
/begin MEASUREMENT sfpbm "Status Fehlerpfad: Bezugsmarkengeber" UWORD dez 1 100 0 65535 FORMAT "%8.2" ECU_ADDRESS 0x383B1E /end MEASUREMENT
/begin MEASUREMENT sfpcair "Status Fehlerpfad : Airbag-Botschaft" UWORD dez 1 100 0 65535 FORMAT "%8.2" ECU_ADDRESS 0x383B24 /end MEASUREMENT
/begin MEASUREMENT sfpcas "Status Fehlerpfad: Diagnose CAN-Timeout ASC-Schnittstelle" UWORD dez 1 100 0 65535 FORMAT "%8.2" ECU_ADDRESS 0x383B28 /end MEASUREMENT
/begin MEASUREMENT sfpcat "Status Fehlerpfad: CAN-Schnittstelle, Timeout ASC" UWORD dez 1 100 0 65535 FORMAT "%8.2" ECU_ADDRESS 0x383B2A /end MEASUREMENT
/begin MEASUREMENT sfpcge "Status Fehlerpfad: Diagnose CAN-Timeout EGS-Schnittstelle" UWORD dez 1 100 0 65535 FORMAT "%8.2" ECU_ADDRESS 0x383B2C /end MEASUREMENT
/begin MEASUREMENT sfpcgra "Status Fehlerpfad: CAN-Schnittstelle, Timeout Botschaft GRA" UWORD dez 1 100 0 65535 FORMAT "%8.2" ECU_ADDRESS 0x383B2E /end MEASUREMENT
/begin MEASUREMENT sfpcif "Status Fehlerpfad: CAN im Zustand Bus-Off" UWORD dez 1 100 0 65535 FORMAT "%8.2" ECU_ADDRESS 0x383B30 /end MEASUREMENT
/begin MEASUREMENT sfpcins "Status Fehlerpfad: Diagnose CAN-Timeout Kombiinstr." UWORD dez 1 100 0 65535 FORMAT "%8.2" ECU_ADDRESS 0x383B32 /end MEASUREMENT
/begin MEASUREMENT sfpckla "Status Fehlerpfad: Diagnose CAN-Timeout Klima" UWORD dez 1 100 0 65535 FORMAT "%8.2" ECU_ADDRESS 0x383B34 /end MEASUREMENT
/begin MEASUREMENT sfpclws "Status Fehlerpfad: CAN-Schnittstelle, Timeout Botschaft Lenkwinkelsensor" UWORD dez 1 100 0 65535 FORMAT "%8.2" ECU_ADDRESS 0x383B36 /end MEASUREMENT
/begin MEASUREMENT sfpdkvm "Status Fehlerpfad: Drosselklappenverschmutzung" UWORD dez 1 100 0 65535 FORMAT "%8.2" ECU_ADDRESS 0x383B3E /end MEASUREMENT
/begin MEASUREMENT sfpn "Status Fehlerpfad: Drehzahlgeber" UWORD dez 1 100 0 65535 FORMAT "%8.2" ECU_ADDRESS 0x383BDC /end MEASUREMENT
/begin MEASUREMENT sfptol "Status Fehlerpfad: (Motor-) Oeltemperatur TOL" UWORD dez 1 100 0 65535 FORMAT "%8.2" ECU_ADDRESS 0x383C14 /end MEASUREMENT
/begin MEASUREMENT sfptum "Status Fehlerpfad: Umgebungstemperatur TUM" UWORD dez 1 100 0 65535 FORMAT "%8.2" ECU_ADDRESS 0x383C16 /end MEASUREMENT
/begin MEASUREMENT snobm "Summierer für nicht gefundene Bezugsmarken im Start" UBYTE dez 1 100 0 255 FORMAT "%5.1" ECU_ADDRESS 0x383314 /end MEASUREMENT
/begin MEASUREMENT statgra "Status GRA für Ausgabe auf CAN" UBYTE DEZ 1 100 0 255 FORMAT "%5.1" ECU_ADDRESS 0x3808D3 /end MEASUREMENT
/begin MEASUREMENT S_fs "Schalter Fahrstufe" UWORD B_TRUE 1 100 0 1 BIT_MASK 0x1 FORMAT "%13.11" ECU_ADDRESS 0xFD1A /end MEASUREMENT
/begin MEASUREMENT tabcan_w "Standzeit aus Kombi-Botschaft" UWORD t_q4_s 1 100 0 262140 FORMAT "%8.1" ECU_ADDRESS 0x384A02 /end MEASUREMENT
/begin MEASUREMENT tfst "Tankfüllstand" UBYTE tfst_ub_b126 1 100 0 255 FORMAT "%5.1" ECU_ADDRESS 0x3808D4 /end MEASUREMENT
/begin MEASUREMENT tmkic "Motortemperatur aus Kombibotschaft" UBYTE temp_ub_q0p75_o48 1 100 -48 143.25 FORMAT "%5.1" ECU_ADDRESS 0x3808D5 /end MEASUREMENT
/begin MEASUREMENT tmot_u "Motor-Temperatur mit def. Quantisierung für FSP-Umwelten" UBYTE temp_ub_q1_o40 1 100 -40 215 FORMAT "%5.1" ECU_ADDRESS 0x380905 /end MEASUREMENT
/begin MEASUREMENT tolc "Öltemperatur aus Kombibotschaft od. aus COWIV abhängig von LH" UBYTE temp_ub_q1_o60 1 100 -60 195 FORMAT "%5.1" ECU_ADDRESS 0x3808D6 /end MEASUREMENT
/begin MEASUREMENT tumc "Umgebungstemperatur aus CAN Botschaft" UBYTE temp_ub_q0p75_o48 1 100 -48 143.25 FORMAT "%5.1" ECU_ADDRESS 0x3808D7 /end MEASUREMENT
/begin MEASUREMENT tvluessc "Lüfteransteuerung über Klimabotschaft ( CAN )" UBYTE rel_q0p4 1 100 0 102 FORMAT "%5.1" ECU_ADDRESS 0x3808D8 /end MEASUREMENT
/begin MEASUREMENT TYP_atr "" UWORD B_TRUE 1 100 0 1 BIT_MASK 0xf00 FORMAT "%13.11" ECU_ADDRESS 0x383B0E /end MEASUREMENT
/begin MEASUREMENT TYP_atr2 "" UWORD B_TRUE 1 100 0 1 BIT_MASK 0xf00 FORMAT "%13.11" ECU_ADDRESS 0x383B10 /end MEASUREMENT
/begin MEASUREMENT TYP_atrd "" UWORD B_TRUE 1 100 0 1 BIT_MASK 0xf00 FORMAT "%13.11" ECU_ADDRESS 0x383B12 /end MEASUREMENT
/begin MEASUREMENT TYP_atrd2 "" UWORD B_TRUE 1 100 0 1 BIT_MASK 0xf00 FORMAT "%13.11" ECU_ADDRESS 0x383B14 /end MEASUREMENT
/begin MEASUREMENT TYP_ats "" UWORD B_TRUE 1 100 0 1 BIT_MASK 0xf00 FORMAT "%13.11" ECU_ADDRESS 0x383B16 /end MEASUREMENT
/begin MEASUREMENT TYP_ats2 "" UWORD B_TRUE 1 100 0 1 BIT_MASK 0xf00 FORMAT "%13.11" ECU_ADDRESS 0x383B18 /end MEASUREMENT
/begin MEASUREMENT TYP_bkvp "" UWORD B_TRUE 1 100 0 1 BIT_MASK 0xf00 FORMAT "%13.11" ECU_ADDRESS 0x383B1A /end MEASUREMENT
/begin MEASUREMENT TYP_bm "" UWORD B_TRUE 1 100 0 1 BIT_MASK 0xf00 FORMAT "%13.11" ECU_ADDRESS 0x383B1E /end MEASUREMENT
/begin MEASUREMENT TYP_cair "" UWORD B_TRUE 1 100 0 1 BIT_MASK 0xf00 FORMAT "%13.11" ECU_ADDRESS 0x383B24 /end MEASUREMENT
/begin MEASUREMENT TYP_cas "" UWORD B_TRUE 1 100 0 1 BIT_MASK 0xf00 FORMAT "%13.11" ECU_ADDRESS 0x383B28 /end MEASUREMENT
/begin MEASUREMENT TYP_cat "" UWORD B_TRUE 1 100 0 1 BIT_MASK 0xf00 FORMAT "%13.11" ECU_ADDRESS 0x383B2A /end MEASUREMENT
/begin MEASUREMENT TYP_cge "" UWORD B_TRUE 1 100 0 1 BIT_MASK 0xf00 FORMAT "%13.11" ECU_ADDRESS 0x383B2C /end MEASUREMENT
/begin MEASUREMENT TYP_cgra "" UWORD B_TRUE 1 100 0 1 BIT_MASK 0xf00 FORMAT "%13.11" ECU_ADDRESS 0x383B2E /end MEASUREMENT
/begin MEASUREMENT TYP_cif "Fehlertyp: CAN im Zustand Bus-Off" UWORD B_TRUE 1 100 0 1 BIT_MASK 0xf00 FORMAT "%13.11" ECU_ADDRESS 0x383B30 /end MEASUREMENT
/begin MEASUREMENT TYP_cins "" UWORD B_TRUE 1 100 0 1 BIT_MASK 0xf00 FORMAT "%13.11" ECU_ADDRESS 0x383B32 /end MEASUREMENT
/begin MEASUREMENT TYP_ckla "" UWORD B_TRUE 1 100 0 1 BIT_MASK 0xf00 FORMAT "%13.11" ECU_ADDRESS 0x383B34 /end MEASUREMENT
/begin MEASUREMENT TYP_clws "" UWORD B_TRUE 1 100 0 1 BIT_MASK 0xf00 FORMAT "%13.11" ECU_ADDRESS 0x383B36 /end MEASUREMENT
/begin MEASUREMENT TYP_dkvm "Fehlertyp:  Drosselklappenverschmutzung" UWORD B_TRUE 1 100 0 1 BIT_MASK 0xf00 FORMAT "%13.11" ECU_ADDRESS 0x383B3E /end MEASUREMENT
/begin MEASUREMENT TYP_n "" UWORD B_TRUE 1 100 0 1 BIT_MASK 0xf00 FORMAT "%13.11" ECU_ADDRESS 0x383BDC /end MEASUREMENT
/begin MEASUREMENT TYP_tol "" UWORD B_TRUE 1 100 0 1 BIT_MASK 0xf00 FORMAT "%13.11" ECU_ADDRESS 0x383C14 /end MEASUREMENT
/begin MEASUREMENT TYP_tum "" UWORD B_TRUE 1 100 0 1 BIT_MASK 0xf00 FORMAT "%13.11" ECU_ADDRESS 0x383C16 /end MEASUREMENT
/begin MEASUREMENT udkp1_u "Spannung Drosselklappen-Poti 1 (Byte)" UBYTE spg_ub_b5 1 100 0 4.98047 FORMAT "%5.3" ECU_ADDRESS 0x380906 /end MEASUREMENT
/begin MEASUREMENT udkp2_u "Spannung Drosselklappen-Poti 2 (Byte)" UBYTE spg_ub_b5 1 100 0 4.98047 FORMAT "%5.3" ECU_ADDRESS 0x380907 /end MEASUREMENT
/begin MEASUREMENT uefktget "Übertragungsfunktion (Mrad/Mkurbelwelle) von der Getriebesteuerung" UBYTE uefktget_ub_b25p4 1 100 0 25.5 FORMAT "%5.2" ECU_ADDRESS 0x3808D9 /end MEASUREMENT
/begin MEASUREMENT upwg1_u "Spannung PWG-Poti 1 (Byte)" UBYTE spg_ub_b5 1 100 0 4.98047 FORMAT "%5.3" ECU_ADDRESS 0x380908 /end MEASUREMENT
/begin MEASUREMENT upwg2d_u "Verdoppelte PWG-Poti-2-Spannung (Byte)" UBYTE spg_ub_b5 1 100 0 4.98047 FORMAT "%5.3" ECU_ADDRESS 0x380909 /end MEASUREMENT
/begin MEASUREMENT upwg2_u "Spannung PWG-Poti 2 (Byte)" UBYTE spg_ub_b5 1 100 0 4.98047 FORMAT "%5.3" ECU_ADDRESS 0x38090A /end MEASUREMENT
/begin MEASUREMENT ushknoc_w "Lambda-Sprungsignal hinter Kat, NOx-Sensor-Controller" UWORD spg_q1o200 1 100 -200 65335 FORMAT "%8.2" ECU_ADDRESS 0x380EA4 /end MEASUREMENT
/begin MEASUREMENT vfzgkb_w "Geschwindigkeit aus Kombi-Botschaft" UWORD vfzgkb_uw_b655 1 100 0 654.99 FORMAT "%8.4" ECU_ADDRESS 0x380EA6 /end MEASUREMENT
/begin MEASUREMENT vfzg_u "Fahrzeuggeschwindigkeit, mit def. Quantisierung für Tester" UBYTE vfzg_q1p0 1 100 0 255 FORMAT "%5.1" ECU_ADDRESS 0x38090B /end MEASUREMENT
/begin MEASUREMENT vzgrac "GRA-Zielgeschwindigkeit für CAN-Ausgabe" UBYTE vfzg_ub_q1p25 1 100 0 318.75 FORMAT "%5.1" ECU_ADDRESS 0x3808DA /end MEASUREMENT
/begin MEASUREMENT Z_atr "Zyklusflag: Abgastemperaturregelung" UWORD B_TRUE 1 100 0 1 BIT_MASK 0x2 FORMAT "%13.11" ECU_ADDRESS 0x383B0E /end MEASUREMENT
/begin MEASUREMENT Z_atr2 "Zyklusflag: Abgastemperaturregelung Bank 2" UWORD B_TRUE 1 100 0 1 BIT_MASK 0x2 FORMAT "%13.11" ECU_ADDRESS 0x383B10 /end MEASUREMENT
/begin MEASUREMENT Z_atrd "Zyklusflag: Abgastemperaturregelung Differenz" UWORD B_TRUE 1 100 0 1 BIT_MASK 0x2 FORMAT "%13.11" ECU_ADDRESS 0x383B12 /end MEASUREMENT
/begin MEASUREMENT Z_atrd2 "Zyklusflag: Abgastemperaturregelung Differenz Bank 2" UWORD B_TRUE 1 100 0 1 BIT_MASK 0x2 FORMAT "%13.11" ECU_ADDRESS 0x383B14 /end MEASUREMENT
/begin MEASUREMENT Z_ats "Zyklusflag: Abgastemperatursensor" UWORD B_TRUE 1 100 0 1 BIT_MASK 0x2 FORMAT "%13.11" ECU_ADDRESS 0x383B16 /end MEASUREMENT
/begin MEASUREMENT Z_ats2 "Zyklusflag: Abgastemperatursensor2 (Bank1)" UWORD B_TRUE 1 100 0 1 BIT_MASK 0x2 FORMAT "%13.11" ECU_ADDRESS 0x383B18 /end MEASUREMENT
/begin MEASUREMENT Z_bkvp "Zyklusflag: Bremskraftverstärker-Pumpe" UWORD B_TRUE 1 100 0 1 BIT_MASK 0x2 FORMAT "%13.11" ECU_ADDRESS 0x383B1A /end MEASUREMENT
/begin MEASUREMENT Z_bm "Zyklusflag: Bezugsmarkengeber" UWORD B_TRUE 1 100 0 1 BIT_MASK 0x2 FORMAT "%13.11" ECU_ADDRESS 0x383B1E /end MEASUREMENT
/begin MEASUREMENT Z_cair "Zyklusflag : Timeout Airbag-Botschaft" UWORD B_TRUE 1 100 0 1 BIT_MASK 0x2 FORMAT "%13.11" ECU_ADDRESS 0x383B24 /end MEASUREMENT
/begin MEASUREMENT Z_cas "Zyklusflag: CAN-Schnittstelle, Timeout ASC" UWORD B_TRUE 1 100 0 1 BIT_MASK 0x2 FORMAT "%13.11" ECU_ADDRESS 0x383B28 /end MEASUREMENT
/begin MEASUREMENT Z_cat "Zyklusflag: CAN-Schnittstelle, Timeout Bremsbotschaft setzen" UWORD B_TRUE 1 100 0 1 BIT_MASK 0x2 FORMAT "%13.11" ECU_ADDRESS 0x383B2A /end MEASUREMENT
/begin MEASUREMENT Z_cge "Zyklusflag: CAN-Schnittstelle, Timeout EGS" UWORD B_TRUE 1 100 0 1 BIT_MASK 0x2 FORMAT "%13.11" ECU_ADDRESS 0x383B2C /end MEASUREMENT
/begin MEASUREMENT Z_cgra "Zyklusflag : Timeout GRA-Botschaft" UWORD B_TRUE 1 100 0 1 BIT_MASK 0x2 FORMAT "%13.11" ECU_ADDRESS 0x383B2E /end MEASUREMENT
/begin MEASUREMENT Z_cif "Zyklusflag: CAN-Schnittstelle, interner Fehler" UWORD B_TRUE 1 100 0 1 BIT_MASK 0x2 FORMAT "%13.11" ECU_ADDRESS 0x383B30 /end MEASUREMENT
/begin MEASUREMENT Z_cins "Zyklusflag: CAN-Schnittstelle, Timeout Instrument" UWORD B_TRUE 1 100 0 1 BIT_MASK 0x2 FORMAT "%13.11" ECU_ADDRESS 0x383B32 /end MEASUREMENT
/begin MEASUREMENT Z_ckla "Zyklusflag: CAN-Kommunikation zum KLA-SG gestört" UWORD B_TRUE 1 100 0 1 BIT_MASK 0x2 FORMAT "%13.11" ECU_ADDRESS 0x383B34 /end MEASUREMENT
/begin MEASUREMENT Z_clws "Zyklusflag: CAN-Schnittstelle, Timeout Botschaft Lenkwinkelsensor" UWORD B_TRUE 1 100 0 1 BIT_MASK 0x2 FORMAT "%13.11" ECU_ADDRESS 0x383B36 /end MEASUREMENT
/begin MEASUREMENT Z_dkvm "Zyklusflag: Drosselklappenverschmutzung" UWORD B_TRUE 1 100 0 1 BIT_MASK 0x2 FORMAT "%13.11" ECU_ADDRESS 0x383B3E /end MEASUREMENT
/begin MEASUREMENT Z_ev "Zyklusflag: Einspritzventil Endstufe" UWORD B_TRUE 1 100 0 1 BIT_MASK 0x8000 FORMAT "%13.11" ECU_ADDRESS 0xFD4C /end MEASUREMENT
/begin MEASUREMENT Z_n "Zyklusflag: Drehzahlsignalgeber" UWORD B_TRUE 1 100 0 1 BIT_MASK 0x2 FORMAT "%13.11" ECU_ADDRESS 0x383BDC /end MEASUREMENT
/begin MEASUREMENT Z_tol "Zyklusflag: Öltemperatur" UWORD B_TRUE 1 100 0 1 BIT_MASK 0x2 FORMAT "%13.11" ECU_ADDRESS 0x383C14 /end MEASUREMENT
/begin MEASUREMENT Z_tum "Zyklusflag: Umgebungstemperatur" UWORD B_TRUE 1 100 0 1 BIT_MASK 0x2 FORMAT "%13.11" ECU_ADDRESS 0x383C16 /end MEASUREMENT
/begin FUNCTION CAN "51.502    CAN-Signalliste"
 /begin DEF_CHARACTERISTIC BUSOFFCTR BUSOFFTIME CANVERS CCMKBI CSAIR CWCANKBI CWCANLWS CWCANMD CWCAUVW CWCFS CWCSER CWGC_0_A CWGC_1_A CWGC_2_A CWGC_3_A CWGC_4_A CWGC_5_A CWGC_6_A CWGC_7_A CWGEEIN CW_CAN_C CW_CAN_R_0___A CW_CAN_R_1___A CW_CAN_R_2___A CW_CAN_R_3___A CW_CAN_R_4___A CW_CAN_R_5___A CW_CAN_R_6___A CW_CAN_R_7___A CW_CAN_S_0___A CW_CAN_S_1___A CW_CAN_S_2___A CW_CAN_S_3___A CW_CAN_S_4___A CW_CAN_S_5___A CW_CAN_S_6___A CW_CAN_S_7___A FMOTC FWCBFT FWCSBK FWTMUEBO FWTMUEBU FWTOUEBO FWTOUEBU KFOELKBI KLMIGENL KVNPZ MDMAXKBI MDNORM MOTTYP NMAXKBI OELKBI PMAXKBI T_GEUEW T_KLIMADEADCTR T_KOM1CLDEAD T_NOMAIR T_NOMAIRTA T_NOMBSG T_NOMEGS T_NOMKBI T_NOMKBI1 T_NOMKBI23 T_NOMKLA T_NOMLWS T_NOMNOX T_SFSEN VANZKBI VGNL ZCANAIR ZTOELKBI /end DEF_CHARACTERISTIC
 /begin REF_CHARACTERISTIC MDIMX NOASR /end REF_CHARACTERISTIC
 /begin IN_MEASUREMENT bfgrs_w B_acc B_autget B_bl B_br B_dknolu B_dkpu B_epcl B_fgr B_fgren B_fgrhsa B_fgrte B_fgrtse B_gracan B_i_ska_fr B_kd B_kl15 B_kmtre B_koe B_kosrc B_kov B_kuppl B_kvakbi B_ll B_mil B_msr B_nldg B_nmin B_png B_st B_stend B_wdk2sel cserk fcmEnd fgnsol fho kvakbi_w mdverl_w miautget_w miautgs_w mifab_w mifa_w miist_w milsol_w mimax_w mimin_w misol_w mivbeg_w mizwmn_w mrfamx_w mrfgr_w mrped_w nmot nmot_w nstat S_bls S_brs tans tmot tnst_w toelk_w tvluesic ub udkp1_w udkp2_w vfzg vregl_w vziel_w wdkba wpedv_w wpfgr_w zstfgr /end IN_MEASUREMENT
 /begin OUT_MEASUREMENT bfgrsc bz_air bz_cang1 bz_cmf B_aircan B_airnbot B_amsrbot B_amsrnbot B_anlasc B_anlfr B_br3bot B_cankbi B_canlws B_cdma B_ckien B_csair B_ctout B_cvtad B_ectal B_epcden B_fku B_fstcanok B_gekoa B_ges B_geuew B_grabot B_gsaf B_gsch B_kooffc B_lowra B_luesscb B_lwsbot B_lwser B_lwsok B_mdwaner B_mgbget B_milfb B_milfbg B_motaus B_nlbzanf B_nohts B_noip0s B_noip1s B_noip2s B_nooke B_nuair B_nukla B_sacc B_sacvt B_skoc B_sksc B_statbr B_statge B_statgec B_statmd B_statmdc B_statme B_statme_t B_statnb B_statto B_stattoc B_tabcan B_talcan B_talkbi B_tfstok B_tippg B_tmkicb B_tolcb B_tolueb B_tumcb B_wk B_wkauf B_wkr B_zges can_nv_bits cs_air dlws_w fawifgr gangauti gwhpos klahc km01tr kmstand_w lws_w mdgbeg mdgrad_w mdverlc mdwancan miautgetc miautgsc miges_w migs_can migs_w miistc mizwmnc mkllsc mkolsc nllcvt1 nohknoc_w o2hknoc_w pkodrc statgra S_fs tabcan_w tfst tmkic tolc tumc tvluessc uefktget ushknoc_w vfzgkb_w vzgrac /end OUT_MEASUREMENT
 /begin LOC_MEASUREMENT kfoelkbi_nmot /end LOC_MEASUREMENT
 /begin SUB_FUNCTION /end SUB_FUNCTION
/end FUNCTION
/begin FUNCTION CAN_DST "" /begin DEF_CHARACTERISTIC /end DEF_CHARACTERISTIC /begin REF_CHARACTERISTIC /end REF_CHARACTERISTIC /begin IN_MEASUREMENT B_ctout /end IN_MEASUREMENT /begin OUT_MEASUREMENT /end OUT_MEASUREMENT /begin LOC_MEASUREMENT /end LOC_MEASUREMENT /begin SUB_FUNCTION /end SUB_FUNCTION /end FUNCTION
/begin FUNCTION D2CTR "2.40      Diagnose; Ereigniscounter für Systembeobachtung" /begin DEF_CHARACTERISTIC DFPSLBIT /end DEF_CHARACTERISTIC /begin REF_CHARACTERISTIC /end REF_CHARACTERISTIC /begin IN_MEASUREMENT /end IN_MEASUREMENT
 /begin OUT_MEASUREMENT bbd2ctr B_syserr B_syserrk B_trip ctrerf1 ctrerfk1 ctrrdy1 ctrsfp ctrzyf0 ctrzyf1 /end OUT_MEASUREMENT
 /begin LOC_MEASUREMENT /end LOC_MEASUREMENT
 /begin SUB_FUNCTION /end SUB_FUNCTION
/end FUNCTION
/begin FUNCTION DATR "1.20      Diagnose Abgastemperaturregelung" /begin DEF_CHARACTERISTIC DLATRNP DLEATRN TVBATRF TVEATRDR TVEATRDS TVEATRR TVEATRS /end DEF_CHARACTERISTIC /begin REF_CHARACTERISTIC /end REF_CHARACTERISTIC /begin IN_MEASUREMENT B_atr B_atr2 B_cdatr cd_bits1_w dlatr2_w dlatr_w nmot /end IN_MEASUREMENT /begin OUT_MEASUREMENT B_atrf dleatr /end OUT_MEASUREMENT /begin LOC_MEASUREMENT B_atrd B_atrd2 B_fatr B_fatr2 /end LOC_MEASUREMENT /begin SUB_FUNCTION /end SUB_FUNCTION /end FUNCTION
/begin FUNCTION DATS "1.60      Diagnose Abgastemperatursensor" /begin DEF_CHARACTERISTIC DTPATS TATSMN TATSMX TATSNP TDATSO TPSATS TVEATSR TVEATSS /end DEF_CHARACTERISTIC /begin REF_CHARACTERISTIC /end REF_CHARACTERISTIC
 /begin IN_MEASUREMENT B_atsb B_cdats B_ll cd_bits1_w tabgm_w tats2_w tats_w tpats tpats2 /end IN_MEASUREMENT
 /begin OUT_MEASUREMENT /end OUT_MEASUREMENT
 /begin LOC_MEASUREMENT B_tdats /end LOC_MEASUREMENT
 /begin SUB_FUNCTION /end SUB_FUNCTION
/end FUNCTION
/begin FUNCTION DBKVP "1.90      Diagnose Bremskraftverstärker-Pumpe" /begin DEF_CHARACTERISTIC DPBKVP DPBKVPMN TDBBKVP TDDBKVP TNSTBKV /end DEF_CHARACTERISTIC /begin REF_CHARACTERISTIC FBKVP PBKVKRHY /end REF_CHARACTERISTIC
 /begin IN_MEASUREMENT B_bkvp B_brems B_cdbkvp B_cddsbkv B_fabkv dpbkvukp_w pbkv_w psspbkv_w pubkv_w tnst_w /end IN_MEASUREMENT
 /begin OUT_MEASUREMENT B_fdbkvp B_fpbkvmx B_zbkvtest /end OUT_MEASUREMENT
 /begin LOC_MEASUREMENT B_dbkvpa B_rdbkvp B_rdbkvpps B_rtdbkvp dpbkvpa_w pbkvpaus_w pbkvpdf_w pbkvprd_w pbkvp_w /end LOC_MEASUREMENT
 /begin SUB_FUNCTION /end SUB_FUNCTION
/end FUNCTION
/begin FUNCTION DBKVPE "1.10      Endstufendiagnose Bremskraftverstärker-Pumpe" /begin DEF_CHARACTERISTIC /end DEF_CHARACTERISTIC /begin REF_CHARACTERISTIC /end REF_CHARACTERISTIC /begin IN_MEASUREMENT B_bkvp B_desee /end IN_MEASUREMENT /begin OUT_MEASUREMENT /end OUT_MEASUREMENT /begin LOC_MEASUREMENT bkvpea_ctr bkvpena_ctr B_bkvpea B_bkvpena dbkvpelokbits /end LOC_MEASUREMENT /begin SUB_FUNCTION /end SUB_FUNCTION /end FUNCTION
/begin FUNCTION DCDACC "2.10      Diagnose; Zugriff auf Testerdaten" /begin DEF_CHARACTERISTIC CWCDCUM /end DEF_CHARACTERISTIC /begin REF_CHARACTERISTIC /end REF_CHARACTERISTIC /begin IN_MEASUREMENT /end IN_MEASUREMENT /begin OUT_MEASUREMENT /end OUT_MEASUREMENT /begin LOC_MEASUREMENT /end LOC_MEASUREMENT /begin SUB_FUNCTION /end SUB_FUNCTION /end FUNCTION
/begin FUNCTION DCLA "7.10      OBDII; Klassentabelle"
 /begin DEF_CHARACTERISTIC CL30LINE CL31LINE CL32LINE CL33LINE CL34LINE CL35LINE CL36LINE CL37LINE CL38LINE CL39LINE CWFLC /end DEF_CHARACTERISTIC
 /begin REF_CHARACTERISTIC /end REF_CHARACTERISTIC
 /begin IN_MEASUREMENT /end IN_MEASUREMENT
 /begin OUT_MEASUREMENT /end OUT_MEASUREMENT
 /begin LOC_MEASUREMENT /end LOC_MEASUREMENT
 /begin SUB_FUNCTION /end SUB_FUNCTION
/end FUNCTION
/begin FUNCTION DDCY "15.10     OBDII; Erfüllung Bedingung 'driving cycle'" /begin DEF_CHARACTERISTIC TWBDCY /end DEF_CHARACTERISTIC /begin REF_CHARACTERISTIC /end REF_CHARACTERISTIC /begin IN_MEASUREMENT B_pwf B_stend /end IN_MEASUREMENT /begin OUT_MEASUREMENT bbdcy B_dcy dcycnt /end OUT_MEASUREMENT /begin LOC_MEASUREMENT /end LOC_MEASUREMENT /begin SUB_FUNCTION /end SUB_FUNCTION /end FUNCTION
/begin FUNCTION DDG "10.50     Diagnose Drehzahlgeber"
 /begin DEF_CHARACTERISTIC CORTINC CORTINIT CORTMX LBMINC LBMINIT LBMMX LBMSUB MXNLN NOBMINC NOBMINIT NOBMSTMX PGFLNL PGFLWA TMOTNLDG /end DEF_CHARACTERISTIC
 /begin REF_CHARACTERISTIC /end REF_CHARACTERISTIC
 /begin IN_MEASUREMENT bmLosCtr_w B_bm B_fbm B_motstop B_nmin B_nophnldg B_pwf B_synnldg B_zprel nmotllfil nstat nsynnldg tmCorCtr_w tmot tpCorCtr_w vfzg_w wkw_w znbm_w zrph /end IN_MEASUREMENT
 /begin OUT_MEASUREMENT B_nldg /end OUT_MEASUREMENT
 /begin LOC_MEASUREMENT B_enabddg B_nlbm B_nlnobm B_nlnon B_nobmflr1 B_nobmflr2 B_nocorflr flgddg sbmcorm sbmcorp sbmlos_w snobm /end LOC_MEASUREMENT
 /begin SUB_FUNCTION /end SUB_FUNCTION
/end FUNCTION
/begin FUNCTION DDKV ""
 /begin DEF_CHARACTERISTIC APDKGMN CWDDKV DDKVFZMN DDKVHZMN DFUELSANMX FDKVDELTA FDKVMX FRAUDDKVMN FRAUDDKVMX OFMSNDKVMN RKATDDKVMN RKATDDKVMX /end DEF_CHARACTERISTIC
 /begin REF_CHARACTERISTIC /end REF_CHARACTERISTIC
 /begin IN_MEASUREMENT B_gae B_hfm B_ofmsndk dfuelsan_w frau_w ofmsndk_w rkat_w /end IN_MEASUREMENT
 /begin OUT_MEASUREMENT /end OUT_MEASUREMENT
 /begin LOC_MEASUREMENT apdkg_w apdkv_w B_ddkvstp B_dkve B_fdkv ddkvfz ddkvhz ddkvLokBitsKoop fdkv_w /end LOC_MEASUREMENT
 /begin SUB_FUNCTION DFPM_DDKV /end SUB_FUNCTION
/end FUNCTION
/begin FUNCTION DDPL "9.20      Diagnose; Plausibilitätsprüfung Dauerversorgung (OBDII)" /begin DEF_CHARACTERISTIC /end DEF_CHARACTERISTIC /begin REF_CHARACTERISTIC /end REF_CHARACTERISTIC /begin IN_MEASUREMENT B_pwfCsErr /end IN_MEASUREMENT /begin OUT_MEASUREMENT /end OUT_MEASUREMENT /begin LOC_MEASUREMENT /end LOC_MEASUREMENT /begin SUB_FUNCTION /end SUB_FUNCTION /end FUNCTION
/begin FUNCTION DDSBKV "Diagnose Drucksensor im Bremskraftverstärker"
 /begin DEF_CHARACTERISTIC DPBKVLE DPSBKV DPSPBKVNPH DPSPUBKVH DPUBKV PBKVMN PBKVMX TDDFBKV TDDHBKV TEPBKVNB TTBRL TVPBKVNB UDSBKVMN UDSBKVMX /end DEF_CHARACTERISTIC
 /begin REF_CHARACTERISTIC /end REF_CHARACTERISTIC
 /begin IN_MEASUREMENT B_brems B_cddsbkv B_ehfm B_nmin pbkv_w ps_w pu_w udsbkv_w /end IN_MEASUREMENT
 /begin OUT_MEASUREMENT /end OUT_MEASUREMENT
 /begin LOC_MEASUREMENT B_bkvnpler B_bkvnplh B_ebkvl B_hbkvl B_rtdbkvl dpbkvae_w pbkva_w pbkvel_w /end LOC_MEASUREMENT
 /begin SUB_FUNCTION /end SUB_FUNCTION
/end FUNCTION
/begin FUNCTION DDVE "7.30      Diagnose: EGAS-Steller DV-E" /begin DEF_CHARACTERISTIC TPNSE /end DEF_CHARACTERISTIC /begin REF_CHARACTERISTIC /end REF_CHARACTERISTIC
 /begin IN_MEASUREMENT B_abgle B_dkaden B_dkp1e B_dkp1mn B_dkp1mx B_dkp1np B_dkp2e B_dkp2mn B_dkp2mx B_dkp2np B_dlrbe B_dlrpide B_dveese B_fproab B_fproe B_fprook B_fprordy B_fprovb B_fprrdy B_fprzab B_fprze B_fprzvb B_lrnakt B_lrnerf B_lrnrdy B_lrnvb B_lrnws B_nlpe B_nlperf B_nlpnew B_pwf B_stend B_umae B_umauab B_wdksive dveadchst fprstep_c lrnstep_c /end IN_MEASUREMENT
 /begin OUT_MEASUREMENT /end OUT_MEASUREMENT
 /begin LOC_MEASUREMENT /end LOC_MEASUREMENT
 /begin SUB_FUNCTION /end SUB_FUNCTION
/end FUNCTION
/begin FUNCTION DECJ "14.30     Diagnose; Endstufe CJ4x/9x" /begin DEF_CHARACTERISTIC CWBBDECJ /end DEF_CHARACTERISTIC /begin REF_CHARACTERISTIC /end REF_CHARACTERISTIC /begin IN_MEASUREMENT B_airbag B_dhrnio B_nmin B_ubrk B_ubrmax nmot ub /end IN_MEASUREMENT /begin OUT_MEASUREMENT B_bbdecj B_bbubr B_desee B_esdia /end OUT_MEASUREMENT /begin LOC_MEASUREMENT /end LOC_MEASUREMENT /begin SUB_FUNCTION /end SUB_FUNCTION /end FUNCTION
/begin FUNCTION DEGFE "6.60      Diagnose der Eingangsgrößen Füllungserfassung"
 /begin DEF_CHARACTERISTIC DFEMPOS DFEMPUS DFRAOS DFRAUS FEMPOS FEMPUS FRAOS FRAUS TDEGFEMN TDEGFEMX TDEGFENO TEGA TLADEGFE TVFKMSDK ZKGAFRANM /end DEF_CHARACTERISTIC
 /begin REF_CHARACTERISTIC /end REF_CHARACTERISTIC
 /begin IN_MEASUREMENT B_cdegfe B_fedkb B_fkpvdk B_frao B_frau B_lra B_msndko B_pwf fkpvdkg_w fra_w frm_w pspvds_w /end IN_MEASUREMENT
 /begin OUT_MEASUREMENT B_ehfmfe B_fempos B_fempus B_gaedegfe B_gafraos B_gafraus B_laedegfe B_tepvb B_zhfmfe DEGFEintbits degfe_bits1 dgafram_w dgafra_w fram_w frmm_w /end OUT_MEASUREMENT
 /begin LOC_MEASUREMENT /end LOC_MEASUREMENT
 /begin SUB_FUNCTION /end SUB_FUNCTION
/end FUNCTION
/begin FUNCTION DEKON "Konfiguration der Endstufendiagnose" /begin DEF_CHARACTERISTIC ESKONF_0_A ESKONF_1_A /end DEF_CHARACTERISTIC /begin REF_CHARACTERISTIC /end REF_CHARACTERISTIC /begin IN_MEASUREMENT /end IN_MEASUREMENT /begin OUT_MEASUREMENT /end OUT_MEASUREMENT /begin LOC_MEASUREMENT /end LOC_MEASUREMENT /begin SUB_FUNCTION /end SUB_FUNCTION /end FUNCTION
/begin FUNCTION DEKPE "11.20     Diagnose; Elektrokraftstoffpumpe Endstufe" /begin DEF_CHARACTERISTIC UBDEKPMN /end DEF_CHARACTERISTIC /begin REF_CHARACTERISTIC /end REF_CHARACTERISTIC /begin IN_MEASUREMENT B_desee ub /end IN_MEASUREMENT /begin OUT_MEASUREMENT /end OUT_MEASUREMENT /begin LOC_MEASUREMENT /end LOC_MEASUREMENT /begin SUB_FUNCTION /end SUB_FUNCTION /end FUNCTION
/begin FUNCTION DEPCL "1.20      Diagnose; Elektronik Powertrain Control Lampe" /begin DEF_CHARACTERISTIC TEPCL TEPCLI /end DEF_CHARACTERISTIC /begin REF_CHARACTERISTIC /end REF_CHARACTERISTIC /begin IN_MEASUREMENT B_nmot dfpmEpclState /end IN_MEASUREMENT /begin OUT_MEASUREMENT B_epcl /end OUT_MEASUREMENT /begin LOC_MEASUREMENT /end LOC_MEASUREMENT /begin SUB_FUNCTION /end SUB_FUNCTION /end FUNCTION
/begin FUNCTION DEPCLE "1.20      Diagnose EPCL-Endstufe" /begin DEF_CHARACTERISTIC /end DEF_CHARACTERISTIC /begin REF_CHARACTERISTIC /end REF_CHARACTERISTIC /begin IN_MEASUREMENT B_desee B_epcl /end IN_MEASUREMENT /begin OUT_MEASUREMENT /end OUT_MEASUREMENT /begin LOC_MEASUREMENT /end LOC_MEASUREMENT /begin SUB_FUNCTION /end SUB_FUNCTION /end FUNCTION
/begin FUNCTION DETRE "1.10      Diagnose Endstufenprüfung elektrische Thermostatregelung" /begin DEF_CHARACTERISTIC /end DEF_CHARACTERISTIC /begin REF_CHARACTERISTIC /end REF_CHARACTERISTIC /begin IN_MEASUREMENT B_desee tvkmtr /end IN_MEASUREMENT /begin OUT_MEASUREMENT /end OUT_MEASUREMENT /begin LOC_MEASUREMENT /end LOC_MEASUREMENT /begin SUB_FUNCTION /end SUB_FUNCTION /end FUNCTION
/begin FUNCTION DEVE "6.40      Diagnose; Einspritzventil - Endstufe" /begin DEF_CHARACTERISTIC /end DEF_CHARACTERISTIC /begin REF_CHARACTERISTIC /end REF_CHARACTERISTIC /begin IN_MEASUREMENT B_desee B_sa B_stend evz_austot /end IN_MEASUREMENT /begin OUT_MEASUREMENT B_eev Z_ev /end OUT_MEASUREMENT /begin LOC_MEASUREMENT /end LOC_MEASUREMENT /begin SUB_FUNCTION /end SUB_FUNCTION /end FUNCTION
/begin FUNCTION DFFT "1.80      Diagnose; Freeze Frame Auswahltabelle" /begin DEF_CHARACTERISTIC /end DEF_CHARACTERISTIC /begin REF_CHARACTERISTIC /end REF_CHARACTERISTIC
 /begin IN_MEASUREMENT egaspfad flglrs fra_u fr_u gangi mizsolv_u mizuvfil mi_duf mi_um ml mpfad nmot pu rinh_u rl rml rstpfad skapfad tabgm tans tfst tkatm tmew tmot tmotlin tmot_u tmrw tumg ub udkp1_u udkp2_u uhsv upwg1_u upwg2d_u upwg2_u ushk usvk vfzg_u wdkba wdks wped /end IN_MEASUREMENT
 /begin OUT_MEASUREMENT /end OUT_MEASUREMENT
 /begin LOC_MEASUREMENT /end LOC_MEASUREMENT
 /begin SUB_FUNCTION /end SUB_FUNCTION
/end FUNCTION
/begin FUNCTION DFFTCNV "3.60      Diagnose; Freeze Frame Tabelle, Konvertierung zu Bytes" /begin DEF_CHARACTERISTIC /end DEF_CHARACTERISTIC /begin REF_CHARACTERISTIC NMAX /end REF_CHARACTERISTIC
 /begin IN_MEASUREMENT fra_w fr_w mizsolv_w nmot_w rinh_w rlugd_w rl_w tmotlin udkp1_w udkp2_w upwg1_w upwg2d_w upwg2_w vfzg /end IN_MEASUREMENT
 /begin OUT_MEASUREMENT fra_u fr_u mizsolv_u rinh_u rl_u tmot_u udkp1_u udkp2_u upwg1_u upwg2d_u upwg2_u vfzg_u /end OUT_MEASUREMENT
 /begin LOC_MEASUREMENT /end LOC_MEASUREMENT
 /begin SUB_FUNCTION /end SUB_FUNCTION
/end FUNCTION
/begin FUNCTION DFFTK "9.10      Diagnose; Kundenspezifische Auswahlliste für Freeze Frame-Werte" /begin DEF_CHARACTERISTIC /end DEF_CHARACTERISTIC /begin REF_CHARACTERISTIC /end REF_CHARACTERISTIC /begin IN_MEASUREMENT /end IN_MEASUREMENT /begin OUT_MEASUREMENT /end OUT_MEASUREMENT /begin LOC_MEASUREMENT /end LOC_MEASUREMENT /begin SUB_FUNCTION /end SUB_FUNCTION /end FUNCTION
/begin FUNCTION DFPM "3.40      OBDII; Fehlerpfadmanager" /begin DEF_CHARACTERISTIC /end DEF_CHARACTERISTIC /begin REF_CHARACTERISTIC CWFLC /end REF_CHARACTERISTIC
 /begin IN_MEASUREMENT bbwuc B_pwf egaspfad mi_duf mpfad nmot rstpfad skapfad tans tmot tmotlin top_w ushk usvk vfzg /end IN_MEASUREMENT
 /begin OUT_MEASUREMENT bbno bbsp3 bbtim B_no B_sp3 B_tim dfcmFcm dfcmNo dfcmSfp dfpmEpclState dfpmMilState dfp_ap fcmEnd FCMTab /end OUT_MEASUREMENT
 /begin LOC_MEASUREMENT /end LOC_MEASUREMENT
 /begin SUB_FUNCTION /end SUB_FUNCTION
/end FUNCTION
/begin FUNCTION DFPMEEP "3.50      Diagnose; Fehlerpfadmanager, EEPROM-Speicherung" /begin DEF_CHARACTERISTIC /end DEF_CHARACTERISTIC /begin REF_CHARACTERISTIC CWFLC /end REF_CHARACTERISTIC /begin IN_MEASUREMENT B_pwf dfcmNo fcmEnd FCMTab ffzdfp /end IN_MEASUREMENT /begin OUT_MEASUREMENT /end OUT_MEASUREMENT /begin LOC_MEASUREMENT /end LOC_MEASUREMENT /begin SUB_FUNCTION /end SUB_FUNCTION /end FUNCTION
/begin FUNCTION DFPMNL "2.10      Diagnose Fehlerpfadmanagement im Nachlauf" /begin DEF_CHARACTERISTIC /end DEF_CHARACTERISTIC /begin REF_CHARACTERISTIC CWFLC /end REF_CHARACTERISTIC /begin IN_MEASUREMENT B_nlobd fcmEnd /end IN_MEASUREMENT /begin OUT_MEASUREMENT /end OUT_MEASUREMENT /begin LOC_MEASUREMENT /end LOC_MEASUREMENT /begin SUB_FUNCTION /end SUB_FUNCTION /end FUNCTION
/begin FUNCTION DFPMOVF "2.10      Diagnose Fehlerpfadmanagement, Memory Overflow" /begin DEF_CHARACTERISTIC /end DEF_CHARACTERISTIC /begin REF_CHARACTERISTIC CWFLC /end REF_CHARACTERISTIC /begin IN_MEASUREMENT fcmEnd /end IN_MEASUREMENT /begin OUT_MEASUREMENT /end OUT_MEASUREMENT /begin LOC_MEASUREMENT /end LOC_MEASUREMENT /begin SUB_FUNCTION /end SUB_FUNCTION /end FUNCTION
/begin FUNCTION DFPMPWF "1.10      Diagnose Fehlerpfadmanagement; Erkennung Powerfail" /begin DEF_CHARACTERISTIC /end DEF_CHARACTERISTIC /begin REF_CHARACTERISTIC /end REF_CHARACTERISTIC /begin IN_MEASUREMENT fcmEnd /end IN_MEASUREMENT /begin OUT_MEASUREMENT /end OUT_MEASUREMENT /begin LOC_MEASUREMENT /end LOC_MEASUREMENT /begin SUB_FUNCTION /end SUB_FUNCTION /end FUNCTION
/begin FUNCTION DFPM_BGTOL "" /begin DEF_CHARACTERISTIC CDCTOL CDKTOL CDTTOL CLATOL FFTTOL TSFTOL /end DEF_CHARACTERISTIC /begin REF_CHARACTERISTIC /end REF_CHARACTERISTIC /begin IN_MEASUREMENT /end IN_MEASUREMENT
 /begin OUT_MEASUREMENT B_avtol B_betol B_bktol B_cltol B_fttol B_mntol B_mxtol B_nptol B_pytol B_sctol B_sitol E_tol sfptol TYP_tol Z_tol /end OUT_MEASUREMENT
 /begin LOC_MEASUREMENT /end LOC_MEASUREMENT
 /begin SUB_FUNCTION /end SUB_FUNCTION
/end FUNCTION
/begin FUNCTION DFPM_BGTUMG "" /begin DEF_CHARACTERISTIC CDCTUM CDKTUM CDTTUM CLATUM FFTTUM TSFTUM /end DEF_CHARACTERISTIC /begin REF_CHARACTERISTIC /end REF_CHARACTERISTIC /begin IN_MEASUREMENT /end IN_MEASUREMENT
 /begin OUT_MEASUREMENT B_betum B_bktum B_cltum B_fttum B_mntum B_mxtum B_nptum B_situm E_tum sfptum TYP_tum Z_tum /end OUT_MEASUREMENT
 /begin LOC_MEASUREMENT /end LOC_MEASUREMENT
 /begin SUB_FUNCTION /end SUB_FUNCTION
/end FUNCTION
/begin FUNCTION DFPM_CAIR "" /begin DEF_CHARACTERISTIC CDCCAIR CDKCAIR CDTCAIR CLACAIR FFTCAIR TSFCAIR /end DEF_CHARACTERISTIC /begin REF_CHARACTERISTIC /end REF_CHARACTERISTIC /begin IN_MEASUREMENT /end IN_MEASUREMENT
 /begin OUT_MEASUREMENT B_avcair B_becair B_bkcair B_clcair B_ftcair B_mncair B_mxcair B_npcair B_pycair B_sccair B_sicair E_cair sfpcair TYP_cair Z_cair /end OUT_MEASUREMENT
 /begin LOC_MEASUREMENT /end LOC_MEASUREMENT
 /begin SUB_FUNCTION /end SUB_FUNCTION
/end FUNCTION
/begin FUNCTION DFPM_CALL "" /begin DEF_CHARACTERISTIC /end DEF_CHARACTERISTIC /begin REF_CHARACTERISTIC /end REF_CHARACTERISTIC /begin IN_MEASUREMENT /end IN_MEASUREMENT /begin OUT_MEASUREMENT /end OUT_MEASUREMENT /begin LOC_MEASUREMENT /end LOC_MEASUREMENT /begin SUB_FUNCTION /end SUB_FUNCTION /end FUNCTION
/begin FUNCTION DFPM_CAS "" /begin DEF_CHARACTERISTIC CDCCAS CDKCAS CDTCAS CLACAS FFTCAS TSFCAS /end DEF_CHARACTERISTIC /begin REF_CHARACTERISTIC /end REF_CHARACTERISTIC /begin IN_MEASUREMENT /end IN_MEASUREMENT
 /begin OUT_MEASUREMENT B_avcas B_becas B_bkcas B_clcas B_ftcas B_mncas B_mxcas B_npcas B_pycas B_sccas B_sicas E_cas sfpcas TYP_cas Z_cas /end OUT_MEASUREMENT
 /begin LOC_MEASUREMENT /end LOC_MEASUREMENT
 /begin SUB_FUNCTION /end SUB_FUNCTION
/end FUNCTION
/begin FUNCTION DFPM_CAT "" /begin DEF_CHARACTERISTIC CDCCAT CDKCAT CDTCAT CLACAT FFTCAT TSFCAT /end DEF_CHARACTERISTIC /begin REF_CHARACTERISTIC /end REF_CHARACTERISTIC /begin IN_MEASUREMENT /end IN_MEASUREMENT
 /begin OUT_MEASUREMENT B_avcat B_becat B_bkcat B_clcat B_ftcat B_mncat B_mxcat B_npcat B_pycat B_sccat B_sicat E_cat sfpcat TYP_cat Z_cat /end OUT_MEASUREMENT
 /begin LOC_MEASUREMENT /end LOC_MEASUREMENT
 /begin SUB_FUNCTION /end SUB_FUNCTION
/end FUNCTION
/begin FUNCTION DFPM_CBSG "" /begin DEF_CHARACTERISTIC /end DEF_CHARACTERISTIC /begin REF_CHARACTERISTIC /end REF_CHARACTERISTIC /begin IN_MEASUREMENT /end IN_MEASUREMENT /begin OUT_MEASUREMENT /end OUT_MEASUREMENT /begin LOC_MEASUREMENT /end LOC_MEASUREMENT /begin SUB_FUNCTION /end SUB_FUNCTION /end FUNCTION
/begin FUNCTION DFPM_CGE "" /begin DEF_CHARACTERISTIC CDCCGE CDKCGE CDTCGE CLACGE FFTCGE TSFCGE /end DEF_CHARACTERISTIC /begin REF_CHARACTERISTIC /end REF_CHARACTERISTIC /begin IN_MEASUREMENT /end IN_MEASUREMENT
 /begin OUT_MEASUREMENT B_avcge B_becge B_bkcge B_clcge B_ftcge B_mncge B_mxcge B_npcge B_pycge B_sccge B_sicge E_cge sfpcge TYP_cge Z_cge /end OUT_MEASUREMENT
 /begin LOC_MEASUREMENT /end LOC_MEASUREMENT
 /begin SUB_FUNCTION /end SUB_FUNCTION
/end FUNCTION
/begin FUNCTION DFPM_CGRA "" /begin DEF_CHARACTERISTIC CDCCGRA CDKCGRA CDTCGRA CLACGRA FFTCGRA TSFCGRA /end DEF_CHARACTERISTIC /begin REF_CHARACTERISTIC /end REF_CHARACTERISTIC /begin IN_MEASUREMENT /end IN_MEASUREMENT
 /begin OUT_MEASUREMENT B_avcgra B_becgra B_bkcgra B_clcgra B_ftcgra B_mncgra B_mxcgra B_npcgra B_pycgra B_sccgra B_sicgra E_cgra sfpcgra TYP_cgra Z_cgra /end OUT_MEASUREMENT
 /begin LOC_MEASUREMENT /end LOC_MEASUREMENT
 /begin SUB_FUNCTION /end SUB_FUNCTION
/end FUNCTION
/begin FUNCTION DFPM_CIF "" /begin DEF_CHARACTERISTIC CDCCIF CDKCIF CDTCIF CLACIF FFTCIF TSFCIF /end DEF_CHARACTERISTIC /begin REF_CHARACTERISTIC /end REF_CHARACTERISTIC /begin IN_MEASUREMENT /end IN_MEASUREMENT
 /begin OUT_MEASUREMENT B_avcif B_becif B_bkcif B_clcif B_ftcif B_mncif B_mxcif B_npcif B_pycif B_sccif B_sicif E_cif sfpcif TYP_cif Z_cif /end OUT_MEASUREMENT
 /begin LOC_MEASUREMENT /end LOC_MEASUREMENT
 /begin SUB_FUNCTION /end SUB_FUNCTION
/end FUNCTION
/begin FUNCTION DFPM_CINS "" /begin DEF_CHARACTERISTIC CDCCINS CDKCINS CDTCINS CLACINS FFTCINS TSFCINS /end DEF_CHARACTERISTIC /begin REF_CHARACTERISTIC /end REF_CHARACTERISTIC /begin IN_MEASUREMENT /end IN_MEASUREMENT
 /begin OUT_MEASUREMENT B_avcins B_becins B_bkcins B_clcins B_ftcins B_mncins B_mxcins B_npcins B_pycins B_sccins B_sicins E_cins sfpcins TYP_cins Z_cins /end OUT_MEASUREMENT
 /begin LOC_MEASUREMENT /end LOC_MEASUREMENT
 /begin SUB_FUNCTION /end SUB_FUNCTION
/end FUNCTION
/begin FUNCTION DFPM_CKLA "" /begin DEF_CHARACTERISTIC CDCCKLA CDKCKLA CDTCKLA CLACKLA FFTCKLA TSFCKLA /end DEF_CHARACTERISTIC /begin REF_CHARACTERISTIC /end REF_CHARACTERISTIC /begin IN_MEASUREMENT /end IN_MEASUREMENT
 /begin OUT_MEASUREMENT B_avckla B_beckla B_bkckla B_clckla B_ftckla B_mnckla B_mxckla B_npckla B_pyckla B_scckla B_sickla E_ckla sfpckla TYP_ckla Z_ckla /end OUT_MEASUREMENT
 /begin LOC_MEASUREMENT /end LOC_MEASUREMENT
 /begin SUB_FUNCTION /end SUB_FUNCTION
/end FUNCTION
/begin FUNCTION DFPM_CLWS "" /begin DEF_CHARACTERISTIC CDCCLWS CDKCLWS CDTCLWS CLACLWS FFTCLWS TSFCLWS /end DEF_CHARACTERISTIC /begin REF_CHARACTERISTIC /end REF_CHARACTERISTIC /begin IN_MEASUREMENT /end IN_MEASUREMENT
 /begin OUT_MEASUREMENT B_avclws B_beclws B_bkclws B_clclws B_ftclws B_mnclws B_mxclws B_npclws B_pyclws B_scclws B_siclws E_clws sfpclws TYP_clws Z_clws /end OUT_MEASUREMENT
 /begin LOC_MEASUREMENT /end LOC_MEASUREMENT
 /begin SUB_FUNCTION /end SUB_FUNCTION
/end FUNCTION
/begin FUNCTION DFPM_CNIV "" /begin DEF_CHARACTERISTIC /end DEF_CHARACTERISTIC /begin REF_CHARACTERISTIC /end REF_CHARACTERISTIC /begin IN_MEASUREMENT /end IN_MEASUREMENT /begin OUT_MEASUREMENT /end OUT_MEASUREMENT /begin LOC_MEASUREMENT /end LOC_MEASUREMENT /begin SUB_FUNCTION /end SUB_FUNCTION /end FUNCTION
/begin FUNCTION DFPM_CNOX "" /begin DEF_CHARACTERISTIC /end DEF_CHARACTERISTIC /begin REF_CHARACTERISTIC /end REF_CHARACTERISTIC /begin IN_MEASUREMENT /end IN_MEASUREMENT /begin OUT_MEASUREMENT /end OUT_MEASUREMENT /begin LOC_MEASUREMENT /end LOC_MEASUREMENT /begin SUB_FUNCTION /end SUB_FUNCTION /end FUNCTION
/begin FUNCTION DFPM_CZAS "" /begin DEF_CHARACTERISTIC /end DEF_CHARACTERISTIC /begin REF_CHARACTERISTIC /end REF_CHARACTERISTIC /begin IN_MEASUREMENT /end IN_MEASUREMENT /begin OUT_MEASUREMENT /end OUT_MEASUREMENT /begin LOC_MEASUREMENT /end LOC_MEASUREMENT /begin SUB_FUNCTION /end SUB_FUNCTION /end FUNCTION
/begin FUNCTION DFPM_DATR ""
 /begin DEF_CHARACTERISTIC CDCATR CDCATR2 CDCATRD CDCATRD2 CDKATR CDKATR2 CDKATRD CDKATRD2 CDTATR CDTATR2 CDTATRD CDTATRD2 CLAATR CLAATR2 CLAATRD CLAATRD2 FFTATR FFTATR2 FFTATRD FFTATRD2 TSFATR TSFATR2 TSFATRD TSFATRD2 /end DEF_CHARACTERISTIC
 /begin REF_CHARACTERISTIC /end REF_CHARACTERISTIC
 /begin IN_MEASUREMENT /end IN_MEASUREMENT
 /begin OUT_MEASUREMENT B_beatr B_beatr2 B_beatrd B_beatrd2 B_bkatr B_bkatr2 B_bkatrd B_bkatrd2 B_clatr B_clatr2 B_clatrd B_clatrd2 B_ftatr B_ftatr2 B_ftatrd B_ftatrd2 B_mnatr B_mnatr2 B_mnatrd B_mnatrd2 B_mxatr B_mxatr2 B_mxatrd B_mxatrd2 B_npatr B_npatr2 B_npatrd B_npatrd2 B_siatr B_siatr2 B_siatrd B_siatrd2 E_atr E_atr2 E_atrd E_atrd2 sfpatr sfpatr2 sfpatrd sfpatrd2 TYP_atr TYP_atr2 TYP_atrd TYP_atrd2 Z_atr Z_atr2 Z_atrd Z_atrd2 /end OUT_MEASUREMENT
 /begin LOC_MEASUREMENT /end LOC_MEASUREMENT
 /begin SUB_FUNCTION /end SUB_FUNCTION
/end FUNCTION
/begin FUNCTION DFPM_DATS ""
 /begin DEF_CHARACTERISTIC CDCATS CDCATS2 CDKATS CDKATS2 CDTATS CDTATS2 CLAATS CLAATS2 FFTATS FFTATS2 TSFATS TSFATS2 /end DEF_CHARACTERISTIC
 /begin REF_CHARACTERISTIC /end REF_CHARACTERISTIC
 /begin IN_MEASUREMENT /end IN_MEASUREMENT
 /begin OUT_MEASUREMENT B_beats B_beats2 B_bkats B_bkats2 B_clats B_clats2 B_ftats B_ftats2 B_mnats B_mnats2 B_mxats B_mxats2 B_npats B_npats2 B_siats B_siats2 E_ats E_ats2 sfpats sfpats2 TYP_ats TYP_ats2 Z_ats Z_ats2 /end OUT_MEASUREMENT
 /begin LOC_MEASUREMENT /end LOC_MEASUREMENT
 /begin SUB_FUNCTION /end SUB_FUNCTION
/end FUNCTION
/begin FUNCTION DFPM_DBKVP "" /begin DEF_CHARACTERISTIC CDCBKVP CDKBKVP CDTBKVP CLABKVP FFTBKVP TSFBKVP /end DEF_CHARACTERISTIC /begin REF_CHARACTERISTIC /end REF_CHARACTERISTIC /begin IN_MEASUREMENT /end IN_MEASUREMENT
 /begin OUT_MEASUREMENT B_bebkvp B_bkbkvp B_clbkvp B_ftbkvp B_mnbkvp B_mxbkvp B_npbkvp B_sibkvp E_bkvp sfpbkvp TYP_bkvp Z_bkvp /end OUT_MEASUREMENT
 /begin LOC_MEASUREMENT /end LOC_MEASUREMENT
 /begin SUB_FUNCTION /end SUB_FUNCTION
/end FUNCTION
/begin FUNCTION DFPM_DDG ""
 /begin DEF_CHARACTERISTIC CDCBM CDCN CDKBM CDKN CDTBM CDTN CLABM CLAN FFTBM FFTN TSFBM TSFN /end DEF_CHARACTERISTIC
 /begin REF_CHARACTERISTIC /end REF_CHARACTERISTIC
 /begin IN_MEASUREMENT /end IN_MEASUREMENT
 /begin OUT_MEASUREMENT B_bebm B_ben B_bkbm B_bkn B_clbm B_cln B_ftbm B_ftn B_mnbm B_mnn B_mxbm B_mxn B_npbm B_npn B_sibm B_sin E_bm E_n sfpbm sfpn TYP_bm TYP_n Z_bm Z_n /end OUT_MEASUREMENT
 /begin LOC_MEASUREMENT /end LOC_MEASUREMENT
 /begin SUB_FUNCTION /end SUB_FUNCTION
/end FUNCTION
/begin FUNCTION DFPM_DDKV "" /begin DEF_CHARACTERISTIC CDCDKVM CDKDKVM CDTDKVM CLADKVM FFTDKVM TSFDKVM /end DEF_CHARACTERISTIC /begin REF_CHARACTERISTIC /end REF_CHARACTERISTIC /begin IN_MEASUREMENT /end IN_MEASUREMENT
 /begin OUT_MEASUREMENT B_bedkvm B_bkdkvm B_cldkvm B_ftdkvm B_mndkvm B_mxdkvm B_npdkvm B_sidkvm E_dkvm sfpdkvm TYP_dkvm Z_dkvm /end OUT_MEASUREMENT
 /begin LOC_MEASUREMENT /end LOC_MEASUREMENT
 /begin SUB_FUNCTION /end SUB_FUNCTION
/end FUNCTION
/begin COMPU_METHOD bfgrsc_ub_q0p024_o3p984 "" RAT_FUNC "%6.3" "m/s^2" COEFFS 0 1 3.984 0 0 0.024 /end COMPU_METHOD
/begin COMPU_METHOD B_TRUE "boolsche Zustände, positive Logik" TAB_VERB "%6.3" "" COMPU_TAB_REF B_TRUE /end COMPU_METHOD
/begin COMPU_VTAB B_TRUE "boolsche Zustände, positive Logik" TAB_VERB 2 0 "----" 1 "TRUE" /end COMPU_VTAB
/begin COMPU_METHOD DEZ "1 : 1 Umrechnug (dez/hex)" RAT_FUNC "%6.2" "" COEFFS 0 1 0 0 0 1 /end COMPU_METHOD
/begin COMPU_METHOD dez "1 : 1 Umrechnug (dez/hex)" RAT_FUNC "%6.2" "" COEFFS 0 1 0 0 0 1 /end COMPU_METHOD
/begin COMPU_METHOD dlw_sw_q0p04375 "" RAT_FUNC "%6.4" "°/s" COEFFS 0 32767 0 0 0 1434 /end COMPU_METHOD
/begin COMPU_METHOD fak_q0p1 "" RAT_FUNC "%6.3" "" COEFFS 0 1 0 0 0 0.1 /end COMPU_METHOD
/begin COMPU_METHOD fak_sb_b1 "" RAT_FUNC "%6.4" "-" COEFFS 0 256 0 0 0 2 /end COMPU_METHOD
/begin COMPU_METHOD fak_ub_b2 "" RAT_FUNC "%6.4" "-" COEFFS 0 256 0 0 0 2 /end COMPU_METHOD
/begin COMPU_METHOD fak_uw_b2 "" RAT_FUNC "%7.6" "-" COEFFS 0 65536 0 0 0 2 /end COMPU_METHOD
/begin COMPU_METHOD fak_uw_b4 "" RAT_FUNC "%7.6" "-" COEFFS 0 65536 0 0 0 4 /end COMPU_METHOD
/begin COMPU_METHOD fak_uw_b4_no1 "" RAT_FUNC "%6.3" "" COEFFS 0 65536 65536 0 0 4 /end COMPU_METHOD
/begin COMPU_METHOD kva_ub_q20 "" RAT_FUNC "%6.1" "L/Zyl." COEFFS 0 1 0 0 0 20 /end COMPU_METHOD
/begin COMPU_METHOD kw_q1 "" RAT_FUNC "%6.2" "°KW" COEFFS 0 1 0 0 0 1 /end COMPU_METHOD
/begin COMPU_METHOD lw_sw_q0p04375 "" RAT_FUNC "%6.4" "°" COEFFS 0 32767 0 0 0 1434 /end COMPU_METHOD
/begin COMPU_METHOD md_q0p25 "" RAT_FUNC "%6.3" "Nm" COEFFS 0 65536 0 0 0 16384 /end COMPU_METHOD
/begin COMPU_METHOD md_ub_q10 "" RAT_FUNC "%6.1" "Nm" COEFFS 0 1 0 0 0 10 /end COMPU_METHOD
/begin COMPU_METHOD m_sw_b3276p8 "" RAT_FUNC "%6.3" "kg/h" COEFFS 0 1 0 0 0 0.1 /end COMPU_METHOD
/begin COMPU_METHOD nmotg_ub_q100 "" RAT_FUNC "%6.0" "U/min/s" COEFFS 0 1 0 0 0 100 /end COMPU_METHOD
/begin COMPU_METHOD nmot_ub_q10 "" RAT_FUNC "%6.1" "U/min" COEFFS 0 1 0 0 0 10 /end COMPU_METHOD
/begin COMPU_METHOD nmot_ub_q40 "" RAT_FUNC "%6.1" "Upm" COEFFS 0 1 0 0 0 40 /end COMPU_METHOD
/begin COMPU_METHOD p_q0p2 "" RAT_FUNC "%6.3" "bar" COEFFS 0 5 0 0 0 1 /end COMPU_METHOD
/begin COMPU_METHOD p_sw_q0p039 "" RAT_FUNC "%6.4" "hPa" COEFFS 0 256 0 0 0 10 /end COMPU_METHOD
/begin COMPU_METHOD p_uw_q0p039 "" RAT_FUNC "%6.4" "hPa" COEFFS 0 256 0 0 0 10 /end COMPU_METHOD
/begin COMPU_METHOD rel_q0p25 "" RAT_FUNC "%6.3" "%/V" COEFFS 0 1 0 0 0 0.25 /end COMPU_METHOD
/begin COMPU_METHOD rel_q0p39 "" RAT_FUNC "%6.3" "%" COEFFS 0 256 0 0 0 100 /end COMPU_METHOD
/begin COMPU_METHOD rel_q0p4 "" RAT_FUNC "%6.3" "%" COEFFS 0 1 0 0 0 0.4 /end COMPU_METHOD
/begin COMPU_METHOD rel_sw_b1536 "" RAT_FUNC "%6.4" "%" COEFFS 0 65536 0 0 0 3072 /end COMPU_METHOD
/begin COMPU_METHOD rel_ub_b100 "" RAT_FUNC "%6.3" "%" COEFFS 0 256 0 0 0 100 /end COMPU_METHOD
/begin COMPU_METHOD rel_ub_b99p6 "" RAT_FUNC "%6.3" "%" COEFFS 0 256 0 0 0 100 /end COMPU_METHOD
/begin COMPU_METHOD rel_uw_b100 "" RAT_FUNC "%6.4" "%" COEFFS 0 65536 0 0 0 100 /end COMPU_METHOD
/begin COMPU_METHOD rel_uw_b728 "" RAT_FUNC "%4.2" "%/s" COEFFS 0 6.5536 0 0 0 1 /end COMPU_METHOD
/begin COMPU_METHOD r_ub_q64 "" RAT_FUNC "%6.1" "Ohm" COEFFS 0 1 0 0 0 64 /end COMPU_METHOD
/begin COMPU_METHOD spg_q1o200 "" RAT_FUNC "%6.3" "mV" COEFFS 0 1 200 0 0 1 /end COMPU_METHOD
/begin COMPU_METHOD spg_ubatt "" RAT_FUNC "%6.4" "V" COEFFS 0 1 0 0 0 0.0704 /end COMPU_METHOD
/begin COMPU_METHOD spg_ub_b5 "" RAT_FUNC "%6.4" "V" COEFFS 0 256 0 0 0 5 /end COMPU_METHOD
/begin COMPU_METHOD s_q1_km "" RAT_FUNC "%6.2" "km" COEFFS 0 1 0 0 0 1 /end COMPU_METHOD
/begin COMPU_METHOD s_q63p75 "" RAT_FUNC "%6.3" "cm" COEFFS 0 1 0 0 0 0.25 /end COMPU_METHOD
/begin COMPU_METHOD s_q6_km "" RAT_FUNC "%6.2" "km" COEFFS 0 1 0 0 0 6 /end COMPU_METHOD
/begin COMPU_METHOD t100msxms_ub_b255 "" RAT_FUNC "%6.2" "ms" COEFFS 0 1 0 0 0 1 /end COMPU_METHOD
/begin COMPU_METHOD t100msxs_ub_b25p5 "" RAT_FUNC "%6.3" "s" COEFFS 0 1 0 0 0 0.1 /end COMPU_METHOD
/begin COMPU_METHOD t10msxs_ub_b2p55 "" RAT_FUNC "%6.4" "s" COEFFS 0 1 0 0 0 0.01 /end COMPU_METHOD
/begin COMPU_METHOD t10msxs_uw_b655p35 "" RAT_FUNC "%6.4" "s" COEFFS 0 1 0 0 0 0.01 /end COMPU_METHOD
/begin COMPU_METHOD t1sxs_ub_b255 "" RAT_FUNC "%6.2" "s" COEFFS 0 1 0 0 0 1 /end COMPU_METHOD
/begin COMPU_METHOD t1sxs_uw_b65535 "" RAT_FUNC "%6.2" "s" COEFFS 0 1 0 0 0 1 /end COMPU_METHOD
/begin COMPU_METHOD t200msxs_ub_b51 "" RAT_FUNC "%6.3" "s" COEFFS 0 1 0 0 0 0.2 /end COMPU_METHOD
/begin COMPU_METHOD t200msxs_uw_q0p2 "" RAT_FUNC "%6.3" "s" COEFFS 0 1 0 0 0 0.2 /end COMPU_METHOD
/begin COMPU_METHOD t20msxs_ub_b5p1 "" RAT_FUNC "%6.4" "s" COEFFS 0 1 0 0 0 0.02 /end COMPU_METHOD
/begin COMPU_METHOD t400msxs_ub_b102 "" RAT_FUNC "%6.3" "s" COEFFS 0 1 0 0 0 0.4 /end COMPU_METHOD
/begin COMPU_METHOD temp_q0p0234_o273 "" RAT_FUNC "%6.1" "Grad C" COEFFS 0 1 273.15 0 0 0.0234375 /end COMPU_METHOD
/begin COMPU_METHOD temp_ub_q0p75_o48 "" RAT_FUNC "%6.2" "Grad C" COEFFS 0 1 48 0 0 0.75 /end COMPU_METHOD
/begin COMPU_METHOD temp_ub_q1_o40 "" RAT_FUNC "%6.2" "Grad C" COEFFS 0 1 40 0 0 1 /end COMPU_METHOD
/begin COMPU_METHOD temp_ub_q1_o60 "" RAT_FUNC "%6.2" "Grad C" COEFFS 0 1 60 0 0 1 /end COMPU_METHOD
/begin COMPU_METHOD temp_uw_q0p0195_o50 "" RAT_FUNC "%6.2" "Grad C" COEFFS 0 256 12800 0 0 5 /end COMPU_METHOD
/begin COMPU_METHOD tfst_ub_b126 "" RAT_FUNC "%6.2" "l" COEFFS 0 1 0 0 0 1 /end COMPU_METHOD
/begin COMPU_METHOD tz100msxs_uw_b3276p8 "" RAT_FUNC "%6.1" "s" COEFFS 0 0 3276.8 0 1 0 /end COMPU_METHOD
/begin COMPU_METHOD t_q4_s "" RAT_FUNC "%6.2" "s" COEFFS 0 1 0 0 0 4 /end COMPU_METHOD
/begin COMPU_METHOD uefktget_ub_b25p4 "" RAT_FUNC "%6.3" "" COEFFS 0 10 0 0 0 1 /end COMPU_METHOD
/begin COMPU_METHOD vfzgkb_uw_b655 "" RAT_FUNC "%6.4" "km/h" COEFFS 0 65536 0 0 0 655 /end COMPU_METHOD
/begin COMPU_METHOD vfzg_q1p0 "" RAT_FUNC "%6.2" "km/h" COEFFS 0 1 0 0 0 1 /end COMPU_METHOD
/begin COMPU_METHOD vfzg_ub_q1p25 "" RAT_FUNC "%6.2" "km/h" COEFFS 0 1 0 0 0 1.25 /end COMPU_METHOD
/begin COMPU_METHOD vol_q0p1_l "" RAT_FUNC "%6.3" "L" COEFFS 0 1 0 0 0 0.1 /end COMPU_METHOD
/begin COMPU_METHOD zk1sxs_uw_b65535 "" RAT_FUNC "%6.0" "s" COEFFS 0 0 65535 0 1 0 /end COMPU_METHOD
/begin COMPU_METHOD default "" RAT_FUNC "%6.2" "" COEFFS 0 1 0 0 0 1 /end COMPU_METHOD
/begin RECORD_LAYOUT KfAxUbAyUbSstxUbSstyUbWUb NO_AXIS_PTS_X 1 UBYTE NO_AXIS_PTS_Y 2 UBYTE AXIS_PTS_X 3 UBYTE INDEX_INCR DIRECT AXIS_PTS_Y 4 UBYTE INDEX_INCR DIRECT FNC_VALUES 5 UBYTE COLUMN_DIR DIRECT /end RECORD_LAYOUT
/begin RECORD_LAYOUT KlAUbSstUbWSb NO_AXIS_PTS_X 1 UBYTE AXIS_PTS_X 2 UBYTE INDEX_INCR DIRECT FNC_VALUES 3 SBYTE COLUMN_DIR DIRECT /end RECORD_LAYOUT
/begin RECORD_LAYOUT KlAUbSstUbWUb NO_AXIS_PTS_X 1 UBYTE AXIS_PTS_X 2 UBYTE INDEX_INCR DIRECT FNC_VALUES 3 UBYTE COLUMN_DIR DIRECT /end RECORD_LAYOUT
/begin RECORD_LAYOUT KlAUwSstUwWUw NO_AXIS_PTS_X 1 UWORD AXIS_PTS_X 2 UWORD INDEX_INCR DIRECT FNC_VALUES 3 UWORD COLUMN_DIR DIRECT /end RECORD_LAYOUT
/begin RECORD_LAYOUT KwbUb FNC_VALUES 1 UBYTE COLUMN_DIR DIRECT /end RECORD_LAYOUT
/begin RECORD_LAYOUT KwbUw FNC_VALUES 1 UWORD COLUMN_DIR DIRECT /end RECORD_LAYOUT
/begin RECORD_LAYOUT KwSb FNC_VALUES 1 SBYTE COLUMN_DIR DIRECT /end RECORD_LAYOUT
/begin RECORD_LAYOUT KwSw FNC_VALUES 1 SWORD COLUMN_DIR DIRECT /end RECORD_LAYOUT
/begin RECORD_LAYOUT KwUb FNC_VALUES 1 UBYTE COLUMN_DIR DIRECT /end RECORD_LAYOUT
/begin RECORD_LAYOUT KwUw FNC_VALUES 1 UWORD COLUMN_DIR DIRECT /end RECORD_LAYOUT
/end MODULE
/end PROJECT
