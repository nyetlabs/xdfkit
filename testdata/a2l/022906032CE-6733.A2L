ASAP2_VERSION 1 3
/begin PROJECT S1103A_25G5_0 "S1103A"
/begin HEADER "" VERSION "S1103A_25G5_0" PROJECT_NO S1103A_25G5_0 /end HEADER
/begin MODULE DIM ""
/begin MOD_COMMON "" BYTE_ORDER MSB_LAST ALIGNMENT_BYTE 1 ALIGNMENT_WORD 2 ALIGNMENT_LONG 2 /end MOD_COMMON
/begin CHARACTERISTIC CANVERS "" VALUE 0x8FCD66 KwUb 255.0 DEZ 0.00 255.0 FORMAT "%5.1" /end CHARACTERISTIC
/begin CHARACTERISTIC CBGRLP "" VALUE 0x8FD002 KwUb 255.0 dez 0.00 255.0 FORMAT "%5.1" /end CHARACTERISTIC
/begin CHARACTERISTIC CCMKBI "" VALUE 0x8E03D4 KwUb 25.50 vol_q0p1_l 0.00 25.50 FORMAT "%5.2" /end CHARACTERISTIC
/begin CHARACTERISTIC CWBGELSV "" VALUE 0x8E0D6B KwUb 255.0 dez 0.00 255.0 FORMAT "%5.1" /end CHARACTERISTIC
/begin CHARACTERISTIC CWBGGNSOL "" VALUE 0x8E29AC KwUb 255.0 dez 0.00 255.0 FORMAT "%5.1" /end CHARACTERISTIC
/begin CHARACTERISTIC CWBGLASO "" VALUE 0x8FD00A KwUb 255.0 dez 0.00 255.0 FORMAT "%5.1" /end CHARACTERISTIC
/begin CHARACTERISTIC CWBGMIL "" VALUE 0x8E08EF KwUb 255.0 dez 0.00 255.0 FORMAT "%5.1" /end CHARACTERISTIC
/begin CHARACTERISTIC CWBGMSZS "" VALUE 0x8FCFC7 KwUb 255.0 DEZ 0.00 255.0 FORMAT "%5.1" /end CHARACTERISTIC
/begin CHARACTERISTIC CWBGTABST "" VALUE 0x8E20AC KwUb 255.0 DEZ 0.00 255.0 FORMAT "%5.1" /end CHARACTERISTIC
/begin CHARACTERISTIC CWBGWPFGR "" VALUE 0x8E0F05 KwUb 255.0 dez 0.00 255.0 FORMAT "%5.1" /end CHARACTERISTIC
/begin CHARACTERISTIC CWBKV "" VALUE 0x8F144E KwUw 65535.00 dez 0.00 65535.00 FORMAT "%8.2" /end CHARACTERISTIC
/begin CHARACTERISTIC CWBUSOFF "" VALUE 0x8FCD67 KwUb 255.0 dez 0.00 255.0 FORMAT "%5.1" /end CHARACTERISTIC
/begin CHARACTERISTIC CWCAUVW "" VALUE 0x8FCD68 KwUb 255.0 DEZ 0.00 255.0 FORMAT "%5.1" /end CHARACTERISTIC
/begin CHARACTERISTIC CWCMOT5 "" VALUE 0x8FCD69 KwUb 255.0 DEZ 0.00 255.0 FORMAT "%5.1" /end CHARACTERISTIC
/begin CHARACTERISTIC CWCMOT7 "" VALUE 0x8FCD6A KwUb 255.0 DEZ 0.00 255.0 FORMAT "%5.1" /end CHARACTERISTIC
/begin CHARACTERISTIC CWDVEFO "" VALUE 0x8FCEA9 KwUb 255.0 dez 0.00 255.0 FORMAT "%5.1" /end CHARACTERISTIC
/begin CHARACTERISTIC CWFKMSDKA "" VALUE 0x8FCFC8 KwUb 255.0 dez 0.00 255.0 FORMAT "%5.1" /end CHARACTERISTIC
/begin CHARACTERISTIC CWGC "" VALUE 0x8FCD6B KwUb 255.0 DEZ 0.00 255.0 FORMAT "%5.1" /end CHARACTERISTIC
/begin CHARACTERISTIC CWKONGTO "" VALUE 0x8E3B04 KwUb 255.0 dez 0.00 255.0 FORMAT "%5.1" /end CHARACTERISTIC
/begin CHARACTERISTIC CWKONGTU "" VALUE 0x8FD069 KwUb 255.0 DEZ 0.00 255.0 FORMAT "%5.1" /end CHARACTERISTIC
/begin CHARACTERISTIC CWLBZAPP "" VALUE 0x8E0D78 KwUb 255.0 dez 0.00 255.0 FORMAT "%5.1" /end CHARACTERISTIC
/begin CHARACTERISTIC CWLLG "" VALUE 0x8FCD6C KwUb 255.0 DEZ 0.00 255.0 FORMAT "%5.1" /end CHARACTERISTIC
/begin CHARACTERISTIC CWLRFZA "" VALUE 0x8FD267 KwUb 255.0 dez 0.00 255.0 FORMAT "%5.1" /end CHARACTERISTIC
/begin CHARACTERISTIC CWMOTFLX "" VALUE 0x8FCD6D KwUb 255.0 DEZ 0.00 255.0 FORMAT "%5.1" /end CHARACTERISTIC
/begin CHARACTERISTIC CWOBDCAN "" VALUE 0x8FCD6E KwUb 63.00 dez 0.00 63.00 FORMAT "%5.2" /end CHARACTERISTIC
/begin CHARACTERISTIC CWPIRGAP "" VALUE 0x8E1389 KwUb 255.0 dez 0.00 255.0 FORMAT "%5.1" /end CHARACTERISTIC
/begin CHARACTERISTIC CWRBS "" VALUE 0x8FD276 KwUb 255.0 dez 0.00 255.0 FORMAT "%5.1" /end CHARACTERISTIC
/begin CHARACTERISTIC CWTEMPK "" VALUE 0x8E13A2 KwUb 255.0 dez 0.00 255.0 FORMAT "%5.1" /end CHARACTERISTIC
/begin CHARACTERISTIC CWTOELZK "" VALUE 0x8E3B09 KwUb 255.0 dez 0.00 255.0 FORMAT "%5.1" /end CHARACTERISTIC
/begin CHARACTERISTIC CW_CAN_S_0___A "" VALUE 0x8E5FA8 KwUw 65535.00 DEZ 0.00 65535.00 FORMAT "%8.2" /end CHARACTERISTIC
/begin CHARACTERISTIC CW_CAN_S_1___A "" VALUE 0x8E5FAA KwUw 65535.00 DEZ 0.00 65535.00 FORMAT "%8.2" /end CHARACTERISTIC
/begin CHARACTERISTIC DDRLDKZU "" VALUE 0x8FE182 KwSw 1535.977 rel_sw_q0p0234 -768.0000 767.9766 FORMAT "%8.4" /end CHARACTERISTIC
/begin CHARACTERISTIC DEVTMAGR "" CURVE 0x8E9B3C KlASwSstSwWSw 49151.25 temp_sw_q0p75 -24576.00 24575.25 FORMAT "%8.2"
 /begin AXIS_DESCR STD_AXIS tsges_w temp_sw_q0p75 8 -24576.00 24575.25 FORMAT "%8.2" DEPOSIT ABSOLUTE /end AXIS_DESCR
/end CHARACTERISTIC
/begin CHARACTERISTIC DFGNSOL "" VALUE 0x8EBB66 KwUw 99.99847 rel_uw_b100 0.00 99.99847 FORMAT "%8.5" /end CHARACTERISTIC
/begin CHARACTERISTIC DFKMSMN "" VALUE 0x8FE184 KwUw 3.999939 fak_uw_b4 0.00 3.999939 FORMAT "%8.6" /end CHARACTERISTIC
/begin CHARACTERISTIC DFKMSMX "" VALUE 0x8FE186 KwUw 3.999939 fak_uw_b4 0.00 3.999939 FORMAT "%8.6" /end CHARACTERISTIC
/begin CHARACTERISTIC DFKPVMN "" VALUE 0x8E9A8C KwUw 3.999939 fak_uw_b4 0.00 3.999939 FORMAT "%8.6" /end CHARACTERISTIC
/begin CHARACTERISTIC DFKPVMX "" VALUE 0x8E9A8E KwUw 3.999939 fak_uw_b4 0.00 3.999939 FORMAT "%8.6" /end CHARACTERISTIC
/begin CHARACTERISTIC DFTEDS "" VALUE 0x8EAAA6 KwSw 127.9980 fak_sw_b64 -64.00000 63.99805 FORMAT "%8.5" /end CHARACTERISTIC
/begin CHARACTERISTIC DIFFMAX "" VALUE 0x8FEF60 KwUw 2559.961 p_uw_q0p039 0.00 2559.961 FORMAT "%8.3" /end CHARACTERISTIC
/begin CHARACTERISTIC DKPSTGMIN "" VALUE 0x8FDC92 KwUw 39.99939 rel_uw_b40 0.00 39.99939 FORMAT "%8.5" /end CHARACTERISTIC
/begin CHARACTERISTIC DLBZ "" VALUE 0x8E0D79 KwUb 99.61 rel_ub_b100 0.00 99.61 FORMAT "%5.2" /end CHARACTERISTIC
/begin CHARACTERISTIC DLRPIDSTMN "" VALUE 0x8FDC94 KwUw 99.99847 rel_uw_b100 0.00 99.99847 FORMAT "%8.5" /end CHARACTERISTIC
/begin CHARACTERISTIC DMRFATE "" VALUE 0x8E1DE7 KwUb 99.61 rel_ub_b99p6 0.00 99.61 FORMAT "%5.2" /end CHARACTERISTIC
/begin CHARACTERISTIC DNWVSMN "" VALUE 0x8E89B2 KwSw 511.9922 kw_sw_q0p0078 -256.0000 255.9922 FORMAT "%8.4" /end CHARACTERISTIC
/begin CHARACTERISTIC DPBKVSPS "" VALUE 0x8F1450 KwUw 2559.961 p_uw_q0p039 0.00 2559.961 FORMAT "%8.3" /end CHARACTERISTIC
/begin CHARACTERISTIC DPBKVUKKPU "" CURVE 0x8F1452 KlAUwSstUwWUw 2559.961 p_uw_q0p039 0.00 2559.961 FORMAT "%8.3"
 /begin AXIS_DESCR STD_AXIS pubkv_w p_uw_q0p039 4 0.00 2559.961 FORMAT "%8.3" DEPOSIT ABSOLUTE /end AXIS_DESCR
/end CHARACTERISTIC
/begin CHARACTERISTIC DPBKVUKNW "" CURVE 0x8F1464 KlAUwSstUwWUw 2559.961 p_uw_q0p039 0.00 2559.961 FORMAT "%8.3"
 /begin AXIS_DESCR STD_AXIS pubkv_w p_uw_q0p039 4 0.00 2559.961 FORMAT "%8.3" DEPOSIT ABSOLUTE /end AXIS_DESCR
/end CHARACTERISTIC
/begin CHARACTERISTIC DPBKVUKP "" CURVE 0x8F1476 KlAUwSstUwWUw 2559.961 p_uw_q0p039 0.00 2559.961 FORMAT "%8.3"
 /begin AXIS_DESCR STD_AXIS pubkv_w p_uw_q0p039 4 0.00 2559.961 FORMAT "%8.3" DEPOSIT ABSOLUTE /end AXIS_DESCR
/end CHARACTERISTIC
/begin CHARACTERISTIC DPBKVUKPU "" CURVE 0x8F1488 KlAUwSstUwWUw 2559.961 p_uw_q0p039 0.00 2559.961 FORMAT "%8.3"
 /begin AXIS_DESCR STD_AXIS pubkv_w p_uw_q0p039 4 0.00 2559.961 FORMAT "%8.3" DEPOSIT ABSOLUTE /end AXIS_DESCR
/end CHARACTERISTIC
/begin CHARACTERISTIC DPBKVUS "" VALUE 0x8E3FEA KwUb 1275. p_ub_q5 0.00 1275. FORMAT "%5.0" /end CHARACTERISTIC
/begin CHARACTERISTIC DRLDYNU "" VALUE 0x8FE6A4 KwSw 767.9531 rel_sw_q0p0234 0.02343750 767.9766 FORMAT "%8.4" /end CHARACTERISTIC
/begin CHARACTERISTIC DRLMIN "" VALUE 0x8FE6A6 KwSw 1535.977 rel_sw_q0p0234 -768.0000 767.9766 FORMAT "%8.4" /end CHARACTERISTIC
/begin CHARACTERISTIC DTABOVF "" VALUE 0x8EABF2 KwUw 65535.00 t1sxs_uw_q1 0.00 65535.00 FORMAT "%8.2" /end CHARACTERISTIC
/begin CHARACTERISTIC DTABUNPL "" VALUE 0x8EABF4 KwUw 65535.00 DEZ 0.00 65535.00 FORMAT "%8.2" /end CHARACTERISTIC
/begin CHARACTERISTIC DTATMSTOL "" VALUE 0x8E3B05 KwUb 191.3 temp_ub_b191p25 0.00 191.3 FORMAT "%5.1" /end CHARACTERISTIC
/begin CHARACTERISTIC DTEPRU "" VALUE 0x8FE6A8 KwUw 209.7120 tinjection_sy 0.00 209.7120 FORMAT "%8.4" /end CHARACTERISTIC
/begin CHARACTERISTIC DTMABSTOL "" VALUE 0x8E3B06 KwUb 191.3 temp_ub_b191p25 0.00 191.3 FORMAT "%5.1" /end CHARACTERISTIC
/begin CHARACTERISTIC DTMTATUM "" VALUE 0x8E20B2 KwUb 191.3 temp_ub_b191p25 0.00 191.3 FORMAT "%5.1" /end CHARACTERISTIC
/begin CHARACTERISTIC DTMTOLOFF "" VALUE 0x8E3B07 KwUb 191.3 temp_ub_b191p25 0.00 191.3 FORMAT "%5.1" /end CHARACTERISTIC
/begin CHARACTERISTIC DUDKNLPO "" VALUE 0x8FDC96 KwUw 4.998779 spg_q1p221_mV 0.00 4.998779 FORMAT "%8.6" /end CHARACTERISTIC
/begin CHARACTERISTIC DUDKNLPU "" VALUE 0x8FDC98 KwUw 4.998779 spg_q1p221_mV 0.00 4.998779 FORMAT "%8.6" /end CHARACTERISTIC
/begin CHARACTERISTIC DUDKPTMP "" VALUE 0x8FCEAA KwUb 0.3064 spg_q1p221_mV 0.004883 0.3113 /end CHARACTERISTIC
/begin CHARACTERISTIC DVMAXTOM "" VALUE 0x8EBF10 KwUw 511.9922 vfzg_uw_q0p00781 0.00 511.9922 FORMAT "%8.4" /end CHARACTERISTIC
/begin CHARACTERISTIC DWNRFPT "" VALUE 0x8EF2BA KwSw 511.9922 kw_q0p0078 -256.0000 255.9922 FORMAT "%8.4" /end CHARACTERISTIC
/begin CHARACTERISTIC DWNSRFIX "" VALUE 0x8EF2BC KwSw 511.9922 kw_q0p0078 -256.0000 255.9922 FORMAT "%8.4" /end CHARACTERISTIC
/begin CHARACTERISTIC DWNWADRPA "" VALUE 0x8EF264 KwSw 255.9922 kw_sw_q0p0078 0.00 255.9922 FORMAT "%8.4" /end CHARACTERISTIC
/begin CHARACTERISTIC DWNWADRPE "" VALUE 0x8EF266 KwSw 255.9922 kw_sw_q0p0078 0.00 255.9922 FORMAT "%8.4" /end CHARACTERISTIC
/begin CHARACTERISTIC DWNWSKA "" VALUE 0x8EF268 KwSw 255.9922 kw_sw_q0p0078 0.00 255.9922 FORMAT "%8.4" /end CHARACTERISTIC
/begin CHARACTERISTIC DWNWSKE "" VALUE 0x8EF26A KwSw 255.9922 kw_sw_q0p0078 0.00 255.9922 FORMAT "%8.4" /end CHARACTERISTIC
/begin CHARACTERISTIC DWPR "" VALUE 0x8FD003 KwSb 1530. kw_q6 -768.0 762.0 FORMAT "%5.1" /end CHARACTERISTIC
/begin CHARACTERISTIC DWPRNSP "" VALUE 0x8FD004 KwSb 1530. kw_q6 -768.0 762.0 FORMAT "%5.1" /end CHARACTERISTIC
/begin CHARACTERISTIC EVTMODO "" CURVE 0x8E13A3 KlAUbSstUbWUb 191.3 temp_ub_q0p75_o48 -48.00 143.3 FORMAT "%5.1"
 /begin AXIS_DESCR STD_AXIS tmotfil temp_ub_q0p75_o48 12 -48.00 143.3 FORMAT "%5.1" DEPOSIT ABSOLUTE /end AXIS_DESCR
/end CHARACTERISTIC
/begin CHARACTERISTIC FDVANS "" CURVE 0x8E13BC KlAUbSstUbWUb 1.992 fak_ub_b2 0.00 1.992 FORMAT "%5.3"
 /begin AXIS_DESCR STD_AXIS tans temp_ub_q0p75_o48 8 -48.00 143.3 FORMAT "%5.1" DEPOSIT ABSOLUTE /end AXIS_DESCR
/end CHARACTERISTIC
/begin CHARACTERISTIC FGDPSMPDVS "" VALUE 0x8FD005 KwUb 0.9961 fak_ub_b1 0.00 0.9961 /end CHARACTERISTIC
/begin CHARACTERISTIC FIMLATMW "" VALUE 0x8E29AD KwUb 0.2550 m_q0p001 0.00 0.2550 FORMAT "%6.4" /end CHARACTERISTIC
/begin CHARACTERISTIC FKMSDKMN "" VALUE 0x8FE188 KwUw 3.999939 fak_uw_b4 0.00 3.999939 FORMAT "%8.6" /end CHARACTERISTIC
/begin CHARACTERISTIC FKMSDKMX "" VALUE 0x8FE18A KwUw 3.999939 fak_uw_b4 0.00 3.999939 FORMAT "%8.6" /end CHARACTERISTIC
/begin CHARACTERISTIC FKPVDKMN "" VALUE 0x8E9A90 KwUw 3.999939 fak_uw_b4 0.00 3.999939 FORMAT "%8.6" /end CHARACTERISTIC
/begin CHARACTERISTIC FKPVDKMX "" VALUE 0x8E9A92 KwUw 3.999939 fak_uw_b4 0.00 3.999939 FORMAT "%8.6" /end CHARACTERISTIC
/begin CHARACTERISTIC FLTEFUEL "" CURVE 0x8E3981 KlAUbSstUbWUb 0.9961 fak_ub_b1 0.00 0.9961 /begin AXIS_DESCR STD_AXIS qltefil fak_ub_b1 4 0.00 0.9961 DEPOSIT ABSOLUTE /end AXIS_DESCR /end CHARACTERISTIC
/begin CHARACTERISTIC FMOTC "" VALUE 0x8FCD6F KwUb 255.0 DEZ 0.00 255.0 FORMAT "%5.1" /end CHARACTERISTIC
/begin CHARACTERISTIC FMRFAZTE "" CURVE 0x8E1DE8 KlAUbSstUbWUb 3.984 fak_ub_b4 0.00 3.984 FORMAT "%5.3"
 /begin AXIS_DESCR STD_AXIS nmot nmot_ub_q40 4 0.00 10200. FORMAT "%5.0" DEPOSIT ABSOLUTE /end AXIS_DESCR
/end CHARACTERISTIC
/begin CHARACTERISTIC FPRAT "" VALUE 0x8FCEAB KwUb 191.3 temp_ub_q0p75_o48 -48.00 143.3 FORMAT "%5.1" /end CHARACTERISTIC
/begin CHARACTERISTIC FPRMT "" VALUE 0x8FCEAC KwUb 191.3 temp_ub_q0p75_o48 -48.00 143.3 FORMAT "%5.1" /end CHARACTERISTIC
/begin CHARACTERISTIC FPRNMAX "" VALUE 0x8FCEAD KwUb 2550. nmot_ub_q10 0.00 2550. FORMAT "%5.0" /end CHARACTERISTIC
/begin CHARACTERISTIC FPRTIM1_T "" VALUE 0x8FCEAE KwUb 2.540 t10msxs_ub_b2p55 0.01000 2.550 FORMAT "%5.3" /end CHARACTERISTIC
/begin CHARACTERISTIC FPRTIM2_T "" VALUE 0x8FCEAF KwUb 2.540 t10msxs_ub_b2p55 0.01000 2.550 FORMAT "%5.3" /end CHARACTERISTIC
/begin CHARACTERISTIC FPRTIM3_T "" VALUE 0x8FCEB0 KwUb 2.540 t10msxs_ub_b2p55 0.01000 2.550 FORMAT "%5.3" /end CHARACTERISTIC
/begin CHARACTERISTIC FPRTIM4_T "" VALUE 0x8FCEB1 KwUb 2.540 t10msxs_ub_b2p55 0.01000 2.550 FORMAT "%5.3" /end CHARACTERISTIC
/begin CHARACTERISTIC FPVHKMSAB "" CURVE 0x8E894A KlAUbSstUwWUw 104856.0 m_q1p6 0.00 104856.0 FORMAT "%8.1"
 /begin AXIS_DESCR STD_AXIS msabvhk_w m_uw_b6553p5 5 0.00 6553.500 FORMAT "%8.3" DEPOSIT ABSOLUTE /end AXIS_DESCR
/end CHARACTERISTIC
/begin CHARACTERISTIC FPVHKTTA "" CURVE 0x8E8960 KlAUbSstUwWUb 5100. fak_q20_hPahPa_mul_h_div_kg 0.00 5100. FORMAT "%5.0"
 /begin AXIS_DESCR STD_AXIS tkihkmm_w temp_q0p0234_o273 6 -273.1500 1262.827 FORMAT "%8.3" DEPOSIT ABSOLUTE /end AXIS_DESCR
/end CHARACTERISTIC
/begin CHARACTERISTIC FPVHKTTA2 "" CURVE 0x8E8974 KlAUbSstUwWUb 5100. fak_q20_hPahPa_mul_h_div_kg 0.00 5100. FORMAT "%5.0"
 /begin AXIS_DESCR STD_AXIS tkihkmm2_w temp_q0p0234_o273 6 -273.1500 1262.827 FORMAT "%8.3" DEPOSIT ABSOLUTE /end AXIS_DESCR
/end CHARACTERISTIC
/begin CHARACTERISTIC FPVMXP "" VALUE 0x8FE6AA KwUw 1.999969 fak_uw_b2 0.00 1.999969 FORMAT "%8.6" /end CHARACTERISTIC
/begin CHARACTERISTIC FPVMXST "" VALUE 0x8E89B4 KwUw 3.999939 fak_uw_b4 0.00 3.999939 FORMAT "%8.6" /end CHARACTERISTIC
/begin CHARACTERISTIC FPVVKMSAB "" CURVE 0x8E8988 KlAUbSstUwWUw 104856.0 m_q1p6 0.00 104856.0 FORMAT "%8.1"
 /begin AXIS_DESCR STD_AXIS msabvvk_w m_uw_b6553p5 5 0.00 6553.500 FORMAT "%8.3" DEPOSIT ABSOLUTE /end AXIS_DESCR
/end CHARACTERISTIC
/begin CHARACTERISTIC FPVVKTTA "" CURVE 0x8E899E KlAUbSstUwWUb 5100. fak_q20_hPahPa_mul_h_div_kg 0.00 5100. FORMAT "%5.0"
 /begin AXIS_DESCR STD_AXIS tkivkmm_w temp_q0p0234_o273 6 -273.1500 1262.827 FORMAT "%8.3" DEPOSIT ABSOLUTE /end AXIS_DESCR
/end CHARACTERISTIC
/begin CHARACTERISTIC FRFWNI "" VALUE 0x8EF2BE KwUw 85.33203 kwprs_q0p001302 0.00 85.33203 FORMAT "%8.5" /end CHARACTERISTIC
/begin CHARACTERISTIC FRFWNP "" VALUE 0x8EF2C0 KwUw 85.33203 kwpr_q0p001302 0.00 85.33203 FORMAT "%8.5" /end CHARACTERISTIC
/begin CHARACTERISTIC FRIRLABBR "" VALUE 0x8FE6AC KwUw 1.999969 fak_uw_b2 0.00 1.999969 FORMAT "%8.6" /end CHARACTERISTIC
/begin CHARACTERISTIC FTEADZU "" VALUE 0x8EAAA8 KwSw 127.9980 fak_sw_b64 -64.00000 63.99805 FORMAT "%8.5" /end CHARACTERISTIC
/begin CHARACTERISTIC FTEDS "" VALUE 0x8EAAAA KwSw 127.9980 fak_sw_b64 -64.00000 63.99805 FORMAT "%8.5" /end CHARACTERISTIC
/begin CHARACTERISTIC FUMRMV "" VALUE 0x8E398A KwUb 1.992 dichte_ub_b2 0.00 1.992 FORMAT "%5.3" /end CHARACTERISTIC
/begin CHARACTERISTIC FUMSTEK "" VALUE 0x8E398B KwUb 0.5000 fak_ub_b2 0.00 0.5000 /end CHARACTERISTIC
/begin CHARACTERISTIC FUPSRLMN "" VALUE 0x8E89B6 KwUw 0.2999954 rel_uw_b0p3 0.00 0.2999954 FORMAT "%9.7" /end CHARACTERISTIC
/begin CHARACTERISTIC FUPSRLMX "" VALUE 0x8E89B8 KwUw 0.2999954 rel_uw_b0p3 0.00 0.2999954 FORMAT "%9.7" /end CHARACTERISTIC
/begin CHARACTERISTIC FWFTBRTA "" CURVE 0x8E13CD KlAUbSstUbWUb 1.992 fak_ub_b2 0.00 1.992 FORMAT "%5.3"
 /begin AXIS_DESCR STD_AXIS tempin temp_ub_q0p75_o48 14 -48.00 143.3 FORMAT "%5.1" DEPOSIT ABSOLUTE /end AXIS_DESCR
/end CHARACTERISTIC
/begin CHARACTERISTIC FWLKFTBR "" CURVE 0x8E13EA KlAUbSstUbWUb 1.992 fak_ub_b2 0.00 1.992 FORMAT "%5.3"
 /begin AXIS_DESCR STD_AXIS tmotdif temp_ub_q0p75_o48 8 -48.00 143.3 FORMAT "%5.1" DEPOSIT ABSOLUTE /end AXIS_DESCR
/end CHARACTERISTIC
/begin CHARACTERISTIC FWNWVSAP "" VALUE 0x8E89BA KwUw 1.000000 fak_uw_b2 0.00 1.000000 FORMAT "%8.6" /end CHARACTERISTIC
/begin CHARACTERISTIC FWNWVSO "" VALUE 0x8E89BC KwUw 1.000000 fak_uw_b2 0.00 1.000000 FORMAT "%8.6" /end CHARACTERISTIC
/begin CHARACTERISTIC FWNWVSU "" VALUE 0x8E89BE KwUw 1.000000 fak_uw_b2 0.00 1.000000 FORMAT "%8.6" /end CHARACTERISTIC
/begin CHARACTERISTIC HYNMOTNW "" VALUE 0x8E3A87 KwUb 10200. nmot_ub_q40 0.00 10200. FORMAT "%5.0" /end CHARACTERISTIC
/begin CHARACTERISTIC HYRLNW "" VALUE 0x8EF26C KwUw 1535.977 rel_uw_q0p0234 0.00 1535.977 FORMAT "%8.3" /end CHARACTERISTIC
/begin CHARACTERISTIC IMTUMTA "" VALUE 0x8EAC4C KwUw 23.30133 m_uw_b23p3 0.00 23.30133 FORMAT "%8.5" /end CHARACTERISTIC
/begin CHARACTERISTIC KAFLTESG "" VALUE 0x8EEC9E KwUw 28.79956 fak1_q4p3945Em4 0.00 28.79956 FORMAT "%8.5" /end CHARACTERISTIC
/begin CHARACTERISTIC KFAFTE "" MAP 0x8E398C KfAxUbAyUbSstxUbSstyUbWUb 1.984 fak_ub_b2 0.007813 1.992 FORMAT "%5.3"
 /begin AXIS_DESCR STD_AXIS nmot nmot_ub_q40 10 0.00 10200. FORMAT "%5.0" DEPOSIT ABSOLUTE /end AXIS_DESCR
 /begin AXIS_DESCR STD_AXIS wdkbate relDK_ub_b100 10 0.00 100.0 FORMAT "%5.1" DEPOSIT ABSOLUTE /end AXIS_DESCR
/end CHARACTERISTIC
/begin CHARACTERISTIC KFDFBTMN "" MAP 0x8E9B5E KfAxUbAyUbSstxUwSstyUbWUb 1.992 fak_ub_b2 0.00 1.992 FORMAT "%5.3"
 /begin AXIS_DESCR STD_AXIS tabgm_w temp_uw_q0p0195_o50 6 -50.00000 1229.980 FORMAT "%8.3" DEPOSIT ABSOLUTE /end AXIS_DESCR
 /begin AXIS_DESCR STD_AXIS nmot nmot_ub_q40 8 0.00 10200. FORMAT "%5.0" DEPOSIT ABSOLUTE /end AXIS_DESCR
/end CHARACTERISTIC
/begin CHARACTERISTIC KFDFBTMP "" MAP 0x8E9BA4 KfAxUbAyUbSstxUwSstyUbWUb 1.992 fak_ub_b2 0.00 1.992 FORMAT "%5.3"
 /begin AXIS_DESCR STD_AXIS tabgm_w temp_uw_q0p0195_o50 6 -50.00000 1229.980 FORMAT "%8.3" DEPOSIT ABSOLUTE /end AXIS_DESCR
 /begin AXIS_DESCR STD_AXIS nmot nmot_ub_q40 8 0.00 10200. FORMAT "%5.0" DEPOSIT ABSOLUTE /end AXIS_DESCR
/end CHARACTERISTIC
/begin CHARACTERISTIC KFFUPSRLK "" MAP 0x8E89C0 KfAxUwAyUwSstxUwSstyUwWUw 1.999969 fak_uw_b2 0.00 1.999969 FORMAT "%8.6"
 /begin AXIS_DESCR STD_AXIS rlfg_w rel_uw_q0p0234 12 0.00 1535.977 FORMAT "%8.3" DEPOSIT ABSOLUTE /end AXIS_DESCR
 /begin AXIS_DESCR STD_AXIS nmot_w nmot_uw_q0p25 12 0.00 16383.75 FORMAT "%8.2" DEPOSIT ABSOLUTE /end AXIS_DESCR
/end CHARACTERISTIC
/begin CHARACTERISTIC KFFWTBR "" MAP 0x8E13FB KfAxUbAyUbSstxUbSstyUbWUb 1.992 fak_ub_b2 0.00 1.992 FORMAT "%5.3"
 /begin AXIS_DESCR STD_AXIS rl rel_ub_q0p75 10 0.00 191.3 FORMAT "%5.1" DEPOSIT ABSOLUTE /end AXIS_DESCR
 /begin AXIS_DESCR STD_AXIS nmot nmot_ub_q40 8 0.00 10200. FORMAT "%5.0" DEPOSIT ABSOLUTE /end AXIS_DESCR
/end CHARACTERISTIC
/begin CHARACTERISTIC KFGNSOL "" MAP 0x8EBB68 KfAxUbAyUbSstxUwSstyUbWUb 99.61 rel_ub_b99p6 0.00 99.61 FORMAT "%5.2"
 /begin AXIS_DESCR STD_AXIS imlatmw_w m_uw_b23p3 6 0.00 23.30133 FORMAT "%8.5" DEPOSIT ABSOLUTE /end AXIS_DESCR
 /begin AXIS_DESCR STD_AXIS tmst temp_ub_q0p75_o48 6 -48.00 143.3 FORMAT "%5.1" DEPOSIT ABSOLUTE /end AXIS_DESCR
/end CHARACTERISTIC
/begin CHARACTERISTIC KFKOMABNPU "" MAP 0x8F149A KfAxUwAyUwSstxUwSstyUwWUw 199.9969 rel_uw_b200 0.00 199.9969 FORMAT "%8.4"
 /begin AXIS_DESCR STD_AXIS nmot_w nmot_uw_q0p25 4 0.00 16383.75 FORMAT "%8.2" DEPOSIT ABSOLUTE /end AXIS_DESCR
 /begin AXIS_DESCR STD_AXIS fho_w fak_uw_b4 3 0.00 3.999939 FORMAT "%8.6" DEPOSIT ABSOLUTE /end AXIS_DESCR
/end CHARACTERISTIC
/begin CHARACTERISTIC KFLAMSLS "" MAP 0x8E350F KfAxUbAyUbSstxUbSstyUbWUb 1.992 fak_ub_b2 0.00 1.992 FORMAT "%5.3"
 /begin AXIS_DESCR STD_AXIS nmot nmot_ub_q40 8 0.00 10200. FORMAT "%5.0" DEPOSIT ABSOLUTE /end AXIS_DESCR
 /begin AXIS_DESCR STD_AXIS rl rel_ub_q0p75 8 0.00 191.3 FORMAT "%5.1" DEPOSIT ABSOLUTE /end AXIS_DESCR
/end CHARACTERISTIC
/begin CHARACTERISTIC KFLRST "" MAP 0x8EDCE6 KfAxUwAyUwSstxUwSstyUwWUw 327.67000000 tz10msxs_uw_b327p68 0.010000000000 327.68000000 FORMAT "%12.8"
 /begin AXIS_DESCR STD_AXIS nmot_w nmot_uw_q0p25 7 0.00 16383.75 FORMAT "%8.2" DEPOSIT ABSOLUTE /end AXIS_DESCR
 /begin AXIS_DESCR STD_AXIS rl_w rel_uw_q0p0234 8 0.00 1535.977 FORMAT "%8.3" DEPOSIT ABSOLUTE /end AXIS_DESCR
/end CHARACTERISTIC
/begin CHARACTERISTIC KFLRST2 "" MAP 0x8EDD78 KfAxUwAyUwSstxUwSstyUwWUw 327.67000000 tz10msxs_uw_b327p68 0.010000000000 327.68000000 FORMAT "%12.8"
 /begin AXIS_DESCR STD_AXIS nmot_w nmot_uw_q0p25 7 0.00 16383.75 FORMAT "%8.2" DEPOSIT ABSOLUTE /end AXIS_DESCR
 /begin AXIS_DESCR STD_AXIS rl_w rel_uw_q0p0234 8 0.00 1535.977 FORMAT "%8.3" DEPOSIT ABSOLUTE /end AXIS_DESCR
/end CHARACTERISTIC
/begin CHARACTERISTIC KFLRSZ "" MAP 0x8EDE0A KfAxUwAyUwSstxUwSstyUwWUw 655.34999985 zk10msxs_uw_b655 0.010000152590 655.36000000 FORMAT "%12.8"
 /begin AXIS_DESCR STD_AXIS nmot_w nmot_uw_q0p25 7 0.00 16383.75 FORMAT "%8.2" DEPOSIT ABSOLUTE /end AXIS_DESCR
 /begin AXIS_DESCR STD_AXIS rl_w rel_uw_q0p0234 8 0.00 1535.977 FORMAT "%8.3" DEPOSIT ABSOLUTE /end AXIS_DESCR
/end CHARACTERISTIC
/begin CHARACTERISTIC KFLRSZ2 "" MAP 0x8EDE9C KfAxUwAyUwSstxUwSstyUwWUw 655.34999985 zk10msxs_uw_b655 0.010000152590 655.36000000 FORMAT "%12.8"
 /begin AXIS_DESCR STD_AXIS nmot_w nmot_uw_q0p25 7 0.00 16383.75 FORMAT "%8.2" DEPOSIT ABSOLUTE /end AXIS_DESCR
 /begin AXIS_DESCR STD_AXIS rl_w rel_uw_q0p0234 8 0.00 1535.977 FORMAT "%8.3" DEPOSIT ABSOLUTE /end AXIS_DESCR
/end CHARACTERISTIC
/begin CHARACTERISTIC KFMSNWDK "" MAP 0x8FE18C KfAxUwAyUwSstxUwSstyUwWUw 6553.500 m_uw_b6553p5 0.00 6553.500 FORMAT "%8.3"
 /begin AXIS_DESCR STD_AXIS wdkbab_w rel_uw_b100 16 0.00 99.99847 FORMAT "%8.5" DEPOSIT ABSOLUTE /end AXIS_DESCR
 /begin AXIS_DESCR STD_AXIS nmot_w nmot_uw_q0p25 6 0.00 16383.75 FORMAT "%8.2" DEPOSIT ABSOLUTE /end AXIS_DESCR
/end CHARACTERISTIC
/begin CHARACTERISTIC KFNWADA "" MAP 0x8E3A88 KfAxUbAyUbSstxUbSstyUbWUb 255.0 dez 0.00 255.0 FORMAT "%5.1"
 /begin AXIS_DESCR STD_AXIS nmotkf nmot_ub_q40 4 0.00 10200. FORMAT "%5.0" DEPOSIT ABSOLUTE /end AXIS_DESCR
 /begin AXIS_DESCR STD_AXIS rlnwkf rel_ub_q0p75 4 0.00 191.3 FORMAT "%5.1" DEPOSIT ABSOLUTE /end AXIS_DESCR
/end CHARACTERISTIC
/begin CHARACTERISTIC KFNWADE "" MAP 0x8E3AA2 KfAxUbAyUbSstxUbSstyUbWUb 255.0 dez 0.00 255.0 FORMAT "%5.1"
 /begin AXIS_DESCR STD_AXIS nmotkf nmot_ub_q40 4 0.00 10200. FORMAT "%5.0" DEPOSIT ABSOLUTE /end AXIS_DESCR
 /begin AXIS_DESCR STD_AXIS rlnwkf rel_ub_q0p75 4 0.00 191.3 FORMAT "%5.1" DEPOSIT ABSOLUTE /end AXIS_DESCR
/end CHARACTERISTIC
/begin CHARACTERISTIC KFNWADGA "" MAP 0x8E3ABC KfAxUbAyUbSstxUbSstyUbWUb 255.0 dez 0.00 255.0 FORMAT "%5.1"
 /begin AXIS_DESCR STD_AXIS nmotkf nmot_ub_q40 4 0.00 10200. FORMAT "%5.0" DEPOSIT ABSOLUTE /end AXIS_DESCR
 /begin AXIS_DESCR STD_AXIS rlnwkf rel_ub_q0p75 4 0.00 191.3 FORMAT "%5.1" DEPOSIT ABSOLUTE /end AXIS_DESCR
/end CHARACTERISTIC
/begin CHARACTERISTIC KFNWADGE "" MAP 0x8E3AD6 KfAxUbAyUbSstxUbSstyUbWUb 255.0 dez 0.00 255.0 FORMAT "%5.1"
 /begin AXIS_DESCR STD_AXIS nmotkf nmot_ub_q40 4 0.00 10200. FORMAT "%5.0" DEPOSIT ABSOLUTE /end AXIS_DESCR
 /begin AXIS_DESCR STD_AXIS rlnwkf rel_ub_q0p75 4 0.00 191.3 FORMAT "%5.1" DEPOSIT ABSOLUTE /end AXIS_DESCR
/end CHARACTERISTIC
/begin CHARACTERISTIC KFPIRGRES "" MAP 0x8E8B14 KfAxUwAyUwSstxSwSstyUwWUw 2559.961 p_uw_q0p039 0.00 2559.961 FORMAT "%8.3"
 /begin AXIS_DESCR STD_AXIS wnwspue_w kw_q0p0078 7 -256.0000 255.9922 FORMAT "%8.4" DEPOSIT ABSOLUTE /end AXIS_DESCR
 /begin AXIS_DESCR STD_AXIS nmot_w nmot_uw_q0p25 14 0.00 16383.75 FORMAT "%8.2" DEPOSIT ABSOLUTE /end AXIS_DESCR
/end CHARACTERISTIC
/begin CHARACTERISTIC KFPRGA "" MAP 0x8E8C06 KfAxUwAyUwSstxUwSstyUwWUw 2559.961 p_uw_q0p039 0.00 2559.961 FORMAT "%8.3"
 /begin AXIS_DESCR STD_AXIS wnwvu_w kw_q0p0078 10 0.00 511.9922 FORMAT "%8.4" DEPOSIT ABSOLUTE /end AXIS_DESCR
 /begin AXIS_DESCR STD_AXIS nmot_w nmot_uw_q0p25 14 0.00 16383.75 FORMAT "%8.2" DEPOSIT ABSOLUTE /end AXIS_DESCR
/end CHARACTERISTIC
/begin CHARACTERISTIC KFPRGE "" MAP 0x8E8D52 KfAxUwAyUwSstxUwSstyUwWUw 2559.961 p_uw_q0p039 0.00 2559.961 FORMAT "%8.3"
 /begin AXIS_DESCR STD_AXIS wnwvu_w kw_q0p0078 10 0.00 511.9922 FORMAT "%8.4" DEPOSIT ABSOLUTE /end AXIS_DESCR
 /begin AXIS_DESCR STD_AXIS nmot_w nmot_uw_q0p25 14 0.00 16383.75 FORMAT "%8.2" DEPOSIT ABSOLUTE /end AXIS_DESCR
/end CHARACTERISTIC
/begin CHARACTERISTIC KFPRGSUA "" MAP 0x8E8E9E KfAxUwAyUwSstxUwSstyUwWUw 2559.961 p_uw_q0p039 0.00 2559.961 FORMAT "%8.3"
 /begin AXIS_DESCR STD_AXIS wnwvu_w kw_q0p0078 10 0.00 511.9922 FORMAT "%8.4" DEPOSIT ABSOLUTE /end AXIS_DESCR
 /begin AXIS_DESCR STD_AXIS nmot_w nmot_uw_q0p25 14 0.00 16383.75 FORMAT "%8.2" DEPOSIT ABSOLUTE /end AXIS_DESCR
/end CHARACTERISTIC
/begin CHARACTERISTIC KFPRGSUE "" MAP 0x8E8FEA KfAxUwAyUwSstxUwSstyUwWUw 2559.961 p_uw_q0p039 0.00 2559.961 FORMAT "%8.3"
 /begin AXIS_DESCR STD_AXIS wnwvu_w kw_q0p0078 10 0.00 511.9922 FORMAT "%8.4" DEPOSIT ABSOLUTE /end AXIS_DESCR
 /begin AXIS_DESCR STD_AXIS nmot_w nmot_uw_q0p25 14 0.00 16383.75 FORMAT "%8.2" DEPOSIT ABSOLUTE /end AXIS_DESCR
/end CHARACTERISTIC
/begin CHARACTERISTIC KFUPSRLKNW "" MAP 0x8E9136 KfAxUwAyUwSstxUwSstyUwWUw 1.999969 fak_uw_b2 0.00 1.999969 FORMAT "%8.6"
 /begin AXIS_DESCR STD_AXIS rlfg_w rel_uw_q0p0234 12 0.00 1535.977 FORMAT "%8.3" DEPOSIT ABSOLUTE /end AXIS_DESCR
 /begin AXIS_DESCR STD_AXIS nmot_w nmot_uw_q0p25 12 0.00 16383.75 FORMAT "%8.2" DEPOSIT ABSOLUTE /end AXIS_DESCR
/end CHARACTERISTIC
/begin CHARACTERISTIC KFURLA "" MAP 0x8E928A KfAxUwAyUwSstxUwSstyUwWUw 0.2999954 rel_uw_b0p3 0.00 0.2999954 FORMAT "%9.7"
 /begin AXIS_DESCR STD_AXIS wnwvu_w kw_q0p0078 10 0.00 511.9922 FORMAT "%8.4" DEPOSIT ABSOLUTE /end AXIS_DESCR
 /begin AXIS_DESCR STD_AXIS nmot_w nmot_uw_q0p25 14 0.00 16383.75 FORMAT "%8.2" DEPOSIT ABSOLUTE /end AXIS_DESCR
/end CHARACTERISTIC
/begin CHARACTERISTIC KFURLE "" MAP 0x8E93D6 KfAxUwAyUwSstxUwSstyUwWUw 0.2999954 rel_uw_b0p3 0.00 0.2999954 FORMAT "%9.7"
 /begin AXIS_DESCR STD_AXIS wnwvu_w kw_q0p0078 10 0.00 511.9922 FORMAT "%8.4" DEPOSIT ABSOLUTE /end AXIS_DESCR
 /begin AXIS_DESCR STD_AXIS nmot_w nmot_uw_q0p25 14 0.00 16383.75 FORMAT "%8.2" DEPOSIT ABSOLUTE /end AXIS_DESCR
/end CHARACTERISTIC
/begin CHARACTERISTIC KFURLSUA "" MAP 0x8E9522 KfAxUwAyUwSstxUwSstyUwWUw 0.2999954 rel_uw_b0p3 0.00 0.2999954 FORMAT "%9.7"
 /begin AXIS_DESCR STD_AXIS wnwvu_w kw_q0p0078 10 0.00 511.9922 FORMAT "%8.4" DEPOSIT ABSOLUTE /end AXIS_DESCR
 /begin AXIS_DESCR STD_AXIS nmot_w nmot_uw_q0p25 14 0.00 16383.75 FORMAT "%8.2" DEPOSIT ABSOLUTE /end AXIS_DESCR
/end CHARACTERISTIC
/begin CHARACTERISTIC KFURLSUE "" MAP 0x8E966E KfAxUwAyUwSstxUwSstyUwWUw 0.2999954 rel_uw_b0p3 0.00 0.2999954 FORMAT "%9.7"
 /begin AXIS_DESCR STD_AXIS wnwvu_w kw_q0p0078 10 0.00 511.9922 FORMAT "%8.4" DEPOSIT ABSOLUTE /end AXIS_DESCR
 /begin AXIS_DESCR STD_AXIS nmot_w nmot_uw_q0p25 14 0.00 16383.75 FORMAT "%8.2" DEPOSIT ABSOLUTE /end AXIS_DESCR
/end CHARACTERISTIC
/begin CHARACTERISTIC KFWPFGR "" MAP 0x8E85E4 KfAxUwAyUwSstxUwSstyUwWUw 99.99847 rel_uw_b100 0.00 99.99847 FORMAT "%8.5"
 /begin AXIS_DESCR STD_AXIS mrfgr_w rel_uw_b200 16 0.00 199.9969 FORMAT "%8.4" DEPOSIT ABSOLUTE /end AXIS_DESCR
 /begin AXIS_DESCR STD_AXIS nmot_w nmot_uw_q0p25 12 0.00 16383.75 FORMAT "%8.2" DEPOSIT ABSOLUTE /end AXIS_DESCR
/end CHARACTERISTIC
/begin CHARACTERISTIC KIMSALL "" VALUE 0x8E9A94 KwUw 2559.0000000 mk1sxs_b2560 1.0000000000 2560.0000000 FORMAT "%12.7" /end CHARACTERISTIC
/begin CHARACTERISTIC KISRM "" VALUE 0x8E97BA KwUw 0.9999847 fak_uw_b1 0.00 0.9999847 FORMAT "%9.7" /end CHARACTERISTIC
/begin CHARACTERISTIC KISRMSU "" VALUE 0x8E97BC KwUw 0.9999847 fak_uw_b1 0.00 0.9999847 FORMAT "%9.7" /end CHARACTERISTIC
/begin CHARACTERISTIC KLAF "" CURVE 0x8FE27C FklWUw 0.9999847 fak_uw_b1 0.00 0.9999847 FORMAT "%9.7"
 /begin AXIS_DESCR FIX_AXIS klaf_kge fak_uw_q0p001 501 0.5000000 1.000000 FORMAT "%8.6" FIX_AXIS_PAR 500 0 501 /end AXIS_DESCR
/end CHARACTERISTIC
/begin CHARACTERISTIC KLAFTE "" CURVE 0x8EECA0 KlAUwSstUwWUw 1.999969 fak_uw_b2 0.00 1.999969 FORMAT "%8.6"
 /begin AXIS_DESCR STD_AXIS pspvdk_w fak_uw_b2 14 0.00 1.999969 FORMAT "%8.6" DEPOSIT ABSOLUTE /end AXIS_DESCR
/end CHARACTERISTIC
/begin CHARACTERISTIC KLDTUMTA "" CURVE 0x8EAC4E KlAUbSstUbWSb 191.3 temp_sb_q0p75 -96.00 95.25 FORMAT "%5.2"
 /begin AXIS_DESCR STD_AXIS tans temp_ub_q0p75_o48 4 -48.00 143.3 FORMAT "%5.1" DEPOSIT ABSOLUTE /end AXIS_DESCR
/end CHARACTERISTIC
/begin CHARACTERISTIC KLFAKTABGM "" CURVE 0x8E9BEA KlAUwSstUwWUw 1.999969 fak_uw_b2 0.00 1.999969 FORMAT "%8.6"
 /begin AXIS_DESCR STD_AXIS vpspabna_w fak_uw_b2 6 0.00 1.999969 FORMAT "%8.6" DEPOSIT ABSOLUTE /end AXIS_DESCR
/end CHARACTERISTIC
/begin CHARACTERISTIC KLPRGAGPS "" CURVE 0x8E97BE KlAUwSstUwWUw 1.999969 fak_uw_b2 0.00 1.999969 FORMAT "%8.6"
 /begin AXIS_DESCR STD_AXIS vpspanav_w fak_uw_b2 8 0.00 1.999969 FORMAT "%8.6" DEPOSIT ABSOLUTE /end AXIS_DESCR
/end CHARACTERISTIC
/begin CHARACTERISTIC KLRLNMXN "" CURVE 0x8E9C82 KlAUbSstUwWUw 1535.977 rel_uw_q0p0234 0.00 1535.977 FORMAT "%8.3"
 /begin AXIS_DESCR STD_AXIS nmot_w nmot_uw_q0p25 11 0.00 16383.75 FORMAT "%8.2" DEPOSIT ABSOLUTE /end AXIS_DESCR
/end CHARACTERISTIC
/begin CHARACTERISTIC KMLTESG "" VALUE 0x8EECDA KwUw 1.066650 fak1_q1p63Em5 0.00 1.066650 FORMAT "%8.6" /end CHARACTERISTIC
/begin CHARACTERISTIC KUMSRL "" VALUE 0x8FCFC9 KwUb 0.00199218750 kumsrl_ub_b0p002 0.00 0.00199218750 FORMAT "%13.11" /end CHARACTERISTIC
/begin CHARACTERISTIC KVNPZ "" VALUE 0x8FCD70 KwUb 5100. kva_ub_q20 0.00 5100. FORMAT "%5.0" /end CHARACTERISTIC
/begin CHARACTERISTIC LALIO "" CURVE 0x8EDC80 KlAUwSstSwWUw 15.99976 fak_uw_b16 0.00 15.99976 FORMAT "%8.5"
 /begin AXIS_DESCR STD_AXIS o2adap_w relO2_q9p765Em4 25 -32.00000 31.99902 FORMAT "%8.5" DEPOSIT ABSOLUTE /end AXIS_DESCR
/end CHARACTERISTIC
/begin CHARACTERISTIC LAMGAINMN "" VALUE 0x8FECE8 KwUw 15.99976 fak_uw_b16 0.00 15.99976 FORMAT "%8.5" /end CHARACTERISTIC
/begin CHARACTERISTIC LAMGAINMX "" VALUE 0x8FECEA KwUw 15.99976 fak_uw_b16 0.00 15.99976 FORMAT "%8.5" /end CHARACTERISTIC
/begin CHARACTERISTIC LASTCMN "" VALUE 0x8FE6AE KwUw 15.99976 fak_uw_b16 0.00 15.99976 FORMAT "%8.5" /end CHARACTERISTIC
/begin CHARACTERISTIC LASTCMX "" VALUE 0x8FE6B0 KwUw 15.99976 fak_uw_b16 0.00 15.99976 FORMAT "%8.5" /end CHARACTERISTIC
/begin CHARACTERISTIC LNXQTM "" CURVE 0x8EABF6 KlAUbSstUwWUw 3.999939 fak_uw_b4 0.00 3.999939 FORMAT "%8.6"
 /begin AXIS_DESCR STD_AXIS xqtm_w fak_uw_b16 12 0.00 15.99976 FORMAT "%8.5" DEPOSIT ABSOLUTE /end AXIS_DESCR
/end CHARACTERISTIC
/begin CHARACTERISTIC LRNST1_T "" VALUE 0x8FCEB2 KwUb 5.080 t20msxs_ub_b5p1 0.02000 5.100 FORMAT "%5.3" /end CHARACTERISTIC
/begin CHARACTERISTIC LRNST3_T "" VALUE 0x8FCEB3 KwUb 5.080 t20msxs_ub_b5p1 0.02000 5.100 FORMAT "%5.3" /end CHARACTERISTIC
/begin CHARACTERISTIC LRNST7_T "" VALUE 0x8FCEB4 KwUb 5.080 t20msxs_ub_b5p1 0.02000 5.100 FORMAT "%5.3" /end CHARACTERISTIC
/begin CHARACTERISTIC LRNST9_T "" VALUE 0x8FCEB5 KwUb 5.080 t20msxs_ub_b5p1 0.02000 5.100 FORMAT "%5.3" /end CHARACTERISTIC
/begin CHARACTERISTIC LRNVB_T "" VALUE 0x8FDC9A KwUw 1310.700 t20msxs_uw_q0p02 0.00 1310.700 FORMAT "%8.3" /end CHARACTERISTIC
/begin CHARACTERISTIC LRSMODMS "" CURVE 0x8EDF2E KlAUwSstUwWUb 0.249023438 fak_ub_b0p25 0.00 0.249023438 FORMAT "%11.9"
 /begin AXIS_DESCR STD_AXIS msabmod_w m_uw_b6553p5 6 0.00 6553.500 FORMAT "%8.3" DEPOSIT ABSOLUTE /end AXIS_DESCR
/end CHARACTERISTIC
/begin CHARACTERISTIC LRSTPZA "" VALUE 0x8FECEE KwUw 655.3500 t10msxs_uw_b655p35 0.00 655.3500 FORMAT "%8.4" /end CHARACTERISTIC
/begin CHARACTERISTIC MDMAXKBI "" VALUE 0x8FCD71 KwUb 2550. md_ub_q10 0.00 2550. FORMAT "%5.0" /end CHARACTERISTIC
/begin CHARACTERISTIC MDNORM "" VALUE 0x8FCD72 KwUb 2550. md_ub_q10 0.00 2550. FORMAT "%5.0" /end CHARACTERISTIC
/begin CHARACTERISTIC MLFKMSDK "" VALUE 0x8FE666 KwUw 6553.500 m_uw_b6553p5 0.00 6553.500 FORMAT "%8.3" /end CHARACTERISTIC
/begin CHARACTERISTIC MOTTYP "" VALUE 0x8FCD73 KwUb 255.0 DEZ 0.00 255.0 FORMAT "%5.1" /end CHARACTERISTIC
/begin CHARACTERISTIC MRFABNTE "" VALUE 0x8E1DF1 KwUb 99.61 rel_ub_b99p6 0.00 99.61 FORMAT "%5.2" /end CHARACTERISTIC
/begin CHARACTERISTIC MRFAMXKAHY "" VALUE 0x8F14C4 KwUw 199.9969 rel_uw_b200 0.00 199.9969 FORMAT "%8.4" /end CHARACTERISTIC
/begin CHARACTERISTIC MSALLMN "" VALUE 0x8E9A96 KwUw 6553.500 m_uw_b6553p5 0.00 6553.500 FORMAT "%8.3" /end CHARACTERISTIC
/begin CHARACTERISTIC MSALLMX "" VALUE 0x8E9A98 KwUw 6553.500 m_uw_b6553p5 0.00 6553.500 FORMAT "%8.3" /end CHARACTERISTIC
/begin CHARACTERISTIC MSLG "" VALUE 0x8E9A9A KwUw 6553.500 m_uw_b6553p5 0.00 6553.500 FORMAT "%8.3" /end CHARACTERISTIC
/begin CHARACTERISTIC MSNTATE "" CURVE 0x8EECDC KlAUwSstUwWUw 25.59961 m_uw_b25p6 0.00 25.59961 FORMAT "%8.5"
 /begin AXIS_DESCR STD_AXIS tateist_w rel_uw_b100 10 0.00 99.99847 FORMAT "%8.5" DEPOSIT ABSOLUTE /end AXIS_DESCR
/end CHARACTERISTIC
/begin CHARACTERISTIC MSNTEVO "" VALUE 0x8EED06 KwUw 25.59961 m_uw_b25p6 0.00 25.59961 FORMAT "%8.5" /end CHARACTERISTIC
/begin CHARACTERISTIC MXFLAD "" VALUE 0x8E3AF0 KwUb 255.0 dez 0.00 255.0 FORMAT "%5.1" /end CHARACTERISTIC
/begin CHARACTERISTIC NDYDAMPF "" VALUE 0x8E5FA4 KwUw 16383.75 nmot_uw_q0p25 0.00 16383.75 FORMAT "%8.2" /end CHARACTERISTIC
/begin CHARACTERISTIC NLPST1T "" VALUE 0x8FCEB6 KwUb 2.540 t10msxs_ub_b2p55 0.01000 2.550 FORMAT "%5.3" /end CHARACTERISTIC
/begin CHARACTERISTIC NLPST2T "" VALUE 0x8FCEB7 KwUb 2.540 t10msxs_ub_b2p55 0.01000 2.550 FORMAT "%5.3" /end CHARACTERISTIC
/begin CHARACTERISTIC NMAXKBI "" VALUE 0x8FCD74 KwUb 25500. nmot_ub_q100 0.00 25500. FORMAT "%5.0" /end CHARACTERISTIC
/begin CHARACTERISTIC NNSTA "" CURVE 0x8E3704 KlAUbSstUbWUb 10200. nmot_ub_q40 0.00 10200. FORMAT "%5.0"
 /begin AXIS_DESCR STD_AXIS tans temp_ub_q0p75_o48 3 -48.00 143.3 FORMAT "%5.1" DEPOSIT ABSOLUTE /end AXIS_DESCR
/end CHARACTERISTIC
/begin CHARACTERISTIC NSTNM "" CURVE 0x8E370B KlAUbSstUbWUb 10200. nmot_ub_q40 0.00 10200. FORMAT "%5.0"
 /begin AXIS_DESCR STD_AXIS tmot temp_ub_q0p75_o48 3 -48.00 143.3 FORMAT "%5.1" DEPOSIT ABSOLUTE /end AXIS_DESCR
/end CHARACTERISTIC
/begin CHARACTERISTIC NTUMTA "" VALUE 0x8E20B3 KwUb 10200. nmot_ub_q40 0.00 10200. FORMAT "%5.0" /end CHARACTERISTIC
/begin CHARACTERISTIC OFFIMLATMW "" VALUE 0x8E29AE KwUb 5.000 m_ub_b5 0.00 5.000 FORMAT "%5.3" /end CHARACTERISTIC
/begin CHARACTERISTIC OPBKVUKKB "" VALUE 0x8F14C6 KwSw 2559.961 p_sw_q0p039 -1280.000 1279.961 FORMAT "%8.3" /end CHARACTERISTIC
/begin CHARACTERISTIC OPBKVUKNWB "" VALUE 0x8F14C8 KwSw 2559.961 p_sw_q0p039 -1280.000 1279.961 FORMAT "%8.3" /end CHARACTERISTIC
/begin CHARACTERISTIC OPBKVUKPB "" VALUE 0x8F14CA KwSw 2559.961 p_sw_q0p039 -1280.000 1279.961 FORMAT "%8.3" /end CHARACTERISTIC
/begin CHARACTERISTIC OPBKVUKPUB "" VALUE 0x8F14CC KwSw 2559.961 p_sw_q0p039 -1280.000 1279.961 FORMAT "%8.3" /end CHARACTERISTIC
/begin CHARACTERISTIC PBKVKREHY "" VALUE 0x8F14CE KwUw 2559.961 p_uw_q0p039 0.00 2559.961 FORMAT "%8.3" /end CHARACTERISTIC
/begin CHARACTERISTIC PBKVKRHY "" VALUE 0x8F14D0 KwUw 2559.961 p_uw_q0p039 0.00 2559.961 FORMAT "%8.3" /end CHARACTERISTIC
/begin CHARACTERISTIC PBRINTMN "" VALUE 0x8E97E0 KwUw 2559.961 p_uw_q0p039 0.00 2559.961 FORMAT "%8.3" /end CHARACTERISTIC
/begin CHARACTERISTIC PBRINTMX "" VALUE 0x8E97E2 KwUw 2559.961 p_uw_q0p039 0.00 2559.961 FORMAT "%8.3" /end CHARACTERISTIC
/begin CHARACTERISTIC PMAXKBI "" VALUE 0x8FD910 KwUw 511.0000 kw_q1 0.00 511.0000 FORMAT "%8.4" /end CHARACTERISTIC
/begin CHARACTERISTIC PSPVDKUG "" VALUE 0x8FE668 KwUw 1.999969 fak_uw_b2 0.00 1.999969 FORMAT "%8.6" /end CHARACTERISTIC
/begin CHARACTERISTIC PUKORRV "" CURVE 0x8EEC7C KlAUwSstUwWUw 2559.961 p_uw_q0p039 0.00 2559.961 FORMAT "%8.3"
 /begin AXIS_DESCR STD_AXIS vfzg_w vfzg_uw_b512 8 0.00 511.9922 FORMAT "%8.4" DEPOSIT ABSOLUTE /end AXIS_DESCR
/end CHARACTERISTIC
/begin CHARACTERISTIC PUSMAX "" VALUE 0x8FEF62 KwUw 2559.961 p_uw_q0p039 0.00 2559.961 FORMAT "%8.3" /end CHARACTERISTIC
/begin CHARACTERISTIC PUSMIN "" VALUE 0x8FEF64 KwUw 2559.961 p_uw_q0p039 0.00 2559.961 FORMAT "%8.3" /end CHARACTERISTIC
/begin CHARACTERISTIC RLAOSPMX "" VALUE 0x8EBBA0 KwUw 1536.000 rel_uw_q0p0234 0.00 1536.000 FORMAT "%8.3" /end CHARACTERISTIC
/begin CHARACTERISTIC RLNOT "" CURVE 0x8E9A9C KlAUbSstUbWUw 1535.977 rel_uw_q0p0234 0.00 1535.977 FORMAT "%8.3"
 /begin AXIS_DESCR STD_AXIS nmot nmot_ub_q40 6 0.00 10200. FORMAT "%5.0" DEPOSIT ABSOLUTE /end AXIS_DESCR
/end CHARACTERISTIC
/begin AXIS_PTS SNM12FEUB "" 0x8E0201 nmot SstAUbSstUb 10200. nmot_ub_q40 12 0.00 10200. FORMAT "%5.0" DEPOSIT ABSOLUTE /end AXIS_PTS
/begin CHARACTERISTIC TABMNTUM "" VALUE 0x8EAC58 KwUw 65535.00 t1sxs_uw_q1 0.00 65535.00 FORMAT "%8.2" /end CHARACTERISTIC
/begin CHARACTERISTIC TABSTOLTM "" VALUE 0x8EF2B4 KwUw 65535.00 t1sxs_uw_q1 0.00 65535.00 FORMAT "%8.2" /end CHARACTERISTIC
/begin CHARACTERISTIC TATELL "" VALUE 0x8E1DF2 KwUb 191.3 temp_ub_q0p75_o48 -48.00 143.3 FORMAT "%5.1" /end CHARACTERISTIC
/begin CHARACTERISTIC TBSTEGNSOL "" VALUE 0x8EBBA2 KwUw 6553.500 t_q0p1 0.00 6553.500 FORMAT "%8.3" /end CHARACTERISTIC
/begin CHARACTERISTIC TDABGLST "" VALUE 0x8FE66A KwUw 655.3500 t10msxs_uw_b655p35 0.00 655.3500 FORMAT "%8.4" /end CHARACTERISTIC
/begin CHARACTERISTIC TDBKVKOMAB "" VALUE 0x8E3FEB KwUb 5.100 t20msxs_ub_q0p02 0.00 5.100 FORMAT "%5.3" /end CHARACTERISTIC
/begin CHARACTERISTIC TDBKVNWAB "" VALUE 0x8E3FEC KwUb 5.100 t20msxs_ub_q0p02 0.00 5.100 FORMAT "%5.3" /end CHARACTERISTIC
/begin CHARACTERISTIC TDBKVP "" VALUE 0x8E3FED KwUb 5.100 t20msxs_ub_q0p02 0.00 5.100 FORMAT "%5.3" /end CHARACTERISTIC
/begin CHARACTERISTIC TDBKVSTED "" VALUE 0x8F14D2 KwUw 655.3500 t10msxs_uw_b655p35 0.00 655.3500 FORMAT "%8.4" /end CHARACTERISTIC
/begin CHARACTERISTIC TDKNACH "" VALUE 0x8FDC9C KwUw 655.3500 t10msxs_uw_b655p35 0.00 655.3500 FORMAT "%8.4" /end CHARACTERISTIC
/begin CHARACTERISTIC TDLRPIDMX "" VALUE 0x8FCEB8 KwUb 12.75 t50msxs_q0p05 0.00 12.75 FORMAT "%5.2" /end CHARACTERISTIC
/begin CHARACTERISTIC TDMSDKS "" VALUE 0x8FCFCA KwUb 2.550 t10msxs_ub_b2p55 0.00 2.550 FORMAT "%5.3" /end CHARACTERISTIC
/begin CHARACTERISTIC TDPBKVMN "" VALUE 0x8E3FEE KwUb 5.100 t20msxs_ub_q0p02 0.00 5.100 FORMAT "%5.3" /end CHARACTERISTIC
/begin CHARACTERISTIC TDPBKVMNP "" VALUE 0x8E3FEF KwUb 5.100 t20msxs_ub_q0p02 0.00 5.100 FORMAT "%5.3" /end CHARACTERISTIC
/begin CHARACTERISTIC TDTOL "" VALUE 0x8EF2B6 KwUw 65534.00 t1sxs_uw_b65535 1.000000 65535.00 FORMAT "%8.2" /end CHARACTERISTIC
/begin CHARACTERISTIC TDTUM "" VALUE 0x8EAC5A KwUw 65535.00 t1sxs_uw_q1 0.00 65535.00 FORMAT "%8.2" /end CHARACTERISTIC
/begin CHARACTERISTIC TEBKVNWAB "" VALUE 0x8E3FF0 KwUb 5.100 t20msxs_ub_q0p02 0.00 5.100 FORMAT "%5.3" /end CHARACTERISTIC
/begin CHARACTERISTIC TEPBKVMN "" VALUE 0x8E3FF1 KwUb 5.100 t20msxs_ub_q0p02 0.00 5.100 FORMAT "%5.3" /end CHARACTERISTIC
/begin CHARACTERISTIC TEPPBKV "" VALUE 0x8E3FF2 KwUb 5.080 t20msxs_ub_q0p02 0.00 5.080 FORMAT "%5.3" /end CHARACTERISTIC
/begin CHARACTERISTIC TFRECILAM "" VALUE 0x8FD00B KwUb 2.54996 zk10msxs_ub_b2p56 0.0100392 2.56000 FORMAT "%7.5" /end CHARACTERISTIC
/begin CHARACTERISTIC TFWPFGR "" VALUE 0x8E87A0 KwUw 1310.6999997 zk20msxs_uw_b1310p72 0.020000305180 1310.7200000 FORMAT "%12.7" /end CHARACTERISTIC
/begin CHARACTERISTIC TGAHBX "" VALUE 0x8EAAAC KwUw 6553.500 t100msxs_uw_b6553p6 0.00 6553.500 FORMAT "%8.3" /end CHARACTERISTIC
/begin CHARACTERISTIC TGENONC "" VALUE 0x8E5FA6 KwUw 655.3500 t10msxs_uw_b655p35 0.00 655.3500 FORMAT "%8.4" /end CHARACTERISTIC
/begin CHARACTERISTIC TKATSZA "" VALUE 0x8FECF0 KwUw 1535.977 temp_q0p0234_o273 -273.1500 1262.827 FORMAT "%8.3" /end CHARACTERISTIC
/begin CHARACTERISTIC TKATSZA2 "" VALUE 0x8FECF2 KwUw 1535.977 temp_q0p0234_o273 -273.1500 1262.827 FORMAT "%8.3" /end CHARACTERISTIC
/begin CHARACTERISTIC TMILAS "" VALUE 0x8E08F0 KwUb 255.0 t1sxs_ub_b255 0.00 255.0 FORMAT "%5.1" /end CHARACTERISTIC
/begin CHARACTERISTIC TMILRB "" VALUE 0x8E08F1 KwUb 255.0 t1sxs_ub_b255 0.00 255.0 FORMAT "%5.1" /end CHARACTERISTIC
/begin CHARACTERISTIC TMILVT "" VALUE 0x8E08F2 KwUb 255.0 t1sxs_ub_b255 0.00 255.0 FORMAT "%5.1" /end CHARACTERISTIC
/begin CHARACTERISTIC TMLRZAMN "" VALUE 0x8FD268 KwUb 191.3 temp_ub_q0p75_o48 -48.00 143.3 FORMAT "%5.1" /end CHARACTERISTIC
/begin CHARACTERISTIC TMMXTUM "" VALUE 0x8E20B4 KwUb 191.3 temp_ub_q0p75_o48 -48.00 143.3 FORMAT "%5.1" /end CHARACTERISTIC
/begin CHARACTERISTIC TMOTWRM "" VALUE 0x8E145F KwUb 191.3 temp_ub_q0p75_o48 -48.00 143.3 FORMAT "%5.1" /end CHARACTERISTIC
/begin CHARACTERISTIC TMSKLH "" VALUE 0x8E1DF3 KwUb 191.3 temp_ub_q0p75_o48 -48.00 143.3 FORMAT "%5.1" /end CHARACTERISTIC
/begin CHARACTERISTIC TMSNOGA "" VALUE 0x8E1DF4 KwUb 191.3 temp_ub_q0p75_o48 -48.00 143.3 FORMAT "%5.1" /end CHARACTERISTIC
/begin CHARACTERISTIC TMSUTMUMA "" VALUE 0x8FCEB9 KwUb 191.3 temp_ub_q0p75_o48 -48.00 143.3 FORMAT "%5.1" /end CHARACTERISTIC
/begin CHARACTERISTIC TMVDBS "" VALUE 0x8FD277 KwUb 25.50 t100msxs_ub_b25p5 0.00 25.50 FORMAT "%5.2" /end CHARACTERISTIC
/begin CHARACTERISTIC TMWAFMN "" VALUE 0x8E3AF1 KwUb 191.3 temp_ub_q0p75_o48 -48.00 143.3 FORMAT "%5.1" /end CHARACTERISTIC
/begin CHARACTERISTIC TNLSGM "" CURVE 0x8EAC28 KlAUbSstUbWUw 65535.00 t1sxs_uw_q1 0.00 65535.00 FORMAT "%8.2"
 /begin AXIS_DESCR STD_AXIS tmotab temp_ub_q0p75_o48 6 -48.00 143.3 FORMAT "%5.1" DEPOSIT ABSOLUTE /end AXIS_DESCR
/end CHARACTERISTIC
/begin CHARACTERISTIC TNSEUHRCMP "" VALUE 0x8EAC3C KwUw 6553.500 t100msxs_uw_b6553p5 0.00 6553.500 FORMAT "%8.3" /end CHARACTERISTIC
/begin CHARACTERISTIC TNSURLP "" VALUE 0x8FD006 KwUb 25.50 t100msxs_ub_b25p5 0.00 25.50 FORMAT "%5.2" /end CHARACTERISTIC
/begin CHARACTERISTIC TNWADAMX "" VALUE 0x8EF26E KwUw 3276.750 t50msxs_uw_b3276p75 0.00 3276.750 FORMAT "%8.3" /end CHARACTERISTIC
/begin CHARACTERISTIC TNWADAMXA "" VALUE 0x8EF270 KwUw 3276.750 t50msxs_uw_b3276p75 0.00 3276.750 FORMAT "%8.3" /end CHARACTERISTIC
/begin CHARACTERISTIC TOLE "" VALUE 0x8E3B08 KwUb 255.0 temp_ub_q1_o60 -60.00 195.0 FORMAT "%5.1" /end CHARACTERISTIC
/begin CHARACTERISTIC TPUKOR "" VALUE 0x8E3980 KwUb 25.4996 zk100msxs_ub_b25p5 0.100392 25.6000 FORMAT "%7.4" /end CHARACTERISTIC
/begin CHARACTERISTIC TRLAOSP "" VALUE 0x8EBBA4 KwUw 6553.500 t_q0p1 0.00 6553.500 FORMAT "%8.3" /end CHARACTERISTIC
/begin CHARACTERISTIC TRSECMX "" VALUE 0x8EABEE KwUl 4294967295.00 t1sxs_uw_q1 0.00 4294967295.00 FORMAT "%13.2" /end CHARACTERISTIC
/begin CHARACTERISTIC TTE "" VALUE 0x8EAAAE KwUw 6553.500 t100msxs_uw_b6553p6 0.00 6553.500 FORMAT "%8.3" /end CHARACTERISTIC
/begin CHARACTERISTIC TTEAE "" VALUE 0x8EAAB0 KwUw 6553.500 t100msxs_uw_b6553p6 0.00 6553.500 FORMAT "%8.3" /end CHARACTERISTIC
/begin CHARACTERISTIC TTEBSTP "" VALUE 0x8EAAB2 KwUw 6553.500 t100msxs_uw_b6553p6 0.00 6553.500 FORMAT "%8.3" /end CHARACTERISTIC
/begin CHARACTERISTIC TTEGA "" VALUE 0x8EAAB4 KwUw 6553.500 t100msxs_uw_b6553p6 0.00 6553.500 FORMAT "%8.3" /end CHARACTERISTIC
/begin CHARACTERISTIC TTEGAI "" VALUE 0x8EAAB6 KwUw 6553.500 t100msxs_uw_b6553p6 0.00 6553.500 FORMAT "%8.3" /end CHARACTERISTIC
/begin CHARACTERISTIC TTEGAIH "" VALUE 0x8EAAB8 KwUw 6553.500 t100msxs_uw_b6553p6 0.00 6553.500 FORMAT "%8.3" /end CHARACTERISTIC
/begin CHARACTERISTIC TTEGAZO "" VALUE 0x8EAABA KwUw 6553.500 t100msxs_uw_b6553p6 0.00 6553.500 FORMAT "%8.3" /end CHARACTERISTIC
/begin CHARACTERISTIC TTEGAZU "" VALUE 0x8EAABC KwUw 6553.500 t100msxs_uw_b6553p6 0.00 6553.500 FORMAT "%8.3" /end CHARACTERISTIC
/begin CHARACTERISTIC TTEINI "" VALUE 0x8EAABE KwUw 6553.500 t100msxs_uw_b6553p6 0.00 6553.500 FORMAT "%8.3" /end CHARACTERISTIC
/begin CHARACTERISTIC TTEMN "" VALUE 0x8EAAC0 KwUw 6553.500 t100msxs_uw_b6553p6 0.00 6553.500 FORMAT "%8.3" /end CHARACTERISTIC
/begin CHARACTERISTIC TTEPRIO "" VALUE 0x8EAAC2 KwUw 6553.500 t100msxs_uw_b6553p6 0.00 6553.500 FORMAT "%8.3" /end CHARACTERISTIC
/begin CHARACTERISTIC TTEZAO "" VALUE 0x8EAAC4 KwUw 6553.500 t100msxs_uw_b6553p6 0.00 6553.500 FORMAT "%8.3" /end CHARACTERISTIC
/begin CHARACTERISTIC TTEZAU "" VALUE 0x8EAAC6 KwUw 6553.500 t100msxs_uw_b6553p6 0.00 6553.500 FORMAT "%8.3" /end CHARACTERISTIC
/begin CHARACTERISTIC TTMUMASTA "" VALUE 0x8FDC9E KwUw 3276.750 t50msxs_q0p05 0.00 3276.750 FORMAT "%8.3" /end CHARACTERISTIC
/begin CHARACTERISTIC TUMTAI "" VALUE 0x8E20B5 KwUb 191.3 temp_ub_q0p75_o48 -48.00 143.3 FORMAT "%5.1" /end CHARACTERISTIC
/begin CHARACTERISTIC TVABST "" VALUE 0x8E20AD KwUb 12.75 t50msxs_ub_b12p75 0.00 12.75 FORMAT "%5.2" /end CHARACTERISTIC
/begin CHARACTERISTIC TVGAIN "" VALUE 0x8FECEC KwUw 655.3500 t10msxs_uw_b655p35 0.00 655.3500 FORMAT "%8.4" /end CHARACTERISTIC
/begin CHARACTERISTIC TVNW_S "" VALUE 0x8E3AF2 KwUb 12.75 t50msxs_ub_b12p75 0.00 12.75 FORMAT "%5.2" /end CHARACTERISTIC
/begin CHARACTERISTIC TVTUMTA "" VALUE 0x8EAC5C KwUw 65534.00 t1sxs_uw_b65535 1.000000 65535.00 FORMAT "%8.2" /end CHARACTERISTIC
/begin CHARACTERISTIC TVUHR "" VALUE 0x8E20AE KwUb 255.0 t1sxs_uw_q1 0.00 255.0 FORMAT "%5.1" /end CHARACTERISTIC
/begin CHARACTERISTIC TVUHRDEV "" VALUE 0x8E20AF KwUb 255.0 t1sxs_uw_q1 0.00 255.0 FORMAT "%5.1" /end CHARACTERISTIC
/begin CHARACTERISTIC TWAFMN "" VALUE 0x8E3AF3 KwUb 191.3 temp_ub_q0p75_o48 -48.00 143.3 FORMAT "%5.1" /end CHARACTERISTIC
/begin CHARACTERISTIC TWAFMX "" VALUE 0x8E3AF4 KwUb 191.3 temp_ub_q0p75_o48 -48.00 143.3 FORMAT "%5.1" /end CHARACTERISTIC
/begin CHARACTERISTIC UANAUFRP "" VALUE 0x8FDCA0 KwUw 0.9994659 relDK_uw_b100 0.00 0.9994659 FORMAT "%9.7" /end CHARACTERISTIC
/begin CHARACTERISTIC UANNMAX "" VALUE 0x8FCEBA KwUb 2550. nmot_ub_q10 0.00 2550. FORMAT "%5.0" /end CHARACTERISTIC
/begin CHARACTERISTIC UANPEDMAX "" VALUE 0x8FCEBB KwUb 100.0 relDK_ub_b100 0.00 100.0 FORMAT "%5.1" /end CHARACTERISTIC
/begin CHARACTERISTIC UANPIDMIN "" VALUE 0x8FDCA2 KwUw 99.99847 rel_uw_b100 0.00 99.99847 FORMAT "%8.5" /end CHARACTERISTIC
/begin CHARACTERISTIC UANPIDMINA "" VALUE 0x8FDCA4 KwUw 99.99847 rel_uw_b100 0.00 99.99847 FORMAT "%8.5" /end CHARACTERISTIC
/begin CHARACTERISTIC UANUATS "" VALUE 0x8FCEBC KwUb 191.3 temp_ub_q0p75_o48 -48.00 143.3 FORMAT "%5.1" /end CHARACTERISTIC
/begin CHARACTERISTIC UANVFZG "" VALUE 0x8FCEBD KwUb 318.8 vfzg_ub_q1p25 0.00 318.8 FORMAT "%5.1" /end CHARACTERISTIC
/begin CHARACTERISTIC UANZURP "" VALUE 0x8FDCA6 KwUw 0.05004883 spg_q1p221_mV 0.00 0.05004883 FORMAT "%10.8" /end CHARACTERISTIC
/begin CHARACTERISTIC UAN_O_MT "" VALUE 0x8FCEBE KwUb 191.3 temp_ub_q0p75_o48 -48.00 143.3 FORMAT "%5.1" /end CHARACTERISTIC
/begin CHARACTERISTIC UAN_STORE "" VALUE 0x8FDCA8 KwUw 0.05004883 spg_q1p221_mV 0.00 0.05004883 FORMAT "%10.8" /end CHARACTERISTIC
/begin CHARACTERISTIC UAN_U_MT "" VALUE 0x8FCEBF KwUb 191.3 temp_ub_q0p75_o48 -48.00 143.3 FORMAT "%5.1" /end CHARACTERISTIC
/begin CHARACTERISTIC UB_UANL "" VALUE 0x8FCEC0 KwUb 17.95 spg_ubatt 0.00 17.95 FORMAT "%5.2" /end CHARACTERISTIC
/begin CHARACTERISTIC UDKNLP1N "" VALUE 0x8FDCAA KwUw 4.998779 spg_q1p221_mV 0.00 4.998779 FORMAT "%8.6" /end CHARACTERISTIC
/begin CHARACTERISTIC UDKNLP2N "" VALUE 0x8FDCAC KwUw 4.998779 spg_q1p221_mV 0.00 4.998779 FORMAT "%8.6" /end CHARACTERISTIC
/begin CHARACTERISTIC UDKP1AMAX "" VALUE 0x8FDCAE KwUw 4.998779 spg_q1p221_mV 0.00 4.998779 FORMAT "%8.6" /end CHARACTERISTIC
/begin CHARACTERISTIC UDKP1AMIN "" VALUE 0x8FDCB0 KwUw 4.998779 spg_q1p221_mV 0.00 4.998779 FORMAT "%8.6" /end CHARACTERISTIC
/begin CHARACTERISTIC UDKP1AURI "" VALUE 0x8FDCB2 KwUw 4.998779 spg_q1p221_mV 0.00 4.998779 FORMAT "%8.6" /end CHARACTERISTIC
/begin CHARACTERISTIC UDKP1DUS "" VALUE 0x8FCEC1 KwUb 4.980 spg_ub_q0p019 0.00 4.980 FORMAT "%5.3" /end CHARACTERISTIC
/begin CHARACTERISTIC UDKP1NHUB "" VALUE 0x8FDCB4 KwUw 4.998779 spg_q1p221_mV 0.00 4.998779 FORMAT "%8.6" /end CHARACTERISTIC
/begin CHARACTERISTIC UDKP1VID "" VALUE 0x8FDCB6 KwUw 7.996094 fak_q0p0039 0.00 7.996094 FORMAT "%8.6" /end CHARACTERISTIC
/begin CHARACTERISTIC UDKP1VOMA "" VALUE 0x8FDCB8 KwSw 5.004090 spg_sw_q0p001222 0.00 5.004090 FORMAT "%8.6" /end CHARACTERISTIC
/begin CHARACTERISTIC UDKP1VOMI "" VALUE 0x8FDCBA KwSw 5.004090 spg_sw_q0p001222 -5.004090 0.00 FORMAT "%8.6" /end CHARACTERISTIC
/begin CHARACTERISTIC UDKP1VOSC "" VALUE 0x8FDCBC KwUw 4.995117 spg_uw_q0p00488 0.00 4.995117 FORMAT "%8.6" /end CHARACTERISTIC
/begin CHARACTERISTIC UDKP1VUSC "" VALUE 0x8FDCBE KwUw 4.995117 spg_uw_q0p00488 0.00 4.995117 FORMAT "%8.6" /end CHARACTERISTIC
/begin CHARACTERISTIC UDKP1VVMA "" VALUE 0x8FDCC0 KwUw 7.996094 fak_q0p0039 0.00 7.996094 FORMAT "%8.6" /end CHARACTERISTIC
/begin CHARACTERISTIC UDKP1VVMI "" VALUE 0x8FDCC2 KwUw 7.996094 fak_q0p0039 0.00 7.996094 FORMAT "%8.6" /end CHARACTERISTIC
/begin CHARACTERISTIC UDKP2AMAX "" VALUE 0x8FDCC4 KwUw 4.998779 spg_q1p221_mV 0.00 4.998779 FORMAT "%8.6" /end CHARACTERISTIC
/begin CHARACTERISTIC UDKP2AMIN "" VALUE 0x8FDCC6 KwUw 4.998779 spg_q1p221_mV 0.00 4.998779 FORMAT "%8.6" /end CHARACTERISTIC
/begin CHARACTERISTIC UDKP2AURI "" VALUE 0x8FDCC8 KwUw 4.998779 spg_q1p221_mV 0.00 4.998779 FORMAT "%8.6" /end CHARACTERISTIC
/begin CHARACTERISTIC UDKPALOS "" VALUE 0x8FDCCA KwUw 0.4003906 spg_q1p221_mV 0.00 0.4003906 FORMAT "%9.7" /end CHARACTERISTIC
/begin CHARACTERISTIC UDKPAOFF "" VALUE 0x8FDCCC KwUw 0.05004883 spg_q1p221_mV 0.00 0.05004883 FORMAT "%10.8" /end CHARACTERISTIC
/begin CHARACTERISTIC UDKPATMX "" VALUE 0x8FDCCE KwUw 4.998779 spg_q1p221_mV 0.00 4.998779 FORMAT "%8.6" /end CHARACTERISTIC
/begin CHARACTERISTIC UHRMNDEV "" VALUE 0x8E20B0 KwUb 1.992 fak_ub_b2 0.00 1.992 FORMAT "%5.3" /end CHARACTERISTIC
/begin CHARACTERISTIC UHRMXDEV "" VALUE 0x8E20B1 KwUb 1.992 fak_ub_b2 0.00 1.992 FORMAT "%5.3" /end CHARACTERISTIC
/begin CHARACTERISTIC UPVGNENN "" VALUE 0x8E82A6 KwUw 1.000000 dez 65534.00 65535.00 FORMAT "%8.2" /end CHARACTERISTIC
/begin CHARACTERISTIC VANZKBI "" VALUE 0x8FCD75 KwUb 255.0 DEZ 0.00 255.0 FORMAT "%5.1" /end CHARACTERISTIC
/begin CHARACTERISTIC VASRM "" VALUE 0x8FD278 KwUb 318.8 vfzg_ub_q1p25 0.00 318.8 FORMAT "%5.1" /end CHARACTERISTIC
/begin CHARACTERISTIC VMAXNB "" VALUE 0x8EBF12 KwUw 511.9922 vfzg_uw_q0p00781 0.00 511.9922 FORMAT "%8.4" /end CHARACTERISTIC
/begin CHARACTERISTIC VMAXTM "" CURVE 0x8EBF14 KlAUwSstUwWUw 511.9922 vfzg_uw_q0p00781 0.00 511.9922 FORMAT "%8.4"
 /begin AXIS_DESCR STD_AXIS tmotrvmx temp_ub_q0p75_o48 5 -48.00 143.3 FORMAT "%5.1" DEPOSIT ABSOLUTE /end AXIS_DESCR
/end CHARACTERISTIC
/begin CHARACTERISTIC VMAXTOL "" CURVE 0x8EBF2A KlAUwSstUwWUw 511.9922 vfzg_uw_q0p00781 0.00 511.9922 FORMAT "%8.4"
 /begin AXIS_DESCR STD_AXIS toelk_w temp_q0p0234_o273 5 -273.1500 1262.827 FORMAT "%8.3" DEPOSIT ABSOLUTE /end AXIS_DESCR
/end CHARACTERISTIC
/begin CHARACTERISTIC VRADF "" VALUE 0x8FEF56 KwUw 654.9900 vrad_uw_b655 0.00 654.9900 FORMAT "%8.4" /end CHARACTERISTIC
/begin CHARACTERISTIC VSONTL "" VALUE 0x8EA7B8 KwUw 19999.69 vol_q0p306_cme3 0.00 19999.69 FORMAT "%8.2" /end CHARACTERISTIC
/begin CHARACTERISTIC VSONTL2 "" VALUE 0x8EA7BA KwUw 19999.69 vol_q0p306_cme3 0.00 19999.69 FORMAT "%8.2" /end CHARACTERISTIC
/begin CHARACTERISTIC VTUMTA "" VALUE 0x8E20B6 KwUb 318.8 vfzg_ub_q1p25 0.00 318.8 FORMAT "%5.1" /end CHARACTERISTIC
/begin CHARACTERISTIC WDKFPRO2 "" VALUE 0x8FDCD0 KwSw 1599.976 relDK_q0p02441 -800.0000 799.9756 FORMAT "%8.4" /end CHARACTERISTIC
/begin CHARACTERISTIC WDKFPROO "" VALUE 0x8FDCD2 KwSw 1599.976 relDK_q0p02441 -800.0000 799.9756 FORMAT "%8.4" /end CHARACTERISTIC
/begin CHARACTERISTIC WDKFPROU "" VALUE 0x8FDCD4 KwSw 1599.976 relDK_q0p02441 -800.0000 799.9756 FORMAT "%8.4" /end CHARACTERISTIC
/begin CHARACTERISTIC WDKFPRZ1 "" VALUE 0x8FDCD6 KwUw 100.0000 relDK_uw_b100 0.00 100.0000 FORMAT "%8.4" /end CHARACTERISTIC
/begin CHARACTERISTIC WDKFPRZ2 "" VALUE 0x8FDCD8 KwUw 100.0000 relDK_uw_b100 0.00 100.0000 FORMAT "%8.4" /end CHARACTERISTIC
/begin CHARACTERISTIC WDKNLPMA "" VALUE 0x8FDCDA KwUw 100.0000 relDK_uw_b100 0.00 100.0000 FORMAT "%8.4" /end CHARACTERISTIC
/begin CHARACTERISTIC WDKNLPMI "" VALUE 0x8FDCDC KwUw 100.0000 relDK_uw_b100 0.00 100.0000 FORMAT "%8.4" /end CHARACTERISTIC
/begin CHARACTERISTIC WDKNPLAUS "" VALUE 0x8FDCDE KwUw 100.0000 relDK_uw_b100 0.00 100.0000 FORMAT "%8.4" /end CHARACTERISTIC
/begin CHARACTERISTIC WDKNSTORE "" VALUE 0x8FDCE0 KwUw 100.0000 relDK_uw_b100 0.00 100.0000 FORMAT "%8.4" /end CHARACTERISTIC
/begin CHARACTERISTIC WDKSFPR "" VALUE 0x8FDCE2 KwUw 100.0000 relDK_uw_b100 0.00 100.0000 FORMAT "%8.4" /end CHARACTERISTIC
/begin CHARACTERISTIC WDKSFPRO "" VALUE 0x8FDCE4 KwUw 100.0000 relDK_uw_b100 0.00 100.0000 FORMAT "%8.4" /end CHARACTERISTIC
/begin CHARACTERISTIC WDKSTMUMA "" VALUE 0x8FDCE6 KwUw 100.0000 relDK_uw_b100 0.00 100.0000 FORMAT "%8.4" /end CHARACTERISTIC
/begin CHARACTERISTIC WDKUGDN "" CURVE 0x8E9AD2 GklWUw 99.99847 rel_uw_b100 0.00 99.99847 FORMAT "%8.5"
 /begin AXIS_DESCR COM_AXIS nmot nmot_ub_q40 12 0.00 10200. FORMAT "%5.0" AXIS_PTS_REF SNM12FEUB /end AXIS_DESCR
/end CHARACTERISTIC
/begin CHARACTERISTIC WPFGRBMR "" CURVE 0x8E87A2 KlAUwSstUwWUw 99.99847 rel_uw_b100 0.00 99.99847 FORMAT "%8.5"
 /begin AXIS_DESCR STD_AXIS mrfgr_w rel_uw_b200 16 0.00 199.9969 FORMAT "%8.4" DEPOSIT ABSOLUTE /end AXIS_DESCR
/end CHARACTERISTIC
/begin CHARACTERISTIC WPRMX "" VALUE 0x8FD007 KwUb 1530. kw_q6 0.00 1530. FORMAT "%5.0" /end CHARACTERISTIC
/begin CHARACTERISTIC ZBRT "" VALUE 0x8E9C04 KwUw 6553.4999985 zk100msxs_uw_b6553 0.10000152590 6553.6000000 FORMAT "%12.7" /end CHARACTERISTIC
/begin CHARACTERISTIC ZDBTMN "" CURVE 0x8E9C06 KlAUwSstUwWUw 6553.4999985 zk100msxs_uw_b6553 0.10000152590 6553.6000000 FORMAT "%12.7"
 /begin AXIS_DESCR STD_AXIS nmot_w nmot_uw_q0p25 8 0.00 16383.75 FORMAT "%8.2" DEPOSIT ABSOLUTE /end AXIS_DESCR
/end CHARACTERISTIC
/begin CHARACTERISTIC ZDBTMP "" CURVE 0x8E9C28 KlAUwSstUwWUw 6553.4999985 zk100msxs_uw_b6553 0.10000152590 6553.6000000 FORMAT "%12.7"
 /begin AXIS_DESCR STD_AXIS nmot_w nmot_uw_q0p25 8 0.00 16383.75 FORMAT "%8.2" DEPOSIT ABSOLUTE /end AXIS_DESCR
/end CHARACTERISTIC
/begin CHARACTERISTIC ZKLBZ "" VALUE 0x8E0D7A KwUb 50.8000 zk200msxs_ub_b51p2 0.200000 51.0000 FORMAT "%7.4" /end CHARACTERISTIC
/begin CHARACTERISTIC ZKMSDKTHFM "" CURVE 0x8E9AEA KlAUwSstUwWUw 655.34999985 zk10msxs_uw_b655 0.010000152590 655.36000000 FORMAT "%12.8"
 /begin AXIS_DESCR STD_AXIS pspvds_w fak_uw_b2 8 0.00 1.999969 FORMAT "%8.6" DEPOSIT ABSOLUTE /end AXIS_DESCR
/end CHARACTERISTIC
/begin CHARACTERISTIC ZKPVDKT "" CURVE 0x8E9AB0 KlAUwSstUwWUw 65534.000000 zk1sxs_uw_b65535 1.0000000000 65535.000000 FORMAT "%12.6"
 /begin AXIS_DESCR STD_AXIS pspvds_w fak_uw_b2 8 0.00 1.999969 FORMAT "%8.6" DEPOSIT ABSOLUTE /end AXIS_DESCR
/end CHARACTERISTIC
/begin CHARACTERISTIC ZKTABTU "" CURVE 0x8EAC3E KlAUbSstUbWUw 65535.00 t1sxs_uw_b65535 0.00 65535.00 FORMAT "%8.2"
 /begin AXIS_DESCR STD_AXIS tumg temp_ub_q0p75_o48 4 -48.00 143.3 FORMAT "%5.1" DEPOSIT ABSOLUTE /end AXIS_DESCR
/end CHARACTERISTIC
/begin CHARACTERISTIC ZKTPTOLTM "" VALUE 0x8EF2B8 KwUw 65534.000000 zk1sxs_uw_b65535 1.0000000000 65535.000000 FORMAT "%12.6" /end CHARACTERISTIC
/begin CHARACTERISTIC ZMRFABN "" CURVE 0x8EAAC8 KlAUwSstSwWUw 6553.4999985 zk100msxs_uw_b6553 0.10000152590 6553.6000000 FORMAT "%12.7"
 /begin AXIS_DESCR STD_AXIS dmrfabn_w rel_sw_b100 5 -100.0000 99.99695 FORMAT "%8.4" DEPOSIT ABSOLUTE /end AXIS_DESCR
/end CHARACTERISTIC
/begin CHARACTERISTIC ZNGFIL "" VALUE 0x8FDBD4 KwUw 655.34999985 zk10msxs_uw_b655 0.010000152590 655.36000000 FORMAT "%12.8" /end CHARACTERISTIC
/begin CHARACTERISTIC ZRFKMSDK "" VALUE 0x8FCFCB KwUb 2.54000 zk10msxs_ub_b2p55 0.0100000 2.55000 FORMAT "%7.5" /end CHARACTERISTIC
/begin CHARACTERISTIC ZTDAGR "" VALUE 0x8E9C4A KwUw 6553.4999985 zk100msxs_uw_b6553 0.10000152590 6553.6000000 FORMAT "%12.7" /end CHARACTERISTIC
/begin CHARACTERISTIC ZTMMBR "" VALUE 0x8E9C4C KwUw 6553.4999985 zk100msxs_uw_b6553 0.10000152590 6553.6000000 FORMAT "%12.7" /end CHARACTERISTIC
/begin CHARACTERISTIC ZWDKM1 "" VALUE 0x8FE6C4 KwUw 2.550000 zk10msxs_uw_b2p55T 0.00 2.550000 FORMAT "%8.6" /end CHARACTERISTIC
/begin CHARACTERISTIC ZWDKM2 "" VALUE 0x8FE6C6 KwUw 2.550000 zk10msxs_uw_b2p55T 0.00 2.550000 FORMAT "%8.6" /end CHARACTERISTIC
/begin CHARACTERISTIC ZYLANZB "" VALUE 0x8E8026 KwUw 5.000000 fak_uw_b16 1.000000 6.000000 FORMAT "%8.6" /end CHARACTERISTIC
/begin CHARACTERISTIC ZYLANZB2 "" VALUE 0x8E8028 KwUw 5.000000 fak_uw_b16 1.000000 6.000000 FORMAT "%8.6" /end CHARACTERISTIC
/begin MEASUREMENT BGARNWausbits "" UBYTE dez 1 100 0.00 255.0 FORMAT "%5.1" ECU_ADDRESS 0xF4191 /end MEASUREMENT
/begin MEASUREMENT BGARNWlokbits "" UBYTE dez 1 100 0.00 255.0 FORMAT "%5.1" ECU_ADDRESS 0xF4192 /end MEASUREMENT
/begin MEASUREMENT BGBNausbits0 "" UBYTE dez 1 100 0.00 255.0 FORMAT "%5.1" ECU_ADDRESS 0xF08B8 /end MEASUREMENT
/begin MEASUREMENT bgcvn_bits "" UBYTE dez 1 100 0.00 255.0 FORMAT "%5.1" ECU_ADDRESS 0xF4052 /end MEASUREMENT
/begin MEASUREMENT BGDVEintbits "" UBYTE dez 1 100 0.00 255.0 FORMAT "%5.1" ECU_ADDRESS 0x38205E /end MEASUREMENT
/begin MEASUREMENT bgelsvAusBitsKoop "" UBYTE dez 1 100 0.00 255.0 FORMAT "%5.1" ECU_ADDRESS 0xF07E5 /end MEASUREMENT
/begin MEASUREMENT bgelsvAusBitsNovKoop "" UBYTE dez 1 100 0.00 255.0 FORMAT "%5.1" ECU_ADDRESS 0x382059 /end MEASUREMENT
/begin MEASUREMENT bgelsvLokBitsKoop "" UBYTE dez 1 100 0.00 255.0 FORMAT "%5.1" ECU_ADDRESS 0xF07E6 /end MEASUREMENT
/begin MEASUREMENT BGMSZSbits "" UBYTE dez 1 100 0.00 255.0 FORMAT "%5.1" ECU_ADDRESS 0xF08BB /end MEASUREMENT
/begin MEASUREMENT bgtabsaAusBits "" UBYTE dez 1 100 0.00 255.0 FORMAT "%5.1" ECU_ADDRESS 0xF0910 /end MEASUREMENT
/begin MEASUREMENT bgtabstBits1_50ms "" UBYTE dez 1 100 0.00 255.0 FORMAT "%5.1" ECU_ADDRESS 0xF0911 /end MEASUREMENT
/begin MEASUREMENT bgtabstBits2_50ms "" UBYTE dez 1 100 0.00 255.0 FORMAT "%5.1" ECU_ADDRESS 0xF0912 /end MEASUREMENT
/begin MEASUREMENT bgtabstBits3_1000ms "" UBYTE dez 1 100 0.00 255.0 FORMAT "%5.1" ECU_ADDRESS 0x382066 /end MEASUREMENT
/begin MEASUREMENT BGTOLausbits1 "" UBYTE dez 1 100 0.00 255.0 FORMAT "%5.1" ECU_ADDRESS 0xF419B /end MEASUREMENT
/begin MEASUREMENT bgtumgBits_1000ms "" UBYTE dez 1 100 0.00 255.0 FORMAT "%5.1" ECU_ADDRESS 0xF0913 /end MEASUREMENT
/begin MEASUREMENT BKVlokbits0 "" UBYTE dez 1 100 0.00 255.0 FORMAT "%5.1" ECU_ADDRESS 0xF0C9E /end MEASUREMENT
/begin MEASUREMENT bsc "" UBYTE acc_ub_b55p55 1 100 0.00 55.34 FORMAT "%5.2" ECU_ADDRESS 0xF0BA6 /end MEASUREMENT
/begin MEASUREMENT bz_cmf "" UBYTE dez 1 100 0.00 255.0 FORMAT "%5.1" ECU_ADDRESS 0xF0667 /end MEASUREMENT
/begin MEASUREMENT bz_mot6 "" UBYTE dez 1 100 0.00 255.0 FORMAT "%5.1" ECU_ADDRESS 0xF0668 /end MEASUREMENT
/begin MEASUREMENT bz_mot8 "" UBYTE dez 1 100 0.00 255.0 FORMAT "%5.1" ECU_ADDRESS 0xF0669 /end MEASUREMENT
/begin MEASUREMENT B_abgle "" UWORD B_TRUE 1 100 0.00 1.00000000000 BIT_MASK 0x20 FORMAT "%13.11" ECU_ADDRESS 0xFD5A /end MEASUREMENT
/begin MEASUREMENT B_absf "" UWORD B_TRUE 1 100 0.00 1.00000000000 BIT_MASK 0x200 FORMAT "%13.11" ECU_ADDRESS 0xFDB8 /end MEASUREMENT
/begin MEASUREMENT B_abstgp "" UBYTE B_TRUE 1 100 0.00 1.00000000000 BIT_MASK 0x1 FORMAT "%13.11" ECU_ADDRESS 0xF0911 /end MEASUREMENT
/begin MEASUREMENT B_abstmnpl "" UBYTE B_TRUE 1 100 0.00 1.00000000000 BIT_MASK 0x1 FORMAT "%13.11" ECU_ADDRESS 0xF0912 /end MEASUREMENT
/begin MEASUREMENT B_abstnlg0 "" UBYTE B_TRUE 1 100 0.00 1.00000000000 BIT_MASK 0x2 FORMAT "%13.11" ECU_ADDRESS 0x382066 /end MEASUREMENT
/begin MEASUREMENT B_abstnlgp "" UWORD B_TRUE 1 100 0.00 1.00000000000 BIT_MASK 0x8000 FORMAT "%13.11" ECU_ADDRESS 0xFD7C /end MEASUREMENT
/begin MEASUREMENT B_abstnpl "" UBYTE B_TRUE 1 100 0.00 1.00000000000 BIT_MASK 0x2 FORMAT "%13.11" ECU_ADDRESS 0xF0911 /end MEASUREMENT
/begin MEASUREMENT B_abstuhrg "" UBYTE B_TRUE 1 100 0.00 1.00000000000 BIT_MASK 0x2 FORMAT "%13.11" ECU_ADDRESS 0xF0912 /end MEASUREMENT
/begin MEASUREMENT B_add "" UBYTE B_TRUE 1 100 0.00 1.00000000000 BIT_MASK 0x2 FORMAT "%13.11" ECU_ADDRESS 0xF0BC9 /end MEASUREMENT
/begin MEASUREMENT B_bevab "" UWORD B_TRUE 1 100 0.00 1.00000000000 BIT_MASK 0x20 FORMAT "%13.11" ECU_ADDRESS 0xFD78 /end MEASUREMENT
/begin MEASUREMENT B_bevab2 "" UWORD B_TRUE 1 100 0.00 1.00000000000 BIT_MASK 0x40 FORMAT "%13.11" ECU_ADDRESS 0xFD78 /end MEASUREMENT
/begin MEASUREMENT B_bkvagrab "" UWORD B_TRUE 1 100 0.00 1.00000000000 BIT_MASK 0x8000 FORMAT "%13.11" ECU_ADDRESS 0xFDCE /end MEASUREMENT
/begin MEASUREMENT B_bkvdkhab "" UWORD B_TRUE 1 100 0.00 1.00000000000 BIT_MASK 0x1 FORMAT "%13.11" ECU_ADDRESS 0xFDD0 /end MEASUREMENT
/begin MEASUREMENT B_bkvkoma "" UBYTE B_TRUE 1 100 0.00 1.00000000000 BIT_MASK 0x2 FORMAT "%13.11" ECU_ADDRESS 0xF0C9E /end MEASUREMENT
/begin MEASUREMENT B_bkvkomab "" UWORD B_TRUE 1 100 0.00 1.00000000000 BIT_MASK 0x2 FORMAT "%13.11" ECU_ADDRESS 0xFDD0 /end MEASUREMENT
/begin MEASUREMENT B_bkvleer "" UWORD B_TRUE 1 100 0.00 1.00000000000 BIT_MASK 0x4 FORMAT "%13.11" ECU_ADDRESS 0xFDD0 /end MEASUREMENT
/begin MEASUREMENT B_bkvnkhab "" UWORD B_TRUE 1 100 0.00 1.00000000000 BIT_MASK 0x8 FORMAT "%13.11" ECU_ADDRESS 0xFDD0 /end MEASUREMENT
/begin MEASUREMENT B_bkvnwab "" UWORD B_TRUE 1 100 0.00 1.00000000000 BIT_MASK 0x10 FORMAT "%13.11" ECU_ADDRESS 0xFDD0 /end MEASUREMENT
/begin MEASUREMENT B_bkvnwum "" UBYTE B_TRUE 1 100 0.00 1.00000000000 BIT_MASK 0x4 FORMAT "%13.11" ECU_ADDRESS 0xF0C9E /end MEASUREMENT
/begin MEASUREMENT B_bkvpa "" UWORD B_TRUE 1 100 0.00 1.00000000000 BIT_MASK 0x20 FORMAT "%13.11" ECU_ADDRESS 0xFDD0 /end MEASUREMENT
/begin MEASUREMENT B_blkeb "" UBYTE B_TRUE 1 100 0.00 1.00000000000 BIT_MASK 0x4 FORMAT "%13.11" ECU_ADDRESS 0xF4044 /end MEASUREMENT
/begin MEASUREMENT B_bvhfm "" UBYTE B_TRUE 1 100 0.00 1.00000000000 BIT_MASK 0x1 FORMAT "%13.11" ECU_ADDRESS 0xF08B8 /end MEASUREMENT
/begin MEASUREMENT B_bvhls "" UBYTE B_TRUE 1 100 0.00 1.00000000000 BIT_MASK 0x2 FORMAT "%13.11" ECU_ADDRESS 0xF08B8 /end MEASUREMENT
/begin MEASUREMENT B_cksbrdy "" UBYTE B_TRUE 1 100 0.00 1.00000000000 BIT_MASK 0x1 FORMAT "%13.11" ECU_ADDRESS 0xF4052 /end MEASUREMENT
/begin MEASUREMENT B_crlsv "" UBYTE B_TRUE 1 100 0.00 1.00000000000 BIT_MASK 0x4 FORMAT "%13.11" ECU_ADDRESS 0xF07E5 /end MEASUREMENT
/begin MEASUREMENT B_crlsv2 "" UBYTE B_TRUE 1 100 0.00 1.00000000000 BIT_MASK 0x8 FORMAT "%13.11" ECU_ADDRESS 0xF07E5 /end MEASUREMENT
/begin MEASUREMENT B_dcdisr "" UWORD B_TRUE 1 100 0.00 1.00000000000 BIT_MASK 0x40 FORMAT "%13.11" ECU_ADDRESS 0xFD5A /end MEASUREMENT
/begin MEASUREMENT B_dkaden "" UWORD B_TRUE 1 100 0.00 1.00000000000 BIT_MASK 0x80 FORMAT "%13.11" ECU_ADDRESS 0xFD5A /end MEASUREMENT
/begin MEASUREMENT B_dknach "" UBYTE B_TRUE 1 100 0.00 1.00000000000 BIT_MASK 0x8 FORMAT "%13.11" ECU_ADDRESS 0x38205E /end MEASUREMENT
/begin MEASUREMENT B_dlrien "" UWORD B_TRUE 1 100 0.00 1.00000000000 BIT_MASK 0x100 FORMAT "%13.11" ECU_ADDRESS 0xFD5A /end MEASUREMENT
/begin MEASUREMENT B_dveada "" UWORD B_TRUE 1 100 0.00 1.00000000000 BIT_MASK 0x200 FORMAT "%13.11" ECU_ADDRESS 0xFD5A /end MEASUREMENT
/begin MEASUREMENT B_dvetv "" UWORD B_TRUE 1 100 0.00 1.00000000000 BIT_MASK 0x400 FORMAT "%13.11" ECU_ADDRESS 0xFD5A /end MEASUREMENT
/begin MEASUREMENT B_dwdknws "" UBYTE B_TRUE 1 100 0.00 1.00000000000 BIT_MASK 0x1 FORMAT "%13.11" ECU_ADDRESS 0xF0C01 /end MEASUREMENT
/begin MEASUREMENT B_edsli "" UWORD B_TRUE 1 100 0.00 1.00000000000 BIT_MASK 0x80 FORMAT "%13.11" ECU_ADDRESS 0xFD6C /end MEASUREMENT
/begin MEASUREMENT B_elsv "" UBYTE B_TRUE 1 100 0.00 1.00000000000 BIT_MASK 0x1 FORMAT "%13.11" ECU_ADDRESS 0x382059 /end MEASUREMENT
/begin MEASUREMENT B_elsv2 "" UBYTE B_TRUE 1 100 0.00 1.00000000000 BIT_MASK 0x2 FORMAT "%13.11" ECU_ADDRESS 0x382059 /end MEASUREMENT
/begin MEASUREMENT B_epcl "" UWORD B_TRUE 1 100 0.00 1.00000000000 BIT_MASK 0x8000 FORMAT "%13.11" ECU_ADDRESS 0xFD3C /end MEASUREMENT
/begin MEASUREMENT B_etoltm "" UBYTE B_TRUE 1 100 0.00 1.00000000000 BIT_MASK 0x1 FORMAT "%13.11" ECU_ADDRESS 0xF419B /end MEASUREMENT
/begin MEASUREMENT B_evakt "" UWORD B_TRUE 1 100 0.00 1.00000000000 BIT_MASK 0x80 FORMAT "%13.11" ECU_ADDRESS 0xFD78 /end MEASUREMENT
/begin MEASUREMENT B_evloc "" UWORD B_TRUE 1 100 0.00 1.00000000000 BIT_MASK 0x100 FORMAT "%13.11" ECU_ADDRESS 0xFD78 /end MEASUREMENT
/begin MEASUREMENT B_fgabgl "" UWORD B_TRUE 1 100 0.00 1.00000000000 BIT_MASK 0x100 FORMAT "%13.11" ECU_ADDRESS 0xFD6C /end MEASUREMENT
/begin MEASUREMENT B_fklsol "" UWORD B_TRUE 1 100 0.00 1.00000000000 BIT_MASK 0x8 FORMAT "%13.11" ECU_ADDRESS 0xFDB2 /end MEASUREMENT
/begin MEASUREMENT B_fklsol2 "" UWORD B_TRUE 1 100 0.00 1.00000000000 BIT_MASK 0x10 FORMAT "%13.11" ECU_ADDRESS 0xFDB2 /end MEASUREMENT
/begin MEASUREMENT B_fkmsmn "" UWORD B_TRUE 1 100 0.00 1.00000000000 BIT_MASK 0x200 FORMAT "%13.11" ECU_ADDRESS 0xFD6C /end MEASUREMENT
/begin MEASUREMENT B_fkmsmx "" UWORD B_TRUE 1 100 0.00 1.00000000000 BIT_MASK 0x400 FORMAT "%13.11" ECU_ADDRESS 0xFD6C /end MEASUREMENT
/begin MEASUREMENT B_fkpvdk "" UBYTE B_TRUE 1 100 0.00 1.00000000000 BIT_MASK 0x1 FORMAT "%13.11" ECU_ADDRESS 0xF08BB /end MEASUREMENT
/begin MEASUREMENT B_fkpvmn "" UBYTE B_TRUE 1 100 0.00 1.00000000000 BIT_MASK 0x20 FORMAT "%13.11" ECU_ADDRESS 0xF08BB /end MEASUREMENT
/begin MEASUREMENT B_fkpvmx "" UBYTE B_TRUE 1 100 0.00 1.00000000000 BIT_MASK 0x10 FORMAT "%13.11" ECU_ADDRESS 0xF08BB /end MEASUREMENT
/begin MEASUREMENT B_fphad "" UBYTE B_TRUE 1 100 0.00 1.00000000000 BIT_MASK 0x1 FORMAT "%13.11" ECU_ADDRESS 0xF4192 /end MEASUREMENT
/begin MEASUREMENT B_fprakt "" UWORD B_TRUE 1 100 0.00 1.00000000000 BIT_MASK 0x800 FORMAT "%13.11" ECU_ADDRESS 0xFD5A /end MEASUREMENT
/begin MEASUREMENT B_fproab "" UWORD B_TRUE 1 100 0.00 1.00000000000 BIT_MASK 0x1000 FORMAT "%13.11" ECU_ADDRESS 0xFD5A /end MEASUREMENT
/begin MEASUREMENT B_fproe "" UWORD B_TRUE 1 100 0.00 1.00000000000 BIT_MASK 0x2000 FORMAT "%13.11" ECU_ADDRESS 0xFD5A /end MEASUREMENT
/begin MEASUREMENT B_fprook "" UWORD B_TRUE 1 100 0.00 1.00000000000 BIT_MASK 0x4000 FORMAT "%13.11" ECU_ADDRESS 0xFD5A /end MEASUREMENT
/begin MEASUREMENT B_fprordy "" UWORD B_TRUE 1 100 0.00 1.00000000000 BIT_MASK 0x8000 FORMAT "%13.11" ECU_ADDRESS 0xFD5A /end MEASUREMENT
/begin MEASUREMENT B_fprovb "" UWORD B_TRUE 1 100 0.00 1.00000000000 BIT_MASK 0x1 FORMAT "%13.11" ECU_ADDRESS 0xFD5C /end MEASUREMENT
/begin MEASUREMENT B_fprrdy "" UWORD B_TRUE 1 100 0.00 1.00000000000 BIT_MASK 0x2 FORMAT "%13.11" ECU_ADDRESS 0xFD5C /end MEASUREMENT
/begin MEASUREMENT B_fprzab "" UWORD B_TRUE 1 100 0.00 1.00000000000 BIT_MASK 0x4 FORMAT "%13.11" ECU_ADDRESS 0xFD5C /end MEASUREMENT
/begin MEASUREMENT B_fprze "" UWORD B_TRUE 1 100 0.00 1.00000000000 BIT_MASK 0x8 FORMAT "%13.11" ECU_ADDRESS 0xFD5C /end MEASUREMENT
/begin MEASUREMENT B_fprzok "" UWORD B_TRUE 1 100 0.00 1.00000000000 BIT_MASK 0x10 FORMAT "%13.11" ECU_ADDRESS 0xFD5C /end MEASUREMENT
/begin MEASUREMENT B_fprzvb "" UWORD B_TRUE 1 100 0.00 1.00000000000 BIT_MASK 0x20 FORMAT "%13.11" ECU_ADDRESS 0xFD5C /end MEASUREMENT
/begin MEASUREMENT B_fraoan "" UWORD B_TRUE 1 100 0.00 1.00000000000 BIT_MASK 0x200 FORMAT "%13.11" ECU_ADDRESS 0xFD78 /end MEASUREMENT
/begin MEASUREMENT B_gap "" UWORD B_TRUE 1 100 0.00 1.00000000000 BIT_MASK 0x400 FORMAT "%13.11" ECU_ADDRESS 0xFD78 /end MEASUREMENT
/begin MEASUREMENT B_genonc "" UWORD B_TRUE 1 100 0.00 1.00000000000 BIT_MASK 0x4 FORMAT "%13.11" ECU_ADDRESS 0xFD22 /end MEASUREMENT
/begin MEASUREMENT B_inilabgl "" UBYTE B_TRUE 1 100 0.00 1.00000000000 BIT_MASK 0x4 FORMAT "%13.11" ECU_ADDRESS 0xF08BB /end MEASUREMENT
/begin MEASUREMENT B_inimsdko "" UBYTE B_TRUE 1 100 0.00 1.00000000000 BIT_MASK 0x8 FORMAT "%13.11" ECU_ADDRESS 0xF08BB /end MEASUREMENT
/begin MEASUREMENT B_inisabgl "" UWORD B_TRUE 1 100 0.00 1.00000000000 BIT_MASK 0x800 FORMAT "%13.11" ECU_ADDRESS 0xFD6C /end MEASUREMENT
/begin MEASUREMENT B_kmmil "" UBYTE B_TRUE 1 100 0.00 1.00000000000 BIT_MASK 0x10 FORMAT "%13.11" ECU_ADDRESS 0x384004 /end MEASUREMENT
/begin MEASUREMENT B_lasostc "" UWORD B_TRUE 1 100 0.00 1.00000000000 BIT_MASK 0x2 FORMAT "%13.11" ECU_ADDRESS 0xFD72 /end MEASUREMENT
/begin MEASUREMENT B_lasostc2 "" UWORD B_TRUE 1 100 0.00 1.00000000000 BIT_MASK 0x4 FORMAT "%13.11" ECU_ADDRESS 0xFD72 /end MEASUREMENT
/begin MEASUREMENT B_lrnakt "" UWORD B_TRUE 1 100 0.00 1.00000000000 BIT_MASK 0x40 FORMAT "%13.11" ECU_ADDRESS 0xFD5C /end MEASUREMENT
/begin MEASUREMENT B_lrnerf "" UBYTE B_TRUE 1 100 0.00 1.00000000000 BIT_MASK 0x2 FORMAT "%13.11" ECU_ADDRESS 0x38205E /end MEASUREMENT
/begin MEASUREMENT B_lrnfg "" UWORD B_TRUE 1 100 0.00 1.00000000000 BIT_MASK 0x80 FORMAT "%13.11" ECU_ADDRESS 0xFD5C /end MEASUREMENT
/begin MEASUREMENT B_lrnrdy "" UWORD B_TRUE 1 100 0.00 1.00000000000 BIT_MASK 0x100 FORMAT "%13.11" ECU_ADDRESS 0xFD5C /end MEASUREMENT
/begin MEASUREMENT B_lrntesa "" UWORD B_TRUE 1 100 0.00 1.00000000000 BIT_MASK 0x200 FORMAT "%13.11" ECU_ADDRESS 0xFD5C /end MEASUREMENT
/begin MEASUREMENT B_lrnvb "" UWORD B_TRUE 1 100 0.00 1.00000000000 BIT_MASK 0x400 FORMAT "%13.11" ECU_ADDRESS 0xFD5C /end MEASUREMENT
/begin MEASUREMENT B_lrnws "" UBYTE B_TRUE 1 100 0.00 1.00000000000 BIT_MASK 0x1 FORMAT "%13.11" ECU_ADDRESS 0x38205E /end MEASUREMENT
/begin MEASUREMENT B_lrssp "" UWORD B_TRUE 1 100 0.00 1.00000000000 BIT_MASK 0x80 FORMAT "%13.11" ECU_ADDRESS 0xFDB2 /end MEASUREMENT
/begin MEASUREMENT B_lrssp2 "" UWORD B_TRUE 1 100 0.00 1.00000000000 BIT_MASK 0x100 FORMAT "%13.11" ECU_ADDRESS 0xFDB2 /end MEASUREMENT
/begin MEASUREMENT B_lrzatrg "" UWORD B_TRUE 1 100 0.00 1.00000000000 BIT_MASK 0x200 FORMAT "%13.11" ECU_ADDRESS 0xFDB2 /end MEASUREMENT
/begin MEASUREMENT B_mil "" UWORD B_TRUE 1 100 0.00 1.00000000000 BIT_MASK 0x1 FORMAT "%13.11" ECU_ADDRESS 0xFD3E /end MEASUREMENT
/begin MEASUREMENT B_milact "" UWORD B_TRUE 1 100 0.00 1.00000000000 BIT_MASK 0x2 FORMAT "%13.11" ECU_ADDRESS 0xFD3E /end MEASUREMENT
/begin MEASUREMENT B_milas "" UWORD B_TRUE 1 100 0.00 1.00000000000 BIT_MASK 0x4 FORMAT "%13.11" ECU_ADDRESS 0xFD3E /end MEASUREMENT
/begin MEASUREMENT B_milblk "" UBYTE B_TRUE 1 100 0.00 1.00000000000 BIT_MASK 0x8 FORMAT "%13.11" ECU_ADDRESS 0xF4044 /end MEASUREMENT
/begin MEASUREMENT B_milclr "" UWORD B_TRUE 1 100 0.00 1.00000000000 BIT_MASK 0x8 FORMAT "%13.11" ECU_ADDRESS 0xFD3E /end MEASUREMENT
/begin MEASUREMENT B_mileb "" UBYTE B_TRUE 1 100 0.00 1.00000000000 BIT_MASK 0x2 FORMAT "%13.11" ECU_ADDRESS 0xF4044 /end MEASUREMENT
/begin MEASUREMENT B_milfd "" UWORD B_TRUE 1 100 0.00 1.00000000000 BIT_MASK 0x10 FORMAT "%13.11" ECU_ADDRESS 0xFD3E /end MEASUREMENT
/begin MEASUREMENT B_milfon "" UWORD B_TRUE 1 100 0.00 1.00000000000 BIT_MASK 0x20 FORMAT "%13.11" ECU_ADDRESS 0xFD3E /end MEASUREMENT
/begin MEASUREMENT B_milkm "" UBYTE B_TRUE 1 100 0.00 1.00000000000 BIT_MASK 0x1 FORMAT "%13.11" ECU_ADDRESS 0x384004 /end MEASUREMENT
/begin MEASUREMENT B_milrb "" UWORD B_TRUE 1 100 0.00 1.00000000000 BIT_MASK 0x40 FORMAT "%13.11" ECU_ADDRESS 0xFD3E /end MEASUREMENT
/begin MEASUREMENT B_milsf "" UWORD B_TRUE 1 100 0.00 1.00000000000 BIT_MASK 0x80 FORMAT "%13.11" ECU_ADDRESS 0xFD3E /end MEASUREMENT
/begin MEASUREMENT B_milsfint "" UWORD B_TRUE 1 100 0.00 1.00000000000 BIT_MASK 0x100 FORMAT "%13.11" ECU_ADDRESS 0xFD3E /end MEASUREMENT
/begin MEASUREMENT B_milsfr "" UWORD B_TRUE 1 100 0.00 1.00000000000 BIT_MASK 0x4000 FORMAT "%13.11" ECU_ADDRESS 0xFD3C /end MEASUREMENT
/begin MEASUREMENT B_milstat "" UBYTE B_TRUE 1 100 0.00 1.00000000000 BIT_MASK 0x40 FORMAT "%13.11" ECU_ADDRESS 0xF4044 /end MEASUREMENT
/begin MEASUREMENT B_milste "" UWORD B_TRUE 1 100 0.00 1.00000000000 BIT_MASK 0x200 FORMAT "%13.11" ECU_ADDRESS 0xFD3E /end MEASUREMENT
/begin MEASUREMENT B_milvt "" UWORD B_TRUE 1 100 0.00 1.00000000000 BIT_MASK 0x400 FORMAT "%13.11" ECU_ADDRESS 0xFD3E /end MEASUREMENT
/begin MEASUREMENT B_msndko "" UBYTE B_TRUE 1 100 0.00 1.00000000000 BIT_MASK 0x2 FORMAT "%13.11" ECU_ADDRESS 0xF08BB /end MEASUREMENT
/begin MEASUREMENT B_mszsdkb "" UWORD B_TRUE 1 100 0.00 1.00000000000 BIT_MASK 0x1000 FORMAT "%13.11" ECU_ADDRESS 0xFD6C /end MEASUREMENT
/begin MEASUREMENT B_mxrlroh "" UWORD B_TRUE 1 100 0.00 1.00000000000 BIT_MASK 0x2000 FORMAT "%13.11" ECU_ADDRESS 0xFD6C /end MEASUREMENT
/begin MEASUREMENT B_ngasok "" UWORD B_TRUE 1 100 0.00 1.00000000000 BIT_MASK 0x2000 FORMAT "%13.11" ECU_ADDRESS 0xFD3E /end MEASUREMENT
/begin MEASUREMENT B_nlbzakt "" UBYTE B_TRUE 1 100 0.00 1.00000000000 BIT_MASK 0x1 FORMAT "%13.11" ECU_ADDRESS 0xF40A6 /end MEASUREMENT
/begin MEASUREMENT B_nlbzakt2 "" UBYTE B_TRUE 1 100 0.00 1.00000000000 BIT_MASK 0x2 FORMAT "%13.11" ECU_ADDRESS 0xF40A6 /end MEASUREMENT
/begin MEASUREMENT B_nlpe "" UWORD B_TRUE 1 100 0.00 1.00000000000 BIT_MASK 0x800 FORMAT "%13.11" ECU_ADDRESS 0xFD5C /end MEASUREMENT
/begin MEASUREMENT B_nlperf "" UBYTE B_TRUE 1 100 0.00 1.00000000000 BIT_MASK 0x4 FORMAT "%13.11" ECU_ADDRESS 0x38205E /end MEASUREMENT
/begin MEASUREMENT B_nlpnew "" UWORD B_TRUE 1 100 0.00 1.00000000000 BIT_MASK 0x1000 FORMAT "%13.11" ECU_ADDRESS 0xFD5C /end MEASUREMENT
/begin MEASUREMENT B_nlpreq "" UWORD B_TRUE 1 100 0.00 1.00000000000 BIT_MASK 0x2000 FORMAT "%13.11" ECU_ADDRESS 0xFD5C /end MEASUREMENT
/begin MEASUREMENT B_nomil "" UBYTE B_TRUE 1 100 0.00 1.00000000000 BIT_MASK 0x10 FORMAT "%13.11" ECU_ADDRESS 0xF4044 /end MEASUREMENT
/begin MEASUREMENT B_nsp "" UWORD B_TRUE 1 100 0.00 1.00000000000 BIT_MASK 0x100 FORMAT "%13.11" ECU_ADDRESS 0xFD70 /end MEASUREMENT
/begin MEASUREMENT B_nwadaa "" UBYTE B_TRUE 1 100 0.00 1.00000000000 BIT_MASK 0x2 FORMAT "%13.11" ECU_ADDRESS 0xF4192 /end MEASUREMENT
/begin MEASUREMENT B_nwadae "" UBYTE B_TRUE 1 100 0.00 1.00000000000 BIT_MASK 0x10 FORMAT "%13.11" ECU_ADDRESS 0xF4192 /end MEASUREMENT
/begin MEASUREMENT B_nwadaga "" UBYTE B_TRUE 1 100 0.00 1.00000000000 BIT_MASK 0x4 FORMAT "%13.11" ECU_ADDRESS 0xF4192 /end MEASUREMENT
/begin MEASUREMENT B_nwadage "" UBYTE B_TRUE 1 100 0.00 1.00000000000 BIT_MASK 0x20 FORMAT "%13.11" ECU_ADDRESS 0xF4192 /end MEASUREMENT
/begin MEASUREMENT B_nwadagfa "" UBYTE B_TRUE 1 100 0.00 1.00000000000 BIT_MASK 0x4 FORMAT "%13.11" ECU_ADDRESS 0xF4191 /end MEASUREMENT
/begin MEASUREMENT B_nwadagfe "" UBYTE B_TRUE 1 100 0.00 1.00000000000 BIT_MASK 0x20 FORMAT "%13.11" ECU_ADDRESS 0xF4191 /end MEASUREMENT
/begin MEASUREMENT B_nwflada "" UBYTE B_TRUE 1 100 0.00 1.00000000000 BIT_MASK 0x1 FORMAT "%13.11" ECU_ADDRESS 0xF4191 /end MEASUREMENT
/begin MEASUREMENT B_nwflade "" UBYTE B_TRUE 1 100 0.00 1.00000000000 BIT_MASK 0x10 FORMAT "%13.11" ECU_ADDRESS 0xF4191 /end MEASUREMENT
/begin MEASUREMENT B_nwpnrpa "" UBYTE B_TRUE 1 100 0.00 1.00000000000 BIT_MASK 0x8 FORMAT "%13.11" ECU_ADDRESS 0xF4192 /end MEASUREMENT
/begin MEASUREMENT B_nwpnrpe "" UBYTE B_TRUE 1 100 0.00 1.00000000000 BIT_MASK 0x40 FORMAT "%13.11" ECU_ADDRESS 0xF4192 /end MEASUREMENT
/begin MEASUREMENT B_nwrposa "" UBYTE B_TRUE 1 100 0.00 1.00000000000 BIT_MASK 0x2 FORMAT "%13.11" ECU_ADDRESS 0xF4191 /end MEASUREMENT
/begin MEASUREMENT B_nwrpose "" UBYTE B_TRUE 1 100 0.00 1.00000000000 BIT_MASK 0x8 FORMAT "%13.11" ECU_ADDRESS 0xF4191 /end MEASUREMENT
/begin MEASUREMENT B_p1refpos "" UBYTE B_TRUE 1 100 0.00 1.00000000000 BIT_MASK 0x1 FORMAT "%13.11" ECU_ADDRESS 0xF06F9 /end MEASUREMENT
/begin MEASUREMENT B_p2refpos "" UBYTE B_TRUE 1 100 0.00 1.00000000000 BIT_MASK 0x2 FORMAT "%13.11" ECU_ADDRESS 0xF06F9 /end MEASUREMENT
/begin MEASUREMENT B_pbkvmn "" UBYTE B_TRUE 1 100 0.00 1.00000000000 BIT_MASK 0x1 FORMAT "%13.11" ECU_ADDRESS 0xF0C9E /end MEASUREMENT
/begin MEASUREMENT B_pbkvmnp "" UBYTE B_TRUE 1 100 0.00 1.00000000000 BIT_MASK 0x8 FORMAT "%13.11" ECU_ADDRESS 0xF0C9E /end MEASUREMENT
/begin MEASUREMENT B_pltab "" UBYTE B_TRUE 1 100 0.00 1.00000000000 BIT_MASK 0x4 FORMAT "%13.11" ECU_ADDRESS 0xF0912 /end MEASUREMENT
/begin MEASUREMENT B_puerr "" UBYTE B_TRUE 1 100 0.00 1.00000000000 BIT_MASK 0x1 FORMAT "%13.11" ECU_ADDRESS 0xF0BC9 /end MEASUREMENT
/begin MEASUREMENT B_rlp "" UWORD B_TRUE 1 100 0.00 1.00000000000 BIT_MASK 0x200 FORMAT "%13.11" ECU_ADDRESS 0xFD70 /end MEASUREMENT
/begin MEASUREMENT B_rlpns "" UWORD B_TRUE 1 100 0.00 1.00000000000 BIT_MASK 0x400 FORMAT "%13.11" ECU_ADDRESS 0xFD70 /end MEASUREMENT
/begin MEASUREMENT B_sbbvk "" UWORD B_TRUE 1 100 0.00 1.00000000000 BIT_MASK 0x20 FORMAT "%13.11" ECU_ADDRESS 0xFDB2 /end MEASUREMENT
/begin MEASUREMENT B_sbbvk2 "" UWORD B_TRUE 1 100 0.00 1.00000000000 BIT_MASK 0x40 FORMAT "%13.11" ECU_ADDRESS 0xFDB2 /end MEASUREMENT
/begin MEASUREMENT B_sleepi "" UWORD B_TRUE 1 100 0.00 1.00000000000 BIT_MASK 0x8 FORMAT "%13.11" ECU_ADDRESS 0xFD22 /end MEASUREMENT
/begin MEASUREMENT B_st "" UWORD B_TRUE 1 100 0.00 1.00000000000 BIT_MASK 0x800 FORMAT "%13.11" ECU_ADDRESS 0xFDB8 /end MEASUREMENT
/begin MEASUREMENT B_stend "" UWORD B_TRUE 1 100 0.00 1.00000000000 BIT_MASK 0x1000 FORMAT "%13.11" ECU_ADDRESS 0xFDB8 /end MEASUREMENT
/begin MEASUREMENT B_syn2nd "" UWORD B_TRUE 1 100 0.00 1.00000000000 BIT_MASK 0x4000 FORMAT "%13.11" ECU_ADDRESS 0xFD3E /end MEASUREMENT
/begin MEASUREMENT B_tabststp "" UBYTE B_TRUE 1 100 0.00 1.00000000000 BIT_MASK 0x4 FORMAT "%13.11" ECU_ADDRESS 0xF0911 /end MEASUREMENT
/begin MEASUREMENT B_tabuhrof "" UBYTE B_TRUE 1 100 0.00 1.00000000000 BIT_MASK 0x8 FORMAT "%13.11" ECU_ADDRESS 0xF0912 /end MEASUREMENT
/begin MEASUREMENT B_tabunpl "" UBYTE B_TRUE 1 100 0.00 1.00000000000 BIT_MASK 0x10 FORMAT "%13.11" ECU_ADDRESS 0xF0912 /end MEASUREMENT
/begin MEASUREMENT B_tedtev "" UWORD B_TRUE 1 100 0.00 1.00000000000 BIT_MASK 0x800 FORMAT "%13.11" ECU_ADDRESS 0xFD78 /end MEASUREMENT
/begin MEASUREMENT B_tehbxf "" UWORD B_TRUE 1 100 0.00 1.00000000000 BIT_MASK 0x1000 FORMAT "%13.11" ECU_ADDRESS 0xFD78 /end MEASUREMENT
/begin MEASUREMENT B_tep "" UWORD B_TRUE 1 100 0.00 1.00000000000 BIT_MASK 0x2000 FORMAT "%13.11" ECU_ADDRESS 0xFD78 /end MEASUREMENT
/begin MEASUREMENT B_tepi "" UWORD B_TRUE 1 100 0.00 1.00000000000 BIT_MASK 0x4000 FORMAT "%13.11" ECU_ADDRESS 0xFD78 /end MEASUREMENT
/begin MEASUREMENT B_tepzhl "" UWORD B_TRUE 1 100 0.00 1.00000000000 BIT_MASK 0x8000 FORMAT "%13.11" ECU_ADDRESS 0xFD78 /end MEASUREMENT
/begin MEASUREMENT B_tepzus "" UWORD B_TRUE 1 100 0.00 1.00000000000 BIT_MASK 0x1 FORMAT "%13.11" ECU_ADDRESS 0xFD7A /end MEASUREMENT
/begin MEASUREMENT B_tesstp "" UWORD B_TRUE 1 100 0.00 1.00000000000 BIT_MASK 0x2 FORMAT "%13.11" ECU_ADDRESS 0xFD7A /end MEASUREMENT
/begin MEASUREMENT B_testop "" UWORD B_TRUE 1 100 0.00 1.00000000000 BIT_MASK 0x4 FORMAT "%13.11" ECU_ADDRESS 0xFD7A /end MEASUREMENT
/begin MEASUREMENT B_tezstp "" UWORD B_TRUE 1 100 0.00 1.00000000000 BIT_MASK 0x8 FORMAT "%13.11" ECU_ADDRESS 0xFD7A /end MEASUREMENT
/begin MEASUREMENT B_tired "" UWORD B_TRUE 1 100 0.00 1.00000000000 BIT_MASK 0x800 FORMAT "%13.11" ECU_ADDRESS 0xFD70 /end MEASUREMENT
/begin MEASUREMENT B_totab "" UWORD B_TRUE 1 100 0.00 1.00000000000 BIT_MASK 0x8 FORMAT "%13.11" ECU_ADDRESS 0xFD72 /end MEASUREMENT
/begin MEASUREMENT B_totab2 "" UWORD B_TRUE 1 100 0.00 1.00000000000 BIT_MASK 0x10 FORMAT "%13.11" ECU_ADDRESS 0xFD72 /end MEASUREMENT
/begin MEASUREMENT B_trigger "" UWORD B_TRUE 1 100 0.00 1.00000000000 BIT_MASK 0x400 FORMAT "%13.11" ECU_ADDRESS 0xFDB2 /end MEASUREMENT
/begin MEASUREMENT B_tteae "" UWORD B_TRUE 1 100 0.00 1.00000000000 BIT_MASK 0x10 FORMAT "%13.11" ECU_ADDRESS 0xFD7A /end MEASUREMENT
/begin MEASUREMENT B_ttegais "" UWORD B_TRUE 1 100 0.00 1.00000000000 BIT_MASK 0x20 FORMAT "%13.11" ECU_ADDRESS 0xFD7A /end MEASUREMENT
/begin MEASUREMENT B_tumkst "" UBYTE B_TRUE 1 100 0.00 1.00000000000 BIT_MASK 0x2 FORMAT "%13.11" ECU_ADDRESS 0xF0913 /end MEASUREMENT
/begin MEASUREMENT B_tumnpl "" UBYTE B_TRUE 1 100 0.00 1.00000000000 BIT_MASK 0x1 FORMAT "%13.11" ECU_ADDRESS 0xF0913 /end MEASUREMENT
/begin MEASUREMENT B_ugd "" UWORD B_TRUE 1 100 0.00 1.00000000000 BIT_MASK 0x4000 FORMAT "%13.11" ECU_ADDRESS 0xFD6C /end MEASUREMENT
/begin MEASUREMENT B_ugdsp "" UWORD B_TRUE 1 100 0.00 1.00000000000 BIT_MASK 0x1000 FORMAT "%13.11" ECU_ADDRESS 0xFD70 /end MEASUREMENT
/begin MEASUREMENT B_uhrexte "" UBYTE B_TRUE 1 100 0.00 1.00000000000 BIT_MASK 0x1 FORMAT "%13.11" ECU_ADDRESS 0xF0910 /end MEASUREMENT
/begin MEASUREMENT B_uhrextof "" UBYTE B_TRUE 1 100 0.00 1.00000000000 BIT_MASK 0x2 FORMAT "%13.11" ECU_ADDRESS 0xF0910 /end MEASUREMENT
/begin MEASUREMENT B_uhrnpl "" UBYTE B_TRUE 1 100 0.00 1.00000000000 BIT_MASK 0x20 FORMAT "%13.11" ECU_ADDRESS 0xF0912 /end MEASUREMENT
/begin MEASUREMENT B_uhrnpl0 "" UBYTE B_TRUE 1 100 0.00 1.00000000000 BIT_MASK 0x4 FORMAT "%13.11" ECU_ADDRESS 0x382066 /end MEASUREMENT
/begin MEASUREMENT B_uhrnpl1 "" UBYTE B_TRUE 1 100 0.00 1.00000000000 BIT_MASK 0x40 FORMAT "%13.11" ECU_ADDRESS 0xF0912 /end MEASUREMENT
/begin MEASUREMENT B_umae "" UWORD B_TRUE 1 100 0.00 1.00000000000 BIT_MASK 0x4000 FORMAT "%13.11" ECU_ADDRESS 0xFD5C /end MEASUREMENT
/begin MEASUREMENT B_umauab "" UWORD B_TRUE 1 100 0.00 1.00000000000 BIT_MASK 0x8000 FORMAT "%13.11" ECU_ADDRESS 0xFD5C /end MEASUREMENT
/begin MEASUREMENT B_za "" UWORD B_TRUE 1 100 0.00 1.00000000000 BIT_MASK 0x800 FORMAT "%13.11" ECU_ADDRESS 0xFDB2 /end MEASUREMENT
/begin MEASUREMENT B_za2 "" UWORD B_TRUE 1 100 0.00 1.00000000000 BIT_MASK 0x1000 FORMAT "%13.11" ECU_ADDRESS 0xFDB2 /end MEASUREMENT
/begin MEASUREMENT B_zlsv "" UBYTE B_TRUE 1 100 0.00 1.00000000000 BIT_MASK 0x1 FORMAT "%13.11" ECU_ADDRESS 0xF07E5 /end MEASUREMENT
/begin MEASUREMENT B_zlsv2 "" UBYTE B_TRUE 1 100 0.00 1.00000000000 BIT_MASK 0x2 FORMAT "%13.11" ECU_ADDRESS 0xF07E5 /end MEASUREMENT
/begin MEASUREMENT cs_mot5 "" UBYTE dez 1 100 0.00 255.0 FORMAT "%5.1" ECU_ADDRESS 0xF066B /end MEASUREMENT
/begin MEASUREMENT cs_mot6 "" UBYTE dez 1 100 0.00 255.0 FORMAT "%5.1" ECU_ADDRESS 0xF066C /end MEASUREMENT
/begin MEASUREMENT cs_mot8 "" UBYTE dez 1 100 0.00 255.0 FORMAT "%5.1" ECU_ADDRESS 0xF066D /end MEASUREMENT
/begin MEASUREMENT ctr_motorflexia "" UBYTE dez 1 100 0.00 255.0 FORMAT "%5.1" ECU_ADDRESS 0x3801CC /end MEASUREMENT
/begin MEASUREMENT ctr_phada "" UBYTE dez 1 100 0.00 255.0 FORMAT "%5.1" ECU_ADDRESS 0xF4193 /end MEASUREMENT
/begin MEASUREMENT ctr_phade "" UBYTE dez 1 100 0.00 255.0 FORMAT "%5.1" ECU_ADDRESS 0xF4194 /end MEASUREMENT
/begin MEASUREMENT cvnh_w "" UWORD dez 1 100 0.00 65535.00 FORMAT "%8.2" ECU_ADDRESS 0xF440A /end MEASUREMENT
/begin MEASUREMENT cvnl_w "" UWORD dez 1 100 0.00 65535.00 FORMAT "%8.2" ECU_ADDRESS 0xF440C /end MEASUREMENT
/begin MEASUREMENT dfrza2_w "" SWORD fak_sw_b1 1 100 -1.000000 0.9999695 FORMAT "%8.6" ECU_ADDRESS 0xF2830 /end MEASUREMENT
/begin MEASUREMENT dfrzaf2_w "" SWORD fak_sw_b1 1 100 -1.000000 0.9999695 FORMAT "%8.6" ECU_ADDRESS 0xF2832 /end MEASUREMENT
/begin MEASUREMENT dfrzaff2_w "" SWORD fak_sw_b1 1 100 -1.000000 0.9999695 FORMAT "%8.6" ECU_ADDRESS 0xF2834 /end MEASUREMENT
/begin MEASUREMENT dfrzaff_w "" SWORD fak_sw_b1 1 100 -1.000000 0.9999695 FORMAT "%8.6" ECU_ADDRESS 0xF2836 /end MEASUREMENT
/begin MEASUREMENT dfrzaf_w "" SWORD fak_sw_b1 1 100 -1.000000 0.9999695 FORMAT "%8.6" ECU_ADDRESS 0xF2838 /end MEASUREMENT
/begin MEASUREMENT dfrzapr_w "" SWORD fak_sw_b1 1 100 -1.000000 0.9999695 FORMAT "%8.6" ECU_ADDRESS 0xF283A /end MEASUREMENT
/begin MEASUREMENT dfrza_w "" SWORD fak_sw_b1 1 100 -1.000000 0.9999695 FORMAT "%8.6" ECU_ADDRESS 0xF283C /end MEASUREMENT
/begin MEASUREMENT dfuelsan_w "" SWORD fak_sw_b1 1 100 -1.000000 0.9999695 FORMAT "%8.6" ECU_ADDRESS 0xF1CA2 /end MEASUREMENT
/begin MEASUREMENT dfupsrla_w "" SWORD rel_sw_b0p15 1 100 -0.1500000 0.1499954 FORMAT "%9.7" ECU_ADDRESS 0xF1C44 /end MEASUREMENT
/begin MEASUREMENT dfupsrle_w "" SWORD rel_sw_b0p15 1 100 -0.1500000 0.1499954 FORMAT "%9.7" ECU_ADDRESS 0xF1C46 /end MEASUREMENT
/begin MEASUREMENT diffbks2_w "" SWORD fak_sw_b8 1 100 -8.000000 7.999756 FORMAT "%8.6" ECU_ADDRESS 0xF281C /end MEASUREMENT
/begin MEASUREMENT diffbks_w "" SWORD fak_sw_b8 1 100 -8.000000 7.999756 FORMAT "%8.6" ECU_ADDRESS 0xF281E /end MEASUREMENT
/begin MEASUREMENT dkpstg_w "" UWORD rel_uw_b40 1 100 0.00 39.99939 FORMAT "%8.5" ECU_ADDRESS 0xF1AFE /end MEASUREMENT
/begin MEASUREMENT dlamza2_w "" SWORD fak_sw_b1 1 100 -1.000000 0.9999695 FORMAT "%8.6" ECU_ADDRESS 0xF283E /end MEASUREMENT
/begin MEASUREMENT dlamza_w "" SWORD fak_sw_b1 1 100 -1.000000 0.9999695 FORMAT "%8.6" ECU_ADDRESS 0xF2840 /end MEASUREMENT
/begin MEASUREMENT dlrmxt "" UBYTE t50msxs_q0p05 1 100 0.00 12.75 FORMAT "%5.2" ECU_ADDRESS 0xF0843 /end MEASUREMENT
/begin MEASUREMENT dmrfabn_w "" SWORD rel_sw_b100 1 100 -100.0000 99.99695 FORMAT "%8.4" ECU_ADDRESS 0xF4666 /end MEASUREMENT
/begin MEASUREMENT dnmotas_w "" SWORD nmot_sw_q0p25 1 100 -8192.000 8191.750 FORMAT "%8.3" ECU_ADDRESS 0xF1706 /end MEASUREMENT
/begin MEASUREMENT dnmot_w "" SWORD nmot_sw_q0p25 1 100 -8192.000 8191.750 FORMAT "%8.3" ECU_ADDRESS 0xF1708 /end MEASUREMENT
/begin MEASUREMENT dpabvhk2_w "" UWORD p_uw_q0p039 1 100 0.00 2559.961 FORMAT "%8.3" ECU_ADDRESS 0xF45A2 /end MEASUREMENT
/begin MEASUREMENT dpabvhk_w "" UWORD p_uw_q0p039 1 100 0.00 2559.961 FORMAT "%8.3" ECU_ADDRESS 0xF45A4 /end MEASUREMENT
/begin MEASUREMENT dpabvvk_w "" UWORD p_uw_q0p039 1 100 0.00 2559.961 FORMAT "%8.3" ECU_ADDRESS 0xF45A6 /end MEASUREMENT
/begin MEASUREMENT dpbkvukb_w "" UWORD p_uw_q0p039 1 100 0.00 2559.961 FORMAT "%8.3" ECU_ADDRESS 0xF2CF8 /end MEASUREMENT
/begin MEASUREMENT dpbkvukk_w "" UWORD p_uw_q0p039 1 100 0.00 2559.961 FORMAT "%8.3" ECU_ADDRESS 0xF2CFA /end MEASUREMENT
/begin MEASUREMENT dpbkvukp_w "" UWORD p_uw_q0p039 1 100 0.00 2559.961 FORMAT "%8.3" ECU_ADDRESS 0xF2CFC /end MEASUREMENT
/begin MEASUREMENT dpbkvukr_w "" UWORD p_uw_q0p039 1 100 0.00 2559.961 FORMAT "%8.3" ECU_ADDRESS 0xF2CFE /end MEASUREMENT
/begin MEASUREMENT dpbkvuk_w "" UWORD p_uw_q0p039 1 100 0.00 2559.961 FORMAT "%8.3" ECU_ADDRESS 0xF2D00 /end MEASUREMENT
/begin MEASUREMENT dpbkvunw_w "" UWORD p_uw_q0p039 1 100 0.00 2559.961 FORMAT "%8.3" ECU_ADDRESS 0xF2D02 /end MEASUREMENT
/begin MEASUREMENT dpbra_w "" SWORD p_sw_q0p039 1 100 -1280.000 1279.961 FORMAT "%8.3" ECU_ADDRESS 0xF1C48 /end MEASUREMENT
/begin MEASUREMENT dpbre_w "" SWORD p_sw_q0p039 1 100 -1280.000 1279.961 FORMAT "%8.3" ECU_ADDRESS 0xF1C4A /end MEASUREMENT
/begin MEASUREMENT dpbukkb_w "" UWORD p_uw_q0p039 1 100 0.00 2559.961 FORMAT "%8.3" ECU_ADDRESS 0xF2D04 /end MEASUREMENT
/begin MEASUREMENT dpbukk_w "" UWORD p_uw_q0p039 1 100 0.00 2559.961 FORMAT "%8.3" ECU_ADDRESS 0xF2D06 /end MEASUREMENT
/begin MEASUREMENT dpbuknwb_w "" UWORD p_uw_q0p039 1 100 0.00 2559.961 FORMAT "%8.3" ECU_ADDRESS 0xF2D08 /end MEASUREMENT
/begin MEASUREMENT dpbuknw_w "" UWORD p_uw_q0p039 1 100 0.00 2559.961 FORMAT "%8.3" ECU_ADDRESS 0xF2D0A /end MEASUREMENT
/begin MEASUREMENT dpbukpb_w "" UWORD p_uw_q0p039 1 100 0.00 2559.961 FORMAT "%8.3" ECU_ADDRESS 0xF2D0C /end MEASUREMENT
/begin MEASUREMENT dpbukp_w "" UWORD p_uw_q0p039 1 100 0.00 2559.961 FORMAT "%8.3" ECU_ADDRESS 0xF2D0E /end MEASUREMENT
/begin MEASUREMENT dpsdvs_w "" SWORD p_sw_q0p039 1 100 -1280.000 1279.961 FORMAT "%8.3" ECU_ADDRESS 0xF1E70 /end MEASUREMENT
/begin MEASUREMENT dpsmp_w "" SWORD p_sw_q0p039 1 100 -1280.000 1279.961 FORMAT "%8.3" ECU_ADDRESS 0xF1E72 /end MEASUREMENT
/begin MEASUREMENT drlas_w "" SWORD rel_q0p02344 1 100 -768.0000 767.9766 FORMAT "%8.4" ECU_ADDRESS 0xF1D1C /end MEASUREMENT
/begin MEASUREMENT drllad_w "" SWORD rel_sw_q0p0234 1 100 -768.0000 767.9766 FORMAT "%8.4" ECU_ADDRESS 0xF1CA4 /end MEASUREMENT
/begin MEASUREMENT drlp_w "" SWORD rel_sw_q0p0234 1 100 -768.0000 767.9766 FORMAT "%8.4" ECU_ADDRESS 0xE18A /end MEASUREMENT
/begin MEASUREMENT dtbrt_w "" SWORD temp_sw_q0p75 1 100 -24576.00 24575.25 FORMAT "%8.2" ECU_ADDRESS 0xF45FA /end MEASUREMENT
/begin MEASUREMENT dveadchst "" UBYTE dez 1 100 0.00 255.0 FORMAT "%5.1" ECU_ADDRESS 0xF0844 /end MEASUREMENT
/begin MEASUREMENT dv_hl "" SWORD vrad_uw_b655 1 100 -327.5000 327.4900 FORMAT "%8.4" ECU_ADDRESS 0xF29DE /end MEASUREMENT
/begin MEASUREMENT dv_hr "" SWORD vrad_uw_b655 1 100 -327.5000 327.4900 FORMAT "%8.4" ECU_ADDRESS 0xF29E0 /end MEASUREMENT
/begin MEASUREMENT dv_vl "" SWORD vrad_uw_b655 1 100 -327.5000 327.4900 FORMAT "%8.4" ECU_ADDRESS 0xF29E2 /end MEASUREMENT
/begin MEASUREMENT dv_vr "" SWORD vrad_uw_b655 1 100 -327.5000 327.4900 FORMAT "%8.4" ECU_ADDRESS 0xF29E4 /end MEASUREMENT
/begin MEASUREMENT dv_w "" SWORD vrad_uw_b655 1 100 -327.5000 327.4900 FORMAT "%8.4" ECU_ADDRESS 0xF29E6 /end MEASUREMENT
/begin MEASUREMENT dwnrfiie_w "" SWORD kw_q0p0078 1 100 -256.0000 255.9922 FORMAT "%8.4" ECU_ADDRESS 0xF2B66 /end MEASUREMENT
/begin MEASUREMENT dwnrfipe_w "" SWORD kw_q0p0078 1 100 -256.0000 255.9922 FORMAT "%8.4" ECU_ADDRESS 0xF2B68 /end MEASUREMENT
/begin MEASUREMENT dwnrfixe_w "" SWORD kw_q0p0078 1 100 -256.0000 255.9922 FORMAT "%8.4" ECU_ADDRESS 0xF2B6A /end MEASUREMENT
/begin MEASUREMENT dwnsrfie_w "" SWORD kw_q0p0078 1 100 -256.0000 255.9922 FORMAT "%8.4" ECU_ADDRESS 0xF2B6C /end MEASUREMENT
/begin MEASUREMENT evabkor2_w "" UWORD fak_uw_b32 1 100 0.00 31.99951 FORMAT "%8.5" ECU_ADDRESS 0xF1EA2 /end MEASUREMENT
/begin MEASUREMENT evabkor_w "" UWORD fak_uw_b32 1 100 0.00 31.99951 FORMAT "%8.5" ECU_ADDRESS 0xF1EA4 /end MEASUREMENT
/begin MEASUREMENT evtmod "" UBYTE temp_ub_q0p75_o48 1 100 -48.00 143.3 FORMAT "%5.1" ECU_ADDRESS 0xF40C8 /end MEASUREMENT
/begin MEASUREMENT faftekf "" UBYTE fak_ub_b2 1 100 0.00 1.992 FORMAT "%5.3" ECU_ADDRESS 0xF0BCA /end MEASUREMENT
/begin MEASUREMENT fafte_w "" UWORD fak_uw_b2 1 100 0.00 1.999969 FORMAT "%8.6" ECU_ADDRESS 0xF2AE6 /end MEASUREMENT
/begin MEASUREMENT ffupsrlk_w "" UWORD fak_uw_b2 1 100 0.00 1.999969 FORMAT "%8.6" ECU_ADDRESS 0xF1C4C /end MEASUREMENT
/begin MEASUREMENT fgnsol "" UBYTE rel_ub_b99p6 1 100 0.00 99.61 FORMAT "%5.2" ECU_ADDRESS 0xF0AE9 /end MEASUREMENT
/begin MEASUREMENT fkisrm_w "" UWORD fak_uw_b1 1 100 0.00 0.9999847 FORMAT "%9.7" ECU_ADDRESS 0xF45BE /end MEASUREMENT
/begin MEASUREMENT fklaf_w "" UWORD fak_uw_b1 1 100 0.00 0.9999847 FORMAT "%9.7" ECU_ADDRESS 0xF1CA6 /end MEASUREMENT
/begin MEASUREMENT fkmsdkg_w "" UWORD fak_uw_b4 1 100 0.00 3.999939 FORMAT "%8.6" ECU_ADDRESS 0xF1CA8 /end MEASUREMENT
/begin MEASUREMENT fkmsdksg_w "" UWORD fak_uw_b4 1 100 0.00 3.999939 FORMAT "%8.6" ECU_ADDRESS 0xF1CAA /end MEASUREMENT
/begin MEASUREMENT fkmsdks_w "" UWORD fak_uw_b4 1 100 0.00 3.999939 FORMAT "%8.6" ECU_ADDRESS 0xF1CAC /end MEASUREMENT
/begin MEASUREMENT fkmsdk_w "" UWORD fak_uw_b4 1 100 0.00 3.999939 FORMAT "%8.6" ECU_ADDRESS 0xF1CAE /end MEASUREMENT
/begin MEASUREMENT fkpvdkg_w "" UWORD fak_uw_b4 1 100 0.00 3.999939 FORMAT "%8.6" ECU_ADDRESS 0x382EEA /end MEASUREMENT
/begin MEASUREMENT fkpvdk_w "" UWORD fak_uw_b4 1 100 0.00 3.999939 FORMAT "%8.6" ECU_ADDRESS 0x38406C /end MEASUREMENT
/begin MEASUREMENT flamagr "" UBYTE fak_ub_b2 1 100 0.00 1.992 FORMAT "%5.3" ECU_ADDRESS 0xF0B74 /end MEASUREMENT
/begin MEASUREMENT flamagr2 "" UBYTE fak_ub_b2 1 100 0.00 1.992 FORMAT "%5.3" ECU_ADDRESS 0xF0B75 /end MEASUREMENT
/begin MEASUREMENT flamsls "" UBYTE fak_ub_b2 1 100 0.00 1.992 FORMAT "%5.3" ECU_ADDRESS 0xF0B76 /end MEASUREMENT
/begin MEASUREMENT flamsls2 "" UBYTE fak_ub_b2 1 100 0.00 1.992 FORMAT "%5.3" ECU_ADDRESS 0xF0B77 /end MEASUREMENT
/begin MEASUREMENT flamslsi "" UBYTE fak_ub_b2 1 100 0.00 1.992 FORMAT "%5.3" ECU_ADDRESS 0xF0B78 /end MEASUREMENT
/begin MEASUREMENT fpabnav2_w "" UWORD fak_uw_b8 1 100 0.00 7.999878 FORMAT "%8.6" ECU_ADDRESS 0xF45A8 /end MEASUREMENT
/begin MEASUREMENT fpabnav_w "" UWORD fak_uw_b8 1 100 0.00 7.999878 FORMAT "%8.6" ECU_ADDRESS 0xF45AA /end MEASUREMENT
/begin MEASUREMENT fprgagps_w "" UWORD fak_uw_b2 1 100 0.00 1.999969 FORMAT "%8.6" ECU_ADDRESS 0xF45C0 /end MEASUREMENT
/begin MEASUREMENT fprstep_c "" UBYTE dez 1 100 0.00 255.0 FORMAT "%5.1" ECU_ADDRESS 0xF0845 /end MEASUREMENT
/begin MEASUREMENT fprtim_c "" UBYTE t10msxs_ub_b2p55 1 100 0.00 2.550 FORMAT "%5.3" ECU_ADDRESS 0xF0846 /end MEASUREMENT
/begin MEASUREMENT fpsrlroa_w "" UWORD rel_uw_b0p3 1 100 0.00 0.2999954 FORMAT "%9.7" ECU_ADDRESS 0xF45C2 /end MEASUREMENT
/begin MEASUREMENT fpsrlroe_w "" UWORD rel_uw_b0p3 1 100 0.00 0.2999954 FORMAT "%9.7" ECU_ADDRESS 0xF45C4 /end MEASUREMENT
/begin MEASUREMENT fpvdk "" UBYTE fak_ub_b4 1 100 0.00 3.984 FORMAT "%5.3" ECU_ADDRESS 0xF08BC /end MEASUREMENT
/begin MEASUREMENT fpvdk_w "" UWORD fak_uw_b4 1 100 0.00 3.999939 FORMAT "%8.6" ECU_ADDRESS 0xF1CB0 /end MEASUREMENT
/begin MEASUREMENT fpvhk2_w "" UWORD fak_q16_hPahPa 1 100 0.00 1048560. FORMAT "%8.0" ECU_ADDRESS 0xF45AC /end MEASUREMENT
/begin MEASUREMENT fpvhkt "" UBYTE fak_q20_hPahPa_mul_h_div_kg 1 100 0.00 5100. FORMAT "%5.0" ECU_ADDRESS 0xF40C2 /end MEASUREMENT
/begin MEASUREMENT fpvhkt2 "" UBYTE fak_q20_hPahPa_mul_h_div_kg 1 100 0.00 5100. FORMAT "%5.0" ECU_ADDRESS 0xF40C3 /end MEASUREMENT
/begin MEASUREMENT fpvhk_w "" UWORD fak_q16_hPahPa 1 100 0.00 1048560. FORMAT "%8.0" ECU_ADDRESS 0xF45AE /end MEASUREMENT
/begin MEASUREMENT fpvvkt "" UBYTE fak_q20_hPahPa_mul_h_div_kg 1 100 0.00 5100. FORMAT "%5.0" ECU_ADDRESS 0xF40C4 /end MEASUREMENT
/begin MEASUREMENT fpvvk_w "" UWORD fak_q16_hPahPa 1 100 0.00 1048560. FORMAT "%8.0" ECU_ADDRESS 0xF45B0 /end MEASUREMENT
/begin MEASUREMENT frhodk_w "" UWORD fak_uw_b2 1 100 0.00 1.999969 FORMAT "%8.6" ECU_ADDRESS 0xF1CB2 /end MEASUREMENT
/begin MEASUREMENT ftbr "" UBYTE fak_ub_b2 1 100 0.00 1.992 FORMAT "%5.3" ECU_ADDRESS 0xF40C9 /end MEASUREMENT
/begin MEASUREMENT ftbr_w "" UWORD fak_uw_b2 1 100 0.00 1.999969 FORMAT "%8.6" ECU_ADDRESS 0xF45FC /end MEASUREMENT
/begin MEASUREMENT ftho_w "" UWORD fak_uw_b2 1 100 0.00 1.999969 FORMAT "%8.6" ECU_ADDRESS 0xF4F36 /end MEASUREMENT
/begin MEASUREMENT ftsr "" UBYTE fak_ub_b2 1 100 0.00 1.992 FORMAT "%5.3" ECU_ADDRESS 0xF40CA /end MEASUREMENT
/begin MEASUREMENT ftu "" UBYTE fak_ub_b2 1 100 0.00 1.992 FORMAT "%5.3" ECU_ADDRESS 0xF40CB /end MEASUREMENT
/begin MEASUREMENT ftvdk "" UBYTE fak_ub_b2 1 100 0.00 1.992 FORMAT "%5.3" ECU_ADDRESS 0xF08C0 /end MEASUREMENT
/begin MEASUREMENT ftw "" UBYTE fak_ub_b2 1 100 0.00 1.992 FORMAT "%5.3" ECU_ADDRESS 0xF40CC /end MEASUREMENT
/begin MEASUREMENT fupsrlro_w "" UWORD rel_uw_b0p3 1 100 0.00 0.2999954 FORMAT "%9.7" ECU_ADDRESS 0xF45C6 /end MEASUREMENT
/begin MEASUREMENT fupsrluk_w "" UWORD rel_uw_b0p3 1 100 0.00 0.2999954 FORMAT "%9.7" ECU_ADDRESS 0xF45C8 /end MEASUREMENT
/begin MEASUREMENT fupsrl_w "" UWORD rel_uw_b0p3 1 100 0.00 0.2999954 FORMAT "%9.7" ECU_ADDRESS 0xF45CA /end MEASUREMENT
/begin MEASUREMENT furla_w "" UWORD rel_uw_b0p3 1 100 0.00 0.2999954 FORMAT "%9.7" ECU_ADDRESS 0xF1C4E /end MEASUREMENT
/begin MEASUREMENT furle_w "" UWORD rel_uw_b0p3 1 100 0.00 0.2999954 FORMAT "%9.7" ECU_ADDRESS 0xF1C50 /end MEASUREMENT
/begin MEASUREMENT furlsua_w "" UWORD rel_uw_b0p3 1 100 0.00 0.2999954 FORMAT "%9.7" ECU_ADDRESS 0xF1C52 /end MEASUREMENT
/begin MEASUREMENT furlsue_w "" UWORD rel_uw_b0p3 1 100 0.00 0.2999954 FORMAT "%9.7" ECU_ADDRESS 0xF1C54 /end MEASUREMENT
/begin MEASUREMENT fvisrm_w "" UWORD p_uw_b32 1 100 0.00 31.99951 FORMAT "%8.5" ECU_ADDRESS 0xF45CC /end MEASUREMENT
/begin MEASUREMENT fwnwvs_w "" UWORD fak_uw_b2 1 100 0.00 1.999969 FORMAT "%8.6" ECU_ADDRESS 0xF1C56 /end MEASUREMENT
/begin MEASUREMENT fwprs_w "" UWORD fak_uw_b32 1 100 0.00 31.99951 FORMAT "%8.5" ECU_ADDRESS 0xF1E74 /end MEASUREMENT
/begin MEASUREMENT irspsyn "" UBYTE dez 1 100 0.00 255.0 FORMAT "%5.1" ECU_ADDRESS 0xF06E9 /end MEASUREMENT
/begin MEASUREMENT klaf_kge "" UWORD fak_uw_q0p001 1 100 0.00 65.53500 FORMAT "%8.5" ECU_ADDRESS 0xF1CB4 /end MEASUREMENT
/begin MEASUREMENT kmdp1km_w "" UWORD s_q1_km 1 100 0.00 65535.00 FORMAT "%8.2" ECU_ADDRESS 0x38405A /end MEASUREMENT
/begin MEASUREMENT kmp6km_w "" UWORD s_q6_km 1 100 0.00 393210.0 FORMAT "%8.1" ECU_ADDRESS 0x38405C /end MEASUREMENT
/begin MEASUREMENT kmstl_w "" UWORD s_q6_km 1 100 0.00 393210.0 FORMAT "%8.1" ECU_ADDRESS 0xF43EE /end MEASUREMENT
/begin MEASUREMENT kmstmil_w "" UWORD s_q1_km 1 100 0.00 65535.00 FORMAT "%8.2" ECU_ADDRESS 0x38405E /end MEASUREMENT
/begin MEASUREMENT kmst_w "" UWORD s_q6_km 1 100 0.00 393210.0 FORMAT "%8.1" ECU_ADDRESS 0x384060 /end MEASUREMENT
/begin MEASUREMENT labbrm2_w "" UWORD fak_uw_b16 1 100 0.00 15.99976 FORMAT "%8.5" ECU_ADDRESS 0xF1EA6 /end MEASUREMENT
/begin MEASUREMENT labbrm_w "" UWORD fak_uw_b16 1 100 0.00 15.99976 FORMAT "%8.5" ECU_ADDRESS 0xF1EA8 /end MEASUREMENT
/begin MEASUREMENT labrgs2_w "" UWORD fak_uw_b16 1 100 0.00 15.99976 FORMAT "%8.5" ECU_ADDRESS 0xF1EAA /end MEASUREMENT
/begin MEASUREMENT labrgs_w "" UWORD fak_uw_b16 1 100 0.00 15.99976 FORMAT "%8.5" ECU_ADDRESS 0xF1EAC /end MEASUREMENT
/begin MEASUREMENT lalsuvj2_w "" UWORD fak_uw_b2 1 100 0.00 1.999969 FORMAT "%8.6" ECU_ADDRESS 0xF2820 /end MEASUREMENT
/begin MEASUREMENT lalsuvj_w "" UWORD fak_uw_b2 1 100 0.00 1.999969 FORMAT "%8.6" ECU_ADDRESS 0xF2822 /end MEASUREMENT
/begin MEASUREMENT lamsbrs2_w "" UWORD fak_uw_b16 1 100 0.00 15.99976 FORMAT "%8.5" ECU_ADDRESS 0xF1EAE /end MEASUREMENT
/begin MEASUREMENT lamsbrs_w "" UWORD fak_uw_b16 1 100 0.00 15.99976 FORMAT "%8.5" ECU_ADDRESS 0xF1EB0 /end MEASUREMENT
/begin MEASUREMENT lamsobk2_w "" UWORD fak_uw_b16 1 100 0.00 15.99976 FORMAT "%8.5" ECU_ADDRESS 0xF2824 /end MEASUREMENT
/begin MEASUREMENT lamsobk_w "" UWORD fak_uw_b16 1 100 0.00 15.99976 FORMAT "%8.5" ECU_ADDRESS 0xF2826 /end MEASUREMENT
/begin MEASUREMENT lamsonb2_w "" UWORD fak_uw_b16 1 100 0.00 15.99976 FORMAT "%8.5" ECU_ADDRESS 0xF2828 /end MEASUREMENT
/begin MEASUREMENT lamsonb_w "" UWORD fak_uw_b16 1 100 0.00 15.99976 FORMAT "%8.5" ECU_ADDRESS 0xF282A /end MEASUREMENT
/begin MEASUREMENT lamsoni2_w "" UWORD fak_uw_b16 1 100 0.00 15.99976 FORMAT "%8.5" ECU_ADDRESS 0xF282C /end MEASUREMENT
/begin MEASUREMENT lamsoni_w "" UWORD fak_uw_b16 1 100 0.00 15.99976 FORMAT "%8.5" ECU_ADDRESS 0xF282E /end MEASUREMENT
/begin MEASUREMENT lamsons2_w "" UWORD fak_uw_b16 1 100 0.00 15.99976 FORMAT "%8.5" ECU_ADDRESS 0xF1EB2 /end MEASUREMENT
/begin MEASUREMENT lamsons_w "" UWORD fak_uw_b16 1 100 0.00 15.99976 FORMAT "%8.5" ECU_ADDRESS 0xF1EB4 /end MEASUREMENT
/begin MEASUREMENT laoikrm2_w "" UWORD fak_uw_b16 1 100 0.00 15.99976 FORMAT "%8.5" ECU_ADDRESS 0xF1EB6 /end MEASUREMENT
/begin MEASUREMENT laoikrm_w "" UWORD fak_uw_b16 1 100 0.00 15.99976 FORMAT "%8.5" ECU_ADDRESS 0xF1EB8 /end MEASUREMENT
/begin MEASUREMENT laontlm2_w "" UWORD fak_uw_b16 1 100 0.00 15.99976 FORMAT "%8.5" ECU_ADDRESS 0xF1EBA /end MEASUREMENT
/begin MEASUREMENT laontlm_w "" UWORD fak_uw_b16 1 100 0.00 15.99976 FORMAT "%8.5" ECU_ADDRESS 0xF1EBC /end MEASUREMENT
/begin MEASUREMENT laonvkm2_w "" UWORD fak_uw_b16 1 100 0.00 15.99976 FORMAT "%8.5" ECU_ADDRESS 0xF1EBE /end MEASUREMENT
/begin MEASUREMENT laonvkm_w "" UWORD fak_uw_b16 1 100 0.00 15.99976 FORMAT "%8.5" ECU_ADDRESS 0xF1EC0 /end MEASUREMENT
/begin MEASUREMENT lbz "" UBYTE rel_ub_b100 1 100 0.00 99.61 FORMAT "%5.2" ECU_ADDRESS 0xF40A7 /end MEASUREMENT
/begin MEASUREMENT lrnstat "" UBYTE dez 1 100 0.00 255.0 FORMAT "%5.1" ECU_ADDRESS 0xF0847 /end MEASUREMENT
/begin MEASUREMENT lrnstep_c "" UBYTE dez 1 100 0.00 255.0 FORMAT "%5.1" ECU_ADDRESS 0xF0848 /end MEASUREMENT
/begin MEASUREMENT lrntim_c "" UBYTE t20msxs_ub_b5p1 1 100 0.00 5.100 FORMAT "%5.3" ECU_ADDRESS 0xF0849 /end MEASUREMENT
/begin MEASUREMENT lrnvb_c "" UWORD t20msxs_uw_q0p02 1 100 0.00 1310.700 FORMAT "%8.3" ECU_ADDRESS 0xF1B00 /end MEASUREMENT
/begin MEASUREMENT lrstza_w "" UWORD t10msxs_uw_b655p35 1 100 0.00 655.3500 FORMAT "%8.4" ECU_ADDRESS 0xF2842 /end MEASUREMENT
/begin MEASUREMENT lrsza "" UBYTE fak_ub_b0p25 1 100 0.00 0.249023438 FORMAT "%11.9" ECU_ADDRESS 0xF0B79 /end MEASUREMENT
/begin MEASUREMENT mabghks2_w "" UWORD m_q2p777Em5 1 100 0.00 1.820417 FORMAT "%8.6" ECU_ADDRESS 0xF4460 /end MEASUREMENT
/begin MEASUREMENT mabghks_w "" UWORD m_q2p777Em5 1 100 0.00 1.820417 FORMAT "%8.6" ECU_ADDRESS 0xF4462 /end MEASUREMENT
/begin MEASUREMENT mabikrs2_w "" UWORD m_q2p777Em5 1 100 0.00 1.820417 FORMAT "%8.6" ECU_ADDRESS 0xF4464 /end MEASUREMENT
/begin MEASUREMENT mabikrs_w "" UWORD m_q2p777Em5 1 100 0.00 1.820417 FORMAT "%8.6" ECU_ADDRESS 0xF4466 /end MEASUREMENT
/begin MEASUREMENT mabnavs2_w "" UWORD m_q2p777Em5 1 100 0.00 1.820417 FORMAT "%8.6" ECU_ADDRESS 0xF4468 /end MEASUREMENT
/begin MEASUREMENT mabnavs_w "" UWORD m_q2p777Em5 1 100 0.00 1.820417 FORMAT "%8.6" ECU_ADDRESS 0xF446A /end MEASUREMENT
/begin MEASUREMENT mabnhks2_w "" UWORD m_q2p777Em5 1 100 0.00 1.820417 FORMAT "%8.6" ECU_ADDRESS 0xF446C /end MEASUREMENT
/begin MEASUREMENT mabnhks_w "" UWORD m_q2p777Em5 1 100 0.00 1.820417 FORMAT "%8.6" ECU_ADDRESS 0xF446E /end MEASUREMENT
/begin MEASUREMENT mabnvks2_w "" UWORD m_q2p777Em5 1 100 0.00 1.820417 FORMAT "%8.6" ECU_ADDRESS 0xF4470 /end MEASUREMENT
/begin MEASUREMENT mabnvks_w "" UWORD m_q2p777Em5 1 100 0.00 1.820417 FORMAT "%8.6" ECU_ADDRESS 0xF4472 /end MEASUREMENT
/begin MEASUREMENT mabvhks2_w "" UWORD m_q2p777Em5 1 100 0.00 1.820417 FORMAT "%8.6" ECU_ADDRESS 0xF4474 /end MEASUREMENT
/begin MEASUREMENT mabvhks_w "" UWORD m_q2p777Em5 1 100 0.00 1.820417 FORMAT "%8.6" ECU_ADDRESS 0xF4476 /end MEASUREMENT
/begin MEASUREMENT mabvvks2_w "" UWORD m_q2p777Em5 1 100 0.00 1.820417 FORMAT "%8.6" ECU_ADDRESS 0xF4478 /end MEASUREMENT
/begin MEASUREMENT mabvvks_w "" UWORD m_q2p777Em5 1 100 0.00 1.820417 FORMAT "%8.6" ECU_ADDRESS 0xF447A /end MEASUREMENT
/begin MEASUREMENT milactsfc "" UBYTE dez 1 100 0.00 255.0 FORMAT "%5.1" ECU_ADDRESS 0xF4043 /end MEASUREMENT
/begin MEASUREMENT milactsf_w "" UWORD dez 1 100 0.00 65535.00 FORMAT "%8.2" ARRAY_SIZE 12 ECU_ADDRESS 0xF43F0 /end MEASUREMENT
/begin MEASUREMENT milstat "" UBYTE dez 1 100 0.00 255.0 FORMAT "%5.1" ECU_ADDRESS 0xF4044 /end MEASUREMENT
/begin MEASUREMENT milstate_w "" UWORD dez 1 100 0.00 65535.00 FORMAT "%8.2" ECU_ADDRESS 0xF4408 /end MEASUREMENT
/begin MEASUREMENT milstatnov "" UBYTE dez 1 100 0.00 255.0 FORMAT "%5.1" ECU_ADDRESS 0x384004 /end MEASUREMENT
/begin MEASUREMENT mlbb2_w "" UWORD m_uw_b6553p5 1 100 0.00 6553.500 FORMAT "%8.3" ECU_ADDRESS 0xF186C /end MEASUREMENT
/begin MEASUREMENT mlbb_w "" UWORD m_uw_b6553p5 1 100 0.00 6553.500 FORMAT "%8.3" ECU_ADDRESS 0xF186E /end MEASUREMENT
/begin MEASUREMENT mleitmx_w "" UWORD m_q2p71Em5_g 1 100 0.00 1.777753 FORMAT "%8.6" ECU_ADDRESS 0xF2AE8 /end MEASUREMENT
/begin MEASUREMENT mleit_w "" UWORD m_q2p71Em5_g 1 100 0.00 1.777753 FORMAT "%8.6" ECU_ADDRESS 0xF2AEA /end MEASUREMENT
/begin MEASUREMENT Motor_6_100 "" UBYTE dez 1 100 0.00 255.0 FORMAT "%5.1" ECU_ADDRESS 0xF144E /end MEASUREMENT
/begin MEASUREMENT mrfabn "" UBYTE rel_ub_b100 1 100 0.00 99.61 FORMAT "%5.2" ECU_ADDRESS 0xF40EB /end MEASUREMENT
/begin MEASUREMENT mrfabnf "" UBYTE rel_ub_b100 1 100 0.00 99.61 FORMAT "%5.2" ECU_ADDRESS 0xF40EC /end MEASUREMENT
/begin MEASUREMENT msabg "" UBYTE m_ub_b1020 1 100 0.00 1020. FORMAT "%5.0" ECU_ADDRESS 0xF0752 /end MEASUREMENT
/begin MEASUREMENT msabg2 "" UBYTE m_ub_b1020 1 100 0.00 1020. FORMAT "%5.0" ECU_ADDRESS 0xF0753 /end MEASUREMENT
/begin MEASUREMENT msabg2_w "" UWORD m_uw_b6553p5 1 100 0.00 6553.500 FORMAT "%8.3" ECU_ADDRESS 0xF1870 /end MEASUREMENT
/begin MEASUREMENT msabghk2_w "" UWORD m_uw_b6553p5 1 100 0.00 6553.500 FORMAT "%8.3" ECU_ADDRESS 0xF1872 /end MEASUREMENT
/begin MEASUREMENT msabghk_w "" UWORD m_uw_b6553p5 1 100 0.00 6553.500 FORMAT "%8.3" ECU_ADDRESS 0xF1874 /end MEASUREMENT
/begin MEASUREMENT msabgs2_w "" UWORD m_q2p777Em5 1 100 0.00 1.820417 FORMAT "%8.6" ECU_ADDRESS 0xF447C /end MEASUREMENT
/begin MEASUREMENT msabgs_w "" UWORD m_q2p777Em5 1 100 0.00 1.820417 FORMAT "%8.6" ECU_ADDRESS 0xF447E /end MEASUREMENT
/begin MEASUREMENT msabg_w "" UWORD m_uw_b6553p5 1 100 0.00 6553.500 FORMAT "%8.3" ECU_ADDRESS 0xF1876 /end MEASUREMENT
/begin MEASUREMENT msabikr2_w "" UWORD m_uw_b6553p5 1 100 0.00 6553.500 FORMAT "%8.3" ECU_ADDRESS 0xF1878 /end MEASUREMENT
/begin MEASUREMENT msabikr_w "" UWORD m_uw_b6553p5 1 100 0.00 6553.500 FORMAT "%8.3" ECU_ADDRESS 0xF187A /end MEASUREMENT
/begin MEASUREMENT msabmod_w "" UWORD m_uw_b6553p5 1 100 0.00 6553.500 FORMAT "%8.3" ECU_ADDRESS 0xF2844 /end MEASUREMENT
/begin MEASUREMENT msabnav2_w "" UWORD m_uw_b6553p5 1 100 0.00 6553.500 FORMAT "%8.3" ECU_ADDRESS 0xF187C /end MEASUREMENT
/begin MEASUREMENT msabnav_w "" UWORD m_uw_b6553p5 1 100 0.00 6553.500 FORMAT "%8.3" ECU_ADDRESS 0xF187E /end MEASUREMENT
/begin MEASUREMENT msabnhk2_w "" UWORD m_uw_b6553p5 1 100 0.00 6553.500 FORMAT "%8.3" ECU_ADDRESS 0xF1880 /end MEASUREMENT
/begin MEASUREMENT msabnhk_w "" UWORD m_uw_b6553p5 1 100 0.00 6553.500 FORMAT "%8.3" ECU_ADDRESS 0xF1882 /end MEASUREMENT
/begin MEASUREMENT msabnvk2_w "" UWORD m_uw_b6553p5 1 100 0.00 6553.500 FORMAT "%8.3" ECU_ADDRESS 0xF1884 /end MEASUREMENT
/begin MEASUREMENT msabnvk_w "" UWORD m_uw_b6553p5 1 100 0.00 6553.500 FORMAT "%8.3" ECU_ADDRESS 0xF1886 /end MEASUREMENT
/begin MEASUREMENT msabvhk2_w "" UWORD m_uw_b6553p5 1 100 0.00 6553.500 FORMAT "%8.3" ECU_ADDRESS 0xF1888 /end MEASUREMENT
/begin MEASUREMENT msabvhk_w "" UWORD m_uw_b6553p5 1 100 0.00 6553.500 FORMAT "%8.3" ECU_ADDRESS 0xF188A /end MEASUREMENT
/begin MEASUREMENT msabvvk2_w "" UWORD m_uw_b6553p5 1 100 0.00 6553.500 FORMAT "%8.3" ECU_ADDRESS 0xF188C /end MEASUREMENT
/begin MEASUREMENT msabvvk_w "" UWORD m_uw_b6553p5 1 100 0.00 6553.500 FORMAT "%8.3" ECU_ADDRESS 0xF188E /end MEASUREMENT
/begin MEASUREMENT msaovvk2_w "" UWORD m_uw_b6553p5 1 100 0.00 6553.500 FORMAT "%8.3" ECU_ADDRESS 0xF1890 /end MEASUREMENT
/begin MEASUREMENT msaovvk_w "" UWORD m_uw_b6553p5 1 100 0.00 6553.500 FORMAT "%8.3" ECU_ADDRESS 0xF1892 /end MEASUREMENT
/begin MEASUREMENT msdkalm_w "" UWORD m_uw_b6553p5 1 100 0.00 6553.500 FORMAT "%8.3" ECU_ADDRESS 0xF1CB6 /end MEASUREMENT
/begin MEASUREMENT msdkf_w "" UWORD m_uw_b6553p5 1 100 0.00 6553.500 FORMAT "%8.3" ECU_ADDRESS 0xF1CB8 /end MEASUREMENT
/begin MEASUREMENT msdkue_w "" UWORD m_uw_b6553p5 1 100 0.00 6553.500 FORMAT "%8.3" ECU_ADDRESS 0xF1CBA /end MEASUREMENT
/begin MEASUREMENT msdk_w "" UWORD m_uw_b6553p5 1 100 0.00 6553.500 FORMAT "%8.3" ECU_ADDRESS 0xF1CBC /end MEASUREMENT
/begin MEASUREMENT mskgb2_w "" UWORD m_uw_b6553p5 1 100 0.00 6553.500 FORMAT "%8.3" ECU_ADDRESS 0xF1894 /end MEASUREMENT
/begin MEASUREMENT mskgb_w "" UWORD m_uw_b6553p5 1 100 0.00 6553.500 FORMAT "%8.3" ECU_ADDRESS 0xF1896 /end MEASUREMENT
/begin MEASUREMENT msndkoo_w "" UWORD m_uw_b6553p5 1 100 0.00 6553.500 FORMAT "%8.3" ECU_ADDRESS 0xF1CBE /end MEASUREMENT
/begin MEASUREMENT msndko_w "" UWORD m_uw_b6553p5 1 100 0.00 6553.500 FORMAT "%8.3" ECU_ADDRESS 0x382EEC /end MEASUREMENT
/begin MEASUREMENT msndkpk_w "" UWORD m_uw_b6553p5 1 100 0.00 6553.500 FORMAT "%8.3" ECU_ADDRESS 0xF1E76 /end MEASUREMENT
/begin MEASUREMENT msndk_w "" UWORD m_uw_b6553p5 1 100 0.00 6553.500 FORMAT "%8.3" ECU_ADDRESS 0xF1CC0 /end MEASUREMENT
/begin MEASUREMENT msnsaug_w "" UWORD m_uw_b6553p5 1 100 0.00 6553.500 FORMAT "%8.3" ECU_ADDRESS 0xF1CC2 /end MEASUREMENT
/begin MEASUREMENT msntetev_w "" UWORD m_uw_b25p6 1 100 0.00 25.59961 FORMAT "%8.5" ECU_ADDRESS 0xF2AEC /end MEASUREMENT
/begin MEASUREMENT msntevo_w "" UWORD m_uw_b25p6 1 100 0.00 25.59961 FORMAT "%8.5" ECU_ADDRESS 0xF4F38 /end MEASUREMENT
/begin MEASUREMENT mssaug_w "" UWORD m_uw_b6553p5 1 100 0.00 6553.500 FORMAT "%8.3" ECU_ADDRESS 0xF1CC4 /end MEASUREMENT
/begin MEASUREMENT mste "" UBYTE m_ub_b25p6 1 100 0.00 25.50 FORMAT "%5.2" ECU_ADDRESS 0xE292 /end MEASUREMENT
/begin MEASUREMENT mstedte "" UBYTE m_ub_b25p6 1 100 0.00 25.50 FORMAT "%5.2" ECU_ADDRESS 0xF0BCB /end MEASUREMENT
/begin MEASUREMENT mstedte_w "" UWORD m_uw_b25p6 1 100 0.00 25.59961 FORMAT "%8.5" ECU_ADDRESS 0xF2AEE /end MEASUREMENT
/begin MEASUREMENT msteo_w "" UWORD m_uw_b25p6 1 100 0.00 25.59961 FORMAT "%8.5" ECU_ADDRESS 0xF2AF0 /end MEASUREMENT
/begin MEASUREMENT mstetev_w "" UWORD m_uw_b25p6 1 100 0.00 25.59961 FORMAT "%8.5" ECU_ADDRESS 0xF2AF2 /end MEASUREMENT
/begin MEASUREMENT mste_w "" UWORD m_uw_b25p6 1 100 0.00 25.59961 FORMAT "%8.5" ECU_ADDRESS 0xF2AF4 /end MEASUREMENT
/begin MEASUREMENT mux_counter "" UBYTE dez 1 100 0.00 255.0 FORMAT "%5.1" ECU_ADDRESS 0x3801CD /end MEASUREMENT
/begin MEASUREMENT mux_counter2 "" UBYTE dez 1 100 0.00 255.0 FORMAT "%5.1" ECU_ADDRESS 0x3801CE /end MEASUREMENT
/begin MEASUREMENT ngas_w "" SWORD nmotg_sw_q0p39 1 100 -12800.16 12799.77 FORMAT "%8.2" ECU_ADDRESS 0xF170A /end MEASUREMENT
/begin MEASUREMENT ngfil "" SBYTE nmotg_sb_q100 1 100 -12800. 12700. FORMAT "%5.0" ECU_ADDRESS 0xF06EA /end MEASUREMENT
/begin MEASUREMENT ngfil_w "" SWORD nmotg_sw_q0p39 1 100 -12800.16 12799.77 FORMAT "%8.2" ECU_ADDRESS 0xF170C /end MEASUREMENT
/begin MEASUREMENT nlp1tim "" UBYTE t10msxs_ub_b2p55 1 100 0.00 2.550 FORMAT "%5.3" ECU_ADDRESS 0xF084A /end MEASUREMENT
/begin MEASUREMENT nmot "" UBYTE nmot_ub_q40 1 100 0.00 10200. FORMAT "%5.0" ECU_ADDRESS 0xE05E /end MEASUREMENT
/begin MEASUREMENT nmotas_w "" UWORD nmot_uw_q0p25 1 100 0.00 16383.75 FORMAT "%8.2" ECU_ADDRESS 0xF170E /end MEASUREMENT
/begin MEASUREMENT nmotkf "" UBYTE nmot_ub_q40 1 100 0.00 10200. FORMAT "%5.0" ECU_ADDRESS 0xF4195 /end MEASUREMENT
/begin MEASUREMENT nmotll "" UBYTE nmot_ub_q10 1 100 0.00 2550. FORMAT "%5.0" ECU_ADDRESS 0xF06E7 /end MEASUREMENT
/begin MEASUREMENT nmotllfil "" UBYTE nmot_ub_q10 1 100 0.00 2550. FORMAT "%5.0" ECU_ADDRESS 0xF06E8 /end MEASUREMENT
/begin MEASUREMENT nmotrsp_w "" UWORD nmot_uw_q0p25 1 100 0.00 16383.75 FORMAT "%8.2" ARRAY_SIZE 8 ECU_ADDRESS 0xE064 /end MEASUREMENT
/begin MEASUREMENT nmot_w "" UWORD nmot_uw_q0p25 1 100 0.00 16383.75 FORMAT "%8.2" ECU_ADDRESS 0xE060 /end MEASUREMENT
/begin MEASUREMENT nwvsakt_w "" SWORD kw_sw_q0p0078 1 100 -256.0000 255.9922 FORMAT "%8.4" ECU_ADDRESS 0xF45CE /end MEASUREMENT
/begin MEASUREMENT nwvsfrue_w "" SWORD kw_sw_q0p0078 1 100 -256.0000 255.9922 FORMAT "%8.4" ECU_ADDRESS 0xF45D0 /end MEASUREMENT
/begin MEASUREMENT nwvsmnu_w "" SWORD kw_sw_q0p0078 1 100 -256.0000 255.9922 FORMAT "%8.4" ECU_ADDRESS 0xF45D2 /end MEASUREMENT
/begin MEASUREMENT nwvsspae_w "" SWORD kw_sw_q0p0078 1 100 -256.0000 255.9922 FORMAT "%8.4" ECU_ADDRESS 0xF45D4 /end MEASUREMENT
/begin MEASUREMENT pabnav2_w "" UWORD p_uw_q0p078 1 100 0.00 5119.922 FORMAT "%8.3" ECU_ADDRESS 0xF45B2 /end MEASUREMENT
/begin MEASUREMENT pabnav_w "" UWORD p_uw_q0p078 1 100 0.00 5119.922 FORMAT "%8.3" ECU_ADDRESS 0xF45B4 /end MEASUREMENT
/begin MEASUREMENT pabvhk2_w "" UWORD p_uw_q0p039 1 100 0.00 2559.961 FORMAT "%8.3" ECU_ADDRESS 0xF45B6 /end MEASUREMENT
/begin MEASUREMENT pabvhk_w "" UWORD p_uw_q0p039 1 100 0.00 2559.961 FORMAT "%8.3" ECU_ADDRESS 0xF45B8 /end MEASUREMENT
/begin MEASUREMENT pabvvk2_w "" UWORD p_uw_q0p039 1 100 0.00 2559.961 FORMAT "%8.3" ECU_ADDRESS 0xF45BA /end MEASUREMENT
/begin MEASUREMENT pabvvk_w "" UWORD p_uw_q0p039 1 100 0.00 2559.961 FORMAT "%8.3" ECU_ADDRESS 0xF45BC /end MEASUREMENT
/begin MEASUREMENT pbrintna_w "" UWORD p_uw_q0p039 1 100 0.00 2559.961 FORMAT "%8.3" ECU_ADDRESS 0xF1C58 /end MEASUREMENT
/begin MEASUREMENT pbrintro_w "" UWORD p_uw_q0p039 1 100 0.00 2559.961 FORMAT "%8.3" ECU_ADDRESS 0xF1C5A /end MEASUREMENT
/begin MEASUREMENT pbrintuk_w "" UWORD p_uw_q0p039 1 100 0.00 2559.961 FORMAT "%8.3" ECU_ADDRESS 0xF45D6 /end MEASUREMENT
/begin MEASUREMENT pbrint_w "" UWORD p_uw_q0p039 1 100 0.00 2559.961 FORMAT "%8.3" ECU_ADDRESS 0xF1C5C /end MEASUREMENT
/begin MEASUREMENT pbriroa_w "" UWORD p_uw_q0p039 1 100 0.00 2559.961 FORMAT "%8.3" ECU_ADDRESS 0xF1C5E /end MEASUREMENT
/begin MEASUREMENT pbriroe_w "" UWORD p_uw_q0p039 1 100 0.00 2559.961 FORMAT "%8.3" ECU_ADDRESS 0xF1C60 /end MEASUREMENT
/begin MEASUREMENT pirgres_w "" UWORD p_uw_q0p039 1 100 0.00 2559.961 FORMAT "%8.3" ECU_ADDRESS 0xF45D8 /end MEASUREMENT
/begin MEASUREMENT pirg_w "" UWORD p_uw_q0p039 1 100 0.00 2559.961 FORMAT "%8.3" ECU_ADDRESS 0xF45DA /end MEASUREMENT
/begin MEASUREMENT prga_w "" UWORD p_uw_q0p039 1 100 0.00 2559.961 FORMAT "%8.3" ECU_ADDRESS 0xF1C62 /end MEASUREMENT
/begin MEASUREMENT prge_w "" UWORD p_uw_q0p039 1 100 0.00 2559.961 FORMAT "%8.3" ECU_ADDRESS 0xF1C64 /end MEASUREMENT
/begin MEASUREMENT prgsua_w "" UWORD p_uw_q0p039 1 100 0.00 2559.961 FORMAT "%8.3" ECU_ADDRESS 0xF1C66 /end MEASUREMENT
/begin MEASUREMENT prgsue_w "" UWORD p_uw_q0p039 1 100 0.00 2559.961 FORMAT "%8.3" ECU_ADDRESS 0xF1C68 /end MEASUREMENT
/begin MEASUREMENT psbkv_w "" UWORD p_uw_q0p039 1 100 0.00 2559.961 FORMAT "%8.3" ECU_ADDRESS 0xF2D10 /end MEASUREMENT
/begin MEASUREMENT psmppvdk_w "" UWORD fak_uw_q0p001 1 100 0.00 65.53500 FORMAT "%8.5" ECU_ADDRESS 0xF1E78 /end MEASUREMENT
/begin MEASUREMENT psmp_w "" UWORD p_uw_q0p039 1 100 0.00 2559.961 FORMAT "%8.3" ECU_ADDRESS 0xF1E7A /end MEASUREMENT
/begin MEASUREMENT psmxbkvg "" UBYTE p_ub_q10 1 100 0.00 2550. FORMAT "%5.0" ECU_ADDRESS 0xF0C9F /end MEASUREMENT
/begin MEASUREMENT psmxbkvg_w "" UWORD p_uw_q0p039 1 100 0.00 2559.961 FORMAT "%8.3" ECU_ADDRESS 0xF2D12 /end MEASUREMENT
/begin MEASUREMENT psmx_w "" UWORD p_uw_q0p039 1 100 0.00 2559.961 FORMAT "%8.3" ECU_ADDRESS 0xF1C6A /end MEASUREMENT
/begin MEASUREMENT pspmx_w "" UWORD p_uw_q0p039 1 100 0.00 2559.961 FORMAT "%8.3" ECU_ADDRESS 0xF1E7C /end MEASUREMENT
/begin MEASUREMENT pspvdb_w "" UWORD fak_uw_b2 1 100 0.00 1.999969 FORMAT "%8.6" ECU_ADDRESS 0xF1CC6 /end MEASUREMENT
/begin MEASUREMENT pspvdkf_w "" UWORD fak_uw_b2 1 100 0.00 1.999969 FORMAT "%8.6" ECU_ADDRESS 0xF1CC8 /end MEASUREMENT
/begin MEASUREMENT pspvdk_w "" UWORD fak_uw_b2 1 100 0.00 1.999969 FORMAT "%8.6" ECU_ADDRESS 0xF1CCA /end MEASUREMENT
/begin MEASUREMENT pspvds_w "" UWORD fak_uw_b2 1 100 0.00 1.999969 FORMAT "%8.6" ECU_ADDRESS 0xF1CCC /end MEASUREMENT
/begin MEASUREMENT psp_w "" UWORD p_uw_q0p039 1 100 0.00 2559.961 FORMAT "%8.3" ECU_ADDRESS 0xF1E7E /end MEASUREMENT
/begin MEASUREMENT pukBits "" UBYTE dez 1 100 0.00 255.0 FORMAT "%5.1" ECU_ADDRESS 0xF0BC9 /end MEASUREMENT
/begin MEASUREMENT pukorf_w "" UWORD p_uw_q0p039 1 100 0.00 2559.961 FORMAT "%8.3" ECU_ADDRESS 0xF4F30 /end MEASUREMENT
/begin MEASUREMENT pukor_w "" UWORD p_uw_q0p039 1 100 0.00 2559.961 FORMAT "%8.3" ECU_ADDRESS 0xF4F32 /end MEASUREMENT
/begin MEASUREMENT pumean_w "" UWORD p_uw_q0p039 1 100 0.00 2559.961 FORMAT "%8.3" ECU_ADDRESS 0xF4F34 /end MEASUREMENT
/begin MEASUREMENT pvdk "" UBYTE p_ub_q10 1 100 0.00 2550. FORMAT "%5.0" ECU_ADDRESS 0xF08BD /end MEASUREMENT
/begin MEASUREMENT pvdk_w "" UWORD p_uw_q0p039 1 100 0.00 2559.961 FORMAT "%8.3" ECU_ADDRESS 0xF1CCE /end MEASUREMENT
/begin MEASUREMENT qltefil "" UBYTE fak_ub_b1 1 100 0.00 0.9961 ECU_ADDRESS 0xF0BCC /end MEASUREMENT
/begin MEASUREMENT recilamf_w "" UWORD fak_uw_b16 1 100 0.00 15.99976 FORMAT "%8.5" ECU_ADDRESS 0xF1EC2 /end MEASUREMENT
/begin MEASUREMENT recilam_w "" UWORD fak_uw_b16 1 100 0.00 15.99976 FORMAT "%8.5" ECU_ADDRESS 0xF1EC4 /end MEASUREMENT
/begin MEASUREMENT redist "" UBYTE dez 1 100 0.00 255.0 FORMAT "%5.1" ECU_ADDRESS 0xF08FD /end MEASUREMENT
/begin MEASUREMENT redistb1 "" UBYTE dez 1 100 0.00 255.0 FORMAT "%5.1" ECU_ADDRESS 0xF08FE /end MEASUREMENT
/begin MEASUREMENT redistb2 "" UBYTE dez 1 100 0.00 255.0 FORMAT "%5.1" ECU_ADDRESS 0xF08FF /end MEASUREMENT
/begin MEASUREMENT rfrint_w "" UWORD rel_uw_q0p0234 1 100 0.00 1535.977 FORMAT "%8.3" ECU_ADDRESS 0xF1C6C /end MEASUREMENT
/begin MEASUREMENT rfr_w "" UWORD rel_uw_q0p0234 1 100 0.00 1535.977 FORMAT "%8.3" ECU_ADDRESS 0xF1C6E /end MEASUREMENT
/begin MEASUREMENT rirint_w "" UWORD rel_uw_q0p0234 1 100 0.00 1535.977 FORMAT "%8.3" ECU_ADDRESS 0xF1C70 /end MEASUREMENT
/begin MEASUREMENT rir_w "" UWORD rel_uw_q0p0234 1 100 0.00 1535.977 FORMAT "%8.3" ECU_ADDRESS 0xF1C72 /end MEASUREMENT
/begin MEASUREMENT rklabbr2_w "" UWORD rel_uw_b3072 1 100 0.00 3071.953 FORMAT "%8.3" ECU_ADDRESS 0xF1EC6 /end MEASUREMENT
/begin MEASUREMENT rklabbr_w "" UWORD rel_uw_b3072 1 100 0.00 3071.953 FORMAT "%8.3" ECU_ADDRESS 0xF1EC8 /end MEASUREMENT
/begin MEASUREMENT rksum_w "" UWORD rel_uw_b491520 1 100 0.00 491512.5 FORMAT "%8.1" ECU_ADDRESS 0xF4FB0 /end MEASUREMENT
/begin MEASUREMENT rldkofk_w "" UWORD rel_uw_q0p0234 1 100 0.00 1535.977 FORMAT "%8.3" ECU_ADDRESS 0xF1CD0 /end MEASUREMENT
/begin MEASUREMENT rldvs_w "" UWORD rel_uw_q0p0234 1 100 0.00 1535.977 FORMAT "%8.3" ECU_ADDRESS 0xF1CD2 /end MEASUREMENT
/begin MEASUREMENT rlfdkrof_w "" UWORD rel_uw_q0p0234 1 100 0.00 1535.977 FORMAT "%8.3" ECU_ADDRESS 0xF1CD4 /end MEASUREMENT
/begin MEASUREMENT rlfdkroh_w "" UWORD rel_uw_q0p0234 1 100 0.00 1535.977 FORMAT "%8.3" ECU_ADDRESS 0xF1CD6 /end MEASUREMENT
/begin MEASUREMENT rlfgroh_w "" UWORD rel_uw_q0p0234 1 100 0.00 1535.977 FORMAT "%8.3" ECU_ADDRESS 0xF1CD8 /end MEASUREMENT
/begin MEASUREMENT rlflmroh_w "" UWORD rel_uw_q0p0234 1 100 0.00 1535.977 FORMAT "%8.3" ECU_ADDRESS 0xF1CDA /end MEASUREMENT
/begin MEASUREMENT rlgas_w "" SWORD relt_q0p02344 1 100 -768.0000 767.9766 FORMAT "%8.4" ECU_ADDRESS 0xF1D1E /end MEASUREMENT
/begin MEASUREMENT rllabbr2_w "" UWORD rel_q0p02344 1 100 0.00 1535.977 FORMAT "%8.3" ECU_ADDRESS 0xF1ECA /end MEASUREMENT
/begin MEASUREMENT rllabbr_w "" UWORD rel_q0p02344 1 100 0.00 1535.977 FORMAT "%8.3" ECU_ADDRESS 0xF1ECC /end MEASUREMENT
/begin MEASUREMENT rlmp_w "" UWORD rel_uw_q0p0234 1 100 0.00 1535.977 FORMAT "%8.3" ECU_ADDRESS 0xF1E80 /end MEASUREMENT
/begin MEASUREMENT rlmxs_w "" UWORD rel_uw_q0p0234 1 100 0.00 1535.977 FORMAT "%8.3" ECU_ADDRESS 0xF460E /end MEASUREMENT
/begin MEASUREMENT rlnotn_w "" UWORD rel_uw_q0p0234 1 100 0.00 1535.977 FORMAT "%8.3" ECU_ADDRESS 0xF1CDC /end MEASUREMENT
/begin MEASUREMENT rlnwkf "" UBYTE rel_ub_q0p75 1 100 0.00 191.3 FORMAT "%5.1" ECU_ADDRESS 0xF4196 /end MEASUREMENT
/begin MEASUREMENT rlnwkf_w "" UWORD rel_uw_q0p0234 1 100 0.00 1535.977 FORMAT "%8.3" ECU_ADDRESS 0xF4F44 /end MEASUREMENT
/begin MEASUREMENT rlp "" UBYTE rel_ub_q0p75 1 100 0.00 191.3 FORMAT "%5.1" ECU_ADDRESS 0xF08DE /end MEASUREMENT
/begin MEASUREMENT rlp_w "" UWORD rel_uw_q0p0234 1 100 0.00 1535.977 FORMAT "%8.3" ECU_ADDRESS 0xF1E82 /end MEASUREMENT
/begin MEASUREMENT rlrint_w "" UWORD rel_uw_q0p0234 1 100 0.00 1535.977 FORMAT "%8.3" ECU_ADDRESS 0xF1C74 /end MEASUREMENT
/begin MEASUREMENT rlrohmp_w "" UWORD rel_uw_q0p0234 1 100 0.00 1535.977 FORMAT "%8.3" ECU_ADDRESS 0xF1E84 /end MEASUREMENT
/begin MEASUREMENT rlroh_w "" UWORD rel_uw_q0p0234 1 100 0.00 1535.977 FORMAT "%8.3" ECU_ADDRESS 0xF1CDE /end MEASUREMENT
/begin MEASUREMENT rlrsp_w "" UWORD rel_uw_q0p0234 1 100 0.00 1535.977 FORMAT "%8.3" ARRAY_SIZE 8 ECU_ADDRESS 0xF1D20 /end MEASUREMENT
/begin MEASUREMENT rlr_w "" UWORD rel_uw_q0p0234 1 100 0.00 1535.977 FORMAT "%8.3" ECU_ADDRESS 0xF1C76 /end MEASUREMENT
/begin MEASUREMENT rlugd_w "" UWORD rel_uw_q0p0234 1 100 0.00 1535.977 FORMAT "%8.3" ECU_ADDRESS 0xF4610 /end MEASUREMENT
/begin MEASUREMENT rlvugd_w "" UWORD rel_uw_q0p0234 1 100 0.00 1535.977 FORMAT "%8.3" ECU_ADDRESS 0xF4612 /end MEASUREMENT
/begin MEASUREMENT rlzuhfs_w "" UWORD rel_uw_q0p0234 1 100 0.00 1535.977 FORMAT "%8.3" ECU_ADDRESS 0xF1CE0 /end MEASUREMENT
/begin MEASUREMENT rlzunfs_w "" UWORD rel_uw_q0p0234 1 100 0.00 1535.977 FORMAT "%8.3" ECU_ADDRESS 0xF1CE2 /end MEASUREMENT
/begin MEASUREMENT rml "" UBYTE rel_ub_b99p6 1 100 0.00 99.61 FORMAT "%5.2" ECU_ADDRESS 0xF40CF /end MEASUREMENT
/begin MEASUREMENT rri_w "" UWORD rel_uw_b100 1 100 0.00 99.99847 FORMAT "%8.5" ECU_ADDRESS 0xF1C78 /end MEASUREMENT
/begin MEASUREMENT rr_w "" UWORD rel_uw_b100 1 100 0.00 99.99847 FORMAT "%8.5" ECU_ADDRESS 0xF1C7A /end MEASUREMENT
/begin MEASUREMENT StateActionID "" UBYTE dez 1 100 0.00 255.0 FORMAT "%5.1" ECU_ADDRESS 0xF4045 /end MEASUREMENT
/begin MEASUREMENT StateID "" UBYTE dez 1 100 0.00 255.0 FORMAT "%5.1" ECU_ADDRESS 0xF4046 /end MEASUREMENT
/begin MEASUREMENT tabadd_w "" UWORD t_q1 1 100 0.00 65535.00 FORMAT "%8.2" ECU_ADDRESS 0x384072 /end MEASUREMENT
/begin MEASUREMENT tabgsant_w "" SWORD temp_sw_q0p75 1 100 -24576.00 24575.25 FORMAT "%8.2" ECU_ADDRESS 0xF45FE /end MEASUREMENT
/begin MEASUREMENT tabsnl0_w "" UWORD t1sxs_uw_q1 1 100 0.00 65535.00 FORMAT "%8.2" ECU_ADDRESS 0x384078 /end MEASUREMENT
/begin MEASUREMENT tabsnl_w "" UWORD t1sxs_uw_b65535 1 100 0.00 65535.00 FORMAT "%8.2" ECU_ADDRESS 0xF46A0 /end MEASUREMENT
/begin MEASUREMENT tabstm_w "" UWORD t1sxs_uw_q1 1 100 0.00 65535.00 FORMAT "%8.2" ECU_ADDRESS 0xF46A2 /end MEASUREMENT
/begin MEASUREMENT tabststp "" UBYTE t50msxs_ub_b12p75 1 100 0.00 12.75 FORMAT "%5.2" ECU_ADDRESS 0xF40F7 /end MEASUREMENT
/begin MEASUREMENT tabst_w "" UWORD t1sxs_uw_q1 1 100 0.00 65535.00 FORMAT "%8.2" ECU_ADDRESS 0xF46A4 /end MEASUREMENT
/begin MEASUREMENT tabsuhr0_w "" UWORD t1sxs_uw_q1 1 100 0.00 65535.00 FORMAT "%8.2" ECU_ADDRESS 0xF203C /end MEASUREMENT
/begin MEASUREMENT tabsuhr_w "" UWORD t1sxs_uw_q1 1 100 0.00 65535.00 FORMAT "%8.2" ECU_ADDRESS 0xF46A6 /end MEASUREMENT
/begin MEASUREMENT tas_w "" UWORD t_q16us 1 100 0.00 1048560. FORMAT "%8.0" ECU_ADDRESS 0xF1D30 /end MEASUREMENT
/begin MEASUREMENT tbrraum_w "" SWORD temp_sw_q0p75 1 100 -24576.00 24575.25 FORMAT "%8.2" ECU_ADDRESS 0xF4600 /end MEASUREMENT
/begin MEASUREMENT tcmilas "" UBYTE dez 1 100 0.00 255.0 FORMAT "%5.1" ECU_ADDRESS 0xF4047 /end MEASUREMENT
/begin MEASUREMENT tcmilrb "" UBYTE dez 1 100 0.00 255.0 FORMAT "%5.1" ECU_ADDRESS 0xF4048 /end MEASUREMENT
/begin MEASUREMENT tcmilvt "" UBYTE dez 1 100 0.00 255.0 FORMAT "%5.1" ECU_ADDRESS 0xF4049 /end MEASUREMENT
/begin MEASUREMENT tdknach_w "" UWORD t10msxs_uw_b655p35 1 100 0.00 655.3500 FORMAT "%8.4" ECU_ADDRESS 0xF1B02 /end MEASUREMENT
/begin MEASUREMENT tempin "" UBYTE temp_ub_q0p75_o48 1 100 -48.00 143.3 FORMAT "%5.1" ECU_ADDRESS 0xF40CD /end MEASUREMENT
/begin MEASUREMENT tengoff0_l "" ULONG t1sxs_uw_q1 1 100 0.00 4294967295.00 FORMAT "%13.2" ECU_ADDRESS 0x384074 /end MEASUREMENT
/begin MEASUREMENT tengoff_l "" ULONG t1sxs_uw_q1 1 100 0.00 4294967295.00 FORMAT "%13.2" ECU_ADDRESS 0xF4694 /end MEASUREMENT
/begin MEASUREMENT tengon_l "" ULONG t1sxs_uw_q1 1 100 0.00 4294967295.00 FORMAT "%13.2" ECU_ADDRESS 0xF4698 /end MEASUREMENT
/begin MEASUREMENT tephc "" UWORD t100msxs_uw_b6553p6 1 100 0.00 6553.500 FORMAT "%8.3" ECU_ADDRESS 0xF4668 /end MEASUREMENT
/begin MEASUREMENT tfrgsant_w "" SWORD temp_sw_q0p75 1 100 -24576.00 24575.25 FORMAT "%8.2" ECU_ADDRESS 0xF4602 /end MEASUREMENT
/begin MEASUREMENT tloop_w "" UWORD t50msxs_q0p05 1 100 0.00 3276.750 FORMAT "%8.3" ECU_ADDRESS 0xF1B04 /end MEASUREMENT
/begin MEASUREMENT tlrs2_w "" UWORD tz10msxs_uw_b327p68 1 100 0.0050000762951 327.68000000 FORMAT "%12.8" ECU_ADDRESS 0xF2846 /end MEASUREMENT
/begin MEASUREMENT tlrsk_w "" UWORD tz10msxs_uw_b327p68 1 100 0.0050000762951 327.68000000 FORMAT "%12.8" ECU_ADDRESS 0xF1ECE /end MEASUREMENT
/begin MEASUREMENT tlrs_w "" UWORD tz10msxs_uw_b327p68 1 100 0.0050000762951 327.68000000 FORMAT "%12.8" ECU_ADDRESS 0xF2848 /end MEASUREMENT
/begin MEASUREMENT tmischbr_w "" SWORD temp_sw_q0p75 1 100 -24576.00 24575.25 FORMAT "%8.2" ECU_ADDRESS 0xF4604 /end MEASUREMENT
/begin MEASUREMENT tmotdif "" UBYTE temp_ub_q0p75_o48 1 100 -48.00 143.3 FORMAT "%5.1" ECU_ADDRESS 0xF40CE /end MEASUREMENT
/begin MEASUREMENT tmotfil "" UBYTE temp_ub_q0p75_o48 1 100 -48.00 143.3 FORMAT "%5.1" ECU_ADDRESS 0x384015 /end MEASUREMENT
/begin MEASUREMENT tmotrvmx "" UBYTE temp_ub_q0p75_o48 1 100 -48.00 143.3 FORMAT "%5.1" ECU_ADDRESS 0xF4160 /end MEASUREMENT
/begin MEASUREMENT tmpumast "" UBYTE dez 1 100 0.00 255.0 FORMAT "%5.1" ECU_ADDRESS 0xF084B /end MEASUREMENT
/begin MEASUREMENT tnseuhr_w "" UWORD t100msxs_uw_b6553p5 1 100 0.00 6553.500 FORMAT "%8.3" ECU_ADDRESS 0xF46A8 /end MEASUREMENT
/begin MEASUREMENT tnse_w "" UWORD t100msxs_uw_b6553p5 1 100 0.00 6553.500 FORMAT "%8.3" ECU_ADDRESS 0xF4F02 /end MEASUREMENT
/begin MEASUREMENT tnst_w "" UWORD t10msxs_uw_b655p35 1 100 0.00 655.3500 FORMAT "%8.4" ECU_ADDRESS 0xF2A04 /end MEASUREMENT
/begin MEASUREMENT toel "" UBYTE temp_ub_q1_o60 1 100 -60.00 195.0 FORMAT "%5.1" ECU_ADDRESS 0xF419C /end MEASUREMENT
/begin MEASUREMENT toelk_w "" UWORD temp_q0p0234_o273 1 100 -273.1500 1262.827 FORMAT "%8.3" ECU_ADDRESS 0xF4F50 /end MEASUREMENT
/begin MEASUREMENT toelzk_w "" UWORD temp_q0p0234_o273 1 100 -273.1500 1262.827 FORMAT "%8.3" ECU_ADDRESS 0xF4F52 /end MEASUREMENT
/begin MEASUREMENT toltm "" UBYTE temp_ub_q0p75_o48 1 100 -48.00 143.3 FORMAT "%5.1" ECU_ADDRESS 0xF419D /end MEASUREMENT
/begin MEASUREMENT trsectmp_l "" ULONG t1sxs_uw_q1 1 100 0.00 4294967295.00 FORMAT "%13.2" ECU_ADDRESS 0xF469C /end MEASUREMENT
/begin MEASUREMENT trsec_l "" ULONG t_q1 1 100 0.00 4294967295.00 FORMAT "%13.2" ECU_ADDRESS 0xF468C /end MEASUREMENT
/begin MEASUREMENT tsas_w "" UWORD tsquantl 1 100 0.00 838848.0 FORMAT "%8.1" ECU_ADDRESS 0xF1710 /end MEASUREMENT
/begin MEASUREMENT tseghi "" UBYTE dez 1 100 0.00 255.0 FORMAT "%5.1" ECU_ADDRESS 0xE05F /end MEASUREMENT
/begin MEASUREMENT tsegrsp_w "" UWORD tsquant 1 100 0.00 52428.00 FORMAT "%8.2" ARRAY_SIZE 8 ECU_ADDRESS 0xE074 /end MEASUREMENT
/begin MEASUREMENT tseg_w "" UWORD tsegment_sy 1 100 0.00 52.42800 FORMAT "%8.5" ECU_ADDRESS 0xE062 /end MEASUREMENT
/begin MEASUREMENT tsges_w "" SWORD temp_sw_q0p75 1 100 -24576.00 24575.25 FORMAT "%8.2" ECU_ADDRESS 0xF4606 /end MEASUREMENT
/begin MEASUREMENT tsontl2_w "" UWORD t_q0p01 1 100 0.00 655.3500 FORMAT "%8.4" ECU_ADDRESS 0xF1ED0 /end MEASUREMENT
/begin MEASUREMENT tsontl_w "" UWORD t_q0p01 1 100 0.00 655.3500 FORMAT "%8.4" ECU_ADDRESS 0xF1ED2 /end MEASUREMENT
/begin MEASUREMENT ttmumad_w "" UWORD t50msxs_q0p05 1 100 0.00 3276.750 FORMAT "%8.3" ECU_ADDRESS 0xF1B06 /end MEASUREMENT
/begin MEASUREMENT tum "" UBYTE temp_ub_q0p75_o48 1 100 -48.00 143.3 FORMAT "%5.1" ECU_ADDRESS 0x38401A /end MEASUREMENT
/begin MEASUREMENT tumg "" UBYTE temp_ub_q0p75_o48 1 100 -48.00 143.3 FORMAT "%5.1" ECU_ADDRESS 0xF40F9 /end MEASUREMENT
/begin MEASUREMENT tumgk_w "" UWORD temp_q0p0234_o273 1 100 -273.1500 1262.827 FORMAT "%8.3" ECU_ADDRESS 0xF46AC /end MEASUREMENT
/begin MEASUREMENT tumtmp "" UBYTE temp_ub_q0p75_o48 1 100 -48.00 143.3 FORMAT "%5.1" ECU_ADDRESS 0xF40FA /end MEASUREMENT
/begin MEASUREMENT t_nomgatCtr1 "" UBYTE dez 1 100 0.00 255.0 FORMAT "%5.1" ECU_ADDRESS 0x3801C8 /end MEASUREMENT
/begin MEASUREMENT ubuanlr "" UBYTE spg_q0p1 1 100 0.00 25.50 FORMAT "%5.2" ECU_ADDRESS 0xF084C /end MEASUREMENT
/begin MEASUREMENT udknlp1 "" UWORD spg_q1p221_mV 1 100 0.00 79.99878 FORMAT "%8.5" ECU_ADDRESS 0xF1B08 /end MEASUREMENT
/begin MEASUREMENT udknlp1r "" UWORD spg_q1p221_mV 1 100 0.00 79.99878 FORMAT "%8.5" ECU_ADDRESS 0x382EDA /end MEASUREMENT
/begin MEASUREMENT udknlp2 "" UWORD spg_q1p221_mV 1 100 0.00 79.99878 FORMAT "%8.5" ECU_ADDRESS 0xF1B0A /end MEASUREMENT
/begin MEASUREMENT udknlp2r "" UWORD spg_q1p221_mV 1 100 0.00 79.99878 FORMAT "%8.5" ECU_ADDRESS 0x382EDC /end MEASUREMENT
/begin MEASUREMENT udkp1a "" UBYTE spg_ub_q0p019 1 100 0.00 4.980 FORMAT "%5.3" ECU_ADDRESS 0xF084D /end MEASUREMENT
/begin MEASUREMENT udkp1aalt "" UWORD spg_q1p221_mV 1 100 0.00 79.99878 FORMAT "%8.5" ECU_ADDRESS 0xF1B0C /end MEASUREMENT
/begin MEASUREMENT udkp1asr_w "" UWORD spg_q1p221_mV 1 100 0.00 79.99878 FORMAT "%8.5" ECU_ADDRESS 0x382EDE /end MEASUREMENT
/begin MEASUREMENT udkp1as_w "" UWORD spg_q1p221_mV 1 100 0.00 79.99878 FORMAT "%8.5" ECU_ADDRESS 0xF1B0E /end MEASUREMENT
/begin MEASUREMENT udkp1a_w "" UWORD spg_q1p221_mV 1 100 0.00 79.99878 FORMAT "%8.5" ECU_ADDRESS 0xF1B10 /end MEASUREMENT
/begin MEASUREMENT udkp1rob "" UWORD spg_uw_q0p00488 1 100 0.00 319.9951 FORMAT "%8.4" ECU_ADDRESS 0xF1B12 /end MEASUREMENT
/begin MEASUREMENT udkp1run "" UWORD spg_uw_q0p00488 1 100 0.00 319.9951 FORMAT "%8.4" ECU_ADDRESS 0xF1B14 /end MEASUREMENT
/begin MEASUREMENT udkp1sv "" UBYTE spg_ub_q0p019 1 100 0.00 4.980 FORMAT "%5.3" ECU_ADDRESS 0xF084E /end MEASUREMENT
/begin MEASUREMENT udkp1vor "" SWORD spg_sw_q0p001222 1 100 -40.04250 40.04127 FORMAT "%8.5" ECU_ADDRESS 0x382EE0 /end MEASUREMENT
/begin MEASUREMENT udkp1vou "" SBYTE spg_q0p00977 1 100 -1.250 1.240 FORMAT "%5.3" ECU_ADDRESS 0xF40AB /end MEASUREMENT
/begin MEASUREMENT udkp1vo_w "" SWORD spg_sw_q0p001222 1 100 -40.04250 40.04127 FORMAT "%8.5" ECU_ADDRESS 0xF1B16 /end MEASUREMENT
/begin MEASUREMENT udkp1vrob "" UWORD spg_uw_q0p00488 1 100 0.00 319.9951 FORMAT "%8.4" ECU_ADDRESS 0xF1B18 /end MEASUREMENT
/begin MEASUREMENT udkp1vrun "" UWORD spg_uw_q0p00488 1 100 0.00 319.9951 FORMAT "%8.4" ECU_ADDRESS 0xF1B1A /end MEASUREMENT
/begin MEASUREMENT udkp1vv "" UBYTE spg_q0p03125 1 100 0.00 7.969 FORMAT "%5.3" ECU_ADDRESS 0xF40AC /end MEASUREMENT
/begin MEASUREMENT udkp1vvr "" UWORD fak_q0p0039 1 100 0.00 255.9961 FORMAT "%8.4" ECU_ADDRESS 0x382EE2 /end MEASUREMENT
/begin MEASUREMENT udkp1vv_w "" UWORD fak_q0p0039 1 100 0.00 255.9961 FORMAT "%8.4" ECU_ADDRESS 0xF1B1C /end MEASUREMENT
/begin MEASUREMENT udkp2a "" UBYTE spg_ub_q0p019 1 100 0.00 4.980 FORMAT "%5.3" ECU_ADDRESS 0xF084F /end MEASUREMENT
/begin MEASUREMENT udkp2aalt "" UWORD spg_q1p221_mV 1 100 0.00 79.99878 FORMAT "%8.5" ECU_ADDRESS 0xF1B1E /end MEASUREMENT
/begin MEASUREMENT udkp2asr_w "" UWORD spg_q1p221_mV 1 100 0.00 79.99878 FORMAT "%8.5" ECU_ADDRESS 0x382EE4 /end MEASUREMENT
/begin MEASUREMENT udkp2as_w "" UWORD spg_q1p221_mV 1 100 0.00 79.99878 FORMAT "%8.5" ECU_ADDRESS 0x382EE6 /end MEASUREMENT
/begin MEASUREMENT udkp2a_w "" UWORD spg_q1p221_mV 1 100 0.00 79.99878 FORMAT "%8.5" ECU_ADDRESS 0xF1B20 /end MEASUREMENT
/begin MEASUREMENT udkpat_w "" UWORD spg_q1p221_mV 1 100 0.00 79.99878 FORMAT "%8.5" ECU_ADDRESS 0xF1B22 /end MEASUREMENT
/begin MEASUREMENT uhrdev "" UBYTE fak_ub_b2 1 100 0.00 1.992 FORMAT "%5.3" ECU_ADDRESS 0xF40F8 /end MEASUREMENT
/begin MEASUREMENT umsrln_w "" UWORD m_uw_q0p0005 1 100 0.00 32.76750 FORMAT "%8.5" ECU_ADDRESS 0xF1CE4 /end MEASUREMENT
/begin MEASUREMENT vapp_w "" UWORD vol_q0p002146 1 100 0.00 140.6229 FORMAT "%8.4" ECU_ADDRESS 0xF4FB2 /end MEASUREMENT
/begin MEASUREMENT verhmsb2_w "" UWORD fak_uw_b2 1 100 0.00 1.000000 FORMAT "%8.6" ECU_ADDRESS 0xF4480 /end MEASUREMENT
/begin MEASUREMENT verhmsb_w "" UWORD fak_uw_b2 1 100 0.00 1.000000 FORMAT "%8.6" ECU_ADDRESS 0xF4482 /end MEASUREMENT
/begin MEASUREMENT vmaxtm_w "" UWORD vfzg_uw_q0p00781 1 100 0.00 511.9922 FORMAT "%8.4" ECU_ADDRESS 0xF477C /end MEASUREMENT
/begin MEASUREMENT vmaxtol_w "" UWORD vfzg_uw_q0p00781 1 100 0.00 511.9922 FORMAT "%8.4" ECU_ADDRESS 0xF477E /end MEASUREMENT
/begin MEASUREMENT vmaxtom_w "" UWORD vfzg_uw_q0p00781 1 100 0.00 511.9922 FORMAT "%8.4" ECU_ADDRESS 0xF4780 /end MEASUREMENT
/begin MEASUREMENT vmax_w "" UWORD vfzg_uw_q0p00781 1 100 0.00 511.9922 FORMAT "%8.4" ECU_ADDRESS 0xF4782 /end MEASUREMENT
/begin MEASUREMENT vpspabna_w "" UWORD fak_uw_b2 1 100 0.00 1.999969 FORMAT "%8.6" ECU_ADDRESS 0xF4608 /end MEASUREMENT
/begin MEASUREMENT vpspanav_w "" UWORD fak_uw_b2 1 100 0.00 1.999969 FORMAT "%8.6" ECU_ADDRESS 0xF45DC /end MEASUREMENT
/begin MEASUREMENT vregdia_w "" UWORD vs_uw_b25p6 1 100 0.00 25.59961 FORMAT "%8.5" ECU_ADDRESS 0xF2AF6 /end MEASUREMENT
/begin MEASUREMENT vsksml_w "" UWORD volgrd_q5p96Em4 1 100 0.00 39.06190 FORMAT "%8.5" ECU_ADDRESS 0xF4FB4 /end MEASUREMENT
/begin MEASUREMENT vsks_w "" UWORD volgrd_q5p96Em7 1 100 0.00 0.03906190 FORMAT "%10.8" ECU_ADDRESS 0xF4FB6 /end MEASUREMENT
/begin MEASUREMENT vtrip_w "" UWORD vol_q3p90625Em3_l 1 100 0.00 255.9961 FORMAT "%8.4" ECU_ADDRESS 0xF4FB8 /end MEASUREMENT
/begin MEASUREMENT vwkw "" UBYTE rel_ub_q0p1875 1 100 0.00 47.81 FORMAT "%5.2" ECU_ADDRESS 0xF08DF /end MEASUREMENT
/begin MEASUREMENT wdkada_w "" UWORD relDK_uw_b100 1 100 0.00 100.0000 FORMAT "%8.4" ECU_ADDRESS 0xF1B24 /end MEASUREMENT
/begin MEASUREMENT wdkbab_w "" UWORD rel_uw_b100 1 100 0.00 99.99847 FORMAT "%8.5" ECU_ADDRESS 0xF1CE6 /end MEASUREMENT
/begin MEASUREMENT wdkbapb_w "" UWORD rel_uw_b100 1 100 0.00 99.99847 FORMAT "%8.5" ECU_ADDRESS 0xF1E86 /end MEASUREMENT
/begin MEASUREMENT wdkbap_w "" UWORD rel_uw_b100 1 100 0.00 99.99847 FORMAT "%8.5" ECU_ADDRESS 0xF1FEA /end MEASUREMENT
/begin MEASUREMENT wdkbate "" UBYTE relDK_ub_b100 1 100 0.00 100.0 FORMAT "%5.1" ECU_ADDRESS 0xF0BCD /end MEASUREMENT
/begin MEASUREMENT wdknlp "" UBYTE relDK_q0p3922 1 100 0.00 100.0 FORMAT "%5.1" ECU_ADDRESS 0xF40AD /end MEASUREMENT
/begin MEASUREMENT wdknlpr "" UBYTE relDK_q0p3922 1 100 0.00 100.0 FORMAT "%5.1" ECU_ADDRESS 0xF40AE /end MEASUREMENT
/begin MEASUREMENT wdknlpr_w "" UWORD relDK_uw_b100 1 100 0.00 100.0000 FORMAT "%8.4" ECU_ADDRESS 0x382EE8 /end MEASUREMENT
/begin MEASUREMENT wdknlp_w "" UWORD relDK_uw_b100 1 100 0.00 100.0000 FORMAT "%8.4" ECU_ADDRESS 0xF1B26 /end MEASUREMENT
/begin MEASUREMENT wdkugd_w "" UWORD rel_uw_b100 1 100 0.00 99.99847 FORMAT "%8.5" ECU_ADDRESS 0xF1CE8 /end MEASUREMENT
/begin MEASUREMENT wdkvabob "" UWORD relDK_uw_b100 1 100 0.00 100.0000 FORMAT "%8.4" ECU_ADDRESS 0xF1B28 /end MEASUREMENT
/begin MEASUREMENT wdkvabub "" UWORD relDK_uw_b100 1 100 0.00 100.0000 FORMAT "%8.4" ECU_ADDRESS 0xF1B2A /end MEASUREMENT
/begin MEASUREMENT wnwsakfa_w "" SWORD kw_sw_q0p0078 1 100 -256.0000 255.9922 FORMAT "%8.4" ECU_ADDRESS 0xF4F46 /end MEASUREMENT
/begin MEASUREMENT wnwsakfe_w "" SWORD kw_sw_q0p0078 1 100 -256.0000 255.9922 FORMAT "%8.4" ECU_ADDRESS 0xF4F48 /end MEASUREMENT
/begin MEASUREMENT wnwspue_w "" SWORD kw_q0p0078 1 100 -256.0000 255.9922 FORMAT "%8.4" ECU_ADDRESS 0xF1C7C /end MEASUREMENT
/begin MEASUREMENT wpfgr_w "" UWORD rel_uw_b100 1 100 0.00 99.99847 FORMAT "%8.5" ECU_ADDRESS 0xF459C /end MEASUREMENT
/begin MEASUREMENT wpr "" UBYTE zw_ub_q6 1 100 0.00 1530. FORMAT "%5.0" ECU_ADDRESS 0xF08E0 /end MEASUREMENT
/begin MEASUREMENT wprnsp "" UBYTE zw_ub_q6 1 100 0.00 1530. FORMAT "%5.0" ECU_ADDRESS 0xF08E1 /end MEASUREMENT
/begin MEASUREMENT xfvisrm_w "" UWORD dez 1 100 0.00 65535.00 FORMAT "%8.2" ECU_ADDRESS 0xF45DE /end MEASUREMENT
/begin MEASUREMENT xqtm_w "" UWORD fak_uw_b16 1 100 0.00 15.99976 FORMAT "%8.5" ECU_ADDRESS 0xF46AA /end MEASUREMENT
/begin MEASUREMENT zlrs "" UBYTE zk10msxs_ub_b2p55 1 100 0.0100000 2.55000 FORMAT "%7.5" ECU_ADDRESS 0xF0B7A /end MEASUREMENT
/begin MEASUREMENT zlrs2_w "" UWORD zk10msxs_uw_b655 1 100 0.010000152590 655.36000000 FORMAT "%12.8" ECU_ADDRESS 0xF284A /end MEASUREMENT
/begin MEASUREMENT zlrs_w "" UWORD zk10msxs_uw_b655 1 100 0.010000152590 655.36000000 FORMAT "%12.8" ECU_ADDRESS 0xF284C /end MEASUREMENT
/begin MEASUREMENT zylzab "" UBYTE dez 1 100 0.00 255.0 FORMAT "%5.1" ECU_ADDRESS 0xF08EB /end MEASUREMENT
/begin MEASUREMENT zylzab2 "" UBYTE dez 1 100 0.00 255.0 FORMAT "%5.1" ECU_ADDRESS 0xF08EC /end MEASUREMENT
/begin FUNCTION BBSTT "11.21" /begin DEF_CHARACTERISTIC NNSTA NSTNM /end DEF_CHARACTERISTIC /begin IN_MEASUREMENT B_nmot nmot tans tmot /end IN_MEASUREMENT /begin OUT_MEASUREMENT B_st B_stend tnse_w tnst_w /end OUT_MEASUREMENT /end FUNCTION
/begin FUNCTION BBTEGA "3.130"
 /begin DEF_CHARACTERISTIC DFTEDS DMRFATE FMRFAZTE FTEADZU FTEDS MRFABNTE TATELL TGAHBX TMSKLH TMSNOGA TTE TTEAE TTEBSTP TTEGA TTEGAI TTEGAIH TTEGAZO TTEGAZU TTEINI TTEMN TTEPRIO TTEZAO TTEZAU ZMRFABN /end DEF_CHARACTERISTIC
 /begin IN_MEASUREMENT B_dldpte B_dmmtev B_dmtltz B_dtes B_edkvs B_edkvs2 B_frao B_gae B_gaefra B_gaefra2 B_gasp B_grdst B_ll B_lr B_lr2 B_nmot B_te B_teabb B_tehbx B_tepvb B_teza ftead_w mrfa_w nmot tans tmst tnse_w /end IN_MEASUREMENT
 /begin OUT_MEASUREMENT B_fraoan B_gap B_tep /end OUT_MEASUREMENT
 /begin LOC_MEASUREMENT B_tedtev B_tehbxf B_tepi B_tepzhl B_tepzus B_tesstp B_testop B_tezstp B_tteae B_ttegais dmrfabn_w mrfabn mrfabnf tephc /end LOC_MEASUREMENT
/end FUNCTION
/begin FUNCTION BGARNW "2.30"
 /begin DEF_CHARACTERISTIC DWNWADRPA DWNWADRPE DWNWSKA DWNWSKE HYNMOTNW HYRLNW KFNWADA KFNWADE KFNWADGA KFNWADGE MXFLAD TMWAFMN TNWADAMX TNWADAMXA TVNW_S TWAFMN TWAFMX /end DEF_CHARACTERISTIC
 /begin REF_CHARACTERISTIC WNWRAS WNWREO /end REF_CHARACTERISTIC
 /begin IN_MEASUREMENT B_enwsva B_enwsve B_nwkwaosw B_phada B_phade B_stend B_wnws0a B_wnws0e nmot rlnw_w tmot wnwa_w wnwe_w wnwsaa_w wnwsae_w /end IN_MEASUREMENT
 /begin OUT_MEASUREMENT BGARNWausbits B_nwadagfa B_nwadagfe B_nwflada B_nwflade B_nwrposa B_nwrpose /end OUT_MEASUREMENT
 /begin LOC_MEASUREMENT BGARNWlokbits B_fphad B_nwadaa B_nwadae B_nwadaga B_nwadage B_nwpnrpa B_nwpnrpe ctr_phada ctr_phade nmotkf rlnwkf rlnwkf_w wnwsakfa_w wnwsakfe_w /end LOC_MEASUREMENT
/end FUNCTION
/begin FUNCTION BGBN "1.10" /begin IN_MEASUREMENT B_airbag /end IN_MEASUREMENT /begin OUT_MEASUREMENT BGBNausbits0 B_bvhfm B_bvhls /end OUT_MEASUREMENT /end FUNCTION
/begin FUNCTION BGCVN "6.10" /begin IN_MEASUREMENT B_m9cvn B_m9cvnclr B_m9cvnout /end IN_MEASUREMENT /begin OUT_MEASUREMENT bgcvn_bits B_cksbrdy cvnh_w cvnl_w /end OUT_MEASUREMENT /end FUNCTION
/begin FUNCTION BGDVE "3.150"
 /begin DEF_CHARACTERISTIC CWDVEFO DKPSTGMIN DLRPIDSTMN DUDKNLPO DUDKNLPU DUDKPTMP FPRAT FPRMT FPRNMAX FPRTIM1_T FPRTIM2_T FPRTIM3_T FPRTIM4_T LRNST1_T LRNST3_T LRNST7_T LRNST9_T LRNVB_T NLPST1T NLPST2T TDKNACH TDLRPIDMX TMSUTMUMA TTMUMASTA UANAUFRP UANNMAX UANPEDMAX UANPIDMIN UANPIDMINA UANUATS UANVFZG UANZURP UAN_O_MT UAN_STORE UAN_U_MT UB_UANL UDKNLP1N UDKNLP2N UDKP1AMAX UDKP1AMIN UDKP1AURI UDKP1DUS UDKP1NHUB UDKP1VID UDKP1VOMA UDKP1VOMI UDKP1VOSC UDKP1VUSC UDKP1VVMA UDKP1VVMI UDKP2AMAX UDKP2AMIN UDKP2AURI UDKPALOS UDKPAOFF UDKPATMX UPVGNENN WDKFPRO2 WDKFPROO WDKFPROU WDKFPRZ1 WDKFPRZ2 WDKNLPMA WDKNLPMI WDKNPLAUS WDKNSTORE WDKSFPR WDKSFPRO WDKSTMUMA /end DEF_CHARACTERISTIC
 /begin REF_CHARACTERISTIC DUDKP1HY /end REF_CHARACTERISTIC
 /begin IN_MEASUREMENT B_dcdisfr B_dknolu B_dknot B_dkp1e B_dkp2e B_dkpiu B_dlrspid B_dvete B_i_ska_um B_lrndia B_pwf B_stend B_ubdve B_wdk2sel dlrspid_w nmotll tans tmot ub ubrsq udkp1v_w udkp1_w udkp2_w vfzg wdkba_w wdks_w wped /end IN_MEASUREMENT
 /begin OUT_MEASUREMENT B_abgle B_dcdisr B_dkaden B_dlrien B_dveada B_dvetv B_fproab B_fproe B_fprook B_fprordy B_fprovb B_fprrdy B_fprzab B_fprze B_fprzok B_fprzvb B_lrnakt B_lrnerf B_lrnfg B_lrnrdy B_lrntesa B_lrnvb B_lrnws B_nlpe B_nlperf B_nlpnew B_umae B_umauab dkpstg_w dlrmxt dveadchst fprstep_c lrnstep_c tloop_w tmpumast ttmumad_w udknlp1 udknlp2 udkp1a udkp1asr_w udkp1as_w udkp1a_w udkp1sv udkp1vou udkp1vo_w udkp1vv udkp1vv_w udkp2a udkp2asr_w udkp2as_w udkp2a_w udkpat_w wdkada_w wdknlp wdknlpr wdknlp_w /end OUT_MEASUREMENT
 /begin LOC_MEASUREMENT BGDVEintbits B_dknach B_fprakt B_nlpreq fprtim_c lrnstat lrntim_c lrnvb_c nlp1tim tdknach_w ubuanlr udknlp1r udknlp2r udkp1aalt udkp1rob udkp1run udkp1vor udkp1vrob udkp1vrun udkp1vvr udkp2aalt wdknlpr_w wdkvabob wdkvabub /end LOC_MEASUREMENT
/end FUNCTION
/begin FUNCTION BGELSV "1.90" /begin DEF_CHARACTERISTIC CWBGELSV /end DEF_CHARACTERISTIC /begin IN_MEASUREMENT B_dlahieg B_dlahieg2 B_fa B_pwf /end IN_MEASUREMENT
 /begin OUT_MEASUREMENT bgelsvAusBitsKoop bgelsvAusBitsNovKoop B_crlsv B_crlsv2 B_elsv B_elsv2 B_zlsv B_zlsv2 /end OUT_MEASUREMENT
 /begin LOC_MEASUREMENT bgelsvLokBitsKoop /end LOC_MEASUREMENT
 /begin SUB_FUNCTION DFPM_BGELSV /end SUB_FUNCTION
/end FUNCTION
/begin FUNCTION BGEVAB "4.11" /begin IN_MEASUREMENT evz_austot stateaevab zzbank /end IN_MEASUREMENT /begin OUT_MEASUREMENT B_bevab B_bevab2 B_evakt B_evloc redist redistb1 redistb2 /end OUT_MEASUREMENT /end FUNCTION
/begin FUNCTION BGGNSOL "1.80"
 /begin DEF_CHARACTERISTIC CWBGGNSOL DFGNSOL FIMLATMW KFGNSOL OFFIMLATMW RLAOSPMX TBSTEGNSOL TRLAOSP /end DEF_CHARACTERISTIC
 /begin IN_MEASUREMENT B_kh B_stend B_wst imlatmw_w rl_w tmst tnst_w /end IN_MEASUREMENT
 /begin OUT_MEASUREMENT fgnsol /end OUT_MEASUREMENT
/end FUNCTION
/begin FUNCTION BGKML "1.10" /begin IN_MEASUREMENT kmst_w /end IN_MEASUREMENT /begin OUT_MEASUREMENT kmstl_w /end OUT_MEASUREMENT /end FUNCTION
/begin FUNCTION BGKMST "2.30" /begin IN_MEASUREMENT B_kmmil fcmEnd FCMTab vfzg_u /end IN_MEASUREMENT /begin OUT_MEASUREMENT kmdp1km_w kmp6km_w kmstmil_w kmst_w /end OUT_MEASUREMENT /end FUNCTION
/begin FUNCTION BGKV "5.20" /begin REF_CHARACTERISTIC KUMSRL /end REF_CHARACTERISTIC /begin IN_MEASUREMENT B_sa rk2_w rkte_w rk_w /end IN_MEASUREMENT /begin OUT_MEASUREMENT vsksml_w vsks_w vtrip_w /end OUT_MEASUREMENT /begin LOC_MEASUREMENT rksum_w vapp_w /end LOC_MEASUREMENT /end FUNCTION
/begin FUNCTION BGLAMBDA "3.20" /begin DEF_CHARACTERISTIC KFLAMSLS LALIO LAMGAINMN LAMGAINMX TVGAIN /end DEF_CHARACTERISTIC /begin REF_CHARACTERISTIC TUMTOE /end REF_CHARACTERISTIC
 /begin IN_MEASUREMENT B_fklanf B_fklanf2 B_iclsabg B_iclsabg2 B_sbblsu B_sbblsu2 B_sls lamsbrs2_w lamsbrs_w lamsons2_w lamsons_w nmot o2adap2_w o2adap_w rl zseglsumt /end IN_MEASUREMENT
 /begin OUT_MEASUREMENT B_fklsol B_fklsol2 B_sbbvk B_sbbvk2 lalsuvj2_w lalsuvj_w lamsonb2_w lamsonb_w lamsoni2_w lamsoni_w /end OUT_MEASUREMENT
 /begin LOC_MEASUREMENT diffbks2_w diffbks_w flamagr flamagr2 flamsls flamsls2 flamslsi lamsobk2_w lamsobk_w /end LOC_MEASUREMENT
/end FUNCTION
/begin FUNCTION BGLAMOD "1.40"
 /begin DEF_CHARACTERISTIC CWLRFZA KFLRST KFLRST2 KFLRSZ KFLRSZ2 LRSMODMS LRSTPZA TKATSZA TKATSZA2 TMLRZAMN /end DEF_CHARACTERISTIC
 /begin REF_CHARACTERISTIC CLRS /end REF_CHARACTERISTIC
 /begin IN_MEASUREMENT azlrdkt B_dktlp B_lasostc B_lasostc2 B_lr B_lr2 g1korr lamsbg2_w lamsbg_w msabvvk2_w msabvvk_w nmot_w rl_w rriext_w tkivkm2_w tkivkm_w tmot tzlrdkt_w /end IN_MEASUREMENT
 /begin OUT_MEASUREMENT B_lrssp B_lrssp2 B_lrzatrg B_za B_za2 dfrza2_w dfrzaf2_w dfrzaf_w dfrza_w dlamza2_w dlamza_w tlrs2_w tlrs_w zlrs zlrs2_w zlrs_w /end OUT_MEASUREMENT
 /begin LOC_MEASUREMENT B_trigger dfrzaff2_w dfrzaff_w dfrzapr_w lrstza_w lrsza msabmod_w /end LOC_MEASUREMENT
/end FUNCTION
/begin FUNCTION BGLASO "4.60"
 /begin DEF_CHARACTERISTIC CWBGLASO FRIRLABBR LASTCMN LASTCMX TFRECILAM VSONTL VSONTL2 /end DEF_CHARACTERISTIC
 /begin IN_MEASUREMENT B_ddkds B_stendes flamsl2_w flamsl_w lamsbg2_w lamsbg_w msabg2_w msabg_w msabikr2_w msabikr_w pabnav2_w pabnav_w pabvvk2_w pabvvk_w redistb1 redistb2 rir_w rldte_w rllaso2_w rllaso_w taikr2_w taikr_w tavvk2_w tavvk_w tlrs_w zlrs_w zzbank /end IN_MEASUREMENT
 /begin OUT_MEASUREMENT B_lasostc B_lasostc2 evabkor2_w evabkor_w labbrm2_w labbrm_w labrgs2_w labrgs_w lamsbrs2_w lamsbrs_w lamsons2_w lamsons_w laoikrm2_w laoikrm_w laontlm2_w laontlm_w laonvkm2_w laonvkm_w recilamf_w recilam_w /end OUT_MEASUREMENT
 /begin LOC_MEASUREMENT B_totab B_totab2 rklabbr2_w rklabbr_w rllabbr2_w rllabbr_w tlrsk_w tsontl2_w tsontl_w zylzab zylzab2 /end LOC_MEASUREMENT
/end FUNCTION
/begin FUNCTION BGLBZ "8.20" /begin DEF_CHARACTERISTIC CWLBZAPP DLBZ ZKLBZ /end DEF_CHARACTERISTIC /begin REF_CHARACTERISTIC LBZO1 NSLBZFS NSLBZFS2 NSLBZLL NSLBZLL2 /end REF_CHARACTERISTIC /begin IN_MEASUREMENT B_fs B_nlbzanf B_nlbzanf2 nstat /end IN_MEASUREMENT /begin OUT_MEASUREMENT B_nlbzakt B_nlbzakt2 lbz /end OUT_MEASUREMENT /end FUNCTION
/begin FUNCTION BGMIL "2.50" /begin DEF_CHARACTERISTIC CWBGMIL TMILAS TMILRB TMILVT /end DEF_CHARACTERISTIC
 /begin IN_MEASUREMENT B_blkfb B_blkmd B_milfb B_milmd B_milsfr B_nmot B_stend dfpmEpclState dfpmMilState milactsfc milactsf_w ready /end IN_MEASUREMENT
 /begin OUT_MEASUREMENT B_blkeb B_epcl B_kmmil B_mil B_milact B_milas B_milblk B_milclr B_mileb B_milfd B_milfon B_milkm B_milrb B_milsf B_milsfint B_milstat B_milste B_milvt B_nomil milstat milstate_w milstatnov StateActionID StateID tcmilas tcmilrb tcmilvt /end OUT_MEASUREMENT
/end FUNCTION
/begin FUNCTION BGMILSF "1.10" /begin OUT_MEASUREMENT B_milsfr milactsfc milactsf_w /end OUT_MEASUREMENT /end FUNCTION
/begin FUNCTION BGMSABG "7.20" /begin DEF_CHARACTERISTIC ZYLANZB ZYLANZB2 /end DEF_CHARACTERISTIC /begin IN_MEASUREMENT msfabr_w msl2_w msl_w rkg2_w rkg_w umsrln_w /end IN_MEASUREMENT
 /begin OUT_MEASUREMENT mabghks2_w mabghks_w mabikrs2_w mabikrs_w mabnavs2_w mabnavs_w mabnhks2_w mabnhks_w mabnvks2_w mabnvks_w mabvhks2_w mabvhks_w mabvvks2_w mabvvks_w mlbb2_w mlbb_w msabg msabg2 msabg2_w msabghk2_w msabghk_w msabgs2_w msabgs_w msabg_w msabikr2_w msabikr_w msabnav2_w msabnav_w msabnhk2_w msabnhk_w msabnvk2_w msabnvk_w msabvhk2_w msabvhk_w msabvvk2_w msabvvk_w msaovvk2_w msaovvk_w verhmsb2_w verhmsb_w /end OUT_MEASUREMENT
 /begin LOC_MEASUREMENT mskgb2_w mskgb_w /end LOC_MEASUREMENT
/end FUNCTION
/begin FUNCTION BGMSZS "25.60"
 /begin DEF_CHARACTERISTIC CWBGMSZS CWFKMSDKA DDRLDKZU DFKMSMN DFKMSMX DFKPVMN DFKPVMX FKMSDKMN FKMSDKMX FKPVDKMN FKPVDKMX KFMSNWDK KIMSALL KLAF KUMSRL MLFKMSDK MSALLMN MSALLMX MSLG PSPVDKUG RLNOT TDABGLST TDMSDKS WDKUGDN ZKMSDKTHFM ZKPVDKT ZRFKMSDK /end DEF_CHARACTERISTIC
 /begin REF_CHARACTERISTIC SNM12FEUB /end REF_CHARACTERISTIC
 /begin IN_MEASUREMENT B_dteaam B_dtest B_edks B_ehfm B_fkmsdks B_hfm B_pwf B_stend dmsnte_w esst_snm12feub fpvdkds_w ftvdk ml_w mshfms_w mste nmot nmot_w ps_w pvdkds_w rl_w wdkba_w /end IN_MEASUREMENT
 /begin OUT_MEASUREMENT BGMSZSbits B_fgabgl B_fkmsmn B_fkmsmx B_fkpvdk B_fkpvmn B_fkpvmx B_inilabgl B_inimsdko B_inisabgl B_msndko B_mszsdkb B_mxrlroh B_ugd dfuelsan_w fklaf_w fkmsdkg_w fkmsdksg_w fkmsdks_w fkmsdk_w fkpvdkg_w fkpvdk_w fpvdk fpvdk_w frhodk_w msdkalm_w msdk_w msndkoo_w msndko_w msndk_w msnsaug_w mssaug_w pspvdb_w pspvdkf_w pspvdk_w pspvds_w pvdk pvdk_w rldkofk_w rldvs_w rlfdkroh_w rlfgroh_w rlflmroh_w rlroh_w rlzuhfs_w rlzunfs_w umsrln_w wdkugd_w /end OUT_MEASUREMENT
 /begin LOC_MEASUREMENT B_edsli drllad_w klaf_kge msdkf_w msdkue_w rlfdkrof_w rlnotn_w wdkbab_w /end LOC_MEASUREMENT
/end FUNCTION
/begin FUNCTION BGNG "5.20" /begin DEF_CHARACTERISTIC ZNGFIL /end DEF_CHARACTERISTIC /begin IN_MEASUREMENT nmot_w tseghi tseg_w /end IN_MEASUREMENT
 /begin OUT_MEASUREMENT B_ngasok B_syn2nd dnmotas_w dnmot_w irspsyn ngas_w ngfil ngfil_w nmotas_w nmotrsp_w tsas_w tsegrsp_w /end OUT_MEASUREMENT
/end FUNCTION
/begin FUNCTION BGNMOT "5.60" /begin IN_MEASUREMENT B_bm B_nmin tnbm1_w tnbm_w tr_zeit tr_zeit_msb zztab /end IN_MEASUREMENT /begin OUT_MEASUREMENT nmot nmotll nmotllfil nmot_w tseghi tseg_w /end OUT_MEASUREMENT /end FUNCTION
/begin FUNCTION BGNWDEF "1.11" /begin IN_MEASUREMENT B_phad B_phad2 /end IN_MEASUREMENT /begin OUT_MEASUREMENT B_p1refpos B_p2refpos /end OUT_MEASUREMENT /end FUNCTION
/begin FUNCTION BGPABG "2.21" /begin DEF_CHARACTERISTIC FPVHKMSAB FPVHKTTA FPVHKTTA2 FPVVKMSAB FPVVKTTA /end DEF_CHARACTERISTIC
 /begin IN_MEASUREMENT msabvhk2_w msabvhk_w msabvvk_w pu_w tkihkmm2_w tkihkmm_w tkivkmm_w /end IN_MEASUREMENT
 /begin OUT_MEASUREMENT fpabnav2_w fpabnav_w pabnav2_w pabnav_w pabvhk2_w pabvhk_w pabvvk2_w pabvvk_w /end OUT_MEASUREMENT
 /begin LOC_MEASUREMENT dpabvhk2_w dpabvhk_w dpabvvk_w fpvhk2_w fpvhkt fpvhkt2 fpvhk_w fpvvkt fpvvk_w /end LOC_MEASUREMENT
/end FUNCTION
/begin FUNCTION BGPIRG "3.50"
 /begin DEF_CHARACTERISTIC CWPIRGAP DNWVSMN FPVMXST FUPSRLMN FUPSRLMX FWNWVSAP FWNWVSO FWNWVSU KFFUPSRLK KFPIRGRES KFPRGA KFPRGE KFPRGSUA KFPRGSUE KFUPSRLKNW KFURLA KFURLE KFURLSUA KFURLSUE KISRM KISRMSU KLPRGAGPS PBRINTMN PBRINTMX /end DEF_CHARACTERISTIC
 /begin IN_MEASUREMENT B_st B_su fho_w fnwue fpabnav2_w fpabnav_w fsu_w ftbr_w ftsr nmot_w pabnav2_w pabnav_w ps_w pvdkds_w rfges_w rlfg_w wnwa_w wnwe_w wnwsmna_w wnwsmxe_w wnwvumxa_w wnwvumxe_w wnwvu_w /end IN_MEASUREMENT
 /begin OUT_MEASUREMENT fkisrm_w fprgagps_w fupsrluk_w fupsrl_w fvisrm_w fwnwvs_w pbrintuk_w pbrint_w pirgres_w pirg_w psmx_w rfrint_w rfr_w rirint_w rir_w rlrint_w rlr_w rri_w rr_w wnwspue_w xfvisrm_w /end OUT_MEASUREMENT
 /begin LOC_MEASUREMENT dfupsrla_w dfupsrle_w dpbra_w dpbre_w ffupsrlk_w fpsrlroa_w fpsrlroe_w fupsrlro_w furla_w furle_w furlsua_w furlsue_w nwvsakt_w nwvsfrue_w nwvsmnu_w nwvsspae_w pbrintna_w pbrintro_w pbriroa_w pbriroe_w prga_w prge_w prgsua_w prgsue_w vpspanav_w /end LOC_MEASUREMENT
/end FUNCTION
/begin FUNCTION BGPUK "1.20" /begin DEF_CHARACTERISTIC DIFFMAX PUKORRV PUSMAX PUSMIN TPUKOR /end DEF_CHARACTERISTIC /begin IN_MEASUREMENT pus_w vfzg_w /end IN_MEASUREMENT /begin OUT_MEASUREMENT B_add B_puerr pukBits pukorf_w pukor_w /end OUT_MEASUREMENT /begin LOC_MEASUREMENT pumean_w /end LOC_MEASUREMENT /end FUNCTION
/begin FUNCTION BGRBS "5.30" /begin DEF_CHARACTERISTIC CWRBS TMVDBS VASRM VRADF /end DEF_CHARACTERISTIC /begin IN_MEASUREMENT B_cdswe vfzg vrad_hl_w vrad_hr_w vrad_vl_w vrad_vr_w /end IN_MEASUREMENT /begin OUT_MEASUREMENT bsc /end OUT_MEASUREMENT /begin LOC_MEASUREMENT B_absf dv_hl dv_hr dv_vl dv_vr dv_w /end LOC_MEASUREMENT /end FUNCTION
/begin FUNCTION BGRFNW "1.40" /begin DEF_CHARACTERISTIC DWNRFPT DWNSRFIX FRFWNI FRFWNP /end DEF_CHARACTERISTIC
 /begin IN_MEASUREMENT B_bkvnwab B_nws B_ugdnws rfinugds_w rfrints_w wnsrfixe_w wnwe_w wnwsae_w /end IN_MEASUREMENT
 /begin OUT_MEASUREMENT B_dwdknws dwnsrfie_w /end OUT_MEASUREMENT
 /begin LOC_MEASUREMENT dwnrfiie_w dwnrfipe_w dwnrfixe_w /end LOC_MEASUREMENT
/end FUNCTION
/begin FUNCTION BGRLG "1.20" /begin IN_MEASUREMENT B_ngasok irspsyn rl_w tsegrsp_w /end IN_MEASUREMENT /begin OUT_MEASUREMENT drlas_w rlgas_w /end OUT_MEASUREMENT /begin LOC_MEASUREMENT rlrsp_w tas_w /end LOC_MEASUREMENT /end FUNCTION
/begin FUNCTION BGRLMXS "2.10" /begin DEF_CHARACTERISTIC KLRLNMXN /end DEF_CHARACTERISTIC /begin IN_MEASUREMENT fho_w ftbr_w nmot_w rl_w /end IN_MEASUREMENT /begin OUT_MEASUREMENT rlmxs_w rlugd_w rml /end OUT_MEASUREMENT /begin LOC_MEASUREMENT rlvugd_w /end LOC_MEASUREMENT /end FUNCTION
/begin FUNCTION BGRLP "4.60"
 /begin DEF_CHARACTERISTIC CBGRLP DRLDYNU DRLMIN DTEPRU DWPR DWPRNSP FGDPSMPDVS FPVMXP TNSURLP WPRMX /end DEF_CHARACTERISTIC
 /begin REF_CHARACTERISTIC KFMSNWDK KLAF PSPVDKUG /end REF_CHARACTERISTIC
 /begin IN_MEASUREMENT B_dknolu B_ll B_nswo2 B_st B_stend dpsfg_w drl_w fpbrkds_w frhodk_w fupsrl_w fvisrm_w grundwert klaf_kge msndko_w mste nmot_w pirg_w pspvds_w ps_w pvdk_w rldvs_w rl_w te_w tvu_w umsrln_w wdkbap_w wdksp_w wdkugd_w wea wee wessbm /end IN_MEASUREMENT
 /begin OUT_MEASUREMENT B_nsp B_tired dpsmp_w drlp_w rlp rlp_w /end OUT_MEASUREMENT
 /begin LOC_MEASUREMENT B_rlp B_rlpns B_ugdsp dpsdvs_w fwprs_w msndkpk_w psmppvdk_w psmp_w pspmx_w psp_w rlmp_w rlrohmp_w vwkw wdkbapb_w wpr wprnsp /end LOC_MEASUREMENT
/end FUNCTION
/begin FUNCTION BGTABSA "1.50" /begin IN_MEASUREMENT B_pwf B_stend B_tabcan B_tabststp tabcan_w tengoff_l /end IN_MEASUREMENT /begin OUT_MEASUREMENT bgtabsaAusBits B_uhrexte B_uhrextof trsec_l /end OUT_MEASUREMENT /begin LOC_MEASUREMENT tabadd_w /end LOC_MEASUREMENT /end FUNCTION
/begin FUNCTION BGTABST "11.60"
 /begin DEF_CHARACTERISTIC CWBGTABST DTABOVF DTABUNPL LNXQTM TNLSGM TNSEUHRCMP TRSECMX TVABST TVUHR TVUHRDEV UHRMNDEV UHRMXDEV ZKTABTU /end DEF_CHARACTERISTIC
 /begin IN_MEASUREMENT B_nachlstp B_nlwst B_nmin B_pwf B_stend B_tumnpl B_uhrexte B_uhrextof tmotab tmst tnse_w trsec_l tumg /end IN_MEASUREMENT
 /begin OUT_MEASUREMENT bgtabstBits1_50ms bgtabstBits2_50ms bgtabstBits3_1000ms B_abstgp B_abstnlgp B_abstnpl B_tabststp tabsnl0_w tabsnl_w tabstm_w tabst_w tabsuhr_w tengoff_l /end OUT_MEASUREMENT
 /begin LOC_MEASUREMENT B_abstmnpl B_abstnlg0 B_abstuhrg B_pltab B_tabuhrof B_tabunpl B_uhrnpl B_uhrnpl0 B_uhrnpl1 tabststp tabsuhr0_w tengoff0_l tengon_l tnseuhr_w trsectmp_l uhrdev xqtm_w /end LOC_MEASUREMENT
/end FUNCTION
/begin FUNCTION BGTEMPK "10.60"
 /begin DEF_CHARACTERISTIC CWTEMPK DEVTMAGR EVTMODO FDVANS FWFTBRTA FWLKFTBR KFDFBTMN KFDFBTMP KFFWTBR KLFAKTABGM TMOTWRM ZBRT ZDBTMN ZDBTMP ZTDAGR ZTMMBR /end DEF_CHARACTERISTIC
 /begin IN_MEASUREMENT nmot nmot_w pabnav_w pirg_w ps_w rl tabgkrm_w tabgm_w tans tmot /end IN_MEASUREMENT
 /begin OUT_MEASUREMENT evtmod ftbr ftbr_w ftsr ftu ftvdk /end OUT_MEASUREMENT
 /begin LOC_MEASUREMENT dtbrt_w ftw tabgsant_w tbrraum_w tempin tfrgsant_w tmischbr_w tmotdif tmotfil tsges_w vpspabna_w /end LOC_MEASUREMENT
/end FUNCTION
/begin FUNCTION BGTEV "4.60"
 /begin DEF_CHARACTERISTIC FLTEFUEL FUMRMV FUMSTEK KAFLTESG KFAFTE KLAFTE KMLTESG MSNTATE MSNTEVO /end DEF_CHARACTERISTIC
 /begin IN_MEASUREMENT B_dteaa fho_w ftvdk nmot pspvdk_w ps_w tans tateist_w wdkba /end IN_MEASUREMENT
 /begin OUT_MEASUREMENT msntevo_w mste mstedte mstedte_w msteo_w mste_w vregdia_w /end OUT_MEASUREMENT
 /begin LOC_MEASUREMENT faftekf fafte_w ftho_w mleitmx_w mleit_w msntetev_w mstetev_w qltefil wdkbate /end LOC_MEASUREMENT
/end FUNCTION
/begin FUNCTION BGTOL "4.40"
 /begin DEF_CHARACTERISTIC CWKONGTO DTATMSTOL DTMABSTOL DTMTOLOFF TABSTOLTM TDTOL TOLE ZKTPTOLTM /end DEF_CHARACTERISTIC
 /begin IN_MEASUREMENT B_ctol B_ctole B_st B_tolcb ctol tabst_w tans tmot tmotab tmst wtol /end IN_MEASUREMENT
 /begin OUT_MEASUREMENT BGTOLausbits1 B_etoltm toel toelk_w toltm /end OUT_MEASUREMENT
/end FUNCTION
/begin FUNCTION BGTOLZK "1.10" /begin DEF_CHARACTERISTIC CWTOELZK /end DEF_CHARACTERISTIC /begin IN_MEASUREMENT tmot toelk_w /end IN_MEASUREMENT /begin OUT_MEASUREMENT toelzk_w /end OUT_MEASUREMENT /end FUNCTION
/begin FUNCTION BGTUMG "7.20"
 /begin DEF_CHARACTERISTIC CWKONGTU DTMTATUM IMTUMTA KLDTUMTA NTUMTA TABMNTUM TDTUM TMMXTUM TUMTAI TVTUMTA VTUMTA /end DEF_CHARACTERISTIC
 /begin IN_MEASUREMENT B_abstgp B_ctum B_ctume B_nmot B_pwf B_stend B_tmsrt ctum imlatm_w nmot tabst_w tans tmot tmst vfzg /end IN_MEASUREMENT
 /begin OUT_MEASUREMENT bgtumgBits_1000ms B_tumkst B_tumnpl tum tumg tumgk_w /end OUT_MEASUREMENT
 /begin LOC_MEASUREMENT tumtmp /end LOC_MEASUREMENT
/end FUNCTION
/begin FUNCTION BGVMAX "1.70" /begin DEF_CHARACTERISTIC DVMAXTOM VMAXNB VMAXTM VMAXTOL /end DEF_CHARACTERISTIC /begin IN_MEASUREMENT tmki tmot toelk_w vfzg_w vstvvr /end IN_MEASUREMENT /begin OUT_MEASUREMENT vmax_w /end OUT_MEASUREMENT /begin LOC_MEASUREMENT tmotrvmx vmaxtm_w vmaxtol_w vmaxtom_w /end LOC_MEASUREMENT /end FUNCTION
/begin FUNCTION BGWDKM "1.11" /begin DEF_CHARACTERISTIC ZWDKM1 ZWDKM2 /end DEF_CHARACTERISTIC /begin IN_MEASUREMENT wdksp_w /end IN_MEASUREMENT /begin OUT_MEASUREMENT wdkbap_w /end OUT_MEASUREMENT /end FUNCTION
/begin FUNCTION BGWPFGR "2.30" /begin DEF_CHARACTERISTIC CWBGWPFGR KFWPFGR TFWPFGR WPFGRBMR /end DEF_CHARACTERISTIC /begin IN_MEASUREMENT B_acc B_fgren mrfgr_w nmot_w zstfgr /end IN_MEASUREMENT /begin OUT_MEASUREMENT wpfgr_w /end OUT_MEASUREMENT /end FUNCTION
/begin FUNCTION BKV "2.80"
 /begin DEF_CHARACTERISTIC CWBKV DPBKVSPS DPBKVUKKPU DPBKVUKNW DPBKVUKP DPBKVUKPU DPBKVUS KFKOMABNPU MRFAMXKAHY OPBKVUKKB OPBKVUKNWB OPBKVUKPB OPBKVUKPUB PBKVKREHY PBKVKRHY TDBKVKOMAB TDBKVNWAB TDBKVP TDBKVSTED TDPBKVMN TDPBKVMNP TEBKVNWAB TEPBKVMN TEPPBKV /end DEF_CHARACTERISTIC
 /begin IN_MEASUREMENT B_bkvp B_brems B_cdbkvp B_kh B_ll dpbkvu_w fho_w mrfa_w nmot_w psspbkv_w ps_w pubkv_w tnst_w /end IN_MEASUREMENT
 /begin OUT_MEASUREMENT B_bkvagrab B_bkvdkhab B_bkvkomab B_bkvleer B_bkvnkhab B_bkvnwab B_bkvpa dpbkvukp_w psmxbkvg psmxbkvg_w /end OUT_MEASUREMENT
 /begin LOC_MEASUREMENT BKVlokbits0 B_bkvkoma B_bkvnwum B_pbkvmn B_pbkvmnp dpbkvukb_w dpbkvukk_w dpbkvukr_w dpbkvuk_w dpbkvunw_w dpbukkb_w dpbukk_w dpbuknwb_w dpbuknw_w dpbukpb_w dpbukp_w psbkv_w /end LOC_MEASUREMENT
/end FUNCTION
/begin FUNCTION CANECU "6.70"
 /begin DEF_CHARACTERISTIC CANVERS CCMKBI CWBUSOFF CWCAUVW CWCMOT5 CWCMOT7 CWGC CWLLG CWMOTFLX CWOBDCAN CW_CAN_S_0___A CW_CAN_S_1___A FMOTC KVNPZ MDMAXKBI MDNORM MOTTYP NDYDAMPF NMAXKBI PMAXKBI TGENONC VANZKBI /end DEF_CHARACTERISTIC
 /begin REF_CHARACTERISTIC CWCOWIV CW_CAN_R_0___A CW_CAN_R_1___A CW_CAN_R_2___A CW_CAN_R_3___A CW_CAN_R_4___A CW_CAN_R_5___A CW_CAN_R_6___A CW_CAN_R_7___A T_NOMGAT /end REF_CHARACTERISTIC
 /begin IN_MEASUREMENT bfgrsc B_anlasc B_anlfr B_autget B_blc B_brc B_bus_off B_cdma B_dcy B_dnmcan B_epcl B_fgrat B_fgrbr B_fgrhsa B_fgrtbe B_fgrtbh B_fgrtse B_fgrtve B_fgrtvh B_fgrtwa B_gatbot B_gracan B_gralc B_gsala B_kd B_kl15 B_kmtre B_koe B_kosrc B_kov B_kovkmtr B_kuppl B_kvakbi B_ll B_llped B_mil B_mshlon B_nlbzakt B_nlbzakt2 B_nlcan B_nmax B_nmin B_sleepa B_statbr B_statgec B_statmdc B_statnb B_stattoc B_stend B_tolcb B_tolfstc B_tolueb B_tverac B_vmax B_wowarn B_wswarn B_wuc dnmcan fcmEnd ffzdfp fgnsol fho genlrc kldfpwm kldfpwmf kvakbi_w mdverlc miautgetc miautgsc mifab_w miistc mimax_w mivbeb_w mivbeg_w mizwmnc momintrest nmot_c nmot_w nstat pu statgra tans tmot tnst_w tolc tvluesic ub vfzg vzgrac wdcan wdkba wfv_w woeldir woeloff woeltol wpedc wpedv_w wsmit wtmax wtmin wwertmin wwmax wwmin wzcan /end IN_MEASUREMENT
 /begin OUT_MEASUREMENT bz_cmf bz_mot6 bz_mot8 B_genonc B_sleepi cs_mot5 cs_mot6 cs_mot8 /end OUT_MEASUREMENT
 /begin LOC_MEASUREMENT ctr_motorflexia Motor_6_100 mux_counter mux_counter2 t_nomgatCtr1 /end LOC_MEASUREMENT
/end FUNCTION
/begin COMPU_METHOD acc_ub_b55p55 "" RAT_FUNC "%6.3" "m/(s^2)" COEFFS 0 1 0 0 0 0.217 /end COMPU_METHOD
/begin COMPU_METHOD B_TRUE "" TAB_VERB "%6.3" "" COMPU_TAB_REF B_TRUE /end COMPU_METHOD
/begin COMPU_VTAB B_TRUE "" TAB_VERB 2 0 "----" 1 "TRUE" /end COMPU_VTAB
/begin COMPU_METHOD DEZ "" RAT_FUNC "%6.2" "" COEFFS 0 1 0 0 0 1 /end COMPU_METHOD
/begin COMPU_METHOD dez "" RAT_FUNC "%6.2" "" COEFFS 0 1 0 0 0 1 /end COMPU_METHOD
/begin COMPU_METHOD dichte_ub_b2 "" RAT_FUNC "%6.4" "kg/m^3" COEFFS 0 256 0 0 0 2 /end COMPU_METHOD
/begin COMPU_METHOD fak1_q1p63Em5 "" RAT_FUNC "%7.6" "[g*K]/hPa" COEFFS 0 61440 0 0 0 1 /end COMPU_METHOD
/begin COMPU_METHOD fak1_q4p3945Em4 "" RAT_FUNC "%6.5" "[kg/h]/g" COEFFS 0 65536 0 0 0 28.8 /end COMPU_METHOD
/begin COMPU_METHOD fak_q0p0039 "" RAT_FUNC "%6.4" "-" COEFFS 0 256 0 0 0 1 /end COMPU_METHOD
/begin COMPU_METHOD fak_q16_hPahPa "" RAT_FUNC "%6.1" "hPa*hPa" COEFFS 0 1 0 0 0 16 /end COMPU_METHOD
/begin COMPU_METHOD fak_q20_hPahPa_mul_h_div_kg "" RAT_FUNC "%6.1" "hPa*hPa*h/kg" COEFFS 0 1 0 0 0 20 /end COMPU_METHOD
/begin COMPU_METHOD fak_sw_b1 "" RAT_FUNC "%7.6" "-" COEFFS 0 65536 0 0 0 2 /end COMPU_METHOD
/begin COMPU_METHOD fak_sw_b64 "" RAT_FUNC "%6.4" "-" COEFFS 0 65536 0 0 0 128 /end COMPU_METHOD
/begin COMPU_METHOD fak_sw_b8 "" RAT_FUNC "%6.5" "-" COEFFS 0 65536 0 0 0 16 /end COMPU_METHOD
/begin COMPU_METHOD fak_ub_b0p25 "" RAT_FUNC "%10.7" "-" COEFFS 0 256 0 0 0 0.25 /end COMPU_METHOD
/begin COMPU_METHOD fak_ub_b1 "" RAT_FUNC "%6.4" "-" COEFFS 0 256 0 0 0 1 /end COMPU_METHOD
/begin COMPU_METHOD fak_ub_b2 "" RAT_FUNC "%6.4" "-" COEFFS 0 256 0 0 0 2 /end COMPU_METHOD
/begin COMPU_METHOD fak_ub_b4 "" RAT_FUNC "%6.4" "-" COEFFS 0 256 0 0 0 4 /end COMPU_METHOD
/begin COMPU_METHOD fak_uw_b1 "" RAT_FUNC "%7.6" "-" COEFFS 0 65536 0 0 0 1 /end COMPU_METHOD
/begin COMPU_METHOD fak_uw_b16 "" RAT_FUNC "%6.5" "-" COEFFS 0 65536 0 0 0 16 /end COMPU_METHOD
/begin COMPU_METHOD fak_uw_b2 "" RAT_FUNC "%7.6" "-" COEFFS 0 65536 0 0 0 2 /end COMPU_METHOD
/begin COMPU_METHOD fak_uw_b32 "" RAT_FUNC "%6.5" "-" COEFFS 0 65536 0 0 0 32 /end COMPU_METHOD
/begin COMPU_METHOD fak_uw_b4 "" RAT_FUNC "%7.6" "-" COEFFS 0 65536 0 0 0 4 /end COMPU_METHOD
/begin COMPU_METHOD fak_uw_b8 "" RAT_FUNC "%6.5" "-" COEFFS 0 65536 0 0 0 8 /end COMPU_METHOD
/begin COMPU_METHOD fak_uw_q0p001 "" RAT_FUNC "%6.5" "-" COEFFS 0 65536 0 0 0 65.536 /end COMPU_METHOD
/begin COMPU_METHOD kumsrl_ub_b0p002 "" RAT_FUNC "%10.9" "(kg/h)/((1/min)*%)" COEFFS 0 128000 0 0 0 1 /end COMPU_METHOD
/begin COMPU_METHOD kva_ub_q20 "" RAT_FUNC "%6.1" "L/Zyl." COEFFS 0 1 0 0 0 20 /end COMPU_METHOD
/begin COMPU_METHOD kwprs_q0p001302 "" RAT_FUNC "%6.4" "°KW/%s" COEFFS 0 65536 0 0 0 85.3333333333333 /end COMPU_METHOD
/begin COMPU_METHOD kwpr_q0p001302 "" RAT_FUNC "%6.4" "°KW/%" COEFFS 0 65536 0 0 0 85.3333333333333 /end COMPU_METHOD
/begin COMPU_METHOD kw_q0p0078 "" RAT_FUNC "%6.4" "Grad KW" COEFFS 0 128 0 0 0 1 /end COMPU_METHOD
/begin COMPU_METHOD kw_q1 "" RAT_FUNC "%6.2" "Grad KW" COEFFS 0 1 0 0 0 1 /end COMPU_METHOD
/begin COMPU_METHOD kw_q6 "" RAT_FUNC "%6.2" "Grad KW" COEFFS 0 1 0 0 0 6 /end COMPU_METHOD
/begin COMPU_METHOD kw_sw_q0p0078 "" RAT_FUNC "%6.4" "Grad KW" COEFFS 0 128 0 0 0 1 /end COMPU_METHOD
/begin COMPU_METHOD md_ub_q10 "" RAT_FUNC "%6.1" "Nm" COEFFS 0 1 0 0 0 10 /end COMPU_METHOD
/begin COMPU_METHOD mk1sxs_b2560 "" RAT_FUNC "%6.1" "s/(kg/h)" COEFFS 0 0 2560 0 1 0 /end COMPU_METHOD
/begin COMPU_METHOD m_q0p001 "" RAT_FUNC "%6.5" "kg/s" COEFFS 0 1000 0 0 0 1 /end COMPU_METHOD
/begin COMPU_METHOD m_q1p6 "" RAT_FUNC "%6.2" "kg/h" COEFFS 0 1 0 0 0 1.6 /end COMPU_METHOD
/begin COMPU_METHOD m_q2p71Em5_g "" RAT_FUNC "%7.6" "g" COEFFS 0 65536 0 0 0 1.77778 /end COMPU_METHOD
/begin COMPU_METHOD m_q2p777Em5 "" RAT_FUNC "%7.6" "kg/s" COEFFS 0 3600 0 0 0 0.1 /end COMPU_METHOD
/begin COMPU_METHOD m_ub_b1020 "" RAT_FUNC "%6.2" "kg/h" COEFFS 0 1 0 0 0 4 /end COMPU_METHOD
/begin COMPU_METHOD m_ub_b25p6 "" RAT_FUNC "%6.3" "kg/h" COEFFS 0 256 0 0 0 25.6 /end COMPU_METHOD
/begin COMPU_METHOD m_ub_b5 "" RAT_FUNC "%6.4" "kg" COEFFS 0 255 0 0 0 5 /end COMPU_METHOD
/begin COMPU_METHOD m_uw_b23p3 "" RAT_FUNC "%6.5" "kg" COEFFS 0 2812.5 0 0 0 1 /end COMPU_METHOD
/begin COMPU_METHOD m_uw_b25p6 "" RAT_FUNC "%6.5" "kg/h" COEFFS 0 65536 0 0 0 25.6 /end COMPU_METHOD
/begin COMPU_METHOD m_uw_b6553p5 "" RAT_FUNC "%6.3" "kg/h" COEFFS 0 1 0 0 0 0.1 /end COMPU_METHOD
/begin COMPU_METHOD m_uw_q0p0005 "" RAT_FUNC "%6.5" "kg/h" COEFFS 0 1 0 0 0 0.0005 /end COMPU_METHOD
/begin COMPU_METHOD nmotg_sb_q100 "" RAT_FUNC "%6.0" "1/min/s" COEFFS 0 1 0 0 0 100 /end COMPU_METHOD
/begin COMPU_METHOD nmotg_sw_q0p39 "" RAT_FUNC "%6.3" "1/min/s" COEFFS 0 1 0 0 0 0.39063 /end COMPU_METHOD
/begin COMPU_METHOD nmot_sw_q0p25 "" RAT_FUNC "%6.3" "1/min" COEFFS 0 1 0 0 0 0.25 /end COMPU_METHOD
/begin COMPU_METHOD nmot_ub_q10 "" RAT_FUNC "%6.1" "1/min" COEFFS 0 1 0 0 0 10 /end COMPU_METHOD
/begin COMPU_METHOD nmot_ub_q100 "" RAT_FUNC "%6.0" "U/min" COEFFS 0 1 0 0 0 100 /end COMPU_METHOD
/begin COMPU_METHOD nmot_ub_q40 "" RAT_FUNC "%6.1" "1/min" COEFFS 0 1 0 0 0 40 /end COMPU_METHOD
/begin COMPU_METHOD nmot_uw_q0p25 "" RAT_FUNC "%6.3" "1/min" COEFFS 0 1 0 0 0 0.25 /end COMPU_METHOD
/begin COMPU_METHOD p_sw_q0p039 "" RAT_FUNC "%6.4" "hPa" COEFFS 0 256 0 0 0 10 /end COMPU_METHOD
/begin COMPU_METHOD p_ub_q10 "" RAT_FUNC "%6.1" "hPa" COEFFS 0 1 0 0 0 10 /end COMPU_METHOD
/begin COMPU_METHOD p_ub_q5 "" RAT_FUNC "%6.2" "hPa" COEFFS 0 1 0 0 0 5 /end COMPU_METHOD
/begin COMPU_METHOD p_uw_b32 "" RAT_FUNC "%6.5" "hPa/%" COEFFS 0 65536 0 0 0 32 /end COMPU_METHOD
/begin COMPU_METHOD p_uw_q0p039 "" RAT_FUNC "%6.4" "hPa" COEFFS 0 256 0 0 0 10 /end COMPU_METHOD
/begin COMPU_METHOD p_uw_q0p078 "" RAT_FUNC "%6.4" "hPa" COEFFS 0 256 0 0 0 20 /end COMPU_METHOD
/begin COMPU_METHOD relDK_q0p02441 "" RAT_FUNC "%6.4" "%DK" COEFFS 0 65536 0 0 0 1600 /end COMPU_METHOD
/begin COMPU_METHOD relDK_q0p3922 "" RAT_FUNC "%6.3" "%DK" COEFFS 0 255 0 0 0 100 /end COMPU_METHOD
/begin COMPU_METHOD relDK_ub_b100 "" RAT_FUNC "%6.3" "%DK" COEFFS 0 255 0 0 0 100 /end COMPU_METHOD
/begin COMPU_METHOD relDK_uw_b100 "" RAT_FUNC "%6.4" "%DK" COEFFS 0 65535 0 0 0 100 /end COMPU_METHOD
/begin COMPU_METHOD relO2_q9p765Em4 "" RAT_FUNC "%6.5" "% O2" COEFFS 0 1024 0 0 0 1 /end COMPU_METHOD
/begin COMPU_METHOD relt_q0p02344 "" RAT_FUNC "%6.4" "%" COEFFS 0 32 0 0 0 0.75 /end COMPU_METHOD
/begin COMPU_METHOD rel_q0p02344 "" RAT_FUNC "%6.4" "%" COEFFS 0 32 0 0 0 0.75 /end COMPU_METHOD
/begin COMPU_METHOD rel_sw_b0p15 "" RAT_FUNC "%8.7" "%/hPa" COEFFS 0 65536 0 0 0 0.3 /end COMPU_METHOD
/begin COMPU_METHOD rel_sw_b100 "" RAT_FUNC "%6.4" "%" COEFFS 0 32768 0 0 0 100 /end COMPU_METHOD
/begin COMPU_METHOD rel_sw_q0p0234 "" RAT_FUNC "%6.4" "%/seg" COEFFS 0 32 0 0 0 0.75 /end COMPU_METHOD
/begin COMPU_METHOD rel_ub_b100 "" RAT_FUNC "%6.3" "%" COEFFS 0 256 0 0 0 100 /end COMPU_METHOD
/begin COMPU_METHOD rel_ub_b99p6 "" RAT_FUNC "%6.3" "%" COEFFS 0 256 0 0 0 100 /end COMPU_METHOD
/begin COMPU_METHOD rel_ub_q0p1875 "" RAT_FUNC "%6.3" "KW/ms" COEFFS 0 256 0 0 0 48 /end COMPU_METHOD
/begin COMPU_METHOD rel_ub_q0p75 "" RAT_FUNC "%6.3" "%" COEFFS 0 1 0 0 0 0.75 /end COMPU_METHOD
/begin COMPU_METHOD rel_uw_b0p3 "" RAT_FUNC "%8.7" "%/hPa" COEFFS 0 65536 0 0 0 0.3 /end COMPU_METHOD
/begin COMPU_METHOD rel_uw_b100 "" RAT_FUNC "%6.4" "%" COEFFS 0 65536 0 0 0 100 /end COMPU_METHOD
/begin COMPU_METHOD rel_uw_b200 "" RAT_FUNC "%6.4" "%" COEFFS 0 65536 0 0 0 200 /end COMPU_METHOD
/begin COMPU_METHOD rel_uw_b3072 "" RAT_FUNC "%6.4" "%" COEFFS 0 65536 0 0 0 3072 /end COMPU_METHOD
/begin COMPU_METHOD rel_uw_b40 "" RAT_FUNC "%6.5" "%" COEFFS 0 65536 0 0 0 40 /end COMPU_METHOD
/begin COMPU_METHOD rel_uw_b491520 "" RAT_FUNC "%6.2" "%/s" COEFFS 0 65536 0 0 0 491520 /end COMPU_METHOD
/begin COMPU_METHOD rel_uw_q0p0234 "" RAT_FUNC "%6.4" "%" COEFFS 0 32 0 0 0 0.75 /end COMPU_METHOD
/begin COMPU_METHOD spg_q0p00977 "" RAT_FUNC "%6.4" "V" COEFFS 0 256 0 0 0 2.5 /end COMPU_METHOD
/begin COMPU_METHOD spg_q0p03125 "" RAT_FUNC "%6.4" "V" COEFFS 0 256 0 0 0 8 /end COMPU_METHOD
/begin COMPU_METHOD spg_q0p1 "" RAT_FUNC "%6.3" "V" COEFFS 0 1 0 0 0 0.1 /end COMPU_METHOD
/begin COMPU_METHOD spg_q1p221_mV "" RAT_FUNC "%6.4" "V" COEFFS 0 65536 0 0 0 80 /end COMPU_METHOD
/begin COMPU_METHOD spg_sw_q0p001222 "" RAT_FUNC "%6.4" "V" COEFFS 0 1 0 0 0 0.001222 /end COMPU_METHOD
/begin COMPU_METHOD spg_ubatt "" RAT_FUNC "%6.4" "V" COEFFS 0 1 0 0 0 0.0704 /end COMPU_METHOD
/begin COMPU_METHOD spg_ub_q0p019 "" RAT_FUNC "%6.4" "V" COEFFS 0 256 0 0 0 5 /end COMPU_METHOD
/begin COMPU_METHOD spg_uw_q0p00488 "" RAT_FUNC "%6.4" "V" COEFFS 0 1024 0 0 0 5 /end COMPU_METHOD
/begin COMPU_METHOD s_q1_km "" RAT_FUNC "%6.2" "km" COEFFS 0 1 0 0 0 1 /end COMPU_METHOD
/begin COMPU_METHOD s_q6_km "" RAT_FUNC "%6.2" "km" COEFFS 0 1 0 0 0 6 /end COMPU_METHOD
/begin COMPU_METHOD t100msxs_ub_b25p5 "" RAT_FUNC "%6.3" "s" COEFFS 0 1 0 0 0 0.1 /end COMPU_METHOD
/begin COMPU_METHOD t100msxs_uw_b6553p5 "" RAT_FUNC "%6.3" "s" COEFFS 0 1 0 0 0 0.1 /end COMPU_METHOD
/begin COMPU_METHOD t100msxs_uw_b6553p6 "" RAT_FUNC "%6.3" "s" COEFFS 0 10 0 0 0 1 /end COMPU_METHOD
/begin COMPU_METHOD t10msxs_ub_b2p55 "" RAT_FUNC "%6.4" "s" COEFFS 0 1 0 0 0 0.01 /end COMPU_METHOD
/begin COMPU_METHOD t10msxs_uw_b655p35 "" RAT_FUNC "%6.4" "s" COEFFS 0 1 0 0 0 0.01 /end COMPU_METHOD
/begin COMPU_METHOD t1sxs_ub_b255 "" RAT_FUNC "%6.2" "s" COEFFS 0 1 0 0 0 1 /end COMPU_METHOD
/begin COMPU_METHOD t1sxs_uw_b65535 "" RAT_FUNC "%6.2" "s" COEFFS 0 1 0 0 0 1 /end COMPU_METHOD
/begin COMPU_METHOD t1sxs_uw_q1 "" RAT_FUNC "%6.2" "s" COEFFS 0 1 0 0 0 1 /end COMPU_METHOD
/begin COMPU_METHOD t20msxs_ub_b5p1 "" RAT_FUNC "%6.4" "s" COEFFS 0 1 0 0 0 0.02 /end COMPU_METHOD
/begin COMPU_METHOD t20msxs_ub_q0p02 "" RAT_FUNC "%6.4" "s" COEFFS 0 50 0 0 0 1 /end COMPU_METHOD
/begin COMPU_METHOD t20msxs_uw_q0p02 "" RAT_FUNC "%6.4" "s" COEFFS 0 1 0 0 0 0.02 /end COMPU_METHOD
/begin COMPU_METHOD t50msxs_q0p05 "" RAT_FUNC "%6.4" "s" COEFFS 0 1 0 0 0 0.05 /end COMPU_METHOD
/begin COMPU_METHOD t50msxs_ub_b12p75 "" RAT_FUNC "%6.4" "s" COEFFS 0 1 0 0 0 0.05 /end COMPU_METHOD
/begin COMPU_METHOD t50msxs_uw_b3276p75 "" RAT_FUNC "%6.4" "s" COEFFS 0 1 0 0 0 0.05 /end COMPU_METHOD
/begin COMPU_METHOD temp_q0p0234_o273 "" RAT_FUNC "%6.1" "Grad C" COEFFS 0 1 273.15 0 0 0.0234375 /end COMPU_METHOD
/begin COMPU_METHOD temp_sb_q0p75 "" RAT_FUNC "%6.3" "Grad C" COEFFS 0 1 0 0 0 0.75 /end COMPU_METHOD
/begin COMPU_METHOD temp_sw_q0p75 "" RAT_FUNC "%6.3" "Grad C" COEFFS 0 4 0 0 0 3 /end COMPU_METHOD
/begin COMPU_METHOD temp_ub_b191p25 "" RAT_FUNC "%6.3" "Grad C" COEFFS 0 1 0 0 0 0.75 /end COMPU_METHOD
/begin COMPU_METHOD temp_ub_q0p75_o48 "" RAT_FUNC "%6.2" "Grad C" COEFFS 0 1 48 0 0 0.75 /end COMPU_METHOD
/begin COMPU_METHOD temp_ub_q1_o60 "" RAT_FUNC "%6.2" "Grad C" COEFFS 0 1 60 0 0 1 /end COMPU_METHOD
/begin COMPU_METHOD temp_uw_q0p0195_o50 "" RAT_FUNC "%6.2" "Grad C" COEFFS 0 256 12800 0 0 5 /end COMPU_METHOD
/begin COMPU_METHOD tinjection_sy "" RAT_FUNC "%6.4" "ms" COEFFS 0 312.5 0 0 0 1 /end COMPU_METHOD
/begin COMPU_METHOD tsegment_sy "" RAT_FUNC "%6.5" "ms" COEFFS 0 1250 0 0 0 1 /end COMPU_METHOD
/begin COMPU_METHOD tsquant "" RAT_FUNC "%6.2" "us" COEFFS 0 1.25 0 0 0 1 /end COMPU_METHOD
/begin COMPU_METHOD tsquantl "" RAT_FUNC "%6.1" "us" COEFFS 0 0.078125 0 0 0 1 /end COMPU_METHOD
/begin COMPU_METHOD tz10msxs_uw_b327p68 "" RAT_FUNC "%6.2" "s" COEFFS 0 0 327.68 0 1 0 /end COMPU_METHOD
/begin COMPU_METHOD t_q0p01 "" RAT_FUNC "%6.4" "s" COEFFS 0 100 0 0 0 1 /end COMPU_METHOD
/begin COMPU_METHOD t_q0p1 "" RAT_FUNC "%6.3" "s" COEFFS 0 10 0 0 0 1 /end COMPU_METHOD
/begin COMPU_METHOD t_q1 "" RAT_FUNC "%6.2" "s" COEFFS 0 1 0 0 0 1 /end COMPU_METHOD
/begin COMPU_METHOD t_q16us "" RAT_FUNC "%6.1" "us" COEFFS 0 1 0 0 0 16 /end COMPU_METHOD
/begin COMPU_METHOD vfzg_ub_q1p25 "" RAT_FUNC "%6.2" "km/h" COEFFS 0 1 0 0 0 1.25 /end COMPU_METHOD
/begin COMPU_METHOD vfzg_uw_b512 "" RAT_FUNC "%6.4" "km/h" COEFFS 0 65536 0 0 0 512 /end COMPU_METHOD
/begin COMPU_METHOD vfzg_uw_q0p00781 "" RAT_FUNC "%6.4" "km/h" COEFFS 0 1 0 0 0 0.0078125 /end COMPU_METHOD
/begin COMPU_METHOD volgrd_q5p96Em4 "" RAT_FUNC "%6.5" "ml/s" COEFFS 0 65536 0 0 0 39.0625 /end COMPU_METHOD
/begin COMPU_METHOD volgrd_q5p96Em7 "" RAT_FUNC "%9.8" "l/s" COEFFS 0 65536 0 0 0 0.0390625 /end COMPU_METHOD
/begin COMPU_METHOD vol_q0p002146 "" RAT_FUNC "%6.4" "l/h" COEFFS 0 65536 0 0 0 140.625 /end COMPU_METHOD
/begin COMPU_METHOD vol_q0p1_l "" RAT_FUNC "%6.3" "l" COEFFS 0 1 0 0 0 0.1 /end COMPU_METHOD
/begin COMPU_METHOD vol_q0p306_cme3 "" RAT_FUNC "%6.3" "cm^3" COEFFS 0 6.5536 0 0 0 2 /end COMPU_METHOD
/begin COMPU_METHOD vol_q3p90625Em3_l "" RAT_FUNC "%6.4" "l" COEFFS 0 65536 0 0 0 256 /end COMPU_METHOD
/begin COMPU_METHOD vrad_uw_b655 "" RAT_FUNC "%6.4" "km/h" COEFFS 0 65536 0 0 0 655 /end COMPU_METHOD
/begin COMPU_METHOD vs_uw_b25p6 "" RAT_FUNC "%6.5" "m^3/h" COEFFS 0 65536 0 0 0 25.6 /end COMPU_METHOD
/begin COMPU_METHOD zk100msxs_ub_b25p5 "" RAT_FUNC "%6.3" "s" COEFFS 0 0 256 0 10 0 /end COMPU_METHOD
/begin COMPU_METHOD zk100msxs_uw_b6553 "" RAT_FUNC "%6.1" "s" COEFFS 0 0 65536 0 10 0 /end COMPU_METHOD
/begin COMPU_METHOD zk10msxs_ub_b2p55 "" RAT_FUNC "%6.4" "s" COEFFS 0 0 255 0 100 0 /end COMPU_METHOD
/begin COMPU_METHOD zk10msxs_ub_b2p56 "" RAT_FUNC "%6.4" "s" COEFFS 0 0 256 0 100 0 /end COMPU_METHOD
/begin COMPU_METHOD zk10msxs_uw_b2p55T "" TAB_INTP "%6.3" "s" COMPU_TAB_REF zk10msxs_uw_b2p55T /end COMPU_METHOD
/begin COMPU_TAB zk10msxs_uw_b2p55T "" TAB_INTP 35 128 2.55 145 2.25 163 2 186 1.75 217 1.5 251 1.3 283 1.15 326 1 362 0.9 407 0.8 465 0.7 541 0.6 649 0.5 720 0.45 809 0.4 923 0.35 1074 0.3 1285 0.25 1524 0.21 1872 0.17 2259 0.14 2426 0.13 2620 0.12 2847 0.11 3118 0.1 3446 0.09 3850 0.08 4362 0.07 5030 0.06 5939 0.05 7248 0.04 9288 0.03 12893 0.02 20713 0.01 32767 0 /end COMPU_TAB
/begin COMPU_METHOD zk10msxs_uw_b655 "" RAT_FUNC "%6.2" "s" COEFFS 0 0 65536 0 100 0 /end COMPU_METHOD
/begin COMPU_METHOD zk1sxs_uw_b65535 "" RAT_FUNC "%6.0" "s" COEFFS 0 0 65535 0 1 0 /end COMPU_METHOD
/begin COMPU_METHOD zk200msxs_ub_b51p2 "" RAT_FUNC "%6.3" "s" COEFFS 0 0 255 0 5 0 /end COMPU_METHOD
/begin COMPU_METHOD zk20msxs_uw_b1310p72 "" RAT_FUNC "%6.1" "s" COEFFS 0 0 65536 0 50 0 /end COMPU_METHOD
/begin COMPU_METHOD zw_ub_q6 "" RAT_FUNC "%6.2" "Grad KW" COEFFS 0 255 0 0 0 1530 /end COMPU_METHOD
/begin RECORD_LAYOUT FklWUw FNC_VALUES 1 UWORD COLUMN_DIR DIRECT /end RECORD_LAYOUT
/begin RECORD_LAYOUT GklWUw FNC_VALUES 1 UWORD COLUMN_DIR DIRECT /end RECORD_LAYOUT
/begin RECORD_LAYOUT KfAxUbAyUbSstxUbSstyUbWUb NO_AXIS_PTS_X 1 UBYTE NO_AXIS_PTS_Y 2 UBYTE AXIS_PTS_X 3 UBYTE INDEX_INCR DIRECT AXIS_PTS_Y 4 UBYTE INDEX_INCR DIRECT FNC_VALUES 5 UBYTE COLUMN_DIR DIRECT /end RECORD_LAYOUT
/begin RECORD_LAYOUT KfAxUbAyUbSstxUwSstyUbWUb NO_AXIS_PTS_X 1 UBYTE NO_AXIS_PTS_Y 2 UBYTE AXIS_PTS_X 3 UWORD INDEX_INCR DIRECT AXIS_PTS_Y 4 UBYTE INDEX_INCR DIRECT FNC_VALUES 5 UBYTE COLUMN_DIR DIRECT /end RECORD_LAYOUT
/begin RECORD_LAYOUT KfAxUwAyUwSstxSwSstyUwWUw NO_AXIS_PTS_X 1 UWORD NO_AXIS_PTS_Y 2 UWORD AXIS_PTS_X 3 SWORD INDEX_INCR DIRECT AXIS_PTS_Y 4 UWORD INDEX_INCR DIRECT FNC_VALUES 5 UWORD COLUMN_DIR DIRECT /end RECORD_LAYOUT
/begin RECORD_LAYOUT KfAxUwAyUwSstxUwSstyUwWUw NO_AXIS_PTS_X 1 UWORD NO_AXIS_PTS_Y 2 UWORD AXIS_PTS_X 3 UWORD INDEX_INCR DIRECT AXIS_PTS_Y 4 UWORD INDEX_INCR DIRECT FNC_VALUES 5 UWORD COLUMN_DIR DIRECT /end RECORD_LAYOUT
/begin RECORD_LAYOUT KlASwSstSwWSw NO_AXIS_PTS_X 1 SWORD AXIS_PTS_X 2 SWORD INDEX_INCR DIRECT FNC_VALUES 3 SWORD COLUMN_DIR DIRECT /end RECORD_LAYOUT
/begin RECORD_LAYOUT KlAUbSstUbWSb NO_AXIS_PTS_X 1 UBYTE AXIS_PTS_X 2 UBYTE INDEX_INCR DIRECT FNC_VALUES 3 SBYTE COLUMN_DIR DIRECT /end RECORD_LAYOUT
/begin RECORD_LAYOUT KlAUbSstUbWUb NO_AXIS_PTS_X 1 UBYTE AXIS_PTS_X 2 UBYTE INDEX_INCR DIRECT FNC_VALUES 3 UBYTE COLUMN_DIR DIRECT /end RECORD_LAYOUT
/begin RECORD_LAYOUT KlAUbSstUbWUw NO_AXIS_PTS_X 1 UBYTE AXIS_PTS_X 2 UBYTE INDEX_INCR DIRECT FNC_VALUES 3 UWORD COLUMN_DIR DIRECT /end RECORD_LAYOUT
/begin RECORD_LAYOUT KlAUbSstUwWUb NO_AXIS_PTS_X 1 UBYTE AXIS_PTS_X 2 UWORD INDEX_INCR DIRECT FNC_VALUES 3 UBYTE COLUMN_DIR DIRECT /end RECORD_LAYOUT
/begin RECORD_LAYOUT KlAUbSstUwWUw NO_AXIS_PTS_X 1 UWORD AXIS_PTS_X 2 UWORD INDEX_INCR DIRECT FNC_VALUES 3 UWORD COLUMN_DIR DIRECT /end RECORD_LAYOUT
/begin RECORD_LAYOUT KlAUwSstSwWUw NO_AXIS_PTS_X 1 UWORD AXIS_PTS_X 2 SWORD INDEX_INCR DIRECT FNC_VALUES 3 UWORD COLUMN_DIR DIRECT /end RECORD_LAYOUT
/begin RECORD_LAYOUT KlAUwSstUwWUb NO_AXIS_PTS_X 1 UWORD AXIS_PTS_X 2 UWORD INDEX_INCR DIRECT FNC_VALUES 3 UBYTE COLUMN_DIR DIRECT /end RECORD_LAYOUT
/begin RECORD_LAYOUT KlAUwSstUwWUw NO_AXIS_PTS_X 1 UWORD AXIS_PTS_X 2 UWORD INDEX_INCR DIRECT FNC_VALUES 3 UWORD COLUMN_DIR DIRECT /end RECORD_LAYOUT
/begin RECORD_LAYOUT KwSb FNC_VALUES 1 SBYTE COLUMN_DIR DIRECT /end RECORD_LAYOUT
/begin RECORD_LAYOUT KwSw FNC_VALUES 1 SWORD COLUMN_DIR DIRECT /end RECORD_LAYOUT
/begin RECORD_LAYOUT KwUb FNC_VALUES 1 UBYTE COLUMN_DIR DIRECT /end RECORD_LAYOUT
/begin RECORD_LAYOUT KwUl FNC_VALUES 1 ULONG COLUMN_DIR DIRECT /end RECORD_LAYOUT
/begin RECORD_LAYOUT KwUw FNC_VALUES 1 UWORD COLUMN_DIR DIRECT /end RECORD_LAYOUT
/begin RECORD_LAYOUT SstAUbSstUb NO_AXIS_PTS_X 1 UBYTE AXIS_PTS_X 2 UBYTE INDEX_INCR DIRECT /end RECORD_LAYOUT
/end MODULE
/end PROJECT
