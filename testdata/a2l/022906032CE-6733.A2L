ASAP2_VERSION 1 3
/begin PROJECT S1103A_25G5_0 "S1103A"
/begin HEADER "" VERSION "S1103A_25G5_0" PROJECT_NO S1103A_25G5_0 /end HEADER
/begin MODULE DIM ""
/begin MOD_COMMON "" BYTE_ORDER MSB_LAST ALIGNMENT_BYTE 1 ALIGNMENT_WORD 2 ALIGNMENT_LONG 2 /end MOD_COMMON
/begin CHARACTERISTIC ADKATNF "" VALUE 0x8E0CA6 KwUb 23.87 spg_ub_b24 0.00 23.87 FORMAT "%5.2" /end CHARACTERISTIC
/begin CHARACTERISTIC AGANGW "" VALUE 0x8E0D88 KwUb 255.0 dez 0.00 255.0 FORMAT "%5.1" /end CHARACTERISTIC
/begin CHARACTERISTIC AHKATMN "" VALUE 0x8E0CA7 KwUb 0.9961 fak_ub_b1 0.00 0.9961 /end CHARACTERISTIC
/begin CHARACTERISTIC AHKATMX "" VALUE 0x8E0CA8 KwUb 0.9961 fak_ub_b1 0.00 0.9961 /end CHARACTERISTIC
/begin CHARACTERISTIC AHKATS "" VALUE 0x8E0CA9 KwUb 1.992 fak_ub_b2 0.00 1.992 FORMAT "%5.3" /end CHARACTERISTIC
/begin CHARACTERISTIC AHKATSB "" VALUE 0x8E0CAA KwUb 0.9961 fak_ub_b1 0.00 0.9961 /end CHARACTERISTIC
/begin CHARACTERISTIC AHKTMXT "" VALUE 0x8E0CAB KwUb 0.9961 fak_ub_b1 0.00 0.9961 /end CHARACTERISTIC
/begin CHARACTERISTIC AHKTTSW "" VALUE 0x8E8098 KwUw 3276.750 t50msxs_uw_b3276p75 0.00 3276.750 FORMAT "%8.3" /end CHARACTERISTIC
/begin CHARACTERISTIC AKUPPLB "" VALUE 0x8E0D89 KwUb 255.0 dez 0.00 255.0 FORMAT "%5.1" /end CHARACTERISTIC
/begin CHARACTERISTIC ANZFEHLER "" VALUE 0x8E0EC4 KwUb 255.0 DEZ 0.00 255.0 FORMAT "%5.1" /end CHARACTERISTIC
/begin CHARACTERISTIC APEKTDX "" VALUE 0x8E0CAC KwUb 255.0 dez 0.00 255.0 FORMAT "%5.1" /end CHARACTERISTIC
/begin CHARACTERISTIC ATMRWT "" VALUE 0x8E8050 KwSw 1535.977 temp_q0p0234 -768.0000 767.9766 FORMAT "%8.4" /end CHARACTERISTIC
/begin CHARACTERISTIC AVKATFS "" VALUE 0x8E0CAD KwUb 0.9961 fak_ub_b1 0.00 0.9961 /end CHARACTERISTIC
/begin CHARACTERISTIC AZLRKTT "" VALUE 0x8E0CAE KwUb 0.249023438 fak_ub_b0p25 0.00 0.249023438 FORMAT "%11.9" /end CHARACTERISTIC
/begin CHARACTERISTIC CDCAATUN "" VAL_BLK 0x8E694C KwbUw 65535.00 dez 0.00 65535.00 FORMAT "%8.2" NUMBER 4 /end CHARACTERISTIC
/begin CHARACTERISTIC CDCASGNPL "" VAL_BLK 0x8E696C KwbUw 65535.00 dez 0.00 65535.00 FORMAT "%8.2" NUMBER 4 /end CHARACTERISTIC
/begin CHARACTERISTIC CDCBREMS "" VAL_BLK 0x8E698C KwbUw 65535.00 dez 0.00 65535.00 FORMAT "%8.2" NUMBER 4 /end CHARACTERISTIC
/begin CHARACTERISTIC CDCBZNPL "" VAL_BLK 0x8E6994 KwbUw 65535.00 dez 0.00 65535.00 FORMAT "%8.2" NUMBER 4 /end CHARACTERISTIC
/begin CHARACTERISTIC CDCCAIRP "" VAL_BLK 0x8E69A4 KwbUw 65535.00 dez 0.00 65535.00 FORMAT "%8.2" NUMBER 4 /end CHARACTERISTIC
/begin CHARACTERISTIC CDCDSU "" VAL_BLK 0x8E6A3C KwbUw 65535.00 dez 0.00 65535.00 FORMAT "%8.2" NUMBER 4 /end CHARACTERISTIC
/begin CHARACTERISTIC CDCEGSBGR "" VAL_BLK 0x8E6AB4 KwbUw 65535.00 dez 0.00 65535.00 FORMAT "%8.2" NUMBER 4 /end CHARACTERISTIC
/begin CHARACTERISTIC CDCFKU "" VAL_BLK 0x8E6B04 KwbUw 65535.00 dez 0.00 65535.00 FORMAT "%8.2" NUMBER 4 /end CHARACTERISTIC
/begin CHARACTERISTIC CDCFP1P "" VAL_BLK 0x8E6B0C KwbUw 65535.00 dez 0.00 65535.00 FORMAT "%8.2" NUMBER 4 /end CHARACTERISTIC
/begin CHARACTERISTIC CDCFP2P "" VAL_BLK 0x8E6B14 KwbUw 65535.00 dez 0.00 65535.00 FORMAT "%8.2" NUMBER 4 /end CHARACTERISTIC
/begin CHARACTERISTIC CDCGRBH "" VAL_BLK 0x8E6B54 KwbUw 65535.00 dez 0.00 65535.00 FORMAT "%8.2" NUMBER 4 /end CHARACTERISTIC
/begin CHARACTERISTIC CDCHRE "" VAL_BLK 0x8E6B6C KwbUw 65535.00 dez 0.00 65535.00 FORMAT "%8.2" NUMBER 4 /end CHARACTERISTIC
/begin CHARACTERISTIC CDCLSHV "" VAL_BLK 0x8E6C94 KwbUw 65535.00 dez 0.00 65535.00 FORMAT "%8.2" NUMBER 4 /end CHARACTERISTIC
/begin CHARACTERISTIC CDCMA "" VAL_BLK 0x8E6D14 KwbUw 65535.00 dez 0.00 65535.00 FORMAT "%8.2" NUMBER 4 /end CHARACTERISTIC
/begin CHARACTERISTIC CDCMDB "" VAL_BLK 0x8E6D54 KwbUw 65535.00 dez 0.00 65535.00 FORMAT "%8.2" NUMBER 4 /end CHARACTERISTIC
/begin CHARACTERISTIC CDCPWGDE "" VAL_BLK 0x8E6DA4 KwbUw 65535.00 dez 0.00 65535.00 FORMAT "%8.2" NUMBER 4 /end CHARACTERISTIC
/begin CHARACTERISTIC CDCSCR "" VAL_BLK 0x8E6DCC KwbUw 65535.00 dez 0.00 65535.00 FORMAT "%8.2" NUMBER 4 /end CHARACTERISTIC
/begin CHARACTERISTIC CDCSGEEW "" VAL_BLK 0x8E6DDC KwbUw 65535.00 dez 0.00 65535.00 FORMAT "%8.2" NUMBER 4 /end CHARACTERISTIC
/begin CHARACTERISTIC CDCTA "" VAL_BLK 0x8E6E24 KwbUw 65535.00 dez 0.00 65535.00 FORMAT "%8.2" NUMBER 4 /end CHARACTERISTIC
/begin CHARACTERISTIC CDCTKA "" VAL_BLK 0x8E6E5C KwbUw 65535.00 dez 0.00 65535.00 FORMAT "%8.2" NUMBER 4 /end CHARACTERISTIC
/begin CHARACTERISTIC CDCTM "" VAL_BLK 0x8E6E64 KwbUw 65535.00 dez 0.00 65535.00 FORMAT "%8.2" NUMBER 4 /end CHARACTERISTIC
/begin CHARACTERISTIC CDCTMKI "" VAL_BLK 0x8E6E6C KwbUw 65535.00 dez 0.00 65535.00 FORMAT "%8.2" NUMBER 4 /end CHARACTERISTIC
/begin CHARACTERISTIC CDCUB "" VAL_BLK 0x8E6E84 KwbUw 65535.00 dez 0.00 65535.00 FORMAT "%8.2" NUMBER 4 /end CHARACTERISTIC
/begin CHARACTERISTIC CDCUBR "" VAL_BLK 0x8E6E8C KwbUw 65535.00 dez 0.00 65535.00 FORMAT "%8.2" NUMBER 4 /end CHARACTERISTIC
/begin CHARACTERISTIC CDCWFS "" VAL_BLK 0x8E6EFC KwbUw 65535.00 dez 0.00 65535.00 FORMAT "%8.2" NUMBER 4 /end CHARACTERISTIC
/begin CHARACTERISTIC CDCWFSRC "" VAL_BLK 0x8E6F04 KwbUw 65535.00 dez 0.00 65535.00 FORMAT "%8.2" NUMBER 4 /end CHARACTERISTIC
/begin CHARACTERISTIC CDKAATUN "" VAL_BLK 0x8E6F54 KwbUw 65535.00 dez 0.00 65535.00 FORMAT "%8.2" NUMBER 4 /end CHARACTERISTIC
/begin CHARACTERISTIC CDKASGNPL "" VAL_BLK 0x8E6F74 KwbUw 65535.00 dez 0.00 65535.00 FORMAT "%8.2" NUMBER 4 /end CHARACTERISTIC
/begin CHARACTERISTIC CDKATLK "" VALUE 0x8E0CAF KwUb 255.0 dez 0.00 255.0 FORMAT "%5.1" /end CHARACTERISTIC
/begin CHARACTERISTIC CDKBREMS "" VAL_BLK 0x8E6F94 KwbUw 65535.00 dez 0.00 65535.00 FORMAT "%8.2" NUMBER 4 /end CHARACTERISTIC
/begin CHARACTERISTIC CDKBZNPL "" VAL_BLK 0x8E6F9C KwbUw 65535.00 dez 0.00 65535.00 FORMAT "%8.2" NUMBER 4 /end CHARACTERISTIC
/begin CHARACTERISTIC CDKCAIRP "" VAL_BLK 0x8E6FAC KwbUw 65535.00 dez 0.00 65535.00 FORMAT "%8.2" NUMBER 4 /end CHARACTERISTIC
/begin CHARACTERISTIC CDKDSU "" VAL_BLK 0x8E7044 KwbUw 65535.00 dez 0.00 65535.00 FORMAT "%8.2" NUMBER 4 /end CHARACTERISTIC
/begin CHARACTERISTIC CDKEGSBGR "" VAL_BLK 0x8E70BC KwbUw 65535.00 dez 0.00 65535.00 FORMAT "%8.2" NUMBER 4 /end CHARACTERISTIC
/begin CHARACTERISTIC CDKFKU "" VAL_BLK 0x8E710C KwbUw 65535.00 dez 0.00 65535.00 FORMAT "%8.2" NUMBER 4 /end CHARACTERISTIC
/begin CHARACTERISTIC CDKFP1P "" VAL_BLK 0x8E7114 KwbUw 65535.00 dez 0.00 65535.00 FORMAT "%8.2" NUMBER 4 /end CHARACTERISTIC
/begin CHARACTERISTIC CDKFP2P "" VAL_BLK 0x8E711C KwbUw 65535.00 dez 0.00 65535.00 FORMAT "%8.2" NUMBER 4 /end CHARACTERISTIC
/begin CHARACTERISTIC CDKGRBH "" VAL_BLK 0x8E715C KwbUw 65535.00 dez 0.00 65535.00 FORMAT "%8.2" NUMBER 4 /end CHARACTERISTIC
/begin CHARACTERISTIC CDKHRE "" VAL_BLK 0x8E7174 KwbUw 65535.00 dez 0.00 65535.00 FORMAT "%8.2" NUMBER 4 /end CHARACTERISTIC
/begin CHARACTERISTIC CDKLSHV "" VAL_BLK 0x8E729C KwbUw 65535.00 dez 0.00 65535.00 FORMAT "%8.2" NUMBER 4 /end CHARACTERISTIC
/begin CHARACTERISTIC CDKMA "" VAL_BLK 0x8E731C KwbUw 65535.00 dez 0.00 65535.00 FORMAT "%8.2" NUMBER 4 /end CHARACTERISTIC
/begin CHARACTERISTIC CDKMDB "" VAL_BLK 0x8E735C KwbUw 65535.00 dez 0.00 65535.00 FORMAT "%8.2" NUMBER 4 /end CHARACTERISTIC
/begin CHARACTERISTIC CDKPWGDE "" VAL_BLK 0x8E73AC KwbUw 65535.00 dez 0.00 65535.00 FORMAT "%8.2" NUMBER 4 /end CHARACTERISTIC
/begin CHARACTERISTIC CDKSCR "" VAL_BLK 0x8E73D4 KwbUw 65535.00 dez 0.00 65535.00 FORMAT "%8.2" NUMBER 4 /end CHARACTERISTIC
/begin CHARACTERISTIC CDKSGEEW "" VAL_BLK 0x8E73E4 KwbUw 65535.00 dez 0.00 65535.00 FORMAT "%8.2" NUMBER 4 /end CHARACTERISTIC
/begin CHARACTERISTIC CDKTA "" VAL_BLK 0x8E742C KwbUw 65535.00 dez 0.00 65535.00 FORMAT "%8.2" NUMBER 4 /end CHARACTERISTIC
/begin CHARACTERISTIC CDKTKA "" VAL_BLK 0x8E7464 KwbUw 65535.00 dez 0.00 65535.00 FORMAT "%8.2" NUMBER 4 /end CHARACTERISTIC
/begin CHARACTERISTIC CDKTM "" VAL_BLK 0x8E746C KwbUw 65535.00 dez 0.00 65535.00 FORMAT "%8.2" NUMBER 4 /end CHARACTERISTIC
/begin CHARACTERISTIC CDKTMKI "" VAL_BLK 0x8E7474 KwbUw 65535.00 dez 0.00 65535.00 FORMAT "%8.2" NUMBER 4 /end CHARACTERISTIC
/begin CHARACTERISTIC CDKUB "" VAL_BLK 0x8E748C KwbUw 65535.00 dez 0.00 65535.00 FORMAT "%8.2" NUMBER 4 /end CHARACTERISTIC
/begin CHARACTERISTIC CDKUBR "" VAL_BLK 0x8E7494 KwbUw 65535.00 dez 0.00 65535.00 FORMAT "%8.2" NUMBER 4 /end CHARACTERISTIC
/begin CHARACTERISTIC CDKWFS "" VAL_BLK 0x8E7504 KwbUw 65535.00 dez 0.00 65535.00 FORMAT "%8.2" NUMBER 4 /end CHARACTERISTIC
/begin CHARACTERISTIC CDKWFSRC "" VAL_BLK 0x8E750C KwbUw 65535.00 dez 0.00 65535.00 FORMAT "%8.2" NUMBER 4 /end CHARACTERISTIC
/begin CHARACTERISTIC CDTAATUN "" VALUE 0x8E7556 KwUw 65535.00 dez 0.00 65535.00 FORMAT "%8.2" /end CHARACTERISTIC
/begin CHARACTERISTIC CDTASGNPL "" VALUE 0x8E755E KwUw 65535.00 dez 0.00 65535.00 FORMAT "%8.2" /end CHARACTERISTIC
/begin CHARACTERISTIC CDTBREMS "" VALUE 0x8E7566 KwUw 65535.00 dez 0.00 65535.00 FORMAT "%8.2" /end CHARACTERISTIC
/begin CHARACTERISTIC CDTBZNPL "" VALUE 0x8E7568 KwUw 65535.00 dez 0.00 65535.00 FORMAT "%8.2" /end CHARACTERISTIC
/begin CHARACTERISTIC CDTCAIRP "" VALUE 0x8E756C KwUw 65535.00 dez 0.00 65535.00 FORMAT "%8.2" /end CHARACTERISTIC
/begin CHARACTERISTIC CDTDSU "" VALUE 0x8E7592 KwUw 65535.00 dez 0.00 65535.00 FORMAT "%8.2" /end CHARACTERISTIC
/begin CHARACTERISTIC CDTEGSBGR "" VALUE 0x8E75B0 KwUw 65535.00 dez 0.00 65535.00 FORMAT "%8.2" /end CHARACTERISTIC
/begin CHARACTERISTIC CDTFKU "" VALUE 0x8E75C4 KwUw 65535.00 dez 0.00 65535.00 FORMAT "%8.2" /end CHARACTERISTIC
/begin CHARACTERISTIC CDTFP1P "" VALUE 0x8E75C6 KwUw 65535.00 dez 0.00 65535.00 FORMAT "%8.2" /end CHARACTERISTIC
/begin CHARACTERISTIC CDTFP2P "" VALUE 0x8E75C8 KwUw 65535.00 dez 0.00 65535.00 FORMAT "%8.2" /end CHARACTERISTIC
/begin CHARACTERISTIC CDTGRBH "" VALUE 0x8E75D8 KwUw 65535.00 dez 0.00 65535.00 FORMAT "%8.2" /end CHARACTERISTIC
/begin CHARACTERISTIC CDTHRE "" VALUE 0x8E75DE KwUw 65535.00 dez 0.00 65535.00 FORMAT "%8.2" /end CHARACTERISTIC
/begin CHARACTERISTIC CDTLSHV "" VALUE 0x8E7628 KwUw 65535.00 dez 0.00 65535.00 FORMAT "%8.2" /end CHARACTERISTIC
/begin CHARACTERISTIC CDTMA "" VALUE 0x8E7648 KwUw 65535.00 dez 0.00 65535.00 FORMAT "%8.2" /end CHARACTERISTIC
/begin CHARACTERISTIC CDTMDB "" VALUE 0x8E7658 KwUw 65535.00 dez 0.00 65535.00 FORMAT "%8.2" /end CHARACTERISTIC
/begin CHARACTERISTIC CDTPWGDE "" VALUE 0x8E766C KwUw 65535.00 dez 0.00 65535.00 FORMAT "%8.2" /end CHARACTERISTIC
/begin CHARACTERISTIC CDTSCR "" VALUE 0x8E7676 KwUw 65535.00 dez 0.00 65535.00 FORMAT "%8.2" /end CHARACTERISTIC
/begin CHARACTERISTIC CDTSGEEW "" VALUE 0x8E767A KwUw 65535.00 dez 0.00 65535.00 FORMAT "%8.2" /end CHARACTERISTIC
/begin CHARACTERISTIC CDTTA "" VALUE 0x8E768C KwUw 65535.00 dez 0.00 65535.00 FORMAT "%8.2" /end CHARACTERISTIC
/begin CHARACTERISTIC CDTTKA "" VALUE 0x8E769A KwUw 65535.00 dez 0.00 65535.00 FORMAT "%8.2" /end CHARACTERISTIC
/begin CHARACTERISTIC CDTTM "" VALUE 0x8E769C KwUw 65535.00 dez 0.00 65535.00 FORMAT "%8.2" /end CHARACTERISTIC
/begin CHARACTERISTIC CDTTMKI "" VALUE 0x8E769E KwUw 65535.00 dez 0.00 65535.00 FORMAT "%8.2" /end CHARACTERISTIC
/begin CHARACTERISTIC CDTUB "" VALUE 0x8E76A4 KwUw 65535.00 dez 0.00 65535.00 FORMAT "%8.2" /end CHARACTERISTIC
/begin CHARACTERISTIC CDTUBR "" VALUE 0x8E76A6 KwUw 65535.00 dez 0.00 65535.00 FORMAT "%8.2" /end CHARACTERISTIC
/begin CHARACTERISTIC CDTWFS "" VALUE 0x8E76C2 KwUw 65535.00 dez 0.00 65535.00 FORMAT "%8.2" /end CHARACTERISTIC
/begin CHARACTERISTIC CDTWFSRC "" VALUE 0x8E76C4 KwUw 65535.00 dez 0.00 65535.00 FORMAT "%8.2" /end CHARACTERISTIC
/begin CHARACTERISTIC CLAAATUN "" VALUE 0x8E05EC KwUb 255.0 dez 0.00 255.0 FORMAT "%5.1" /end CHARACTERISTIC
/begin CHARACTERISTIC CLAASGNPL "" VALUE 0x8E05F0 KwUb 255.0 dez 0.00 255.0 FORMAT "%5.1" /end CHARACTERISTIC
/begin CHARACTERISTIC CLABREMS "" VALUE 0x8E05F4 KwUb 255.0 dez 0.00 255.0 FORMAT "%5.1" /end CHARACTERISTIC
/begin CHARACTERISTIC CLABZNPL "" VALUE 0x8E05F5 KwUb 255.0 dez 0.00 255.0 FORMAT "%5.1" /end CHARACTERISTIC
/begin CHARACTERISTIC CLACAIRP "" VALUE 0x8E05F7 KwUb 255.0 dez 0.00 255.0 FORMAT "%5.1" /end CHARACTERISTIC
/begin CHARACTERISTIC CLADSU "" VALUE 0x8E060A KwUb 255.0 dez 0.00 255.0 FORMAT "%5.1" /end CHARACTERISTIC
/begin CHARACTERISTIC CLAEGSBGR "" VALUE 0x8E0619 KwUb 255.0 dez 0.00 255.0 FORMAT "%5.1" /end CHARACTERISTIC
/begin CHARACTERISTIC CLAFKU "" VALUE 0x8E0623 KwUb 255.0 dez 0.00 255.0 FORMAT "%5.1" /end CHARACTERISTIC
/begin CHARACTERISTIC CLAFP1P "" VALUE 0x8E0624 KwUb 255.0 dez 0.00 255.0 FORMAT "%5.1" /end CHARACTERISTIC
/begin CHARACTERISTIC CLAFP2P "" VALUE 0x8E0625 KwUb 255.0 dez 0.00 255.0 FORMAT "%5.1" /end CHARACTERISTIC
/begin CHARACTERISTIC CLAGRBH "" VALUE 0x8E062D KwUb 255.0 dez 0.00 255.0 FORMAT "%5.1" /end CHARACTERISTIC
/begin CHARACTERISTIC CLAHRE "" VALUE 0x8E0630 KwUb 255.0 dez 0.00 255.0 FORMAT "%5.1" /end CHARACTERISTIC
/begin CHARACTERISTIC CLALSHV "" VALUE 0x8E0655 KwUb 255.0 dez 0.00 255.0 FORMAT "%5.1" /end CHARACTERISTIC
/begin CHARACTERISTIC CLAMA "" VALUE 0x8E0665 KwUb 255.0 dez 0.00 255.0 FORMAT "%5.1" /end CHARACTERISTIC
/begin CHARACTERISTIC CLAMDB "" VALUE 0x8E066D KwUb 255.0 dez 0.00 255.0 FORMAT "%5.1" /end CHARACTERISTIC
/begin CHARACTERISTIC CLAPWGDE "" VALUE 0x8E0677 KwUb 255.0 dez 0.00 255.0 FORMAT "%5.1" /end CHARACTERISTIC
/begin CHARACTERISTIC CLASCR "" VALUE 0x8E067C KwUb 255.0 dez 0.00 255.0 FORMAT "%5.1" /end CHARACTERISTIC
/begin CHARACTERISTIC CLASGEEW "" VALUE 0x8E067E KwUb 255.0 dez 0.00 255.0 FORMAT "%5.1" /end CHARACTERISTIC
/begin CHARACTERISTIC CLATA "" VALUE 0x8E0687 KwUb 255.0 dez 0.00 255.0 FORMAT "%5.1" /end CHARACTERISTIC
/begin CHARACTERISTIC CLATKA "" VALUE 0x8E068E KwUb 255.0 dez 0.00 255.0 FORMAT "%5.1" /end CHARACTERISTIC
/begin CHARACTERISTIC CLATM "" VALUE 0x8E068F KwUb 255.0 dez 0.00 255.0 FORMAT "%5.1" /end CHARACTERISTIC
/begin CHARACTERISTIC CLATMKI "" VALUE 0x8E0690 KwUb 255.0 dez 0.00 255.0 FORMAT "%5.1" /end CHARACTERISTIC
/begin CHARACTERISTIC CLAUB "" VALUE 0x8E0693 KwUb 255.0 dez 0.00 255.0 FORMAT "%5.1" /end CHARACTERISTIC
/begin CHARACTERISTIC CLAUBR "" VALUE 0x8E0694 KwUb 255.0 dez 0.00 255.0 FORMAT "%5.1" /end CHARACTERISTIC
/begin CHARACTERISTIC CLAWFS "" VALUE 0x8E06A2 KwUb 255.0 dez 0.00 255.0 FORMAT "%5.1" /end CHARACTERISTIC
/begin CHARACTERISTIC CLAWFSRC "" VALUE 0x8E06A3 KwUb 255.0 dez 0.00 255.0 FORMAT "%5.1" /end CHARACTERISTIC
/begin CHARACTERISTIC CPLRA "" VALUE 0x8E20B7 KwUb 255.0 dez 0.00 255.0 FORMAT "%5.1" /end CHARACTERISTIC
/begin CHARACTERISTIC CWDHFM "" VALUE 0x8FCFC4 KwUb 255.0 dez 0.00 255.0 FORMAT "%5.1" /end CHARACTERISTIC
/begin CHARACTERISTIC CWDHLSH "" VALUE 0x8E0913 KwUb 255.0 dez 0.00 255.0 FORMAT "%5.1" /end CHARACTERISTIC
/begin CHARACTERISTIC CWDHRLSU "" VALUE 0x8E0CA1 KwUb 3.000 dez 0.00 3.000 FORMAT "%5.3" /end CHARACTERISTIC
/begin CHARACTERISTIC CWDICLSU "" VALUE 0x8E0D4E KwUb 255.0 dez 0.00 255.0 FORMAT "%5.1" /end CHARACTERISTIC
/begin CHARACTERISTIC CWDKRNT "" VALUE 0x8FD0C7 KwUb 255.0 dez 0.00 255.0 FORMAT "%5.1" /end CHARACTERISTIC
/begin CHARACTERISTIC CWDKROF "" VALUE 0x8FD0C8 KwUb 255.0 dez 0.00 255.0 FORMAT "%5.1" /end CHARACTERISTIC
/begin CHARACTERISTIC CWDKRTP "" VALUE 0x8FD0CC KwUb 255.0 dez 0.00 255.0 FORMAT "%5.1" /end CHARACTERISTIC
/begin CHARACTERISTIC CWDKS "" VALUE 0x8E27CE KwUb 255.0 dez 0.00 255.0 FORMAT "%5.1" /end CHARACTERISTIC
/begin CHARACTERISTIC CWDKVSS "" VALUE 0x8E20B8 KwUb 255.0 dez 0.00 255.0 FORMAT "%5.1" /end CHARACTERISTIC
/begin CHARACTERISTIC CWKATUM "" VALUE 0x8FCE76 KwUb 255.0 dez 0.00 255.0 FORMAT "%5.1" /end CHARACTERISTIC
/begin CHARACTERISTIC CWRDYTES "" VALUE 0x8E08F8 KwUb 255.0 dez 0.00 255.0 FORMAT "%5.1" /end CHARACTERISTIC
/begin CHARACTERISTIC DASA "" VALUE 0x8E2F2C KwUb 255.0 dez 0.00 255.0 FORMAT "%5.1" /end CHARACTERISTIC
/begin CHARACTERISTIC DFRMST "" VALUE 0x8E20B9 KwUb 1.992 fak_ub_b2 0.00 1.992 FORMAT "%5.3" /end CHARACTERISTIC
/begin CHARACTERISTIC DFRZASNAMN "" VALUE 0x8E80EC KwUw 1.999969 fak_uw_b2 0.00 1.999969 FORMAT "%8.6" /end CHARACTERISTIC
/begin CHARACTERISTIC DKATCW "" VALUE 0x8E0CB0 KwUb 255.0 dez 0.00 255.0 FORMAT "%5.1" /end CHARACTERISTIC
/begin CHARACTERISTIC DKRAMX "" VALUE 0x8FE8F4 KwUw 65535.00 dez 0.00 65535.00 FORMAT "%8.2" /end CHARACTERISTIC
/begin CHARACTERISTIC DKRAZ "" VALUE 0x8FE8F6 KwUw 65535.00 dez 0.00 65535.00 FORMAT "%8.2" /end CHARACTERISTIC
/begin CHARACTERISTIC DKROFN "" CURVE 0x8EBA70 KlAUwSstUwWUw 6102.947 tknockintgrad_sy 0.00 6102.947 FORMAT "%8.3"
 /begin AXIS_DESCR STD_AXIS tmfln_w tknockcon_sy 6 0.00 0.2097120 FORMAT "%9.7" DEPOSIT ABSOLUTE /end AXIS_DESCR
/end CHARACTERISTIC
/begin CHARACTERISTIC DKROKU "" VALUE 0x8FD0C9 KwUb 10200. nmot_ub_q40 0.00 10200. FORMAT "%5.0" /end CHARACTERISTIC
/begin CHARACTERISTIC DMRKTD "" VALUE 0x8E809A KwUw 99.99847 rel_uw_b100 0.00 99.99847 FORMAT "%8.5" /end CHARACTERISTIC
/begin CHARACTERISTIC DNDLLRO "" VALUE 0x8E2F2D KwUb 1270. nmot_ub_q10 0.00 1270. FORMAT "%5.0" /end CHARACTERISTIC
/begin CHARACTERISTIC DNDLLRU "" VALUE 0x8E2F2E KwSb 1280. nmot_ub_q10 -1280. 0.00 FORMAT "%5.0" /end CHARACTERISTIC
/begin CHARACTERISTIC DNMOTFD "" VALUE 0x8E27CF KwUb 10200. nmot_ub_q40 0.00 10200. FORMAT "%5.0" /end CHARACTERISTIC
/begin CHARACTERISTIC DRLKTDP "" VALUE 0x8E0CB1 KwSb 191.3 rel_sb_q0p75 -96.00 95.25 FORMAT "%5.2" /end CHARACTERISTIC
/begin CHARACTERISTIC DRLKTDPT "" VALUE 0x8E0CB2 KwSb 191.3 rel_sb_q0p75 -96.00 95.25 FORMAT "%5.2" /end CHARACTERISTIC
/begin CHARACTERISTIC FFTAATUN "" VAL_BLK 0x8E06AE KwbUb 255.0 dez 0.00 255.0 FORMAT "%5.1" NUMBER 2 /end CHARACTERISTIC
/begin CHARACTERISTIC FFTASGNPL "" VAL_BLK 0x8E06B6 KwbUb 255.0 dez 0.00 255.0 FORMAT "%5.1" NUMBER 2 /end CHARACTERISTIC
/begin CHARACTERISTIC FFTBREMS "" VAL_BLK 0x8E06BE KwbUb 255.0 dez 0.00 255.0 FORMAT "%5.1" NUMBER 2 /end CHARACTERISTIC
/begin CHARACTERISTIC FFTBZNPL "" VAL_BLK 0x8E06C0 KwbUb 255.0 dez 0.00 255.0 FORMAT "%5.1" NUMBER 2 /end CHARACTERISTIC
/begin CHARACTERISTIC FFTCAIRP "" VAL_BLK 0x8E06C4 KwbUb 255.0 dez 0.00 255.0 FORMAT "%5.1" NUMBER 2 /end CHARACTERISTIC
/begin CHARACTERISTIC FFTDSU "" VAL_BLK 0x8E06EA KwbUb 255.0 dez 0.00 255.0 FORMAT "%5.1" NUMBER 2 /end CHARACTERISTIC
/begin CHARACTERISTIC FFTEGSBGR "" VAL_BLK 0x8E0708 KwbUb 255.0 dez 0.00 255.0 FORMAT "%5.1" NUMBER 2 /end CHARACTERISTIC
/begin CHARACTERISTIC FFTFKU "" VAL_BLK 0x8E071C KwbUb 255.0 dez 0.00 255.0 FORMAT "%5.1" NUMBER 2 /end CHARACTERISTIC
/begin CHARACTERISTIC FFTFP1P "" VAL_BLK 0x8E071E KwbUb 255.0 dez 0.00 255.0 FORMAT "%5.1" NUMBER 2 /end CHARACTERISTIC
/begin CHARACTERISTIC FFTFP2P "" VAL_BLK 0x8E0720 KwbUb 255.0 dez 0.00 255.0 FORMAT "%5.1" NUMBER 2 /end CHARACTERISTIC
/begin CHARACTERISTIC FFTGRBH "" VAL_BLK 0x8E0730 KwbUb 255.0 dez 0.00 255.0 FORMAT "%5.1" NUMBER 2 /end CHARACTERISTIC
/begin CHARACTERISTIC FFTHRE "" VAL_BLK 0x8E0736 KwbUb 255.0 dez 0.00 255.0 FORMAT "%5.1" NUMBER 2 /end CHARACTERISTIC
/begin CHARACTERISTIC FFTLSHV "" VAL_BLK 0x8E0780 KwbUb 255.0 dez 0.00 255.0 FORMAT "%5.1" NUMBER 2 /end CHARACTERISTIC
/begin CHARACTERISTIC FFTMA "" VAL_BLK 0x8E07A0 KwbUb 255.0 dez 0.00 255.0 FORMAT "%5.1" NUMBER 2 /end CHARACTERISTIC
/begin CHARACTERISTIC FFTMDB "" VAL_BLK 0x8E07B0 KwbUb 255.0 dez 0.00 255.0 FORMAT "%5.1" NUMBER 2 /end CHARACTERISTIC
/begin CHARACTERISTIC FFTPWGDE "" VAL_BLK 0x8E07C4 KwbUb 255.0 dez 0.00 255.0 FORMAT "%5.1" NUMBER 2 /end CHARACTERISTIC
/begin CHARACTERISTIC FFTSCR "" VAL_BLK 0x8E07CE KwbUb 255.0 dez 0.00 255.0 FORMAT "%5.1" NUMBER 2 /end CHARACTERISTIC
/begin CHARACTERISTIC FFTSGEEW "" VAL_BLK 0x8E07D2 KwbUb 255.0 dez 0.00 255.0 FORMAT "%5.1" NUMBER 2 /end CHARACTERISTIC
/begin CHARACTERISTIC FFTTA "" VAL_BLK 0x8E07E4 KwbUb 255.0 dez 0.00 255.0 FORMAT "%5.1" NUMBER 2 /end CHARACTERISTIC
/begin CHARACTERISTIC FFTTKA "" VAL_BLK 0x8E07F2 KwbUb 255.0 dez 0.00 255.0 FORMAT "%5.1" NUMBER 2 /end CHARACTERISTIC
/begin CHARACTERISTIC FFTTM "" VAL_BLK 0x8E07F4 KwbUb 255.0 dez 0.00 255.0 FORMAT "%5.1" NUMBER 2 /end CHARACTERISTIC
/begin CHARACTERISTIC FFTTMKI "" VAL_BLK 0x8E07F6 KwbUb 255.0 dez 0.00 255.0 FORMAT "%5.1" NUMBER 2 /end CHARACTERISTIC
/begin CHARACTERISTIC FFTUB "" VAL_BLK 0x8E07FC KwbUb 255.0 dez 0.00 255.0 FORMAT "%5.1" NUMBER 2 /end CHARACTERISTIC
/begin CHARACTERISTIC FFTUBR "" VAL_BLK 0x8E07FE KwbUb 255.0 dez 0.00 255.0 FORMAT "%5.1" NUMBER 2 /end CHARACTERISTIC
/begin CHARACTERISTIC FFTWFS "" VAL_BLK 0x8E081A KwbUb 255.0 dez 0.00 255.0 FORMAT "%5.1" NUMBER 2 /end CHARACTERISTIC
/begin CHARACTERISTIC FFTWFSRC "" VAL_BLK 0x8E081C KwbUb 255.0 dez 0.00 255.0 FORMAT "%5.1" NUMBER 2 /end CHARACTERISTIC
/begin CHARACTERISTIC FHDLLR "" VALUE 0x8E2F2F KwUb 3.984 fak_ub_b4 0.00 3.984 FORMAT "%5.3" /end CHARACTERISTIC
/begin CHARACTERISTIC FMLDMXKO "" VALUE 0x8FE17E KwUw 15.99976 fak_uw_b16 0.00 15.99976 FORMAT "%8.5" /end CHARACTERISTIC
/begin CHARACTERISTIC FRAE "" VALUE 0x8EAC5E KwUw 1.999969 fak_uw_b2 0.00 1.999969 FORMAT "%8.6" /end CHARACTERISTIC
/begin CHARACTERISTIC FRAODN "" VALUE 0x8EAC60 KwUw 1.999969 fak_uw_b2 0.00 1.999969 FORMAT "%8.6" /end CHARACTERISTIC
/begin CHARACTERISTIC FRAODX "" VALUE 0x8EAC62 KwUw 1.999969 fak_uw_b2 0.00 1.999969 FORMAT "%8.6" /end CHARACTERISTIC
/begin CHARACTERISTIC FRAUDN "" VALUE 0x8EAC64 KwUw 1.999969 fak_uw_b2 0.00 1.999969 FORMAT "%8.6" /end CHARACTERISTIC
/begin CHARACTERISTIC FRAUDX "" VALUE 0x8EAC66 KwUw 1.999969 fak_uw_b2 0.00 1.999969 FORMAT "%8.6" /end CHARACTERISTIC
/begin CHARACTERISTIC FRINH1 "" CURVE 0x8E7D78 KlAUbSstUwWUb 63.75 fak_ub_b64 0.00 63.75 FORMAT "%5.2"
 /begin AXIS_DESCR STD_AXIS tahsomf_w temp_q0p0234_o273 5 -273.1500 1262.827 FORMAT "%8.3" DEPOSIT ABSOLUTE /end AXIS_DESCR
/end CHARACTERISTIC
/begin CHARACTERISTIC FRINH2 "" CURVE 0x8E7D8A KlAUbSstUwWUb 63.75 fak_ub_b64 0.00 63.75 FORMAT "%5.2"
 /begin AXIS_DESCR STD_AXIS tahsomf2_w temp_q0p0234_o273 5 -273.1500 1262.827 FORMAT "%8.3" DEPOSIT ABSOLUTE /end AXIS_DESCR
/end CHARACTERISTIC
/begin CHARACTERISTIC FRMSTTDN "" CURVE 0x8E20BA KlAUbSstUbWUb 1.992 fak_ub_b2 0.00 1.992 FORMAT "%5.3"
 /begin AXIS_DESCR STD_AXIS tans temp_ub_q0p75_o48 4 -48.00 143.3 FORMAT "%5.1" DEPOSIT ABSOLUTE /end AXIS_DESCR
/end CHARACTERISTIC
/begin CHARACTERISTIC FRMSTTDX "" CURVE 0x8E20C3 KlAUbSstUbWUb 1.992 fak_ub_b2 0.00 1.992 FORMAT "%5.3"
 /begin AXIS_DESCR STD_AXIS tans temp_ub_q0p75_o48 4 -48.00 143.3 FORMAT "%5.1" DEPOSIT ABSOLUTE /end AXIS_DESCR
/end CHARACTERISTIC
/begin CHARACTERISTIC FRSNAMX "" VALUE 0x8E80EE KwUw 1.999969 fak_uw_b2 0.00 1.999969 FORMAT "%8.6" /end CHARACTERISTIC
/begin CHARACTERISTIC FWMLHFMMN "" CURVE 0x8E87E4 KlAUwSstUwWUw 0.9999847 fak_uw_b1 0.00 0.9999847 FORMAT "%9.7"
 /begin AXIS_DESCR STD_AXIS fho_w fak_uw_b4 2 0.00 3.999939 FORMAT "%8.6" DEPOSIT ABSOLUTE /end AXIS_DESCR
/end CHARACTERISTIC
/begin CHARACTERISTIC HYKATA "" VALUE 0x8E0CB3 KwUb 0.9961 fak_ub_b1 0.00 0.9961 /end CHARACTERISTIC
/begin CHARACTERISTIC HYKATR "" VALUE 0x8E0CB4 KwUb 0.9961 fak_ub_b1 0.00 0.9961 /end CHARACTERISTIC
/begin CHARACTERISTIC IKMTR "" VALUE 0x8E0EC5 KwUb 100.0 DEZ 0.00 100.0 FORMAT "%5.1" /end CHARACTERISTIC
/begin CHARACTERISTIC IMLKVSMX "" VALUE 0x8EAC68 KwUw 233.0133 m_q0p00355 0.00 233.0133 FORMAT "%8.4" /end CHARACTERISTIC
/begin CHARACTERISTIC IMLNAMN "" VALUE 0x8E80F0 KwUw 1.820417 m_q2p777Em5_kg 0.00 1.820417 FORMAT "%8.6" /end CHARACTERISTIC
/begin CHARACTERISTIC IMLNAMN2 "" VALUE 0x8E80F2 KwUw 1.820417 m_q2p777Em5_kg 0.00 1.820417 FORMAT "%8.6" /end CHARACTERISTIC
/begin CHARACTERISTIC JKMTR "" VALUE 0x8E0EC6 KwUb 3.000 DEZ 0.00 3.000 FORMAT "%5.3" /end CHARACTERISTIC
/begin CHARACTERISTIC KATBFML "" CURVE 0x8E0CB5 GklWUb 12.7498 zk50msxs_ub_b12p8 0.0501961 12.8000 FORMAT "%7.4"
 /begin AXIS_DESCR COM_AXIS ml m_ub_b1020 5 0.00 1020. FORMAT "%5.0" AXIS_PTS_REF SML05DKUB /end AXIS_DESCR
/end CHARACTERISTIC
/begin CHARACTERISTIC KATBFMN "" VALUE 0x8E0CBA KwUb 0.9961 fak_ub_b1 0.00 0.9961 /end CHARACTERISTIC
/begin CHARACTERISTIC KATBFMNT "" VALUE 0x8E0CBB KwUb 0.9961 fak_ub_b1 0.00 0.9961 /end CHARACTERISTIC
/begin CHARACTERISTIC KATBFN "" VALUE 0x8E0CBC KwUb 0.9961 fak_ub_b1 0.00 0.9961 /end CHARACTERISTIC
/begin CHARACTERISTIC KATBFNM "" VALUE 0x8E0CBD KwUb 1.330 spg_ub_b1p33 0.00 1.330 FORMAT "%5.3" /end CHARACTERISTIC
/begin CHARACTERISTIC KATBFNP "" VALUE 0x8E0CBE KwUb 1.330 spg_ub_b1p33 0.00 1.330 FORMAT "%5.3" /end CHARACTERISTIC
/begin CHARACTERISTIC KATBFSX "" VALUE 0x8E0CBF KwSb 1.992 fak_sb_b1 -1.000 0.9922 FORMAT "%5.3" /end CHARACTERISTIC
/begin CHARACTERISTIC KATBFXM "" CURVE 0x8E809C GklWSw 1023.984 freq_sw_b512 -512.0000 511.9844 FORMAT "%8.4"
 /begin AXIS_DESCR COM_AXIS ml m_ub_b1020 5 0.00 1020. FORMAT "%5.0" AXIS_PTS_REF SML05DKUB /end AXIS_DESCR
/end CHARACTERISTIC
/begin CHARACTERISTIC KATBFXT "" VALUE 0x8E80A6 KwSw 1023.984 freq_sw_b512 -512.0000 511.9844 FORMAT "%8.4" /end CHARACTERISTIC
/begin CHARACTERISTIC KATBSG "" VALUE 0x8E0CC0 KwUb 220.5 m_ub_b221p35 0.8681 221.4 FORMAT "%5.1" /end CHARACTERISTIC
/begin CHARACTERISTIC KATBSH "" VALUE 0x8E0CC1 KwUb 221.4 mgrad_ub_b221p35 0.00 221.4 FORMAT "%5.1" /end CHARACTERISTIC
/begin CHARACTERISTIC KATBSHF "" VALUE 0x8E80A8 KwUw 9996.308 mgrad_uw_q0p0961 0.00 9996.308 FORMAT "%8.3" /end CHARACTERISTIC
/begin CHARACTERISTIC KATBSHG "" VALUE 0x8E0CC2 KwUb 0.9961 fak_ub_b1 0.00 0.9961 /end CHARACTERISTIC
/begin CHARACTERISTIC KFKABMT "" MAP 0x8E0CC3 KfAxUbAyUbSstxUbSstyUbWUb 1.992 fak_ub_b2 0.00 1.992 FORMAT "%5.3"
 /begin AXIS_DESCR STD_AXIS ml m_ub_b1020 8 0.00 1020. FORMAT "%5.0" DEPOSIT ABSOLUTE /end AXIS_DESCR
 /begin AXIS_DESCR STD_AXIS tkdkte temp_ub_q5_o50 8 -50.00 1225. FORMAT "%5.0" DEPOSIT ABSOLUTE /end AXIS_DESCR
/end CHARACTERISTIC
/begin CHARACTERISTIC KFMLDMN "" MAP 0x8E87EE KfAxUbAyUbSstxSwSstyUbWSw 6553.500 m_q0p1 -3276.800 3276.700 FORMAT "%8.3"
 /begin AXIS_DESCR STD_AXIS wdkba_w relDK_q0p02441 8 -800.0000 799.9756 FORMAT "%8.4" DEPOSIT ABSOLUTE /end AXIS_DESCR
 /begin AXIS_DESCR STD_AXIS nmot nmot_ub_q40 9 0.00 10200. FORMAT "%5.0" DEPOSIT ABSOLUTE /end AXIS_DESCR
/end CHARACTERISTIC
/begin CHARACTERISTIC KFMLDMX "" MAP 0x8E889E KfAxUbAyUbSstxSwSstyUbWSw 6553.500 m_q0p1 -3276.800 3276.700 FORMAT "%8.3"
 /begin AXIS_DESCR STD_AXIS wdkbadmx_w relDK_q0p02441 8 -800.0000 799.9756 FORMAT "%8.4" DEPOSIT ABSOLUTE /end AXIS_DESCR
 /begin AXIS_DESCR STD_AXIS nmot nmot_ub_q40 9 0.00 10200. FORMAT "%5.0" DEPOSIT ABSOLUTE /end AXIS_DESCR
/end CHARACTERISTIC
/begin CHARACTERISTIC KFRINH "" MAP 0x8E7D9C KfAxUbAyUbSstxUwSstyUbWUb 2040. r_q8 0.00 2040. FORMAT "%5.0"
 /begin AXIS_DESCR STD_AXIS tahsomf_w temp_q0p0234_o273 5 -273.1500 1262.827 FORMAT "%8.3" DEPOSIT ABSOLUTE /end AXIS_DESCR
 /begin AXIS_DESCR STD_AXIS phlsnhf fak_ub_q0p01 3 0.00 2.550 FORMAT "%5.3" DEPOSIT ABSOLUTE /end AXIS_DESCR
/end CHARACTERISTIC
/begin CHARACTERISTIC KFRINH2 "" MAP 0x8E7DBA KfAxUbAyUbSstxUwSstyUbWUb 2040. r_q8 0.00 2040. FORMAT "%5.0"
 /begin AXIS_DESCR STD_AXIS tahsomf2_w temp_q0p0234_o273 5 -273.1500 1262.827 FORMAT "%8.3" DEPOSIT ABSOLUTE /end AXIS_DESCR
 /begin AXIS_DESCR STD_AXIS phlsnhf2 fak_ub_q0p01 3 0.00 2.550 FORMAT "%5.3" DEPOSIT ABSOLUTE /end AXIS_DESCR
/end CHARACTERISTIC
/begin CHARACTERISTIC KLAZKTD "" CURVE 0x8E0D15 GklWUb 0.249023438 fak_ub_b0p25 0.00 0.249023438 FORMAT "%11.9"
 /begin AXIS_DESCR COM_AXIS ml m_ub_b1020 5 0.00 1020. FORMAT "%5.0" AXIS_PTS_REF SML05DKUB /end AXIS_DESCR
/end CHARACTERISTIC
/begin CHARACTERISTIC KLAZTKKOR "" CURVE 0x8E0D1A KlAUbSstUbWUb 1.992 fak_ub_b2 0.00 1.992 FORMAT "%5.3"
 /begin AXIS_DESCR STD_AXIS tkdkte temp_ub_q5_o50 8 -50.00 1225. FORMAT "%5.0" DEPOSIT ABSOLUTE /end AXIS_DESCR
/end CHARACTERISTIC
/begin CHARACTERISTIC KLIMLNA "" CURVE 0x8E80F4 KlAUbSstUwWUw 6553.4999985 zk100msxs_uw_b6553 0.10000152590 6553.6000000 FORMAT "%12.7"
 /begin AXIS_DESCR STD_AXIS lamsons_w fak_uw_b16 5 0.00 15.99976 FORMAT "%8.5" DEPOSIT ABSOLUTE /end AXIS_DESCR
/end CHARACTERISTIC
/begin CHARACTERISTIC KLKABT "" CURVE 0x8E80AA KlAUbSstUbWUw 511.9922 fak_ub_b2 0.00 511.9922 FORMAT "%8.4"
 /begin AXIS_DESCR STD_AXIS tkdkte temp_ub_q5_o50 4 -50.00 1225. FORMAT "%5.0" DEPOSIT ABSOLUTE /end AXIS_DESCR
/end CHARACTERISTIC
/begin CHARACTERISTIC KLTKERDCMN "" CURVE 0x8E8052 KlAUbSstUbWUw 1535.977 temp_q0p0234_o273 -273.1500 1262.827 FORMAT "%8.3"
 /begin AXIS_DESCR STD_AXIS ub_hsv spg_q0p1 4 0.00 25.50 FORMAT "%5.2" DEPOSIT ABSOLUTE /end AXIS_DESCR
/end CHARACTERISTIC
/begin CHARACTERISTIC KLTZKTD "" CURVE 0x8E80B8 GklWUw 655.3500 t10msxs_uw_b655p35 0.00 655.3500 FORMAT "%8.4"
 /begin AXIS_DESCR COM_AXIS ml m_ub_b1020 5 0.00 1020. FORMAT "%5.0" AXIS_PTS_REF SML05DKUB /end AXIS_DESCR
/end CHARACTERISTIC
/begin CHARACTERISTIC KRFHKS "" VALUE 0x8E27D0 KwUb 255.0 dez 0.00 255.0 FORMAT "%5.1" /end CHARACTERISTIC
/begin CHARACTERISTIC KRFHT "" VALUE 0x8FD0CA KwUb 254.0 dez 1.000 255.0 FORMAT "%5.1" /end CHARACTERISTIC
/begin CHARACTERISTIC KRIVKMX "" VALUE 0x8E8060 KwUw 2559.961 r_q0p0391 0.00 2559.961 FORMAT "%8.3" /end CHARACTERISTIC
/begin CHARACTERISTIC KRZYLDIAG "" VALUE 0x8E27D1 KwUb 255.0 dez 0.00 255.0 FORMAT "%5.1" /end CHARACTERISTIC
/begin CHARACTERISTIC KUBERROR "" VALUE 0x8E8368 KwUw 6553.500 fak_q0p1 0.00 6553.500 FORMAT "%8.3" /end CHARACTERISTIC
/begin CHARACTERISTIC KUBHEAL "" VALUE 0x8E836A KwUw 6553.500 fak_q0p1 0.00 6553.500 FORMAT "%8.3" /end CHARACTERISTIC
/begin CHARACTERISTIC KUSVKMX "" VALUE 0x8E810A KwSw 31.99951 spg_q4p88Em4 -16.00000 15.99951 FORMAT "%8.5" /end CHARACTERISTIC
/begin CHARACTERISTIC LAERROR "" VALUE 0x8E836C KwUw 6553.500 fak_q0p1 0.00 6553.500 FORMAT "%8.3" /end CHARACTERISTIC
/begin CHARACTERISTIC LAHEAL "" VALUE 0x8E836E KwUw 6553.500 fak_q0p1 0.00 6553.500 FORMAT "%8.3" /end CHARACTERISTIC
/begin CHARACTERISTIC LAMSSMN "" VALUE 0x8E810C KwUw 15.99976 fak_uw_b16 0.00 15.99976 FORMAT "%8.5" /end CHARACTERISTIC
/begin CHARACTERISTIC LAMSSMX "" VALUE 0x8E810E KwUw 15.99976 fak_uw_b16 0.00 15.99976 FORMAT "%8.5" /end CHARACTERISTIC
/begin CHARACTERISTIC MLDHFMKO "" VALUE 0x8E889A KwSw 6553.500 m_q0p1 -3276.800 3276.700 FORMAT "%8.3" /end CHARACTERISTIC
/begin CHARACTERISTIC MLDHFMKU "" VALUE 0x8FE180 KwSw 6553.500 m_q0p1 -3276.800 3276.700 FORMAT "%8.3" /end CHARACTERISTIC
/begin CHARACTERISTIC MLDKVSF "" VALUE 0x8EAC6A KwUw 233.0133 m_q0p00355 0.00 233.0133 FORMAT "%8.4" /end CHARACTERISTIC
/begin CHARACTERISTIC MLDKVSG "" VALUE 0x8EAC6C KwUw 233.0133 m_q0p00355 0.00 233.0133 FORMAT "%8.4" /end CHARACTERISTIC
/begin CHARACTERISTIC MLHFMMN "" VALUE 0x8E889C KwSw 6553.500 m_q0p1 -3276.800 3276.700 FORMAT "%8.3" /end CHARACTERISTIC
/begin CHARACTERISTIC NDKRA "" VALUE 0x8FD0BF KwUb 10200. nmot_ub_q40 0.00 10200. FORMAT "%5.0" /end CHARACTERISTIC
/begin CHARACTERISTIC NDKSBET "" VALUE 0x8E27D2 KwUb 10200. nmot_ub_q40 0.00 10200. FORMAT "%5.0" /end CHARACTERISTIC
/begin CHARACTERISTIC NDKSO "" VALUE 0x8E27D3 KwUb 10200. nmot_ub_q40 0.00 10200. FORMAT "%5.0" /end CHARACTERISTIC
/begin CHARACTERISTIC NDKSU "" VALUE 0x8E27D4 KwUb 10200. nmot_ub_q40 0.00 10200. FORMAT "%5.0" /end CHARACTERISTIC
/begin CHARACTERISTIC NDKTSO "" VALUE 0x8E0D2B KwUb 10200. nmot_ub_q40 0.00 10200. FORMAT "%5.0" /end CHARACTERISTIC
/begin CHARACTERISTIC NDKTSOT "" VALUE 0x8E0D2C KwUb 10200. nmot_ub_q40 0.00 10200. FORMAT "%5.0" /end CHARACTERISTIC
/begin CHARACTERISTIC NDKTSU "" VALUE 0x8E0D2D KwUb 10200. nmot_ub_q40 0.00 10200. FORMAT "%5.0" /end CHARACTERISTIC
/begin CHARACTERISTIC NDKTSUT "" VALUE 0x8E0D2E KwUb 10200. nmot_ub_q40 0.00 10200. FORMAT "%5.0" /end CHARACTERISTIC
/begin CHARACTERISTIC NEGABW "" VALUE 0x8E0EC7 KwUb 0.8000 fak_q0p1 0.00 0.8000 FORMAT "%6.4" /end CHARACTERISTIC
/begin CHARACTERISTIC NKTDX "" VALUE 0x8E0D2F KwUb 10200. nmot_ub_q40 0.00 10200. FORMAT "%5.0" /end CHARACTERISTIC
/begin CHARACTERISTIC POSABW "" VALUE 0x8E0EC8 KwUb 1.000 fak_q0p1 0.00 1.000 FORMAT "%5.3" /end CHARACTERISTIC
/begin CHARACTERISTIC RINHAB "" VALUE 0x8E7DD8 KwUw 131070.0 r_uw_q2 0.00 131070.0 FORMAT "%8.1" /end CHARACTERISTIC
/begin CHARACTERISTIC RINLSUPMN "" VALUE 0x8E8062 KwUw 2559.961 r_q0p0391 0.00 2559.961 FORMAT "%8.3" /end CHARACTERISTIC
/begin CHARACTERISTIC RINNPH "" VALUE 0x8E8110 KwUw 2559.961 r_q0p0391 0.00 2559.961 FORMAT "%8.3" /end CHARACTERISTIC
/begin CHARACTERISTIC RKAE "" VALUE 0x8EAC6E KwSw 3071.953 rel_sw_b1536 -1536.000 1535.953 FORMAT "%8.3" /end CHARACTERISTIC
/begin CHARACTERISTIC RKATDN "" VALUE 0x8EAC70 KwSw 3071.953 rel_sw_b1536 -1536.000 1535.953 FORMAT "%8.3" /end CHARACTERISTIC
/begin CHARACTERISTIC RKATDX "" VALUE 0x8EAC72 KwSw 3071.953 rel_sw_b1536 -1536.000 1535.953 FORMAT "%8.3" /end CHARACTERISTIC
/begin CHARACTERISTIC RKAZDN "" VALUE 0x8EAC74 KwSw 3071.953 rel_sw_b1536 -1536.000 1535.953 FORMAT "%8.3" /end CHARACTERISTIC
/begin CHARACTERISTIC RKAZDX "" VALUE 0x8EAC76 KwSw 3071.953 rel_sw_b1536 -1536.000 1535.953 FORMAT "%8.3" /end CHARACTERISTIC
/begin CHARACTERISTIC RLDKTOT "" VALUE 0x8E0D30 KwUb 191.3 rel_ub_q0p75 0.00 191.3 FORMAT "%5.1" /end CHARACTERISTIC
/begin CHARACTERISTIC RLDKTSO "" CURVE 0x8E0D31 GklWUb 191.3 rel_ub_q0p75 0.00 191.3 FORMAT "%5.1"
 /begin AXIS_DESCR COM_AXIS nmot nmot_ub_q40 5 0.00 10200. FORMAT "%5.0" AXIS_PTS_REF SNM05DKUB /end AXIS_DESCR
/end CHARACTERISTIC
/begin CHARACTERISTIC RLDKTSU "" CURVE 0x8E0D36 GklWUb 191.3 rel_ub_q0p75 0.00 191.3 FORMAT "%5.1"
 /begin AXIS_DESCR COM_AXIS nmot nmot_ub_q40 5 0.00 10200. FORMAT "%5.0" AXIS_PTS_REF SNM05DKUB /end AXIS_DESCR
/end CHARACTERISTIC
/begin CHARACTERISTIC RLDKTUT "" VALUE 0x8E0D3B KwUb 191.3 rel_ub_q0p75 0.00 191.3 FORMAT "%5.1" /end CHARACTERISTIC
/begin CHARACTERISTIC RLMDVERL "" CURVE 0x8EBEA4 KlAUwSstUwWUw 99.99902 rel_uw_b192 0.00 99.99902 FORMAT "%8.5"
 /begin AXIS_DESCR STD_AXIS mdverl_w rel_uw_b100 3 0.00 99.99847 FORMAT "%8.5" DEPOSIT ABSOLUTE /end AXIS_DESCR
/end CHARACTERISTIC
/begin AXIS_PTS SML05DKUB "" 0x8E00A1 ml SstAUbSstUb 1020. m_ub_b1020 5 0.00 1020. FORMAT "%5.0" DEPOSIT ABSOLUTE /end AXIS_PTS
/begin AXIS_PTS SNM05DKUB "" 0x8E00B7 nmot SstAUbSstUb 10200. nmot_ub_q40 5 0.00 10200. FORMAT "%5.0" DEPOSIT ABSOLUTE /end AXIS_PTS
/begin AXIS_PTS SNM16KRUB "" 0x8E011B nmot SstAUbSstUb 10200. nmot_ub_q40 16 0.00 10200. FORMAT "%5.0" DEPOSIT ABSOLUTE /end AXIS_PTS
/begin CHARACTERISTIC SRYAGR "" VALUE 0x8E08F3 KwUb 255.0 dez 0.00 255.0 FORMAT "%5.1" /end CHARACTERISTIC
/begin CHARACTERISTIC SRYHS "" VALUE 0x8E08F4 KwUb 255.0 dez 0.00 255.0 FORMAT "%5.1" /end CHARACTERISTIC
/begin CHARACTERISTIC SRYKAT "" VALUE 0x8E08F5 KwUb 255.0 dez 0.00 255.0 FORMAT "%5.1" /end CHARACTERISTIC
/begin CHARACTERISTIC SRYLS "" VALUE 0x8E08F6 KwUb 255.0 dez 0.00 255.0 FORMAT "%5.1" /end CHARACTERISTIC
/begin CHARACTERISTIC SRYSLS "" VALUE 0x8E08F7 KwUb 255.0 dez 0.00 255.0 FORMAT "%5.1" /end CHARACTERISTIC
/begin CHARACTERISTIC SULSUMN "" VALUE 0x8E8112 KwUw 31.99951 spg_q4p88Em4 0.00 31.99951 FORMAT "%8.5" /end CHARACTERISTIC
/begin CHARACTERISTIC TABSTHLSH "" VALUE 0x8E7DDA KwUw 65535.00 t1sxs_uw_q1 0.00 65535.00 FORMAT "%8.2" /end CHARACTERISTIC
/begin CHARACTERISTIC TABSTHLSU "" VALUE 0x8E8064 KwUw 65535.00 t1sxs_uw_b65535 0.00 65535.00 FORMAT "%8.2" /end CHARACTERISTIC
/begin CHARACTERISTIC TADHMNH "" VALUE 0x8E7DDC KwUw 1535.977 temp_q0p0234_o273 -273.1500 1262.827 FORMAT "%8.3" /end CHARACTERISTIC
/begin CHARACTERISTIC TADHMNHFA "" VALUE 0x8E7DDE KwUw 1535.977 temp_q0p0234_o273 -273.1500 1262.827 FORMAT "%8.3" /end CHARACTERISTIC
/begin CHARACTERISTIC TADHMXH "" VALUE 0x8E7DE0 KwUw 1535.977 temp_q0p0234_o273 -273.1500 1262.827 FORMAT "%8.3" /end CHARACTERISTIC
/begin CHARACTERISTIC TADHMXHFA "" VALUE 0x8E7DE2 KwUw 1535.977 temp_q0p0234_o273 -273.1500 1262.827 FORMAT "%8.3" /end CHARACTERISTIC
/begin CHARACTERISTIC TADLLR "" VALUE 0x8E2F30 KwUb 191.3 temp_ub_q0p75_o48 -48.00 143.3 FORMAT "%5.1" /end CHARACTERISTIC
/begin CHARACTERISTIC TAHRLSUMN "" VALUE 0x8E8366 KwUw 199.9969 rel_uw_b200 0.00 199.9969 FORMAT "%8.4" /end CHARACTERISTIC
/begin CHARACTERISTIC TAHSOMFMN "" VALUE 0x8E7DE4 KwUw 1535.977 temp_q0p0234_o273 -273.1500 1262.827 FORMAT "%8.3" /end CHARACTERISTIC
/begin CHARACTERISTIC TAIKRLSUMN "" VALUE 0x8E8066 KwUw 1535.977 temp_q0p0234_o273 -273.1500 1262.827 FORMAT "%8.3" /end CHARACTERISTIC
/begin CHARACTERISTIC TALSUSMX "" VALUE 0x8E8114 KwUw 1535.977 temp_q0p0234_o273 -273.1500 1262.827 FORMAT "%8.3" /end CHARACTERISTIC
/begin CHARACTERISTIC TANSDHLSH "" VALUE 0x8E0914 KwUb 191.3 temp_ub_q0p75_o48 -48.00 143.3 FORMAT "%5.1" /end CHARACTERISTIC
/begin CHARACTERISTIC TASOH "" VALUE 0x8E7DE6 KwUw 1535.977 temp_q0p0234_o273 -273.1500 1262.827 FORMAT "%8.3" /end CHARACTERISTIC
/begin CHARACTERISTIC TDHR "" VALUE 0x8F14D4 KwUw 6553.500 t100msxs_uw_b6553p5 0.00 6553.500 FORMAT "%8.3" /end CHARACTERISTIC
/begin CHARACTERISTIC TDKATAKT "" VALUE 0x8E80C2 KwUw 3276.750 t50msxs_uw_b3276p75 0.00 3276.750 FORMAT "%8.3" /end CHARACTERISTIC
/begin CHARACTERISTIC TDKATATT "" VALUE 0x8E80C4 KwUw 3276.750 t50msxs_uw_b3276p75 0.00 3276.750 FORMAT "%8.3" /end CHARACTERISTIC
/begin CHARACTERISTIC TDKTMNE "" VALUE 0x8E0D3C KwUb 1275. temp_ub_q5 0.00 1275. FORMAT "%5.0" /end CHARACTERISTIC
/begin CHARACTERISTIC TDKTMNKH "" VALUE 0x8E0D3D KwUb 1275. temp_ub_q5 0.00 1275. FORMAT "%5.0" /end CHARACTERISTIC
/begin CHARACTERISTIC TDKTMXE "" VALUE 0x8E0D3E KwUb 1275. temp_ub_q5 0.00 1275. FORMAT "%5.0" /end CHARACTERISTIC
/begin CHARACTERISTIC TDKUPNOG "" VALUE 0x8E0D8A KwUb 255.0 t1sxs_ub_b255 0.00 255.0 FORMAT "%5.1" /end CHARACTERISTIC
/begin CHARACTERISTIC TDLLR "" VALUE 0x8EBEB2 KwUw 255.0000 t200msxs_ub_b51 0.00 255.0000 FORMAT "%8.4" /end CHARACTERISTIC
/begin CHARACTERISTIC TDLLRMN "" VALUE 0x8EBEB4 KwUw 255.0000 t200msxs_ub_b51 0.00 255.0000 FORMAT "%8.4" /end CHARACTERISTIC
/begin CHARACTERISTIC TDLLRMX "" VALUE 0x8EBEB6 KwUw 255.0000 t200msxs_ub_b51 0.00 255.0000 FORMAT "%8.4" /end CHARACTERISTIC
/begin CHARACTERISTIC TDLLRNF "" VALUE 0x8EBEB8 KwUw 255.0000 t200msxs_ub_b51 0.00 255.0000 FORMAT "%8.4" /end CHARACTERISTIC
/begin CHARACTERISTIC TDMLHFM "" VALUE 0x8FCFC5 KwUb 2.550 t10msxs_ub_b2p55 0.00 2.550 FORMAT "%5.3" /end CHARACTERISTIC
/begin CHARACTERISTIC TDMLMN "" VALUE 0x8E1381 KwUb 25.50 t100msxs_ub_b25p5 0.00 25.50 FORMAT "%5.2" /end CHARACTERISTIC
/begin CHARACTERISTIC TDMLMX "" VALUE 0x8E1382 KwUb 25.50 t100msxs_ub_b25p5 0.00 25.50 FORMAT "%5.2" /end CHARACTERISTIC
/begin CHARACTERISTIC TDMLNF "" VALUE 0x8E1383 KwUb 25.50 t100msxs_ub_b25p5 0.00 25.50 FORMAT "%5.2" /end CHARACTERISTIC
/begin CHARACTERISTIC TDMLNPL "" VALUE 0x8E1384 KwUb 25.50 t100msxs_ub_b25p5 0.00 25.50 FORMAT "%5.2" /end CHARACTERISTIC
/begin CHARACTERISTIC TDMLST "" VALUE 0x8E1385 KwUb 25.50 t100msxs_ub_b25p5 0.00 25.50 FORMAT "%5.2" /end CHARACTERISTIC
/begin CHARACTERISTIC TDUBHFM "" VALUE 0x8E1386 KwUb 25.50 t100msxs_ub_b25p5 0.00 25.50 FORMAT "%5.2" /end CHARACTERISTIC
/begin CHARACTERISTIC TDZHR "" VALUE 0x8F14D6 KwUw 6553.500 t100msxs_uw_b6553p5 0.00 6553.500 FORMAT "%8.3" /end CHARACTERISTIC
/begin CHARACTERISTIC TEDKTLP "" VALUE 0x8E0D3F KwUb 12.75 t50msxs_q0p05 0.00 12.75 FORMAT "%5.2" /end CHARACTERISTIC
/begin CHARACTERISTIC TEHEHRLSU "" VALUE 0x8E8068 KwUw 6553.500 t100msxs_uw_b6553p5 0.00 6553.500 FORMAT "%8.3" /end CHARACTERISTIC
/begin CHARACTERISTIC TEHRF "" VALUE 0x8E806A KwUw 6553.500 t100msxs_uw_b6553p5 0.00 6553.500 FORMAT "%8.3" /end CHARACTERISTIC
/begin CHARACTERISTIC TEHRFMN "" VALUE 0x8E806C KwUw 6553.500 t100msxs_uw_b6553p5 0.00 6553.500 FORMAT "%8.3" /end CHARACTERISTIC
/begin CHARACTERISTIC TEHRLSUE "" VALUE 0x8E806E KwUw 6553.500 t100msxs_uw_b6553p5 0.00 6553.500 FORMAT "%8.3" /end CHARACTERISTIC
/begin CHARACTERISTIC TEHRLSUZMX "" VALUE 0x8E8070 KwUw 6553.500 t100msxs_uw_b6553p5 0.00 6553.500 FORMAT "%8.3" /end CHARACTERISTIC
/begin CHARACTERISTIC TFDLLRO "" VALUE 0x8EBEBA KwUw 6553.500 t100msxs_uw_b6553p5 0.00 6553.500 FORMAT "%8.3" /end CHARACTERISTIC
/begin CHARACTERISTIC TFDLLRU "" VALUE 0x8EBEBC KwUw 6553.500 t100msxs_uw_b6553p5 0.00 6553.500 FORMAT "%8.3" /end CHARACTERISTIC
/begin CHARACTERISTIC TFRA "" VALUE 0x8E20CC KwUb 51.00 t200msxs_ub_b51 0.00 51.00 FORMAT "%5.2" /end CHARACTERISTIC
/begin CHARACTERISTIC TFRAOZ "" VALUE 0x8E20CD KwUb 51.00 t200msxs_ub_b51 0.00 51.00 FORMAT "%5.2" /end CHARACTERISTIC
/begin CHARACTERISTIC TFRAUZ "" VALUE 0x8E20CE KwUb 51.00 t200msxs_ub_b51 0.00 51.00 FORMAT "%5.2" /end CHARACTERISTIC
/begin CHARACTERISTIC TFRMST "" VALUE 0x8E20CF KwUb 51.00 t200msxs_ub_b51 0.00 51.00 FORMAT "%5.2" /end CHARACTERISTIC
/begin CHARACTERISTIC TFRMZST "" VALUE 0x8E20D0 KwUb 51.00 t200msxs_ub_b51 0.00 51.00 FORMAT "%5.2" /end CHARACTERISTIC
/begin CHARACTERISTIC THLKSLUE1 "" VALUE 0x8E8370 KwUw 6553.500 fak_q0p1 0.00 6553.500 FORMAT "%8.3" /end CHARACTERISTIC
/begin CHARACTERISTIC THLKSLUE2 "" VALUE 0x8E8372 KwUw 6553.500 fak_q0p1 0.00 6553.500 FORMAT "%8.3" /end CHARACTERISTIC
/begin CHARACTERISTIC TKERLSUDMN "" VALUE 0x8E8072 KwUw 1535.977 temp_q0p0234_o273 -273.1500 1262.827 FORMAT "%8.3" /end CHARACTERISTIC
/begin CHARACTERISTIC TKGRADMX "" VALUE 0x8E0D40 KwSb 1275. temp_sb_q5 -640.0 635.0 FORMAT "%5.1" /end CHARACTERISTIC
/begin CHARACTERISTIC TKMNUV "" CURVE 0x8E80C6 KlAUwSstUwWUw 3276.750 t_q0p05 0.00 3276.750 FORMAT "%8.3"
 /begin AXIS_DESCR STD_AXIS ttkatmnu_w t_q0p05 4 0.00 3276.750 FORMAT "%8.3" DEPOSIT ABSOLUTE /end AXIS_DESCR
/end CHARACTERISTIC
/begin CHARACTERISTIC TKSDLRSCTR "" VALUE 0x8E0EC9 KwUb 25.50 t100msxs_ub_b25p5 0.00 25.50 FORMAT "%5.2" /end CHARACTERISTIC
/begin CHARACTERISTIC TMAXKAT "" VALUE 0x8E0D41 KwUb 1275. temp_ub_q5_o50 -50.00 1225. FORMAT "%5.0" /end CHARACTERISTIC
/begin CHARACTERISTIC TMDHRSTMX "" VALUE 0x8E0CA2 KwUb 191.3 temp_ub_q0p75_o48 -48.00 143.3 FORMAT "%5.1" /end CHARACTERISTIC
/begin CHARACTERISTIC TMDLLR "" VALUE 0x8E2F31 KwUb 191.3 temp_ub_q0p75_o48 -48.00 143.3 FORMAT "%5.1" /end CHARACTERISTIC
/begin CHARACTERISTIC TMFRST "" VALUE 0x8E20D1 KwUb 191.3 temp_ub_q0p75_o48 -48.00 143.3 FORMAT "%5.1" /end CHARACTERISTIC
/begin CHARACTERISTIC TMINKAT "" VALUE 0x8E0D42 KwUb 1275. temp_ub_q5_o50 -50.00 1225. FORMAT "%5.0" /end CHARACTERISTIC
/begin CHARACTERISTIC TMN1DlUE1 "" VALUE 0x8E8374 KwUw 599.2000 fak_q0p1 0.8000000 600.0000 FORMAT "%8.4" /end CHARACTERISTIC
/begin CHARACTERISTIC TMN2DLUE1 "" VALUE 0x8E8376 KwUw 599.2000 fak_q0p1 0.8000000 600.0000 FORMAT "%8.4" /end CHARACTERISTIC
/begin CHARACTERISTIC TMN3DLUE1 "" VALUE 0x8E8378 KwUw 599.2000 fak_q0p1 0.8000000 600.0000 FORMAT "%8.4" /end CHARACTERISTIC
/begin CHARACTERISTIC TMNKATT "" VALUE 0x8E0D43 KwUb 1275. temp_ub_q5_o50 -50.00 1225. FORMAT "%5.0" /end CHARACTERISTIC
/begin CHARACTERISTIC TMNKSLUE1 "" VALUE 0x8E837A KwUw 6553.500 fak_q0p1 0.00 6553.500 FORMAT "%8.3" /end CHARACTERISTIC
/begin CHARACTERISTIC TMSKTDO "" VALUE 0x8E0D44 KwUb 191.3 temp_ub_q0p75_o48 -48.00 143.3 FORMAT "%5.1" /end CHARACTERISTIC
/begin CHARACTERISTIC TMSUKTD "" VALUE 0x8E0D45 KwUb 191.3 temp_ub_q0p75_o48 -48.00 143.3 FORMAT "%5.1" /end CHARACTERISTIC
/begin CHARACTERISTIC TRKA "" VALUE 0x8E20D2 KwUb 51.00 t200msxs_ub_b51 0.00 51.00 FORMAT "%5.2" /end CHARACTERISTIC
/begin CHARACTERISTIC TRKATZ "" VALUE 0x8E20D3 KwUb 51.00 t200msxs_ub_b51 0.00 51.00 FORMAT "%5.2" /end CHARACTERISTIC
/begin CHARACTERISTIC TRKAZZ "" VALUE 0x8E20D4 KwUb 51.00 t200msxs_ub_b51 0.00 51.00 FORMAT "%5.2" /end CHARACTERISTIC
/begin CHARACTERISTIC TSFAATUN "" VALUE 0x8E082F KwUb 255.0 dez 0.00 255.0 FORMAT "%5.1" /end CHARACTERISTIC
/begin CHARACTERISTIC TSFASGNPL "" VALUE 0x8E0833 KwUb 255.0 dez 0.00 255.0 FORMAT "%5.1" /end CHARACTERISTIC
/begin CHARACTERISTIC TSFBREMS "" VALUE 0x8E0837 KwUb 255.0 dez 0.00 255.0 FORMAT "%5.1" /end CHARACTERISTIC
/begin CHARACTERISTIC TSFBZNPL "" VALUE 0x8E0838 KwUb 255.0 dez 0.00 255.0 FORMAT "%5.1" /end CHARACTERISTIC
/begin CHARACTERISTIC TSFCAIRP "" VALUE 0x8E083A KwUb 255.0 dez 0.00 255.0 FORMAT "%5.1" /end CHARACTERISTIC
/begin CHARACTERISTIC TSFDSU "" VALUE 0x8E084D KwUb 255.0 dez 0.00 255.0 FORMAT "%5.1" /end CHARACTERISTIC
/begin CHARACTERISTIC TSFEGSBGR "" VALUE 0x8E085C KwUb 255.0 dez 0.00 255.0 FORMAT "%5.1" /end CHARACTERISTIC
/begin CHARACTERISTIC TSFFKU "" VALUE 0x8E0866 KwUb 255.0 dez 0.00 255.0 FORMAT "%5.1" /end CHARACTERISTIC
/begin CHARACTERISTIC TSFFP1P "" VALUE 0x8E0867 KwUb 255.0 dez 0.00 255.0 FORMAT "%5.1" /end CHARACTERISTIC
/begin CHARACTERISTIC TSFFP2P "" VALUE 0x8E0868 KwUb 255.0 dez 0.00 255.0 FORMAT "%5.1" /end CHARACTERISTIC
/begin CHARACTERISTIC TSFGRBH "" VALUE 0x8E0870 KwUb 255.0 dez 0.00 255.0 FORMAT "%5.1" /end CHARACTERISTIC
/begin CHARACTERISTIC TSFHRE "" VALUE 0x8E0873 KwUb 255.0 dez 0.00 255.0 FORMAT "%5.1" /end CHARACTERISTIC
/begin CHARACTERISTIC TSFLSHV "" VALUE 0x8E0898 KwUb 255.0 dez 0.00 255.0 FORMAT "%5.1" /end CHARACTERISTIC
/begin CHARACTERISTIC TSFMA "" VALUE 0x8E08A8 KwUb 255.0 dez 0.00 255.0 FORMAT "%5.1" /end CHARACTERISTIC
/begin CHARACTERISTIC TSFMDB "" VALUE 0x8E08B0 KwUb 255.0 dez 0.00 255.0 FORMAT "%5.1" /end CHARACTERISTIC
/begin CHARACTERISTIC TSFPWGDE "" VALUE 0x8E08BA KwUb 255.0 dez 0.00 255.0 FORMAT "%5.1" /end CHARACTERISTIC
/begin CHARACTERISTIC TSFSCR "" VALUE 0x8E08BF KwUb 255.0 dez 0.00 255.0 FORMAT "%5.1" /end CHARACTERISTIC
/begin CHARACTERISTIC TSFSGEEW "" VALUE 0x8E08C1 KwUb 255.0 dez 0.00 255.0 FORMAT "%5.1" /end CHARACTERISTIC
/begin CHARACTERISTIC TSFTA "" VALUE 0x8E08CA KwUb 255.0 dez 0.00 255.0 FORMAT "%5.1" /end CHARACTERISTIC
/begin CHARACTERISTIC TSFTKA "" VALUE 0x8E08D1 KwUb 255.0 dez 0.00 255.0 FORMAT "%5.1" /end CHARACTERISTIC
/begin CHARACTERISTIC TSFTM "" VALUE 0x8E08D2 KwUb 255.0 dez 0.00 255.0 FORMAT "%5.1" /end CHARACTERISTIC
/begin CHARACTERISTIC TSFTMKI "" VALUE 0x8E08D3 KwUb 255.0 dez 0.00 255.0 FORMAT "%5.1" /end CHARACTERISTIC
/begin CHARACTERISTIC TSFUB "" VALUE 0x8E08D6 KwUb 255.0 dez 0.00 255.0 FORMAT "%5.1" /end CHARACTERISTIC
/begin CHARACTERISTIC TSFUBR "" VALUE 0x8E08D7 KwUb 255.0 dez 0.00 255.0 FORMAT "%5.1" /end CHARACTERISTIC
/begin CHARACTERISTIC TSFWFS "" VALUE 0x8E08E5 KwUb 255.0 dez 0.00 255.0 FORMAT "%5.1" /end CHARACTERISTIC
/begin CHARACTERISTIC TSFWFSRC "" VALUE 0x8E08E6 KwUb 255.0 dez 0.00 255.0 FORMAT "%5.1" /end CHARACTERISTIC
/begin CHARACTERISTIC TVDESHLSU "" VALUE 0x8E0D4F KwUb 25.50 t_q0p1 0.00 25.50 FORMAT "%5.2" /end CHARACTERISTIC
/begin CHARACTERISTIC TVDFRZAIP "" VALUE 0x8E0D50 KwUb 25.50 t_q0p1 0.00 25.50 FORMAT "%5.2" /end CHARACTERISTIC
/begin CHARACTERISTIC TVDOCVM "" VALUE 0x8E8116 KwUw 6553.500 t_q0p1 0.00 6553.500 FORMAT "%8.3" /end CHARACTERISTIC
/begin CHARACTERISTIC TVENMX "" VALUE 0x8E8074 KwUw 6553.500 t100msxs_uw_b6553p5 0.00 6553.500 FORMAT "%8.3" /end CHARACTERISTIC
/begin CHARACTERISTIC TVFAHRLSU "" VALUE 0x8E0CA3 KwUb 25.50 t100msxs_ub_b25p5 0.00 25.50 FORMAT "%5.2" /end CHARACTERISTIC
/begin CHARACTERISTIC TVHSHEE "" VALUE 0x8E0915 KwUb 12.75 t50msxs_ub_b12p75 0.00 12.75 FORMAT "%5.2" /end CHARACTERISTIC
/begin CHARACTERISTIC TVHSHRI "" VALUE 0x8E0916 KwUb 255.0 t1sxs_ub_b255 0.00 255.0 FORMAT "%5.1" /end CHARACTERISTIC
/begin CHARACTERISTIC TVHSHRIHEL "" VALUE 0x8E0917 KwUb 255.0 t1sxs_ub_b255 0.00 255.0 FORMAT "%5.1" /end CHARACTERISTIC
/begin CHARACTERISTIC TVHSHRIZ "" VALUE 0x8E0918 KwUb 255.0 t1sxs_ub_b255 0.00 255.0 FORMAT "%5.1" /end CHARACTERISTIC
/begin CHARACTERISTIC TVLSUBB "" VALUE 0x8E8076 KwUw 6553.500 t100msxs_uw_b6553p5 0.00 6553.500 FORMAT "%8.3" /end CHARACTERISTIC
/begin CHARACTERISTIC TVLSUDIP "" VALUE 0x8E0D51 KwUb 25.50 t_q0p1 0.00 25.50 FORMAT "%5.2" /end CHARACTERISTIC
/begin CHARACTERISTIC TVLSUTRIM "" VALUE 0x8E0D52 KwUb 25.50 t_q0p1 0.00 25.50 FORMAT "%5.2" /end CHARACTERISTIC
/begin CHARACTERISTIC TVLSUTRIMZ "" VALUE 0x8E0D53 KwUb 25.50 t_q0p1 0.00 25.50 FORMAT "%5.2" /end CHARACTERISTIC
/begin CHARACTERISTIC TVLSUUMN "" VALUE 0x8E0D54 KwUb 25.50 t_q0p1 0.00 25.50 FORMAT "%5.2" /end CHARACTERISTIC
/begin CHARACTERISTIC TVOCIPLL "" VALUE 0x8E0D55 KwUb 25.50 t_q0p1 0.00 25.50 FORMAT "%5.2" /end CHARACTERISTIC
/begin CHARACTERISTIC TVOCVM "" VALUE 0x8FDC42 KwUw 655.3500 t_q0p01 0.00 655.3500 FORMAT "%8.4" /end CHARACTERISTIC
/begin CHARACTERISTIC TVRIHEE "" VALUE 0x8E0919 KwUb 255.0 t1sxs_ub_b255 0.00 255.0 FORMAT "%5.1" /end CHARACTERISTIC
/begin CHARACTERISTIC TVRIHOCVM "" VALUE 0x8E0D56 KwUb 25.50 t_q0p1 0.00 25.50 FORMAT "%5.2" /end CHARACTERISTIC
/begin CHARACTERISTIC TVRINNPH "" VALUE 0x8E0D57 KwUb 25.50 t_q0p1 0.00 25.50 FORMAT "%5.2" /end CHARACTERISTIC
/begin CHARACTERISTIC TVSAOCVM "" VALUE 0x8E0D58 KwUb 25.50 t_q0p1 0.00 25.50 FORMAT "%5.2" /end CHARACTERISTIC
/begin CHARACTERISTIC TVSERSL "" VALUE 0x8E0D59 KwUb 25.50 t_q0p1 0.00 25.50 FORMAT "%5.2" /end CHARACTERISTIC
/begin CHARACTERISTIC TVSHEIP "" VALUE 0x8E8118 KwUw 6553.500 t_q0p1 0.00 6553.500 FORMAT "%8.3" /end CHARACTERISTIC
/begin CHARACTERISTIC TVSHESL "" VALUE 0x8E0D5A KwUb 25.50 t_q0p1 0.00 25.50 FORMAT "%5.2" /end CHARACTERISTIC
/begin CHARACTERISTIC TVSNPFNA "" VALUE 0x8E0D5B KwUb 25.50 t_q0p1 0.00 25.50 FORMAT "%5.2" /end CHARACTERISTIC
/begin CHARACTERISTIC TVZHRNOT "" VALUE 0x8E8078 KwUw 6553.500 t100msxs_uw_b6553p5 0.00 6553.500 FORMAT "%8.3" /end CHARACTERISTIC
/begin CHARACTERISTIC TWDKATST "" VALUE 0x8E0D46 KwUb 12.75 t50msxs_ub_b12p75 0.00 12.75 FORMAT "%5.2" /end CHARACTERISTIC
/begin CHARACTERISTIC TWHRLSUZMX "" VALUE 0x8E807A KwUw 1535.977 temp_q0p0234_o273 -273.1500 1262.827 FORMAT "%8.3" /end CHARACTERISTIC
/begin CHARACTERISTIC TWHRSTMX "" VALUE 0x8E807C KwUw 1535.977 temp_q0p0234_o273 -273.1500 1262.827 FORMAT "%8.3" /end CHARACTERISTIC
/begin CHARACTERISTIC TWKTDLP "" VALUE 0x8E0D47 KwUb 12.75 t50msxs_ub_b12p75 0.00 12.75 FORMAT "%5.2" /end CHARACTERISTIC
/begin CHARACTERISTIC TWKTDTK "" CURVE 0x8E80D8 KlAUbSstUbWUw 3276.750 t50msxs_uw_b3276p75 0.00 3276.750 FORMAT "%8.3"
 /begin AXIS_DESCR STD_AXIS tkdkth temp_ub_q5 4 0.00 1275. FORMAT "%5.0" DEPOSIT ABSOLUTE /end AXIS_DESCR
/end CHARACTERISTIC
/begin CHARACTERISTIC TWLL "" VALUE 0x8E80E6 KwUw 6553.500 t100msxs_uw_b6553p5 0.00 6553.500 FORMAT "%8.3" /end CHARACTERISTIC
/begin CHARACTERISTIC TWVDCMN "" VALUE 0x8E807E KwUw 1535.977 temp_q0p0234_o273 -273.1500 1262.827 FORMAT "%8.3" /end CHARACTERISTIC
/begin CHARACTERISTIC TWVSOMOS "" VALUE 0x8E8080 KwUw 1535.977 temp_q0p0234_o273 -273.1500 1262.827 FORMAT "%8.3" /end CHARACTERISTIC
/begin CHARACTERISTIC TZLRKTT "" VALUE 0x8E80E8 KwUw 655.3500 t10msxs_uw_b655p35 0.00 655.3500 FORMAT "%8.4" /end CHARACTERISTIC
/begin CHARACTERISTIC UAOCUNMN "" VALUE 0x8E811A KwUw 31.99951 spg_q4p88Em4 0.00 31.99951 FORMAT "%8.5" /end CHARACTERISTIC
/begin CHARACTERISTIC UAOCUNMX "" VALUE 0x8E811C KwUw 31.99951 spg_q4p88Em4 0.00 31.99951 FORMAT "%8.5" /end CHARACTERISTIC
/begin CHARACTERISTIC UAOCVMMN "" VALUE 0x8E811E KwUw 31.99951 spg_q4p88Em4 0.00 31.99951 FORMAT "%8.5" /end CHARACTERISTIC
/begin CHARACTERISTIC UAOCVMMX "" VALUE 0x8E8120 KwUw 31.99951 spg_q4p88Em4 0.00 31.99951 FORMAT "%8.5" /end CHARACTERISTIC
/begin CHARACTERISTIC UASNAMN "" VALUE 0x8E8122 KwUw 31.99951 spg_q4p88Em4 0.00 31.99951 FORMAT "%8.5" /end CHARACTERISTIC
/begin CHARACTERISTIC UASNAMX "" VALUE 0x8E8124 KwUw 31.99951 spg_q4p88Em4 0.00 31.99951 FORMAT "%8.5" /end CHARACTERISTIC
/begin CHARACTERISTIC UBDHLSHMN "" VALUE 0x8E7DE8 KwUw 25.59961 spg_q0p00039 0.00 25.59961 FORMAT "%8.5" /end CHARACTERISTIC
/begin CHARACTERISTIC UBDHLSHMX "" VALUE 0x8E7DEA KwUw 25.59961 spg_q0p00039 0.00 25.59961 FORMAT "%8.5" /end CHARACTERISTIC
/begin CHARACTERISTIC UBHFM "" VALUE 0x8E1387 KwUb 17.95 spg_ubatt 0.00 17.95 FORMAT "%5.2" /end CHARACTERISTIC
/begin CHARACTERISTIC UBHRLSUMN "" VALUE 0x8E0CA4 KwUb 25.50 spg_q0p1 0.00 25.50 FORMAT "%5.2" /end CHARACTERISTIC
/begin CHARACTERISTIC UBHRLSUMX "" VALUE 0x8E0CA5 KwUb 25.50 spg_q0p1 0.00 25.50 FORMAT "%5.2" /end CHARACTERISTIC
/begin CHARACTERISTIC UBKLEMN "" VALUE 0x8E0ECA KwUb 25.50 fak_q0p1 0.00 25.50 FORMAT "%5.2" /end CHARACTERISTIC
/begin CHARACTERISTIC UBKLEMX "" VALUE 0x8E0ECB KwUb 25.50 fak_q0p1 0.00 25.50 FORMAT "%5.2" /end CHARACTERISTIC
/begin CHARACTERISTIC UDKRGOFS "" VALUE 0x8FD0CB KwUb 4.980 spg_ub_b5 0.00 4.980 FORMAT "%5.3" /end CHARACTERISTIC
/begin CHARACTERISTIC UDKRTP "" VALUE 0x8FD0CD KwUb 4.980 spg_ub_b5 0.00 4.980 FORMAT "%5.3" /end CHARACTERISTIC
/begin CHARACTERISTIC UDKSNO "" CURVE 0x8EBA8A GklWUw 319.9813 spg_uw_b1280 0.00 319.9813 FORMAT "%8.4"
 /begin AXIS_DESCR COM_AXIS nmot nmot_ub_q40 16 0.00 10200. FORMAT "%5.0" AXIS_PTS_REF SNM16KRUB /end AXIS_DESCR
/end CHARACTERISTIC
/begin CHARACTERISTIC UDKSNU "" CURVE 0x8EBAAA GklWUw 319.9813 spg_uw_b1280 0.00 319.9813 FORMAT "%8.4"
 /begin AXIS_DESCR COM_AXIS nmot nmot_ub_q40 16 0.00 10200. FORMAT "%5.0" AXIS_PTS_REF SNM16KRUB /end AXIS_DESCR
/end CHARACTERISTIC
/begin CHARACTERISTIC UHRMN1 "" VALUE 0x8E3FF8 KwUb 4.980 spg_ub_b5 0.00 4.980 FORMAT "%5.3" /end CHARACTERISTIC
/begin CHARACTERISTIC UHRMN2 "" VALUE 0x8E3FF9 KwUb 4.980 spg_ub_b5 0.00 4.980 FORMAT "%5.3" /end CHARACTERISTIC
/begin CHARACTERISTIC UHRMX1 "" VALUE 0x8E3FFA KwUb 4.980 spg_ub_b5 0.00 4.980 FORMAT "%5.3" /end CHARACTERISTIC
/begin CHARACTERISTIC UHRMX2 "" VALUE 0x8E3FFB KwUb 4.980 spg_ub_b5 0.00 4.980 FORMAT "%5.3" /end CHARACTERISTIC
/begin CHARACTERISTIC UNWDHFM "" VALUE 0x8E1388 KwUb 255.0 dez 0.00 255.0 FORMAT "%5.1" /end CHARACTERISTIC
/begin CHARACTERISTIC VDKUPPLMN "" VALUE 0x8E0D8B KwUb 318.8 vfzg_ub_q1p25 0.00 318.8 FORMAT "%5.1" /end CHARACTERISTIC
/begin CHARACTERISTIC ZATMRW "" CURVE 0x8E8082 KlAUwSstUwWUw 13107.000000 zk200msxs_uw_b13107 0.20000000000 13107.200000 FORMAT "%12.6"
 /begin AXIS_DESCR STD_AXIS msabg_w m_uw_b6553p5 5 0.00 6553.500 FORMAT "%8.3" DEPOSIT ABSOLUTE /end AXIS_DESCR
/end CHARACTERISTIC
/begin CHARACTERISTIC ZDKATAD "" VALUE 0x8E0D48 KwUb 12.7498 zk50msxs_ub_b12p8 0.0501961 12.8000 FORMAT "%7.4" /end CHARACTERISTIC
/begin CHARACTERISTIC ZDKATAF "" VALUE 0x8E0D49 KwUb 12.7498 zk50msxs_ub_b12p8 0.0501961 12.8000 FORMAT "%7.4" /end CHARACTERISTIC
/begin CHARACTERISTIC ZDKATSH "" VALUE 0x8E0D4A KwUb 12.7498 zk50msxs_ub_b12p8 0.0501961 12.8000 FORMAT "%7.4" /end CHARACTERISTIC
/begin CHARACTERISTIC ZDKTBD "" VALUE 0x8E0D4B KwUb 12.7498 zk50msxs_ub_b12p8 0.0501961 12.8000 FORMAT "%7.4" /end CHARACTERISTIC
/begin CHARACTERISTIC ZDKTBF "" VALUE 0x8E0D4C KwUb 12.7498 zk50msxs_ub_b12p8 0.0501961 12.8000 FORMAT "%7.4" /end CHARACTERISTIC
/begin CHARACTERISTIC ZFRMST "" VALUE 0x8E20D5 KwUb 50.8000 zk200msxs_ub_b51p2 0.200000 51.0000 FORMAT "%7.4" /end CHARACTERISTIC
/begin CHARACTERISTIC ZKARIH1 "" CURVE 0x8E7DEC KlAUbSstUwWUw 6553.4999985 zk100msxs_uw_b6553 0.10000152590 6553.6000000 FORMAT "%12.7"
 /begin AXIS_DESCR STD_AXIS msabg_w m_uw_b6553p5 5 0.00 6553.500 FORMAT "%8.3" DEPOSIT ABSOLUTE /end AXIS_DESCR
/end CHARACTERISTIC
/begin CHARACTERISTIC ZKARIH2 "" CURVE 0x8E7E02 KlAUbSstUwWUw 6553.4999985 zk100msxs_uw_b6553 0.10000152590 6553.6000000 FORMAT "%12.7"
 /begin AXIS_DESCR STD_AXIS msabg2_w m_uw_b6553p5 5 0.00 6553.500 FORMAT "%8.3" DEPOSIT ABSOLUTE /end AXIS_DESCR
/end CHARACTERISTIC
/begin CHARACTERISTIC ZKPRIH "" VALUE 0x8E7E18 KwUw 6553.4999985 zk100msxs_uw_b6553 0.10000152590 6553.6000000 FORMAT "%12.7" /end CHARACTERISTIC
/begin CHARACTERISTIC ZKTDRL "" VALUE 0x8E0D4D KwUb 12.7498 zk50msxs_ub_b12p8 0.0501961 12.8000 FORMAT "%7.4" /end CHARACTERISTIC
/begin CHARACTERISTIC ZKTDTKM "" VALUE 0x8E80EA KwUw 3276.7499992 zk50msxs_uw_b3276p8 0.050000762951 3276.8000000 FORMAT "%12.7" /end CHARACTERISTIC
/begin CHARACTERISTIC ZMLRO "" VALUE 0x8FCFC6 KwUb 2.54000 zk10msxs_ub_b2p55 0.0100000 2.55000 FORMAT "%7.5" /end CHARACTERISTIC
/begin MEASUREMENT ahkat "" UBYTE fak_ub_b1 1 100 0.00 0.9961 ECU_ADDRESS 0xF078C /end MEASUREMENT
/begin MEASUREMENT ahkat2 "" UBYTE fak_ub_b1 1 100 0.00 0.9961 ECU_ADDRESS 0xF078D /end MEASUREMENT
/begin MEASUREMENT ahkatn "" UBYTE fak_ub_b1 1 100 0.00 0.9961 ECU_ADDRESS 0xF078E /end MEASUREMENT
/begin MEASUREMENT ahkatn2 "" UBYTE fak_ub_b1 1 100 0.00 0.9961 ECU_ADDRESS 0xF078F /end MEASUREMENT
/begin MEASUREMENT ahktki2_w "" UWORD t50msxs_uw_b819p2 1 100 0.00 819.1875 FORMAT "%8.4" ECU_ADDRESS 0xF18F6 /end MEASUREMENT
/begin MEASUREMENT ahktki_w "" UWORD t50msxs_uw_b819p2 1 100 0.00 819.1875 FORMAT "%8.4" ECU_ADDRESS 0xF18F8 /end MEASUREMENT
/begin MEASUREMENT ahktnk "" UBYTE fak_ub_b1 1 100 0.00 0.9961 ECU_ADDRESS 0xF0790 /end MEASUREMENT
/begin MEASUREMENT ahktnk2 "" UBYTE fak_ub_b1 1 100 0.00 0.9961 ECU_ADDRESS 0xF0791 /end MEASUREMENT
/begin MEASUREMENT akatbn "" UBYTE fak_ub_b1 1 100 0.00 0.9961 ECU_ADDRESS 0xF0792 /end MEASUREMENT
/begin MEASUREMENT akatbn2 "" UBYTE fak_ub_b1 1 100 0.00 0.9961 ECU_ADDRESS 0xF0793 /end MEASUREMENT
/begin MEASUREMENT akatbnk "" UBYTE fak_ub_b1 1 100 0.00 0.9961 ECU_ADDRESS 0xF408B /end MEASUREMENT
/begin MEASUREMENT akatbnk2 "" UBYTE fak_ub_b1 1 100 0.00 0.9961 ECU_ADDRESS 0xF408C /end MEASUREMENT
/begin MEASUREMENT anzgangw "" UBYTE dez 1 100 0.00 255.0 FORMAT "%5.1" ECU_ADDRESS 0xF0809 /end MEASUREMENT
/begin MEASUREMENT anzkupplb "" UBYTE dez 1 100 0.00 255.0 FORMAT "%5.1" ECU_ADDRESS 0xF080A /end MEASUREMENT
/begin MEASUREMENT apedkt "" UBYTE dez 1 100 0.00 255.0 FORMAT "%5.1" ECU_ADDRESS 0xF0794 /end MEASUREMENT
/begin MEASUREMENT apedkt2 "" UBYTE dez 1 100 0.00 255.0 FORMAT "%5.1" ECU_ADDRESS 0xF0795 /end MEASUREMENT
/begin MEASUREMENT avkatf "" UBYTE fak_ub_b1 1 100 0.00 0.9961 ECU_ADDRESS 0x38204E /end MEASUREMENT
/begin MEASUREMENT avkatf2 "" UBYTE fak_ub_b1 1 100 0.00 0.9961 ECU_ADDRESS 0x38204F /end MEASUREMENT
/begin MEASUREMENT azlrdkt "" UBYTE fak_ub_b0p25 1 100 0.00 0.249023438 FORMAT "%11.9" ECU_ADDRESS 0xF0796 /end MEASUREMENT
/begin MEASUREMENT bitbuffer "" UBYTE DEZ 1 100 0.00 255.0 FORMAT "%5.1" ECU_ADDRESS 0xF40BA /end MEASUREMENT
/begin MEASUREMENT B_agrrdy "" UBYTE B_TRUE 1 100 0.00 1.00000000000 BIT_MASK 0x80 FORMAT "%13.11" ECU_ADDRESS 0x384006 /end MEASUREMENT
/begin MEASUREMENT B_avtmki "" UWORD B_TRUE 1 100 0.00 1.00000000000 BIT_MASK 0x1000 FORMAT "%13.11" ECU_ADDRESS 0x382E7A /end MEASUREMENT
/begin MEASUREMENT B_beaatun "" UWORD B_TRUE 1 100 0.00 1.00000000000 BIT_MASK 0x20 FORMAT "%13.11" ECU_ADDRESS 0x382D32 /end MEASUREMENT
/begin MEASUREMENT B_beasgnpl "" UWORD B_TRUE 1 100 0.00 1.00000000000 BIT_MASK 0x20 FORMAT "%13.11" ECU_ADDRESS 0x382D3A /end MEASUREMENT
/begin MEASUREMENT B_bebrems "" UWORD B_TRUE 1 100 0.00 1.00000000000 BIT_MASK 0x20 FORMAT "%13.11" ECU_ADDRESS 0x382D42 /end MEASUREMENT
/begin MEASUREMENT B_bebznpl "" UWORD B_TRUE 1 100 0.00 1.00000000000 BIT_MASK 0x20 FORMAT "%13.11" ECU_ADDRESS 0x382D44 /end MEASUREMENT
/begin MEASUREMENT B_becairp "" UWORD B_TRUE 1 100 0.00 1.00000000000 BIT_MASK 0x20 FORMAT "%13.11" ECU_ADDRESS 0x382D48 /end MEASUREMENT
/begin MEASUREMENT B_bedsu "" UWORD B_TRUE 1 100 0.00 1.00000000000 BIT_MASK 0x20 FORMAT "%13.11" ECU_ADDRESS 0x382D6E /end MEASUREMENT
/begin MEASUREMENT B_beegsbgr "" UWORD B_TRUE 1 100 0.00 1.00000000000 BIT_MASK 0x20 FORMAT "%13.11" ECU_ADDRESS 0x382D8C /end MEASUREMENT
/begin MEASUREMENT B_befku "" UWORD B_TRUE 1 100 0.00 1.00000000000 BIT_MASK 0x20 FORMAT "%13.11" ECU_ADDRESS 0x382DA0 /end MEASUREMENT
/begin MEASUREMENT B_befp1p "" UWORD B_TRUE 1 100 0.00 1.00000000000 BIT_MASK 0x20 FORMAT "%13.11" ECU_ADDRESS 0x382DA2 /end MEASUREMENT
/begin MEASUREMENT B_befp2p "" UWORD B_TRUE 1 100 0.00 1.00000000000 BIT_MASK 0x20 FORMAT "%13.11" ECU_ADDRESS 0x382DA4 /end MEASUREMENT
/begin MEASUREMENT B_begrbh "" UWORD B_TRUE 1 100 0.00 1.00000000000 BIT_MASK 0x20 FORMAT "%13.11" ECU_ADDRESS 0x382DB4 /end MEASUREMENT
/begin MEASUREMENT B_behre "" UWORD B_TRUE 1 100 0.00 1.00000000000 BIT_MASK 0x20 FORMAT "%13.11" ECU_ADDRESS 0x382DBA /end MEASUREMENT
/begin MEASUREMENT B_belshv "" UWORD B_TRUE 1 100 0.00 1.00000000000 BIT_MASK 0x20 FORMAT "%13.11" ECU_ADDRESS 0x382E04 /end MEASUREMENT
/begin MEASUREMENT B_bema "" UWORD B_TRUE 1 100 0.00 1.00000000000 BIT_MASK 0x20 FORMAT "%13.11" ECU_ADDRESS 0x382E24 /end MEASUREMENT
/begin MEASUREMENT B_bemdb "" UWORD B_TRUE 1 100 0.00 1.00000000000 BIT_MASK 0x20 FORMAT "%13.11" ECU_ADDRESS 0x382E34 /end MEASUREMENT
/begin MEASUREMENT B_bepwgde "" UWORD B_TRUE 1 100 0.00 1.00000000000 BIT_MASK 0x20 FORMAT "%13.11" ECU_ADDRESS 0x382E48 /end MEASUREMENT
/begin MEASUREMENT B_bescr "" UWORD B_TRUE 1 100 0.00 1.00000000000 BIT_MASK 0x20 FORMAT "%13.11" ECU_ADDRESS 0x382E52 /end MEASUREMENT
/begin MEASUREMENT B_besgeew "" UWORD B_TRUE 1 100 0.00 1.00000000000 BIT_MASK 0x20 FORMAT "%13.11" ECU_ADDRESS 0x382E56 /end MEASUREMENT
/begin MEASUREMENT B_beta "" UWORD B_TRUE 1 100 0.00 1.00000000000 BIT_MASK 0x20 FORMAT "%13.11" ECU_ADDRESS 0x382E68 /end MEASUREMENT
/begin MEASUREMENT B_betka "" UWORD B_TRUE 1 100 0.00 1.00000000000 BIT_MASK 0x20 FORMAT "%13.11" ECU_ADDRESS 0x382E76 /end MEASUREMENT
/begin MEASUREMENT B_betm "" UWORD B_TRUE 1 100 0.00 1.00000000000 BIT_MASK 0x20 FORMAT "%13.11" ECU_ADDRESS 0x382E78 /end MEASUREMENT
/begin MEASUREMENT B_betmki "" UWORD B_TRUE 1 100 0.00 1.00000000000 BIT_MASK 0x20 FORMAT "%13.11" ECU_ADDRESS 0x382E7A /end MEASUREMENT
/begin MEASUREMENT B_beub "" UWORD B_TRUE 1 100 0.00 1.00000000000 BIT_MASK 0x20 FORMAT "%13.11" ECU_ADDRESS 0x382E80 /end MEASUREMENT
/begin MEASUREMENT B_beubr "" UWORD B_TRUE 1 100 0.00 1.00000000000 BIT_MASK 0x20 FORMAT "%13.11" ECU_ADDRESS 0x382E82 /end MEASUREMENT
/begin MEASUREMENT B_bewfs "" UWORD B_TRUE 1 100 0.00 1.00000000000 BIT_MASK 0x20 FORMAT "%13.11" ECU_ADDRESS 0x382E9E /end MEASUREMENT
/begin MEASUREMENT B_bewfsrc "" UWORD B_TRUE 1 100 0.00 1.00000000000 BIT_MASK 0x20 FORMAT "%13.11" ECU_ADDRESS 0x382EA0 /end MEASUREMENT
/begin MEASUREMENT B_bkaatun "" UWORD B_TRUE 1 100 0.00 1.00000000000 BIT_MASK 0x40 FORMAT "%13.11" ECU_ADDRESS 0x382D32 /end MEASUREMENT
/begin MEASUREMENT B_bkasgnpl "" UWORD B_TRUE 1 100 0.00 1.00000000000 BIT_MASK 0x40 FORMAT "%13.11" ECU_ADDRESS 0x382D3A /end MEASUREMENT
/begin MEASUREMENT B_bkbrems "" UWORD B_TRUE 1 100 0.00 1.00000000000 BIT_MASK 0x40 FORMAT "%13.11" ECU_ADDRESS 0x382D42 /end MEASUREMENT
/begin MEASUREMENT B_bkbznpl "" UWORD B_TRUE 1 100 0.00 1.00000000000 BIT_MASK 0x40 FORMAT "%13.11" ECU_ADDRESS 0x382D44 /end MEASUREMENT
/begin MEASUREMENT B_bkcairp "" UWORD B_TRUE 1 100 0.00 1.00000000000 BIT_MASK 0x40 FORMAT "%13.11" ECU_ADDRESS 0x382D48 /end MEASUREMENT
/begin MEASUREMENT B_bkdsu "" UWORD B_TRUE 1 100 0.00 1.00000000000 BIT_MASK 0x40 FORMAT "%13.11" ECU_ADDRESS 0x382D6E /end MEASUREMENT
/begin MEASUREMENT B_bkegsbgr "" UWORD B_TRUE 1 100 0.00 1.00000000000 BIT_MASK 0x40 FORMAT "%13.11" ECU_ADDRESS 0x382D8C /end MEASUREMENT
/begin MEASUREMENT B_bkfku "" UWORD B_TRUE 1 100 0.00 1.00000000000 BIT_MASK 0x40 FORMAT "%13.11" ECU_ADDRESS 0x382DA0 /end MEASUREMENT
/begin MEASUREMENT B_bkfp1p "" UWORD B_TRUE 1 100 0.00 1.00000000000 BIT_MASK 0x40 FORMAT "%13.11" ECU_ADDRESS 0x382DA2 /end MEASUREMENT
/begin MEASUREMENT B_bkfp2p "" UWORD B_TRUE 1 100 0.00 1.00000000000 BIT_MASK 0x40 FORMAT "%13.11" ECU_ADDRESS 0x382DA4 /end MEASUREMENT
/begin MEASUREMENT B_bkgrbh "" UWORD B_TRUE 1 100 0.00 1.00000000000 BIT_MASK 0x40 FORMAT "%13.11" ECU_ADDRESS 0x382DB4 /end MEASUREMENT
/begin MEASUREMENT B_bkhre "" UWORD B_TRUE 1 100 0.00 1.00000000000 BIT_MASK 0x40 FORMAT "%13.11" ECU_ADDRESS 0x382DBA /end MEASUREMENT
/begin MEASUREMENT B_bklshv "" UWORD B_TRUE 1 100 0.00 1.00000000000 BIT_MASK 0x40 FORMAT "%13.11" ECU_ADDRESS 0x382E04 /end MEASUREMENT
/begin MEASUREMENT B_bkma "" UWORD B_TRUE 1 100 0.00 1.00000000000 BIT_MASK 0x40 FORMAT "%13.11" ECU_ADDRESS 0x382E24 /end MEASUREMENT
/begin MEASUREMENT B_bkmdb "" UWORD B_TRUE 1 100 0.00 1.00000000000 BIT_MASK 0x40 FORMAT "%13.11" ECU_ADDRESS 0x382E34 /end MEASUREMENT
/begin MEASUREMENT B_bkpwgde "" UWORD B_TRUE 1 100 0.00 1.00000000000 BIT_MASK 0x40 FORMAT "%13.11" ECU_ADDRESS 0x382E48 /end MEASUREMENT
/begin MEASUREMENT B_bkscr "" UWORD B_TRUE 1 100 0.00 1.00000000000 BIT_MASK 0x40 FORMAT "%13.11" ECU_ADDRESS 0x382E52 /end MEASUREMENT
/begin MEASUREMENT B_bksgeew "" UWORD B_TRUE 1 100 0.00 1.00000000000 BIT_MASK 0x40 FORMAT "%13.11" ECU_ADDRESS 0x382E56 /end MEASUREMENT
/begin MEASUREMENT B_bkta "" UWORD B_TRUE 1 100 0.00 1.00000000000 BIT_MASK 0x40 FORMAT "%13.11" ECU_ADDRESS 0x382E68 /end MEASUREMENT
/begin MEASUREMENT B_bktka "" UWORD B_TRUE 1 100 0.00 1.00000000000 BIT_MASK 0x40 FORMAT "%13.11" ECU_ADDRESS 0x382E76 /end MEASUREMENT
/begin MEASUREMENT B_bktm "" UWORD B_TRUE 1 100 0.00 1.00000000000 BIT_MASK 0x40 FORMAT "%13.11" ECU_ADDRESS 0x382E78 /end MEASUREMENT
/begin MEASUREMENT B_bktmki "" UWORD B_TRUE 1 100 0.00 1.00000000000 BIT_MASK 0x40 FORMAT "%13.11" ECU_ADDRESS 0x382E7A /end MEASUREMENT
/begin MEASUREMENT B_bkub "" UWORD B_TRUE 1 100 0.00 1.00000000000 BIT_MASK 0x40 FORMAT "%13.11" ECU_ADDRESS 0x382E80 /end MEASUREMENT
/begin MEASUREMENT B_bkubr "" UWORD B_TRUE 1 100 0.00 1.00000000000 BIT_MASK 0x40 FORMAT "%13.11" ECU_ADDRESS 0x382E82 /end MEASUREMENT
/begin MEASUREMENT B_bkwfs "" UWORD B_TRUE 1 100 0.00 1.00000000000 BIT_MASK 0x40 FORMAT "%13.11" ECU_ADDRESS 0x382E9E /end MEASUREMENT
/begin MEASUREMENT B_bkwfsrc "" UWORD B_TRUE 1 100 0.00 1.00000000000 BIT_MASK 0x40 FORMAT "%13.11" ECU_ADDRESS 0x382EA0 /end MEASUREMENT
/begin MEASUREMENT B_claatun "" UWORD B_TRUE 1 100 0.00 1.00000000000 BIT_MASK 0x80 FORMAT "%13.11" ECU_ADDRESS 0x382D32 /end MEASUREMENT
/begin MEASUREMENT B_clasgnpl "" UWORD B_TRUE 1 100 0.00 1.00000000000 BIT_MASK 0x80 FORMAT "%13.11" ECU_ADDRESS 0x382D3A /end MEASUREMENT
/begin MEASUREMENT B_clbrems "" UWORD B_TRUE 1 100 0.00 1.00000000000 BIT_MASK 0x80 FORMAT "%13.11" ECU_ADDRESS 0x382D42 /end MEASUREMENT
/begin MEASUREMENT B_clbznpl "" UWORD B_TRUE 1 100 0.00 1.00000000000 BIT_MASK 0x80 FORMAT "%13.11" ECU_ADDRESS 0x382D44 /end MEASUREMENT
/begin MEASUREMENT B_clcairp "" UWORD B_TRUE 1 100 0.00 1.00000000000 BIT_MASK 0x80 FORMAT "%13.11" ECU_ADDRESS 0x382D48 /end MEASUREMENT
/begin MEASUREMENT B_cldsu "" UWORD B_TRUE 1 100 0.00 1.00000000000 BIT_MASK 0x80 FORMAT "%13.11" ECU_ADDRESS 0x382D6E /end MEASUREMENT
/begin MEASUREMENT B_clegsbgr "" UWORD B_TRUE 1 100 0.00 1.00000000000 BIT_MASK 0x80 FORMAT "%13.11" ECU_ADDRESS 0x382D8C /end MEASUREMENT
/begin MEASUREMENT B_clfku "" UWORD B_TRUE 1 100 0.00 1.00000000000 BIT_MASK 0x80 FORMAT "%13.11" ECU_ADDRESS 0x382DA0 /end MEASUREMENT
/begin MEASUREMENT B_clfp1p "" UWORD B_TRUE 1 100 0.00 1.00000000000 BIT_MASK 0x80 FORMAT "%13.11" ECU_ADDRESS 0x382DA2 /end MEASUREMENT
/begin MEASUREMENT B_clfp2p "" UWORD B_TRUE 1 100 0.00 1.00000000000 BIT_MASK 0x80 FORMAT "%13.11" ECU_ADDRESS 0x382DA4 /end MEASUREMENT
/begin MEASUREMENT B_clgrbh "" UWORD B_TRUE 1 100 0.00 1.00000000000 BIT_MASK 0x80 FORMAT "%13.11" ECU_ADDRESS 0x382DB4 /end MEASUREMENT
/begin MEASUREMENT B_clhre "" UWORD B_TRUE 1 100 0.00 1.00000000000 BIT_MASK 0x80 FORMAT "%13.11" ECU_ADDRESS 0x382DBA /end MEASUREMENT
/begin MEASUREMENT B_cllshv "" UWORD B_TRUE 1 100 0.00 1.00000000000 BIT_MASK 0x80 FORMAT "%13.11" ECU_ADDRESS 0x382E04 /end MEASUREMENT
/begin MEASUREMENT B_clma "" UWORD B_TRUE 1 100 0.00 1.00000000000 BIT_MASK 0x80 FORMAT "%13.11" ECU_ADDRESS 0x382E24 /end MEASUREMENT
/begin MEASUREMENT B_clmdb "" UWORD B_TRUE 1 100 0.00 1.00000000000 BIT_MASK 0x80 FORMAT "%13.11" ECU_ADDRESS 0x382E34 /end MEASUREMENT
/begin MEASUREMENT B_clpwgde "" UWORD B_TRUE 1 100 0.00 1.00000000000 BIT_MASK 0x80 FORMAT "%13.11" ECU_ADDRESS 0x382E48 /end MEASUREMENT
/begin MEASUREMENT B_clscr "" UWORD B_TRUE 1 100 0.00 1.00000000000 BIT_MASK 0x80 FORMAT "%13.11" ECU_ADDRESS 0x382E52 /end MEASUREMENT
/begin MEASUREMENT B_clsgeew "" UWORD B_TRUE 1 100 0.00 1.00000000000 BIT_MASK 0x80 FORMAT "%13.11" ECU_ADDRESS 0x382E56 /end MEASUREMENT
/begin MEASUREMENT B_clta "" UWORD B_TRUE 1 100 0.00 1.00000000000 BIT_MASK 0x80 FORMAT "%13.11" ECU_ADDRESS 0x382E68 /end MEASUREMENT
/begin MEASUREMENT B_cltka "" UWORD B_TRUE 1 100 0.00 1.00000000000 BIT_MASK 0x80 FORMAT "%13.11" ECU_ADDRESS 0x382E76 /end MEASUREMENT
/begin MEASUREMENT B_cltm "" UWORD B_TRUE 1 100 0.00 1.00000000000 BIT_MASK 0x80 FORMAT "%13.11" ECU_ADDRESS 0x382E78 /end MEASUREMENT
/begin MEASUREMENT B_cltmki "" UWORD B_TRUE 1 100 0.00 1.00000000000 BIT_MASK 0x80 FORMAT "%13.11" ECU_ADDRESS 0x382E7A /end MEASUREMENT
/begin MEASUREMENT B_club "" UWORD B_TRUE 1 100 0.00 1.00000000000 BIT_MASK 0x80 FORMAT "%13.11" ECU_ADDRESS 0x382E80 /end MEASUREMENT
/begin MEASUREMENT B_clubr "" UWORD B_TRUE 1 100 0.00 1.00000000000 BIT_MASK 0x80 FORMAT "%13.11" ECU_ADDRESS 0x382E82 /end MEASUREMENT
/begin MEASUREMENT B_clwfs "" UWORD B_TRUE 1 100 0.00 1.00000000000 BIT_MASK 0x80 FORMAT "%13.11" ECU_ADDRESS 0x382E9E /end MEASUREMENT
/begin MEASUREMENT B_clwfsrc "" UWORD B_TRUE 1 100 0.00 1.00000000000 BIT_MASK 0x80 FORMAT "%13.11" ECU_ADDRESS 0x382EA0 /end MEASUREMENT
/begin MEASUREMENT B_dhrnio "" UWORD B_TRUE 1 100 0.00 1.00000000000 BIT_MASK 0x100 FORMAT "%13.11" ECU_ADDRESS 0xFDD0 /end MEASUREMENT
/begin MEASUREMENT B_diagia "" UBYTE B_TRUE 1 100 0.00 1.00000000000 BIT_MASK 0x4 FORMAT "%13.11" ECU_ADDRESS 0xF07B2 /end MEASUREMENT
/begin MEASUREMENT B_diagia2 "" UBYTE B_TRUE 1 100 0.00 1.00000000000 BIT_MASK 0x8 FORMAT "%13.11" ECU_ADDRESS 0xF07B2 /end MEASUREMENT
/begin MEASUREMENT B_dkini "" UBYTE B_TRUE 1 100 0.00 1.00000000000 BIT_MASK 0x1 FORMAT "%13.11" ECU_ADDRESS 0xF0797 /end MEASUREMENT
/begin MEASUREMENT B_dkini2 "" UBYTE B_TRUE 1 100 0.00 1.00000000000 BIT_MASK 0x1 FORMAT "%13.11" ECU_ADDRESS 0xF0798 /end MEASUREMENT
/begin MEASUREMENT B_dklpi "" UBYTE B_TRUE 1 100 0.00 1.00000000000 BIT_MASK 0x4 FORMAT "%13.11" ECU_ADDRESS 0xF0797 /end MEASUREMENT
/begin MEASUREMENT B_dklpi2 "" UBYTE B_TRUE 1 100 0.00 1.00000000000 BIT_MASK 0x4 FORMAT "%13.11" ECU_ADDRESS 0xF0798 /end MEASUREMENT
/begin MEASUREMENT B_dktakt "" UBYTE B_TRUE 1 100 0.00 1.00000000000 BIT_MASK 0x1 FORMAT "%13.11" ECU_ADDRESS 0xF079B /end MEASUREMENT
/begin MEASUREMENT B_dktakt2 "" UBYTE B_TRUE 1 100 0.00 1.00000000000 BIT_MASK 0x10 FORMAT "%13.11" ECU_ADDRESS 0xF079B /end MEASUREMENT
/begin MEASUREMENT B_dkten "" UBYTE B_TRUE 1 100 0.00 1.00000000000 BIT_MASK 0x2 FORMAT "%13.11" ECU_ADDRESS 0xF0797 /end MEASUREMENT
/begin MEASUREMENT B_dkten2 "" UBYTE B_TRUE 1 100 0.00 1.00000000000 BIT_MASK 0x2 FORMAT "%13.11" ECU_ADDRESS 0xF0798 /end MEASUREMENT
/begin MEASUREMENT B_dktlp "" UWORD B_TRUE 1 100 0.00 1.00000000000 BIT_MASK 0x100 FORMAT "%13.11" ECU_ADDRESS 0xFD50 /end MEASUREMENT
/begin MEASUREMENT B_dktnr "" UBYTE B_TRUE 1 100 0.00 1.00000000000 BIT_MASK 0x8 FORMAT "%13.11" ECU_ADDRESS 0xF0797 /end MEASUREMENT
/begin MEASUREMENT B_dktnr2 "" UBYTE B_TRUE 1 100 0.00 1.00000000000 BIT_MASK 0x8 FORMAT "%13.11" ECU_ADDRESS 0xF0798 /end MEASUREMENT
/begin MEASUREMENT B_dktpb "" UBYTE B_TRUE 1 100 0.00 1.00000000000 BIT_MASK 0x80 FORMAT "%13.11" ECU_ADDRESS 0xF0799 /end MEASUREMENT
/begin MEASUREMENT B_dktpb2 "" UBYTE B_TRUE 1 100 0.00 1.00000000000 BIT_MASK 0x80 FORMAT "%13.11" ECU_ADDRESS 0xF079A /end MEASUREMENT
/begin MEASUREMENT B_dktsb "" UBYTE B_TRUE 1 100 0.00 1.00000000000 BIT_MASK 0x10 FORMAT "%13.11" ECU_ADDRESS 0xF0797 /end MEASUREMENT
/begin MEASUREMENT B_dktsb2 "" UBYTE B_TRUE 1 100 0.00 1.00000000000 BIT_MASK 0x10 FORMAT "%13.11" ECU_ADDRESS 0xF0798 /end MEASUREMENT
/begin MEASUREMENT B_dktsp "" UBYTE B_TRUE 1 100 0.00 1.00000000000 BIT_MASK 0x20 FORMAT "%13.11" ECU_ADDRESS 0xF0797 /end MEASUREMENT
/begin MEASUREMENT B_dktsp2 "" UBYTE B_TRUE 1 100 0.00 1.00000000000 BIT_MASK 0x20 FORMAT "%13.11" ECU_ADDRESS 0xF0798 /end MEASUREMENT
/begin MEASUREMENT B_dktst "" UBYTE B_TRUE 1 100 0.00 1.00000000000 BIT_MASK 0x40 FORMAT "%13.11" ECU_ADDRESS 0xF0797 /end MEASUREMENT
/begin MEASUREMENT B_dktst2 "" UBYTE B_TRUE 1 100 0.00 1.00000000000 BIT_MASK 0x40 FORMAT "%13.11" ECU_ADDRESS 0xF0798 /end MEASUREMENT
/begin MEASUREMENT B_dktt "" UBYTE B_TRUE 1 100 0.00 1.00000000000 BIT_MASK 0x80 FORMAT "%13.11" ECU_ADDRESS 0xF0797 /end MEASUREMENT
/begin MEASUREMENT B_dktt2 "" UBYTE B_TRUE 1 100 0.00 1.00000000000 BIT_MASK 0x80 FORMAT "%13.11" ECU_ADDRESS 0xF0798 /end MEASUREMENT
/begin MEASUREMENT B_dkttk "" UBYTE B_TRUE 1 100 0.00 1.00000000000 BIT_MASK 0x1 FORMAT "%13.11" ECU_ADDRESS 0xF0799 /end MEASUREMENT
/begin MEASUREMENT B_dkttk2 "" UBYTE B_TRUE 1 100 0.00 1.00000000000 BIT_MASK 0x1 FORMAT "%13.11" ECU_ADDRESS 0xF079A /end MEASUREMENT
/begin MEASUREMENT B_dkvsef "" UWORD B_TRUE 1 100 0.00 1.00000000000 BIT_MASK 0x1 FORMAT "%13.11" ECU_ADDRESS 0xFD7E /end MEASUREMENT
/begin MEASUREMENT B_dkvsef2 "" UWORD B_TRUE 1 100 0.00 1.00000000000 BIT_MASK 0x2 FORMAT "%13.11" ECU_ADDRESS 0xFD7E /end MEASUREMENT
/begin MEASUREMENT B_dkvsf "" UWORD B_TRUE 1 100 0.00 1.00000000000 BIT_MASK 0x4 FORMAT "%13.11" ECU_ADDRESS 0xFD7E /end MEASUREMENT
/begin MEASUREMENT B_dkvsfm "" UBYTE B_TRUE 1 100 0.00 1.00000000000 BIT_MASK 0x1 FORMAT "%13.11" ECU_ADDRESS 0x382067 /end MEASUREMENT
/begin MEASUREMENT B_dkvstr "" UWORD B_TRUE 1 100 0.00 1.00000000000 BIT_MASK 0x8 FORMAT "%13.11" ECU_ADDRESS 0xFD7E /end MEASUREMENT
/begin MEASUREMENT B_dkvszf "" UBYTE B_TRUE 1 100 0.00 1.00000000000 BIT_MASK 0x1 FORMAT "%13.11" ECU_ADDRESS 0xF40FC /end MEASUREMENT
/begin MEASUREMENT B_dkvszf2 "" UBYTE B_TRUE 1 100 0.00 1.00000000000 BIT_MASK 0x20 FORMAT "%13.11" ECU_ADDRESS 0xF40FC /end MEASUREMENT
/begin MEASUREMENT B_dllr "" UWORD B_TRUE 1 100 0.00 1.00000000000 BIT_MASK 0x4 FORMAT "%13.11" ECU_ADDRESS 0xFDA2 /end MEASUREMENT
/begin MEASUREMENT B_dllra "" UWORD B_TRUE 1 100 0.00 1.00000000000 BIT_MASK 0x8 FORMAT "%13.11" ECU_ADDRESS 0xFDA2 /end MEASUREMENT
/begin MEASUREMENT B_ds "" UWORD B_TRUE 1 100 0.00 1.00000000000 BIT_MASK 0x80 FORMAT "%13.11" ECU_ADDRESS 0xFD94 /end MEASUREMENT
/begin MEASUREMENT B_ds2 "" UWORD B_TRUE 1 100 0.00 1.00000000000 BIT_MASK 0x100 FORMAT "%13.11" ECU_ADDRESS 0xFD94 /end MEASUREMENT
/begin MEASUREMENT B_edkvs "" UWORD B_TRUE 1 100 0.00 1.00000000000 BIT_MASK 0x10 FORMAT "%13.11" ECU_ADDRESS 0xFD7E /end MEASUREMENT
/begin MEASUREMENT B_edkvs2 "" UWORD B_TRUE 1 100 0.00 1.00000000000 BIT_MASK 0x20 FORMAT "%13.11" ECU_ADDRESS 0xFD7E /end MEASUREMENT
/begin MEASUREMENT B_efrao "" UWORD B_TRUE 1 100 0.00 1.00000000000 BIT_MASK 0x40 FORMAT "%13.11" ECU_ADDRESS 0xFD7E /end MEASUREMENT
/begin MEASUREMENT B_efrao2 "" UWORD B_TRUE 1 100 0.00 1.00000000000 BIT_MASK 0x80 FORMAT "%13.11" ECU_ADDRESS 0xFD7E /end MEASUREMENT
/begin MEASUREMENT B_efrau "" UWORD B_TRUE 1 100 0.00 1.00000000000 BIT_MASK 0x100 FORMAT "%13.11" ECU_ADDRESS 0xFD7E /end MEASUREMENT
/begin MEASUREMENT B_efrau2 "" UWORD B_TRUE 1 100 0.00 1.00000000000 BIT_MASK 0x200 FORMAT "%13.11" ECU_ADDRESS 0xFD7E /end MEASUREMENT
/begin MEASUREMENT B_ehfm "" UWORD B_TRUE 1 100 0.00 1.00000000000 BIT_MASK 0x800 FORMAT "%13.11" ECU_ADDRESS 0xFD6A /end MEASUREMENT
/begin MEASUREMENT B_ehfm1 "" UWORD B_TRUE 1 100 0.00 1.00000000000 BIT_MASK 0x1000 FORMAT "%13.11" ECU_ADDRESS 0xFD6A /end MEASUREMENT
/begin MEASUREMENT B_ehlsu "" UBYTE B_TRUE 1 100 0.00 1.00000000000 BIT_MASK 0x1 FORMAT "%13.11" ECU_ADDRESS 0xF0783 /end MEASUREMENT
/begin MEASUREMENT B_ehlsu2 "" UBYTE B_TRUE 1 100 0.00 1.00000000000 BIT_MASK 0x2 FORMAT "%13.11" ECU_ADDRESS 0xF0783 /end MEASUREMENT
/begin MEASUREMENT B_ehsh "" UBYTE B_TRUE 1 100 0.00 1.00000000000 BIT_MASK 0x1 FORMAT "%13.11" ECU_ADDRESS 0xF4053 /end MEASUREMENT
/begin MEASUREMENT B_ehsh2 "" UBYTE B_TRUE 1 100 0.00 1.00000000000 BIT_MASK 0x1 FORMAT "%13.11" ECU_ADDRESS 0xF4054 /end MEASUREMENT
/begin MEASUREMENT B_ehsve "" UBYTE B_TRUE 1 100 0.00 1.00000000000 BIT_MASK 0x1 FORMAT "%13.11" ECU_ADDRESS 0xF40B8 /end MEASUREMENT
/begin MEASUREMENT B_ehsve2 "" UBYTE B_TRUE 1 100 0.00 1.00000000000 BIT_MASK 0x2 FORMAT "%13.11" ECU_ADDRESS 0xF40B8 /end MEASUREMENT
/begin MEASUREMENT B_eiclsu "" UBYTE B_TRUE 1 100 0.00 1.00000000000 BIT_MASK 0x1 FORMAT "%13.11" ECU_ADDRESS 0xF07B1 /end MEASUREMENT
/begin MEASUREMENT B_eiclsu2 "" UBYTE B_TRUE 1 100 0.00 1.00000000000 BIT_MASK 0x10 FORMAT "%13.11" ECU_ADDRESS 0xF07B1 /end MEASUREMENT
/begin MEASUREMENT B_ekats "" UBYTE B_TRUE 1 100 0.00 1.00000000000 BIT_MASK 0x2 FORMAT "%13.11" ECU_ADDRESS 0xF0799 /end MEASUREMENT
/begin MEASUREMENT B_ekats2 "" UBYTE B_TRUE 1 100 0.00 1.00000000000 BIT_MASK 0x2 FORMAT "%13.11" ECU_ADDRESS 0xF079A /end MEASUREMENT
/begin MEASUREMENT B_ekusvk "" UBYTE B_TRUE 1 100 0.00 1.00000000000 BIT_MASK 0x2 FORMAT "%13.11" ECU_ADDRESS 0xF07B1 /end MEASUREMENT
/begin MEASUREMENT B_ekusvk2 "" UBYTE B_TRUE 1 100 0.00 1.00000000000 BIT_MASK 0x20 FORMAT "%13.11" ECU_ADDRESS 0xF07B1 /end MEASUREMENT
/begin MEASUREMENT B_elsuwi "" UBYTE B_TRUE 1 100 0.00 1.00000000000 BIT_MASK 0x4 FORMAT "%13.11" ECU_ADDRESS 0xF07B1 /end MEASUREMENT
/begin MEASUREMENT B_elsuwi2 "" UBYTE B_TRUE 1 100 0.00 1.00000000000 BIT_MASK 0x40 FORMAT "%13.11" ECU_ADDRESS 0xF07B1 /end MEASUREMENT
/begin MEASUREMENT B_enh "" UBYTE B_TRUE 1 100 0.00 1.00000000000 BIT_MASK 0x20 FORMAT "%13.11" ECU_ADDRESS 0xF4053 /end MEASUREMENT
/begin MEASUREMENT B_enh2 "" UBYTE B_TRUE 1 100 0.00 1.00000000000 BIT_MASK 0x20 FORMAT "%13.11" ECU_ADDRESS 0xF4054 /end MEASUREMENT
/begin MEASUREMENT B_enmx "" UBYTE B_TRUE 1 100 0.00 1.00000000000 BIT_MASK 0x20 FORMAT "%13.11" ECU_ADDRESS 0xF0784 /end MEASUREMENT
/begin MEASUREMENT B_enmx2 "" UBYTE B_TRUE 1 100 0.00 1.00000000000 BIT_MASK 0x10 FORMAT "%13.11" ECU_ADDRESS 0xF0785 /end MEASUREMENT
/begin MEASUREMENT B_erdkt "" UBYTE B_TRUE 1 100 0.00 1.00000000000 BIT_MASK 0x4 FORMAT "%13.11" ECU_ADDRESS 0xF0799 /end MEASUREMENT
/begin MEASUREMENT B_erdkt2 "" UBYTE B_TRUE 1 100 0.00 1.00000000000 BIT_MASK 0x4 FORMAT "%13.11" ECU_ADDRESS 0xF079A /end MEASUREMENT
/begin MEASUREMENT B_erkat "" UWORD B_TRUE 1 100 0.00 1.00000000000 BIT_MASK 0x400 FORMAT "%13.11" ECU_ADDRESS 0xFD7E /end MEASUREMENT
/begin MEASUREMENT B_erkat2 "" UWORD B_TRUE 1 100 0.00 1.00000000000 BIT_MASK 0x800 FORMAT "%13.11" ECU_ADDRESS 0xFD7E /end MEASUREMENT
/begin MEASUREMENT B_erkaz "" UWORD B_TRUE 1 100 0.00 1.00000000000 BIT_MASK 0x1000 FORMAT "%13.11" ECU_ADDRESS 0xFD7E /end MEASUREMENT
/begin MEASUREMENT B_erkaz2 "" UWORD B_TRUE 1 100 0.00 1.00000000000 BIT_MASK 0x2000 FORMAT "%13.11" ECU_ADDRESS 0xFD7E /end MEASUREMENT
/begin MEASUREMENT B_fgahfm "" UWORD B_TRUE 1 100 0.00 1.00000000000 BIT_MASK 0x2000 FORMAT "%13.11" ECU_ADDRESS 0xFD6A /end MEASUREMENT
/begin MEASUREMENT B_fgdhfmst "" UBYTE B_TRUE 1 100 0.00 1.00000000000 BIT_MASK 0x1 FORMAT "%13.11" ECU_ADDRESS 0xF40C1 /end MEASUREMENT
/begin MEASUREMENT B_fgfshfm "" UBYTE B_TRUE 1 100 0.00 1.00000000000 BIT_MASK 0x2 FORMAT "%13.11" ECU_ADDRESS 0xF40C1 /end MEASUREMENT
/begin MEASUREMENT B_frste "" UWORD B_TRUE 1 100 0.00 1.00000000000 BIT_MASK 0x4000 FORMAT "%13.11" ECU_ADDRESS 0xFD7E /end MEASUREMENT
/begin MEASUREMENT B_frste2 "" UWORD B_TRUE 1 100 0.00 1.00000000000 BIT_MASK 0x8000 FORMAT "%13.11" ECU_ADDRESS 0xFD7E /end MEASUREMENT
/begin MEASUREMENT B_ftaatun "" UWORD B_TRUE 1 100 0.00 1.00000000000 BIT_MASK 0x10 FORMAT "%13.11" ECU_ADDRESS 0x382D32 /end MEASUREMENT
/begin MEASUREMENT B_ftasgnpl "" UWORD B_TRUE 1 100 0.00 1.00000000000 BIT_MASK 0x10 FORMAT "%13.11" ECU_ADDRESS 0x382D3A /end MEASUREMENT
/begin MEASUREMENT B_ftbrems "" UWORD B_TRUE 1 100 0.00 1.00000000000 BIT_MASK 0x10 FORMAT "%13.11" ECU_ADDRESS 0x382D42 /end MEASUREMENT
/begin MEASUREMENT B_ftbznpl "" UWORD B_TRUE 1 100 0.00 1.00000000000 BIT_MASK 0x10 FORMAT "%13.11" ECU_ADDRESS 0x382D44 /end MEASUREMENT
/begin MEASUREMENT B_ftcairp "" UWORD B_TRUE 1 100 0.00 1.00000000000 BIT_MASK 0x10 FORMAT "%13.11" ECU_ADDRESS 0x382D48 /end MEASUREMENT
/begin MEASUREMENT B_ftdsu "" UWORD B_TRUE 1 100 0.00 1.00000000000 BIT_MASK 0x10 FORMAT "%13.11" ECU_ADDRESS 0x382D6E /end MEASUREMENT
/begin MEASUREMENT B_ftegsbgr "" UWORD B_TRUE 1 100 0.00 1.00000000000 BIT_MASK 0x10 FORMAT "%13.11" ECU_ADDRESS 0x382D8C /end MEASUREMENT
/begin MEASUREMENT B_ftfku "" UWORD B_TRUE 1 100 0.00 1.00000000000 BIT_MASK 0x10 FORMAT "%13.11" ECU_ADDRESS 0x382DA0 /end MEASUREMENT
/begin MEASUREMENT B_ftfp1p "" UWORD B_TRUE 1 100 0.00 1.00000000000 BIT_MASK 0x10 FORMAT "%13.11" ECU_ADDRESS 0x382DA2 /end MEASUREMENT
/begin MEASUREMENT B_ftfp2p "" UWORD B_TRUE 1 100 0.00 1.00000000000 BIT_MASK 0x10 FORMAT "%13.11" ECU_ADDRESS 0x382DA4 /end MEASUREMENT
/begin MEASUREMENT B_ftgrbh "" UWORD B_TRUE 1 100 0.00 1.00000000000 BIT_MASK 0x10 FORMAT "%13.11" ECU_ADDRESS 0x382DB4 /end MEASUREMENT
/begin MEASUREMENT B_fthre "" UWORD B_TRUE 1 100 0.00 1.00000000000 BIT_MASK 0x10 FORMAT "%13.11" ECU_ADDRESS 0x382DBA /end MEASUREMENT
/begin MEASUREMENT B_ftlshv "" UWORD B_TRUE 1 100 0.00 1.00000000000 BIT_MASK 0x10 FORMAT "%13.11" ECU_ADDRESS 0x382E04 /end MEASUREMENT
/begin MEASUREMENT B_ftma "" UWORD B_TRUE 1 100 0.00 1.00000000000 BIT_MASK 0x10 FORMAT "%13.11" ECU_ADDRESS 0x382E24 /end MEASUREMENT
/begin MEASUREMENT B_ftmdb "" UWORD B_TRUE 1 100 0.00 1.00000000000 BIT_MASK 0x10 FORMAT "%13.11" ECU_ADDRESS 0x382E34 /end MEASUREMENT
/begin MEASUREMENT B_ftpwgde "" UWORD B_TRUE 1 100 0.00 1.00000000000 BIT_MASK 0x10 FORMAT "%13.11" ECU_ADDRESS 0x382E48 /end MEASUREMENT
/begin MEASUREMENT B_ftscr "" UWORD B_TRUE 1 100 0.00 1.00000000000 BIT_MASK 0x10 FORMAT "%13.11" ECU_ADDRESS 0x382E52 /end MEASUREMENT
/begin MEASUREMENT B_ftsgeew "" UWORD B_TRUE 1 100 0.00 1.00000000000 BIT_MASK 0x10 FORMAT "%13.11" ECU_ADDRESS 0x382E56 /end MEASUREMENT
/begin MEASUREMENT B_ftta "" UWORD B_TRUE 1 100 0.00 1.00000000000 BIT_MASK 0x10 FORMAT "%13.11" ECU_ADDRESS 0x382E68 /end MEASUREMENT
/begin MEASUREMENT B_fttka "" UWORD B_TRUE 1 100 0.00 1.00000000000 BIT_MASK 0x10 FORMAT "%13.11" ECU_ADDRESS 0x382E76 /end MEASUREMENT
/begin MEASUREMENT B_fttm "" UWORD B_TRUE 1 100 0.00 1.00000000000 BIT_MASK 0x10 FORMAT "%13.11" ECU_ADDRESS 0x382E78 /end MEASUREMENT
/begin MEASUREMENT B_fttmki "" UWORD B_TRUE 1 100 0.00 1.00000000000 BIT_MASK 0x10 FORMAT "%13.11" ECU_ADDRESS 0x382E7A /end MEASUREMENT
/begin MEASUREMENT B_ftub "" UWORD B_TRUE 1 100 0.00 1.00000000000 BIT_MASK 0x10 FORMAT "%13.11" ECU_ADDRESS 0x382E80 /end MEASUREMENT
/begin MEASUREMENT B_ftubr "" UWORD B_TRUE 1 100 0.00 1.00000000000 BIT_MASK 0x10 FORMAT "%13.11" ECU_ADDRESS 0x382E82 /end MEASUREMENT
/begin MEASUREMENT B_ftwfs "" UWORD B_TRUE 1 100 0.00 1.00000000000 BIT_MASK 0x10 FORMAT "%13.11" ECU_ADDRESS 0x382E9E /end MEASUREMENT
/begin MEASUREMENT B_ftwfsrc "" UWORD B_TRUE 1 100 0.00 1.00000000000 BIT_MASK 0x10 FORMAT "%13.11" ECU_ADDRESS 0x382EA0 /end MEASUREMENT
/begin MEASUREMENT B_gae "" UWORD B_TRUE 1 100 0.00 1.00000000000 BIT_MASK 0x1 FORMAT "%13.11" ECU_ADDRESS 0xFD80 /end MEASUREMENT
/begin MEASUREMENT B_gaefra "" UWORD B_TRUE 1 100 0.00 1.00000000000 BIT_MASK 0x2 FORMAT "%13.11" ECU_ADDRESS 0xFD80 /end MEASUREMENT
/begin MEASUREMENT B_gaefra2 "" UWORD B_TRUE 1 100 0.00 1.00000000000 BIT_MASK 0x4 FORMAT "%13.11" ECU_ADDRESS 0xFD80 /end MEASUREMENT
/begin MEASUREMENT B_gaeing "" UWORD B_TRUE 1 100 0.00 1.00000000000 BIT_MASK 0x8 FORMAT "%13.11" ECU_ADDRESS 0xFD80 /end MEASUREMENT
/begin MEASUREMENT B_gaeing2 "" UWORD B_TRUE 1 100 0.00 1.00000000000 BIT_MASK 0x10 FORMAT "%13.11" ECU_ADDRESS 0xFD80 /end MEASUREMENT
/begin MEASUREMENT B_gangok "" UWORD B_TRUE 1 100 0.00 1.00000000000 BIT_MASK 0x1 FORMAT "%13.11" ECU_ADDRESS 0xFD54 /end MEASUREMENT
/begin MEASUREMENT B_heahfmlm "" UBYTE B_TRUE 1 100 0.00 1.00000000000 BIT_MASK 0x1 FORMAT "%13.11" ECU_ADDRESS 0xF40C0 /end MEASUREMENT
/begin MEASUREMENT B_helsuip "" UBYTE B_TRUE 1 100 0.00 1.00000000000 BIT_MASK 0x10 FORMAT "%13.11" ECU_ADDRESS 0xF07B2 /end MEASUREMENT
/begin MEASUREMENT B_helsuip2 "" UBYTE B_TRUE 1 100 0.00 1.00000000000 BIT_MASK 0x20 FORMAT "%13.11" ECU_ADDRESS 0xF07B2 /end MEASUREMENT
/begin MEASUREMENT B_hfm "" UWORD B_TRUE 1 100 0.00 1.00000000000 BIT_MASK 0x4000 FORMAT "%13.11" ECU_ADDRESS 0xFD6A /end MEASUREMENT
/begin MEASUREMENT B_hfmko "" UWORD B_TRUE 1 100 0.00 1.00000000000 BIT_MASK 0x8000 FORMAT "%13.11" ECU_ADDRESS 0xFD6A /end MEASUREMENT
/begin MEASUREMENT B_hfmku "" UWORD B_TRUE 1 100 0.00 1.00000000000 BIT_MASK 0x1 FORMAT "%13.11" ECU_ADDRESS 0xFD6C /end MEASUREMENT
/begin MEASUREMENT B_hrlsunp "" UBYTE B_TRUE 1 100 0.00 1.00000000000 BIT_MASK 0x10 FORMAT "%13.11" ECU_ADDRESS 0xF0784 /end MEASUREMENT
/begin MEASUREMENT B_hrlsunp2 "" UBYTE B_TRUE 1 100 0.00 1.00000000000 BIT_MASK 0x8 FORMAT "%13.11" ECU_ADDRESS 0xF0785 /end MEASUREMENT
/begin MEASUREMENT B_hsokh "" UBYTE B_TRUE 1 100 0.00 1.00000000000 BIT_MASK 0x2 FORMAT "%13.11" ECU_ADDRESS 0xF4055 /end MEASUREMENT
/begin MEASUREMENT B_hsokh2 "" UBYTE B_TRUE 1 100 0.00 1.00000000000 BIT_MASK 0x2 FORMAT "%13.11" ECU_ADDRESS 0xF4056 /end MEASUREMENT
/begin MEASUREMENT B_hsrdy "" UBYTE B_TRUE 1 100 0.00 1.00000000000 BIT_MASK 0x40 FORMAT "%13.11" ECU_ADDRESS 0x384006 /end MEASUREMENT
/begin MEASUREMENT B_hsveemn "" UBYTE B_TRUE 1 100 0.00 1.00000000000 BIT_MASK 0x1 FORMAT "%13.11" ECU_ADDRESS 0xF40B9 /end MEASUREMENT
/begin MEASUREMENT B_hsveemn2 "" UBYTE B_TRUE 1 100 0.00 1.00000000000 BIT_MASK 0x10 FORMAT "%13.11" ECU_ADDRESS 0xF40B9 /end MEASUREMENT
/begin MEASUREMENT B_hsveemx "" UBYTE B_TRUE 1 100 0.00 1.00000000000 BIT_MASK 0x2 FORMAT "%13.11" ECU_ADDRESS 0xF40B9 /end MEASUREMENT
/begin MEASUREMENT B_hsveemx2 "" UBYTE B_TRUE 1 100 0.00 1.00000000000 BIT_MASK 0x20 FORMAT "%13.11" ECU_ADDRESS 0xF40B9 /end MEASUREMENT
/begin MEASUREMENT B_hsveesi "" UBYTE B_TRUE 1 100 0.00 1.00000000000 BIT_MASK 0x4 FORMAT "%13.11" ECU_ADDRESS 0xF40B9 /end MEASUREMENT
/begin MEASUREMENT B_hsveesi2 "" UBYTE B_TRUE 1 100 0.00 1.00000000000 BIT_MASK 0x40 FORMAT "%13.11" ECU_ADDRESS 0xF40B9 /end MEASUREMENT
/begin MEASUREMENT B_imlkvse "" UBYTE B_TRUE 1 100 0.00 1.00000000000 BIT_MASK 0x2 FORMAT "%13.11" ECU_ADDRESS 0x382067 /end MEASUREMENT
/begin MEASUREMENT B_kathrdy "" UBYTE B_TRUE 1 100 0.00 1.00000000000 BIT_MASK 0x2 FORMAT "%13.11" ECU_ADDRESS 0x384006 /end MEASUREMENT
/begin MEASUREMENT B_katrdy "" UBYTE B_TRUE 1 100 0.00 1.00000000000 BIT_MASK 0x1 FORMAT "%13.11" ECU_ADDRESS 0x384006 /end MEASUREMENT
/begin MEASUREMENT B_kkrdy "" UBYTE B_TRUE 1 100 0.00 1.00000000000 BIT_MASK 0x10 FORMAT "%13.11" ECU_ADDRESS 0x384006 /end MEASUREMENT
/begin MEASUREMENT B_ks_1 "" UWORD B_TRUE 1 100 0.00 1.00000000000 BIT_MASK 0x1 FORMAT "%13.11" ECU_ADDRESS 0xF4594 /end MEASUREMENT
/begin MEASUREMENT B_kub "" UWORD B_TRUE 1 100 0.00 1.00000000000 BIT_MASK 0x10 FORMAT "%13.11" ECU_ADDRESS 0xF4594 /end MEASUREMENT
/begin MEASUREMENT B_kvsffl "" UWORD B_TRUE 1 100 0.00 1.00000000000 BIT_MASK 0x20 FORMAT "%13.11" ECU_ADDRESS 0xFD80 /end MEASUREMENT
/begin MEASUREMENT B_la "" UWORD B_TRUE 1 100 0.00 1.00000000000 BIT_MASK 0x20 FORMAT "%13.11" ECU_ADDRESS 0xF4594 /end MEASUREMENT
/begin MEASUREMENT B_lldia "" UWORD B_TRUE 1 100 0.00 1.00000000000 BIT_MASK 0x10 FORMAT "%13.11" ECU_ADDRESS 0xFDA2 /end MEASUREMENT
/begin MEASUREMENT B_lsrdy "" UBYTE B_TRUE 1 100 0.00 1.00000000000 BIT_MASK 0x20 FORMAT "%13.11" ECU_ADDRESS 0x384006 /end MEASUREMENT
/begin MEASUREMENT B_lsuabgl "" UBYTE B_TRUE 1 100 0.00 1.00000000000 BIT_MASK 0x40 FORMAT "%13.11" ECU_ADDRESS 0xF07B2 /end MEASUREMENT
/begin MEASUREMENT B_lsuabgl2 "" UBYTE B_TRUE 1 100 0.00 1.00000000000 BIT_MASK 0x80 FORMAT "%13.11" ECU_ADDRESS 0xF07B2 /end MEASUREMENT
/begin MEASUREMENT B_lsudip "" UBYTE B_TRUE 1 100 0.00 1.00000000000 BIT_MASK 0x1 FORMAT "%13.11" ECU_ADDRESS 0xF07B2 /end MEASUREMENT
/begin MEASUREMENT B_lsudip2 "" UBYTE B_TRUE 1 100 0.00 1.00000000000 BIT_MASK 0x2 FORMAT "%13.11" ECU_ADDRESS 0xF07B2 /end MEASUREMENT
/begin MEASUREMENT B_lsumxtk "" UBYTE B_TRUE 1 100 0.00 1.00000000000 BIT_MASK 0x2 FORMAT "%13.11" ECU_ADDRESS 0xF07B4 /end MEASUREMENT
/begin MEASUREMENT B_lsumxtk2 "" UBYTE B_TRUE 1 100 0.00 1.00000000000 BIT_MASK 0x2 FORMAT "%13.11" ECU_ADDRESS 0xF07B7 /end MEASUREMENT
/begin MEASUREMENT B_lsuna "" UBYTE B_TRUE 1 100 0.00 1.00000000000 BIT_MASK 0x1 FORMAT "%13.11" ECU_ADDRESS 0xF07B3 /end MEASUREMENT
/begin MEASUREMENT B_lsuna2 "" UBYTE B_TRUE 1 100 0.00 1.00000000000 BIT_MASK 0x2 FORMAT "%13.11" ECU_ADDRESS 0xF07B3 /end MEASUREMENT
/begin MEASUREMENT B_lsuocun "" UBYTE B_TRUE 1 100 0.00 1.00000000000 BIT_MASK 0x8 FORMAT "%13.11" ECU_ADDRESS 0xF07B4 /end MEASUREMENT
/begin MEASUREMENT B_lsuocun2 "" UBYTE B_TRUE 1 100 0.00 1.00000000000 BIT_MASK 0x8 FORMAT "%13.11" ECU_ADDRESS 0xF07B7 /end MEASUREMENT
/begin MEASUREMENT B_lsuocvm "" UWORD B_TRUE 1 100 0.00 1.00000000000 BIT_MASK 0x200 FORMAT "%13.11" ECU_ADDRESS 0xFD50 /end MEASUREMENT
/begin MEASUREMENT B_lsuocvm2 "" UWORD B_TRUE 1 100 0.00 1.00000000000 BIT_MASK 0x400 FORMAT "%13.11" ECU_ADDRESS 0xFD50 /end MEASUREMENT
/begin MEASUREMENT B_lsurih "" UBYTE B_TRUE 1 100 0.00 1.00000000000 BIT_MASK 0x10 FORMAT "%13.11" ECU_ADDRESS 0xF07B5 /end MEASUREMENT
/begin MEASUREMENT B_lsurih2 "" UBYTE B_TRUE 1 100 0.00 1.00000000000 BIT_MASK 0x40 FORMAT "%13.11" ECU_ADDRESS 0xF07B5 /end MEASUREMENT
/begin MEASUREMENT B_lsuumn "" UBYTE B_TRUE 1 100 0.00 1.00000000000 BIT_MASK 0x40 FORMAT "%13.11" ECU_ADDRESS 0xF07B6 /end MEASUREMENT
/begin MEASUREMENT B_lsuumn2 "" UBYTE B_TRUE 1 100 0.00 1.00000000000 BIT_MASK 0x80 FORMAT "%13.11" ECU_ADDRESS 0xF07B6 /end MEASUREMENT
/begin MEASUREMENT B_maxtemp "" UBYTE B_TRUE 1 100 0.00 1.00000000000 BIT_MASK 0x1 FORMAT "%13.11" ECU_ADDRESS 0xF088B /end MEASUREMENT
/begin MEASUREMENT B_maxtemp1 "" UBYTE B_TRUE 1 100 0.00 1.00000000000 BIT_MASK 0x8 FORMAT "%13.11" ECU_ADDRESS 0xF088B /end MEASUREMENT
/begin MEASUREMENT B_mintemp "" UBYTE B_TRUE 1 100 0.00 1.00000000000 BIT_MASK 0x2 FORMAT "%13.11" ECU_ADDRESS 0xF088B /end MEASUREMENT
/begin MEASUREMENT B_mintemp1 "" UBYTE B_TRUE 1 100 0.00 1.00000000000 BIT_MASK 0x10 FORMAT "%13.11" ECU_ADDRESS 0xF088B /end MEASUREMENT
/begin MEASUREMENT B_mnaatun "" UWORD B_TRUE 1 100 0.00 1.00000000000 BIT_MASK 0x200 FORMAT "%13.11" ECU_ADDRESS 0x382D32 /end MEASUREMENT
/begin MEASUREMENT B_mnasgnpl "" UWORD B_TRUE 1 100 0.00 1.00000000000 BIT_MASK 0x200 FORMAT "%13.11" ECU_ADDRESS 0x382D3A /end MEASUREMENT
/begin MEASUREMENT B_mnbrems "" UWORD B_TRUE 1 100 0.00 1.00000000000 BIT_MASK 0x200 FORMAT "%13.11" ECU_ADDRESS 0x382D42 /end MEASUREMENT
/begin MEASUREMENT B_mnbznpl "" UWORD B_TRUE 1 100 0.00 1.00000000000 BIT_MASK 0x200 FORMAT "%13.11" ECU_ADDRESS 0x382D44 /end MEASUREMENT
/begin MEASUREMENT B_mncairp "" UWORD B_TRUE 1 100 0.00 1.00000000000 BIT_MASK 0x200 FORMAT "%13.11" ECU_ADDRESS 0x382D48 /end MEASUREMENT
/begin MEASUREMENT B_mndsu "" UWORD B_TRUE 1 100 0.00 1.00000000000 BIT_MASK 0x200 FORMAT "%13.11" ECU_ADDRESS 0x382D6E /end MEASUREMENT
/begin MEASUREMENT B_mnegsbgr "" UWORD B_TRUE 1 100 0.00 1.00000000000 BIT_MASK 0x200 FORMAT "%13.11" ECU_ADDRESS 0x382D8C /end MEASUREMENT
/begin MEASUREMENT B_mnfhsh "" UBYTE B_TRUE 1 100 0.00 1.00000000000 BIT_MASK 0x4 FORMAT "%13.11" ECU_ADDRESS 0xF4053 /end MEASUREMENT
/begin MEASUREMENT B_mnfhsh2 "" UBYTE B_TRUE 1 100 0.00 1.00000000000 BIT_MASK 0x4 FORMAT "%13.11" ECU_ADDRESS 0xF4054 /end MEASUREMENT
/begin MEASUREMENT B_mnfku "" UWORD B_TRUE 1 100 0.00 1.00000000000 BIT_MASK 0x200 FORMAT "%13.11" ECU_ADDRESS 0x382DA0 /end MEASUREMENT
/begin MEASUREMENT B_mnfp1p "" UWORD B_TRUE 1 100 0.00 1.00000000000 BIT_MASK 0x200 FORMAT "%13.11" ECU_ADDRESS 0x382DA2 /end MEASUREMENT
/begin MEASUREMENT B_mnfp2p "" UWORD B_TRUE 1 100 0.00 1.00000000000 BIT_MASK 0x200 FORMAT "%13.11" ECU_ADDRESS 0x382DA4 /end MEASUREMENT
/begin MEASUREMENT B_mngrbh "" UWORD B_TRUE 1 100 0.00 1.00000000000 BIT_MASK 0x200 FORMAT "%13.11" ECU_ADDRESS 0x382DB4 /end MEASUREMENT
/begin MEASUREMENT B_mnhfmlm "" UBYTE B_TRUE 1 100 0.00 1.00000000000 BIT_MASK 0x2 FORMAT "%13.11" ECU_ADDRESS 0xF40C0 /end MEASUREMENT
/begin MEASUREMENT B_mnhre "" UWORD B_TRUE 1 100 0.00 1.00000000000 BIT_MASK 0x200 FORMAT "%13.11" ECU_ADDRESS 0x382DBA /end MEASUREMENT
/begin MEASUREMENT B_mnlshv "" UWORD B_TRUE 1 100 0.00 1.00000000000 BIT_MASK 0x200 FORMAT "%13.11" ECU_ADDRESS 0x382E04 /end MEASUREMENT
/begin MEASUREMENT B_mnma "" UWORD B_TRUE 1 100 0.00 1.00000000000 BIT_MASK 0x200 FORMAT "%13.11" ECU_ADDRESS 0x382E24 /end MEASUREMENT
/begin MEASUREMENT B_mnmdb "" UWORD B_TRUE 1 100 0.00 1.00000000000 BIT_MASK 0x200 FORMAT "%13.11" ECU_ADDRESS 0x382E34 /end MEASUREMENT
/begin MEASUREMENT B_mnmld "" UWORD B_TRUE 1 100 0.00 1.00000000000 BIT_MASK 0x2 FORMAT "%13.11" ECU_ADDRESS 0xFD6C /end MEASUREMENT
/begin MEASUREMENT B_mnpwgde "" UWORD B_TRUE 1 100 0.00 1.00000000000 BIT_MASK 0x200 FORMAT "%13.11" ECU_ADDRESS 0x382E48 /end MEASUREMENT
/begin MEASUREMENT B_mnscr "" UWORD B_TRUE 1 100 0.00 1.00000000000 BIT_MASK 0x200 FORMAT "%13.11" ECU_ADDRESS 0x382E52 /end MEASUREMENT
/begin MEASUREMENT B_mnsgeew "" UWORD B_TRUE 1 100 0.00 1.00000000000 BIT_MASK 0x200 FORMAT "%13.11" ECU_ADDRESS 0x382E56 /end MEASUREMENT
/begin MEASUREMENT B_mnta "" UWORD B_TRUE 1 100 0.00 1.00000000000 BIT_MASK 0x200 FORMAT "%13.11" ECU_ADDRESS 0x382E68 /end MEASUREMENT
/begin MEASUREMENT B_mntka "" UWORD B_TRUE 1 100 0.00 1.00000000000 BIT_MASK 0x200 FORMAT "%13.11" ECU_ADDRESS 0x382E76 /end MEASUREMENT
/begin MEASUREMENT B_mntm "" UWORD B_TRUE 1 100 0.00 1.00000000000 BIT_MASK 0x200 FORMAT "%13.11" ECU_ADDRESS 0x382E78 /end MEASUREMENT
/begin MEASUREMENT B_mntmki "" UWORD B_TRUE 1 100 0.00 1.00000000000 BIT_MASK 0x200 FORMAT "%13.11" ECU_ADDRESS 0x382E7A /end MEASUREMENT
/begin MEASUREMENT B_mnub "" UWORD B_TRUE 1 100 0.00 1.00000000000 BIT_MASK 0x200 FORMAT "%13.11" ECU_ADDRESS 0x382E80 /end MEASUREMENT
/begin MEASUREMENT B_mnubr "" UWORD B_TRUE 1 100 0.00 1.00000000000 BIT_MASK 0x200 FORMAT "%13.11" ECU_ADDRESS 0x382E82 /end MEASUREMENT
/begin MEASUREMENT B_mnwfs "" UWORD B_TRUE 1 100 0.00 1.00000000000 BIT_MASK 0x200 FORMAT "%13.11" ECU_ADDRESS 0x382E9E /end MEASUREMENT
/begin MEASUREMENT B_mnwfsrc "" UWORD B_TRUE 1 100 0.00 1.00000000000 BIT_MASK 0x200 FORMAT "%13.11" ECU_ADDRESS 0x382EA0 /end MEASUREMENT
/begin MEASUREMENT B_mxaatun "" UWORD B_TRUE 1 100 0.00 1.00000000000 BIT_MASK 0x100 FORMAT "%13.11" ECU_ADDRESS 0x382D32 /end MEASUREMENT
/begin MEASUREMENT B_mxasgnpl "" UWORD B_TRUE 1 100 0.00 1.00000000000 BIT_MASK 0x100 FORMAT "%13.11" ECU_ADDRESS 0x382D3A /end MEASUREMENT
/begin MEASUREMENT B_mxbrems "" UWORD B_TRUE 1 100 0.00 1.00000000000 BIT_MASK 0x100 FORMAT "%13.11" ECU_ADDRESS 0x382D42 /end MEASUREMENT
/begin MEASUREMENT B_mxbznpl "" UWORD B_TRUE 1 100 0.00 1.00000000000 BIT_MASK 0x100 FORMAT "%13.11" ECU_ADDRESS 0x382D44 /end MEASUREMENT
/begin MEASUREMENT B_mxcairp "" UWORD B_TRUE 1 100 0.00 1.00000000000 BIT_MASK 0x100 FORMAT "%13.11" ECU_ADDRESS 0x382D48 /end MEASUREMENT
/begin MEASUREMENT B_mxdsu "" UWORD B_TRUE 1 100 0.00 1.00000000000 BIT_MASK 0x100 FORMAT "%13.11" ECU_ADDRESS 0x382D6E /end MEASUREMENT
/begin MEASUREMENT B_mxegsbgr "" UWORD B_TRUE 1 100 0.00 1.00000000000 BIT_MASK 0x100 FORMAT "%13.11" ECU_ADDRESS 0x382D8C /end MEASUREMENT
/begin MEASUREMENT B_mxfhsh "" UBYTE B_TRUE 1 100 0.00 1.00000000000 BIT_MASK 0x2 FORMAT "%13.11" ECU_ADDRESS 0xF4053 /end MEASUREMENT
/begin MEASUREMENT B_mxfhsh2 "" UBYTE B_TRUE 1 100 0.00 1.00000000000 BIT_MASK 0x2 FORMAT "%13.11" ECU_ADDRESS 0xF4054 /end MEASUREMENT
/begin MEASUREMENT B_mxfku "" UWORD B_TRUE 1 100 0.00 1.00000000000 BIT_MASK 0x100 FORMAT "%13.11" ECU_ADDRESS 0x382DA0 /end MEASUREMENT
/begin MEASUREMENT B_mxfp1p "" UWORD B_TRUE 1 100 0.00 1.00000000000 BIT_MASK 0x100 FORMAT "%13.11" ECU_ADDRESS 0x382DA2 /end MEASUREMENT
/begin MEASUREMENT B_mxfp2p "" UWORD B_TRUE 1 100 0.00 1.00000000000 BIT_MASK 0x100 FORMAT "%13.11" ECU_ADDRESS 0x382DA4 /end MEASUREMENT
/begin MEASUREMENT B_mxgrbh "" UWORD B_TRUE 1 100 0.00 1.00000000000 BIT_MASK 0x100 FORMAT "%13.11" ECU_ADDRESS 0x382DB4 /end MEASUREMENT
/begin MEASUREMENT B_mxhfmlm "" UBYTE B_TRUE 1 100 0.00 1.00000000000 BIT_MASK 0x4 FORMAT "%13.11" ECU_ADDRESS 0xF40C0 /end MEASUREMENT
/begin MEASUREMENT B_mxhre "" UWORD B_TRUE 1 100 0.00 1.00000000000 BIT_MASK 0x100 FORMAT "%13.11" ECU_ADDRESS 0x382DBA /end MEASUREMENT
/begin MEASUREMENT B_mxlshv "" UWORD B_TRUE 1 100 0.00 1.00000000000 BIT_MASK 0x100 FORMAT "%13.11" ECU_ADDRESS 0x382E04 /end MEASUREMENT
/begin MEASUREMENT B_mxma "" UWORD B_TRUE 1 100 0.00 1.00000000000 BIT_MASK 0x100 FORMAT "%13.11" ECU_ADDRESS 0x382E24 /end MEASUREMENT
/begin MEASUREMENT B_mxmdb "" UWORD B_TRUE 1 100 0.00 1.00000000000 BIT_MASK 0x100 FORMAT "%13.11" ECU_ADDRESS 0x382E34 /end MEASUREMENT
/begin MEASUREMENT B_mxmld "" UWORD B_TRUE 1 100 0.00 1.00000000000 BIT_MASK 0x4 FORMAT "%13.11" ECU_ADDRESS 0xFD6C /end MEASUREMENT
/begin MEASUREMENT B_mxpwgde "" UWORD B_TRUE 1 100 0.00 1.00000000000 BIT_MASK 0x100 FORMAT "%13.11" ECU_ADDRESS 0x382E48 /end MEASUREMENT
/begin MEASUREMENT B_mxscr "" UWORD B_TRUE 1 100 0.00 1.00000000000 BIT_MASK 0x100 FORMAT "%13.11" ECU_ADDRESS 0x382E52 /end MEASUREMENT
/begin MEASUREMENT B_mxsgeew "" UWORD B_TRUE 1 100 0.00 1.00000000000 BIT_MASK 0x100 FORMAT "%13.11" ECU_ADDRESS 0x382E56 /end MEASUREMENT
/begin MEASUREMENT B_mxta "" UWORD B_TRUE 1 100 0.00 1.00000000000 BIT_MASK 0x100 FORMAT "%13.11" ECU_ADDRESS 0x382E68 /end MEASUREMENT
/begin MEASUREMENT B_mxtka "" UWORD B_TRUE 1 100 0.00 1.00000000000 BIT_MASK 0x100 FORMAT "%13.11" ECU_ADDRESS 0x382E76 /end MEASUREMENT
/begin MEASUREMENT B_mxtm "" UWORD B_TRUE 1 100 0.00 1.00000000000 BIT_MASK 0x100 FORMAT "%13.11" ECU_ADDRESS 0x382E78 /end MEASUREMENT
/begin MEASUREMENT B_mxtmki "" UWORD B_TRUE 1 100 0.00 1.00000000000 BIT_MASK 0x100 FORMAT "%13.11" ECU_ADDRESS 0x382E7A /end MEASUREMENT
/begin MEASUREMENT B_mxub "" UWORD B_TRUE 1 100 0.00 1.00000000000 BIT_MASK 0x100 FORMAT "%13.11" ECU_ADDRESS 0x382E80 /end MEASUREMENT
/begin MEASUREMENT B_mxubr "" UWORD B_TRUE 1 100 0.00 1.00000000000 BIT_MASK 0x100 FORMAT "%13.11" ECU_ADDRESS 0x382E82 /end MEASUREMENT
/begin MEASUREMENT B_mxwfs "" UWORD B_TRUE 1 100 0.00 1.00000000000 BIT_MASK 0x100 FORMAT "%13.11" ECU_ADDRESS 0x382E9E /end MEASUREMENT
/begin MEASUREMENT B_mxwfsrc "" UWORD B_TRUE 1 100 0.00 1.00000000000 BIT_MASK 0x100 FORMAT "%13.11" ECU_ADDRESS 0x382EA0 /end MEASUREMENT
/begin MEASUREMENT B_norkam "" UWORD B_TRUE 1 100 0.00 1.00000000000 BIT_MASK 0x40 FORMAT "%13.11" ECU_ADDRESS 0xFD80 /end MEASUREMENT
/begin MEASUREMENT B_npaatun "" UWORD B_TRUE 1 100 0.00 1.00000000000 BIT_MASK 0x800 FORMAT "%13.11" ECU_ADDRESS 0x382D32 /end MEASUREMENT
/begin MEASUREMENT B_npasgnpl "" UWORD B_TRUE 1 100 0.00 1.00000000000 BIT_MASK 0x800 FORMAT "%13.11" ECU_ADDRESS 0x382D3A /end MEASUREMENT
/begin MEASUREMENT B_npbrems "" UWORD B_TRUE 1 100 0.00 1.00000000000 BIT_MASK 0x800 FORMAT "%13.11" ECU_ADDRESS 0x382D42 /end MEASUREMENT
/begin MEASUREMENT B_npbznpl "" UWORD B_TRUE 1 100 0.00 1.00000000000 BIT_MASK 0x800 FORMAT "%13.11" ECU_ADDRESS 0x382D44 /end MEASUREMENT
/begin MEASUREMENT B_npcairp "" UWORD B_TRUE 1 100 0.00 1.00000000000 BIT_MASK 0x800 FORMAT "%13.11" ECU_ADDRESS 0x382D48 /end MEASUREMENT
/begin MEASUREMENT B_npdsu "" UWORD B_TRUE 1 100 0.00 1.00000000000 BIT_MASK 0x800 FORMAT "%13.11" ECU_ADDRESS 0x382D6E /end MEASUREMENT
/begin MEASUREMENT B_npegsbgr "" UWORD B_TRUE 1 100 0.00 1.00000000000 BIT_MASK 0x800 FORMAT "%13.11" ECU_ADDRESS 0x382D8C /end MEASUREMENT
/begin MEASUREMENT B_npfhsh "" UBYTE B_TRUE 1 100 0.00 1.00000000000 BIT_MASK 0x10 FORMAT "%13.11" ECU_ADDRESS 0xF4053 /end MEASUREMENT
/begin MEASUREMENT B_npfhsh2 "" UBYTE B_TRUE 1 100 0.00 1.00000000000 BIT_MASK 0x10 FORMAT "%13.11" ECU_ADDRESS 0xF4054 /end MEASUREMENT
/begin MEASUREMENT B_npfku "" UWORD B_TRUE 1 100 0.00 1.00000000000 BIT_MASK 0x800 FORMAT "%13.11" ECU_ADDRESS 0x382DA0 /end MEASUREMENT
/begin MEASUREMENT B_npfp1p "" UWORD B_TRUE 1 100 0.00 1.00000000000 BIT_MASK 0x800 FORMAT "%13.11" ECU_ADDRESS 0x382DA2 /end MEASUREMENT
/begin MEASUREMENT B_npfp2p "" UWORD B_TRUE 1 100 0.00 1.00000000000 BIT_MASK 0x800 FORMAT "%13.11" ECU_ADDRESS 0x382DA4 /end MEASUREMENT
/begin MEASUREMENT B_npgrbh "" UWORD B_TRUE 1 100 0.00 1.00000000000 BIT_MASK 0x800 FORMAT "%13.11" ECU_ADDRESS 0x382DB4 /end MEASUREMENT
/begin MEASUREMENT B_nphealh "" UBYTE B_TRUE 1 100 0.00 1.00000000000 BIT_MASK 0x80 FORMAT "%13.11" ECU_ADDRESS 0xF4053 /end MEASUREMENT
/begin MEASUREMENT B_nphealh2 "" UBYTE B_TRUE 1 100 0.00 1.00000000000 BIT_MASK 0x80 FORMAT "%13.11" ECU_ADDRESS 0xF4054 /end MEASUREMENT
/begin MEASUREMENT B_nphre "" UWORD B_TRUE 1 100 0.00 1.00000000000 BIT_MASK 0x800 FORMAT "%13.11" ECU_ADDRESS 0x382DBA /end MEASUREMENT
/begin MEASUREMENT B_nplhfmlm "" UBYTE B_TRUE 1 100 0.00 1.00000000000 BIT_MASK 0x8 FORMAT "%13.11" ECU_ADDRESS 0xF40C0 /end MEASUREMENT
/begin MEASUREMENT B_nplshv "" UWORD B_TRUE 1 100 0.00 1.00000000000 BIT_MASK 0x800 FORMAT "%13.11" ECU_ADDRESS 0x382E04 /end MEASUREMENT
/begin MEASUREMENT B_npma "" UWORD B_TRUE 1 100 0.00 1.00000000000 BIT_MASK 0x800 FORMAT "%13.11" ECU_ADDRESS 0x382E24 /end MEASUREMENT
/begin MEASUREMENT B_npmdb "" UWORD B_TRUE 1 100 0.00 1.00000000000 BIT_MASK 0x800 FORMAT "%13.11" ECU_ADDRESS 0x382E34 /end MEASUREMENT
/begin MEASUREMENT B_nppwgde "" UWORD B_TRUE 1 100 0.00 1.00000000000 BIT_MASK 0x800 FORMAT "%13.11" ECU_ADDRESS 0x382E48 /end MEASUREMENT
/begin MEASUREMENT B_npscr "" UWORD B_TRUE 1 100 0.00 1.00000000000 BIT_MASK 0x800 FORMAT "%13.11" ECU_ADDRESS 0x382E52 /end MEASUREMENT
/begin MEASUREMENT B_npsgeew "" UWORD B_TRUE 1 100 0.00 1.00000000000 BIT_MASK 0x800 FORMAT "%13.11" ECU_ADDRESS 0x382E56 /end MEASUREMENT
/begin MEASUREMENT B_npsna "" UBYTE B_TRUE 1 100 0.00 1.00000000000 BIT_MASK 0x4 FORMAT "%13.11" ECU_ADDRESS 0xF07B3 /end MEASUREMENT
/begin MEASUREMENT B_npsna2 "" UBYTE B_TRUE 1 100 0.00 1.00000000000 BIT_MASK 0x8 FORMAT "%13.11" ECU_ADDRESS 0xF07B3 /end MEASUREMENT
/begin MEASUREMENT B_npta "" UWORD B_TRUE 1 100 0.00 1.00000000000 BIT_MASK 0x800 FORMAT "%13.11" ECU_ADDRESS 0x382E68 /end MEASUREMENT
/begin MEASUREMENT B_nptka "" UWORD B_TRUE 1 100 0.00 1.00000000000 BIT_MASK 0x800 FORMAT "%13.11" ECU_ADDRESS 0x382E76 /end MEASUREMENT
/begin MEASUREMENT B_nptm "" UWORD B_TRUE 1 100 0.00 1.00000000000 BIT_MASK 0x800 FORMAT "%13.11" ECU_ADDRESS 0x382E78 /end MEASUREMENT
/begin MEASUREMENT B_nptmki "" UWORD B_TRUE 1 100 0.00 1.00000000000 BIT_MASK 0x800 FORMAT "%13.11" ECU_ADDRESS 0x382E7A /end MEASUREMENT
/begin MEASUREMENT B_npub "" UWORD B_TRUE 1 100 0.00 1.00000000000 BIT_MASK 0x800 FORMAT "%13.11" ECU_ADDRESS 0x382E80 /end MEASUREMENT
/begin MEASUREMENT B_npubr "" UWORD B_TRUE 1 100 0.00 1.00000000000 BIT_MASK 0x800 FORMAT "%13.11" ECU_ADDRESS 0x382E82 /end MEASUREMENT
/begin MEASUREMENT B_npwfs "" UWORD B_TRUE 1 100 0.00 1.00000000000 BIT_MASK 0x800 FORMAT "%13.11" ECU_ADDRESS 0x382E9E /end MEASUREMENT
/begin MEASUREMENT B_npwfsrc "" UWORD B_TRUE 1 100 0.00 1.00000000000 BIT_MASK 0x800 FORMAT "%13.11" ECU_ADDRESS 0x382EA0 /end MEASUREMENT
/begin MEASUREMENT B_ocipll "" UBYTE B_TRUE 1 100 0.00 1.00000000000 BIT_MASK 0x4 FORMAT "%13.11" ECU_ADDRESS 0xF07B6 /end MEASUREMENT
/begin MEASUREMENT B_ocipll2 "" UBYTE B_TRUE 1 100 0.00 1.00000000000 BIT_MASK 0x8 FORMAT "%13.11" ECU_ADDRESS 0xF07B6 /end MEASUREMENT
/begin MEASUREMENT B_plra "" UWORD B_TRUE 1 100 0.00 1.00000000000 BIT_MASK 0x80 FORMAT "%13.11" ECU_ADDRESS 0xFD80 /end MEASUREMENT
/begin MEASUREMENT B_pytmki "" UWORD B_TRUE 1 100 0.00 1.00000000000 BIT_MASK 0x2000 FORMAT "%13.11" ECU_ADDRESS 0x382E7A /end MEASUREMENT
/begin MEASUREMENT B_rdyagr "" UBYTE B_TRUE 1 100 0.00 1.00000000000 BIT_MASK 0x1 FORMAT "%13.11" ECU_ADDRESS 0x384007 /end MEASUREMENT
/begin MEASUREMENT B_rdyhs "" UBYTE B_TRUE 1 100 0.00 1.00000000000 BIT_MASK 0x1 FORMAT "%13.11" ECU_ADDRESS 0x384009 /end MEASUREMENT
/begin MEASUREMENT B_rdykat "" UBYTE B_TRUE 1 100 0.00 1.00000000000 BIT_MASK 0x1 FORMAT "%13.11" ECU_ADDRESS 0x38400B /end MEASUREMENT
/begin MEASUREMENT B_rdyls "" UBYTE B_TRUE 1 100 0.00 1.00000000000 BIT_MASK 0x1 FORMAT "%13.11" ECU_ADDRESS 0x38400D /end MEASUREMENT
/begin MEASUREMENT B_rdysls "" UBYTE B_TRUE 1 100 0.00 1.00000000000 BIT_MASK 0x1 FORMAT "%13.11" ECU_ADDRESS 0x38400F /end MEASUREMENT
/begin MEASUREMENT B_rdytes "" UBYTE B_TRUE 1 100 0.00 1.00000000000 BIT_MASK 0x1 FORMAT "%13.11" ECU_ADDRESS 0x384010 /end MEASUREMENT
/begin MEASUREMENT B_rdytev "" UBYTE B_TRUE 1 100 0.00 1.00000000000 BIT_MASK 0x1 FORMAT "%13.11" ECU_ADDRESS 0x384011 /end MEASUREMENT
/begin MEASUREMENT B_reocvm "" UBYTE B_TRUE 1 100 0.00 1.00000000000 BIT_MASK 0x1 FORMAT "%13.11" ECU_ADDRESS 0xF07B5 /end MEASUREMENT
/begin MEASUREMENT B_reocvm2 "" UBYTE B_TRUE 1 100 0.00 1.00000000000 BIT_MASK 0x1 FORMAT "%13.11" ECU_ADDRESS 0xF07B7 /end MEASUREMENT
/begin MEASUREMENT B_ricalf "" UBYTE B_TRUE 1 100 0.00 1.00000000000 BIT_MASK 0x4 FORMAT "%13.11" ECU_ADDRESS 0xF0783 /end MEASUREMENT
/begin MEASUREMENT B_ricalf2 "" UBYTE B_TRUE 1 100 0.00 1.00000000000 BIT_MASK 0x8 FORMAT "%13.11" ECU_ADDRESS 0xF0783 /end MEASUREMENT
/begin MEASUREMENT B_rierrh "" UBYTE B_TRUE 1 100 0.00 1.00000000000 BIT_MASK 0x40 FORMAT "%13.11" ECU_ADDRESS 0xF4053 /end MEASUREMENT
/begin MEASUREMENT B_rierrh2 "" UBYTE B_TRUE 1 100 0.00 1.00000000000 BIT_MASK 0x40 FORMAT "%13.11" ECU_ADDRESS 0xF4054 /end MEASUREMENT
/begin MEASUREMENT B_rinnp "" UBYTE B_TRUE 1 100 0.00 1.00000000000 BIT_MASK 0x1 FORMAT "%13.11" ECU_ADDRESS 0xF0784 /end MEASUREMENT
/begin MEASUREMENT B_rinnp2 "" UBYTE B_TRUE 1 100 0.00 1.00000000000 BIT_MASK 0x1 FORMAT "%13.11" ECU_ADDRESS 0xF0785 /end MEASUREMENT
/begin MEASUREMENT B_rkam "" UWORD B_TRUE 1 100 0.00 1.00000000000 BIT_MASK 0x100 FORMAT "%13.11" ECU_ADDRESS 0xFD80 /end MEASUREMENT
/begin MEASUREMENT B_rkamr "" UWORD B_TRUE 1 100 0.00 1.00000000000 BIT_MASK 0x200 FORMAT "%13.11" ECU_ADDRESS 0xFD80 /end MEASUREMENT
/begin MEASUREMENT B_rkamr2 "" UWORD B_TRUE 1 100 0.00 1.00000000000 BIT_MASK 0x400 FORMAT "%13.11" ECU_ADDRESS 0xFD80 /end MEASUREMENT
/begin MEASUREMENT B_sctmki "" UWORD B_TRUE 1 100 0.00 1.00000000000 BIT_MASK 0x4000 FORMAT "%13.11" ECU_ADDRESS 0x382E7A /end MEASUREMENT
/begin MEASUREMENT B_shab "" UBYTE B_TRUE 1 100 0.00 1.00000000000 BIT_MASK 0x4 FORMAT "%13.11" ECU_ADDRESS 0xF4055 /end MEASUREMENT
/begin MEASUREMENT B_shab2 "" UBYTE B_TRUE 1 100 0.00 1.00000000000 BIT_MASK 0x4 FORMAT "%13.11" ECU_ADDRESS 0xF4056 /end MEASUREMENT
/begin MEASUREMENT B_siaatun "" UWORD B_TRUE 1 100 0.00 1.00000000000 BIT_MASK 0x400 FORMAT "%13.11" ECU_ADDRESS 0x382D32 /end MEASUREMENT
/begin MEASUREMENT B_siasgnpl "" UWORD B_TRUE 1 100 0.00 1.00000000000 BIT_MASK 0x400 FORMAT "%13.11" ECU_ADDRESS 0x382D3A /end MEASUREMENT
/begin MEASUREMENT B_sibrems "" UWORD B_TRUE 1 100 0.00 1.00000000000 BIT_MASK 0x400 FORMAT "%13.11" ECU_ADDRESS 0x382D42 /end MEASUREMENT
/begin MEASUREMENT B_sibznpl "" UWORD B_TRUE 1 100 0.00 1.00000000000 BIT_MASK 0x400 FORMAT "%13.11" ECU_ADDRESS 0x382D44 /end MEASUREMENT
/begin MEASUREMENT B_sicairp "" UWORD B_TRUE 1 100 0.00 1.00000000000 BIT_MASK 0x400 FORMAT "%13.11" ECU_ADDRESS 0x382D48 /end MEASUREMENT
/begin MEASUREMENT B_sidsu "" UWORD B_TRUE 1 100 0.00 1.00000000000 BIT_MASK 0x400 FORMAT "%13.11" ECU_ADDRESS 0x382D6E /end MEASUREMENT
/begin MEASUREMENT B_siegsbgr "" UWORD B_TRUE 1 100 0.00 1.00000000000 BIT_MASK 0x400 FORMAT "%13.11" ECU_ADDRESS 0x382D8C /end MEASUREMENT
/begin MEASUREMENT B_sifhsh "" UBYTE B_TRUE 1 100 0.00 1.00000000000 BIT_MASK 0x8 FORMAT "%13.11" ECU_ADDRESS 0xF4053 /end MEASUREMENT
/begin MEASUREMENT B_sifhsh2 "" UBYTE B_TRUE 1 100 0.00 1.00000000000 BIT_MASK 0x8 FORMAT "%13.11" ECU_ADDRESS 0xF4054 /end MEASUREMENT
/begin MEASUREMENT B_sifku "" UWORD B_TRUE 1 100 0.00 1.00000000000 BIT_MASK 0x400 FORMAT "%13.11" ECU_ADDRESS 0x382DA0 /end MEASUREMENT
/begin MEASUREMENT B_sifp1p "" UWORD B_TRUE 1 100 0.00 1.00000000000 BIT_MASK 0x400 FORMAT "%13.11" ECU_ADDRESS 0x382DA2 /end MEASUREMENT
/begin MEASUREMENT B_sifp2p "" UWORD B_TRUE 1 100 0.00 1.00000000000 BIT_MASK 0x400 FORMAT "%13.11" ECU_ADDRESS 0x382DA4 /end MEASUREMENT
/begin MEASUREMENT B_sigrbh "" UWORD B_TRUE 1 100 0.00 1.00000000000 BIT_MASK 0x400 FORMAT "%13.11" ECU_ADDRESS 0x382DB4 /end MEASUREMENT
/begin MEASUREMENT B_sigtemp "" UBYTE B_TRUE 1 100 0.00 1.00000000000 BIT_MASK 0x4 FORMAT "%13.11" ECU_ADDRESS 0xF088B /end MEASUREMENT
/begin MEASUREMENT B_sigtemp1 "" UBYTE B_TRUE 1 100 0.00 1.00000000000 BIT_MASK 0x20 FORMAT "%13.11" ECU_ADDRESS 0xF088B /end MEASUREMENT
/begin MEASUREMENT B_sihre "" UWORD B_TRUE 1 100 0.00 1.00000000000 BIT_MASK 0x400 FORMAT "%13.11" ECU_ADDRESS 0x382DBA /end MEASUREMENT
/begin MEASUREMENT B_silshv "" UWORD B_TRUE 1 100 0.00 1.00000000000 BIT_MASK 0x400 FORMAT "%13.11" ECU_ADDRESS 0x382E04 /end MEASUREMENT
/begin MEASUREMENT B_sima "" UWORD B_TRUE 1 100 0.00 1.00000000000 BIT_MASK 0x400 FORMAT "%13.11" ECU_ADDRESS 0x382E24 /end MEASUREMENT
/begin MEASUREMENT B_simdb "" UWORD B_TRUE 1 100 0.00 1.00000000000 BIT_MASK 0x400 FORMAT "%13.11" ECU_ADDRESS 0x382E34 /end MEASUREMENT
/begin MEASUREMENT B_sipwgde "" UWORD B_TRUE 1 100 0.00 1.00000000000 BIT_MASK 0x400 FORMAT "%13.11" ECU_ADDRESS 0x382E48 /end MEASUREMENT
/begin MEASUREMENT B_siscr "" UWORD B_TRUE 1 100 0.00 1.00000000000 BIT_MASK 0x400 FORMAT "%13.11" ECU_ADDRESS 0x382E52 /end MEASUREMENT
/begin MEASUREMENT B_sisgeew "" UWORD B_TRUE 1 100 0.00 1.00000000000 BIT_MASK 0x400 FORMAT "%13.11" ECU_ADDRESS 0x382E56 /end MEASUREMENT
/begin MEASUREMENT B_sita "" UWORD B_TRUE 1 100 0.00 1.00000000000 BIT_MASK 0x400 FORMAT "%13.11" ECU_ADDRESS 0x382E68 /end MEASUREMENT
/begin MEASUREMENT B_sitka "" UWORD B_TRUE 1 100 0.00 1.00000000000 BIT_MASK 0x400 FORMAT "%13.11" ECU_ADDRESS 0x382E76 /end MEASUREMENT
/begin MEASUREMENT B_sitm "" UWORD B_TRUE 1 100 0.00 1.00000000000 BIT_MASK 0x400 FORMAT "%13.11" ECU_ADDRESS 0x382E78 /end MEASUREMENT
/begin MEASUREMENT B_sitmki "" UWORD B_TRUE 1 100 0.00 1.00000000000 BIT_MASK 0x400 FORMAT "%13.11" ECU_ADDRESS 0x382E7A /end MEASUREMENT
/begin MEASUREMENT B_siub "" UWORD B_TRUE 1 100 0.00 1.00000000000 BIT_MASK 0x400 FORMAT "%13.11" ECU_ADDRESS 0x382E80 /end MEASUREMENT
/begin MEASUREMENT B_siubr "" UWORD B_TRUE 1 100 0.00 1.00000000000 BIT_MASK 0x400 FORMAT "%13.11" ECU_ADDRESS 0x382E82 /end MEASUREMENT
/begin MEASUREMENT B_siwfs "" UWORD B_TRUE 1 100 0.00 1.00000000000 BIT_MASK 0x400 FORMAT "%13.11" ECU_ADDRESS 0x382E9E /end MEASUREMENT
/begin MEASUREMENT B_siwfsrc "" UWORD B_TRUE 1 100 0.00 1.00000000000 BIT_MASK 0x400 FORMAT "%13.11" ECU_ADDRESS 0x382EA0 /end MEASUREMENT
/begin MEASUREMENT B_slsrdy "" UBYTE B_TRUE 1 100 0.00 1.00000000000 BIT_MASK 0x8 FORMAT "%13.11" ECU_ADDRESS 0x384006 /end MEASUREMENT
/begin MEASUREMENT B_spdhrub "" UBYTE B_TRUE 1 100 0.00 1.00000000000 BIT_MASK 0x8 FORMAT "%13.11" ECU_ADDRESS 0xF0784 /end MEASUREMENT
/begin MEASUREMENT B_spf3k "" UBYTE B_TRUE 1 100 0.00 1.00000000000 BIT_MASK 0x8 FORMAT "%13.11" ECU_ADDRESS 0xF07B1 /end MEASUREMENT
/begin MEASUREMENT B_spf3k2 "" UBYTE B_TRUE 1 100 0.00 1.00000000000 BIT_MASK 0x80 FORMAT "%13.11" ECU_ADDRESS 0xF07B1 /end MEASUREMENT
/begin MEASUREMENT B_szkat "" UBYTE B_TRUE 1 100 0.00 1.00000000000 BIT_MASK 0x8 FORMAT "%13.11" ECU_ADDRESS 0xF0799 /end MEASUREMENT
/begin MEASUREMENT B_szkat2 "" UBYTE B_TRUE 1 100 0.00 1.00000000000 BIT_MASK 0x8 FORMAT "%13.11" ECU_ADDRESS 0xF079A /end MEASUREMENT
/begin MEASUREMENT B_tahrmn "" UBYTE B_TRUE 1 100 0.00 1.00000000000 BIT_MASK 0x2 FORMAT "%13.11" ECU_ADDRESS 0xF0784 /end MEASUREMENT
/begin MEASUREMENT B_tahrmn2 "" UBYTE B_TRUE 1 100 0.00 1.00000000000 BIT_MASK 0x2 FORMAT "%13.11" ECU_ADDRESS 0xF0785 /end MEASUREMENT
/begin MEASUREMENT B_tahrmx "" UBYTE B_TRUE 1 100 0.00 1.00000000000 BIT_MASK 0x4 FORMAT "%13.11" ECU_ADDRESS 0xF0784 /end MEASUREMENT
/begin MEASUREMENT B_tahrmx2 "" UBYTE B_TRUE 1 100 0.00 1.00000000000 BIT_MASK 0x4 FORMAT "%13.11" ECU_ADDRESS 0xF0785 /end MEASUREMENT
/begin MEASUREMENT B_tesrdy "" UBYTE B_TRUE 1 100 0.00 1.00000000000 BIT_MASK 0x4 FORMAT "%13.11" ECU_ADDRESS 0x384006 /end MEASUREMENT
/begin MEASUREMENT B_tkatmn "" UBYTE B_TRUE 1 100 0.00 1.00000000000 BIT_MASK 0x4 FORMAT "%13.11" ECU_ADDRESS 0xF079C /end MEASUREMENT
/begin MEASUREMENT B_tkatmn2 "" UBYTE B_TRUE 1 100 0.00 1.00000000000 BIT_MASK 0x4 FORMAT "%13.11" ECU_ADDRESS 0xF079D /end MEASUREMENT
/begin MEASUREMENT B_tkukd "" UBYTE B_TRUE 1 100 0.00 1.00000000000 BIT_MASK 0x4 FORMAT "%13.11" ECU_ADDRESS 0xF079B /end MEASUREMENT
/begin MEASUREMENT B_toggle "" UWORD B_TRUE 1 100 0.00 1.00000000000 BIT_MASK 0x4 FORMAT "%13.11" ECU_ADDRESS 0xFD68 /end MEASUREMENT
/begin MEASUREMENT B_trig "" UBYTE B_TRUE 1 100 0.00 1.00000000000 BIT_MASK 0x2 FORMAT "%13.11" ECU_ADDRESS 0xF079B /end MEASUREMENT
/begin MEASUREMENT B_trig2 "" UBYTE B_TRUE 1 100 0.00 1.00000000000 BIT_MASK 0x20 FORMAT "%13.11" ECU_ADDRESS 0xF079B /end MEASUREMENT
/begin MEASUREMENT B_ubok "" UBYTE B_TRUE 1 100 0.00 1.00000000000 BIT_MASK 0x1 FORMAT "%13.11" ECU_ADDRESS 0xF4055 /end MEASUREMENT
/begin MEASUREMENT B_ubok2 "" UBYTE B_TRUE 1 100 0.00 1.00000000000 BIT_MASK 0x1 FORMAT "%13.11" ECU_ADDRESS 0xF4056 /end MEASUREMENT
/begin MEASUREMENT B_vegkat "" UBYTE B_TRUE 1 100 0.00 1.00000000000 BIT_MASK 0x1 FORMAT "%13.11" ECU_ADDRESS 0xF079C /end MEASUREMENT
/begin MEASUREMENT B_vegkat2 "" UBYTE B_TRUE 1 100 0.00 1.00000000000 BIT_MASK 0x1 FORMAT "%13.11" ECU_ADDRESS 0xF079D /end MEASUREMENT
/begin MEASUREMENT B_vekat "" UBYTE B_TRUE 1 100 0.00 1.00000000000 BIT_MASK 0x1 FORMAT "%13.11" ECU_ADDRESS 0x382050 /end MEASUREMENT
/begin MEASUREMENT B_vekat2 "" UBYTE B_TRUE 1 100 0.00 1.00000000000 BIT_MASK 0x2 FORMAT "%13.11" ECU_ADDRESS 0x382050 /end MEASUREMENT
/begin MEASUREMENT B_zfrao "" UBYTE B_TRUE 1 100 0.00 1.00000000000 BIT_MASK 0x4 FORMAT "%13.11" ECU_ADDRESS 0xF40FC /end MEASUREMENT
/begin MEASUREMENT B_zfrao2 "" UBYTE B_TRUE 1 100 0.00 1.00000000000 BIT_MASK 0x80 FORMAT "%13.11" ECU_ADDRESS 0xF40FC /end MEASUREMENT
/begin MEASUREMENT B_zfrau "" UBYTE B_TRUE 1 100 0.00 1.00000000000 BIT_MASK 0x2 FORMAT "%13.11" ECU_ADDRESS 0xF40FC /end MEASUREMENT
/begin MEASUREMENT B_zfrau2 "" UBYTE B_TRUE 1 100 0.00 1.00000000000 BIT_MASK 0x40 FORMAT "%13.11" ECU_ADDRESS 0xF40FC /end MEASUREMENT
/begin MEASUREMENT B_zhhrlsu "" UBYTE B_TRUE 1 100 0.00 1.00000000000 BIT_MASK 0x10 FORMAT "%13.11" ECU_ADDRESS 0xF0783 /end MEASUREMENT
/begin MEASUREMENT B_zhhrlsu2 "" UBYTE B_TRUE 1 100 0.00 1.00000000000 BIT_MASK 0x20 FORMAT "%13.11" ECU_ADDRESS 0xF0783 /end MEASUREMENT
/begin MEASUREMENT B_zhrnot "" UBYTE B_TRUE 1 100 0.00 1.00000000000 BIT_MASK 0x40 FORMAT "%13.11" ECU_ADDRESS 0xF0784 /end MEASUREMENT
/begin MEASUREMENT B_zhrnot2 "" UBYTE B_TRUE 1 100 0.00 1.00000000000 BIT_MASK 0x20 FORMAT "%13.11" ECU_ADDRESS 0xF0785 /end MEASUREMENT
/begin MEASUREMENT B_zkatb "" UBYTE B_TRUE 1 100 0.00 1.00000000000 BIT_MASK 0x10 FORMAT "%13.11" ECU_ADDRESS 0xF0799 /end MEASUREMENT
/begin MEASUREMENT B_zkatb2 "" UBYTE B_TRUE 1 100 0.00 1.00000000000 BIT_MASK 0x10 FORMAT "%13.11" ECU_ADDRESS 0xF079A /end MEASUREMENT
/begin MEASUREMENT B_zkats "" UBYTE B_TRUE 1 100 0.00 1.00000000000 BIT_MASK 0x20 FORMAT "%13.11" ECU_ADDRESS 0xF0799 /end MEASUREMENT
/begin MEASUREMENT B_zkats2 "" UBYTE B_TRUE 1 100 0.00 1.00000000000 BIT_MASK 0x20 FORMAT "%13.11" ECU_ADDRESS 0xF079A /end MEASUREMENT
/begin MEASUREMENT B_zkatz "" UBYTE B_TRUE 1 100 0.00 1.00000000000 BIT_MASK 0x40 FORMAT "%13.11" ECU_ADDRESS 0xF0799 /end MEASUREMENT
/begin MEASUREMENT B_zkatz2 "" UBYTE B_TRUE 1 100 0.00 1.00000000000 BIT_MASK 0x40 FORMAT "%13.11" ECU_ADDRESS 0xF079A /end MEASUREMENT
/begin MEASUREMENT B_zlsuia "" UBYTE B_TRUE 1 100 0.00 1.00000000000 BIT_MASK 0x1 FORMAT "%13.11" ECU_ADDRESS 0xF07B6 /end MEASUREMENT
/begin MEASUREMENT B_zlsuia2 "" UBYTE B_TRUE 1 100 0.00 1.00000000000 BIT_MASK 0x2 FORMAT "%13.11" ECU_ADDRESS 0xF07B6 /end MEASUREMENT
/begin MEASUREMENT B_zrkat "" UBYTE B_TRUE 1 100 0.00 1.00000000000 BIT_MASK 0x8 FORMAT "%13.11" ECU_ADDRESS 0xF40FC /end MEASUREMENT
/begin MEASUREMENT B_zrkat2 "" UBYTE B_TRUE 1 100 0.00 1.00000000000 BIT_MASK 0x1 FORMAT "%13.11" ECU_ADDRESS 0xF40FB /end MEASUREMENT
/begin MEASUREMENT B_zrkaz "" UBYTE B_TRUE 1 100 0.00 1.00000000000 BIT_MASK 0x10 FORMAT "%13.11" ECU_ADDRESS 0xF40FC /end MEASUREMENT
/begin MEASUREMENT B_zrkaz2 "" UBYTE B_TRUE 1 100 0.00 1.00000000000 BIT_MASK 0x2 FORMAT "%13.11" ECU_ADDRESS 0xF40FB /end MEASUREMENT
/begin MEASUREMENT CountMax_DKMTR_IMPL "" UBYTE DEZ 1 100 0.00 255.0 FORMAT "%5.1" ECU_ADDRESS 0x3802B4 /end MEASUREMENT
/begin MEASUREMENT CountMin_DKMTR_IMPL "" UBYTE DEZ 1 100 0.00 255.0 FORMAT "%5.1" ECU_ADDRESS 0x3802AE /end MEASUREMENT
/begin MEASUREMENT CountSig_DKMTR_IMPL "" UBYTE DEZ 1 100 0.00 255.0 FORMAT "%5.1" ECU_ADDRESS 0x3802A6 /end MEASUREMENT
/begin MEASUREMENT cryhs "" UBYTE dez 1 100 0.00 255.0 FORMAT "%5.1" ECU_ADDRESS 0x384008 /end MEASUREMENT
/begin MEASUREMENT crykat "" UBYTE dez 1 100 0.00 255.0 FORMAT "%5.1" ECU_ADDRESS 0x38400A /end MEASUREMENT
/begin MEASUREMENT cryls "" UBYTE dez 1 100 0.00 255.0 FORMAT "%5.1" ECU_ADDRESS 0x38400C /end MEASUREMENT
/begin MEASUREMENT crysls "" UBYTE dez 1 100 0.00 255.0 FORMAT "%5.1" ECU_ADDRESS 0x38400E /end MEASUREMENT
/begin MEASUREMENT decj_alt "" UBYTE DEZ 1 100 0.00 255.0 FORMAT "%5.1" ECU_ADDRESS 0xF40BB /end MEASUREMENT
/begin MEASUREMENT dfrsna2_w "" UWORD fak_uw_b2 1 100 0.00 1.999969 FORMAT "%8.6" ECU_ADDRESS 0xF44F6 /end MEASUREMENT
/begin MEASUREMENT dfrsna_w "" UWORD fak_uw_b2 1 100 0.00 1.999969 FORMAT "%8.6" ECU_ADDRESS 0xF44F8 /end MEASUREMENT
/begin MEASUREMENT DHRLSUausbits1 "" UBYTE dez 1 100 0.00 255.0 FORMAT "%5.1" ECU_ADDRESS 0xF0783 /end MEASUREMENT
/begin MEASUREMENT DHRLSUlokbits1 "" UBYTE dez 1 100 0.00 255.0 FORMAT "%5.1" ECU_ADDRESS 0xF0784 /end MEASUREMENT
/begin MEASUREMENT DHRLSUlokbits1_2 "" UBYTE dez 1 100 0.00 255.0 FORMAT "%5.1" ECU_ADDRESS 0xF0785 /end MEASUREMENT
/begin MEASUREMENT diclsuAusBits1 "" UBYTE dez 1 100 0.00 255.0 FORMAT "%5.1" ECU_ADDRESS 0xF07B1 /end MEASUREMENT
/begin MEASUREMENT diclsuAusBits2 "" UBYTE dez 1 100 0.00 255.0 FORMAT "%5.1" ECU_ADDRESS 0xF07B2 /end MEASUREMENT
/begin MEASUREMENT diclsuAusBits3 "" UBYTE dez 1 100 0.00 255.0 FORMAT "%5.1" ECU_ADDRESS 0xF07B3 /end MEASUREMENT
/begin MEASUREMENT diclsuLokBits1 "" UBYTE dez 1 100 0.00 255.0 FORMAT "%5.1" ECU_ADDRESS 0xF07B4 /end MEASUREMENT
/begin MEASUREMENT diclsuLokBits2 "" UBYTE dez 1 100 0.00 255.0 FORMAT "%5.1" ECU_ADDRESS 0xF07B5 /end MEASUREMENT
/begin MEASUREMENT diclsuLokBits3 "" UBYTE dez 1 100 0.00 255.0 FORMAT "%5.1" ECU_ADDRESS 0xF07B6 /end MEASUREMENT
/begin MEASUREMENT diclsuLokBits4 "" UBYTE dez 1 100 0.00 255.0 FORMAT "%5.1" ECU_ADDRESS 0xF07B7 /end MEASUREMENT
/begin MEASUREMENT dkatakt2_w "" UWORD t50msxs_uw_b3276p75 1 100 0.00 3276.750 FORMAT "%8.3" ECU_ADDRESS 0xF18FA /end MEASUREMENT
/begin MEASUREMENT dkatakt_w "" UWORD t50msxs_uw_b3276p75 1 100 0.00 3276.750 FORMAT "%8.3" ECU_ADDRESS 0xF18FC /end MEASUREMENT
/begin MEASUREMENT dkmtrLokBits "" UWORD dez 1 100 0.00 65535.00 FORMAT "%8.2" ECU_ADDRESS 0xF4594 /end MEASUREMENT
/begin MEASUREMENT dkmtrLokBits1 "" UBYTE dez 1 100 0.00 255.0 FORMAT "%5.1" ECU_ADDRESS 0xF088B /end MEASUREMENT
/begin MEASUREMENT dkractr "" UWORD dez 1 100 0.00 65535.00 FORMAT "%8.2" ECU_ADDRESS 0xF22EE /end MEASUREMENT
/begin MEASUREMENT DKVS1lokbits "" UBYTE dez 1 100 0.00 255.0 FORMAT "%5.1" ECU_ADDRESS 0xF40FB /end MEASUREMENT
/begin MEASUREMENT DKVSbits "" UBYTE dez 1 100 0.00 255.0 FORMAT "%5.1" ECU_ADDRESS 0x382067 /end MEASUREMENT
/begin MEASUREMENT DKVSlokbits "" UBYTE dez 1 100 0.00 255.0 FORMAT "%5.1" ECU_ADDRESS 0xF40FC /end MEASUREMENT
/begin MEASUREMENT dmrdkt_w "" UWORD rel_uw_b100 1 100 0.00 99.99847 FORMAT "%8.5" ECU_ADDRESS 0xF44E8 /end MEASUREMENT
/begin MEASUREMENT ehks "" UBYTE dez 1 100 0.00 255.0 FORMAT "%5.1" ECU_ADDRESS 0xF4133 /end MEASUREMENT
/begin MEASUREMENT ehks_min "" UBYTE dez 1 100 0.00 255.0 FORMAT "%5.1" ECU_ADDRESS 0xF4134 /end MEASUREMENT
/begin MEASUREMENT ehlpks "" UBYTE dez 1 100 0.00 255.0 FORMAT "%5.1" ECU_ADDRESS 0xF4135 /end MEASUREMENT
/begin MEASUREMENT ehlpks_min "" UBYTE dez 1 100 0.00 255.0 FORMAT "%5.1" ECU_ADDRESS 0xF4136 /end MEASUREMENT
/begin MEASUREMENT evsup1 "" UBYTE dez 1 100 0.00 255.0 FORMAT "%5.1" ECU_ADDRESS 0x384005 /end MEASUREMENT
/begin MEASUREMENT E_aatun "" UWORD B_TRUE 1 100 0.00 1.00000000000 BIT_MASK 0x1 FORMAT "%13.11" ECU_ADDRESS 0x382D32 /end MEASUREMENT
/begin MEASUREMENT E_asgnpl "" UWORD B_TRUE 1 100 0.00 1.00000000000 BIT_MASK 0x1 FORMAT "%13.11" ECU_ADDRESS 0x382D3A /end MEASUREMENT
/begin MEASUREMENT E_brems "" UWORD B_TRUE 1 100 0.00 1.00000000000 BIT_MASK 0x1 FORMAT "%13.11" ECU_ADDRESS 0x382D42 /end MEASUREMENT
/begin MEASUREMENT E_bznpl "" UWORD B_TRUE 1 100 0.00 1.00000000000 BIT_MASK 0x1 FORMAT "%13.11" ECU_ADDRESS 0x382D44 /end MEASUREMENT
/begin MEASUREMENT E_cairp "" UWORD B_TRUE 1 100 0.00 1.00000000000 BIT_MASK 0x1 FORMAT "%13.11" ECU_ADDRESS 0x382D48 /end MEASUREMENT
/begin MEASUREMENT E_dsu "" UWORD B_TRUE 1 100 0.00 1.00000000000 BIT_MASK 0x1 FORMAT "%13.11" ECU_ADDRESS 0x382D6E /end MEASUREMENT
/begin MEASUREMENT E_egsbgr "" UWORD B_TRUE 1 100 0.00 1.00000000000 BIT_MASK 0x1 FORMAT "%13.11" ECU_ADDRESS 0x382D8C /end MEASUREMENT
/begin MEASUREMENT E_fku "" UWORD B_TRUE 1 100 0.00 1.00000000000 BIT_MASK 0x1 FORMAT "%13.11" ECU_ADDRESS 0x382DA0 /end MEASUREMENT
/begin MEASUREMENT E_fp1p "" UWORD B_TRUE 1 100 0.00 1.00000000000 BIT_MASK 0x1 FORMAT "%13.11" ECU_ADDRESS 0x382DA2 /end MEASUREMENT
/begin MEASUREMENT E_fp2p "" UWORD B_TRUE 1 100 0.00 1.00000000000 BIT_MASK 0x1 FORMAT "%13.11" ECU_ADDRESS 0x382DA4 /end MEASUREMENT
/begin MEASUREMENT E_grbh "" UWORD B_TRUE 1 100 0.00 1.00000000000 BIT_MASK 0x1 FORMAT "%13.11" ECU_ADDRESS 0x382DB4 /end MEASUREMENT
/begin MEASUREMENT E_hre "" UWORD B_TRUE 1 100 0.00 1.00000000000 BIT_MASK 0x1 FORMAT "%13.11" ECU_ADDRESS 0x382DBA /end MEASUREMENT
/begin MEASUREMENT E_lshv "" UWORD B_TRUE 1 100 0.00 1.00000000000 BIT_MASK 0x1 FORMAT "%13.11" ECU_ADDRESS 0x382E04 /end MEASUREMENT
/begin MEASUREMENT E_ma "" UWORD B_TRUE 1 100 0.00 1.00000000000 BIT_MASK 0x1 FORMAT "%13.11" ECU_ADDRESS 0x382E24 /end MEASUREMENT
/begin MEASUREMENT E_mdb "" UWORD B_TRUE 1 100 0.00 1.00000000000 BIT_MASK 0x1 FORMAT "%13.11" ECU_ADDRESS 0x382E34 /end MEASUREMENT
/begin MEASUREMENT E_pwgde "" UWORD B_TRUE 1 100 0.00 1.00000000000 BIT_MASK 0x1 FORMAT "%13.11" ECU_ADDRESS 0x382E48 /end MEASUREMENT
/begin MEASUREMENT E_scr "" UWORD B_TRUE 1 100 0.00 1.00000000000 BIT_MASK 0x1 FORMAT "%13.11" ECU_ADDRESS 0x382E52 /end MEASUREMENT
/begin MEASUREMENT E_sgeew "" UWORD B_TRUE 1 100 0.00 1.00000000000 BIT_MASK 0x1 FORMAT "%13.11" ECU_ADDRESS 0x382E56 /end MEASUREMENT
/begin MEASUREMENT E_ta "" UWORD B_TRUE 1 100 0.00 1.00000000000 BIT_MASK 0x1 FORMAT "%13.11" ECU_ADDRESS 0x382E68 /end MEASUREMENT
/begin MEASUREMENT E_TKA "" UWORD B_TRUE 1 100 0.00 1.00000000000 BIT_MASK 0x1 FORMAT "%13.11" ECU_ADDRESS 0x382E76 /end MEASUREMENT
/begin MEASUREMENT E_tm "" UWORD B_TRUE 1 100 0.00 1.00000000000 BIT_MASK 0x1 FORMAT "%13.11" ECU_ADDRESS 0x382E78 /end MEASUREMENT
/begin MEASUREMENT E_tmki "" UWORD B_TRUE 1 100 0.00 1.00000000000 BIT_MASK 0x1 FORMAT "%13.11" ECU_ADDRESS 0x382E7A /end MEASUREMENT
/begin MEASUREMENT E_ub "" UWORD B_TRUE 1 100 0.00 1.00000000000 BIT_MASK 0x1 FORMAT "%13.11" ECU_ADDRESS 0x382E80 /end MEASUREMENT
/begin MEASUREMENT E_ubr "" UWORD B_TRUE 1 100 0.00 1.00000000000 BIT_MASK 0x1 FORMAT "%13.11" ECU_ADDRESS 0x382E82 /end MEASUREMENT
/begin MEASUREMENT E_wfs "" UWORD B_TRUE 1 100 0.00 1.00000000000 BIT_MASK 0x1 FORMAT "%13.11" ECU_ADDRESS 0x382E9E /end MEASUREMENT
/begin MEASUREMENT E_wfsrc "" UWORD B_TRUE 1 100 0.00 1.00000000000 BIT_MASK 0x1 FORMAT "%13.11" ECU_ADDRESS 0x382EA0 /end MEASUREMENT
/begin MEASUREMENT fehlerarray "" UBYTE DEZ 1 100 0.00 255.0 FORMAT "%5.1" ECU_ADDRESS 0xF40BC /end MEASUREMENT
/begin MEASUREMENT flgdkatlrs "" UBYTE dez 1 100 0.00 255.0 FORMAT "%5.1" ECU_ADDRESS 0x382050 /end MEASUREMENT
/begin MEASUREMENT flmxctr "" UWORD dez 1 100 0.00 65535.00 FORMAT "%8.2" ARRAY_SIZE 8 ECU_ADDRESS 0xF22F0 /end MEASUREMENT
/begin MEASUREMENT frauzs2_w "" UWORD fak_uw_b2 1 100 0.00 1.999969 FORMAT "%8.6" ECU_ADDRESS 0xF46AE /end MEASUREMENT
/begin MEASUREMENT frauzs_w "" UWORD fak_uw_b2 1 100 0.00 1.999969 FORMAT "%8.6" ECU_ADDRESS 0xF46B0 /end MEASUREMENT
/begin MEASUREMENT frsnast2_w "" UWORD fak_uw_b2 1 100 0.00 1.999969 FORMAT "%8.6" ECU_ADDRESS 0xF44FA /end MEASUREMENT
/begin MEASUREMENT frsnast_w "" UWORD fak_uw_b2 1 100 0.00 1.999969 FORMAT "%8.6" ECU_ADDRESS 0xF44FC /end MEASUREMENT
/begin MEASUREMENT fwmlhfm_w "" SWORD m_q0p1 1 100 -3276.800 3276.700 FORMAT "%8.3" ECU_ADDRESS 0xF459E /end MEASUREMENT
/begin MEASUREMENT imlkvszs_w "" UWORD m_q0p00355 1 100 0.00 233.0133 FORMAT "%8.4" ECU_ADDRESS 0x38407A /end MEASUREMENT
/begin MEASUREMENT imlkvs_w "" UWORD m_q0p00355 1 100 0.00 233.0133 FORMAT "%8.4" ECU_ADDRESS 0xF46B2 /end MEASUREMENT
/begin MEASUREMENT imlna2_w "" UWORD m_q2p777Em5_kg 1 100 0.00 1.820417 FORMAT "%8.6" ECU_ADDRESS 0xF44FE /end MEASUREMENT
/begin MEASUREMENT imlna_w "" UWORD m_q2p777Em5_kg 1 100 0.00 1.820417 FORMAT "%8.6" ECU_ADDRESS 0xF4500 /end MEASUREMENT
/begin MEASUREMENT kakbmt "" UBYTE fak_ub_b2 1 100 0.00 1.992 FORMAT "%5.3" ECU_ADDRESS 0xF4094 /end MEASUREMENT
/begin MEASUREMENT kakbmt2 "" UBYTE fak_ub_b2 1 100 0.00 1.992 FORMAT "%5.3" ECU_ADDRESS 0xF4095 /end MEASUREMENT
/begin MEASUREMENT katbf "" UBYTE spg_ub_q0p0052_o0p2 1 100 -0.2000 1.130 FORMAT "%5.3" ECU_ADDRESS 0xF07A3 /end MEASUREMENT
/begin MEASUREMENT katbf2 "" UBYTE spg_ub_q0p0052_o0p2 1 100 -0.2000 1.130 FORMAT "%5.3" ECU_ADDRESS 0xF07A4 /end MEASUREMENT
/begin MEASUREMENT katbfi2_w "" SWORD freq_sw_b512 1 100 -512.0000 511.9844 FORMAT "%8.4" ECU_ADDRESS 0xF18FE /end MEASUREMENT
/begin MEASUREMENT katbfi_w "" SWORD freq_sw_b512 1 100 -512.0000 511.9844 FORMAT "%8.4" ECU_ADDRESS 0xF1900 /end MEASUREMENT
/begin MEASUREMENT katbfs "" SBYTE fak_sb_b1 1 100 -1.000 0.9922 FORMAT "%5.3" ECU_ADDRESS 0xF07A5 /end MEASUREMENT
/begin MEASUREMENT katbfs2 "" SBYTE fak_sb_b1 1 100 -1.000 0.9922 FORMAT "%5.3" ECU_ADDRESS 0xF07A6 /end MEASUREMENT
/begin MEASUREMENT katbftp "" UBYTE spg_ub_q0p0052 1 100 0.00 1.330 FORMAT "%5.3" ECU_ADDRESS 0xF07A7 /end MEASUREMENT
/begin MEASUREMENT katbftp2 "" UBYTE spg_ub_q0p0052 1 100 0.00 1.330 FORMAT "%5.3" ECU_ADDRESS 0xF07A8 /end MEASUREMENT
/begin MEASUREMENT katbshd2_w "" SWORD mgrad_sw_b28p44 1 100 -28.44444 28.44358 FORMAT "%8.5" ECU_ADDRESS 0xF1902 /end MEASUREMENT
/begin MEASUREMENT katbshd_w "" SWORD mgrad_sw_b28p44 1 100 -28.44444 28.44358 FORMAT "%8.5" ECU_ADDRESS 0xF1904 /end MEASUREMENT
/begin MEASUREMENT kbdkt2_w "" SWORD mgrad_sw_b28p44 1 100 -28.44444 28.44358 FORMAT "%8.5" ECU_ADDRESS 0xF1906 /end MEASUREMENT
/begin MEASUREMENT kbdkt_w "" SWORD mgrad_sw_b28p44 1 100 -28.44444 28.44358 FORMAT "%8.5" ECU_ADDRESS 0xF1908 /end MEASUREMENT
/begin MEASUREMENT maxError "" UWORD B_TRUE 1 100 0.00 1.00000000000 BIT_MASK 0x4 FORMAT "%13.11" ECU_ADDRESS 0xF4594 /end MEASUREMENT
/begin MEASUREMENT minError "" UWORD B_TRUE 1 100 0.00 1.00000000000 BIT_MASK 0x2 FORMAT "%13.11" ECU_ADDRESS 0xF4594 /end MEASUREMENT
/begin MEASUREMENT mldko_w "" SWORD m_q0p1 1 100 -3276.800 3276.700 FORMAT "%8.3" ECU_ADDRESS 0xF1C30 /end MEASUREMENT
/begin MEASUREMENT mldmn_w "" SWORD m_q0p1 1 100 -3276.800 3276.700 FORMAT "%8.3" ECU_ADDRESS 0xF45A0 /end MEASUREMENT
/begin MEASUREMENT mldmx_w "" SWORD m_q0p1 1 100 -3276.800 3276.700 FORMAT "%8.3" ECU_ADDRESS 0xF1C32 /end MEASUREMENT
/begin MEASUREMENT mlhfmf_w "" SWORD m_q0p1 1 100 -3276.800 3276.700 FORMAT "%8.3" ECU_ADDRESS 0xF1C34 /end MEASUREMENT
/begin MEASUREMENT nmotfd "" UBYTE nmot_ub_q40 1 100 0.00 10200. FORMAT "%5.0" ARRAY_SIZE 4 ECU_ADDRESS 0x384022 /end MEASUREMENT
/begin MEASUREMENT phlsnhf "" UBYTE fak_ub_q0p01 1 100 0.00 2.550 FORMAT "%5.3" ECU_ADDRESS 0xF4057 /end MEASUREMENT
/begin MEASUREMENT phlsnhf2 "" UBYTE fak_ub_q0p01 1 100 0.00 2.550 FORMAT "%5.3" ECU_ADDRESS 0xF4058 /end MEASUREMENT
/begin MEASUREMENT ready "" UBYTE dez 1 100 0.00 255.0 FORMAT "%5.1" ECU_ADDRESS 0x384006 /end MEASUREMENT
/begin MEASUREMENT readyagr "" UBYTE dez 1 100 0.00 255.0 FORMAT "%5.1" ECU_ADDRESS 0x384007 /end MEASUREMENT
/begin MEASUREMENT readyhls "" UBYTE dez 1 100 0.00 255.0 FORMAT "%5.1" ECU_ADDRESS 0x384009 /end MEASUREMENT
/begin MEASUREMENT readykat "" UBYTE dez 1 100 0.00 255.0 FORMAT "%5.1" ECU_ADDRESS 0x38400B /end MEASUREMENT
/begin MEASUREMENT readylsv "" UBYTE dez 1 100 0.00 255.0 FORMAT "%5.1" ECU_ADDRESS 0x38400D /end MEASUREMENT
/begin MEASUREMENT readysls "" UBYTE dez 1 100 0.00 255.0 FORMAT "%5.1" ECU_ADDRESS 0x38400F /end MEASUREMENT
/begin MEASUREMENT rinkfh "" UBYTE r_q8 1 100 0.00 2040. FORMAT "%5.0" ECU_ADDRESS 0xF4059 /end MEASUREMENT
/begin MEASUREMENT rinkfh2 "" UBYTE r_q8 1 100 0.00 2040. FORMAT "%5.0" ECU_ADDRESS 0xF405A /end MEASUREMENT
/begin MEASUREMENT rinsh2_w "" UWORD r_uw_q2 1 100 0.00 131070.0 FORMAT "%8.1" ECU_ADDRESS 0xF441E /end MEASUREMENT
/begin MEASUREMENT rinsh_w "" UWORD r_uw_q2 1 100 0.00 131070.0 FORMAT "%8.1" ECU_ADDRESS 0xF4420 /end MEASUREMENT
/begin MEASUREMENT rkam2_w "" SWORD rel_sw_b1536 1 100 -1536.000 1535.953 FORMAT "%8.3" ECU_ADDRESS 0xF46B4 /end MEASUREMENT
/begin MEASUREMENT rkamzs2_w "" SWORD rel_sw_b1536 1 100 -1536.000 1535.953 FORMAT "%8.3" ECU_ADDRESS 0xF46B6 /end MEASUREMENT
/begin MEASUREMENT rkamzs_w "" SWORD rel_sw_b1536 1 100 -1536.000 1535.953 FORMAT "%8.3" ECU_ADDRESS 0xF46B8 /end MEASUREMENT
/begin MEASUREMENT rkam_w "" SWORD rel_sw_b1536 1 100 -1536.000 1535.953 FORMAT "%8.3" ECU_ADDRESS 0xF46BA /end MEASUREMENT
/begin MEASUREMENT rkrn_w "" UWORD spg_uw_b1280 1 100 0.00 1279.984 FORMAT "%8.3" ARRAY_SIZE 6 ECU_ADDRESS 0xF471E /end MEASUREMENT
/begin MEASUREMENT rldkthp "" SBYTE rel_sb_q0p75 1 100 -96.00 95.25 FORMAT "%5.2" ECU_ADDRESS 0xF07A9 /end MEASUREMENT
/begin MEASUREMENT rldkthp2 "" SBYTE rel_sb_q0p75 1 100 -96.00 95.25 FORMAT "%5.2" ECU_ADDRESS 0xF07AA /end MEASUREMENT
/begin MEASUREMENT sfpaatun "" UWORD default 1 100 0.00 65535.00 FORMAT "%8.2" ECU_ADDRESS 0x382D32 /end MEASUREMENT
/begin MEASUREMENT sfpasgnpl "" UWORD default 1 100 0.00 65535.00 FORMAT "%8.2" ECU_ADDRESS 0x382D3A /end MEASUREMENT
/begin MEASUREMENT sfpbrems "" UWORD default 1 100 0.00 65535.00 FORMAT "%8.2" ECU_ADDRESS 0x382D42 /end MEASUREMENT
/begin MEASUREMENT sfpbznpl "" UWORD default 1 100 0.00 65535.00 FORMAT "%8.2" ECU_ADDRESS 0x382D44 /end MEASUREMENT
/begin MEASUREMENT sfpcairp "" UWORD default 1 100 0.00 65535.00 FORMAT "%8.2" ECU_ADDRESS 0x382D48 /end MEASUREMENT
/begin MEASUREMENT sfpdsu "" UWORD dez 1 100 0.00 65535.00 FORMAT "%8.2" ECU_ADDRESS 0x382D6E /end MEASUREMENT
/begin MEASUREMENT sfpegsbgr "" UWORD default 1 100 0.00 65535.00 FORMAT "%8.2" ECU_ADDRESS 0x382D8C /end MEASUREMENT
/begin MEASUREMENT sfpfku "" UWORD default 1 100 0.00 65535.00 FORMAT "%8.2" ECU_ADDRESS 0x382DA0 /end MEASUREMENT
/begin MEASUREMENT sfpfp1p "" UWORD default 1 100 0.00 65535.00 FORMAT "%8.2" ECU_ADDRESS 0x382DA2 /end MEASUREMENT
/begin MEASUREMENT sfpfp2p "" UWORD default 1 100 0.00 65535.00 FORMAT "%8.2" ECU_ADDRESS 0x382DA4 /end MEASUREMENT
/begin MEASUREMENT sfpgrbh "" UWORD default 1 100 0.00 65535.00 FORMAT "%8.2" ECU_ADDRESS 0x382DB4 /end MEASUREMENT
/begin MEASUREMENT sfphre "" UWORD default 1 100 0.00 65535.00 FORMAT "%8.2" ECU_ADDRESS 0x382DBA /end MEASUREMENT
/begin MEASUREMENT sfplshv "" UWORD default 1 100 0.00 65535.00 FORMAT "%8.2" ECU_ADDRESS 0x382E04 /end MEASUREMENT
/begin MEASUREMENT sfpma "" UWORD default 1 100 0.00 65535.00 FORMAT "%8.2" ECU_ADDRESS 0x382E24 /end MEASUREMENT
/begin MEASUREMENT sfpmdb "" UWORD dez 1 100 0.00 65535.00 FORMAT "%8.2" ECU_ADDRESS 0x382E34 /end MEASUREMENT
/begin MEASUREMENT sfppwgde "" UWORD default 1 100 0.00 65535.00 FORMAT "%8.2" ECU_ADDRESS 0x382E48 /end MEASUREMENT
/begin MEASUREMENT sfpscr "" UWORD default 1 100 0.00 65535.00 FORMAT "%8.2" ECU_ADDRESS 0x382E52 /end MEASUREMENT
/begin MEASUREMENT sfpsgeew "" UWORD default 1 100 0.00 65535.00 FORMAT "%8.2" ECU_ADDRESS 0x382E56 /end MEASUREMENT
/begin MEASUREMENT sfpta "" UWORD dez 1 100 0.00 65535.00 FORMAT "%8.2" ECU_ADDRESS 0x382E68 /end MEASUREMENT
/begin MEASUREMENT sfptka "" UWORD dez 1 100 0.00 65535.00 FORMAT "%8.2" ECU_ADDRESS 0x382E76 /end MEASUREMENT
/begin MEASUREMENT sfptm "" UWORD dez 1 100 0.00 65535.00 FORMAT "%8.2" ECU_ADDRESS 0x382E78 /end MEASUREMENT
/begin MEASUREMENT sfptmki "" UWORD dez 1 100 0.00 65535.00 FORMAT "%8.2" ECU_ADDRESS 0x382E7A /end MEASUREMENT
/begin MEASUREMENT sfpub "" UWORD dez 1 100 0.00 65535.00 FORMAT "%8.2" ECU_ADDRESS 0x382E80 /end MEASUREMENT
/begin MEASUREMENT sfpubr "" UWORD dez 1 100 0.00 65535.00 FORMAT "%8.2" ECU_ADDRESS 0x382E82 /end MEASUREMENT
/begin MEASUREMENT sfpwfs "" UWORD default 1 100 0.00 65535.00 FORMAT "%8.2" ECU_ADDRESS 0x382E9E /end MEASUREMENT
/begin MEASUREMENT sfpwfsrc "" UWORD default 1 100 0.00 65535.00 FORMAT "%8.2" ECU_ADDRESS 0x382EA0 /end MEASUREMENT
/begin MEASUREMENT sigError "" UWORD B_TRUE 1 100 0.00 1.00000000000 BIT_MASK 0x8 FORMAT "%13.11" ECU_ADDRESS 0xF4594 /end MEASUREMENT
/begin MEASUREMENT tahsomf2_w "" UWORD temp_q0p0234_o273 1 100 -273.1500 1262.827 FORMAT "%8.3" ECU_ADDRESS 0xF4422 /end MEASUREMENT
/begin MEASUREMENT tahsomf_w "" UWORD temp_q0p0234_o273 1 100 -273.1500 1262.827 FORMAT "%8.3" ECU_ADDRESS 0xF4424 /end MEASUREMENT
/begin MEASUREMENT tc6kata "" UBYTE dez 1 100 0.00 255.0 FORMAT "%5.1" ECU_ADDRESS 0x382051 /end MEASUREMENT
/begin MEASUREMENT tc6katc "" UBYTE dez 1 100 0.00 255.0 FORMAT "%5.1" ECU_ADDRESS 0x382052 /end MEASUREMENT
/begin MEASUREMENT tc6katc2 "" UBYTE dez 1 100 0.00 255.0 FORMAT "%5.1" ECU_ADDRESS 0x382053 /end MEASUREMENT
/begin MEASUREMENT tc6kats "" UBYTE dez 1 100 0.00 255.0 FORMAT "%5.1" ECU_ADDRESS 0x382054 /end MEASUREMENT
/begin MEASUREMENT tc6kats2 "" UBYTE dez 1 100 0.00 255.0 FORMAT "%5.1" ECU_ADDRESS 0x382055 /end MEASUREMENT
/begin MEASUREMENT tc6katw "" UBYTE dez 1 100 0.00 255.0 FORMAT "%5.1" ECU_ADDRESS 0x382056 /end MEASUREMENT
/begin MEASUREMENT tc6katw2 "" UBYTE dez 1 100 0.00 255.0 FORMAT "%5.1" ECU_ADDRESS 0x382057 /end MEASUREMENT
/begin MEASUREMENT thlsuip2_w "" UWORD t_q0p1 1 100 0.00 6553.500 FORMAT "%8.3" ECU_ADDRESS 0xF4502 /end MEASUREMENT
/begin MEASUREMENT thlsuip_w "" UWORD t_q0p1 1 100 0.00 6553.500 FORMAT "%8.3" ECU_ADDRESS 0xF4504 /end MEASUREMENT
/begin MEASUREMENT tkatmin "" UBYTE temp_ub_q5_o50 1 100 -50.00 1225. FORMAT "%5.0" ECU_ADDRESS 0xF4096 /end MEASUREMENT
/begin MEASUREMENT tkdkte "" UBYTE temp_ub_q5_o50 1 100 -50.00 1225. FORMAT "%5.0" ECU_ADDRESS 0xF4097 /end MEASUREMENT
/begin MEASUREMENT tkdkte2 "" UBYTE temp_ub_q5_o50 1 100 -50.00 1225. FORMAT "%5.0" ECU_ADDRESS 0xF4098 /end MEASUREMENT
/begin MEASUREMENT tkdkth "" UBYTE temp_ub_q5 1 100 0.00 1275. FORMAT "%5.0" ECU_ADDRESS 0xF07AB /end MEASUREMENT
/begin MEASUREMENT tkdkth2 "" UBYTE temp_ub_q5 1 100 0.00 1275. FORMAT "%5.0" ECU_ADDRESS 0xF07AC /end MEASUREMENT
/begin MEASUREMENT tkdkthp "" UBYTE temp_ub_q5 1 100 0.00 1275. FORMAT "%5.0" ECU_ADDRESS 0xF4099 /end MEASUREMENT
/begin MEASUREMENT tkdkthp2 "" UBYTE temp_ub_q5 1 100 0.00 1275. FORMAT "%5.0" ECU_ADDRESS 0xF409A /end MEASUREMENT
/begin MEASUREMENT tkerdcmn_w "" UWORD temp_q0p0234_o273 1 100 -273.1500 1262.827 FORMAT "%8.3" ECU_ADDRESS 0xF4498 /end MEASUREMENT
/begin MEASUREMENT tkmnuvt2_w "" UWORD t_q0p05 1 100 0.00 3276.750 FORMAT "%8.3" ECU_ADDRESS 0xF44EA /end MEASUREMENT
/begin MEASUREMENT tkmnuvt_w "" UWORD t_q0p05 1 100 0.00 3276.750 FORMAT "%8.3" ECU_ADDRESS 0xF44EC /end MEASUREMENT
/begin MEASUREMENT tkslue1 "" UWORD fak_q0p1 1 100 0.00 6553.500 FORMAT "%8.3" ECU_ADDRESS 0xF4596 /end MEASUREMENT
/begin MEASUREMENT tkslue1h "" UWORD fak_q0p1 1 100 0.00 6553.500 FORMAT "%8.3" ECU_ADDRESS 0xF4598 /end MEASUREMENT
/begin MEASUREMENT tksluetmp "" UWORD fak_q0p1 1 100 0.00 6553.500 FORMAT "%8.3" ECU_ADDRESS 0xF459A /end MEASUREMENT
/begin MEASUREMENT ttkatmnu2_w "" UWORD t_q0p05 1 100 0.00 3276.750 FORMAT "%8.3" ECU_ADDRESS 0xF44EE /end MEASUREMENT
/begin MEASUREMENT ttkatmnu_w "" UWORD t_q0p05 1 100 0.00 3276.750 FORMAT "%8.3" ECU_ADDRESS 0xF44F0 /end MEASUREMENT
/begin MEASUREMENT twdkttk2_w "" UWORD t50msxs_uw_b3276p75 1 100 0.00 3276.750 FORMAT "%8.3" ECU_ADDRESS 0xF44F2 /end MEASUREMENT
/begin MEASUREMENT twdkttk_w "" UWORD t50msxs_uw_b3276p75 1 100 0.00 3276.750 FORMAT "%8.3" ECU_ADDRESS 0xF44F4 /end MEASUREMENT
/begin MEASUREMENT twvsom2_w "" UWORD temp_q0p0234_o273 1 100 -273.1500 1262.827 FORMAT "%8.3" ECU_ADDRESS 0xF449A /end MEASUREMENT
/begin MEASUREMENT twvsom_w "" UWORD temp_q0p0234_o273 1 100 -273.1500 1262.827 FORMAT "%8.3" ECU_ADDRESS 0xF449C /end MEASUREMENT
/begin MEASUREMENT TYP_AATUN "" UWORD B_TRUE 1 100 0.00 1.00000000000 BIT_MASK 0xf00 FORMAT "%13.11" ECU_ADDRESS 0x382D32 /end MEASUREMENT
/begin MEASUREMENT TYP_asgnpl "" UWORD B_TRUE 1 100 0.00 1.00000000000 BIT_MASK 0xf00 FORMAT "%13.11" ECU_ADDRESS 0x382D3A /end MEASUREMENT
/begin MEASUREMENT TYP_brems "" UWORD B_TRUE 1 100 0.00 1.00000000000 BIT_MASK 0xf00 FORMAT "%13.11" ECU_ADDRESS 0x382D42 /end MEASUREMENT
/begin MEASUREMENT TYP_bznpl "" UWORD B_TRUE 1 100 0.00 1.00000000000 BIT_MASK 0xf00 FORMAT "%13.11" ECU_ADDRESS 0x382D44 /end MEASUREMENT
/begin MEASUREMENT TYP_cairp "" UWORD B_TRUE 1 100 0.00 1.00000000000 BIT_MASK 0xf00 FORMAT "%13.11" ECU_ADDRESS 0x382D48 /end MEASUREMENT
/begin MEASUREMENT TYP_dsu "" UWORD B_TRUE 1 100 0.00 1.00000000000 BIT_MASK 0xf00 FORMAT "%13.11" ECU_ADDRESS 0x382D6E /end MEASUREMENT
/begin MEASUREMENT TYP_egsbgr "" UWORD B_TRUE 1 100 0.00 1.00000000000 BIT_MASK 0xf00 FORMAT "%13.11" ECU_ADDRESS 0x382D8C /end MEASUREMENT
/begin MEASUREMENT TYP_fku "" UWORD B_TRUE 1 100 0.00 1.00000000000 BIT_MASK 0xf00 FORMAT "%13.11" ECU_ADDRESS 0x382DA0 /end MEASUREMENT
/begin MEASUREMENT TYP_fp1p "" UWORD B_TRUE 1 100 0.00 1.00000000000 BIT_MASK 0xf00 FORMAT "%13.11" ECU_ADDRESS 0x382DA2 /end MEASUREMENT
/begin MEASUREMENT TYP_fp2p "" UWORD B_TRUE 1 100 0.00 1.00000000000 BIT_MASK 0xf00 FORMAT "%13.11" ECU_ADDRESS 0x382DA4 /end MEASUREMENT
/begin MEASUREMENT TYP_grbh "" UWORD B_TRUE 1 100 0.00 1.00000000000 BIT_MASK 0xf00 FORMAT "%13.11" ECU_ADDRESS 0x382DB4 /end MEASUREMENT
/begin MEASUREMENT TYP_hre "" UWORD B_TRUE 1 100 0.00 1.00000000000 BIT_MASK 0xf00 FORMAT "%13.11" ECU_ADDRESS 0x382DBA /end MEASUREMENT
/begin MEASUREMENT TYP_LSHV "" UWORD B_TRUE 1 100 0.00 1.00000000000 BIT_MASK 0xf00 FORMAT "%13.11" ECU_ADDRESS 0x382E04 /end MEASUREMENT
/begin MEASUREMENT TYP_ma "" UWORD B_TRUE 1 100 0.00 1.00000000000 BIT_MASK 0xf00 FORMAT "%13.11" ECU_ADDRESS 0x382E24 /end MEASUREMENT
/begin MEASUREMENT TYP_mdb "" UWORD B_TRUE 1 100 0.00 1.00000000000 BIT_MASK 0xf00 FORMAT "%13.11" ECU_ADDRESS 0x382E34 /end MEASUREMENT
/begin MEASUREMENT TYP_pwgde "" UWORD B_TRUE 1 100 0.00 1.00000000000 BIT_MASK 0xf00 FORMAT "%13.11" ECU_ADDRESS 0x382E48 /end MEASUREMENT
/begin MEASUREMENT TYP_scr "" UWORD B_TRUE 1 100 0.00 1.00000000000 BIT_MASK 0xf00 FORMAT "%13.11" ECU_ADDRESS 0x382E52 /end MEASUREMENT
/begin MEASUREMENT TYP_sgeew "" UWORD B_TRUE 1 100 0.00 1.00000000000 BIT_MASK 0xf00 FORMAT "%13.11" ECU_ADDRESS 0x382E56 /end MEASUREMENT
/begin MEASUREMENT TYP_ta "" UWORD B_TRUE 1 100 0.00 1.00000000000 BIT_MASK 0xf00 FORMAT "%13.11" ECU_ADDRESS 0x382E68 /end MEASUREMENT
/begin MEASUREMENT TYP_tka "" UWORD B_TRUE 1 100 0.00 1.00000000000 BIT_MASK 0xf00 FORMAT "%13.11" ECU_ADDRESS 0x382E76 /end MEASUREMENT
/begin MEASUREMENT TYP_tm "" UWORD B_TRUE 1 100 0.00 1.00000000000 BIT_MASK 0xf00 FORMAT "%13.11" ECU_ADDRESS 0x382E78 /end MEASUREMENT
/begin MEASUREMENT TYP_tmki "" UWORD B_TRUE 1 100 0.00 1.00000000000 BIT_MASK 0xf00 FORMAT "%13.11" ECU_ADDRESS 0x382E7A /end MEASUREMENT
/begin MEASUREMENT TYP_ub "" UWORD B_TRUE 1 100 0.00 1.00000000000 BIT_MASK 0xf00 FORMAT "%13.11" ECU_ADDRESS 0x382E80 /end MEASUREMENT
/begin MEASUREMENT TYP_ubr "" UWORD B_TRUE 1 100 0.00 1.00000000000 BIT_MASK 0xf00 FORMAT "%13.11" ECU_ADDRESS 0x382E82 /end MEASUREMENT
/begin MEASUREMENT TYP_wfs "" UWORD B_TRUE 1 100 0.00 1.00000000000 BIT_MASK 0xf00 FORMAT "%13.11" ECU_ADDRESS 0x382E9E /end MEASUREMENT
/begin MEASUREMENT TYP_wfsrc "" UWORD B_TRUE 1 100 0.00 1.00000000000 BIT_MASK 0xf00 FORMAT "%13.11" ECU_ADDRESS 0x382EA0 /end MEASUREMENT
/begin MEASUREMENT tzlrdkt_w "" UWORD t10msxs_uw_b655p35 1 100 0.00 655.3500 FORMAT "%8.4" ECU_ADDRESS 0xF190A /end MEASUREMENT
/begin MEASUREMENT ub_hsv "" UBYTE spg_q0p1 1 100 0.00 25.50 FORMAT "%5.2" ECU_ADDRESS 0xF408A /end MEASUREMENT
/begin MEASUREMENT udksnoa_w "" UWORD spg_uw_b1280 1 100 0.00 1279.984 FORMAT "%8.3" ECU_ADDRESS 0xF2334 /end MEASUREMENT
/begin MEASUREMENT udksnua_w "" UWORD spg_uw_b1280 1 100 0.00 1279.984 FORMAT "%8.3" ECU_ADDRESS 0xF2336 /end MEASUREMENT
/begin MEASUREMENT urddktp "" SBYTE spg_sb_q0p01043 1 100 -1.335 1.325 FORMAT "%5.3" ECU_ADDRESS 0xF07AD /end MEASUREMENT
/begin MEASUREMENT urddktp2 "" SBYTE spg_sb_q0p01043 1 100 -1.335 1.325 FORMAT "%5.3" ECU_ADDRESS 0xF07AE /end MEASUREMENT
/begin MEASUREMENT ushdktp "" UBYTE spg_ub_q0p0052 1 100 0.00 1.330 FORMAT "%5.3" ECU_ADDRESS 0xF07AF /end MEASUREMENT
/begin MEASUREMENT ushdktp2 "" UBYTE spg_ub_q0p0052 1 100 0.00 1.330 FORMAT "%5.3" ECU_ADDRESS 0xF07B0 /end MEASUREMENT
/begin MEASUREMENT wdkbadmx_w "" SWORD relDK_q0p02441 1 100 -800.0000 799.9756 FORMAT "%8.4" ECU_ADDRESS 0xF1C36 /end MEASUREMENT
/begin MEASUREMENT xzkrznt "" UBYTE dez 1 100 0.00 255.0 FORMAT "%5.1" ECU_ADDRESS 0xF0AC3 /end MEASUREMENT
/begin MEASUREMENT xzkrzof "" UBYTE dez 1 100 0.00 255.0 FORMAT "%5.1" ECU_ADDRESS 0xF0AC4 /end MEASUREMENT
/begin MEASUREMENT xzkrzs "" UBYTE dez 1 100 0.00 255.0 FORMAT "%5.1" ARRAY_SIZE 4 ECU_ADDRESS 0xF4137 /end MEASUREMENT
/begin MEASUREMENT xzkrztp "" UBYTE dez 1 100 0.00 255.0 FORMAT "%5.1" ECU_ADDRESS 0xF0AC7 /end MEASUREMENT
/begin MEASUREMENT xzsen "" UBYTE dez 1 100 0.00 255.0 FORMAT "%5.1" ARRAY_SIZE 4 ECU_ADDRESS 0xF413B /end MEASUREMENT
/begin MEASUREMENT xzskrnt "" UBYTE dez 1 100 0.00 255.0 FORMAT "%5.1" ECU_ADDRESS 0xF0AC5 /end MEASUREMENT
/begin MEASUREMENT xzskrof "" UBYTE dez 1 100 0.00 255.0 FORMAT "%5.1" ECU_ADDRESS 0xF0AC6 /end MEASUREMENT
/begin MEASUREMENT xzskrtp "" UBYTE dez 1 100 0.00 255.0 FORMAT "%5.1" ECU_ADDRESS 0xF0AC8 /end MEASUREMENT
/begin MEASUREMENT zatmwvs2_w "" UWORD zk200msxs_uw_b13107 1 100 0.20000305180 13107.200000 FORMAT "%12.6" ECU_ADDRESS 0xF449E /end MEASUREMENT
/begin MEASUREMENT zatmwvs_w "" UWORD zk200msxs_uw_b13107 1 100 0.20000305180 13107.200000 FORMAT "%12.6" ECU_ADDRESS 0xF44A0 /end MEASUREMENT
/begin MEASUREMENT zhlpks "" UBYTE dez 1 100 0.00 255.0 FORMAT "%5.1" ECU_ADDRESS 0xF413F /end MEASUREMENT
/begin MEASUREMENT Z_aatun "" UWORD B_TRUE 1 100 0.00 1.00000000000 BIT_MASK 0x2 FORMAT "%13.11" ECU_ADDRESS 0x382D32 /end MEASUREMENT
/begin MEASUREMENT Z_asgnpl "" UWORD B_TRUE 1 100 0.00 1.00000000000 BIT_MASK 0x2 FORMAT "%13.11" ECU_ADDRESS 0x382D3A /end MEASUREMENT
/begin MEASUREMENT Z_brems "" UWORD B_TRUE 1 100 0.00 1.00000000000 BIT_MASK 0x2 FORMAT "%13.11" ECU_ADDRESS 0x382D42 /end MEASUREMENT
/begin MEASUREMENT Z_bznpl "" UWORD B_TRUE 1 100 0.00 1.00000000000 BIT_MASK 0x2 FORMAT "%13.11" ECU_ADDRESS 0x382D44 /end MEASUREMENT
/begin MEASUREMENT Z_cairp "" UWORD B_TRUE 1 100 0.00 1.00000000000 BIT_MASK 0x2 FORMAT "%13.11" ECU_ADDRESS 0x382D48 /end MEASUREMENT
/begin MEASUREMENT Z_dsu "" UWORD B_TRUE 1 100 0.00 1.00000000000 BIT_MASK 0x2 FORMAT "%13.11" ECU_ADDRESS 0x382D6E /end MEASUREMENT
/begin MEASUREMENT Z_egsbgr "" UWORD B_TRUE 1 100 0.00 1.00000000000 BIT_MASK 0x2 FORMAT "%13.11" ECU_ADDRESS 0x382D8C /end MEASUREMENT
/begin MEASUREMENT Z_fku "" UWORD B_TRUE 1 100 0.00 1.00000000000 BIT_MASK 0x2 FORMAT "%13.11" ECU_ADDRESS 0x382DA0 /end MEASUREMENT
/begin MEASUREMENT Z_fp1p "" UWORD B_TRUE 1 100 0.00 1.00000000000 BIT_MASK 0x2 FORMAT "%13.11" ECU_ADDRESS 0x382DA2 /end MEASUREMENT
/begin MEASUREMENT Z_fp2p "" UWORD B_TRUE 1 100 0.00 1.00000000000 BIT_MASK 0x2 FORMAT "%13.11" ECU_ADDRESS 0x382DA4 /end MEASUREMENT
/begin MEASUREMENT Z_grbh "" UWORD B_TRUE 1 100 0.00 1.00000000000 BIT_MASK 0x2 FORMAT "%13.11" ECU_ADDRESS 0x382DB4 /end MEASUREMENT
/begin MEASUREMENT Z_hre "" UWORD B_TRUE 1 100 0.00 1.00000000000 BIT_MASK 0x2 FORMAT "%13.11" ECU_ADDRESS 0x382DBA /end MEASUREMENT
/begin MEASUREMENT Z_lshv "" UWORD B_TRUE 1 100 0.00 1.00000000000 BIT_MASK 0x2 FORMAT "%13.11" ECU_ADDRESS 0x382E04 /end MEASUREMENT
/begin MEASUREMENT Z_ma "" UWORD B_TRUE 1 100 0.00 1.00000000000 BIT_MASK 0x2 FORMAT "%13.11" ECU_ADDRESS 0x382E24 /end MEASUREMENT
/begin MEASUREMENT Z_mdb "" UWORD B_TRUE 1 100 0.00 1.00000000000 BIT_MASK 0x2 FORMAT "%13.11" ECU_ADDRESS 0x382E34 /end MEASUREMENT
/begin MEASUREMENT Z_pwgde "" UWORD B_TRUE 1 100 0.00 1.00000000000 BIT_MASK 0x2 FORMAT "%13.11" ECU_ADDRESS 0x382E48 /end MEASUREMENT
/begin MEASUREMENT Z_scr "" UWORD B_TRUE 1 100 0.00 1.00000000000 BIT_MASK 0x2 FORMAT "%13.11" ECU_ADDRESS 0x382E52 /end MEASUREMENT
/begin MEASUREMENT Z_sgeew "" UWORD B_TRUE 1 100 0.00 1.00000000000 BIT_MASK 0x2 FORMAT "%13.11" ECU_ADDRESS 0x382E56 /end MEASUREMENT
/begin MEASUREMENT Z_ta "" UWORD B_TRUE 1 100 0.00 1.00000000000 BIT_MASK 0x2 FORMAT "%13.11" ECU_ADDRESS 0x382E68 /end MEASUREMENT
/begin MEASUREMENT Z_TKA "" UWORD B_TRUE 1 100 0.00 1.00000000000 BIT_MASK 0x2 FORMAT "%13.11" ECU_ADDRESS 0x382E76 /end MEASUREMENT
/begin MEASUREMENT Z_tm "" UWORD B_TRUE 1 100 0.00 1.00000000000 BIT_MASK 0x2 FORMAT "%13.11" ECU_ADDRESS 0x382E78 /end MEASUREMENT
/begin MEASUREMENT Z_tmki "" UWORD B_TRUE 1 100 0.00 1.00000000000 BIT_MASK 0x2 FORMAT "%13.11" ECU_ADDRESS 0x382E7A /end MEASUREMENT
/begin MEASUREMENT Z_ub "" UWORD B_TRUE 1 100 0.00 1.00000000000 BIT_MASK 0x2 FORMAT "%13.11" ECU_ADDRESS 0x382E80 /end MEASUREMENT
/begin MEASUREMENT Z_ubr "" UWORD B_TRUE 1 100 0.00 1.00000000000 BIT_MASK 0x2 FORMAT "%13.11" ECU_ADDRESS 0x382E82 /end MEASUREMENT
/begin MEASUREMENT Z_wfs "" UWORD B_TRUE 1 100 0.00 1.00000000000 BIT_MASK 0x2 FORMAT "%13.11" ECU_ADDRESS 0x382E9E /end MEASUREMENT
/begin MEASUREMENT Z_wfsrc "" UWORD B_TRUE 1 100 0.00 1.00000000000 BIT_MASK 0x2 FORMAT "%13.11" ECU_ADDRESS 0x382EA0 /end MEASUREMENT
/begin FUNCTION DFPM_GGCS ""
 /begin DEF_CHARACTERISTIC CDCCAIRP CDCSCR CDKCAIRP CDKSCR CDTCAIRP CDTSCR CLACAIRP CLASCR FFTCAIRP FFTSCR TSFCAIRP TSFSCR /end DEF_CHARACTERISTIC
 /begin OUT_MEASUREMENT B_becairp B_bescr B_bkcairp B_bkscr B_clcairp B_clscr B_ftcairp B_ftscr B_mncairp B_mnscr B_mxcairp B_mxscr B_npcairp B_npscr B_sicairp B_siscr E_cairp E_scr sfpcairp sfpscr TYP_cairp TYP_scr Z_cairp Z_scr /end OUT_MEASUREMENT
/end FUNCTION
/begin FUNCTION DFPM_GGDSAS "" /begin DEF_CHARACTERISTIC CDCDSU CDKDSU CDTDSU CLADSU FFTDSU TSFDSU /end DEF_CHARACTERISTIC
 /begin OUT_MEASUREMENT B_bedsu B_bkdsu B_cldsu B_ftdsu B_mndsu B_mxdsu B_npdsu B_sidsu E_dsu sfpdsu TYP_dsu Z_dsu /end OUT_MEASUREMENT
/end FUNCTION
/begin FUNCTION DFPM_GGEGAS "" /begin DEF_CHARACTERISTIC CDCBREMS CDKBREMS CDTBREMS CLABREMS FFTBREMS TSFBREMS /end DEF_CHARACTERISTIC
 /begin OUT_MEASUREMENT B_bebrems B_bkbrems B_clbrems B_ftbrems B_mnbrems B_mxbrems B_npbrems B_sibrems E_brems sfpbrems TYP_brems Z_brems /end OUT_MEASUREMENT
/end FUNCTION
/begin FUNCTION DFPM_GGFGRH "" /begin DEF_CHARACTERISTIC CDCGRBH CDKGRBH CDTGRBH CLAGRBH FFTGRBH TSFGRBH /end DEF_CHARACTERISTIC
 /begin OUT_MEASUREMENT B_begrbh B_bkgrbh B_clgrbh B_ftgrbh B_mngrbh B_mxgrbh B_npgrbh B_sigrbh E_grbh sfpgrbh TYP_grbh Z_grbh /end OUT_MEASUREMENT
/end FUNCTION
/begin FUNCTION DFPM_GGGTS "" /begin DEF_CHARACTERISTIC CDCTMKI CDKTMKI CDTTMKI CLATMKI FFTTMKI TSFTMKI /end DEF_CHARACTERISTIC
 /begin OUT_MEASUREMENT B_avtmki B_betmki B_bktmki B_cltmki B_fttmki B_mntmki B_mxtmki B_nptmki B_pytmki B_sctmki B_sitmki E_tmki sfptmki TYP_tmki Z_tmki /end OUT_MEASUREMENT
/end FUNCTION
/begin FUNCTION DFPM_GGPED ""
 /begin DEF_CHARACTERISTIC CDCFP1P CDCFP2P CDCPWGDE CDKFP1P CDKFP2P CDKPWGDE CDTFP1P CDTFP2P CDTPWGDE CLAFP1P CLAFP2P CLAPWGDE FFTFP1P FFTFP2P FFTPWGDE TSFFP1P TSFFP2P TSFPWGDE /end DEF_CHARACTERISTIC
 /begin OUT_MEASUREMENT B_befp1p B_befp2p B_bepwgde B_bkfp1p B_bkfp2p B_bkpwgde B_clfp1p B_clfp2p B_clpwgde B_ftfp1p B_ftfp2p B_ftpwgde B_mnfp1p B_mnfp2p B_mnpwgde B_mxfp1p B_mxfp2p B_mxpwgde B_npfp1p B_npfp2p B_nppwgde B_sifp1p B_sifp2p B_sipwgde E_fp1p E_fp2p E_pwgde sfpfp1p sfpfp2p sfppwgde TYP_fp1p TYP_fp2p TYP_pwgde Z_fp1p Z_fp2p Z_pwgde /end OUT_MEASUREMENT
/end FUNCTION
/begin FUNCTION DFPM_GGTFA "" /begin DEF_CHARACTERISTIC CDCTA CDKTA CDTTA CLATA FFTTA TSFTA /end DEF_CHARACTERISTIC
 /begin OUT_MEASUREMENT B_beta B_bkta B_clta B_ftta B_mnta B_mxta B_npta B_sita E_ta sfpta TYP_ta Z_ta /end OUT_MEASUREMENT
/end FUNCTION
/begin FUNCTION DFPM_GGTFM "" /begin DEF_CHARACTERISTIC CDCTM CDKTM CDTTM CLATM FFTTM TSFTM /end DEF_CHARACTERISTIC
 /begin OUT_MEASUREMENT B_betm B_bktm B_cltm B_fttm B_mntm B_mxtm B_nptm B_sitm E_tm sfptm TYP_tm Z_tm /end OUT_MEASUREMENT
/end FUNCTION
/begin FUNCTION DFPM_GGTKA "" /begin DEF_CHARACTERISTIC CDCTKA CDKTKA CDTTKA CLATKA FFTTKA TSFTKA /end DEF_CHARACTERISTIC
 /begin OUT_MEASUREMENT B_betka B_bktka B_cltka B_fttka B_mntka B_mxtka B_nptka B_sitka E_TKA sfptka TYP_tka Z_TKA /end OUT_MEASUREMENT
/end FUNCTION
/begin FUNCTION DFPM_GGUB "" /begin DEF_CHARACTERISTIC CDCUB CDKUB CDTUB CLAUB FFTUB TSFUB /end DEF_CHARACTERISTIC
 /begin OUT_MEASUREMENT B_beub B_bkub B_club B_ftub B_mnub B_mxub B_npub B_siub E_ub sfpub TYP_ub Z_ub /end OUT_MEASUREMENT
/end FUNCTION
/begin FUNCTION DFPM_GGUBR "" /begin DEF_CHARACTERISTIC CDCUBR CDKUBR CDTUBR CLAUBR FFTUBR TSFUBR /end DEF_CHARACTERISTIC
 /begin OUT_MEASUREMENT B_beubr B_bkubr B_clubr B_ftubr B_mnubr B_mxubr B_npubr B_siubr E_ubr sfpubr TYP_ubr Z_ubr /end OUT_MEASUREMENT
/end FUNCTION
/begin FUNCTION DFPM_HRE "" /begin DEF_CHARACTERISTIC CDCHRE CDKHRE CDTHRE CLAHRE FFTHRE TSFHRE /end DEF_CHARACTERISTIC
 /begin OUT_MEASUREMENT B_behre B_bkhre B_clhre B_fthre B_mnhre B_mxhre B_nphre B_sihre E_hre sfphre TYP_hre Z_hre /end OUT_MEASUREMENT
/end FUNCTION
/begin FUNCTION DFPM_LSHV "" /begin DEF_CHARACTERISTIC CDCLSHV CDKLSHV CDTLSHV CLALSHV FFTLSHV TSFLSHV /end DEF_CHARACTERISTIC
 /begin OUT_MEASUREMENT B_belshv B_bklshv B_cllshv B_ftlshv B_mnlshv B_mxlshv B_nplshv B_silshv E_lshv sfplshv TYP_LSHV Z_lshv /end OUT_MEASUREMENT
/end FUNCTION
/begin FUNCTION DFPM_MDASG ""
 /begin DEF_CHARACTERISTIC CDCASGNPL CDCBZNPL CDCMA CDKASGNPL CDKBZNPL CDKMA CDTASGNPL CDTBZNPL CDTMA CLAASGNPL CLABZNPL CLAMA FFTASGNPL FFTBZNPL FFTMA TSFASGNPL TSFBZNPL TSFMA /end DEF_CHARACTERISTIC
 /begin OUT_MEASUREMENT B_beasgnpl B_bebznpl B_bema B_bkasgnpl B_bkbznpl B_bkma B_clasgnpl B_clbznpl B_clma B_ftasgnpl B_ftbznpl B_ftma B_mnasgnpl B_mnbznpl B_mnma B_mxasgnpl B_mxbznpl B_mxma B_npasgnpl B_npbznpl B_npma B_siasgnpl B_sibznpl B_sima E_asgnpl E_bznpl E_ma sfpasgnpl sfpbznpl sfpma TYP_asgnpl TYP_bznpl TYP_ma Z_asgnpl Z_bznpl Z_ma /end OUT_MEASUREMENT
/end FUNCTION
/begin FUNCTION DFPM_MDASGPH ""
 /begin DEF_CHARACTERISTIC CDCEGSBGR CDCFKU CDKEGSBGR CDKFKU CDTEGSBGR CDTFKU CLAEGSBGR CLAFKU FFTEGSBGR FFTFKU TSFEGSBGR TSFFKU /end DEF_CHARACTERISTIC
 /begin OUT_MEASUREMENT B_beegsbgr B_befku B_bkegsbgr B_bkfku B_clegsbgr B_clfku B_ftegsbgr B_ftfku B_mnegsbgr B_mnfku B_mxegsbgr B_mxfku B_npegsbgr B_npfku B_siegsbgr B_sifku E_egsbgr E_fku sfpegsbgr sfpfku TYP_egsbgr TYP_fku Z_egsbgr Z_fku /end OUT_MEASUREMENT
/end FUNCTION
/begin FUNCTION DFPM_MDKOG "" /begin DEF_CHARACTERISTIC CDCMDB CDKMDB CDTMDB CLAMDB FFTMDB TSFMDB /end DEF_CHARACTERISTIC
 /begin OUT_MEASUREMENT B_bemdb B_bkmdb B_clmdb B_ftmdb B_mnmdb B_mxmdb B_npmdb B_simdb E_mdb sfpmdb TYP_mdb Z_mdb /end OUT_MEASUREMENT
/end FUNCTION
/begin FUNCTION DFPM_STAAG "" /end FUNCTION
/begin FUNCTION DFPM_STBBT "" /end FUNCTION
/begin FUNCTION DFPM_STBLS "" /end FUNCTION
/begin FUNCTION DFPM_STECD "" /end FUNCTION
/begin FUNCTION DFPM_STESP "" /end FUNCTION
/begin FUNCTION DFPM_STILM "" /end FUNCTION
/begin FUNCTION DFPM_TUNING "" /begin DEF_CHARACTERISTIC CDCAATUN CDKAATUN CDTAATUN CLAAATUN FFTAATUN TSFAATUN /end DEF_CHARACTERISTIC
 /begin OUT_MEASUREMENT B_beaatun B_bkaatun B_claatun B_ftaatun B_mnaatun B_mxaatun B_npaatun B_siaatun E_aatun sfpaatun TYP_AATUN Z_aatun /end OUT_MEASUREMENT
/end FUNCTION
/begin FUNCTION DFPM_WFSIF ""
 /begin DEF_CHARACTERISTIC CDCSGEEW CDCWFS CDCWFSRC CDKSGEEW CDKWFS CDKWFSRC CDTSGEEW CDTWFS CDTWFSRC CLASGEEW CLAWFS CLAWFSRC FFTSGEEW FFTWFS FFTWFSRC TSFSGEEW TSFWFS TSFWFSRC /end DEF_CHARACTERISTIC
 /begin OUT_MEASUREMENT B_besgeew B_bewfs B_bewfsrc B_bksgeew B_bkwfs B_bkwfsrc B_clsgeew B_clwfs B_clwfsrc B_ftsgeew B_ftwfs B_ftwfsrc B_mnsgeew B_mnwfs B_mnwfsrc B_mxsgeew B_mxwfs B_mxwfsrc B_npsgeew B_npwfs B_npwfsrc B_sisgeew B_siwfs B_siwfsrc E_sgeew E_wfs E_wfsrc sfpsgeew sfpwfs sfpwfsrc TYP_sgeew TYP_wfs TYP_wfsrc Z_sgeew Z_wfs Z_wfsrc /end OUT_MEASUREMENT
/end FUNCTION
/begin FUNCTION DFRZ "20.20" /end FUNCTION
/begin FUNCTION DHELSU "100.10" /end FUNCTION
/begin FUNCTION DHFM "77.40"
 /begin DEF_CHARACTERISTIC CWDHFM FMLDMXKO FWMLHFMMN KFMLDMN KFMLDMX MLDHFMKO MLDHFMKU MLHFMMN TDMLHFM TDMLMN TDMLMX TDMLNF TDMLNPL TDMLST TDUBHFM UBHFM UNWDHFM ZMLRO /end DEF_CHARACTERISTIC
 /begin IN_MEASUREMENT B_bvhfm B_cdehfm B_dkpu B_edks B_ehfmfe B_stend B_zhfmfe fho_w mlsol_w mshfm1_w mshfms_w nmot nmot_w ub uzkw_w wdkba_w /end IN_MEASUREMENT
 /begin OUT_MEASUREMENT B_ehfm B_fgahfm B_heahfmlm B_hfm B_mnhfmlm B_mnmld B_mxhfmlm B_mxmld B_nplhfmlm fwmlhfm_w mldmn_w mldmx_w /end OUT_MEASUREMENT
 /begin LOC_MEASUREMENT B_ehfm1 B_fgdhfmst B_fgfshfm B_hfmko B_hfmku mldko_w mlhfmf_w wdkbadmx_w /end LOC_MEASUREMENT
/end FUNCTION
/begin FUNCTION DHLSHK "4.100"
 /begin DEF_CHARACTERISTIC CWDHLSH FRINH1 FRINH2 KFRINH KFRINH2 RINHAB TABSTHLSH TADHMNH TADHMNHFA TADHMXH TADHMXHFA TAHSOMFMN TANSDHLSH TASOH TVHSHEE TVHSHRI TVHSHRIHEL TVHSHRIZ TVRIHEE UBDHLSHMN UBDHLSHMX ZKARIH1 ZKARIH2 ZKPRIH /end DEF_CHARACTERISTIC
 /begin IN_MEASUREMENT B_atmst B_atmst2 B_bvhls B_cdhsh B_fahsh B_lsh B_lsh2 B_nmot B_rinh B_rinh2 B_risigh B_risigh2 B_stend msabg2_w msabg_w phlsnh phlsnh2 rinh2_w rinh_w tabst_w tahsom2_w tahsom_w tans ubsq_w /end IN_MEASUREMENT
 /begin OUT_MEASUREMENT B_hsokh B_hsokh2 B_shab B_shab2 B_ubok B_ubok2 /end OUT_MEASUREMENT
 /begin LOC_MEASUREMENT B_ehsh B_ehsh2 B_enh B_enh2 B_mnfhsh B_mnfhsh2 B_mxfhsh B_mxfhsh2 B_npfhsh B_npfhsh2 B_nphealh B_nphealh2 B_rierrh B_rierrh2 B_sifhsh B_sifhsh2 phlsnhf phlsnhf2 rinkfh rinkfh2 rinsh2_w rinsh_w tahsomf2_w tahsomf_w /end LOC_MEASUREMENT
/end FUNCTION
/begin FUNCTION DHLSHKE "1.10" /begin IN_MEASUREMENT B_cdhshe B_desee B_hshe B_hshe2 /end IN_MEASUREMENT /end FUNCTION
/begin FUNCTION DHR "2.20" /begin DEF_CHARACTERISTIC TDHR TDZHR UHRMN1 UHRMN2 UHRMX1 UHRMX2 /end DEF_CHARACTERISTIC /begin IN_MEASUREMENT B_ubrdmn1 B_ubrdmn2 wuhr /end IN_MEASUREMENT /begin OUT_MEASUREMENT B_dhrnio /end OUT_MEASUREMENT /end FUNCTION
/begin FUNCTION DHRLSU "3.110"
 /begin DEF_CHARACTERISTIC ATMRWT CWDHRLSU KLTKERDCMN KRIVKMX RINLSUPMN TABSTHLSU TAIKRLSUMN TEHEHRLSU TEHRF TEHRFMN TEHRLSUE TEHRLSUZMX TKERLSUDMN TMDHRSTMX TVENMX TVFAHRLSU TVLSUBB TVZHRNOT TWHRLSUZMX TWHRSTMX TWVDCMN TWVSOMOS UBHRLSUMN UBHRLSUMX ZATMRW /end DEF_CHARACTERISTIC
 /begin REF_CHARACTERISTIC TKERLSUS /end REF_CHARACTERISTIC
 /begin IN_MEASUREMENT B_atmng B_atmst B_atmtpa B_atmtpa2 B_cdhrlsu B_ehsve B_ehsve2 B_eiclsu B_eiclsu2 B_elsuwi B_elsuwi2 B_eshlsu B_eshlsu2 B_evloc B_fa B_henrin B_henrin2 B_hlsumx B_hlsumx2 B_hrlsaus B_hsv B_hsv2 B_mdarv B_nmot B_sa B_stend krivk2_w krivk_w msabg2_w msabg_w rinlsu2_w rinlsu_w tabst_w tahrlsu2_w tahrlsu_w tavso2_w tavso_w tkerlsu2_w tkerlsu_w tmst ubrsq /end IN_MEASUREMENT
 /begin OUT_MEASUREMENT B_ehlsu B_ehlsu2 B_ricalf B_ricalf2 B_zhhrlsu B_zhhrlsu2 DHRLSUausbits1 /end OUT_MEASUREMENT
 /begin LOC_MEASUREMENT B_enmx B_enmx2 B_hrlsunp B_hrlsunp2 B_rinnp B_rinnp2 B_spdhrub B_tahrmn B_tahrmn2 B_tahrmx B_tahrmx2 B_zhrnot B_zhrnot2 DHRLSUlokbits1 DHRLSUlokbits1_2 tkerdcmn_w twvsom2_w twvsom_w ub_hsv zatmwvs2_w zatmwvs_w /end LOC_MEASUREMENT
/end FUNCTION
/begin FUNCTION DHRLSUE "1.80" /begin DEF_CHARACTERISTIC TAHRLSUMN /end DEF_CHARACTERISTIC /begin REF_CHARACTERISTIC UBHRLSUMN UBHRLSUMX /end REF_CHARACTERISTIC
 /begin IN_MEASUREMENT B_cdhrlsue B_hsvemn B_hsvemn2 B_hsvemx B_hsvemx2 B_hsvesi B_hsvesi2 B_nmot B_stend tahrlsu2_w tahrlsu_w ubrsq /end IN_MEASUREMENT
 /begin OUT_MEASUREMENT B_ehsve B_ehsve2 /end OUT_MEASUREMENT
 /begin LOC_MEASUREMENT B_hsveemn B_hsveemn2 B_hsveemx B_hsveemx2 B_hsveesi B_hsveesi2 /end LOC_MEASUREMENT
/end FUNCTION
/begin FUNCTION DIAVALVE "" /begin IN_MEASUREMENT eevx /end IN_MEASUREMENT /end FUNCTION
/begin FUNCTION DICLSU "2.70"
 /begin DEF_CHARACTERISTIC CWDICLSU DFRZASNAMN FRSNAMX IMLNAMN IMLNAMN2 KLIMLNA KUSVKMX LAMSSMN LAMSSMX RINNPH SULSUMN TALSUSMX TVDESHLSU TVDFRZAIP TVDOCVM TVLSUDIP TVLSUTRIM TVLSUTRIMZ TVLSUUMN TVOCIPLL TVOCVM TVRIHOCVM TVRINNPH TVSAOCVM TVSERSL TVSHEIP TVSHESL TVSNPFNA UAOCUNMN UAOCUNMX UAOCVMMN UAOCVMMX UASNAMN UASNAMX /end DEF_CHARACTERISTIC
 /begin REF_CHARACTERISTIC SULSUMX SULSUMXL TVTKLSU /end REF_CHARACTERISTIC
 /begin IN_MEASUREMENT B_cdiclsu B_ehsve B_ehsve2 B_eshlsu B_eshlsu2 B_fa B_fklanf B_fklanf2 B_frini B_frini2 B_hrlsaus B_hstlsua B_hstlsua2 B_hsv B_hsv2 B_iclsabg B_iclsabg2 B_kh B_lrhkp B_lrhkp2 B_lrmsbs B_lrmsbs2 B_lrs B_lrs2 B_lsuiamn B_lsuiamn2 B_lsuiamx B_lsuiamx2 B_lsuicif B_lsuicif2 B_lsuickf B_lsuickf2 B_lsuube B_lsuube2 B_lsuunmn B_lsuunmn2 B_lsuunmx B_lsuunmx2 B_lsuvmmn B_lsuvmmn2 B_lsuvmmx B_lsuvmmx2 B_nmot B_pusab B_pusab2 B_sa B_stend B_tal B_talval B_za B_za2 dfrza2_w dfrza_w frm2_w frm_w kusvk2_w kusvkft2_w kusvkft_w kusvk_w lamsons2_w lamsons_w msabg2_w msabg_w rinlsu2_w rinlsu_w tavvkm2_w tavvkm_w ua10mo2_w ua10mo_w ubrsq_w /end IN_MEASUREMENT
 /begin OUT_MEASUREMENT B_diagia B_diagia2 B_eiclsu B_eiclsu2 B_ekusvk B_ekusvk2 B_elsuwi B_elsuwi2 B_helsuip B_helsuip2 B_lsuabgl B_lsuabgl2 B_lsudip B_lsudip2 B_lsuna B_lsuna2 B_npsna B_npsna2 B_spf3k B_spf3k2 diclsuAusBits1 diclsuAusBits2 diclsuAusBits3 /end OUT_MEASUREMENT
 /begin LOC_MEASUREMENT B_lsumxtk B_lsumxtk2 B_lsuocun B_lsuocun2 B_lsuocvm B_lsuocvm2 B_lsurih B_lsurih2 B_lsuumn B_lsuumn2 B_ocipll B_ocipll2 B_reocvm B_reocvm2 B_zlsuia B_zlsuia2 dfrsna2_w dfrsna_w diclsuLokBits1 diclsuLokBits2 diclsuLokBits3 diclsuLokBits4 frsnast2_w frsnast_w imlna2_w imlna_w thlsuip2_w thlsuip_w /end LOC_MEASUREMENT
 /begin SUB_FUNCTION DFPM_DICLSU /end SUB_FUNCTION
/end FUNCTION
/begin FUNCTION DIMCA "1.10"
 /begin IN_MEASUREMENT B_cdagr B_cdhsv B_cdldp B_cdlsv B_cdsls B_cdtes B_katfz B_kath B_pwf B_rdyagr B_rdyhs B_rdykat B_rdyls B_rdysls B_rdytes cd_bits1_w cd_bits2_w /end IN_MEASUREMENT
 /begin OUT_MEASUREMENT B_agrrdy B_hsrdy B_kathrdy B_katrdy B_kkrdy B_lsrdy B_slsrdy B_tesrdy evsup1 ready /end OUT_MEASUREMENT
/end FUNCTION
/begin FUNCTION DIMCAGR "1.10" /begin DEF_CHARACTERISTIC SRYAGR /end DEF_CHARACTERISTIC /begin OUT_MEASUREMENT B_rdyagr readyagr /end OUT_MEASUREMENT /end FUNCTION
/begin FUNCTION DIMCHLS "1.20" /begin DEF_CHARACTERISTIC SRYHS /end DEF_CHARACTERISTIC /begin OUT_MEASUREMENT B_rdyhs readyhls /end OUT_MEASUREMENT /begin LOC_MEASUREMENT cryhs /end LOC_MEASUREMENT /end FUNCTION
/begin FUNCTION DIMCKAT "1.10" /begin DEF_CHARACTERISTIC SRYKAT /end DEF_CHARACTERISTIC /begin OUT_MEASUREMENT B_rdykat readykat /end OUT_MEASUREMENT /begin LOC_MEASUREMENT crykat /end LOC_MEASUREMENT /end FUNCTION
/begin FUNCTION DIMCLSV "1.10" /begin DEF_CHARACTERISTIC SRYLS /end DEF_CHARACTERISTIC /begin OUT_MEASUREMENT B_rdyls readylsv /end OUT_MEASUREMENT /begin LOC_MEASUREMENT cryls /end LOC_MEASUREMENT /end FUNCTION
/begin FUNCTION DIMCSLS "1.10" /begin DEF_CHARACTERISTIC SRYSLS /end DEF_CHARACTERISTIC /begin IN_MEASUREMENT B_cwdslt B_cwdslty B_mslmin B_mslmin2 /end IN_MEASUREMENT /begin OUT_MEASUREMENT B_rdysls readysls /end OUT_MEASUREMENT /begin LOC_MEASUREMENT crysls /end LOC_MEASUREMENT /end FUNCTION
/begin FUNCTION DIMCTES "4.80" /begin DEF_CHARACTERISTIC CWRDYTES /end DEF_CHARACTERISTIC /begin IN_MEASUREMENT B_pwf /end IN_MEASUREMENT /begin OUT_MEASUREMENT B_rdytes /end OUT_MEASUREMENT /begin LOC_MEASUREMENT B_rdytev /end LOC_MEASUREMENT /end FUNCTION
/begin FUNCTION DKATLRS "10.70"
 /begin DEF_CHARACTERISTIC ADKATNF AHKATMN AHKATMX AHKATS AHKATSB AHKTMXT AHKTTSW APEKTDX AVKATFS AZLRKTT CDKATLK CWKATUM DKATCW DMRKTD DRLKTDP DRLKTDPT HYKATA HYKATR KATBFML KATBFMN KATBFMNT KATBFN KATBFNM KATBFNP KATBFSX KATBFXM KATBFXT KATBSG KATBSH KATBSHF KATBSHG KFKABMT KLAZKTD KLAZTKKOR KLKABT KLTZKTD NDKTSO NDKTSOT NDKTSU NDKTSUT NKTDX RLDKTOT RLDKTSO RLDKTSU RLDKTUT TDKATAKT TDKATATT TDKTMNE TDKTMNKH TDKTMXE TEDKTLP TKGRADMX TKMNUV TMAXKAT TMINKAT TMNKATT TMSKTDO TMSUKTD TWDKATST TWKTDLP TWKTDTK TWLL TZLRKTT ZDKATAD ZDKATAF ZDKATSH ZDKTBD ZDKTBF ZKTDRL ZKTDTKM /end DEF_CHARACTERISTIC
 /begin REF_CHARACTERISTIC SML05DKUB SNM05DKUB /end REF_CHARACTERISTIC
 /begin IN_MEASUREMENT B_cdkat B_dlahieg B_dlahieg2 B_dsls B_dtes B_edkvs B_edkvs2 B_fa B_fakat B_fakat2 B_frmax B_frmax2 B_frmin B_frmin2 B_kh B_ll B_lr B_lr2 B_lrhkp B_lrhkp2 B_lrka B_lrka2 B_mdarv B_mdkat B_pwf B_sbbhk B_sbbhk2 B_shab B_shab2 B_sls B_stend B_tehb B_ukg B_vlsuftb B_vlsuftb2 B_vlsumrb B_vlsumrb2 cd_bits1_w esst_sml05dkub esst_snm05dkub lamsoni2_w lamsoni_w ml ml_w nmot rl tikatm tikatm2 tkatm tkatm2 tmst ushk ushk2 /end IN_MEASUREMENT
 /begin OUT_MEASUREMENT avkatf avkatf2 azlrdkt B_dkini B_dkini2 B_dklpi B_dklpi2 B_dktakt B_dktakt2 B_dkten B_dkten2 B_dktlp B_dktnr B_dktnr2 B_dktpb B_dktpb2 B_dktsb B_dktsb2 B_dktsp B_dktsp2 B_dktst B_dktst2 B_dktt B_dktt2 B_dkttk B_dkttk2 B_ekats B_ekats2 B_erdkt B_erdkt2 B_szkat B_szkat2 B_tkatmn B_tkatmn2 B_tkukd B_trig B_trig2 B_vegkat B_vegkat2 B_vekat B_vekat2 B_zkatb B_zkatb2 B_zkats B_zkats2 B_zkatz B_zkatz2 dmrdkt_w flgdkatlrs tc6kata tc6katc tc6katc2 tc6kats tc6kats2 tc6katw tc6katw2 tzlrdkt_w /end OUT_MEASUREMENT
 /begin LOC_MEASUREMENT ahkat ahkat2 ahkatn ahkatn2 ahktki2_w ahktki_w ahktnk ahktnk2 akatbn akatbn2 akatbnk akatbnk2 apedkt apedkt2 dkatakt2_w dkatakt_w kakbmt kakbmt2 katbf katbf2 katbfi2_w katbfi_w katbfs katbfs2 katbftp katbftp2 katbshd2_w katbshd_w kbdkt2_w kbdkt_w rldkthp rldkthp2 tkatmin tkdkte tkdkte2 tkdkth tkdkth2 tkdkthp tkdkthp2 tkmnuvt2_w tkmnuvt_w ttkatmnu2_w ttkatmnu_w twdkttk2_w twdkttk_w urddktp urddktp2 ushdktp ushdktp2 /end LOC_MEASUREMENT
/end FUNCTION
/begin FUNCTION DKMTR "1.51"
 /begin DEF_CHARACTERISTIC ANZFEHLER IKMTR JKMTR KUBERROR KUBHEAL LAERROR LAHEAL NEGABW POSABW THLKSLUE1 THLKSLUE2 TKSDLRSCTR TMN1DlUE1 TMN2DLUE1 TMN3DLUE1 TMNKSLUE1 UBKLEMN UBKLEMX /end DEF_CHARACTERISTIC
 /begin IN_MEASUREMENT B_desee B_kl15 ubsq /end IN_MEASUREMENT
 /begin OUT_MEASUREMENT dkmtrLokBits /end OUT_MEASUREMENT
 /begin LOC_MEASUREMENT bitbuffer B_ks_1 B_kub B_la B_maxtemp B_maxtemp1 B_mintemp B_mintemp1 B_sigtemp B_sigtemp1 B_toggle CountMax_DKMTR_IMPL CountMin_DKMTR_IMPL CountSig_DKMTR_IMPL decj_alt dkmtrLokBits1 fehlerarray maxError minError sigError tkslue1 tkslue1h tksluetmp /end LOC_MEASUREMENT
/end FUNCTION
/begin FUNCTION DKRA "6.40" /begin DEF_CHARACTERISTIC DKRAMX DKRAZ NDKRA /end DEF_CHARACTERISTIC /begin IN_MEASUREMENT B_kl B_kr B_krwa B_pwf nmot tpnt_aktiv zzylkr /end IN_MEASUREMENT /begin OUT_MEASUREMENT flmxctr /end OUT_MEASUREMENT /begin LOC_MEASUREMENT dkractr /end LOC_MEASUREMENT /end FUNCTION
/begin FUNCTION DKRNT "11.11" /begin DEF_CHARACTERISTIC CWDKRNT CWDKROF DKROFN DKROKU KRFHT UDKRGOFS /end DEF_CHARACTERISTIC /begin REF_CHARACTERISTIC DKROKD /end REF_CHARACTERISTIC /begin IN_MEASUREMENT B_dnt B_pwf B_stend igod_w ikrma nmot tmfln_w tpnt_aktiv /end IN_MEASUREMENT /begin OUT_MEASUREMENT xzskrnt xzskrof /end OUT_MEASUREMENT /begin LOC_MEASUREMENT xzkrznt xzkrzof /end LOC_MEASUREMENT /end FUNCTION
/begin FUNCTION DKRS "29.121"
 /begin DEF_CHARACTERISTIC CWDKS DNMOTFD KRFHKS KRZYLDIAG NDKSBET NDKSO NDKSU UDKSNO UDKSNU /end DEF_CHARACTERISTIC
 /begin REF_CHARACTERISTIC SENZZYL SNM16KRUB /end REF_CHARACTERISTIC
 /begin IN_MEASUREMENT B_fakrs B_kr B_krfdks B_krldy B_krndy B_pwf B_tmkr esst_snm16krub nmot rkr vkr /end IN_MEASUREMENT
 /begin OUT_MEASUREMENT rkrn_w /end OUT_MEASUREMENT
 /begin LOC_MEASUREMENT B_ds B_ds2 ehks ehks_min ehlpks ehlpks_min nmotfd udksnoa_w udksnua_w xzkrzs xzsen zhlpks /end LOC_MEASUREMENT
/end FUNCTION
/begin FUNCTION DKRTP "11.11" /begin DEF_CHARACTERISTIC CWDKRTP UDKRTP /end DEF_CHARACTERISTIC /begin REF_CHARACTERISTIC KRFHT /end REF_CHARACTERISTIC /begin IN_MEASUREMENT B_dtp B_pwf ikrma ikrmet tpnt_aktiv /end IN_MEASUREMENT /begin OUT_MEASUREMENT xzskrtp /end OUT_MEASUREMENT /begin LOC_MEASUREMENT xzkrztp /end LOC_MEASUREMENT /end FUNCTION
/begin FUNCTION DKUPPL "1.40" /begin DEF_CHARACTERISTIC AGANGW AKUPPLB TDKUPNOG VDKUPPLMN /end DEF_CHARACTERISTIC /begin IN_MEASUREMENT B_autget B_brems B_lsd gangi S_kupp vfzg /end IN_MEASUREMENT /begin OUT_MEASUREMENT anzgangw anzkupplb B_gangok /end OUT_MEASUREMENT /end FUNCTION
/begin FUNCTION DKVS "17.110"
 /begin DEF_CHARACTERISTIC CPLRA CWDKVSS DFRMST FRAE FRAODN FRAODX FRAUDN FRAUDX FRMSTTDN FRMSTTDX IMLKVSMX MLDKVSF MLDKVSG RKAE RKATDN RKATDX RKAZDN RKAZDX TFRA TFRAOZ TFRAUZ TFRMST TFRMZST TMFRST TRKA TRKATZ TRKAZZ ZFRMST /end DEF_CHARACTERISTIC
 /begin IN_MEASUREMENT B_cdkvs B_fa B_fakvs B_falra B_frao B_frau B_fraur B_fraur2 B_lr B_lr2 B_lra B_lra2 B_lrare B_nofra B_norkat B_norkaz B_pwf B_rkat B_rkatr B_rkatr2 B_rkaz B_rkazr B_rkazr2 B_sa B_tal B_talval B_te cd_bits1_w frao2_w frao_w frau2_w frau_w frm2_w frm_w ml rkat2_w rkat_w rkaz2_w rkaz_w tans tmot /end IN_MEASUREMENT
 /begin OUT_MEASUREMENT B_dkvsf B_dkvstr B_edkvs B_edkvs2 B_gae B_gaefra B_gaefra2 B_kvsffl /end OUT_MEASUREMENT
 /begin LOC_MEASUREMENT B_dkvsef B_dkvsef2 B_dkvsfm B_dkvszf B_dkvszf2 B_efrao B_efrao2 B_efrau B_efrau2 B_erkat B_erkat2 B_erkaz B_erkaz2 B_frste B_frste2 B_gaeing B_gaeing2 B_imlkvse B_norkam B_plra B_rkam B_rkamr B_rkamr2 B_zfrao B_zfrao2 B_zfrau B_zfrau2 B_zrkat B_zrkat2 B_zrkaz B_zrkaz2 DKVS1lokbits DKVSbits DKVSlokbits frauzs2_w frauzs_w imlkvszs_w imlkvs_w rkam2_w rkamzs2_w rkamzs_w rkam_w /end LOC_MEASUREMENT
/end FUNCTION
/begin FUNCTION DLLR "28.140"
 /begin DEF_CHARACTERISTIC DASA DNDLLRO DNDLLRU FHDLLR RLMDVERL TADLLR TDLLR TDLLRMN TDLLRMX TDLLRNF TFDLLRO TFDLLRU TMDLLR /end DEF_CHARACTERISTIC
 /begin IN_MEASUREMENT abmf B_cdllr B_dknolu B_dkpu B_dsls B_dtes B_ll B_llr B_lrar B_mdarv B_nldg B_nmot B_nswo1 B_sa B_st B_tehb cd_bits2_w dmllri_w dns fho limax_w limin_w mdverl_w rl tans tmot tnse_w vfzg /end IN_MEASUREMENT
 /begin OUT_MEASUREMENT B_dllr B_dllra /end OUT_MEASUREMENT
 /begin LOC_MEASUREMENT B_lldia /end LOC_MEASUREMENT
/end FUNCTION
/begin COMPU_METHOD B_TRUE "" TAB_VERB "%6.3" "" COMPU_TAB_REF B_TRUE /end COMPU_METHOD
/begin COMPU_VTAB B_TRUE "" TAB_VERB 2 0 "----" 1 "TRUE" /end COMPU_VTAB
/begin COMPU_METHOD DEZ "" RAT_FUNC "%6.2" "" COEFFS 0 1 0 0 0 1 /end COMPU_METHOD
/begin COMPU_METHOD dez "" RAT_FUNC "%6.2" "" COEFFS 0 1 0 0 0 1 /end COMPU_METHOD
/begin COMPU_METHOD fak_q0p1 "" RAT_FUNC "%6.3" "-" COEFFS 0 1 0 0 0 0.1 /end COMPU_METHOD
/begin COMPU_METHOD fak_sb_b1 "" RAT_FUNC "%6.4" "-" COEFFS 0 256 0 0 0 2 /end COMPU_METHOD
/begin COMPU_METHOD fak_ub_b0p25 "" RAT_FUNC "%10.7" "-" COEFFS 0 256 0 0 0 0.25 /end COMPU_METHOD
/begin COMPU_METHOD fak_ub_b1 "" RAT_FUNC "%6.4" "-" COEFFS 0 256 0 0 0 1 /end COMPU_METHOD
/begin COMPU_METHOD fak_ub_b2 "" RAT_FUNC "%6.4" "-" COEFFS 0 256 0 0 0 2 /end COMPU_METHOD
/begin COMPU_METHOD fak_ub_b4 "" RAT_FUNC "%6.4" "-" COEFFS 0 256 0 0 0 4 /end COMPU_METHOD
/begin COMPU_METHOD fak_ub_b64 "" RAT_FUNC "%6.3" "-" COEFFS 0 256 0 0 0 64 /end COMPU_METHOD
/begin COMPU_METHOD fak_ub_q0p01 "" RAT_FUNC "%6.4" "-" COEFFS 0 1 0 0 0 0.01 /end COMPU_METHOD
/begin COMPU_METHOD fak_uw_b1 "" RAT_FUNC "%7.6" "-" COEFFS 0 65536 0 0 0 1 /end COMPU_METHOD
/begin COMPU_METHOD fak_uw_b16 "" RAT_FUNC "%6.5" "-" COEFFS 0 65536 0 0 0 16 /end COMPU_METHOD
/begin COMPU_METHOD fak_uw_b2 "" RAT_FUNC "%7.6" "-" COEFFS 0 65536 0 0 0 2 /end COMPU_METHOD
/begin COMPU_METHOD fak_uw_b4 "" RAT_FUNC "%7.6" "-" COEFFS 0 65536 0 0 0 4 /end COMPU_METHOD
/begin COMPU_METHOD freq_sw_b512 "" RAT_FUNC "%6.4" "1/s" COEFFS 0 65536 0 0 0 1024 /end COMPU_METHOD
/begin COMPU_METHOD mgrad_sw_b28p44 "" RAT_FUNC "%6.5" "g/s" COEFFS 0 230.4 0 0 0 0.2 /end COMPU_METHOD
/begin COMPU_METHOD mgrad_ub_b221p35 "" RAT_FUNC "%6.2" "mg/s" COEFFS 0 230.4 0 0 0 200 /end COMPU_METHOD
/begin COMPU_METHOD mgrad_uw_q0p0961 "" RAT_FUNC "%6.1" "mg/(V*s)" COEFFS 0 9805.82 0 0 0 102000 /end COMPU_METHOD
/begin COMPU_METHOD m_q0p00355 "" RAT_FUNC "%6.4" "kg" COEFFS 0 1125 0 0 0 4 /end COMPU_METHOD
/begin COMPU_METHOD m_q0p1 "" RAT_FUNC "%6.3" "kg/h" COEFFS 0 10 0 0 0 1 /end COMPU_METHOD
/begin COMPU_METHOD m_q2p777Em5_kg "" RAT_FUNC "%7.6" "kg" COEFFS 0 3600 0 0 0 0.1 /end COMPU_METHOD
/begin COMPU_METHOD m_ub_b1020 "" RAT_FUNC "%6.2" "kg/h" COEFFS 0 1 0 0 0 4 /end COMPU_METHOD
/begin COMPU_METHOD m_ub_b221p35 "" RAT_FUNC "%6.2" "mg" COEFFS 0 230.4 0 0 0 200 /end COMPU_METHOD
/begin COMPU_METHOD m_uw_b6553p5 "" RAT_FUNC "%6.3" "kg/h" COEFFS 0 1 0 0 0 0.1 /end COMPU_METHOD
/begin COMPU_METHOD nmot_ub_q10 "" RAT_FUNC "%6.1" "1/min" COEFFS 0 1 0 0 0 10 /end COMPU_METHOD
/begin COMPU_METHOD nmot_ub_q40 "" RAT_FUNC "%6.1" "1/min" COEFFS 0 1 0 0 0 40 /end COMPU_METHOD
/begin COMPU_METHOD relDK_q0p02441 "" RAT_FUNC "%6.4" "%DK" COEFFS 0 65536 0 0 0 1600 /end COMPU_METHOD
/begin COMPU_METHOD rel_sb_q0p75 "" RAT_FUNC "%6.3" "%" COEFFS 0 1 0 0 0 0.75 /end COMPU_METHOD
/begin COMPU_METHOD rel_sw_b1536 "" RAT_FUNC "%6.4" "%" COEFFS 0 65536 0 0 0 3072 /end COMPU_METHOD
/begin COMPU_METHOD rel_ub_q0p75 "" RAT_FUNC "%6.3" "%" COEFFS 0 1 0 0 0 0.75 /end COMPU_METHOD
/begin COMPU_METHOD rel_uw_b100 "" RAT_FUNC "%6.4" "%" COEFFS 0 65536 0 0 0 100 /end COMPU_METHOD
/begin COMPU_METHOD rel_uw_b192 "" RAT_FUNC "%6.4" "%" COEFFS 0 65536 0 0 0 192 /end COMPU_METHOD
/begin COMPU_METHOD rel_uw_b200 "" RAT_FUNC "%6.4" "%" COEFFS 0 65536 0 0 0 200 /end COMPU_METHOD
/begin COMPU_METHOD r_q0p0391 "" RAT_FUNC "%6.4" "Ohm" COEFFS 0 65536 0 0 0 2560 /end COMPU_METHOD
/begin COMPU_METHOD r_q8 "" RAT_FUNC "%6.2" "Ohm" COEFFS 0 1 0 0 0 8 /end COMPU_METHOD
/begin COMPU_METHOD r_uw_q2 "" RAT_FUNC "%6.2" "Ohm" COEFFS 0 1 0 0 0 2 /end COMPU_METHOD
/begin COMPU_METHOD spg_q0p00039 "" RAT_FUNC "%6.5" "V" COEFFS 0 1 0 0 0 0.000390625 /end COMPU_METHOD
/begin COMPU_METHOD spg_q0p1 "" RAT_FUNC "%6.3" "V" COEFFS 0 1 0 0 0 0.1 /end COMPU_METHOD
/begin COMPU_METHOD spg_q4p88Em4 "" RAT_FUNC "%6.5" "V" COEFFS 0 2048 0 0 0 1 /end COMPU_METHOD
/begin COMPU_METHOD spg_sb_q0p01043 "" RAT_FUNC "%6.4" "V" COEFFS 0 255 0 0 0 2.66 /end COMPU_METHOD
/begin COMPU_METHOD spg_ubatt "" RAT_FUNC "%6.4" "V" COEFFS 0 1 0 0 0 0.0704 /end COMPU_METHOD
/begin COMPU_METHOD spg_ub_b1p33 "" RAT_FUNC "%6.4" "V" COEFFS 0 255 0 0 0 1.33 /end COMPU_METHOD
/begin COMPU_METHOD spg_ub_b24 "" RAT_FUNC "%6.3" "1/V" COEFFS 0 1 0 0 0 0.09362 /end COMPU_METHOD
/begin COMPU_METHOD spg_ub_b5 "" RAT_FUNC "%6.4" "V" COEFFS 0 256 0 0 0 5 /end COMPU_METHOD
/begin COMPU_METHOD spg_ub_q0p0052 "" RAT_FUNC "%6.4" "V" COEFFS 0 255 0 0 0 1.33 /end COMPU_METHOD
/begin COMPU_METHOD spg_ub_q0p0052_o0p2 "" RAT_FUNC "%6.3" "V" COEFFS 0 255 51 0 0 1.33 /end COMPU_METHOD
/begin COMPU_METHOD spg_uw_b1280 "" RAT_FUNC "%6.4" "V" COEFFS 0 1000 0 0 0 19.5313 /end COMPU_METHOD
/begin COMPU_METHOD t100msxs_ub_b25p5 "" RAT_FUNC "%6.3" "s" COEFFS 0 1 0 0 0 0.1 /end COMPU_METHOD
/begin COMPU_METHOD t100msxs_uw_b6553p5 "" RAT_FUNC "%6.3" "s" COEFFS 0 1 0 0 0 0.1 /end COMPU_METHOD
/begin COMPU_METHOD t10msxs_ub_b2p55 "" RAT_FUNC "%6.4" "s" COEFFS 0 1 0 0 0 0.01 /end COMPU_METHOD
/begin COMPU_METHOD t10msxs_uw_b655p35 "" RAT_FUNC "%6.4" "s" COEFFS 0 1 0 0 0 0.01 /end COMPU_METHOD
/begin COMPU_METHOD t1sxs_ub_b255 "" RAT_FUNC "%6.2" "s" COEFFS 0 1 0 0 0 1 /end COMPU_METHOD
/begin COMPU_METHOD t1sxs_uw_b65535 "" RAT_FUNC "%6.2" "s" COEFFS 0 1 0 0 0 1 /end COMPU_METHOD
/begin COMPU_METHOD t1sxs_uw_q1 "" RAT_FUNC "%6.2" "s" COEFFS 0 1 0 0 0 1 /end COMPU_METHOD
/begin COMPU_METHOD t200msxs_ub_b51 "" RAT_FUNC "%6.3" "s" COEFFS 0 1 0 0 0 0.2 /end COMPU_METHOD
/begin COMPU_METHOD t50msxs_q0p05 "" RAT_FUNC "%6.4" "s" COEFFS 0 1 0 0 0 0.05 /end COMPU_METHOD
/begin COMPU_METHOD t50msxs_ub_b12p75 "" RAT_FUNC "%6.4" "s" COEFFS 0 1 0 0 0 0.05 /end COMPU_METHOD
/begin COMPU_METHOD t50msxs_uw_b3276p75 "" RAT_FUNC "%6.4" "s" COEFFS 0 1 0 0 0 0.05 /end COMPU_METHOD
/begin COMPU_METHOD t50msxs_uw_b819p2 "" RAT_FUNC "%6.4" "s" COEFFS 0 1 0 0 0 0.0125 /end COMPU_METHOD
/begin COMPU_METHOD temp_q0p0234 "" RAT_FUNC "%6.4" "K" COEFFS 0 256 0 0 0 6 /end COMPU_METHOD
/begin COMPU_METHOD temp_q0p0234_o273 "" RAT_FUNC "%6.1" "Grad C" COEFFS 0 1 273.15 0 0 0.0234375 /end COMPU_METHOD
/begin COMPU_METHOD temp_sb_q5 "" RAT_FUNC "%6.2" "Grad C" COEFFS 0 1 0 0 0 5 /end COMPU_METHOD
/begin COMPU_METHOD temp_ub_q0p75_o48 "" RAT_FUNC "%6.2" "Grad C" COEFFS 0 1 48 0 0 0.75 /end COMPU_METHOD
/begin COMPU_METHOD temp_ub_q5 "" RAT_FUNC "%6.2" "Grad C" COEFFS 0 1 0 0 0 5 /end COMPU_METHOD
/begin COMPU_METHOD temp_ub_q5_o50 "" RAT_FUNC "%6.2" "Grad C" COEFFS 0 1 50 0 0 5 /end COMPU_METHOD
/begin COMPU_METHOD tknockcon_sy "" RAT_FUNC "%8.7" "s" COEFFS 0 312500 0 0 0 1 /end COMPU_METHOD
/begin COMPU_METHOD tknockintgrad_sy "" RAT_FUNC "%6.3" "V/s" COEFFS 0 10.738255033557 0 0 0 1 /end COMPU_METHOD
/begin COMPU_METHOD t_q0p01 "" RAT_FUNC "%6.4" "s" COEFFS 0 100 0 0 0 1 /end COMPU_METHOD
/begin COMPU_METHOD t_q0p05 "" RAT_FUNC "%6.4" "s" COEFFS 0 100 0 0 0 5 /end COMPU_METHOD
/begin COMPU_METHOD t_q0p1 "" RAT_FUNC "%6.3" "s" COEFFS 0 10 0 0 0 1 /end COMPU_METHOD
/begin COMPU_METHOD vfzg_ub_q1p25 "" RAT_FUNC "%6.2" "km/h" COEFFS 0 1 0 0 0 1.25 /end COMPU_METHOD
/begin COMPU_METHOD zk100msxs_uw_b6553 "" RAT_FUNC "%6.1" "s" COEFFS 0 0 65536 0 10 0 /end COMPU_METHOD
/begin COMPU_METHOD zk10msxs_ub_b2p55 "" RAT_FUNC "%6.4" "s" COEFFS 0 0 255 0 100 0 /end COMPU_METHOD
/begin COMPU_METHOD zk200msxs_ub_b51p2 "" RAT_FUNC "%6.3" "s" COEFFS 0 0 255 0 5 0 /end COMPU_METHOD
/begin COMPU_METHOD zk200msxs_uw_b13107 "" RAT_FUNC "%12.3" "s" COEFFS 0 0 13107.2 0 1 0 /end COMPU_METHOD
/begin COMPU_METHOD zk50msxs_ub_b12p8 "" RAT_FUNC "%6.3" "s" COEFFS 0 0 256 0 20 0 /end COMPU_METHOD
/begin COMPU_METHOD zk50msxs_uw_b3276p8 "" RAT_FUNC "%6.1" "s" COEFFS 0 0 65536 0 20 0 /end COMPU_METHOD
/begin COMPU_METHOD default "" RAT_FUNC "%6.2" "" COEFFS 0 1 0 0 0 1 /end COMPU_METHOD
/begin RECORD_LAYOUT GklWSw FNC_VALUES 1 SWORD COLUMN_DIR DIRECT /end RECORD_LAYOUT
/begin RECORD_LAYOUT GklWUb FNC_VALUES 1 UBYTE COLUMN_DIR DIRECT /end RECORD_LAYOUT
/begin RECORD_LAYOUT GklWUw FNC_VALUES 1 UWORD COLUMN_DIR DIRECT /end RECORD_LAYOUT
/begin RECORD_LAYOUT KfAxUbAyUbSstxSwSstyUbWSw NO_AXIS_PTS_X 1 UBYTE NO_AXIS_PTS_Y 2 UBYTE AXIS_PTS_X 3 SWORD INDEX_INCR DIRECT AXIS_PTS_Y 4 UBYTE INDEX_INCR DIRECT FNC_VALUES 5 SWORD COLUMN_DIR DIRECT /end RECORD_LAYOUT
/begin RECORD_LAYOUT KfAxUbAyUbSstxUbSstyUbWUb NO_AXIS_PTS_X 1 UBYTE NO_AXIS_PTS_Y 2 UBYTE AXIS_PTS_X 3 UBYTE INDEX_INCR DIRECT AXIS_PTS_Y 4 UBYTE INDEX_INCR DIRECT FNC_VALUES 5 UBYTE COLUMN_DIR DIRECT /end RECORD_LAYOUT
/begin RECORD_LAYOUT KfAxUbAyUbSstxUwSstyUbWUb NO_AXIS_PTS_X 1 UBYTE NO_AXIS_PTS_Y 2 UBYTE AXIS_PTS_X 3 UWORD INDEX_INCR DIRECT AXIS_PTS_Y 4 UBYTE INDEX_INCR DIRECT FNC_VALUES 5 UBYTE COLUMN_DIR DIRECT /end RECORD_LAYOUT
/begin RECORD_LAYOUT KlAUbSstUbWUb NO_AXIS_PTS_X 1 UBYTE AXIS_PTS_X 2 UBYTE INDEX_INCR DIRECT FNC_VALUES 3 UBYTE COLUMN_DIR DIRECT /end RECORD_LAYOUT
/begin RECORD_LAYOUT KlAUbSstUbWUw NO_AXIS_PTS_X 1 UBYTE AXIS_PTS_X 2 UBYTE INDEX_INCR DIRECT FNC_VALUES 3 UWORD COLUMN_DIR DIRECT /end RECORD_LAYOUT
/begin RECORD_LAYOUT KlAUbSstUwWUb NO_AXIS_PTS_X 1 UBYTE AXIS_PTS_X 2 UWORD INDEX_INCR DIRECT FNC_VALUES 3 UBYTE COLUMN_DIR DIRECT /end RECORD_LAYOUT
/begin RECORD_LAYOUT KlAUbSstUwWUw NO_AXIS_PTS_X 1 UWORD AXIS_PTS_X 2 UWORD INDEX_INCR DIRECT FNC_VALUES 3 UWORD COLUMN_DIR DIRECT /end RECORD_LAYOUT
/begin RECORD_LAYOUT KlAUwSstUwWUw NO_AXIS_PTS_X 1 UWORD AXIS_PTS_X 2 UWORD INDEX_INCR DIRECT FNC_VALUES 3 UWORD COLUMN_DIR DIRECT /end RECORD_LAYOUT
/begin RECORD_LAYOUT KwbUb FNC_VALUES 1 UBYTE COLUMN_DIR DIRECT /end RECORD_LAYOUT
/begin RECORD_LAYOUT KwbUw FNC_VALUES 1 UWORD COLUMN_DIR DIRECT /end RECORD_LAYOUT
/begin RECORD_LAYOUT KwSb FNC_VALUES 1 SBYTE COLUMN_DIR DIRECT /end RECORD_LAYOUT
/begin RECORD_LAYOUT KwSw FNC_VALUES 1 SWORD COLUMN_DIR DIRECT /end RECORD_LAYOUT
/begin RECORD_LAYOUT KwUb FNC_VALUES 1 UBYTE COLUMN_DIR DIRECT /end RECORD_LAYOUT
/begin RECORD_LAYOUT KwUw FNC_VALUES 1 UWORD COLUMN_DIR DIRECT /end RECORD_LAYOUT
/begin RECORD_LAYOUT SstAUbSstUb NO_AXIS_PTS_X 1 UBYTE AXIS_PTS_X 2 UBYTE INDEX_INCR DIRECT /end RECORD_LAYOUT
/end MODULE
/end PROJECT
