/* Erstellt von DAMOS++ V1.17 */
ASAP2_VERSION 1 3
/begin PROJECT X505R_24d1_0 "4019.XX"
/begin HEADER "" VERSION "X505R_24d1_0" PROJECT_NO X505R_24d1_0 /end HEADER
/begin MODULE DIM ""
/begin MOD_PAR "4019.XX" VERSION "PrV = X24d1 mit 5r" ADDR_EPK 0x810005 EPK "41/1/ME7.5/5/4019.XX//X24d1/Dst5r/170602/" CUSTOMER_NO "5" USER "" PHONE_NO "" CPU_TYPE "S80166" ECU "ME7.5"
 /begin MEMORY_SEGMENT Pst800000 "" CODE EPROM EXTERN 0x800000 0x10000 -1 -1 -1 -1 -1 /begin IF_DATA ETK ADDRESS_MAPPING 0x800000 0x800000 0x10000 /end IF_DATA /end MEMORY_SEGMENT
 /begin MEMORY_SEGMENT Pst820000 "" CODE EPROM EXTERN 0x820000 0x6A00 -1 -1 -1 -1 -1 /begin IF_DATA ETK ADDRESS_MAPPING 0x820000 0x820000 0x6A00 /end IF_DATA /end MEMORY_SEGMENT
 /begin MEMORY_SEGMENT Pst830000 "" CODE EPROM EXTERN 0x830000 0x50000 -1 -1 -1 -1 -1 /begin IF_DATA ETK ADDRESS_MAPPING 0x830000 0x830000 0x50000 /end IF_DATA /end MEMORY_SEGMENT
 /begin MEMORY_SEGMENT Pst880000 "" CODE EPROM EXTERN 0x880000 0x80000 -1 -1 -1 -1 -1 /begin IF_DATA ETK ADDRESS_MAPPING 0x880000 0x880000 0x80000 /end IF_DATA /end MEMORY_SEGMENT
 /begin MEMORY_SEGMENT Dst810000 "" DATA EPROM EXTERN 0x810000 0x10000 -1 -1 -1 -1 -1 /begin IF_DATA ETK ADDRESS_MAPPING 0x810000 0x810000 0x10000 /end IF_DATA /end MEMORY_SEGMENT
 /begin MEMORY_SEGMENT Dst826A00 "" DATA EPROM EXTERN 0x826A00 0x9600 -1 -1 -1 -1 -1 /begin IF_DATA ETK ADDRESS_MAPPING 0x826A00 0x826A00 0x9600 /end IF_DATA /end MEMORY_SEGMENT
 /begin MEMORY_SEGMENT ExtRam380000 "" VARIABLES RAM EXTERN 0x380000 0x8000 -1 -1 -1 -1 -1 /begin IF_DATA ETK ADDRESS_MAPPING 0x380000 0x380000 0x8000 /end IF_DATA /end MEMORY_SEGMENT
 /begin MEMORY_SEGMENT Ram0 "" VARIABLES RAM INTERN 0x0 0x10000 -1 -1 -1 -1 -1 /end MEMORY_SEGMENT
 SYSTEM_CONSTANT "ANZ_VARTAB" "324"
 SYSTEM_CONSTANT "ANZ_VARTABC" "324"
 SYSTEM_CONSTANT "EPK_MAX_LEN" "80"
 SYSTEM_CONSTANT "FPPANZ" "28"
 SYSTEM_CONSTANT "FPPANZA" "8"
 SYSTEM_CONSTANT "SK_ME75" "1"
 SYSTEM_CONSTANT "SK_PECC650" "1"
 SYSTEM_CONSTANT "SK_UMHC05" "1"
 SYSTEM_CONSTANT "SWOFFDL_REQUEST_MASK" "8191"
 SYSTEM_CONSTANT "SY_2HFM" "0"
 SYSTEM_CONSTANT "SY_2SG" "0"
 SYSTEM_CONSTANT "SY_2SGHST" "0"
 SYSTEM_CONSTANT "SY_2SLS" "0"
 SYSTEM_CONSTANT "SY_2TEV" "0"
 SYSTEM_CONSTANT "SY_AAU" "0"
 SYSTEM_CONSTANT "SY_AAV" "1"
 SYSTEM_CONSTANT "SY_ABGKL" "0"
 SYSTEM_CONSTANT "SY_ABGY" "0"
 SYSTEM_CONSTANT "SY_ABGYVBP" "0"
 SYSTEM_CONSTANT "SY_ABMZND" "0"
 SYSTEM_CONSTANT "SY_ACTRQCM" "0"
 SYSTEM_CONSTANT "SY_ADR" "0"
 SYSTEM_CONSTANT "SY_AEKPBI" "0"
 SYSTEM_CONSTANT "SY_AFR" "0"
 SYSTEM_CONSTANT "SY_AGR" "0"
 SYSTEM_CONSTANT "SY_AGRGSTA" "0"
 SYSTEM_CONSTANT "SY_AGRKOMP" "0"
 SYSTEM_CONSTANT "SY_AGRVBP" "0"
 SYSTEM_CONSTANT "SY_AGR_DSS" "0"
 SYSTEM_CONSTANT "SY_AIRBAG" "1"
 SYSTEM_CONSTANT "SY_ALLRAD" "0"
 SYSTEM_CONSTANT "SY_ALLRAD_NIVEAU" "0"
 SYSTEM_CONSTANT "SY_ANZLUE" "0"
 SYSTEM_CONSTANT "SY_ASAP" "100"
 SYSTEM_CONSTANT "SY_ASG" "0"
 SYSTEM_CONSTANT "SY_ASICRUN" "0"
 SYSTEM_CONSTANT "SY_ASICRUNTIME" "0"
 SYSTEM_CONSTANT "SY_ASM" "0"
 SYSTEM_CONSTANT "SY_ASR" "1"
 SYSTEM_CONSTANT "SY_ASTIKR" "0"
 SYSTEM_CONSTANT "SY_ASTIKR2" "0"
 SYSTEM_CONSTANT "SY_ASTNHK" "0"
 SYSTEM_CONSTANT "SY_ASTNHK2" "0"
 SYSTEM_CONSTANT "SY_ASTNTL" "0"
 SYSTEM_CONSTANT "SY_ASTNTL2" "0"
 SYSTEM_CONSTANT "SY_ASTNVK" "0"
 SYSTEM_CONSTANT "SY_ASTNVK2" "0"
 SYSTEM_CONSTANT "SY_ASTVHK" "0"
 SYSTEM_CONSTANT "SY_ASTVHK2" "0"
 SYSTEM_CONSTANT "SY_ASTVVK" "0"
 SYSTEM_CONSTANT "SY_ASTVVK2" "0"
 SYSTEM_CONSTANT "SY_ASV" "0"
 SYSTEM_CONSTANT "SY_ATLB" "0"
 SYSTEM_CONSTANT "SY_ATMLA" "0"
 SYSTEM_CONSTANT "SY_ATMST" "0"
 SYSTEM_CONSTANT "SY_ATMZA" "0"
 SYSTEM_CONSTANT "SY_ATR" "1"
 SYSTEM_CONSTANT "SY_AWUE" "0"
 SYSTEM_CONSTANT "SY_AZUESHF" "3"
 SYSTEM_CONSTANT "SY_BATTSG" "0"
 SYSTEM_CONSTANT "SY_BBPHSYN" "0"
 SYSTEM_CONSTANT "SY_BDE" "0"
 SYSTEM_CONSTANT "SY_BGSRM" "1"
 SYSTEM_CONSTANT "SY_BGVMX" "1"
 SYSTEM_CONSTANT "SY_BGVZS" "0"
 SYSTEM_CONSTANT "SY_BH" "0"
 SYSTEM_CONSTANT "SY_BKS" "0"
 SYSTEM_CONSTANT "SY_BKV" "2"
 SYSTEM_CONSTANT "SY_BKVP" "3"
 SYSTEM_CONSTANT "SY_BLOOP" "0"
 SYSTEM_CONSTANT "SY_BNWSX" "0"
 SYSTEM_CONSTANT "SY_BUKDIAG" "0"
 SYSTEM_CONSTANT "SY_C167CS" "0"
 SYSTEM_CONSTANT "SY_C167CS_IRAM" "0"
 SYSTEM_CONSTANT "SY_C167CS_XRAM" "0"
 SYSTEM_CONSTANT "SY_CAN" "1"
 SYSTEM_CONSTANT "SY_CANAC" "1"
 SYSTEM_CONSTANT "SY_CANACC" "0"
 SYSTEM_CONSTANT "SY_CANADR" "0"
 SYSTEM_CONSTANT "SY_CANAIR" "1"
 SYSTEM_CONSTANT "SY_CANALL" "0"
 SYSTEM_CONSTANT "SY_CANBEM" "0"
 SYSTEM_CONSTANT "SY_CANBR2" "0"
 SYSTEM_CONSTANT "SY_CANBR3" "1"
 SYSTEM_CONSTANT "SY_CANBR8" "0"
 SYSTEM_CONSTANT "SY_CANBSG" "0"
 SYSTEM_CONSTANT "SY_CANCINS" "1"
 SYSTEM_CONSTANT "SY_CANCLA" "1"
 SYSTEM_CONSTANT "SY_CANGAT" "0"
 SYSTEM_CONSTANT "SY_CANGE2" "1"
 SYSTEM_CONSTANT "SY_CANGE3" "0"
 SYSTEM_CONSTANT "SY_CANGRA" "5"
 SYSTEM_CONSTANT "SY_CANLHV" "0"
 SYSTEM_CONSTANT "SY_CANLWS" "0"
 SYSTEM_CONSTANT "SY_CANMUX_KC" "1"
 SYSTEM_CONSTANT "SY_CANMUX_KK" "1"
 SYSTEM_CONSTANT "SY_CANMUX_MM" "0"
 SYSTEM_CONSTANT "SY_CANNIV" "0"
 SYSTEM_CONSTANT "SY_CANNOHK" "0"
 SYSTEM_CONSTANT "SY_CANTOG" "0"
 SYSTEM_CONSTANT "SY_CANZAS" "0"
 SYSTEM_CONSTANT "SY_CAN_B" "0"
 SYSTEM_CONSTANT "SY_CAN_C" "0"
 SYSTEM_CONSTANT "SY_CAN_CONFIG" "0"
 SYSTEM_CONSTANT "SY_CDCSIZE" "4"
 SYSTEM_CONSTANT "SY_CDKSIZE" "4"
 SYSTEM_CONSTANT "SY_CDTSIZE" "1"
 SYSTEM_CONSTANT "SY_CHKPROC" "75018"
 SYSTEM_CONSTANT "SY_CJ120" "0"
 SYSTEM_CONSTANT "SY_CJ125" "0"
 SYSTEM_CONSTANT "SY_CJ830" "0"
 SYSTEM_CONSTANT "SY_CJ830RST" "0"
 SYSTEM_CONSTANT "SY_CKBI" "0"
 SYSTEM_CONSTANT "SY_CLASIZE" "1"
 SYSTEM_CONSTANT "SY_CNG" "0"
 SYSTEM_CONSTANT "SY_CONFSL" "1"
 SYSTEM_CONSTANT "SY_COPOTI" "0"
 SYSTEM_CONSTANT "SY_CRCTAB" "2"
 SYSTEM_CONSTANT "SY_CSBVAR" "0"
 SYSTEM_CONSTANT "SY_CVT" "1"
 SYSTEM_CONSTANT "SY_DAGRFC" "4"
 SYSTEM_CONSTANT "SY_DCDACC" "2"
 SYSTEM_CONSTANT "SY_DCSAVE" "0"
 SYSTEM_CONSTANT "SY_DCV" "1"
 SYSTEM_CONSTANT "SY_DDYLSU" "0"
 SYSTEM_CONSTANT "SY_DECOS" "0"
 SYSTEM_CONSTANT "SY_DEGFE" "1"
 SYSTEM_CONSTANT "SY_DELFCMS" "0"
 SYSTEM_CONSTANT "SY_DFPMENV" "2"
 SYSTEM_CONSTANT "SY_DFPMTIM" "4"
 SYSTEM_CONSTANT "SY_DFPMVAR" "3"
 SYSTEM_CONSTANT "SY_DFPM_DATA_FAR" "0"
 SYSTEM_CONSTANT "SY_DGANZ" "1"
 SYSTEM_CONSTANT "SY_DHELSU" "0"
 SYSTEM_CONSTANT "SY_DIADRL" "0"
 SYSTEM_CONSTANT "SY_DIBLKL" "0"
 SYSTEM_CONSTANT "SY_DIMONL" "0"
 SYSTEM_CONSTANT "SY_DIPRGL" "0"
 SYSTEM_CONSTANT "SY_DIVARL" "0"
 SYSTEM_CONSTANT "SY_DKAT" "1"
 SYSTEM_CONSTANT "SY_DKATEF" "0"
 SYSTEM_CONSTANT "SY_DKATLRS" "1"
 SYSTEM_CONSTANT "SY_DKATNO" "0"
 SYSTEM_CONSTANT "SY_DKATSP" "0"
 SYSTEM_CONSTANT "SY_DKATSPF" "0"
 SYSTEM_CONSTANT "SY_DKATTH" "0"
 SYSTEM_CONSTANT "SY_DKHZ" "0"
 SYSTEM_CONSTANT "SY_DLCKD" "40"
 SYSTEM_CONSTANT "SY_DLCPEN" "40"
 SYSTEM_CONSTANT "SY_DLDP" "1"
 SYSTEM_CONSTANT "SY_DLS" "1"
 SYSTEM_CONSTANT "SY_DLSFHV" "0"
 SYSTEM_CONSTANT "SY_DLSFV" "0"
 SYSTEM_CONSTANT "SY_DLSHV" "0"
 SYSTEM_CONSTANT "SY_DLSU" "0"
 SYSTEM_CONSTANT "SY_DLSUV" "0"
 SYSTEM_CONSTANT "SY_DMDDVS" "0"
 SYSTEM_CONSTANT "SY_DMDVAR" "1"
 SYSTEM_CONSTANT "SY_DMDZAG" "0"
 SYSTEM_CONSTANT "SY_DMTL" "0"
 SYSTEM_CONSTANT "SY_DOPZW" "1"
 SYSTEM_CONSTANT "SY_DSKNO" "0"
 SYSTEM_CONSTANT "SY_DSKVND" "0"
 SYSTEM_CONSTANT "SY_DSL10MS" "0"
 SYSTEM_CONSTANT "SY_DSL2MS" "1"
 SYSTEM_CONSTANT "SY_DSM" "0"
 SYSTEM_CONSTANT "SY_DSS" "0"
 SYSTEM_CONSTANT "SY_DSU" "0"
 SYSTEM_CONSTANT "SY_DSVDK" "0"
 SYSTEM_CONSTANT "SY_DTANKL" "1"
 SYSTEM_CONSTANT "SY_DTES" "2"
 SYSTEM_CONSTANT "SY_DTHM" "1"
 SYSTEM_CONSTANT "SY_DUZND" "0"
 SYSTEM_CONSTANT "SY_DVEADA" "1"
 SYSTEM_CONSTANT "SY_EEPROM_ADDRESS_MODE" "0"
 SYSTEM_CONSTANT "SY_EEPROM_SIZE" "512"
 SYSTEM_CONSTANT "SY_EGAS" "1"
 SYSTEM_CONSTANT "SY_EGFE" "13"
 SYSTEM_CONSTANT "SY_EKPRMK" "1"
 SYSTEM_CONSTANT "SY_ELKUP" "0"
 SYSTEM_CONSTANT "SY_ENVBLOK" "2"
 SYSTEM_CONSTANT "SY_EOLT" "0"
 SYSTEM_CONSTANT "SY_ERCOS_TIMER_INPUT_SEL" "5"
 SYSTEM_CONSTANT "SY_ESNWS" "0"
 SYSTEM_CONSTANT "SY_ESTZ" "0"
 SYSTEM_CONSTANT "SY_ESUKNGN" "0"
 SYSTEM_CONSTANT "SY_ETKBYP" "0"
 SYSTEM_CONSTANT "SY_ETRART" "0"
 SYSTEM_CONSTANT "SY_FANT" "1"
 SYSTEM_CONSTANT "SY_FARRAM_EN" "1"
 SYSTEM_CONSTANT "SY_FCMDISP" "5"
 SYSTEM_CONSTANT "SY_FCMIRD" "0"
 SYSTEM_CONSTANT "SY_FCMSIZE" "20"
 SYSTEM_CONSTANT "SY_FDTHM" "0"
 SYSTEM_CONSTANT "SY_FFCSIZE" "11"
 SYSTEM_CONSTANT "SY_FFESIZE" "0"
 SYSTEM_CONSTANT "SY_FFTSIZE" "2"
 SYSTEM_CONSTANT "SY_FFZ" "1"
 SYSTEM_CONSTANT "SY_FKAT" "0"
 SYSTEM_CONSTANT "SY_FKAT2" "0"
 SYSTEM_CONSTANT "SY_FLASH_SIZE" "1024"
 SYSTEM_CONSTANT "SY_FLBOOT_V" "0"
 SYSTEM_CONSTANT "SY_FLUQ" "39"
 SYSTEM_CONSTANT "SY_FREQ_CPU" "24000"
 SYSTEM_CONSTANT "SY_FRROM_V" "1283"
 SYSTEM_CONSTANT "SY_FWFGR" "0"
 SYSTEM_CONSTANT "SY_GAP" "2"
 SYSTEM_CONSTANT "SY_GGGTS" "1"
 SYSTEM_CONSTANT "SY_GLST" "0"
 SYSTEM_CONSTANT "SY_GRDWOF" "0"
 SYSTEM_CONSTANT "SY_GRDWRT" "72"
 SYSTEM_CONSTANT "SY_GRUNDWERT" "72"
 SYSTEM_CONSTANT "SY_HBR" "0"
 SYSTEM_CONSTANT "SY_HDP" "0"
 SYSTEM_CONSTANT "SY_HFM" "1"
 SYSTEM_CONSTANT "SY_HFM2" "0"
 SYSTEM_CONSTANT "SY_HKAT" "0"
 SYSTEM_CONSTANT "SY_HKAT2" "0"
 SYSTEM_CONSTANT "SY_HKS" "0"
 SYSTEM_CONSTANT "SY_HLA" "0"
 SYSTEM_CONSTANT "SY_HLCCARB" "4"
 SYSTEM_CONSTANT "SY_HLSFFET" "0"
 SYSTEM_CONSTANT "SY_HLSHFET" "0"
 SYSTEM_CONSTANT "SY_HMM" "0"
 SYSTEM_CONSTANT "SY_HOMAGR" "0"
 SYSTEM_CONSTANT "SY_HSP" "0"
 SYSTEM_CONSTANT "SY_HWCONFIG_SLS" "1"
 SYSTEM_CONSTANT "SY_HWMSG" "0"
 SYSTEM_CONSTANT "SY_INGASOS" "6"
 SYSTEM_CONSTANT "SY_INI_OBD" "2"
 SYSTEM_CONSTANT "SY_INJTIM_PRE" "64"
 SYSTEM_CONSTANT "SY_INTFLASH_SIZE" "0"
 SYSTEM_CONSTANT "SY_ISOPROT" "0"
 SYSTEM_CONSTANT "SY_KHFMDY" "0"
 SYSTEM_CONSTANT "SY_KHSLS" "0"
 SYSTEM_CONSTANT "SY_KL50" "0"
 SYSTEM_CONSTANT "SY_KLDF" "1"
 SYSTEM_CONSTANT "SY_KMTR" "0"
 SYSTEM_CONSTANT "SY_KMTREG" "0"
 SYSTEM_CONSTANT "SY_KNWS" "0"
 SYSTEM_CONSTANT "SY_KOAC" "1"
 SYSTEM_CONSTANT "SY_KOBIDIR" "1"
 SYSTEM_CONSTANT "SY_KOEVAB" "0"
 SYSTEM_CONSTANT "SY_KOPWM" "0"
 SYSTEM_CONSTANT "SY_KORRZ" "1.23"
 SYSTEM_CONSTANT "SY_KRDY" "0"
 SYSTEM_CONSTANT "SY_KRMFTIM_PRE" "64"
 SYSTEM_CONSTANT "SY_KRNDY" "0"
 SYSTEM_CONSTANT "SY_KR_EXT" "0"
 SYSTEM_CONSTANT "SY_KR_INT" "1"
 SYSTEM_CONSTANT "SY_KS1" "0"
 SYSTEM_CONSTANT "SY_KS2" "2"
 SYSTEM_CONSTANT "SY_KS3" "1"
 SYSTEM_CONSTANT "SY_KS4" "3"
 SYSTEM_CONSTANT "SY_KSZA" "4"
 SYSTEM_CONSTANT "SY_KUPFGR" "0"
 SYSTEM_CONSTANT "SY_KUPOT" "0"
 SYSTEM_CONSTANT "SY_KWP2000VAG" "0"
 SYSTEM_CONSTANT "SY_KWP71" "1"
 SYSTEM_CONSTANT "SY_LAMBTS" "1"
 SYSTEM_CONSTANT "SY_LBK" "0"
 SYSTEM_CONSTANT "SY_LECK" "0"
 SYSTEM_CONSTANT "SY_LENKH" "1"
 SYSTEM_CONSTANT "SY_LENKHILFE_PORT" "1"
 SYSTEM_CONSTANT "SY_LFS" "0"
 SYSTEM_CONSTANT "SY_LLR" "0"
 SYSTEM_CONSTANT "SY_LOWRA" "0"
 SYSTEM_CONSTANT "SY_LRFKEF" "0"
 SYSTEM_CONSTANT "SY_LRHCAS" "0"
 SYSTEM_CONSTANT "SY_LRSEZ" "0"
 SYSTEM_CONSTANT "SY_LS" "0"
 SYSTEM_CONSTANT "SY_LSFHV" "0"
 SYSTEM_CONSTANT "SY_LSFNHK" "1"
 SYSTEM_CONSTANT "SY_LSFNHK2" "0"
 SYSTEM_CONSTANT "SY_LSFNVK" "0"
 SYSTEM_CONSTANT "SY_LSFNVK2" "0"
 SYSTEM_CONSTANT "SY_LSFV" "0"
 SYSTEM_CONSTANT "SY_LSHV" "0"
 SYSTEM_CONSTANT "SY_LSUGR" "0"
 SYSTEM_CONSTANT "SY_LSUIKR" "0"
 SYSTEM_CONSTANT "SY_LSUMRS" "0"
 SYSTEM_CONSTANT "SY_LSVV" "0"
 SYSTEM_CONSTANT "SY_LUART" "0"
 SYSTEM_CONSTANT "SY_LUEFTKONF" "0"
 SYSTEM_CONSTANT "SY_LUEKONF" "0"
 SYSTEM_CONSTANT "SY_LUFIKL" "0"
 SYSTEM_CONSTANT "SY_LUR" "0"
 SYSTEM_CONSTANT "SY_LUV" "0"
 SYSTEM_CONSTANT "SY_LWS" "0"
 SYSTEM_CONSTANT "SY_LZ_SIZE100MS" "0"
 SYSTEM_CONSTANT "SY_LZ_SIZE10MS" "0"
 SYSTEM_CONSTANT "SY_LZ_SIZE1MS" "0"
 SYSTEM_CONSTANT "SY_LZ_SIZE1S" "0"
 SYSTEM_CONSTANT "SY_LZ_SIZE200MS" "0"
 SYSTEM_CONSTANT "SY_LZ_SIZE20MS" "0"
 SYSTEM_CONSTANT "SY_LZ_SIZE2MS" "0"
 SYSTEM_CONSTANT "SY_LZ_SIZE50MS" "0"
 SYSTEM_CONSTANT "SY_LZ_SIZE5MS" "0"
 SYSTEM_CONSTANT "SY_LZ_SIZESYN" "0"
 SYSTEM_CONSTANT "SY_LZ_SIZESYN2" "0"
 SYSTEM_CONSTANT "SY_M1I00A" "190"
 SYSTEM_CONSTANT "SY_M1I00B" "31"
 SYSTEM_CONSTANT "SY_M1I00C" "232"
 SYSTEM_CONSTANT "SY_M1I00D" "17"
 SYSTEM_CONSTANT "SY_M1I20A" "128"
 SYSTEM_CONSTANT "SY_M1I20B" "0"
 SYSTEM_CONSTANT "SY_M1I20C" "16"
 SYSTEM_CONSTANT "SY_M1I20D" "0"
 SYSTEM_CONSTANT "SY_M2I00A" "126"
 SYSTEM_CONSTANT "SY_M2I00B" "24"
 SYSTEM_CONSTANT "SY_M2I00C" "0"
 SYSTEM_CONSTANT "SY_M2I00D" "0"
 SYSTEM_CONSTANT "SY_M5IH00A" "195"
 SYSTEM_CONSTANT "SY_M5IH00B" "0"
 SYSTEM_CONSTANT "SY_M5IH00C" "0"
 SYSTEM_CONSTANT "SY_M5IH00D" "0"
 SYSTEM_CONSTANT "SY_M5IH20A" "0"
 SYSTEM_CONSTANT "SY_M5IH20B" "0"
 SYSTEM_CONSTANT "SY_M5IH20C" "0"
 SYSTEM_CONSTANT "SY_M5IH20D" "0"
 SYSTEM_CONSTANT "SY_M5IH40A" "0"
 SYSTEM_CONSTANT "SY_M5IH40B" "0"
 SYSTEM_CONSTANT "SY_M5IH40C" "0"
 SYSTEM_CONSTANT "SY_M5IH40D" "0"
 SYSTEM_CONSTANT "SY_M5IH60A" "0"
 SYSTEM_CONSTANT "SY_M5IH60B" "0"
 SYSTEM_CONSTANT "SY_M5IH60C" "0"
 SYSTEM_CONSTANT "SY_M5IH60D" "0"
 SYSTEM_CONSTANT "SY_M5IH80A" "0"
 SYSTEM_CONSTANT "SY_M5IH80B" "0"
 SYSTEM_CONSTANT "SY_M5IH80C" "0"
 SYSTEM_CONSTANT "SY_M5IH80D" "0"
 SYSTEM_CONSTANT "SY_M5IV00A" "0"
 SYSTEM_CONSTANT "SY_M5IV00B" "0"
 SYSTEM_CONSTANT "SY_M5IV00C" "0"
 SYSTEM_CONSTANT "SY_M5IV00D" "1"
 SYSTEM_CONSTANT "SY_M5IV20A" "0"
 SYSTEM_CONSTANT "SY_M5IV20B" "0"
 SYSTEM_CONSTANT "SY_M5IV20C" "0"
 SYSTEM_CONSTANT "SY_M5IV20D" "1"
 SYSTEM_CONSTANT "SY_M5IV40A" "0"
 SYSTEM_CONSTANT "SY_M5IV40B" "0"
 SYSTEM_CONSTANT "SY_M5IV40C" "0"
 SYSTEM_CONSTANT "SY_M5IV40D" "1"
 SYSTEM_CONSTANT "SY_M5IV60A" "0"
 SYSTEM_CONSTANT "SY_M5IV60B" "0"
 SYSTEM_CONSTANT "SY_M5IV60C" "0"
 SYSTEM_CONSTANT "SY_M5IV60D" "1"
 SYSTEM_CONSTANT "SY_M5IV80A" "240"
 SYSTEM_CONSTANT "SY_M5IV80B" "0"
 SYSTEM_CONSTANT "SY_M5IV80C" "0"
 SYSTEM_CONSTANT "SY_M5IV80D" "0"
 SYSTEM_CONSTANT "SY_M6I00A" "168"
 SYSTEM_CONSTANT "SY_M6I00B" "128"
 SYSTEM_CONSTANT "SY_M6I00C" "0"
 SYSTEM_CONSTANT "SY_M6I00D" "0"
 SYSTEM_CONSTANT "SY_M7VAR" "0"
 SYSTEM_CONSTANT "SY_M8I00B" "128"
 SYSTEM_CONSTANT "SY_M8I00C" "0"
 SYSTEM_CONSTANT "SY_M8I00D" "0"
 SYSTEM_CONSTANT "SY_M8I00E" "0"
 SYSTEM_CONSTANT "SY_M9I00A" "60"
 SYSTEM_CONSTANT "SY_M9I00B" "0"
 SYSTEM_CONSTANT "SY_M9I00C" "0"
 SYSTEM_CONSTANT "SY_M9I00D" "0"
 SYSTEM_CONSTANT "SY_MAGER" "0"
 SYSTEM_CONSTANT "SY_MAX_EV" "4"
 SYSTEM_CONSTANT "SY_MDZUL" "6"
 SYSTEM_CONSTANT "SY_MFCCMODE1" "1"
 SYSTEM_CONSTANT "SY_MOST" "0"
 SYSTEM_CONSTANT "SY_MSGRED" "0"
 SYSTEM_CONSTANT "SY_MWB19" "0"
 SYSTEM_CONSTANT "SY_NLDG" "1"
 SYSTEM_CONSTANT "SY_NOHK" "0"
 SYSTEM_CONSTANT "SY_NOHK2" "0"
 SYSTEM_CONSTANT "SY_NOKT" "0"
 SYSTEM_CONSTANT "SY_NOXKAT" "0"
 SYSTEM_CONSTANT "SY_NSAD" "0"
 SYSTEM_CONSTANT "SY_NWGA" "0"
 SYSTEM_CONSTANT "SY_NWGA2" "0"
 SYSTEM_CONSTANT "SY_NWGE" "1"
 SYSTEM_CONSTANT "SY_NWGE2" "0"
 SYSTEM_CONSTANT "SY_NWRA" "0"
 SYSTEM_CONSTANT "SY_NWRE" "1"
 SYSTEM_CONSTANT "SY_NWROI" "0"
 SYSTEM_CONSTANT "SY_NWS" "1"
 SYSTEM_CONSTANT "SY_NWSA" "0"
 SYSTEM_CONSTANT "SY_NWSTIM_PRE" "16"
 SYSTEM_CONSTANT "SY_NWVAR" "1"
 SYSTEM_CONSTANT "SY_NZUEB" "720"
 SYSTEM_CONSTANT "SY_OBDCERT" "0"
 SYSTEM_CONSTANT "SY_ONCHIP_ROMFLASH" "1"
 SYSTEM_CONSTANT "SY_OVERSIZE" "2"
 SYSTEM_CONSTANT "SY_PBRPW" "1"
 SYSTEM_CONSTANT "SY_PEDABS" "0"
 SYSTEM_CONSTANT "SY_PGRAD" "4"
 SYSTEM_CONSTANT "SY_PGRAD2" "0"
 SYSTEM_CONSTANT "SY_PGRAD3" "0"
 SYSTEM_CONSTANT "SY_PGRAD4" "0"
 SYSTEM_CONSTANT "SY_PGTPO" "0"
 SYSTEM_CONSTANT "SY_PH2OFST" "0"
 SYSTEM_CONSTANT "SY_PHTWIN" "0"
 SYSTEM_CONSTANT "SY_PROGCAN" "0"
 SYSTEM_CONSTANT "SY_PROZESSLAUFZEIT" "1"
 SYSTEM_CONSTANT "SY_RDE" "1"
 SYSTEM_CONSTANT "SY_REDMX" "4"
 SYSTEM_CONSTANT "SY_REVTIM_PRE" "16"
 SYSTEM_CONSTANT "SY_RLAPP" "0"
 SYSTEM_CONSTANT "SY_SAACC" "0"
 SYSTEM_CONSTANT "SY_SALSU" "0"
 SYSTEM_CONSTANT "SY_SCHICHT" "0"
 SYSTEM_CONSTANT "SY_SDFP" "0"
 SYSTEM_CONSTANT "SY_SGANZ" "1"
 SYSTEM_CONSTANT "SY_SHK_OT" "1"
 SYSTEM_CONSTANT "SY_SLPANST" "0"
 SYSTEM_CONSTANT "SY_SLPANZ" "1"
 SYSTEM_CONSTANT "SY_SLS" "88"
 SYSTEM_CONSTANT "SY_SLSHK" "0"
 SYSTEM_CONSTANT "SY_SLVANST" "0"
 SYSTEM_CONSTANT "SY_SLVANZ" "1"
 SYSTEM_CONSTANT "SY_SLWG" "0"
 SYSTEM_CONSTANT "SY_SPRSTRT" "0"
 SYSTEM_CONSTANT "SY_SSPB" "0"
 SYSTEM_CONSTANT "SY_STA" "0"
 SYSTEM_CONSTANT "SY_STADAP" "1"
 SYSTEM_CONSTANT "SY_STARTPAKET" "0"
 SYSTEM_CONSTANT "SY_STERBTS" "0"
 SYSTEM_CONSTANT "SY_STEREO" "0"
 SYSTEM_CONSTANT "SY_STERFK" "0"
 SYSTEM_CONSTANT "SY_STERHK" "0"
 SYSTEM_CONSTANT "SY_STERSY" "0"
 SYSTEM_CONSTANT "SY_STERVK" "0"
 SYSTEM_CONSTANT "SY_STETLR" "1"
 SYSTEM_CONSTANT "SY_STVR" "0"
 SYSTEM_CONSTANT "SY_SU" "0"
 SYSTEM_CONSTANT "SY_SWEISR" "0"
 SYSTEM_CONSTANT "SY_SWE_B" "1"
 SYSTEM_CONSTANT "SY_SWE_C" "0"
 SYSTEM_CONSTANT "SY_SWE_K" "0"
 SYSTEM_CONSTANT "SY_SWE_S" "0"
 SYSTEM_CONSTANT "SY_T6MDTHM" "0"
 SYSTEM_CONSTANT "SY_TABST" "0"
 SYSTEM_CONSTANT "SY_TAGR" "0"
 SYSTEM_CONSTANT "SY_TCNS" "1"
 SYSTEM_CONSTANT "SY_TDZW" "1"
 SYSTEM_CONSTANT "SY_TEBF" "1"
 SYSTEM_CONSTANT "SY_TEETH" "60"
 SYSTEM_CONSTANT "SY_TEVE2" "0"
 SYSTEM_CONSTANT "SY_TFA" "0"
 SYSTEM_CONSTANT "SY_TFAOPL" "0"
 SYSTEM_CONSTANT "SY_TFBA" "1"
 SYSTEM_CONSTANT "SY_TFMA" "1"
 SYSTEM_CONSTANT "SY_TFMAP" "1"
 SYSTEM_CONSTANT "SY_TFMHST" "0"
 SYSTEM_CONSTANT "SY_TFMO" "0"
 SYSTEM_CONSTANT "SY_TFNS" "1"
 SYSTEM_CONSTANT "SY_TFOL" "0"
 SYSTEM_CONSTANT "SY_TFRK" "1"
 SYSTEM_CONSTANT "SY_TFST" "1"
 SYSTEM_CONSTANT "SY_TFUMG" "0"
 SYSTEM_CONSTANT "SY_TFVA" "1"
 SYSTEM_CONSTANT "SY_TFWL" "1"
 SYSTEM_CONSTANT "SY_THYDRO" "0"
 SYSTEM_CONSTANT "SY_TIMER1_PRESCALER" "16"
 SYSTEM_CONSTANT "SY_TIMER3_PRESCALER" "64"
 SYSTEM_CONSTANT "SY_TIMER8_PRESCALER" "64"
 SYSTEM_CONSTANT "SY_TKA" "0"
 SYSTEM_CONSTANT "SY_TKAA" "0"
 SYSTEM_CONSTANT "SY_TKAT" "0"
 SYSTEM_CONSTANT "SY_TLDR" "0"
 SYSTEM_CONSTANT "SY_TLR" "1"
 SYSTEM_CONSTANT "SY_TLRARES" "0"
 SYSTEM_CONSTANT "SY_TLRASP" "0"
 SYSTEM_CONSTANT "SY_TN" "1"
 SYSTEM_CONSTANT "SY_TP20" "0"
 SYSTEM_CONSTANT "SY_TRLX" "1"
 SYSTEM_CONSTANT "SY_TSFSIZE" "1"
 SYSTEM_CONSTANT "SY_TUM" "0"
 SYSTEM_CONSTANT "SY_TUN" "2"
 SYSTEM_CONSTANT "SY_TUNKEY" "1"
 SYSTEM_CONSTANT "SY_TUNKEY1" "1"
 SYSTEM_CONSTANT "SY_TURBO" "1"
 SYSTEM_CONSTANT "SY_TVVR" "1"
 SYSTEM_CONSTANT "SY_TWAN" "0"
 SYSTEM_CONSTANT "SY_TWDKS" "0"
 SYSTEM_CONSTANT "SY_TWSLP" "0"
 SYSTEM_CONSTANT "SY_UB13V" "185"
 SYSTEM_CONSTANT "SY_UBDEDIS" "92"
 SYSTEM_CONSTANT "SY_UBDEEN" "106"
 SYSTEM_CONSTANT "SY_UBKL15" "0"
 SYSTEM_CONSTANT "SY_UBOKDIS" "87"
 SYSTEM_CONSTANT "SY_UBOKEN" "102"
 SYSTEM_CONSTANT "SY_UBR" "1"
 SYSTEM_CONSTANT "SY_UBRSQ_W" "1140"
 SYSTEM_CONSTANT "SY_UBSQ_W" "720"
 SYSTEM_CONSTANT "SY_UHR" "4"
 SYSTEM_CONSTANT "SY_UMALS" "0"
 SYSTEM_CONSTANT "SY_USOFF" "205"
 SYSTEM_CONSTANT "SY_VAR" "290"
 SYSTEM_CONSTANT "SY_VS" "0"
 SYSTEM_CONSTANT "SY_VVT" "0"
 SYSTEM_CONSTANT "SY_WDTINPUT_SEL" "1"
 SYSTEM_CONSTANT "SY_WFS" "3"
 SYSTEM_CONSTANT "SY_WMAX" "78"
 SYSTEM_CONSTANT "SY_WMIN" "-32"
 SYSTEM_CONSTANT "SY_WNBM" "6"
 SYSTEM_CONSTANT "SY_WSM" "0"
 SYSTEM_CONSTANT "SY_WUBISO" "0"
 SYSTEM_CONSTANT "SY_ZAS" "0"
 SYSTEM_CONSTANT "SY_ZIZWV" "0"
 SYSTEM_CONSTANT "SY_ZMS" "1"
 SYSTEM_CONSTANT "SY_ZNDAUS" "1"
 SYSTEM_CONSTANT "SY_ZP_LAMREG_EUII" "0"
 SYSTEM_CONSTANT "SY_ZYLZA" "4"
 SYSTEM_CONSTANT "SY_ZZBANK" "0"
 SYSTEM_CONSTANT "SY_ZZLAM" "0"
 SYSTEM_CONSTANT "SY_ZZRL" "0"
 SYSTEM_CONSTANT "TSROHRES" "1230"
 SYSTEM_CONSTANT "VARKOD" "1" /end MOD_PAR
/begin MOD_COMMON "" BYTE_ORDER MSB_LAST ALIGNMENT_BYTE 1 ALIGNMENT_WORD 2 ALIGNMENT_LONG 2 /end MOD_COMMON
/* --- AgI-Objekt für ETK (ASAP V1.3B0), Stand 1.0 16.7.98 --- */
/begin IF_DATA ETK
 /begin TP_BLOB /*version:*/ 0x1000001 /*pba:*/ 0x0 /*reset_cfg:*/ 0xFFFFFF07
  /begin DISTAB_CFG /*dsptab:*/ 0xC /*dat_mod:*/ 0x1 /*rfg:*/ 0x2 /*trgsegad:*/ 0x383000 /*trg_cfg:*/ 0x1020100 TRG_MOD /*Id:*/ 0x0 /*trg_mod:*/ 0x27 0x0 0x0 0x0 /end DISTAB_CFG
  CODE_CHK /*prg_data:*/ 0x0 /*prg_length:*/ 0x0 /*prg_eram:*/ 0x0 /*prg_length:*/ 0x0 ETK_CFG 0xf 0xf0 0xff 0x3 0xff 0xee 0xff 0x1 /* EMU_RAM start_addr length CS offset >>>>> (multiple) */ /* EMU_DATA start_addr length CS offset >>>>> (multiple) */ /* EMU_CODE start_addr length CS offset >>>>> (multiple) */ /* RESERVED start_addr length CS offset >>>>> (multiple) */ RESERVED_DISTAB_MEMORY /*start_addr:*/ 0x817F50 0x144 EXTERN -1 -1 -1 -1 -1 ETK_MAILBOX /*pattern:*/ 0x55555555 /*page_ecu:*/ DATA /*ecu_adr:*/ 0x600000 /*..length:*/ 0x8000 /*page_am:*/ EXRAM /*am_adr:*/ 0x620000 /*..length:*/ 0x8000 /end TP_BLOB
 /begin SOURCE "Synchro" 103 1 QP_BLOB 1 0xA 0x817F50 0x3819EA 0x383036 0 0 0 /end SOURCE
 /begin SOURCE "10ms" 4 1 QP_BLOB 2 0x1A 0x817F66 0x3819F4 0x383038 10 0 0 /end SOURCE
 /begin SOURCE "100ms" 5 1 QP_BLOB 3 0x1E 0x817F9C 0x381A0E 0x38303A 100 0 0 /end SOURCE
/end IF_DATA
/begin CHARACTERISTIC A0 "Übertragungsfunktionskoeffizient" VALUE 0x81615E KwSw 0.1249981 fak_sw_b0p0625 -0.06250000 0.06249809 FORMAT "%10.8" /end CHARACTERISTIC
/begin CHARACTERISTIC A1 "Übertragungsfunktionskoeffizient" VALUE 0x816160 KwSw 0.1249981 fak_sw_b0p0625 -0.06250000 0.06249809 FORMAT "%10.8" /end CHARACTERISTIC
/begin CHARACTERISTIC A2 "Übertragungsfunktionskoeffizient" VALUE 0x816162 KwSw 0.1249981 fak_sw_b0p0625 -0.06250000 0.06249809 FORMAT "%10.8" /end CHARACTERISTIC
/begin CHARACTERISTIC ABOINI "Init-Wert  Start-Zähler für Erkennung Benzin im Öl" VALUE 0x819448 KwUb 255.0 dez 0.00 255.0 FORMAT "%5.1" /end CHARACTERISTIC
/begin CHARACTERISTIC ABOLRAR "Schwelle Anzahl Starts mit Benzin im Öl für reduzierte LRA" VALUE 0x819449 KwUb 255.0 dez 0.00 255.0 FORMAT "%5.1" /end CHARACTERISTIC
/begin CHARACTERISTIC ABOMX "max. Anzahl Start-Zähler für Erkennung Benzin im Öl" VALUE 0x81944A KwUb 255.0 dez 0.00 255.0 FORMAT "%5.1" /end CHARACTERISTIC
/begin CHARACTERISTIC ANZEKPVLMX "Max. Anzahl EKP Vorläufe ohne Erreichen von Startende" VALUE 0x81A6BD KwUb 255.0 dez 0.00 255.0 FORMAT "%5.1" /end CHARACTERISTIC
/begin CHARACTERISTIC ATMTAKR "Korrektur der Krümmertemperatur" CURVE 0x81BB82 KlAUbSstUbWSb 1275. temp_q5 -640.0 635.0 FORMAT "%5.1"
 /begin AXIS_DESCR STD_AXIS tans temp_ub_q0p75_o48 5 -48.00 143.3 FORMAT "%5.1" DEPOSIT ABSOLUTE /end AXIS_DESCR
/end CHARACTERISTIC
/begin CHARACTERISTIC ATMTANS "Temperaturkorrektur der Abgas-Modell-Temperatur" CURVE 0x81BB8E KlAUbSstUbWSb 1275. temp_q5 -640.0 635.0 FORMAT "%5.1"
 /begin AXIS_DESCR STD_AXIS tatu temp_ub_q0p75_o48 3 -48.00 143.3 FORMAT "%5.1" DEPOSIT ABSOLUTE /end AXIS_DESCR
/end CHARACTERISTIC
/begin CHARACTERISTIC ATRI "Verstärkungsfaktor I-Anteil Abgastemperaturregelung" VALUE 0x81D386 KwUw 0.1249981 zk100msxms_uw_b0p125 0.00 0.1249981 FORMAT "%9.7" /end CHARACTERISTIC
/begin CHARACTERISTIC ATRP "Verstärkungsfaktor P-Anteil Abgastemperaturregelung" VALUE 0x819405 KwUb 0.09961 temp_ub_b0p1 0.00 0.09961 FORMAT "%7.5" /end CHARACTERISTIC
/begin CHARACTERISTIC B1 "Übertragungsfunktionskoeffizient" VALUE 0x816164 KwSw 3.999939 fak_sw_b2 -2.000000 1.999939 FORMAT "%8.6" /end CHARACTERISTIC
/begin CHARACTERISTIC B2 "Übertragungsfunktionskoeffizient" VALUE 0x816166 KwSw 3.999939 fak_sw_b2 -2.000000 1.999939 FORMAT "%8.6" /end CHARACTERISTIC
/begin CHARACTERISTIC CATR "Konfigurationsbyte Abgastemperaturregelung" VALUE 0x819406 KwUb 255.0 dez 0.00 255.0 FORMAT "%5.1" /end CHARACTERISTIC
/begin CHARACTERISTIC CDPCV "Code wort PCV -Ventil vorhanden" VALUE 0x81944B KwUb 255.0 dez 0.00 255.0 FORMAT "%5.1" /end CHARACTERISTIC
/begin CHARACTERISTIC CLSDKH "Codewort für LSD-Abschaltung bei Kat. heizen" VALUE 0x811F6F KwUb 255.0 dez 0.00 255.0 FORMAT "%5.1" /end CHARACTERISTIC
/begin CHARACTERISTIC CWALE "Auslauferkennung aktiv" VALUE 0x8109C9 KwUb 255.0 dez 0.00 255.0 FORMAT "%5.1" /end CHARACTERISTIC
/begin CHARACTERISTIC CWARMD "Codewort Antiruckelfunktion" VALUE 0x8114D3 KwUb 255.0 dez 0.00 255.0 FORMAT "%5.1" /end CHARACTERISTIC
/begin CHARACTERISTIC CWATM "Codewort für Abgastemperaturmodell" VALUE 0x8184C5 KwUb 255.0 dez 0.00 255.0 FORMAT "%5.1" /end CHARACTERISTIC
/begin CHARACTERISTIC CWBBKD "Codewort für %BBKD" VALUE 0x810A72 KwUb 255.0 dez 0.00 255.0 FORMAT "%5.1" /end CHARACTERISTIC
/begin CHARACTERISTIC CWDKNOLU "" VALUE 0x8188F7 KwUb 255.0 dez 0.00 255.0 FORMAT "%5.1" /end CHARACTERISTIC
/begin CHARACTERISTIC CWDLRIKL "" VALUE 0x810B6E KwUb 255.0 dez 0.00 255.0 FORMAT "%5.1" /end CHARACTERISTIC
/begin CHARACTERISTIC CWESWEZ "Codewort Freigabe Kraftstoffmehrmenge bei Wiedereinsetzen" VALUE 0x818902 KwUb 255.0 dez 0.00 255.0 FORMAT "%5.1" /end CHARACTERISTIC
/begin CHARACTERISTIC CWEVAB "Codewort zur Abschaltung von Einspritzventilen" VALUE 0x818D07 KwUb 255.0 dez 0.00 255.0 FORMAT "%5.1" /end CHARACTERISTIC
/begin CHARACTERISTIC CW_AZUE "Konfigurationscodewort Zündausgabe" VALUE 0x810057 KwUb 255.0 DEZ 0.00 255.0 FORMAT "%5.1" /end CHARACTERISTIC
/begin CHARACTERISTIC DANTGESWNV "Schwelle Aktivierung D-Anteil (Geschwindigkeit) im unverstärkten Bereich" VALUE 0x814536 KwSw 1599.976 relDK_q0p02441 -800.0000 799.9756 FORMAT "%8.4" /end CHARACTERISTIC
/begin CHARACTERISTIC DANTGESWV "Schwelle Aktivierung D-Anteil (Geschwindigkeit) im verstärkten Bereich" VALUE 0x814538 KwSw 1599.976 relDK_q0p02441 -800.0000 799.9756 FORMAT "%8.4" /end CHARACTERISTIC
/begin CHARACTERISTIC DANTSCHWNV "Schwelle Aktivierung D-Anteil (Abweichung) im unverstärkten Bereich" VALUE 0x81453A KwSw 1599.976 relDK_q0p02441 -800.0000 799.9756 FORMAT "%8.4" /end CHARACTERISTIC
/begin CHARACTERISTIC DANTSCHWV "Schwelle Aktivierung D-Anteil (Abweichung) im verstärkten Bereich" VALUE 0x81453C KwSw 1599.976 relDK_q0p02441 -800.0000 799.9756 FORMAT "%8.4" /end CHARACTERISTIC
/begin CHARACTERISTIC DDTABGMN "min. zulässiger Gradient der Abgastemperatur" VALUE 0x81D388 KwSw 1279.980 tempacc_q0p0195 -640.0000 639.9805 FORMAT "%8.4" /end CHARACTERISTIC
/begin CHARACTERISTIC DDTABGMX "max. zulässiger Gradient der Abgastemperatur" VALUE 0x81D38A KwSw 1279.980 tempacc_q0p0195 -640.0000 639.9805 FORMAT "%8.4" /end CHARACTERISTIC
/begin CHARACTERISTIC DKLAGERT "zulässige Fehlerzeit für DK-Soll-/Istvergleich" VALUE 0x810B6F KwUb 5.100 t20msxs_ub_b5p1 0.00 5.100 FORMAT "%5.3" /end CHARACTERISTIC
/begin CHARACTERISTIC DLATRMN "Minimalbegrenzung Abgastemperaturregler" VALUE 0x81D38C KwSw 8.000000 fak_sw_b8 -8.000000 0.00 FORMAT "%8.6" /end CHARACTERISTIC
/begin CHARACTERISTIC DLATRNLN "Delta Lambdasoll in Notlauf Abgastemperaturregelung" CURVE 0x81D38E KlAUbSstUbWSb 1.992 fak_sb_b1 -1.000 0.9922 FORMAT "%5.3"
 /begin AXIS_DESCR STD_AXIS nmot nmot_ub_q40 5 0.00 10200. FORMAT "%5.0" DEPOSIT ABSOLUTE /end AXIS_DESCR
/end CHARACTERISTIC
/begin CHARACTERISTIC DLRDWDKSS1 "DLR, obere Grenze zur Parameterumschaltung" VALUE 0x81453E KwSw 99.99847 relDK_q0p00152 -50.00000 49.99847 FORMAT "%8.5" /end CHARACTERISTIC
/begin CHARACTERISTIC DLRDWDKSS2 "DLR, untere Grenze zur Parameterumschaltung" VALUE 0x814540 KwSw 99.99847 relDK_q0p00152 -50.00000 49.99847 FORMAT "%8.5" /end CHARACTERISTIC
/begin CHARACTERISTIC DLRHAFTMN "min. notwendiger I-Anteil im Haftreibunsfall" VALUE 0x81BF0A KwSw 100.0000 rel_q0p1957 -100.0000 0.00 FORMAT "%8.4" /end CHARACTERISTIC
/begin CHARACTERISTIC DLRHAFTST "max. Sollwertgradient zur Aktivierung der Haftreibunsroutine" VALUE 0x81BF0C KwSw 99.99847 relDK_q0p00152 -50.00000 49.99847 FORMAT "%8.5" /end CHARACTERISTIC
/begin CHARACTERISTIC DLRIAMAXA "maximal zulässiger I-Anteil" VALUE 0x814542 KwUw 100.0000 rel_q0p1957 0.00 100.0000 FORMAT "%8.4" /end CHARACTERISTIC
/begin CHARACTERISTIC DLRIKLPAR "DLR, I-Klein Parameter" VALUE 0x810B70 KwUb 15.94 relDK_q0p0625 0.00 15.94 FORMAT "%5.2" /end CHARACTERISTIC
/begin CHARACTERISTIC DLRININI "I-Anteil bei Inititialisierung der NLP-Funktion" VALUE 0x814544 KwUw 100.0000 rel_q0p1957 0.00 100.0000 FORMAT "%8.4" /end CHARACTERISTIC
/begin CHARACTERISTIC DLRKDONLP0 "DLR, D-Parameter über NLP" VALUE 0x810B71 KwUb 1020. relDK_q4 0.00 1020. FORMAT "%5.0" /end CHARACTERISTIC
/begin CHARACTERISTIC DLRKDUNLP0 "DLR, D-Parameter unter NLP (schwach)" VALUE 0x810B72 KwUb 1020. relDK_q4 0.00 1020. FORMAT "%5.0" /end CHARACTERISTIC
/begin CHARACTERISTIC DLRKDUNLP1 "DLR, D-Parameter unter NLP (mittel)" VALUE 0x810B73 KwUb 1020. relDK_q4 0.00 1020. FORMAT "%5.0" /end CHARACTERISTIC
/begin CHARACTERISTIC DLRKDUNLP2 "DLR, D-Parameter unter NLP (stark)" VALUE 0x810B74 KwUb 1020. relDK_q4 0.00 1020. FORMAT "%5.0" /end CHARACTERISTIC
/begin CHARACTERISTIC DLRKDUNLP3 "DLR, D-Parameter unter NLP (unverstärktes Poti)" VALUE 0x810B75 KwUb 1020. relDK_q4 0.00 1020. FORMAT "%5.0" /end CHARACTERISTIC
/begin CHARACTERISTIC DLRKIONLP0 "I-Anteil als f(abs(dwdkdlr_w)), über NLP" VAL_BLK 0x810B76 KwbUb 15.94 relDK_q0p0625 0.00 15.94 FORMAT "%5.2" NUMBER 32 /end CHARACTERISTIC
/begin CHARACTERISTIC DLRKIUNLP0 "I-Anteil als f(abs(dwdkdlr_w)), unter NLP (schwach)" VAL_BLK 0x810B96 KwbUb 15.94 relDK_q0p0625 0.00 15.94 FORMAT "%5.2" NUMBER 32 /end CHARACTERISTIC
/begin CHARACTERISTIC DLRKIUNLP1 "I-Anteil als f(abs(dwdkdlr_w)), unter NLP (mittel)" VAL_BLK 0x810BB6 KwbUb 15.94 relDK_q0p0625 0.00 15.94 FORMAT "%5.2" NUMBER 32 /end CHARACTERISTIC
/begin CHARACTERISTIC DLRKIUNLP2 "I-Anteil als f(abs(dwdkdlr_w)), unter NLP (stark)" VAL_BLK 0x810BD6 KwbUb 15.94 relDK_q0p0625 0.00 15.94 FORMAT "%5.2" NUMBER 32 /end CHARACTERISTIC
/begin CHARACTERISTIC DLRKIUNLP3 "I-Anteil als f(abs(dwdkdlr_w)), unter NLP (stark)" VAL_BLK 0x810BF6 KwbUb 15.94 relDK_q0p0625 0.00 15.94 FORMAT "%5.2" NUMBER 32 /end CHARACTERISTIC
/begin CHARACTERISTIC DLRKPONLP0 "DLR, P-Parameter über NLP" VALUE 0x810C16 KwUb 255.0 relDK_q1 0.00 255.0 FORMAT "%5.1" /end CHARACTERISTIC
/begin CHARACTERISTIC DLRKPUNLP0 "DLR, P-Parameter unter NLP (schwach)" VALUE 0x810C17 KwUb 255.0 relDK_q1 0.00 255.0 FORMAT "%5.1" /end CHARACTERISTIC
/begin CHARACTERISTIC DLRKPUNLP1 "DLR, P-Parameter unter NLP (mittel)" VALUE 0x810C18 KwUb 255.0 relDK_q1 0.00 255.0 FORMAT "%5.1" /end CHARACTERISTIC
/begin CHARACTERISTIC DLRKPUNLP2 "DLR, P-Parameter unter NLP (stark)" VALUE 0x810C19 KwUb 255.0 relDK_q1 0.00 255.0 FORMAT "%5.1" /end CHARACTERISTIC
/begin CHARACTERISTIC DLRKPUNLP3 "DLR, P-Parameter unter NLP (unverstärktes Poti)" VALUE 0x810C1A KwUb 255.0 relDK_q1 0.00 255.0 FORMAT "%5.1" /end CHARACTERISTIC
/begin CHARACTERISTIC DLRKREIS "DLR, Faktor Kreisverstärkung" VALUE 0x8188F8 KwUb 1.992 fak_ub_b2 0.00 1.992 FORMAT "%5.3" /end CHARACTERISTIC
/begin CHARACTERISTIC DLRKREISST "DLR, Faktor Kreisverstärkung zur Zeit des Motorstarts" VALUE 0x8188F9 KwUb 1.992 fak_ub_b2 0.00 1.992 FORMAT "%5.3" /end CHARACTERISTIC
/begin CHARACTERISTIC DLRNLPD "Unschärfebereich für DK-Notluftposition" VALUE 0x814546 KwUw 100.0000 relDK_uw_b100 0.00 100.0000 FORMAT "%8.4" /end CHARACTERISTIC
/begin CHARACTERISTIC DLRPID0T "Fehlerzeit für DLR-Stellbereich im Anschlag zur erweiterten Stellertauscherkenng" VALUE 0x814548 KwUw 655.3500 t10msxs_uw_b655p35 0.00 655.3500 FORMAT "%8.4" /end CHARACTERISTIC
/begin CHARACTERISTIC DLRPID1T "zulässige Fehlerzeit 1 für DLR-Stellbereich am Anschlag" VALUE 0x81454A KwUw 655.3500 t10msxs_uw_b655p35 0.00 655.3500 FORMAT "%8.4" /end CHARACTERISTIC
/begin CHARACTERISTIC DLRPID2T "zulässige Fehlerzeit 2 für DLR-Stellbereich am Anschlag" VALUE 0x81454C KwUw 655.3500 t10msxs_uw_b655p35 0.00 655.3500 FORMAT "%8.4" /end CHARACTERISTIC
/begin CHARACTERISTIC DLRPIDMAX "max. zulässiges PWM-Tastverhältnis für DLR" VALUE 0x81454E KwUw 99.99847 rel_uw_b100 0.00 99.99847 FORMAT "%8.5" /end CHARACTERISTIC
/begin CHARACTERISTIC DLRPIDMIN "min. zulässiges PWM-Tastverhältnis für DLR" VALUE 0x814550 KwUw 99.99847 rel_uw_b100 0.00 99.99847 FORMAT "%8.5" /end CHARACTERISTIC
/begin CHARACTERISTIC DLRUBSOLL "DLR, Batterie Normalspannung" VALUE 0x8188FA KwUb 17.95 spg_ubatt 0.00 17.95 FORMAT "%5.2" /end CHARACTERISTIC
/begin CHARACTERISTIC DLRUMABAND "Unsicherheitsband bei Sprung aus UMA-Bereich" VALUE 0x814552 KwUw 4.882813 relDK_q0p02441 0.00 4.882813 FORMAT "%8.6" /end CHARACTERISTIC
/begin CHARACTERISTIC DLRUMAIINI "Vorladewert I-Anteil bei Sprung aus UMA-Bereich" VALUE 0x814554 KwSw 12824.85 rel_q0p1957 -6412.524 6412.329 FORMAT "%8.3" /end CHARACTERISTIC
/begin CHARACTERISTIC DMARMX "Maximalbegrenzung des stationären Momenteneingriffs der Antiruckelfunktion" CURVE 0x819DA2 KlAUbSstUbWUb 99.61 rel_ub_b100 0.00 99.61 FORMAT "%5.2"
 /begin AXIS_DESCR STD_AXIS tmot temp_ub_q0p75_o48 6 -48.00 143.3 FORMAT "%5.1" DEPOSIT ABSOLUTE /end AXIS_DESCR
/end CHARACTERISTIC
/begin CHARACTERISTIC DNFILO "obere Schwelle für Gradient des Filterausgangs ndfil" VALUE 0x816168 KwSw 8191.750 nmot_sw_q0p25 0.00 8191.750 FORMAT "%8.3" /end CHARACTERISTIC
/begin CHARACTERISTIC DTABGS "Temperatur-Offset bei Ausfall eines Abgastemperatursensors" VALUE 0x81D39A KwUw 1279.980 temp_uw_q0p0195 0.00 1279.980 FORMAT "%8.3" /end CHARACTERISTIC
/begin CHARACTERISTIC DTIABS "Dti-Schwellwert für ersten Nachspritzer" VALUE 0x814580 KwUw 174.7600 tinjection_sy 0.00 174.7600 FORMAT "%8.4" /end CHARACTERISTIC
/begin CHARACTERISTIC DTIREL "Dti-Schwellwert für zweiten Nachspritzer" VALUE 0x810C22 KwUb 99.61 rel_ub_b99p6 0.00 99.61 FORMAT "%5.2" /end CHARACTERISTIC
/begin CHARACTERISTIC DTUMTAT "Offset Ansauglufttemperatur -> Umgebungstemperatur" VALUE 0x8184C6 KwUb 191.3 temp_ub_b191p25 0.00 191.3 FORMAT "%5.1" /end CHARACTERISTIC
/begin CHARACTERISTIC DUPW12KD "Maximal zulässige Differenz der PWG-Poti-Spannungen beim Kick-Down-Lernen" VALUE 0x8144CE KwUw 319.9951 spg_uw_q0p00488 0.00 319.9951 FORMAT "%8.4" /end CHARACTERISTIC
/begin CHARACTERISTIC DUPWGLKD "Maximal zulässige Änderung der PWG-Poti-Spannung während KD-Abspeicherung" VALUE 0x8144D0 KwUw 319.9951 spg_uw_q0p00488 0.00 319.9951 FORMAT "%8.4" /end CHARACTERISTIC
/begin CHARACTERISTIC DUPWKDLB "Mindestüberschreitung des gespeicherten KD-Werts für KD-Lernen im Betrieb" VALUE 0x8144D2 KwUw 319.9951 spg_uw_q0p00488 0.00 319.9951 FORMAT "%8.4" /end CHARACTERISTIC
/begin CHARACTERISTIC DUPWKDO "Delta PWG-Poti-Spannung zum Setzen der Kick-Down-Information" VALUE 0x8144D4 KwUw 319.9951 spg_uw_q0p00488 0.00 319.9951 FORMAT "%8.4" /end CHARACTERISTIC
/begin CHARACTERISTIC DUPWKDU "Delta PWG-Poti-Spannung zum Rücksetzen der Kick-Down-Information" VALUE 0x8144D6 KwUw 319.9951 spg_uw_q0p00488 0.00 319.9951 FORMAT "%8.4" /end CHARACTERISTIC
/begin CHARACTERISTIC DVEEST "Zeit für Heilungsversuch der DV-E-Endstufe" VALUE 0x810C1B KwUb 2.550 t10msxs_ub_b2p55 0.00 2.550 FORMAT "%5.3" /end CHARACTERISTIC
/begin CHARACTERISTIC DVFZAR "Hysterese fuer Geschwindigkeitsschwelle bei AR" VALUE 0x8114D4 KwUb 318.8 vfzg_ub_q1p25 0.00 318.8 FORMAT "%5.1" /end CHARACTERISTIC
/begin CHARACTERISTIC DWDKSBAMX "max. Soll-/Ist-DK-Winkel-Abweichung als f(dwdks)" CURVE 0x814556 KlAUwSstUwWUw 100.0000 relDK_uw_b100 0.00 100.0000 FORMAT "%8.4"
 /begin AXIS_DESCR STD_AXIS gwdk_kge relDK_q0p00152 5 0.00 99.99847 FORMAT "%8.5" DEPOSIT ABSOLUTE /end AXIS_DESCR
/end CHARACTERISTIC
/begin CHARACTERISTIC DWDKSIKLS "Schwelle zur Aktivierung des I-Kleinanteils" VALUE 0x81456C KwSw 1599.976 relDK_q0p02441 -800.0000 799.9756 FORMAT "%8.4" /end CHARACTERISTIC
/begin CHARACTERISTIC FATMRML_0_A "Faktor fuer die Aufteilung Abgas-/Abgas-Rohrwandtemperatur" CURVE 0x8184C7 GklWUb 0.9961 fak_ub_b1 0.00 0.9961
 /begin AXIS_DESCR COM_AXIS ml_w m_uw_b6553p5 7 0.00 6553.500 AXIS_PTS_REF SML07TMUW /end AXIS_DESCR
/end CHARACTERISTIC
/begin CHARACTERISTIC FATMRML_1_A "Faktor fuer die Aufteilung Abgas-/Abgas-Rohrwandtemperatur" CURVE 0x8184CE GklWUb 0.9961 fak_ub_b1 0.00 0.9961
 /begin AXIS_DESCR COM_AXIS ml_w m_uw_b6553p5 7 0.00 6553.500 AXIS_PTS_REF SML07TMUW /end AXIS_DESCR
/end CHARACTERISTIC
/begin CHARACTERISTIC FATRKRML "Faktor fuer die Aufteilung Abgas-/Abgas-Rohrwandtemperatur im Krümmer" CURVE 0x8184D5 GklWUb 0.9961 fak_ub_b1 0.00 0.9961
 /begin AXIS_DESCR COM_AXIS ml_w m_uw_b6553p5 7 0.00 6553.500 AXIS_PTS_REF SML07TMUW /end AXIS_DESCR
/end CHARACTERISTIC
/begin CHARACTERISTIC FLRAWG "Verstärkung Lastregler bei AT, WK geschlossen" CURVE 0x819DAF FklWUb 15.94 fak_ub_b16 0.00 15.94 FORMAT "%5.2"
 /begin AXIS_DESCR FIX_AXIS gangi dez 6 1.000 6.000 FORMAT "%5.3" FIX_AXIS_PAR 1 0 6 /end AXIS_DESCR
/end CHARACTERISTIC
/begin CHARACTERISTIC FLRHG_0_A "Verstärkung Lastregler" CURVE 0x819DB5 FklWUb 15.94 fak_ub_b16 0.00 15.94 FORMAT "%5.2"
 /begin AXIS_DESCR FIX_AXIS gangi dez 6 1.000 6.000 FORMAT "%5.3" FIX_AXIS_PAR 1 0 6 /end AXIS_DESCR
/end CHARACTERISTIC
/begin CHARACTERISTIC FLRHG_1_A "Verstärkung Lastregler" CURVE 0x819DBB FklWUb 15.94 fak_ub_b16 0.00 15.94 FORMAT "%5.2"
 /begin AXIS_DESCR FIX_AXIS gangi dez 6 1.000 6.000 FORMAT "%5.3" FIX_AXIS_PAR 1 0 6 /end AXIS_DESCR
/end CHARACTERISTIC
/begin CHARACTERISTIC FLRHG_2_A "Verstärkung Lastregler" CURVE 0x819DC1 FklWUb 15.94 fak_ub_b16 0.00 15.94 FORMAT "%5.2"
 /begin AXIS_DESCR FIX_AXIS gangi dez 6 1.000 6.000 FORMAT "%5.3" FIX_AXIS_PAR 1 0 6 /end AXIS_DESCR
/end CHARACTERISTIC
/begin CHARACTERISTIC FLRHG_3_A "Verstärkung Lastregler" CURVE 0x819DC7 FklWUb 15.94 fak_ub_b16 0.00 15.94 FORMAT "%5.2"
 /begin AXIS_DESCR FIX_AXIS gangi dez 6 1.000 6.000 FORMAT "%5.3" FIX_AXIS_PAR 1 0 6 /end AXIS_DESCR
/end CHARACTERISTIC
/begin CHARACTERISTIC FRARAWG "Verstärkungsfaktor bei AT, WK geschlossen" CURVE 0x819DCD FklWUb 3.113 fak_ub_b3p125 0.00 3.113 FORMAT "%5.3"
 /begin AXIS_DESCR FIX_AXIS gangi dez 6 1.000 6.000 FORMAT "%5.3" FIX_AXIS_PAR 1 0 6 /end AXIS_DESCR
/end CHARACTERISTIC
/begin CHARACTERISTIC FRARHG_0_A "Verstärkungsfaktor" CURVE 0x819DD3 FklWUb 3.113 fak_ub_b3p125 0.00 3.113 FORMAT "%5.3"
 /begin AXIS_DESCR FIX_AXIS gangi dez 6 1.000 6.000 FORMAT "%5.3" FIX_AXIS_PAR 1 0 6 /end AXIS_DESCR
/end CHARACTERISTIC
/begin CHARACTERISTIC FRARHG_1_A "Verstärkungsfaktor" CURVE 0x819DD9 FklWUb 3.113 fak_ub_b3p125 0.00 3.113 FORMAT "%5.3"
 /begin AXIS_DESCR FIX_AXIS gangi dez 6 1.000 6.000 FORMAT "%5.3" FIX_AXIS_PAR 1 0 6 /end AXIS_DESCR
/end CHARACTERISTIC
/begin CHARACTERISTIC FRARHG_2_A "Verstärkungsfaktor" CURVE 0x819DDF FklWUb 3.113 fak_ub_b3p125 0.00 3.113 FORMAT "%5.3"
 /begin AXIS_DESCR FIX_AXIS gangi dez 6 1.000 6.000 FORMAT "%5.3" FIX_AXIS_PAR 1 0 6 /end AXIS_DESCR
/end CHARACTERISTIC
/begin CHARACTERISTIC FRARHG_3_A "Verstärkungsfaktor" CURVE 0x819DE5 FklWUb 3.113 fak_ub_b3p125 0.00 3.113 FORMAT "%5.3"
 /begin AXIS_DESCR FIX_AXIS gangi dez 6 1.000 6.000 FORMAT "%5.3" FIX_AXIS_PAR 1 0 6 /end AXIS_DESCR
/end CHARACTERISTIC
/begin CHARACTERISTIC FWEAB "Rekursionskostante Wiedereinsetzfaktor abnehmend" VALUE 0x810C23 KwUb 0.9961 fak_ub_b1 0.00 0.9961 /end CHARACTERISTIC
/begin CHARACTERISTIC FWEAUF "Rekursionskonstante Wiedereinsetzfaktor zunehmend" VALUE 0x810C24 KwUb 0.9961 fak_ub_b1 0.00 0.9961 /end CHARACTERISTIC
/begin CHARACTERISTIC FWEMXT "maximaler Faktor Wiedereinsetzen Temperaturkennlinie" CURVE 0x818903 KlAUbSstUbWUb 0.9922 fak_ub_b2 1.000 1.992 FORMAT "%5.3"
 /begin AXIS_DESCR STD_AXIS tmot temp_ub_q0p75_o48 8 -48.00 143.3 FORMAT "%5.1" DEPOSIT ABSOLUTE /end AXIS_DESCR
/end CHARACTERISTIC
/begin CHARACTERISTIC FWMABGW_0_A "Faktor für Wärmemengen bei Wiederholstart für Taupunktende Abgas vor Vorkat" VALUE 0x81BD94 KwUb 0.9961 fak_ub_b1 0.00 0.9961 /end CHARACTERISTIC
/begin CHARACTERISTIC FWMABGW_1_A "Faktor für Wärmemengen bei Wiederholstart für Taupunktende Abgas vor Vorkat" VALUE 0x81BD95 KwUb 0.9961 fak_ub_b1 0.00 0.9961 /end CHARACTERISTIC
/begin CHARACTERISTIC FWMKATW_0_A "Faktor für Wärmemengen bei Wiederholstart für Taupunktende hinter Hauptkat" VALUE 0x81BD96 KwUb 0.9961 fak_ub_b1 0.00 0.9961 /end CHARACTERISTIC
/begin CHARACTERISTIC FWMKATW_1_A "Faktor für Wärmemengen bei Wiederholstart für Taupunktende hinter Hauptkat" VALUE 0x81BD97 KwUb 0.9961 fak_ub_b1 0.00 0.9961 /end CHARACTERISTIC
/begin CHARACTERISTIC FZN0 "Zylinderindividueller Faktor bei neutraler NW-Stellung EV 1" CURVE 0x818914 GklWUb 1.992 fak_ub_b2 0.00 1.992 FORMAT "%5.3"
 /begin AXIS_DESCR COM_AXIS nmot nmot_ub_q40 16 0.00 10200. AXIS_PTS_REF SNM16CIUB /end AXIS_DESCR
/end CHARACTERISTIC
/begin CHARACTERISTIC FZN1 "Zylinderindividueller Faktor bei neutraler NW-Stellung EV 1" CURVE 0x818924 GklWUb 1.992 fak_ub_b2 0.00 1.992 FORMAT "%5.3"
 /begin AXIS_DESCR COM_AXIS nmot nmot_ub_q40 16 0.00 10200. AXIS_PTS_REF SNM16CIUB /end AXIS_DESCR
/end CHARACTERISTIC
/begin CHARACTERISTIC FZN2 "Zylinderindividueller Faktor bei neutraler NW-Stellung EV 2" CURVE 0x818934 GklWUb 1.992 fak_ub_b2 0.00 1.992 FORMAT "%5.3"
 /begin AXIS_DESCR COM_AXIS nmot nmot_ub_q40 16 0.00 10200. AXIS_PTS_REF SNM16CIUB /end AXIS_DESCR
/end CHARACTERISTIC
/begin CHARACTERISTIC FZN3 "Zylinderindividueller Faktor bei neutraler NW-Stellung EV 3" CURVE 0x818944 GklWUb 1.992 fak_ub_b2 0.00 1.992 FORMAT "%5.3"
 /begin AXIS_DESCR COM_AXIS nmot nmot_ub_q40 16 0.00 10200. AXIS_PTS_REF SNM16CIUB /end AXIS_DESCR
/end CHARACTERISTIC
/begin CHARACTERISTIC FZNWN0 "Zylinderindividueller Faktor bei aktiver NW-Stellung EV 1" CURVE 0x818954 GklWUb 1.992 fak_ub_b2 0.00 1.992 FORMAT "%5.3"
 /begin AXIS_DESCR COM_AXIS nmot nmot_ub_q40 16 0.00 10200. AXIS_PTS_REF SNM16CIUB /end AXIS_DESCR
/end CHARACTERISTIC
/begin CHARACTERISTIC FZNWN1 "Zylinderindividueller Faktor bei aktiver NW-Stellung EV 1" CURVE 0x818964 GklWUb 1.992 fak_ub_b2 0.00 1.992 FORMAT "%5.3"
 /begin AXIS_DESCR COM_AXIS nmot nmot_ub_q40 16 0.00 10200. AXIS_PTS_REF SNM16CIUB /end AXIS_DESCR
/end CHARACTERISTIC
/begin CHARACTERISTIC FZNWN2 "Zylinderindividueller Faktor bei aktiver NW-Stellung EV 2" CURVE 0x818974 GklWUb 1.992 fak_ub_b2 0.00 1.992 FORMAT "%5.3"
 /begin AXIS_DESCR COM_AXIS nmot nmot_ub_q40 16 0.00 10200. AXIS_PTS_REF SNM16CIUB /end AXIS_DESCR
/end CHARACTERISTIC
/begin CHARACTERISTIC FZNWN3 "Zylinderindividueller Faktor bei aktiver NW-Stellung EV 3" CURVE 0x818984 GklWUb 1.992 fak_ub_b2 0.00 1.992 FORMAT "%5.3"
 /begin AXIS_DESCR COM_AXIS nmot nmot_ub_q40 16 0.00 10200. AXIS_PTS_REF SNM16CIUB /end AXIS_DESCR
/end CHARACTERISTIC
/begin CHARACTERISTIC IGESGA "Gesamt-Übersetzungsverhältnis" CURVE 0x810A48 FklWUb 25.50 fak_q0p1 0.00 25.50 FORMAT "%5.2"
 /begin AXIS_DESCR FIX_AXIS gangi dez 8 0.00 7.000 FORMAT "%5.3" FIX_AXIS_PAR 0 0 8 /end AXIS_DESCR
/end CHARACTERISTIC
/begin CHARACTERISTIC IGNDELAY "Synchroanzahl Zündfreigabeverzögerung AZUE" VALUE 0x810058 KwUb 255.0 DEZ 0.00 255.0 FORMAT "%5.1" /end CHARACTERISTIC
/begin CHARACTERISTIC IMLKS "Schwelle für integrierten Luftmassenstrom für Erkennung Benzin im Öl" VALUE 0x81944C KwUb 23.21 m_ub_b23p3 0.00 23.21 FORMAT "%5.2" /end CHARACTERISTIC
/begin CHARACTERISTIC IMTUMTAT "Schwelle integrierte Luftmasse für Bestimmung Umgebungstemperatur aus TANS" VALUE 0x8184DC KwUb 23.21 m_ub_b23p3 0.00 23.21 FORMAT "%5.2" /end CHARACTERISTIC
/begin CHARACTERISTIC KATMEXML_0_A "Exotherme Temperatur im KAT tkatm" CURVE 0x8184DD GklWSb 1275. temp_q5 -640.0 635.0 FORMAT "%5.1"
 /begin AXIS_DESCR COM_AXIS ml_w m_uw_b6553p5 7 0.00 6553.500 AXIS_PTS_REF SML07TMUW /end AXIS_DESCR
/end CHARACTERISTIC
/begin CHARACTERISTIC KATMEXML_1_A "Exotherme Temperatur im KAT tkatm" CURVE 0x8184E4 GklWSb 1275. temp_q5 -640.0 635.0 FORMAT "%5.1"
 /begin AXIS_DESCR COM_AXIS ml_w m_uw_b6553p5 7 0.00 6553.500 AXIS_PTS_REF SML07TMUW /end AXIS_DESCR
/end CHARACTERISTIC
/begin CHARACTERISTIC KATMIEXML_0_A "Exotherme Temperatur im KAT tikatm" CURVE 0x8184EB GklWSb 1275. temp_q5 -640.0 635.0 FORMAT "%5.1"
 /begin AXIS_DESCR COM_AXIS ml_w m_uw_b6553p5 7 0.00 6553.500 AXIS_PTS_REF SML07TMUW /end AXIS_DESCR
/end CHARACTERISTIC
/begin CHARACTERISTIC KATMIEXML_1_A "Exotherme Temperatur im KAT tikatm" CURVE 0x8184F2 GklWSb 1275. temp_q5 -640.0 635.0 FORMAT "%5.1"
 /begin AXIS_DESCR COM_AXIS ml_w m_uw_b6553p5 7 0.00 6553.500 AXIS_PTS_REF SML07TMUW /end AXIS_DESCR
/end CHARACTERISTIC
/begin CHARACTERISTIC KDLRIDDVE "Identifizierung des DLR-Parametersatzes zu DV-E-Typ" VALUE 0x8188FB KwUb 255.0 dez 0.00 255.0 FORMAT "%5.1" /end CHARACTERISTIC
/begin CHARACTERISTIC KFATLAK "Kennfeld Lambdakorrektur für Krümmerabgastemperatur" MAP 0x8184F9 GkfWSb 1275. temp_q5 -640.0 635.0 FORMAT "%5.1"
 /begin AXIS_DESCR COM_AXIS ml_w m_uw_b6553p5 6 0.00 6553.500 AXIS_PTS_REF SMT06TMUW /end AXIS_DESCR
 /begin AXIS_DESCR COM_AXIS lamsbg_w fak_uw_b16 6 0.00 15.99976 AXIS_PTS_REF SLX06TMUW /end AXIS_DESCR
/end CHARACTERISTIC
/begin CHARACTERISTIC KFATMABKA_0_A "Faktor für Abgastemperaturabnahme = f(Abstellzeit,Umgebungstemperatur)" MAP 0x81851D GkfWUb 0.9961 fak_ub_b1 0.00 0.9961
 /begin AXIS_DESCR COM_AXIS tabstatm_w t1sxs_uw_q1 6 0.00 65535.00 AXIS_PTS_REF STS06TMUW /end AXIS_DESCR
 /begin AXIS_DESCR COM_AXIS tatu temp_ub_q0p75_o48 5 -48.00 143.3 AXIS_PTS_REF STU05TMUB /end AXIS_DESCR
/end CHARACTERISTIC
/begin CHARACTERISTIC KFATMABKA_1_A "Faktor für Abgastemperaturabnahme = f(Abstellzeit,Umgebungstemperatur)" MAP 0x81853B GkfWUb 0.9961 fak_ub_b1 0.00 0.9961
 /begin AXIS_DESCR COM_AXIS tabstatm_w t1sxs_uw_q1 6 0.00 65535.00 AXIS_PTS_REF STS06TMUW /end AXIS_DESCR
 /begin AXIS_DESCR COM_AXIS tatu temp_ub_q0p75_o48 5 -48.00 143.3 AXIS_PTS_REF STU05TMUB /end AXIS_DESCR
/end CHARACTERISTIC
/begin CHARACTERISTIC KFATMABKK_0_A "Faktor für Abnahme der Katalysatortemperatur = f(Abstellzeit,Umg.temp.)" MAP 0x818559 GkfWUb 0.9961 fak_ub_b1 0.00 0.9961
 /begin AXIS_DESCR COM_AXIS tabstatm_w t1sxs_uw_q1 6 0.00 65535.00 AXIS_PTS_REF STS06TMUW /end AXIS_DESCR
 /begin AXIS_DESCR COM_AXIS tatu temp_ub_q0p75_o48 5 -48.00 143.3 AXIS_PTS_REF STU05TMUB /end AXIS_DESCR
/end CHARACTERISTIC
/begin CHARACTERISTIC KFATMABKK_1_A "Faktor für Abnahme der Katalysatortemperatur = f(Abstellzeit,Umg.temp.)" MAP 0x818577 GkfWUb 0.9961 fak_ub_b1 0.00 0.9961
 /begin AXIS_DESCR COM_AXIS tabstatm_w t1sxs_uw_q1 6 0.00 65535.00 AXIS_PTS_REF STS06TMUW /end AXIS_DESCR
 /begin AXIS_DESCR COM_AXIS tatu temp_ub_q0p75_o48 5 -48.00 143.3 AXIS_PTS_REF STU05TMUB /end AXIS_DESCR
/end CHARACTERISTIC
/begin CHARACTERISTIC KFATMKR "Kennfeld stationäre Krümmerabgastemperatur f(nmot,rl)" MAP 0x818595 KfAxUbAyUbSstxUbSstyUbWUb 1275. temp_ub_q5_o50 -50.00 1225. FORMAT "%5.0"
 /begin AXIS_DESCR STD_AXIS nmot nmot_ub_q40 8 0.00 10200. FORMAT "%5.0" DEPOSIT ABSOLUTE /end AXIS_DESCR
 /begin AXIS_DESCR STD_AXIS rl rel_ub_q0p75 8 0.00 191.3 FORMAT "%5.1" DEPOSIT ABSOLUTE /end AXIS_DESCR
/end CHARACTERISTIC
/begin CHARACTERISTIC KFATMLA_0_A "Kennfeld Abgastemperatur-Korrektur = f(Lambda)" MAP 0x8185E7 GkfWSb 1275. temp_q5 -640.0 635.0 FORMAT "%5.1"
 /begin AXIS_DESCR COM_AXIS ml_w m_uw_b6553p5 6 0.00 6553.500 AXIS_PTS_REF SML06TMUW /end AXIS_DESCR
 /begin AXIS_DESCR COM_AXIS lamsbg_w fak_uw_b16 6 0.00 15.99976 AXIS_PTS_REF SLX06TMUW /end AXIS_DESCR
/end CHARACTERISTIC
/begin CHARACTERISTIC KFATMLA_1_A "Kennfeld Abgastemperatur-Korrektur = f(Lambda)" MAP 0x81860B GkfWSb 1275. temp_q5 -640.0 635.0 FORMAT "%5.1"
 /begin AXIS_DESCR COM_AXIS ml_w m_uw_b6553p5 6 0.00 6553.500 AXIS_PTS_REF SML06TMUW /end AXIS_DESCR
 /begin AXIS_DESCR COM_AXIS lamsbg_w fak_uw_b16 6 0.00 15.99976 AXIS_PTS_REF SLX06TMUW /end AXIS_DESCR
/end CHARACTERISTIC
/begin CHARACTERISTIC KFATMZW_0_A "Kennfeld Abgastemperatur-Korrektur = f(Zündwinkelverstellung)" MAP 0x81862F GkfWSb 1275. temp_q5 -640.0 635.0 FORMAT "%5.1"
 /begin AXIS_DESCR COM_AXIS ml_w m_uw_b6553p5 6 0.00 6553.500 AXIS_PTS_REF SML06TMUW /end AXIS_DESCR
 /begin AXIS_DESCR COM_AXIS etazwimt rel_ub_b127p5 6 0.00 127.5 AXIS_PTS_REF SEZ06TMUB /end AXIS_DESCR
/end CHARACTERISTIC
/begin CHARACTERISTIC KFATMZW_1_A "Kennfeld Abgastemperatur-Korrektur = f(Zündwinkelverstellung)" MAP 0x818653 GkfWSb 1275. temp_q5 -640.0 635.0 FORMAT "%5.1"
 /begin AXIS_DESCR COM_AXIS ml_w m_uw_b6553p5 6 0.00 6553.500 AXIS_PTS_REF SML06TMUW /end AXIS_DESCR
 /begin AXIS_DESCR COM_AXIS etazwimt rel_ub_b127p5 6 0.00 127.5 AXIS_PTS_REF SEZ06TMUB /end AXIS_DESCR
/end CHARACTERISTIC
/begin CHARACTERISTIC KFATZWK "Kennfeld Zündwinkelkorrektur für Krümmerabgastemperatur" MAP 0x818677 GkfWSb 1275. temp_q5 -640.0 635.0 FORMAT "%5.1"
 /begin AXIS_DESCR COM_AXIS ml_w m_uw_b6553p5 6 0.00 6553.500 AXIS_PTS_REF SMT06TMUW /end AXIS_DESCR
 /begin AXIS_DESCR COM_AXIS etazwimt rel_ub_b127p5 6 0.00 127.5 AXIS_PTS_REF SEZ06TMUB /end AXIS_DESCR
/end CHARACTERISTIC
/begin CHARACTERISTIC KFDMDADP "Obere Schwelle für Momenteneingriff bei Dashpot" MAP 0x826A02 GkfWUw 99.99847 rel_uw_b100 0.00 99.99847 FORMAT "%8.5" /begin AXIS_DESCR COM_AXIS gangi dez 6 0.00 255.0 AXIS_PTS_REF SGA06MDUB /end AXIS_DESCR
 /begin AXIS_DESCR COM_AXIS mkar_w rel_sw_b100 8 -100.0000 99.99695 AXIS_PTS_REF SMK08MDSW /end AXIS_DESCR
/end CHARACTERISTIC
/begin CHARACTERISTIC KFDMDARO_0_A "Obere Schwelle für Momenteneingriff" MAP 0x826A62 GkfWUw 99.99847 rel_uw_b100 0.00 99.99847 FORMAT "%8.5" /begin AXIS_DESCR COM_AXIS gangi dez 6 0.00 255.0 AXIS_PTS_REF SGA06MDUB /end AXIS_DESCR
 /begin AXIS_DESCR COM_AXIS mkar_w rel_sw_b100 8 -100.0000 99.99695 AXIS_PTS_REF SMK08MDSW /end AXIS_DESCR
/end CHARACTERISTIC
/begin CHARACTERISTIC KFDMDARO_1_A "Obere Schwelle für Momenteneingriff" MAP 0x826AC2 GkfWUw 99.99847 rel_uw_b100 0.00 99.99847 FORMAT "%8.5" /begin AXIS_DESCR COM_AXIS gangi dez 6 0.00 255.0 AXIS_PTS_REF SGA06MDUB /end AXIS_DESCR
 /begin AXIS_DESCR COM_AXIS mkar_w rel_sw_b100 8 -100.0000 99.99695 AXIS_PTS_REF SMK08MDSW /end AXIS_DESCR
/end CHARACTERISTIC
/begin CHARACTERISTIC KFDMDARO_2_A "Obere Schwelle für Momenteneingriff" MAP 0x826B22 GkfWUw 99.99847 rel_uw_b100 0.00 99.99847 FORMAT "%8.5" /begin AXIS_DESCR COM_AXIS gangi dez 6 0.00 255.0 AXIS_PTS_REF SGA06MDUB /end AXIS_DESCR
 /begin AXIS_DESCR COM_AXIS mkar_w rel_sw_b100 8 -100.0000 99.99695 AXIS_PTS_REF SMK08MDSW /end AXIS_DESCR
/end CHARACTERISTIC
/begin CHARACTERISTIC KFDMDARO_3_A "Obere Schwelle für Momenteneingriff" MAP 0x826B82 GkfWUw 99.99847 rel_uw_b100 0.00 99.99847 FORMAT "%8.5" /begin AXIS_DESCR COM_AXIS gangi dez 6 0.00 255.0 AXIS_PTS_REF SGA06MDUB /end AXIS_DESCR
 /begin AXIS_DESCR COM_AXIS mkar_w rel_sw_b100 8 -100.0000 99.99695 AXIS_PTS_REF SMK08MDSW /end AXIS_DESCR
/end CHARACTERISTIC
/begin CHARACTERISTIC KFDMDAROS "Obere Schwelle für Momenteneingriff stationär" MAP 0x826BE2 GkfWUw 99.99847 rel_uw_b100 0.00 99.99847 FORMAT "%8.5" /begin AXIS_DESCR COM_AXIS gangi dez 6 0.00 255.0 AXIS_PTS_REF SGA06MDUB /end AXIS_DESCR
 /begin AXIS_DESCR COM_AXIS mkar_w rel_sw_b100 8 -100.0000 99.99695 AXIS_PTS_REF SMK08MDSW /end AXIS_DESCR
/end CHARACTERISTIC
/begin CHARACTERISTIC KFRLATR "Minimale Last für Abgastemperaturregelung" MAP 0x819407 KfAxUbAyUbSstxUbSstyUbWUb 191.3 rel_ub_q0p75 0.00 191.3 FORMAT "%5.1"
 /begin AXIS_DESCR STD_AXIS nmot nmot_ub_q40 5 0.00 10200. FORMAT "%5.0" DEPOSIT ABSOLUTE /end AXIS_DESCR
 /begin AXIS_DESCR STD_AXIS tans temp_ub_q0p75_o48 5 -48.00 143.3 FORMAT "%5.1" DEPOSIT ABSOLUTE /end AXIS_DESCR
/end CHARACTERISTIC
/begin CHARACTERISTIC KFTABGSS "Sollwert der Abgastemperatur" MAP 0x81D39C KfAxUbAyUbSstxUwSstyUwWUw 1279.980 temp_uw_q0p0195_o50 -50.00000 1229.980 FORMAT "%8.3"
 /begin AXIS_DESCR STD_AXIS nmot_w nmot_uw_q0p25 8 0.00 16383.75 FORMAT "%8.2" DEPOSIT ABSOLUTE /end AXIS_DESCR
 /begin AXIS_DESCR STD_AXIS rl_w rel_uw_q0p0234 8 0.00 1535.977 FORMAT "%8.3" DEPOSIT ABSOLUTE /end AXIS_DESCR
/end CHARACTERISTIC
/begin CHARACTERISTIC KFTATM_0_A "Kennfeld Abgastemperatur   f(nmot,rl)" MAP 0x81869B KfAxUbAyUbSstxUbSstyUbWUb 1275. temp_ub_q5_o50 -50.00 1225. FORMAT "%5.0"
 /begin AXIS_DESCR STD_AXIS nmot nmot_ub_q40 8 0.00 10200. FORMAT "%5.0" DEPOSIT ABSOLUTE /end AXIS_DESCR
 /begin AXIS_DESCR STD_AXIS rl rel_ub_q0p75 8 0.00 191.3 FORMAT "%5.1" DEPOSIT ABSOLUTE /end AXIS_DESCR
/end CHARACTERISTIC
/begin CHARACTERISTIC KFTATM_1_A "Kennfeld Abgastemperatur   f(nmot,rl)" MAP 0x8186ED KfAxUbAyUbSstxUbSstyUbWUb 1275. temp_ub_q5_o50 -50.00 1225. FORMAT "%5.0"
 /begin AXIS_DESCR STD_AXIS nmot nmot_ub_q40 8 0.00 10200. FORMAT "%5.0" DEPOSIT ABSOLUTE /end AXIS_DESCR
 /begin AXIS_DESCR STD_AXIS rl rel_ub_q0p75 8 0.00 191.3 FORMAT "%5.1" DEPOSIT ABSOLUTE /end AXIS_DESCR
/end CHARACTERISTIC
/begin CHARACTERISTIC KFTEVP "Kennfeld Periodendauer TEV" MAP 0x81A18F KfAxUbAyUbSstxUbSstyUbWUb 127.5 t500usxms_ub_q0p5 0.00 127.5 FORMAT "%5.1"
 /begin AXIS_DESCR STD_AXIS nmot nmot_ub_q40 5 0.00 10200. FORMAT "%5.0" DEPOSIT ABSOLUTE /end AXIS_DESCR
 /begin AXIS_DESCR STD_AXIS tateroh rel_ub_b99p6 9 0.00 99.61 FORMAT "%5.2" DEPOSIT ABSOLUTE /end AXIS_DESCR
/end CHARACTERISTIC
/begin CHARACTERISTIC KFTVTEV "Kennfeld Verzugszeit Tankentlüftungsventil" MAP 0x81A1CC KfAxUbAyUbSstxUbSstyUbWUb 127.5 t500usxms_ub_q0p5 0.00 127.5 FORMAT "%5.1"
 /begin AXIS_DESCR STD_AXIS ub spg_ubatt 6 0.00 17.95 FORMAT "%5.2" DEPOSIT ABSOLUTE /end AXIS_DESCR
 /begin AXIS_DESCR STD_AXIS tans temp_ub_q0p75_o48 3 -48.00 143.3 FORMAT "%5.1" DEPOSIT ABSOLUTE /end AXIS_DESCR
/end CHARACTERISTIC
/begin CHARACTERISTIC KFWMABG_0_A "Kennfeld für Wärmemengen-Schwellwert Taupunktende Abgas" MAP 0x81BB96 GkfWUw 29825.71 q_q0p4551 0.00 29825.71 FORMAT "%8.2"
 /begin AXIS_DESCR COM_AXIS tabgmst temp_ub_q5_o50 7 -50.00 1225. AXIS_PTS_REF ST107TMUB /end AXIS_DESCR
 /begin AXIS_DESCR COM_AXIS tmst temp_ub_q0p75_o48 5 -48.00 143.3 AXIS_PTS_REF STM05TMUB /end AXIS_DESCR
/end CHARACTERISTIC
/begin CHARACTERISTIC KFWMABG_1_A "Kennfeld für Wärmemengen-Schwellwert Taupunktende Abgas" MAP 0x81BBDC GkfWUw 29825.71 q_q0p4551 0.00 29825.71 FORMAT "%8.2"
 /begin AXIS_DESCR COM_AXIS tabgmst temp_ub_q5_o50 7 -50.00 1225. AXIS_PTS_REF ST107TMUB /end AXIS_DESCR
 /begin AXIS_DESCR COM_AXIS tmst temp_ub_q0p75_o48 5 -48.00 143.3 AXIS_PTS_REF STM05TMUB /end AXIS_DESCR
/end CHARACTERISTIC
/begin CHARACTERISTIC KFWMKAT_0_A "Kennfeld für Wärmemengen-Schwellwert Taupunktende hinter Kat" MAP 0x81BC22 GkfWUw 29825.71 q_q0p4551 0.00 29825.71 FORMAT "%8.2"
 /begin AXIS_DESCR COM_AXIS tkatmst temp_ub_q5_o50 7 -50.00 1225. AXIS_PTS_REF ST307TMUB /end AXIS_DESCR
 /begin AXIS_DESCR COM_AXIS tmst temp_ub_q0p75_o48 5 -48.00 143.3 AXIS_PTS_REF STM05TMUB /end AXIS_DESCR
/end CHARACTERISTIC
/begin CHARACTERISTIC KFWMKAT_1_A "Kennfeld für Wärmemengen-Schwellwert Taupunktende hinter Kat" MAP 0x81BC68 GkfWUw 29825.71 q_q0p4551 0.00 29825.71 FORMAT "%8.2"
 /begin AXIS_DESCR COM_AXIS tkatmst temp_ub_q5_o50 7 -50.00 1225. AXIS_PTS_REF ST307TMUB /end AXIS_DESCR
 /begin AXIS_DESCR COM_AXIS tmst temp_ub_q0p75_o48 5 -48.00 143.3 AXIS_PTS_REF STM05TMUB /end AXIS_DESCR
/end CHARACTERISTIC
/begin CHARACTERISTIC KIFZGAWG "Integratorverstärkung des Fahrzeugmodells bei AT, geschlossene WK" CURVE 0x826C42 FklWUw 4863.926 fak_uw_b4864 0.00 4863.926 FORMAT "%8.3"
 /begin AXIS_DESCR FIX_AXIS gangi dez 6 1.000 6.000 FORMAT "%5.3" FIX_AXIS_PAR 1 0 6 /end AXIS_DESCR
/end CHARACTERISTIC
/begin CHARACTERISTIC KIFZGHG_0_A "Integratorverstärkung des Fahrzeugmodells bei Handschalter" CURVE 0x826C4E FklWUw 4863.926 fak_uw_b4864 0.00 4863.926 FORMAT "%8.3"
 /begin AXIS_DESCR FIX_AXIS gangi dez 6 1.000 6.000 FORMAT "%5.3" FIX_AXIS_PAR 1 0 6 /end AXIS_DESCR
/end CHARACTERISTIC
/begin CHARACTERISTIC KIFZGHG_1_A "Integratorverstärkung des Fahrzeugmodells bei Handschalter" CURVE 0x826C5A FklWUw 4863.926 fak_uw_b4864 0.00 4863.926 FORMAT "%8.3"
 /begin AXIS_DESCR FIX_AXIS gangi dez 6 1.000 6.000 FORMAT "%5.3" FIX_AXIS_PAR 1 0 6 /end AXIS_DESCR
/end CHARACTERISTIC
/begin CHARACTERISTIC KIFZGHG_2_A "Integratorverstärkung des Fahrzeugmodells bei Handschalter" CURVE 0x826C66 FklWUw 4863.926 fak_uw_b4864 0.00 4863.926 FORMAT "%8.3"
 /begin AXIS_DESCR FIX_AXIS gangi dez 6 1.000 6.000 FORMAT "%5.3" FIX_AXIS_PAR 1 0 6 /end AXIS_DESCR
/end CHARACTERISTIC
/begin CHARACTERISTIC KIFZGHG_3_A "Integratorverstärkung des Fahrzeugmodells bei Handschalter" CURVE 0x826C72 FklWUw 4863.926 fak_uw_b4864 0.00 4863.926 FORMAT "%8.3"
 /begin AXIS_DESCR FIX_AXIS gangi dez 6 1.000 6.000 FORMAT "%5.3" FIX_AXIS_PAR 1 0 6 /end AXIS_DESCR
/end CHARACTERISTIC
/begin CHARACTERISTIC KLATMILAE "Exotherme Temperaturabnahme bei Anfettung tikatm" CURVE 0x81873F GklWUb 1.992 fak_ub_b2 0.00 1.992 FORMAT "%5.3"
 /begin AXIS_DESCR COM_AXIS lamsbg_w fak_uw_b16 6 0.00 15.99976 AXIS_PTS_REF SLX06TMUW /end AXIS_DESCR
/end CHARACTERISTIC
/begin CHARACTERISTIC KLATMIZWE "Exotherme Temperaturabnahme im Kat bei späterem Zündwinkel tikatm" CURVE 0x818745 GklWUb 1.992 fak_ub_b2 0.00 1.992 FORMAT "%5.3"
 /begin AXIS_DESCR COM_AXIS etazwimt rel_ub_b127p5 6 0.00 127.5 AXIS_PTS_REF SEZ06TMUB /end AXIS_DESCR
/end CHARACTERISTIC
/begin CHARACTERISTIC KLATMLAE "Exotherme Temperaturabnahme bei Anfettung" CURVE 0x81874B GklWUb 1.992 fak_ub_b2 0.00 1.992 FORMAT "%5.3"
 /begin AXIS_DESCR COM_AXIS lamsbg_w fak_uw_b16 6 0.00 15.99976 AXIS_PTS_REF SLX06TMUW /end AXIS_DESCR
/end CHARACTERISTIC
/begin CHARACTERISTIC KLATMZWE_0_A "Exotherme Temperaturabnahme im Kat bei späterem Zündwinkel tkatm" CURVE 0x818751 GklWUb 1.992 fak_ub_b2 0.00 1.992 FORMAT "%5.3"
 /begin AXIS_DESCR COM_AXIS etazwimt rel_ub_b127p5 6 0.00 127.5 AXIS_PTS_REF SEZ06TMUB /end AXIS_DESCR
/end CHARACTERISTIC
/begin CHARACTERISTIC KLATMZWE_1_A "Exotherme Temperaturabnahme im Kat bei späterem Zündwinkel tkatm" CURVE 0x818757 GklWUb 1.992 fak_ub_b2 0.00 1.992 FORMAT "%5.3"
 /begin AXIS_DESCR COM_AXIS etazwimt rel_ub_b127p5 6 0.00 127.5 AXIS_PTS_REF SEZ06TMUB /end AXIS_DESCR
/end CHARACTERISTIC
/begin CHARACTERISTIC KLNDNWMN "Kennlinie minimaldrehzahl für Diagnose Nockenwellensteuerung" CURVE 0x81A30A KlAUbSstUbWUb 10200. nmot_ub_q40 0.00 10200. FORMAT "%5.0"
 /begin AXIS_DESCR STD_AXIS tmot temp_ub_q0p75_o48 6 -48.00 143.3 FORMAT "%5.1" DEPOSIT ABSOLUTE /end AXIS_DESCR
/end CHARACTERISTIC
/begin CHARACTERISTIC KLTABGPRN "Prädizierte Anstiegszeit der Abgastemperatur für den Sensor Notlauf" CURVE 0x81942C FklWUb 15.94 t100msxs_q0p0625 0.00 15.94 FORMAT "%5.2"
 /begin AXIS_DESCR FIX_AXIS gangi dez 8 0.00 7.000 FORMAT "%5.3" FIX_AXIS_PAR 0 0 8 /end AXIS_DESCR
/end CHARACTERISTIC
/begin CHARACTERISTIC KLTTABGPR "Prädizierte Anstiegszeit der Abgastemperatur" CURVE 0x819434 FklWUb 15.94 t100msxs_q0p0625 0.00 15.94 FORMAT "%5.2"
 /begin AXIS_DESCR FIX_AXIS gangi dez 8 0.00 7.000 FORMAT "%5.3" FIX_AXIS_PAR 0 0 8 /end AXIS_DESCR
/end CHARACTERISTIC
/begin CHARACTERISTIC LATRO "Obergrenze Lambdasoll für Abgastemperaturregelung" VALUE 0x81D440 KwUw 15.99976 fak_uw_b16 0.00 15.99976 FORMAT "%8.5" /end CHARACTERISTIC
/begin CHARACTERISTIC MSNPCV "Massenstrom über PCV Ventil" CURVE 0x81944D KlAUbSstUbWUb 25.50 m_q0p1 0.00 25.50 FORMAT "%5.2"
 /begin AXIS_DESCR STD_AXIS dpspu p_ub_q10 14 0.00 2550. FORMAT "%5.0" DEPOSIT ABSOLUTE /end AXIS_DESCR
/end CHARACTERISTIC
/begin CHARACTERISTIC MSTPKTU "Kennlinie Massenstrom-Schwelle für Verzögerung Taupunktende hinter Kat" CURVE 0x81BCAE KlAUbSstUbWUw 6553.500 m_uw_b6553p5 0.00 6553.500 FORMAT "%8.3"
 /begin AXIS_DESCR STD_AXIS tatu temp_ub_q0p75_o48 4 -48.00 143.3 FORMAT "%5.1" DEPOSIT ABSOLUTE /end AXIS_DESCR
/end CHARACTERISTIC
/begin CHARACTERISTIC NARAO "obere Drehzahlschwelle für AR aktiv" VALUE 0x8114D5 KwUb 10200. nmot_ub_q40 0.00 10200. FORMAT "%5.0" /end CHARACTERISTIC
/begin CHARACTERISTIC NARASTG "Drehzahlschwelle in hoeherem Gang fuer AR aktiv" CURVE 0x8114D6 FklWUb 10200. nmot_ub_q40 0.00 10200. FORMAT "%5.0"
 /begin AXIS_DESCR FIX_AXIS gangi dez 6 1.000 6.000 FORMAT "%5.3" FIX_AXIS_PAR 1 0 6 /end AXIS_DESCR
/end CHARACTERISTIC
/begin CHARACTERISTIC NARLLGA "Drehzahlschwelle für AR im Leerlauf" CURVE 0x819DEB FklWUb 10200. nmot_ub_q40 0.00 10200. FORMAT "%5.0"
 /begin AXIS_DESCR FIX_AXIS gangi dez 6 1.000 6.000 FORMAT "%5.3" FIX_AXIS_PAR 1 0 6 /end AXIS_DESCR
/end CHARACTERISTIC
/begin CHARACTERISTIC NDFILOG "Schwelle für Filterausgang ndfil" CURVE 0x81616A FklWUw 16383.75 nmot_uw_q0p25 0.00 16383.75 FORMAT "%8.2"
 /begin AXIS_DESCR FIX_AXIS gangi dez 6 1.000 6.000 FORMAT "%5.3" FIX_AXIS_PAR 1 0 6 /end AXIS_DESCR
/end CHARACTERISTIC
/begin CHARACTERISTIC NDIFFOG "Schwelle Drehzahldifferenz zum Auslösen Ini der AR beim Verzögern" CURVE 0x826C7E FklWSw 16383.75 nmot_sw_q0p25 -8192.000 8191.750 FORMAT "%8.3"
 /begin AXIS_DESCR FIX_AXIS gangi dez 6 1.000 6.000 FORMAT "%5.3" FIX_AXIS_PAR 1 0 6 /end AXIS_DESCR
/end CHARACTERISTIC
/begin CHARACTERISTIC NDLSO "obere Drehzahlschwelle für digitale Leerlaufstabilisierung" VALUE 0x811F70 KwUb 2550. nmot_ub_q10 0.00 2550. FORMAT "%5.0" /end CHARACTERISTIC
/begin CHARACTERISTIC NDLSU "untere Drehzahlschwelle für digitale Leerlaufstabilisierung" VALUE 0x811F71 KwUb 2550. nmot_ub_q10 0.00 2550. FORMAT "%5.0" /end CHARACTERISTIC
/begin CHARACTERISTIC NDNWMN "Minimaldrehzahl für Diagnose Nockenwellensteuerung" VALUE 0x81A317 KwUb 10200. nmot_ub_q40 0.00 10200. FORMAT "%5.0" /end CHARACTERISTIC
/begin CHARACTERISTIC NDNWMNFA "Minimaldrehzahl für Diagnose Nockenwellensteuerung bei Testeranforderung" VALUE 0x81A318 KwUb 10200. nmot_ub_q40 0.00 10200. FORMAT "%5.0" /end CHARACTERISTIC
/begin CHARACTERISTIC NDNWMX "Maximaldrehzahl für Diagnose Nockenwellensteuerung" VALUE 0x81A319 KwUb 10200. nmot_ub_q40 0.00 10200. FORMAT "%5.0" /end CHARACTERISTIC
/begin CHARACTERISTIC NGANGMIN_0_A "Schwelle fuer Gangerkennung, Mindestwert PLausibilitaetstest" VALUE 0x814456 KwUw 16383.75 nmot_uw_q0p25 0.00 16383.75 FORMAT "%8.2" /end CHARACTERISTIC
/begin CHARACTERISTIC NGANGMIN_1_A "Schwelle fuer Gangerkennung, Mindestwert PLausibilitaetstest" VALUE 0x814458 KwUw 16383.75 nmot_uw_q0p25 0.00 16383.75 FORMAT "%8.2" /end CHARACTERISTIC
/begin CHARACTERISTIC NGANGMIN_2_A "Schwelle fuer Gangerkennung, Mindestwert PLausibilitaetstest" VALUE 0x81445A KwUw 16383.75 nmot_uw_q0p25 0.00 16383.75 FORMAT "%8.2" /end CHARACTERISTIC
/begin CHARACTERISTIC NGANGMIN_3_A "Schwelle fuer Gangerkennung, Mindestwert PLausibilitaetstest" VALUE 0x81445C KwUw 16383.75 nmot_uw_q0p25 0.00 16383.75 FORMAT "%8.2" /end CHARACTERISTIC
/begin CHARACTERISTIC NMXSKA "Maximaldrehzahl bei unbekannter Drosselklappenposition -> Ev-Abschaltung" VALUE 0x811178 KwUb 10200. nmot_ub_q40 0.00 10200. FORMAT "%5.0" /end CHARACTERISTIC
/begin CHARACTERISTIC NTUMTAT "Schwelle Drehzahl für Bestimmung Umgebungstemperatur aus TANS" VALUE 0x81875D KwUb 10200. nmot_ub_q40 0.00 10200. FORMAT "%5.0" /end CHARACTERISTIC
/begin CHARACTERISTIC NVG "Faktor zur Berechnung Initialisierungsdrehzahl" CURVE 0x826C8A FklWUw 511.9922 qnv_uw_b512 0.00 511.9922 FORMAT "%8.4"
 /begin AXIS_DESCR FIX_AXIS gangi dez 6 1.000 6.000 FORMAT "%5.3" FIX_AXIS_PAR 1 0 6 /end AXIS_DESCR
/end CHARACTERISTIC
/begin CHARACTERISTIC NVMNG "Minimales Drehzahl/Geschwindigkeits-Verhältnis" CURVE 0x826C96 FklWUw 511.9922 qnv_uw_b512 0.00 511.9922 FORMAT "%8.4"
 /begin AXIS_DESCR FIX_AXIS gangi dez 6 1.000 6.000 FORMAT "%5.3" FIX_AXIS_PAR 1 0 6 /end AXIS_DESCR
/end CHARACTERISTIC
/begin CHARACTERISTIC NVMXG "Maximales Drehzahl/Geschwindigkeits-Verhältnis" CURVE 0x826CA2 FklWUw 511.9922 qnv_uw_b512 0.00 511.9922 FORMAT "%8.4"
 /begin AXIS_DESCR FIX_AXIS gangi dez 6 1.000 6.000 FORMAT "%5.3" FIX_AXIS_PAR 1 0 6 /end AXIS_DESCR
/end CHARACTERISTIC
/begin CHARACTERISTIC NVQUOT1O_0_A "Gangerkennung n/v 1 Gang oben" VALUE 0x81445E KwUw 511.9922 qnv_uw_b512 0.00 511.9922 FORMAT "%8.4" /end CHARACTERISTIC
/begin CHARACTERISTIC NVQUOT1O_1_A "Gangerkennung n/v 1 Gang oben" VALUE 0x814460 KwUw 511.9922 qnv_uw_b512 0.00 511.9922 FORMAT "%8.4" /end CHARACTERISTIC
/begin CHARACTERISTIC NVQUOT1O_2_A "Gangerkennung n/v 1 Gang oben" VALUE 0x814462 KwUw 511.9922 qnv_uw_b512 0.00 511.9922 FORMAT "%8.4" /end CHARACTERISTIC
/begin CHARACTERISTIC NVQUOT1O_3_A "Gangerkennung n/v 1 Gang oben" VALUE 0x814464 KwUw 511.9922 qnv_uw_b512 0.00 511.9922 FORMAT "%8.4" /end CHARACTERISTIC
/begin CHARACTERISTIC NVQUOT1U_0_A "Gangerekennung n/v 1 Gang unten" VALUE 0x814466 KwUw 511.9922 qnv_uw_b512 0.00 511.9922 FORMAT "%8.4" /end CHARACTERISTIC
/begin CHARACTERISTIC NVQUOT1U_1_A "Gangerekennung n/v 1 Gang unten" VALUE 0x814468 KwUw 511.9922 qnv_uw_b512 0.00 511.9922 FORMAT "%8.4" /end CHARACTERISTIC
/begin CHARACTERISTIC NVQUOT1U_2_A "Gangerekennung n/v 1 Gang unten" VALUE 0x81446A KwUw 511.9922 qnv_uw_b512 0.00 511.9922 FORMAT "%8.4" /end CHARACTERISTIC
/begin CHARACTERISTIC NVQUOT1U_3_A "Gangerekennung n/v 1 Gang unten" VALUE 0x81446C KwUw 511.9922 qnv_uw_b512 0.00 511.9922 FORMAT "%8.4" /end CHARACTERISTIC
/begin CHARACTERISTIC NVQUOT2O_0_A "Gangerkennung n/v 2 Gang oben" VALUE 0x81446E KwUw 511.9922 qnv_uw_b512 0.00 511.9922 FORMAT "%8.4" /end CHARACTERISTIC
/begin CHARACTERISTIC NVQUOT2O_1_A "Gangerkennung n/v 2 Gang oben" VALUE 0x814470 KwUw 511.9922 qnv_uw_b512 0.00 511.9922 FORMAT "%8.4" /end CHARACTERISTIC
/begin CHARACTERISTIC NVQUOT2O_2_A "Gangerkennung n/v 2 Gang oben" VALUE 0x814472 KwUw 511.9922 qnv_uw_b512 0.00 511.9922 FORMAT "%8.4" /end CHARACTERISTIC
/begin CHARACTERISTIC NVQUOT2O_3_A "Gangerkennung n/v 2 Gang oben" VALUE 0x814474 KwUw 511.9922 qnv_uw_b512 0.00 511.9922 FORMAT "%8.4" /end CHARACTERISTIC
/begin CHARACTERISTIC NVQUOT2U_0_A "Gangerkennung n/v 2 Gang unten" VALUE 0x814476 KwUw 511.9922 qnv_uw_b512 0.00 511.9922 FORMAT "%8.4" /end CHARACTERISTIC
/begin CHARACTERISTIC NVQUOT2U_1_A "Gangerkennung n/v 2 Gang unten" VALUE 0x814478 KwUw 511.9922 qnv_uw_b512 0.00 511.9922 FORMAT "%8.4" /end CHARACTERISTIC
/begin CHARACTERISTIC NVQUOT2U_2_A "Gangerkennung n/v 2 Gang unten" VALUE 0x81447A KwUw 511.9922 qnv_uw_b512 0.00 511.9922 FORMAT "%8.4" /end CHARACTERISTIC
/begin CHARACTERISTIC NVQUOT2U_3_A "Gangerkennung n/v 2 Gang unten" VALUE 0x81447C KwUw 511.9922 qnv_uw_b512 0.00 511.9922 FORMAT "%8.4" /end CHARACTERISTIC
/begin CHARACTERISTIC NVQUOT3O_0_A "Gangerkennung n/v 3 Gang oben" VALUE 0x81447E KwUw 511.9922 qnv_uw_b512 0.00 511.9922 FORMAT "%8.4" /end CHARACTERISTIC
/begin CHARACTERISTIC NVQUOT3O_1_A "Gangerkennung n/v 3 Gang oben" VALUE 0x814480 KwUw 511.9922 qnv_uw_b512 0.00 511.9922 FORMAT "%8.4" /end CHARACTERISTIC
/begin CHARACTERISTIC NVQUOT3O_2_A "Gangerkennung n/v 3 Gang oben" VALUE 0x814482 KwUw 511.9922 qnv_uw_b512 0.00 511.9922 FORMAT "%8.4" /end CHARACTERISTIC
/begin CHARACTERISTIC NVQUOT3O_3_A "Gangerkennung n/v 3 Gang oben" VALUE 0x814484 KwUw 511.9922 qnv_uw_b512 0.00 511.9922 FORMAT "%8.4" /end CHARACTERISTIC
/begin CHARACTERISTIC NVQUOT3U_0_A "Gangerkennung n/v 3 Gang unten" VALUE 0x814486 KwUw 511.9922 qnv_uw_b512 0.00 511.9922 FORMAT "%8.4" /end CHARACTERISTIC
/begin CHARACTERISTIC NVQUOT3U_1_A "Gangerkennung n/v 3 Gang unten" VALUE 0x814488 KwUw 511.9922 qnv_uw_b512 0.00 511.9922 FORMAT "%8.4" /end CHARACTERISTIC
/begin CHARACTERISTIC NVQUOT3U_2_A "Gangerkennung n/v 3 Gang unten" VALUE 0x81448A KwUw 511.9922 qnv_uw_b512 0.00 511.9922 FORMAT "%8.4" /end CHARACTERISTIC
/begin CHARACTERISTIC NVQUOT3U_3_A "Gangerkennung n/v 3 Gang unten" VALUE 0x81448C KwUw 511.9922 qnv_uw_b512 0.00 511.9922 FORMAT "%8.4" /end CHARACTERISTIC
/begin CHARACTERISTIC NVQUOT4O_0_A "Gangerkennung n/v 4 Gang oben" VALUE 0x81448E KwUw 511.9922 qnv_uw_b512 0.00 511.9922 FORMAT "%8.4" /end CHARACTERISTIC
/begin CHARACTERISTIC NVQUOT4O_1_A "Gangerkennung n/v 4 Gang oben" VALUE 0x814490 KwUw 511.9922 qnv_uw_b512 0.00 511.9922 FORMAT "%8.4" /end CHARACTERISTIC
/begin CHARACTERISTIC NVQUOT4O_2_A "Gangerkennung n/v 4 Gang oben" VALUE 0x814492 KwUw 511.9922 qnv_uw_b512 0.00 511.9922 FORMAT "%8.4" /end CHARACTERISTIC
/begin CHARACTERISTIC NVQUOT4O_3_A "Gangerkennung n/v 4 Gang oben" VALUE 0x814494 KwUw 511.9922 qnv_uw_b512 0.00 511.9922 FORMAT "%8.4" /end CHARACTERISTIC
/begin CHARACTERISTIC NVQUOT4U_0_A "Gangerkennung n/v 4 Gang unten" VALUE 0x814496 KwUw 511.9922 qnv_uw_b512 0.00 511.9922 FORMAT "%8.4" /end CHARACTERISTIC
/begin CHARACTERISTIC NVQUOT4U_1_A "Gangerkennung n/v 4 Gang unten" VALUE 0x814498 KwUw 511.9922 qnv_uw_b512 0.00 511.9922 FORMAT "%8.4" /end CHARACTERISTIC
/begin CHARACTERISTIC NVQUOT4U_2_A "Gangerkennung n/v 4 Gang unten" VALUE 0x81449A KwUw 511.9922 qnv_uw_b512 0.00 511.9922 FORMAT "%8.4" /end CHARACTERISTIC
/begin CHARACTERISTIC NVQUOT4U_3_A "Gangerkennung n/v 4 Gang unten" VALUE 0x81449C KwUw 511.9922 qnv_uw_b512 0.00 511.9922 FORMAT "%8.4" /end CHARACTERISTIC
/begin CHARACTERISTIC NVQUOT5O_0_A "Gangerkennung n/v 5 Gang oben" VALUE 0x81449E KwUw 511.9922 qnv_uw_b512 0.00 511.9922 FORMAT "%8.4" /end CHARACTERISTIC
/begin CHARACTERISTIC NVQUOT5O_1_A "Gangerkennung n/v 5 Gang oben" VALUE 0x8144A0 KwUw 511.9922 qnv_uw_b512 0.00 511.9922 FORMAT "%8.4" /end CHARACTERISTIC
/begin CHARACTERISTIC NVQUOT5O_2_A "Gangerkennung n/v 5 Gang oben" VALUE 0x8144A2 KwUw 511.9922 qnv_uw_b512 0.00 511.9922 FORMAT "%8.4" /end CHARACTERISTIC
/begin CHARACTERISTIC NVQUOT5O_3_A "Gangerkennung n/v 5 Gang oben" VALUE 0x8144A4 KwUw 511.9922 qnv_uw_b512 0.00 511.9922 FORMAT "%8.4" /end CHARACTERISTIC
/begin CHARACTERISTIC NVQUOT5U_0_A "Gangerkennung n/v 5 Gang unten" VALUE 0x8144A6 KwUw 511.9922 qnv_uw_b512 0.00 511.9922 FORMAT "%8.4" /end CHARACTERISTIC
/begin CHARACTERISTIC NVQUOT5U_1_A "Gangerkennung n/v 5 Gang unten" VALUE 0x8144A8 KwUw 511.9922 qnv_uw_b512 0.00 511.9922 FORMAT "%8.4" /end CHARACTERISTIC
/begin CHARACTERISTIC NVQUOT5U_2_A "Gangerkennung n/v 5 Gang unten" VALUE 0x8144AA KwUw 511.9922 qnv_uw_b512 0.00 511.9922 FORMAT "%8.4" /end CHARACTERISTIC
/begin CHARACTERISTIC NVQUOT5U_3_A "Gangerkennung n/v 5 Gang unten" VALUE 0x8144AC KwUw 511.9922 qnv_uw_b512 0.00 511.9922 FORMAT "%8.4" /end CHARACTERISTIC
/begin CHARACTERISTIC NVQUOT6O_0_A "Gangerkennung n/v 6 Gang oben" VALUE 0x8144AE KwUw 511.9922 qnv_uw_b512 0.00 511.9922 FORMAT "%8.4" /end CHARACTERISTIC
/begin CHARACTERISTIC NVQUOT6O_1_A "Gangerkennung n/v 6 Gang oben" VALUE 0x8144B0 KwUw 511.9922 qnv_uw_b512 0.00 511.9922 FORMAT "%8.4" /end CHARACTERISTIC
/begin CHARACTERISTIC NVQUOT6O_2_A "Gangerkennung n/v 6 Gang oben" VALUE 0x8144B2 KwUw 511.9922 qnv_uw_b512 0.00 511.9922 FORMAT "%8.4" /end CHARACTERISTIC
/begin CHARACTERISTIC NVQUOT6O_3_A "Gangerkennung n/v 6 Gang oben" VALUE 0x8144B4 KwUw 511.9922 qnv_uw_b512 0.00 511.9922 FORMAT "%8.4" /end CHARACTERISTIC
/begin CHARACTERISTIC NVQUOT6U_0_A "Gangerkennung n/v 6 Gang unten" VALUE 0x8144B6 KwUw 511.9922 qnv_uw_b512 0.00 511.9922 FORMAT "%8.4" /end CHARACTERISTIC
/begin CHARACTERISTIC NVQUOT6U_1_A "Gangerkennung n/v 6 Gang unten" VALUE 0x8144B8 KwUw 511.9922 qnv_uw_b512 0.00 511.9922 FORMAT "%8.4" /end CHARACTERISTIC
/begin CHARACTERISTIC NVQUOT6U_2_A "Gangerkennung n/v 6 Gang unten" VALUE 0x8144BA KwUw 511.9922 qnv_uw_b512 0.00 511.9922 FORMAT "%8.4" /end CHARACTERISTIC
/begin CHARACTERISTIC NVQUOT6U_3_A "Gangerkennung n/v 6 Gang unten" VALUE 0x8144BC KwUw 511.9922 qnv_uw_b512 0.00 511.9922 FORMAT "%8.4" /end CHARACTERISTIC
/begin CHARACTERISTIC NWSOSE "Nockenwellensteuerung obere Schaltschwelle (Einlaß)" VALUE 0x81A361 KwUb 0.9961 fak_ub_b1 0.00 0.9961 /end CHARACTERISTIC
/begin CHARACTERISTIC NWSUSE "Nockenwellensteuerung untere schaltschwelle (Einlaß)" VALUE 0x81A362 KwUb 0.9961 fak_ub_b1 0.00 0.9961 /end CHARACTERISTIC
/begin CHARACTERISTIC PEKP "Förderleistung EKP" VALUE 0x81A6BE KwUb 25.50 vs_q0p1 0.00 25.50 FORMAT "%5.2" /end CHARACTERISTIC
/begin CHARACTERISTIC RALEZMAX "Begrenzung der Anzahl rückwärts drehender Zähne im Auslauf" VALUE 0x8109CA KwUb 127.0 dez 0.00 127.0 FORMAT "%5.1" /end CHARACTERISTIC
/begin CHARACTERISTIC REDABM "Ev-Abschaltmuster für Momentenreduzierung" MAP 0x810DC5 FkfNoShNoOffWUb 255.0 dez 0.00 255.0 FORMAT "%5.1"
 /begin AXIS_DESCR FIX_AXIS evrbgn_one dez 4 0.00 3.000 FORMAT "%5.3" FIX_AXIS_PAR 0 0 4 /end AXIS_DESCR
 /begin AXIS_DESCR FIX_AXIS redsol_one dez 4 0.00 3.000 FORMAT "%5.3" FIX_AXIS_PAR 0 0 4 /end AXIS_DESCR
/end CHARACTERISTIC
/begin AXIS_PTS SEZ06TMUB "Stützstellenverteilung, Zündwinkelwirkungsgrad" 0x8181D1 etazwimt SstAUbSstUb 127.5 rel_ub_b127p5 6 0.00 127.5 FORMAT "%5.1" DEPOSIT ABSOLUTE /end AXIS_PTS
/begin AXIS_PTS SGA06MDUB "Stützstellenverteilung Ist Gang 6 Sst." 0x81A7F4 gangi SstAUbSstUb 255.0 dez 6 0.00 255.0 FORMAT "%5.1" DEPOSIT ABSOLUTE /end AXIS_PTS
/begin AXIS_PTS SLX06TMUW "Stützstellenverteilung, Lambdasoll" 0x81A7FC lamsbg_w SstAUwSstUw 15.99976 fak_uw_b16 6 0.00 15.99976 FORMAT "%8.5" DEPOSIT ABSOLUTE /end AXIS_PTS
/begin AXIS_PTS SMK08MDSW "Antiruckelmoment-abhängige Stützstellen (Anzahl =8)" 0x826CAE mkar_w SstASwSstSw 199.9969 rel_sw_b100 8 -100.0000 99.99695 FORMAT "%8.4" DEPOSIT ABSOLUTE /end AXIS_PTS
/begin AXIS_PTS SML06TMUW "Stützstellenverteilung, Luftmasse, 6 Stützstellen" 0x81A81C ml_w SstAUwSstUw 6553.500 m_uw_b6553p5 6 0.00 6553.500 FORMAT "%8.3" DEPOSIT ABSOLUTE /end AXIS_PTS
/begin AXIS_PTS SML07TMUW "Stützstellenverteilung, Luftmasse, 7 Stützstellen" 0x81A82A ml_w SstAUwSstUw 6553.500 m_uw_b6553p5 7 0.00 6553.500 FORMAT "%8.3" DEPOSIT ABSOLUTE /end AXIS_PTS
/begin AXIS_PTS SMT06TMUW "Stützstellenverteilung, Luftmasse, 6 Stützstellen" 0x81A83A ml_w SstAUwSstUw 6553.500 m_uw_b6553p5 6 0.00 6553.500 FORMAT "%8.3" DEPOSIT ABSOLUTE /end AXIS_PTS
/begin AXIS_PTS SNM16CIUB "Stützstellenverteilung Drehzahl, 16 Sst." 0x81824A nmot SstAUbSstUb 10200. nmot_ub_q40 16 0.00 10200. FORMAT "%5.0" DEPOSIT ABSOLUTE /end AXIS_PTS
/begin AXIS_PTS ST107TMUB "Stützstellenverteilung, Starttemperatur an Sonde vorne" 0x81829D tabgmst SstAUbSstUb 1275. temp_ub_q5_o50 7 -50.00 1225. FORMAT "%5.0" DEPOSIT ABSOLUTE /end AXIS_PTS
/begin AXIS_PTS ST307TMUB "Stützstellenverteilung, Starttemperatur an Sonde hinten" 0x8182A5 tkatmst SstAUbSstUb 1275. temp_ub_q5_o50 7 -50.00 1225. FORMAT "%5.0" DEPOSIT ABSOLUTE /end AXIS_PTS
/begin AXIS_PTS STM05TMUB "Stützstellenverteilung, Motorstarttemperatur" 0x8182BF tmst SstAUbSstUb 191.3 temp_ub_q0p75_o48 5 -48.00 143.3 FORMAT "%5.1" DEPOSIT ABSOLUTE /end AXIS_PTS
/begin AXIS_PTS STS06TMUW "Stützstellenverteilung, Abgasmassenfluß" 0x81BCBC tabstatm_w SstAUwSstUw 65535.00 t1sxs_uw_q1 6 0.00 65535.00 FORMAT "%8.2" DEPOSIT ABSOLUTE /end AXIS_PTS
/begin AXIS_PTS STU05TMUB "Stützstellenverteilung, Ersatz-Umgebungstemperatur" 0x81875E tatu SstAUbSstUb 191.3 temp_ub_q0p75_o48 5 -48.00 143.3 FORMAT "%5.1" DEPOSIT ABSOLUTE /end AXIS_PTS
/begin CHARACTERISTIC TABGMEX_0_A "Abgastemperatur unterhalb der Kat-Anspringtemperatur" VALUE 0x81BD98 KwUb 1275. temp_ub_q5_o50 -50.00 1225. FORMAT "%5.0" /end CHARACTERISTIC
/begin CHARACTERISTIC TABGMEX_1_A "Abgastemperatur unterhalb der Kat-Anspringtemperatur" VALUE 0x81BD99 KwUb 1275. temp_ub_q5_o50 -50.00 1225. FORMAT "%5.0" /end CHARACTERISTIC
/begin CHARACTERISTIC TAPVLTM "Schwelle Abstellzeit für EKP-Vorlauf" CURVE 0x8298F4 KlAUbSstUbWUw 65535.00 t1sxs_uw_q1 0.00 65535.00 FORMAT "%8.2"
 /begin AXIS_DESCR STD_AXIS tmotab temp_ub_q0p75_o48 4 -48.00 143.3 FORMAT "%5.1" DEPOSIT ABSOLUTE /end AXIS_DESCR
/end CHARACTERISTIC
/begin CHARACTERISTIC TAREIN "Sperrzeit für Antiruckelfunktion" VALUE 0x8114DC KwUb 2.550 t10msxs_ub_b2p55 0.00 2.550 FORMAT "%5.3" /end CHARACTERISTIC
/begin CHARACTERISTIC TASTBFA "Modell-Temperatur vor Vorkatalysator Startwert bei B_faatm Anforderung" VALUE 0x818764 KwUb 1275. temp_ub_q5_o50 -50.00 1225. FORMAT "%5.0" /end CHARACTERISTIC
/begin CHARACTERISTIC TATEGMX "Maximales Tastverhältnis für getakteten Betrieb." VALUE 0x827FB2 KwUw 99.99847 rel_uw_b100 0.00 99.99847 FORMAT "%8.5" /end CHARACTERISTIC
/begin CHARACTERISTIC TATEGRDO "Obere Schwelle Tastverhältnis TEV zur Erkennung eines neg. Gradienten tatesoll" VALUE 0x81A1E9 KwUb 99.61 rel_ub_b99p6 0.00 99.61 FORMAT "%5.2" /end CHARACTERISTIC
/begin CHARACTERISTIC TATEGRDU "Untere Schwelle Tastverhältnis TEV zur Erkennung eines neg. Gradienten tatesoll" VALUE 0x81A1EA KwUb 99.61 rel_ub_b99p6 0.00 99.61 FORMAT "%5.2" /end CHARACTERISTIC
/begin CHARACTERISTIC TATEMSN "Kennlinie Tastverhältnis TEV abhängig vom gewünschten Massenstrom" CURVE 0x827FB4 KlAUwSstUwWUw 99.99847 rel_uw_b100 0.00 99.99847 FORMAT "%8.5"
 /begin AXIS_DESCR STD_AXIS msntev_w m_uw_b25p6 10 0.00 25.59961 FORMAT "%8.5" DEPOSIT ABSOLUTE /end AXIS_DESCR
/end CHARACTERISTIC
/begin CHARACTERISTIC TATMKH "Abgastemperaturkorrektur bei Kat-Heizen aktiv" VALUE 0x818765 KwUb 1275. temp_q5 0.00 1275. FORMAT "%5.0" /end CHARACTERISTIC
/begin CHARACTERISTIC TATMKRSA "Abgastemperatur im Krümmer bei Schubabschalten" VALUE 0x818766 KwUb 1275. temp_ub_q5_o50 -50.00 1225. FORMAT "%5.0" /end CHARACTERISTIC
/begin CHARACTERISTIC TATMKW "Abgastemperaturkorrektur bei Kat warmhalten aktiv" VALUE 0x818767 KwUb 1275. temp_q5 0.00 1275. FORMAT "%5.0" /end CHARACTERISTIC
/begin CHARACTERISTIC TATMRTPK "Zeitverzögerung zum Rücksetzten des Wärmemengen Integrators iwmatmk" VALUE 0x81BCCA KwUw 13107.00 t_q0p2 0.00 13107.00 FORMAT "%8.2" /end CHARACTERISTIC
/begin CHARACTERISTIC TATMSA_0_A "Abgastemperatur bei Schubabschneiden" VALUE 0x81BD9A KwUb 1275. temp_ub_q5_o50 -50.00 1225. FORMAT "%5.0" /end CHARACTERISTIC
/begin CHARACTERISTIC TATMSA_1_A "Abgastemperatur bei Schubabschneiden" VALUE 0x81BD9B KwUb 1275. temp_ub_q5_o50 -50.00 1225. FORMAT "%5.0" /end CHARACTERISTIC
/begin CHARACTERISTIC TATMSAE "exotherme Temperaturerhöhung im Schub" VALUE 0x818768 KwUb 1275. temp_ub_q5_o50 -50.00 1225. FORMAT "%5.0" /end CHARACTERISTIC
/begin CHARACTERISTIC TATMSTI "Initialisierungswert für tabgm, tkatm Startwert bei Powerfail" VALUE 0x818769 KwUb 1275. temp_ub_q5_o50 -50.00 1225. FORMAT "%5.0" /end CHARACTERISTIC
/begin CHARACTERISTIC TATMTMOT "Motortemperatur warmer Motor , für Temperaturkorrektur beim Kaltstart" VALUE 0x81876A KwUb 191.3 temp_ub_q0p75_o48 -48.00 143.3 FORMAT "%5.1" /end CHARACTERISTIC
/begin CHARACTERISTIC TATMTP_0_A "Abgastaupunkttemperatur" VALUE 0x81BD9C KwUb 1275. temp_ub_q5_o50 -50.00 1225. FORMAT "%5.0" /end CHARACTERISTIC
/begin CHARACTERISTIC TATMTP_1_A "Abgastaupunkttemperatur" VALUE 0x81BD9D KwUb 1275. temp_ub_q5_o50 -50.00 1225. FORMAT "%5.0" /end CHARACTERISTIC
/begin CHARACTERISTIC TATMTRKH "Abgastemperaturkorrektur bei Thermoreaktor-Katheizen" VALUE 0x81876B KwUb 1275. temp_q5 0.00 1275. FORMAT "%5.0" /end CHARACTERISTIC
/begin CHARACTERISTIC TATMWMK_0_A "Temperaturoffset  für Wärmemengenberechnung" VALUE 0x81BD9E KwSb 1275. temp_q5 -640.0 635.0 FORMAT "%5.1" /end CHARACTERISTIC
/begin CHARACTERISTIC TATMWMK_1_A "Temperaturoffset  für Wärmemengenberechnung" VALUE 0x81BD9F KwSb 1275. temp_q5 -640.0 635.0 FORMAT "%5.1" /end CHARACTERISTIC
/begin CHARACTERISTIC TDBKVSTEND "Einschaltverzögerung BKV-Pumpe nach Startende" VALUE 0x81A6D9 KwUb 2.550 t10msxs_ub_b2p55 0.00 2.550 FORMAT "%5.3" /end CHARACTERISTIC
/begin CHARACTERISTIC TDKLAGDE "Zeitdelta für Fehlerzählerlöschung bei DK-Soll-/Istvergleich" VALUE 0x810C1C KwUb 5.100 t20msxs_ub_b5p1 0.00 5.100 FORMAT "%5.3" /end CHARACTERISTIC
/begin CHARACTERISTIC TDLRHAFTMX "Verweildauer für Aktivierung der Haftreibungsroutine" VALUE 0x8188FC KwUb 12.75 t50msxs_q0p05 0.00 12.75 FORMAT "%5.2" /end CHARACTERISTIC
/begin CHARACTERISTIC TDLRPIDC "Zeitdelta zur Fehlerzeitdecrementierung bei DLR-Stellbereichsüberwachung" VALUE 0x81456E KwUw 655.3500 t10msxs_uw_b655p35 0.00 655.3500 FORMAT "%8.4" /end CHARACTERISTIC
/begin CHARACTERISTIC TIKATMOE "Temperaturkorrektur im Kat ohne Exotherme tikatm" VALUE 0x81876C KwSb 1275. temp_q5 -640.0 635.0 FORMAT "%5.1" /end CHARACTERISTIC
/begin CHARACTERISTIC TKATMOE "Temperaturkorrektur Kat ohne Exotherme tkatm" VALUE 0x81876D KwSb 1275. temp_q5 -640.0 635.0 FORMAT "%5.1" /end CHARACTERISTIC
/begin CHARACTERISTIC TKATMTPMN "minimale Abgastemperatur hinter HK, bei der Wasser im Leerlauf noch verdampft" VALUE 0x81BCCC KwUw 1279.980 temp_uw_q0p0195_o50 -50.00000 1229.980 FORMAT "%8.3" /end CHARACTERISTIC
/begin CHARACTERISTIC TKD "Lernzeit für Kick-Down-Position" VALUE 0x810A73 KwUb 2.550 t10msxs_ub_b2p55 0.00 2.550 FORMAT "%5.3" /end CHARACTERISTIC
/begin CHARACTERISTIC TKSTBFA "Modell-Temperatur hinter Hauptkat Startwert bei B_faatm Anforderun" VALUE 0x81876E KwUb 1275. temp_ub_q5_o50 -50.00 1225. FORMAT "%5.0" /end CHARACTERISTIC
/begin CHARACTERISTIC TLKD "Maximal zulässige Zeit für Lernen der Kick-Down-Position über Tester" VALUE 0x8144D8 KwUw 655.3500 t10msxs_uw_b655p35 0.00 655.3500 FORMAT "%8.4" /end CHARACTERISTIC
/begin CHARACTERISTIC TMAR "Untere tmot-Schwelle für AR-Freigabe" VALUE 0x8114DD KwUb 191.3 temp_ub_q0p75_o48 -48.00 143.3 FORMAT "%5.1" /end CHARACTERISTIC
/begin CHARACTERISTIC TMDNWMN "Minimale Motortemperatur zur Freigabe der Nockenwellendiagnose" VALUE 0x81A31A KwUb 191.3 temp_ub_q0p75_o48 -48.00 143.3 FORMAT "%5.1" /end CHARACTERISTIC
/begin CHARACTERISTIC TMDNWMX "Maximale Motortemperatur zur Freigabe der Nockenwellendiagnose" VALUE 0x81A31B KwUb 191.3 temp_ub_q0p75_o48 -48.00 143.3 FORMAT "%5.1" /end CHARACTERISTIC
/begin CHARACTERISTIC TMESP "Motortemperaturschwelle Schnellstart" VALUE 0x810C25 KwUb 191.3 temp_ub_q0p75_o48 -48.00 143.3 FORMAT "%5.1" /end CHARACTERISTIC
/begin CHARACTERISTIC TMLAST "Sperrzeit bis zum Auslösen des Ini der AR beim Verzögern" VALUE 0x8114DE KwUb 2.550 t10msxs_ub_b2p55 0.00 2.550 FORMAT "%5.3" /end CHARACTERISTIC
/begin CHARACTERISTIC TMSKS "Motortemperaturschwelle für Erkennung Benzin im Öl" VALUE 0x81946A KwUb 191.3 temp_ub_q0p75_o48 -48.00 143.3 FORMAT "%5.1" /end CHARACTERISTIC
/begin CHARACTERISTIC TMSTABO "Kennlinie für Hochzählen des ABO-Zählers abhängig von der Starttemperatur" CURVE 0x81946B KlAUbSstUbWUb 255.0 dez 0.00 255.0 FORMAT "%5.1"
 /begin AXIS_DESCR STD_AXIS tmst temp_ub_q0p75_o48 4 -48.00 143.3 FORMAT "%5.1" DEPOSIT ABSOLUTE /end AXIS_DESCR
/end CHARACTERISTIC
/begin CHARACTERISTIC TMTKS "Temperaturschwelle für  integrierten Luftmassenstrom für Erkennung Benzin im Öl" VALUE 0x819474 KwUb 191.3 temp_ub_q0p75_o48 -48.00 143.3 FORMAT "%5.1" /end CHARACTERISTIC
/begin CHARACTERISTIC TMZUB2MX "Temperaturschwelle für Winkelpriorität während Kaltstart" VALUE 0x810059 KwUb 191.3 temp_ub_q0p75_o48 -48.00 143.3 FORMAT "%5.1" /end CHARACTERISTIC
/begin CHARACTERISTIC TNLATM "Minimale SG-Nachlaufzeit für ATM - Abstellzeit" VALUE 0x81BCCE KwUw 65535.00 t1sxs_uw_q1 0.00 65535.00 FORMAT "%8.2" /end CHARACTERISTIC
/begin CHARACTERISTIC TNLATMTM "bei tmot > Schwellert  SG-Nachlauf-Anforderung B_nlatm = 1" VALUE 0x81876F KwUb 191.3 temp_ub_q0p75_o48 -48.00 143.3 FORMAT "%5.1" /end CHARACTERISTIC
/begin CHARACTERISTIC TNLATMTU "bei tumg (tatu -ATM) > Schwellwert SG-Nachlauf-Anforderung" VALUE 0x818770 KwUb 191.3 temp_ub_q0p75_o48 -48.00 143.3 FORMAT "%5.1" /end CHARACTERISTIC
/begin CHARACTERISTIC TNLEKPVL "Schwelle SG-Nachlaufzeit für EKP-Vorlauf" VALUE 0x829902 KwUw 6553.500 t100msxs_uw_b6553p6 0.00 6553.500 FORMAT "%8.3" /end CHARACTERISTIC
/begin CHARACTERISTIC TNWDSTEND "Verzögerunszeit nach Startende bis zur Freigabe der Nockenwellendiagnose" VALUE 0x827FE2 KwUw 655.3500 t10msxs_uw_b655p35 0.00 655.3500 FORMAT "%8.4" /end CHARACTERISTIC
/begin CHARACTERISTIC TOELDNWMN "Minimale Öltemperatur zur Freigabe der Nockenwellendiagnose" VALUE 0x827FE4 KwUw 1535.977 temp_q0p0234_o273 -273.1500 1262.827 FORMAT "%8.3" /end CHARACTERISTIC
/begin CHARACTERISTIC TOELDNWMX "Maximale Öltemperatur zur Freigabe der Nockenwellendiagnose" VALUE 0x827FE6 KwUw 1535.977 temp_q0p0234_o273 -273.1500 1262.827 FORMAT "%8.3" /end CHARACTERISTIC
/begin CHARACTERISTIC TPWRSV "Wartezeit bis DV-E Powersave aktiv wird" VALUE 0x814570 KwUw 655.3500 t10msxs_uw_b655p35 0.00 655.3500 FORMAT "%8.4" /end CHARACTERISTIC
/begin CHARACTERISTIC TRD "Zahnperiodenzeit für Rückdrehen im Auslauf" VALUE 0x8109CB KwUb 100.0 t1msxms_q1 0.00 100.0 FORMAT "%5.1" /end CHARACTERISTIC
/begin CHARACTERISTIC TTROFF "Verzögerungszeit Reglerabschaltung ATR" VALUE 0x81943C KwUb 25.50 t100msxs_ub_b25p5 0.00 25.50 FORMAT "%5.2" /end CHARACTERISTIC
/begin CHARACTERISTIC TUMTAIT "Initialisierungswert Umgebungstemperatur aus TANS" VALUE 0x818771 KwUb 191.3 temp_ub_q0p75_o48 -48.00 143.3 FORMAT "%5.1" /end CHARACTERISTIC
/begin CHARACTERISTIC TVARS "Verzoegerungszeit fuer AR wieder inaktiv" VALUE 0x8114DF KwUb 2.550 t10msxs_ub_b2p55 0.00 2.550 FORMAT "%5.3" /end CHARACTERISTIC
/begin CHARACTERISTIC TVARSS "Verzögerungszeit für AR wieder inaktiv im Stationärfall" VALUE 0x8114E0 KwUb 2.550 t10msxs_ub_b2p55 0.00 2.550 FORMAT "%5.3" /end CHARACTERISTIC
/begin CHARACTERISTIC TVFZNW "Vezögerungszeit für Aktivierung der CIFI-Faktoren nach NoWe-Umschaltung" VALUE 0x810C26 KwUb 2.550 t10msxs_ub_b2p55 0.00 2.550 FORMAT "%5.3" /end CHARACTERISTIC
/begin CHARACTERISTIC TVKUPAR "Verzögerungszeit Kupplung für Antiruckelfunktion" VALUE 0x8114E1 KwUb 5.100 t20msxs_ub_b5p1 0.00 5.100 FORMAT "%5.3" /end CHARACTERISTIC
/begin CHARACTERISTIC TVKUPHS "Verzögerungszeit Kupplungsschalter beim Hochschalten" CURVE 0x8114E2 FklWUb 2.550 t10msxs_ub_b2p55 0.00 2.550 FORMAT "%5.3"
 /begin AXIS_DESCR FIX_AXIS gangi dez 6 1.000 6.000 FORMAT "%5.3" FIX_AXIS_PAR 1 0 6 /end AXIS_DESCR
/end CHARACTERISTIC
/begin CHARACTERISTIC TVKUPRS "Verzögerungszeit Kupplungsschalter beim Runterschalten" CURVE 0x8114E8 FklWUb 2.550 t10msxs_ub_b2p55 0.00 2.550 FORMAT "%5.3"
 /begin AXIS_DESCR FIX_AXIS gangi dez 6 1.000 6.000 FORMAT "%5.3" FIX_AXIS_PAR 1 0 6 /end AXIS_DESCR
/end CHARACTERISTIC
/begin CHARACTERISTIC TVNWFE "Verzugszeit zur NW-Umschaltfreigabe nach früh (Einlaß)" VALUE 0x81A363 KwUb 12.75 t50msxs_ub_b12p75 0.00 12.75 FORMAT "%5.2" /end CHARACTERISTIC
/begin CHARACTERISTIC TVNWSE "Verzugszeit zur NW-Umschaltfreigabe nach spät (Einlaß)" VALUE 0x81A364 KwUb 12.75 t50msxs_ub_b12p75 0.00 12.75 FORMAT "%5.2" /end CHARACTERISTIC
/begin CHARACTERISTIC TVREABO "Verzugszeit für zurücksetzen des Zählers für Benzin im Öl" VALUE 0x819475 KwUb 25.50 t100msxs_ub_b25p5 0.00 25.50 FORMAT "%5.2" /end CHARACTERISTIC
/begin CHARACTERISTIC TVTEVPS "Druckabhängige Verzugszeit Tankentlüftungsventil" CURVE 0x81A1EB KlAUbSstUbWUb 127.5 t500usxms_ub_q0p5 0.00 127.5 FORMAT "%5.1"
 /begin AXIS_DESCR STD_AXIS pspu fak_ub_b2 5 0.00 1.992 FORMAT "%5.3" DEPOSIT ABSOLUTE /end AXIS_DESCR
/end CHARACTERISTIC
/begin CHARACTERISTIC TWDKNL "Zeit nach nmot = 0 und Kl.15 AUS bis Nachlauf gestartet wird" VALUE 0x8188FD KwUb 25.50 t100msxs_ub_b25p5 0.00 25.50 FORMAT "%5.2" /end CHARACTERISTIC
/begin CHARACTERISTIC TZMIN "Zeitfenster für Zahnerkennung nach UBatt-Einbruch" VALUE 0x81A6BF KwUb 2.550 t10msxs_ub_b2p55 0.00 2.550 FORMAT "%5.3" /end CHARACTERISTIC
/begin CHARACTERISTIC TZSPINI "Sperrzeit fuer Filterinitialisierung" VALUE 0x8114EE KwUb 2.550 t10msxs_ub_b2p55 0.00 2.550 FORMAT "%5.3" /end CHARACTERISTIC
/begin CHARACTERISTIC TZZMX "Zeitfenster für Zahnerkennung" VALUE 0x81A6C0 KwUb 2.550 t10msxs_ub_b2p55 0.00 2.550 FORMAT "%5.3" /end CHARACTERISTIC
/begin CHARACTERISTIC UBSQBKVMN "min. Spannungsschwelle für BKV-Pumpe-Ansteuerung möglich" VALUE 0x81A6DA KwUb 25.50 spg_q0p1 0.00 25.50 FORMAT "%5.2" /end CHARACTERISTIC
/begin CHARACTERISTIC UBSQBKVMX "max. Spannungsschwelle für BKV-Pumpe-Ansteuerung möglich" VALUE 0x81A6DB KwUb 25.50 spg_q0p1 0.00 25.50 FORMAT "%5.2" /end CHARACTERISTIC
/begin CHARACTERISTIC UBSTS "Schwelle zur Erkennung UBatt-Einbruch im Start" VALUE 0x81A6C1 KwUb 25.50 spg_q0p1 0.00 25.50 FORMAT "%5.2" /end CHARACTERISTIC
/begin CHARACTERISTIC UDKNLPTOL "zulässige Potispannungs-Toleranz des NLP" VALUE 0x814572 KwUw 80.08377 spg_uw_q0p001222 0.00 80.08377 FORMAT "%8.5" /end CHARACTERISTIC
/begin CHARACTERISTIC UPWGKDMN "Untere Grenze der PWG-Poti-Spannung für Toleranzbereich der Kick-Down-Position" VALUE 0x8144DA KwUw 319.9951 spg_uw_q0p00488 0.00 319.9951 FORMAT "%8.4" /end CHARACTERISTIC
/begin CHARACTERISTIC UPWGKDMX "Obere Grenze der PWG-Poti-Spannung für Toleranzbereich der Kick-Down-Position" VALUE 0x8144DC KwUw 319.9951 spg_uw_q0p00488 0.00 319.9951 FORMAT "%8.4" /end CHARACTERISTIC
/begin CHARACTERISTIC UPWGKDO "Oberer Hysterese-Schaltpunkt zur Kick-Down-Erkennung aus Potispannung" VALUE 0x81BF04 KwUw 319.9951 spg_uw_q0p00488 0.00 319.9951 FORMAT "%8.4" /end CHARACTERISTIC
/begin CHARACTERISTIC UPWGKDU "Unterer Hysterese-Schaltpunkt zur Kick-Down-Erkennung aus Potispannung" VALUE 0x81BF06 KwUw 319.9951 spg_uw_q0p00488 0.00 319.9951 FORMAT "%8.4" /end CHARACTERISTIC
/begin CHARACTERISTIC UPWKDDF "Defaultwert PWG-Poti-Spannung für gelernte Kick-Down-Position" VALUE 0x8144DE KwUw 319.9951 spg_uw_q0p00488 0.00 319.9951 FORMAT "%8.4" /end CHARACTERISTIC
/begin CHARACTERISTIC USVKKS "Lambdasondenspannungsschwelle für Rücksetzen des Zählers für Benzin im Öl" VALUE 0x81BFFE KwUw 319.9951 spg_q0p00488 0.00 319.9951 FORMAT "%8.4" /end CHARACTERISTIC
/begin CHARACTERISTIC VARAU "minimale Fahrzeuggeschwindigkeit für ARA - Funktion" VALUE 0x8114EF KwUb 317.5 fak_ub_b318p75 0.00 317.5 FORMAT "%5.1" /end CHARACTERISTIC
/begin CHARACTERISTIC VKSTEBF "Fördervolumen bei Erstbefüllung" VALUE 0x829904 KwUw 6553.500 vol_q0p1 0.00 6553.500 FORMAT "%8.3" /end CHARACTERISTIC
/begin CHARACTERISTIC VKSTPVLAB "Fördervolumen EKP Vorlauf aus Abstellzeit" CURVE 0x829906 KlAUwSstUwWUw 6553.500 vol_q0p1 0.00 6553.500 FORMAT "%8.3"
 /begin AXIS_DESCR STD_AXIS tabst_w t1sxs_uw_q1 4 0.00 65535.00 FORMAT "%8.2" DEPOSIT ABSOLUTE /end AXIS_DESCR
/end CHARACTERISTIC
/begin CHARACTERISTIC VKSTPVLNL "Fördervolumen EKP Vorlauf aus Nachlaufzeit" VALUE 0x829918 KwUw 6553.500 vol_q0p1 0.00 6553.500 FORMAT "%8.3" /end CHARACTERISTIC
/begin CHARACTERISTIC VTUMTAT "Schwelle Fahrzeuggeschwindigkeit für TANS -> Umgebungstemperatur" VALUE 0x818772 KwUb 318.8 vfzg_ub_q1p25 0.00 318.8 FORMAT "%5.1" /end CHARACTERISTIC
/begin CHARACTERISTIC WDKBEWS "Schwelle zur DK-Bewegungserkennung (I-Klein)" VALUE 0x814574 KwSw 1599.976 relDK_q0p02441 -800.0000 799.9756 FORMAT "%8.4" /end CHARACTERISTIC
/begin CHARACTERISTIC WDKNLPTOL "zulässige DK-Winkel-Toleranz des NLP" VALUE 0x814576 KwUw 100.0000 relDK_uw_b100 0.00 100.0000 FORMAT "%8.4" /end CHARACTERISTIC
/begin CHARACTERISTIC WDKREIB "Haftreibungsanteil der DK für I-Klein" VALUE 0x810C1D KwUb 0.9961 fak_ub_b1 0.00 0.9961 /end CHARACTERISTIC
/begin CHARACTERISTIC WDKSAPNOL "DK-Sollwert bei Applikationshilfe DK-Notluftfahren" VALUE 0x814578 KwUw 99.99847 relDK_q0p00152 0.00 99.99847 FORMAT "%8.5" /end CHARACTERISTIC
/begin CHARACTERISTIC WDKSTFEIN "Schwelle zur Stationaritätserkennung (verstärkter Bereich)" VALUE 0x81457A KwSw 1599.976 relDK_q0p02441 -800.0000 799.9756 FORMAT "%8.4" /end CHARACTERISTIC
/begin CHARACTERISTIC WDKSTGROB "Schwelle zur Stationaritätserkennung (unverstärkter Bereich)" VALUE 0x81457C KwSw 1599.976 relDK_q0p02441 -800.0000 799.9756 FORMAT "%8.4" /end CHARACTERISTIC
/begin CHARACTERISTIC WEESTSM "Winkelgrenze Einspritzende für sim. Startauslösungen f(TMOT)" CURVE 0x818994 KlAUbSstUbWUb 717.2 kw_q2p8125 0.00 717.2 FORMAT "%5.1"
 /begin AXIS_DESCR STD_AXIS tmot temp_ub_q0p75_o48 6 -48.00 143.3 FORMAT "%5.1" DEPOSIT ABSOLUTE /end AXIS_DESCR
/end CHARACTERISTIC
/begin CHARACTERISTIC WESSTO "Offsetwinkel Einspritzung für Schnellstart" VALUE 0x810C27 KwUb 717.2 kw_q2p8125 0.00 717.2 FORMAT "%5.1" /end CHARACTERISTIC
/begin CHARACTERISTIC WMABGKH_0_A "Faktor für Wärmemengenkorrektur bei Katheizen für Taupunktende" VALUE 0x81BDA0 KwUb 1.000 fak_ub_b2 0.00 1.000 FORMAT "%5.3" /end CHARACTERISTIC
/begin CHARACTERISTIC WMABGKH_1_A "Faktor für Wärmemengenkorrektur bei Katheizen für Taupunktende" VALUE 0x81BDA1 KwUb 1.000 fak_ub_b2 0.00 1.000 FORMAT "%5.3" /end CHARACTERISTIC
/begin CHARACTERISTIC WMKATKH_0_A "Faktor für Wärmemengenkorrektur bei Katheizen für Taupunktende hinter Kat" VALUE 0x81BDA2 KwUb 1.000 fak_ub_b2 0.00 1.000 FORMAT "%5.3" /end CHARACTERISTIC
/begin CHARACTERISTIC WMKATKH_1_A "Faktor für Wärmemengenkorrektur bei Katheizen für Taupunktende hinter Kat" VALUE 0x81BDA3 KwUb 1.000 fak_ub_b2 0.00 1.000 FORMAT "%5.3" /end CHARACTERISTIC
/begin CHARACTERISTIC WPEDU "Untere Schwelle Pedalwert für Antiruckelfunktion" VALUE 0x816176 KwUw 100.0000 relPED_uw_b100 0.00 100.0000 FORMAT "%8.4" /end CHARACTERISTIC
/begin CHARACTERISTIC WPKDMN "Minimaler Pedalwert für Kick-Down-Erkennung" VALUE 0x8144E0 KwUw 100.0000 relPED_uw_b100 0.00 100.0000 FORMAT "%8.4" /end CHARACTERISTIC
/begin CHARACTERISTIC ZATAKRML "Zeitkonstante fuer Abgastemperaturmodell Krümmer" CURVE 0x81BCD0 GklWUw 13106.999997 zk200msxs_uw_b13107 0.20000305180 13107.200000 FORMAT "%12.6"
 /begin AXIS_DESCR COM_AXIS ml_w m_uw_b6553p5 7 0.00 6553.500 AXIS_PTS_REF SML07TMUW /end AXIS_DESCR
/end CHARACTERISTIC
/begin CHARACTERISTIC ZATMAML_0_A "Zeitkonstante fuer Abgastemperaturmodell" CURVE 0x81BCDE GklWUw 13106.999997 zk200msxs_uw_b13107 0.20000305180 13107.200000 FORMAT "%12.6"
 /begin AXIS_DESCR COM_AXIS ml_w m_uw_b6553p5 7 0.00 6553.500 AXIS_PTS_REF SML07TMUW /end AXIS_DESCR
/end CHARACTERISTIC
/begin CHARACTERISTIC ZATMAML_1_A "Zeitkonstante fuer Abgastemperaturmodell" CURVE 0x81BCEC GklWUw 13106.999997 zk200msxs_uw_b13107 0.20000305180 13107.200000 FORMAT "%12.6"
 /begin AXIS_DESCR COM_AXIS ml_w m_uw_b6553p5 7 0.00 6553.500 AXIS_PTS_REF SML07TMUW /end AXIS_DESCR
/end CHARACTERISTIC
/begin CHARACTERISTIC ZATMIKKML_0_A "Zeitkonstante fuer Kattemp.modell - Temperatur im Kat tikatm bei Abkühlung" CURVE 0x81BCFA GklWUw 13106.999997 zk200msxs_uw_b13107 0.20000305180 13107.200000 FORMAT "%12.6"
 /begin AXIS_DESCR COM_AXIS ml_w m_uw_b6553p5 7 0.00 6553.500 AXIS_PTS_REF SML07TMUW /end AXIS_DESCR
/end CHARACTERISTIC
/begin CHARACTERISTIC ZATMIKKML_1_A "Zeitkonstante fuer Kattemp.modell - Temperatur im Kat tikatm bei Abkühlung" CURVE 0x81BD08 GklWUw 13106.999997 zk200msxs_uw_b13107 0.20000305180 13107.200000 FORMAT "%12.6"
 /begin AXIS_DESCR COM_AXIS ml_w m_uw_b6553p5 7 0.00 6553.500 AXIS_PTS_REF SML07TMUW /end AXIS_DESCR
/end CHARACTERISTIC
/begin CHARACTERISTIC ZATMIKML_0_A "Zeitkonstante fuer Katalysatortemperaturmodell - Temperatur im Kat tikatm" CURVE 0x81BD16 GklWUw 13106.999997 zk200msxs_uw_b13107 0.20000305180 13107.200000 FORMAT "%12.6"
 /begin AXIS_DESCR COM_AXIS ml_w m_uw_b6553p5 7 0.00 6553.500 AXIS_PTS_REF SML07TMUW /end AXIS_DESCR
/end CHARACTERISTIC
/begin CHARACTERISTIC ZATMIKML_1_A "Zeitkonstante fuer Katalysatortemperaturmodell - Temperatur im Kat tikatm" CURVE 0x81BD24 GklWUw 13106.999997 zk200msxs_uw_b13107 0.20000305180 13107.200000 FORMAT "%12.6"
 /begin AXIS_DESCR COM_AXIS ml_w m_uw_b6553p5 7 0.00 6553.500 AXIS_PTS_REF SML07TMUW /end AXIS_DESCR
/end CHARACTERISTIC
/begin CHARACTERISTIC ZATMKKML_0_A "Zeitkonstante fuer Katalysatortemp.modell - Kat-Temperatur tkatm bei Abkühlung" CURVE 0x81BD32 GklWUw 13106.999997 zk200msxs_uw_b13107 0.20000305180 13107.200000 FORMAT "%12.6"
 /begin AXIS_DESCR COM_AXIS ml_w m_uw_b6553p5 7 0.00 6553.500 AXIS_PTS_REF SML07TMUW /end AXIS_DESCR
/end CHARACTERISTIC
/begin CHARACTERISTIC ZATMKKML_1_A "Zeitkonstante fuer Katalysatortemp.modell - Kat-Temperatur tkatm bei Abkühlung" CURVE 0x81BD40 GklWUw 13106.999997 zk200msxs_uw_b13107 0.20000305180 13107.200000 FORMAT "%12.6"
 /begin AXIS_DESCR COM_AXIS ml_w m_uw_b6553p5 7 0.00 6553.500 AXIS_PTS_REF SML07TMUW /end AXIS_DESCR
/end CHARACTERISTIC
/begin CHARACTERISTIC ZATMKML_0_A "Zeitkonstante fuer Katalysatortemperaturmodell - Kat-Temperatur tkatm" CURVE 0x81BD4E GklWUw 13106.999997 zk200msxs_uw_b13107 0.20000305180 13107.200000 FORMAT "%12.6"
 /begin AXIS_DESCR COM_AXIS ml_w m_uw_b6553p5 7 0.00 6553.500 AXIS_PTS_REF SML07TMUW /end AXIS_DESCR
/end CHARACTERISTIC
/begin CHARACTERISTIC ZATMKML_1_A "Zeitkonstante fuer Katalysatortemperaturmodell - Kat-Temperatur tkatm" CURVE 0x81BD5C GklWUw 13106.999997 zk200msxs_uw_b13107 0.20000305180 13107.200000 FORMAT "%12.6"
 /begin AXIS_DESCR COM_AXIS ml_w m_uw_b6553p5 7 0.00 6553.500 AXIS_PTS_REF SML07TMUW /end AXIS_DESCR
/end CHARACTERISTIC
/begin CHARACTERISTIC ZATMRML_0_A "Zeitkonstante fuer Abgastemperaturmodell - Rohrwandtemperatur" CURVE 0x81BD6A GklWUw 13106.999997 zk200msxs_uw_b13107 0.20000305180 13107.200000 FORMAT "%12.6"
 /begin AXIS_DESCR COM_AXIS ml_w m_uw_b6553p5 7 0.00 6553.500 AXIS_PTS_REF SML07TMUW /end AXIS_DESCR
/end CHARACTERISTIC
/begin CHARACTERISTIC ZATMRML_1_A "Zeitkonstante fuer Abgastemperaturmodell - Rohrwandtemperatur" CURVE 0x81BD78 GklWUw 13106.999997 zk200msxs_uw_b13107 0.20000305180 13107.200000 FORMAT "%12.6"
 /begin AXIS_DESCR COM_AXIS ml_w m_uw_b6553p5 7 0.00 6553.500 AXIS_PTS_REF SML07TMUW /end AXIS_DESCR
/end CHARACTERISTIC
/begin CHARACTERISTIC ZATRKRML "Zeitkonstante fuer Abgastemperaturmodell - Rohrwandtemperatur Krümmer" CURVE 0x81BD86 GklWUw 13106.999997 zk200msxs_uw_b13107 0.20000305180 13107.200000 FORMAT "%12.6"
 /begin AXIS_DESCR COM_AXIS ml_w m_uw_b6553p5 7 0.00 6553.500 AXIS_PTS_REF SML07TMUW /end AXIS_DESCR
/end CHARACTERISTIC
/begin CHARACTERISTIC ZKUBDLR "DLR, Zeitkonstante für Filterung von Ubatt" VALUE 0x8188FE KwUb 0.4980 fak_ub_b0p5 0.00 0.4980 /end CHARACTERISTIC
/begin CHARACTERISTIC ZKWDKSPT1 "Zeitkonstante für Prädiktion DK-Winkel aus Sollwert" VALUE 0x810C1E KwUb 0.6973 fak_q0p00273 0.00 0.6973 /end CHARACTERISTIC
/begin CHARACTERISTIC ZWFUBAMN "Endwinkel der Mehrfachfunkenzündung, falls konfiguriert" VALUE 0x81005A KwUb 90.00 zw_TR2OT_teeth_sy -30.00 60.00 FORMAT "%5.2" /end CHARACTERISTIC
/begin MEASUREMENT abmf "Festeinspritzausblendmuster" UBYTE dez 1 100 0 255 FORMAT "%5.1" ECU_ADDRESS 0x380A2E /end MEASUREMENT
/begin MEASUREMENT abo "Anzahl Starts mit Benzin im Öl" UBYTE dez 1 100 0 255 FORMAT "%5.1" ECU_ADDRESS 0x38400A /end MEASUREMENT
/begin MEASUREMENT aebkvph_w "Anzahl Einschaltungen der BKV-Pumpe(high word)" UWORD dez 1 100 0 65535 FORMAT "%8.2" ECU_ADDRESS 0x382CF0 /end MEASUREMENT
/begin MEASUREMENT aebkvpl_w "Anzahl Einschaltungen der BKV-Pumpe(low word)" UWORD dez 1 100 0 65535 FORMAT "%8.2" ECU_ADDRESS 0x382CF2 /end MEASUREMENT
/begin MEASUREMENT aebkvp_l "Anzahl Einschaltungen der BKV-Pumpe" ULONG DEZL 1 100 0 4.29497e+009 FORMAT "%13.2" ECU_ADDRESS 0x383C42 /end MEASUREMENT
/begin MEASUREMENT aekp8bits "" UBYTE dez 1 100 0 255 FORMAT "%5.1" ECU_ADDRESS 0x384930 /end MEASUREMENT
/begin MEASUREMENT aleNvBits "" UBYTE dez 1 100 0 255 FORMAT "%5.1" ECU_ADDRESS 0x38311A /end MEASUREMENT
/begin MEASUREMENT ANWSE_bits1 "" UBYTE dez 1 100 0 255 FORMAT "%5.1" ECU_ADDRESS 0x38492B /end MEASUREMENT
/begin MEASUREMENT anzeab "Anzahl Segmente Ev-Abschaltung für Notlauf Phasensuche" UBYTE dez 1 100 0 255 FORMAT "%5.1" ECU_ADDRESS 0x380A2F /end MEASUREMENT
/begin MEASUREMENT anzekpvl "Anzahl EKP Vorläufe ohne erreichen von Startende" UBYTE dez 1 100 0 255 FORMAT "%5.1" ECU_ADDRESS 0x38401A /end MEASUREMENT
/begin MEASUREMENT anzti "ti-Einspritzzähler" UBYTE dez 1 100 0 255 FORMAT "%5.1" ECU_ADDRESS 0xF95E /end MEASUREMENT
/begin MEASUREMENT anztib "Einspritzzähler begrenzt" UBYTE dez 1 100 0 255 FORMAT "%5.1" ECU_ADDRESS 0xF95F /end MEASUREMENT
/begin MEASUREMENT anztib_w "ti-Einspritzzähler mit Begrenzung" UWORD dez 1 100 0 65535 FORMAT "%8.2" ECU_ADDRESS 0xF97E /end MEASUREMENT
/begin MEASUREMENT anzti_w "ti-Einspritzzähler" UWORD dez 1 100 0 65535 FORMAT "%8.2" ECU_ADDRESS 0xF980 /end MEASUREMENT
/begin MEASUREMENT ATMbits "" UBYTE dez 1 100 0 255 FORMAT "%5.1" ECU_ADDRESS 0x38311D /end MEASUREMENT
/begin MEASUREMENT ATMbits1 "" UBYTE dez 1 100 0 255 FORMAT "%5.1" ECU_ADDRESS 0x38482F /end MEASUREMENT
/begin MEASUREMENT azFadeStatBits "" UBYTE dez 1 100 0 255 FORMAT "%5.1" ECU_ADDRESS 0xF7C8 /end MEASUREMENT
/begin MEASUREMENT azfdoff "Anforderungsbyte Zündausblendung" UBYTE dez 1 100 0 255 FORMAT "%5.1" ECU_ADDRESS 0xF7C9 /end MEASUREMENT
/begin MEASUREMENT azoffmsk_w "Ausblendmaske Zündausgane" UWORD dez 1 100 0 65535 FORMAT "%8.2" ECU_ADDRESS 0xF7E8 /end MEASUREMENT
/begin MEASUREMENT BBKDbits "" UBYTE dez 1 100 0 255 FORMAT "%5.1" ECU_ADDRESS 0x3809C3 /end MEASUREMENT
/begin MEASUREMENT bblkderf "" UBYTE dez 1 100 0 255 FORMAT "%5.1" ECU_ADDRESS 0x38312E /end MEASUREMENT
/begin MEASUREMENT B_abor "Bedigung Anzahl Starts mit Benzin im Öl für reduzierte LRA" UWORD B_TRUE 1 100 0 1 BIT_MASK 0x40 FORMAT "%13.11" ECU_ADDRESS 0xFD6A /end MEASUREMENT
/begin MEASUREMENT B_ale "Bedingung Motorabstellposition erkannt" UBYTE B_TRUE 1 100 0 1 BIT_MASK 0x1 FORMAT "%13.11" ECU_ADDRESS 0x38311A /end MEASUREMENT
/begin MEASUREMENT B_apnoluv "Verriegelungsbit: Applikationshilfe DK-Notluftfahren" UWORD B_TRUE 1 100 0 1 BIT_MASK 0x8 FORMAT "%13.11" ECU_ADDRESS 0xFD48 /end MEASUREMENT
/begin MEASUREMENT B_appnolu "Bedingung: DK-Notluftfahren durch Applikation angefordert" UWORD B_TRUE 1 100 0 1 BIT_MASK 0x10 FORMAT "%13.11" ECU_ADDRESS 0xFD48 /end MEASUREMENT
/begin MEASUREMENT B_ar "Antiruckeleingriff aktiv" UWORD B_TRUE 1 100 0 1 BIT_MASK 0x40 FORMAT "%13.11" ECU_ADDRESS 0xFD86 /end MEASUREMENT
/begin MEASUREMENT B_argf "Bedingung Gangfenster Antiruckel" UWORD B_TRUE 1 100 0 1 BIT_MASK 0x80 FORMAT "%13.11" ECU_ADDRESS 0xFD86 /end MEASUREMENT
/begin MEASUREMENT B_atmll "Bedinung für Zeitkonstanten bei Abkühlung im Leerlauf" UBYTE B_TRUE 1 100 0 1 BIT_MASK 0x8 FORMAT "%13.11" ECU_ADDRESS 0x38482F /end MEASUREMENT
/begin MEASUREMENT B_atmrtpk "Bedingung Integrator iwmatmk für Taupunkt hinter Kat wird zurückgesetzt" UBYTE B_TRUE 1 100 0 1 BIT_MASK 0x80 FORMAT "%13.11" ECU_ADDRESS 0x38482F /end MEASUREMENT
/begin MEASUREMENT B_atmst "Bedingung Startwert tabgmst,tkatmst berechnet" UBYTE B_TRUE 1 100 0 1 BIT_MASK 0x2 FORMAT "%13.11" ECU_ADDRESS 0x38482F /end MEASUREMENT
/begin MEASUREMENT B_atmtpa "Bedingung Taupunkt vor Kat ueberschritten" UWORD B_TRUE 1 100 0 1 BIT_MASK 0x800 FORMAT "%13.11" ECU_ADDRESS 0xFD32 /end MEASUREMENT
/begin MEASUREMENT B_atmtpf "Bedingung Taupunkt vor Kat überschritten (last trip)" UBYTE B_TRUE 1 100 0 1 BIT_MASK 0x4 FORMAT "%13.11" ECU_ADDRESS 0x38311D /end MEASUREMENT
/begin MEASUREMENT B_atmtpk "Bedingung Taupunkt hinter Kat ueberschritten" UWORD B_TRUE 1 100 0 1 BIT_MASK 0x1000 FORMAT "%13.11" ECU_ADDRESS 0xFD32 /end MEASUREMENT
/begin MEASUREMENT B_atmtpl "Bedingung Taupunkt hinter Kat überschritten (last trip)" UBYTE B_TRUE 1 100 0 1 BIT_MASK 0x1 FORMAT "%13.11" ECU_ADDRESS 0x38311D /end MEASUREMENT
/begin MEASUREMENT B_atr "Bedingung Abgastemperaturregelung" UWORD B_TRUE 1 100 0 1 BIT_MASK 0x800 FORMAT "%13.11" ECU_ADDRESS 0xFD66 /end MEASUREMENT
/begin MEASUREMENT B_atr2 "Bedingung Abgastemperaturregelung Bank 2" UWORD B_TRUE 1 100 0 1 BIT_MASK 0x1000 FORMAT "%13.11" ECU_ADDRESS 0xFD66 /end MEASUREMENT
/begin MEASUREMENT B_atrb "Bedingung gültiger Betriebsbereich für Abgastemperaturregelung" UWORD B_TRUE 1 100 0 1 BIT_MASK 0x2000 FORMAT "%13.11" ECU_ADDRESS 0xFD66 /end MEASUREMENT
/begin MEASUREMENT B_atrnl "Bedingung ATR im Notlauf" UWORD B_TRUE 1 100 0 1 BIT_MASK 0x4000 FORMAT "%13.11" ECU_ADDRESS 0xFD66 /end MEASUREMENT
/begin MEASUREMENT B_atrsp "Bedingung Abgastemperaturregler gesperrt" UWORD B_TRUE 1 100 0 1 BIT_MASK 0x8000 FORMAT "%13.11" ECU_ADDRESS 0xFD66 /end MEASUREMENT
/begin MEASUREMENT B_atrsp2 "Bedingung Abgastemperaturregler Bank 2 gesperrt" UWORD B_TRUE 1 100 0 1 BIT_MASK 0x1 FORMAT "%13.11" ECU_ADDRESS 0xFD68 /end MEASUREMENT
/begin MEASUREMENT B_bkvp "Bedingung: Bremskraftverstärker-Pumpe ansteuern" UWORD B_TRUE 1 100 0 1 BIT_MASK 0x200 FORMAT "%13.11" ECU_ADDRESS 0xFDB2 /end MEASUREMENT
/begin MEASUREMENT B_buf "" UWORD B_TRUE 1 100 0 1 BIT_MASK 0x4000 FORMAT "%13.11" ECU_ADDRESS 0xFDA2 /end MEASUREMENT
/begin MEASUREMENT B_cwesakt "Codewort CWESWEZ Bit 3 gesetzt" UWORD B_TRUE 1 100 0 1 BIT_MASK 0x800 FORMAT "%13.11" ECU_ADDRESS 0xFD4C /end MEASUREMENT
/begin MEASUREMENT B_dcdisfr "Bedingung: Disable DV-E-Endstufe durch den Funktionsrechner" UWORD B_TRUE 1 100 0 1 BIT_MASK 0x20 FORMAT "%13.11" ECU_ADDRESS 0xFD48 /end MEASUREMENT
/begin MEASUREMENT B_dkbew "Bedingung: DK hat sich bewegt" UWORD B_TRUE 1 100 0 1 BIT_MASK 0x40 FORMAT "%13.11" ECU_ADDRESS 0xFD48 /end MEASUREMENT
/begin MEASUREMENT B_dkuevab "Bedingung Ev-Abschaltung bei unplausibler DK" UWORD B_TRUE 1 100 0 1 BIT_MASK 0x200 FORMAT "%13.11" ECU_ADDRESS 0xFD5E /end MEASUREMENT
/begin MEASUREMENT B_dlrbe "Bedingung: DLR-Stellbereich wurde überschritten" UWORD B_TRUE 1 100 0 1 BIT_MASK 0x80 FORMAT "%13.11" ECU_ADDRESS 0xFD48 /end MEASUREMENT
/begin MEASUREMENT B_dlrikla "Bedingung: DLR, I-Klein aktiv" UWORD B_TRUE 1 100 0 1 BIT_MASK 0x100 FORMAT "%13.11" ECU_ADDRESS 0xFD48 /end MEASUREMENT
/begin MEASUREMENT B_dlriklst "Bedingung: Erster Durchlauf I-Klein nach Start" UWORD B_TRUE 1 100 0 1 BIT_MASK 0x200 FORMAT "%13.11" ECU_ADDRESS 0xFD48 /end MEASUREMENT
/begin MEASUREMENT B_dlrparc "Bedingung: Sollgrößensprung steht an" UWORD B_TRUE 1 100 0 1 BIT_MASK 0x400 FORMAT "%13.11" ECU_ADDRESS 0xFD48 /end MEASUREMENT
/begin MEASUREMENT B_dlrpide "Bedingung: Fehler, DLR-Stellbereich am Anschlag" UWORD B_TRUE 1 100 0 1 BIT_MASK 0x800 FORMAT "%13.11" ECU_ADDRESS 0xFD48 /end MEASUREMENT
/begin MEASUREMENT B_dlrspid "Bedingung: DLR, Vorzeichen der Summe der PID-Anteile, =1: positiv, =0: negativ" UWORD B_TRUE 1 100 0 1 BIT_MASK 0x1000 FORMAT "%13.11" ECU_ADDRESS 0xFD48 /end MEASUREMENT
/begin MEASUREMENT B_dlrumzu "Bedingung: NLP-Umladen zugelassen" UWORD B_TRUE 1 100 0 1 BIT_MASK 0x2000 FORMAT "%13.11" ECU_ADDRESS 0xFD48 /end MEASUREMENT
/begin MEASUREMENT B_dls "Bedingung DLS-Funktion aktiv" UWORD B_TRUE 1 100 0 1 BIT_MASK 0x8000 FORMAT "%13.11" ECU_ADDRESS 0xFDA2 /end MEASUREMENT
/begin MEASUREMENT B_dmdstop "Ev-Abschaltung aktiv --> Aussetzerekennung sperren" UWORD B_TRUE 1 100 0 1 BIT_MASK 0x800 FORMAT "%13.11" ECU_ADDRESS 0xFD58 /end MEASUREMENT
/begin MEASUREMENT B_dnn "Bedingung Drehzahlabweichung negativ, nsol<n" UWORD B_TRUE 1 100 0 1 BIT_MASK 0x1 FORMAT "%13.11" ECU_ADDRESS 0xFDA4 /end MEASUREMENT
/begin MEASUREMENT B_dnwrpe "Aktive Diagnose: Einlassnockenwelle in Referenzposition bei Start" UBYTE B_TRUE 1 100 0 1 BIT_MASK 0x4 FORMAT "%13.11" ECU_ADDRESS 0x38491F /end MEASUREMENT
/begin MEASUREMENT B_dnws "Aktive Diagnose: Nockenwellensteuerung" UBYTE B_TRUE 1 100 0 1 BIT_MASK 0x1 FORMAT "%13.11" ECU_ADDRESS 0x38491E /end MEASUREMENT
/begin MEASUREMENT B_dnwse "Aktive Diagnose: Nockenwellensteuerung Einlaß" UBYTE B_TRUE 1 100 0 1 BIT_MASK 0x8 FORMAT "%13.11" ECU_ADDRESS 0x38491E /end MEASUREMENT
/begin MEASUREMENT B_dnwsfa "Diagnose Nockenwellensteuerung: Freigabeanteil für alle Nockenwellen" UBYTE B_TRUE 1 100 0 1 BIT_MASK 0x1 FORMAT "%13.11" ECU_ADDRESS 0x38491D /end MEASUREMENT
/begin MEASUREMENT B_dopzue_i "Bedingung doppelte Zündausgabe : interner puffer" UWORD B_TRUE 1 100 0 1 BIT_MASK 0x8 FORMAT "%13.11" ECU_ADDRESS 0xFD08 /end MEASUREMENT
/begin MEASUREMENT B_dveese "Bedingung: DV-E-Endstufen-Fehler" UWORD B_TRUE 1 100 0 1 BIT_MASK 0x4000 FORMAT "%13.11" ECU_ADDRESS 0xFD48 /end MEASUREMENT
/begin MEASUREMENT B_dveesh "Bedingung: DV-E-Enstufen-Heilung" UWORD B_TRUE 1 100 0 1 BIT_MASK 0x8000 FORMAT "%13.11" ECU_ADDRESS 0xFD48 /end MEASUREMENT
/begin MEASUREMENT B_dvete "Bedingung: Erweiterte Stellertauscherkennung" UWORD B_TRUE 1 100 0 1 BIT_MASK 0x1 FORMAT "%13.11" ECU_ADDRESS 0xFD4A /end MEASUREMENT
/begin MEASUREMENT B_dzai "Bedingung doppelte Zündausgabe interne Anforderung" UWORD B_TRUE 1 100 0 1 BIT_MASK 0x10 FORMAT "%13.11" ECU_ADDRESS 0xFD08 /end MEASUREMENT
/begin MEASUREMENT B_ekp "Freigabe der EKP-Versorgung" UWORD B_TRUE 1 100 0 1 BIT_MASK 0x1 FORMAT "%13.11" ECU_ADDRESS 0xFDB0 /end MEASUREMENT
/begin MEASUREMENT B_ekpd "Bedingung EKP Dauerbetrieb" UWORD B_TRUE 1 100 0 1 BIT_MASK 0x2 FORMAT "%13.11" ECU_ADDRESS 0xFDB0 /end MEASUREMENT
/begin MEASUREMENT B_ekps "Bedingung schnelle Aktivierung der EKP beim Start" UWORD B_TRUE 1 100 0 1 BIT_MASK 0x4 FORMAT "%13.11" ECU_ADDRESS 0xFDB0 /end MEASUREMENT
/begin MEASUREMENT B_ekpvl "Bedingung EKP-Vorlauf" UBYTE B_TRUE 1 100 0 1 BIT_MASK 0x1 FORMAT "%13.11" ECU_ADDRESS 0x384930 /end MEASUREMENT
/begin MEASUREMENT B_ekpvla "Bedingung EKP Vorlauf angefordert" UBYTE B_TRUE 1 100 0 1 BIT_MASK 0x2 FORMAT "%13.11" ECU_ADDRESS 0x384930 /end MEASUREMENT
/begin MEASUREMENT B_ekpvlz "Bedingung EKP Vorlauf zulässig" UBYTE B_TRUE 1 100 0 1 BIT_MASK 0x4 FORMAT "%13.11" ECU_ADDRESS 0x384930 /end MEASUREMENT
/begin MEASUREMENT B_enabale "Bedingung: Freigabe zur Berechnung der Motorabstellposition" UWORD B_TRUE 1 100 0 1 BIT_MASK 0x1000 FORMAT "%13.11" ECU_ADDRESS 0xFD2A /end MEASUREMENT
/begin MEASUREMENT B_encifi "Enable cylinder individual fuel injektion" UWORD B_TRUE 1 100 0 1 BIT_MASK 0x1000 FORMAT "%13.11" ECU_ADDRESS 0xFD4C /end MEASUREMENT
/begin MEASUREMENT B_evabu "Bedingung Ev-Abschaltung durch Überwachungsfunktionen" UWORD B_TRUE 1 100 0 1 BIT_MASK 0x400 FORMAT "%13.11" ECU_ADDRESS 0xFD5E /end MEASUREMENT
/begin MEASUREMENT B_evasel "Status alle für DASE relevant. lokalen Einspritzventile d. SG werden angesteuert" UWORD B_TRUE 1 100 0 1 BIT_MASK 0x100 FORMAT "%13.11" ECU_ADDRESS 0xFD5E /end MEASUREMENT
/begin MEASUREMENT B_ffsn2_i "Bedingung Folgefunkenzündung 2tes Ladeereignis" UWORD B_TRUE 1 100 0 1 BIT_MASK 0x20 FORMAT "%13.11" ECU_ADDRESS 0xFD08 /end MEASUREMENT
/begin MEASUREMENT B_ff_i "Bedingung Folgefunkenzündung: interner Puffer" UWORD B_TRUE 1 100 0 1 BIT_MASK 0x40 FORMAT "%13.11" ECU_ADDRESS 0xFD08 /end MEASUREMENT
/begin MEASUREMENT B_fophsnl "Evabschaltung über feste Abschaltmuster ohne Notlauf Phasensuche" UWORD B_TRUE 1 100 0 1 BIT_MASK 0x1000 FORMAT "%13.11" ECU_ADDRESS 0xFD58 /end MEASUREMENT
/begin MEASUREMENT B_fs "Bedingung Fahrstufe" UWORD B_TRUE 1 100 0 1 BIT_MASK 0x1000 FORMAT "%13.11" ECU_ADDRESS 0xFD3E /end MEASUREMENT
/begin MEASUREMENT B_gfen "Bedingung Gangfenster" UWORD B_TRUE 1 100 0 1 BIT_MASK 0x100 FORMAT "%13.11" ECU_ADDRESS 0xFD86 /end MEASUREMENT
/begin MEASUREMENT B_gwhs "Bedingung Gangwechsel bei Handschalter" UWORD B_TRUE 1 100 0 1 BIT_MASK 0x2000 FORMAT "%13.11" ECU_ADDRESS 0xFD3E /end MEASUREMENT
/begin MEASUREMENT B_hpnmot "Bedingung Hochpunkt Drehzahlschwingung" UWORD B_TRUE 1 100 0 1 BIT_MASK 0x200 FORMAT "%13.11" ECU_ADDRESS 0xFD86 /end MEASUREMENT
/begin MEASUREMENT B_iklrest "Bedingung: Retriggerung I-Klein" UWORD B_TRUE 1 100 0 1 BIT_MASK 0x2 FORMAT "%13.11" ECU_ADDRESS 0xFD4A /end MEASUREMENT
/begin MEASUREMENT B_iklstar "Bedingung: I-Klein soll starten" UWORD B_TRUE 1 100 0 1 BIT_MASK 0x4 FORMAT "%13.11" ECU_ADDRESS 0xFD4A /end MEASUREMENT
/begin MEASUREMENT B_iniar "Bedingung Initialisierung der AR-Funktion" UWORD B_TRUE 1 100 0 1 BIT_MASK 0x400 FORMAT "%13.11" ECU_ADDRESS 0xFD86 /end MEASUREMENT
/begin MEASUREMENT B_iniar1 "Bedingung Initialisierung ARMD vorläufig" UWORD B_TRUE 1 100 0 1 BIT_MASK 0x800 FORMAT "%13.11" ECU_ADDRESS 0xFD86 /end MEASUREMENT
/begin MEASUREMENT B_iniarv "Bedingung Initialisierung der Filterfunktion verzögert" UWORD B_TRUE 1 100 0 1 BIT_MASK 0x1000 FORMAT "%13.11" ECU_ADDRESS 0xFD86 /end MEASUREMENT
/begin MEASUREMENT B_kd "Bedingung Kick-Down" UBYTE B_TRUE 1 100 0 1 BIT_MASK 0x1 FORMAT "%13.11" ECU_ADDRESS 0x3809C3 /end MEASUREMENT
/begin MEASUREMENT B_kdpos "Bedingung Kick-Down-Position während Lernvorgang erreicht" UBYTE B_TRUE 1 100 0 1 BIT_MASK 0x40 FORMAT "%13.11" ECU_ADDRESS 0x3809C3 /end MEASUREMENT
/begin MEASUREMENT B_kupgw "Bedingung Kupplung betätigt bis erkannter Gangwechsel" UWORD B_TRUE 1 100 0 1 BIT_MASK 0x2000 FORMAT "%13.11" ECU_ADDRESS 0xFD86 /end MEASUREMENT
/begin MEASUREMENT B_lkderf "Bedingung Kick-Down-Position erfolgreich gelernt" UBYTE B_TRUE 1 100 0 1 BIT_MASK 0x1 FORMAT "%13.11" ECU_ADDRESS 0x38312E /end MEASUREMENT
/begin MEASUREMENT B_lkdfrg "Bedingung Freigabe Kick-Down-Lernen" UBYTE B_TRUE 1 100 0 1 BIT_MASK 0x80 FORMAT "%13.11" ECU_ADDRESS 0x3809C3 /end MEASUREMENT
/begin MEASUREMENT B_msmntpk "Massenstrom kleiner als Schwellwert NRKTPKTU, Verzögerung von B_atmtpk" UBYTE B_TRUE 1 100 0 1 BIT_MASK 0x20 FORMAT "%13.11" ECU_ADDRESS 0x38482F /end MEASUREMENT
/begin MEASUREMENT B_nlphea "Ev-Abschaltung für Notlauf Phasensynchronisation aktiv" UWORD B_TRUE 1 100 0 1 BIT_MASK 0x2000 FORMAT "%13.11" ECU_ADDRESS 0xFD58 /end MEASUREMENT
/begin MEASUREMENT B_nlpheai "Ev-Abschaltung für Notlauf Phasensynchronisation aktiv AEVAB intern" UWORD B_TRUE 1 100 0 1 BIT_MASK 0x4000 FORMAT "%13.11" ECU_ADDRESS 0xFD58 /end MEASUREMENT
/begin MEASUREMENT B_nlpne "Bedingung: Bei gefordertem DK-Notluftfahren wurde NLP nicht erreicht" UWORD B_TRUE 1 100 0 1 BIT_MASK 0x8 FORMAT "%13.11" ECU_ADDRESS 0xFD4A /end MEASUREMENT
/begin MEASUREMENT B_nmotnwdf "Freigabe Nockenwellendiagnose über Drehzahlschwellen" UBYTE B_TRUE 1 100 0 1 BIT_MASK 0x2 FORMAT "%13.11" ECU_ADDRESS 0x38491D /end MEASUREMENT
/begin MEASUREMENT B_nwsaktiv "" UWORD B_TRUE 1 100 0 1 BIT_MASK 0x2000 FORMAT "%13.11" ECU_ADDRESS 0xFD4C /end MEASUREMENT
/begin MEASUREMENT B_nwsalt "" UWORD B_TRUE 1 100 0 1 BIT_MASK 0x4000 FORMAT "%13.11" ECU_ADDRESS 0xFD4C /end MEASUREMENT
/begin MEASUREMENT B_nwse "Bedingung Nockenwellensteuerung (Einlaßseitig)" UBYTE B_TRUE 1 100 0 1 BIT_MASK 0x1 FORMAT "%13.11" ECU_ADDRESS 0x38492B /end MEASUREMENT
/begin MEASUREMENT B_pvlab "Bedingung EKP Vorlauf aus Abstellzeitüberschreitung" UBYTE B_TRUE 1 100 0 1 BIT_MASK 0x8 FORMAT "%13.11" ECU_ADDRESS 0x384930 /end MEASUREMENT
/begin MEASUREMENT B_pvlnl "Bedingung EKP-Vorlauf aus Nachlaufzeitüberschreitung" UBYTE B_TRUE 1 100 0 1 BIT_MASK 0x10 FORMAT "%13.11" ECU_ADDRESS 0x384930 /end MEASUREMENT
/begin MEASUREMENT B_pwrsv "Bedingung: DV-E-powersave ist aktiv" UWORD B_TRUE 1 100 0 1 BIT_MASK 0x10 FORMAT "%13.11" ECU_ADDRESS 0xFD4A /end MEASUREMENT
/begin MEASUREMENT B_ralectr "Bedingung letzte Zahnzeit > TRD" UWORD B_TRUE 1 100 0 1 BIT_MASK 0x2000 FORMAT "%13.11" ECU_ADDRESS 0xFD2A /end MEASUREMENT
/begin MEASUREMENT B_raleok "Bedingung letzter Zahn liegt im plausiblen Rückdrehbereich" UWORD B_TRUE 1 100 0 1 BIT_MASK 0x4000 FORMAT "%13.11" ECU_ADDRESS 0xFD2A /end MEASUREMENT
/begin MEASUREMENT B_skaevab "Bedingung Ev-Abschaltung durch Sicherheitskraftstoffabschaltung aktiv" UWORD B_TRUE 1 100 0 1 BIT_MASK 0x800 FORMAT "%13.11" ECU_ADDRESS 0xFD5E /end MEASUREMENT
/begin MEASUREMENT B_sl "Bedingung Servo-Lenkung" UWORD B_TRUE 1 100 0 1 BIT_MASK 0x1 FORMAT "%13.11" ECU_ADDRESS 0xFD10 /end MEASUREMENT
/begin MEASUREMENT B_slsn2 "Bedingung Überlappung nach zylinderindiv. Spätverstellung" UWORD B_TRUE 1 100 0 1 BIT_MASK 0x80 FORMAT "%13.11" ECU_ADDRESS 0xFD08 /end MEASUREMENT
/begin MEASUREMENT B_spontan0 "" UWORD B_TRUE 1 100 0 1 BIT_MASK 0x8000 FORMAT "%13.11" ECU_ADDRESS 0xFD4C /end MEASUREMENT
/begin MEASUREMENT B_spontan1 "" UWORD B_TRUE 1 100 0 1 BIT_MASK 0x1 FORMAT "%13.11" ECU_ADDRESS 0xFD4E /end MEASUREMENT
/begin MEASUREMENT B_spontan2 "" UWORD B_TRUE 1 100 0 1 BIT_MASK 0x2 FORMAT "%13.11" ECU_ADDRESS 0xFD4E /end MEASUREMENT
/begin MEASUREMENT B_spontan3 "" UWORD B_TRUE 1 100 0 1 BIT_MASK 0x4 FORMAT "%13.11" ECU_ADDRESS 0xFD4E /end MEASUREMENT
/begin MEASUREMENT B_stndnl "Bedingung Beginn SG-Nachlauf oder Startende (1->0)" UBYTE B_TRUE 1 100 0 1 BIT_MASK 0x1 FORMAT "%13.11" ECU_ADDRESS 0x38482F /end MEASUREMENT
/begin MEASUREMENT B_sw0 "Bedingung keine Schliesszeitüberlappung" UWORD B_TRUE 1 100 0 1 BIT_MASK 0x100 FORMAT "%13.11" ECU_ADDRESS 0xFD08 /end MEASUREMENT
/begin MEASUREMENT B_sw1 "Bedingung Schliesszeitüberlappung" UWORD B_TRUE 1 100 0 1 BIT_MASK 0x200 FORMAT "%13.11" ECU_ADDRESS 0xFD08 /end MEASUREMENT
/begin MEASUREMENT B_synti "" UWORD B_TRUE 1 100 0 1 BIT_MASK 0x8 FORMAT "%13.11" ECU_ADDRESS 0xFD4E /end MEASUREMENT
/begin MEASUREMENT B_tevtstp "Bedingung Stop für TEV Timer" UWORD B_TRUE 1 100 0 1 BIT_MASK 0x4 FORMAT "%13.11" ECU_ADDRESS 0xFD9E /end MEASUREMENT
/begin MEASUREMENT B_ti_cha0 "" UWORD B_TRUE 1 100 0 1 BIT_MASK 0x10 FORMAT "%13.11" ECU_ADDRESS 0xFD4E /end MEASUREMENT
/begin MEASUREMENT B_ti_cha1 "" UWORD B_TRUE 1 100 0 1 BIT_MASK 0x20 FORMAT "%13.11" ECU_ADDRESS 0xFD4E /end MEASUREMENT
/begin MEASUREMENT B_ti_cha2 "" UWORD B_TRUE 1 100 0 1 BIT_MASK 0x40 FORMAT "%13.11" ECU_ADDRESS 0xFD4E /end MEASUREMENT
/begin MEASUREMENT B_ti_cha3 "" UWORD B_TRUE 1 100 0 1 BIT_MASK 0x80 FORMAT "%13.11" ECU_ADDRESS 0xFD4E /end MEASUREMENT
/begin MEASUREMENT B_ti_out0 "" UWORD B_TRUE 1 100 0 1 BIT_MASK 0x100 FORMAT "%13.11" ECU_ADDRESS 0xFD4E /end MEASUREMENT
/begin MEASUREMENT B_ti_out1 "" UWORD B_TRUE 1 100 0 1 BIT_MASK 0x200 FORMAT "%13.11" ECU_ADDRESS 0xFD4E /end MEASUREMENT
/begin MEASUREMENT B_ti_out2 "" UWORD B_TRUE 1 100 0 1 BIT_MASK 0x400 FORMAT "%13.11" ECU_ADDRESS 0xFD4E /end MEASUREMENT
/begin MEASUREMENT B_ti_out3 "" UWORD B_TRUE 1 100 0 1 BIT_MASK 0x800 FORMAT "%13.11" ECU_ADDRESS 0xFD4E /end MEASUREMENT
/begin MEASUREMENT B_ti_wai0 "" UWORD B_TRUE 1 100 0 1 BIT_MASK 0x1000 FORMAT "%13.11" ECU_ADDRESS 0xFD4E /end MEASUREMENT
/begin MEASUREMENT B_ti_wai1 "" UWORD B_TRUE 1 100 0 1 BIT_MASK 0x2000 FORMAT "%13.11" ECU_ADDRESS 0xFD4E /end MEASUREMENT
/begin MEASUREMENT B_ti_wai2 "" UWORD B_TRUE 1 100 0 1 BIT_MASK 0x4000 FORMAT "%13.11" ECU_ADDRESS 0xFD4E /end MEASUREMENT
/begin MEASUREMENT B_ti_wai3 "" UWORD B_TRUE 1 100 0 1 BIT_MASK 0x8000 FORMAT "%13.11" ECU_ADDRESS 0xFD4E /end MEASUREMENT
/begin MEASUREMENT B_tmotnwdf "Freigabe Nockenwellendiagnose über Motortemperaturschwellen" UBYTE B_TRUE 1 100 0 1 BIT_MASK 0x4 FORMAT "%13.11" ECU_ADDRESS 0x38491D /end MEASUREMENT
/begin MEASUREMENT B_tolnwdf "Freigabe Nockenwellendiagnose über Öltemperaturschwellen" UBYTE B_TRUE 1 100 0 1 BIT_MASK 0x8 FORMAT "%13.11" ECU_ADDRESS 0x38491D /end MEASUREMENT
/begin MEASUREMENT B_tooth "Bedingung Zahnerkennung" UWORD B_TRUE 1 100 0 1 BIT_MASK 0x8 FORMAT "%13.11" ECU_ADDRESS 0xFDB0 /end MEASUREMENT
/begin MEASUREMENT B_tpnmot "Bedingung Tiefpunkt Drehzahlschwingung" UWORD B_TRUE 1 100 0 1 BIT_MASK 0x4000 FORMAT "%13.11" ECU_ADDRESS 0xFD86 /end MEASUREMENT
/begin MEASUREMENT B_tvars "Bedingung Antiruckelfunktion dynamisch aktiv" UWORD B_TRUE 1 100 0 1 BIT_MASK 0x8000 FORMAT "%13.11" ECU_ADDRESS 0xFD86 /end MEASUREMENT
/begin MEASUREMENT B_tvarss "Bedingung Antiruckelfunktion stationär aktiv" UWORD B_TRUE 1 100 0 1 BIT_MASK 0x1 FORMAT "%13.11" ECU_ADDRESS 0xFD88 /end MEASUREMENT
/begin MEASUREMENT B_ubdve "Bedingung: Batteriespannung für DV-E-Ansteuerung i.O." UWORD B_TRUE 1 100 0 1 BIT_MASK 0x20 FORMAT "%13.11" ECU_ADDRESS 0xFD4A /end MEASUREMENT
/begin MEASUREMENT B_ubpvg "Bedingung Batteriespannung ausreichend für 5V-Potiversorgung" UWORD B_TRUE 1 100 0 1 BIT_MASK 0x40 FORMAT "%13.11" ECU_ADDRESS 0xFD4A /end MEASUREMENT
/begin MEASUREMENT B_ub_ok "Batteriespannung o.k." UWORD B_TRUE 1 100 0 1 BIT_MASK 0x80 FORMAT "%13.11" ECU_ADDRESS 0xFD4A /end MEASUREMENT
/begin MEASUREMENT B_umsync "Bedingung Umsynchronisation nach Bezugsmarke" UWORD B_TRUE 1 100 0 1 BIT_MASK 0x1 FORMAT "%13.11" ECU_ADDRESS 0xFD50 /end MEASUREMENT
/begin MEASUREMENT B_wdksauf "Bedingung: DLR, Sollsprung in Richtung AUF" UWORD B_TRUE 1 100 0 1 BIT_MASK 0x100 FORMAT "%13.11" ECU_ADDRESS 0xFD4A /end MEASUREMENT
/begin MEASUREMENT B_wdksive "Bedingung: Fehler im Vergleich DK-Winkel-Sollwert/-Istwert" UWORD B_TRUE 1 100 0 1 BIT_MASK 0x200 FORMAT "%13.11" ECU_ADDRESS 0xFD4A /end MEASUREMENT
/begin MEASUREMENT B_z1 "Bedingung Zündbereich 1 aktiv" UWORD B_TRUE 1 100 0 1 BIT_MASK 0x400 FORMAT "%13.11" ECU_ADDRESS 0xFD08 /end MEASUREMENT
/begin MEASUREMENT B_z1not "Flag Zündbereich 1 aktiv :  Anforderung im Notlauf" UWORD B_TRUE 1 100 0 1 BIT_MASK 0x800 FORMAT "%13.11" ECU_ADDRESS 0xFD08 /end MEASUREMENT
/begin MEASUREMENT B_z1_i "Flag Zündbereich 1 aktiv : interne Anforderung" UWORD B_TRUE 1 100 0 1 BIT_MASK 0x1000 FORMAT "%13.11" ECU_ADDRESS 0xFD08 /end MEASUREMENT
/begin MEASUREMENT B_zesync "Bedingung Zündung synchronisiert" UWORD B_TRUE 1 100 0 1 BIT_MASK 0x2000 FORMAT "%13.11" ECU_ADDRESS 0xFD08 /end MEASUREMENT
/begin MEASUREMENT B_zesync_d "Bedingung Zündung synchronisiert verzögern" UWORD B_TRUE 1 100 0 1 BIT_MASK 0x4000 FORMAT "%13.11" ECU_ADDRESS 0xFD08 /end MEASUREMENT
/begin MEASUREMENT B_zws0 "Bedingung Übergang zur einfachen Schliesszeitüberlappung - Schliesszeitausgabe" UWORD B_TRUE 1 100 0 1 BIT_MASK 0x8000 FORMAT "%13.11" ECU_ADDRESS 0xFD08 /end MEASUREMENT
/begin MEASUREMENT cc_cha_0 "" UWORD dez 1 100 0 65535 FORMAT "%8.2" ECU_ADDRESS 0xF982 /end MEASUREMENT
/begin MEASUREMENT cc_cha_1 "" UWORD dez 1 100 0 65535 FORMAT "%8.2" ECU_ADDRESS 0xF984 /end MEASUREMENT
/begin MEASUREMENT cc_cha_2 "" UWORD dez 1 100 0 65535 FORMAT "%8.2" ECU_ADDRESS 0xF986 /end MEASUREMENT
/begin MEASUREMENT cc_cha_3 "" UWORD dez 1 100 0 65535 FORMAT "%8.2" ECU_ADDRESS 0xF988 /end MEASUREMENT
/begin MEASUREMENT dekpub "Differenz der Batteriespannung zwischen zwei Messungen bis EKP-Dauerbetrieb" UBYTE spg_q0p1 1 100 0 25.5 FORMAT "%5.2" ECU_ADDRESS 0x380BE9 /end MEASUREMENT
/begin MEASUREMENT deltaseg_w "Delta Segmente bei Umsynchronisation der Einspritzausgabe" UWORD dez 1 100 0 65535 FORMAT "%8.2" ECU_ADDRESS 0x381D6C /end MEASUREMENT
/begin MEASUREMENT dklagerc "Fehlerzähler DK-Lageüberwachung" UBYTE t20msxs_ub_b5p1 1 100 0 5.1 FORMAT "%5.3" ECU_ADDRESS 0x3809E2 /end MEASUREMENT
/begin MEASUREMENT dlamatr2_w "Delta Lambdasoll aus Abgastemperaturregelung Bank 2" SWORD fak_sw_b8 1 100 -8 7.99976 FORMAT "%8.6" ECU_ADDRESS 0x384B7E /end MEASUREMENT
/begin MEASUREMENT dlamatr_w "Delta Lambdasoll aus Abgastemperaturregelung" SWORD fak_sw_b8 1 100 -8 7.99976 FORMAT "%8.6" ECU_ADDRESS 0x384B80 /end MEASUREMENT
/begin MEASUREMENT dlatr2_w "delta Lambda Abgastemperaturregelung Bank 2" SWORD fak_sw_b8 1 100 -8 7.99976 FORMAT "%8.6" ECU_ADDRESS 0x384B82 /end MEASUREMENT
/begin MEASUREMENT dlatri_w "I-Anteil Abgastemperaturregler" SWORD fak_sw_b8 1 100 -8 7.99976 FORMAT "%8.6" ECU_ADDRESS 0x384B84 /end MEASUREMENT
/begin MEASUREMENT dlatrnl_w "Delta Lambdasoll aus Notlauf Abgastemperaturregelung" SWORD fak_sw_b8 1 100 -8 7.99976 FORMAT "%8.6" ECU_ADDRESS 0x384B86 /end MEASUREMENT
/begin MEASUREMENT dlatrp_w "P-Anteil Abgastemperaturregler" SWORD fak_sw_b8 1 100 -8 7.99976 FORMAT "%8.6" ECU_ADDRESS 0x384B88 /end MEASUREMENT
/begin MEASUREMENT dlatr_w "delta Lambda Abgastemperaturregelung" SWORD fak_sw_b8 1 100 -8 7.99976 FORMAT "%8.6" ECU_ADDRESS 0x384B8A /end MEASUREMENT
/begin MEASUREMENT dlrd "DLR, D-Parameter" UBYTE relDK_q4 1 100 0 1020 FORMAT "%5.0" ECU_ADDRESS 0xF934 /end MEASUREMENT
/begin MEASUREMENT dlrhaftak "Zeitzähler Haftreibungsroutine" SWORD rel_q0p1957 1 100 -6412.52 6412.33 FORMAT "%8.3" ECU_ADDRESS 0x384A9C /end MEASUREMENT
/begin MEASUREMENT dlri "DLR, I-Parameter" UBYTE relDK_q0p0625 1 100 0 15.9375 FORMAT "%5.2" ECU_ADDRESS 0xF935 /end MEASUREMENT
/begin MEASUREMENT dlriamax "DLR, maximal möglicher I-Anteil" UWORD rel_q0p1957 1 100 0 12824.9 FORMAT "%8.2" ECU_ADDRESS 0xF93A /end MEASUREMENT
/begin MEASUREMENT dlriant_w "DLR, I-Anteil, highword von dlriant_l" SWORD rel_sw_q0p1953 1 100 -6400 6399.8 FORMAT "%8.3" ECU_ADDRESS 0x381D44 /end MEASUREMENT
/begin MEASUREMENT dlrihaftc "DLR, Zähler für DV-E in Haftreibung" UBYTE t50msxs_q0p05 1 100 0 12.75 FORMAT "%5.2" ECU_ADDRESS 0x38485C /end MEASUREMENT
/begin MEASUREMENT dlriklst_w "Vorladewert I-Kleinanteil" SWORD rel_q0p1957 1 100 -6412.52 6412.33 FORMAT "%8.3" ECU_ADDRESS 0x381D46 /end MEASUREMENT
/begin MEASUREMENT dlrikl_w "DLR, I-Kleinanteil" SWORD rel_q0p1957 1 100 -6412.52 6412.33 FORMAT "%8.3" ECU_ADDRESS 0xF93C /end MEASUREMENT
/begin MEASUREMENT dlrini_w "I-Anteil bei Initialisierung der NLP-Function" UWORD rel_q0p1957 1 100 0 12824.9 FORMAT "%8.2" ECU_ADDRESS 0x381D48 /end MEASUREMENT
/begin MEASUREMENT dlrkomp "DLR, Faktor Kreisverstärkung" UBYTE fak_ub_b2 1 100 0 1.99219 FORMAT "%5.3" ECU_ADDRESS 0xF936 /end MEASUREMENT
/begin MEASUREMENT dlrndif_w "Istwert aktuell - Istwert letzter für D-Anteil des DLR" SWORD relDK_q0p02441 1 100 -800 799.976 FORMAT "%8.4" ECU_ADDRESS 0xF93E /end MEASUREMENT
/begin MEASUREMENT dlrp "DLR, P-Parameter" UBYTE relDK_q1 1 100 0 255 FORMAT "%5.1" ECU_ADDRESS 0xF937 /end MEASUREMENT
/begin MEASUREMENT dlrpidc "Fehlerzähler DLR-Stellbereichsüberwachung" UWORD t10msxs_uw_b655p35 1 100 0 655.35 FORMAT "%8.4" ECU_ADDRESS 0x381D4A /end MEASUREMENT
/begin MEASUREMENT dlrspid_w "DLR für DV-E: Summe der PID-Anteile" UWORD rel_uw_b100 1 100 0 99.9985 FORMAT "%8.5" ECU_ADDRESS 0xF940 /end MEASUREMENT
/begin MEASUREMENT dlrubrsq "Batterie-Normalspanung in Quantisierung von ubrsq" UBYTE spg_q0p1 1 100 0 25.5 FORMAT "%5.2" ECU_ADDRESS 0x38485D /end MEASUREMENT
/begin MEASUREMENT dmar_w "Delta Drehmoment antiruckel" SWORD rel_sw_b100 1 100 -100 99.9969 FORMAT "%8.4" ECU_ADDRESS 0x3825BC /end MEASUREMENT
/begin MEASUREMENT dmdevab "Ev-Abschaltmuster der Aussetzererkennung das auf dem aktuellen SG umgesetzt wird" UBYTE dez 1 100 0 255 FORMAT "%5.1" ECU_ADDRESS 0x380A30 /end MEASUREMENT
/begin MEASUREMENT dpspu "Delta zwischen Absolut- und Umgebungsdruck" UBYTE p_ub_q10 1 100 0 2550 FORMAT "%5.0" ECU_ADDRESS 0x384894 /end MEASUREMENT
/begin MEASUREMENT dpwrsvc "Zeitzähler DV-E-Powersave" UWORD t10msxs_uw_b655p35 1 100 0 655.35 FORMAT "%8.4" ECU_ADDRESS 0x381D4C /end MEASUREMENT
/begin MEASUREMENT dtabgpr_w "Gradient der Abgastemperatur" SWORD tempg_q0p0195 1 100 -640 639.98 FORMAT "%8.4" ECU_ADDRESS 0x384B8C /end MEASUREMENT
/begin MEASUREMENT dtabprl_w "Gradient der Abgastemperatur limitiert" SWORD tempg_q0p0195 1 100 -640 639.98 FORMAT "%8.4" ECU_ADDRESS 0x384B8E /end MEASUREMENT
/begin MEASUREMENT dveesc "Entprellzähler für DV-E-Endstufe" UBYTE t10msxs_ub_b2p55 1 100 0 2.55 FORMAT "%5.3" ECU_ADDRESS 0x3809E3 /end MEASUREMENT
/begin MEASUREMENT dwdkdlr_w "Differenz-DK-Winkel Sollwert - Istwert (wdkdlr_w - wdkba_w)" SWORD relDK_q0p02441 1 100 -800 799.976 FORMAT "%8.4" ECU_ADDRESS 0xF942 /end MEASUREMENT
/begin MEASUREMENT dzaCtr "Zähler DZA Betrieb, zählt Modusübergang aus" UBYTE dez 1 100 0 255 FORMAT "%5.1" ECU_ADDRESS 0xF7CA /end MEASUREMENT
/begin MEASUREMENT eevx "EV Fehlerbyte" UBYTE dez 1 100 0 255 FORMAT "%5.1" ECU_ADDRESS 0x380A31 /end MEASUREMENT
/begin MEASUREMENT esst_smk08mdsw "" UWORD dez 1 100 0 65535 FORMAT "%8.2" ECU_ADDRESS 0x384C5E /end MEASUREMENT
/begin MEASUREMENT esst_sts06tmuw "" UWORD dez 1 100 0 65535 FORMAT "%8.2" ECU_ADDRESS 0x384A3C /end MEASUREMENT
/begin MEASUREMENT esst_stu05tmub "" UBYTE dez 1 100 0 255 FORMAT "%5.1" ECU_ADDRESS 0x384830 /end MEASUREMENT
/begin MEASUREMENT etazwimt "Ist_Zündwinkelwirkungsgrad für ATM gemittelt (200 ms)" UBYTE rel_ub_b127p5 1 100 0 127.5 FORMAT "%5.1" ECU_ADDRESS 0x384831 /end MEASUREMENT
/begin MEASUREMENT evrbgn_one "Ev Nr -1 bei Beginn der Ev-Abschaltung zur Adressierung von REDABM" UBYTE dez 1 100 0 255 FORMAT "%5.1" ECU_ADDRESS 0x380A32 /end MEASUREMENT
/begin MEASUREMENT evz_aus "Einspritzausblendmuster" UBYTE dez 1 100 0 255 FORMAT "%5.1" ECU_ADDRESS 0x380A33 /end MEASUREMENT
/begin MEASUREMENT evz_austot "Einspritzausblendmuster total" UBYTE dez 1 100 0 255 FORMAT "%5.1" ECU_ADDRESS 0x380A50 /end MEASUREMENT
/begin MEASUREMENT fbmxzahn "Funkenbandbegrenzung Maximalwinkel" UBYTE dez 1 100 0 255 FORMAT "%5.1" ECU_ADDRESS 0xF7CB /end MEASUREMENT
/begin MEASUREMENT fdar "Verstärkungsfaktor des AR-Eingriffs" UBYTE fak_ub_b3p125 1 100 0 3.11279 FORMAT "%5.3" ECU_ADDRESS 0x380B19 /end MEASUREMENT
/begin MEASUREMENT fgezs0 "" UBYTE fak_ub_b2 1 100 0 1.99219 FORMAT "%5.3" ECU_ADDRESS 0xF960 /end MEASUREMENT
/begin MEASUREMENT fgezs1 "" UBYTE fak_ub_b2 1 100 0 1.99219 FORMAT "%5.3" ECU_ADDRESS 0xF961 /end MEASUREMENT
/begin MEASUREMENT fgezs2 "" UBYTE fak_ub_b2 1 100 0 1.99219 FORMAT "%5.3" ECU_ADDRESS 0xF962 /end MEASUREMENT
/begin MEASUREMENT fgezs3 "" UBYTE fak_ub_b2 1 100 0 1.99219 FORMAT "%5.3" ECU_ADDRESS 0xF963 /end MEASUREMENT
/begin MEASUREMENT flrar "Verstärkungsfaktor zum Nachbilden der externen Last" UBYTE fak_ub_b16 1 100 0 15.9375 FORMAT "%5.2" ECU_ADDRESS 0x380B1A /end MEASUREMENT
/begin MEASUREMENT fubaanz_i "" UBYTE dez 1 100 0 255 FORMAT "%5.1" ECU_ADDRESS 0xF7CC /end MEASUREMENT
/begin MEASUREMENT fweg "maximaler Faktor Wiedereinsetzmehrmenge" UBYTE fak_ub_b2 1 100 0 1.99219 FORMAT "%5.3" ECU_ADDRESS 0xF964 /end MEASUREMENT
/begin MEASUREMENT fwez0 "Faktor Wiedereinsetzmenge zylinderindividuell Zyl. 1" UBYTE fak_ub_b2 1 100 0 1.99219 FORMAT "%5.3" ECU_ADDRESS 0xF965 /end MEASUREMENT
/begin MEASUREMENT fwez1 "Faktor Wiedereinsetzmenge zylinderindividuell Zyl. 2" UBYTE fak_ub_b2 1 100 0 1.99219 FORMAT "%5.3" ECU_ADDRESS 0xF966 /end MEASUREMENT
/begin MEASUREMENT fwez2 "Faktor Wiedereinsetzmenge zylinderindividuell Zyl. 3" UBYTE fak_ub_b2 1 100 0 1.99219 FORMAT "%5.3" ECU_ADDRESS 0xF967 /end MEASUREMENT
/begin MEASUREMENT fwez3 "Faktor Wiedereinsetzmenge zylinderindividuell Zyl. 4" UBYTE fak_ub_b2 1 100 0 1.99219 FORMAT "%5.3" ECU_ADDRESS 0xF968 /end MEASUREMENT
/begin MEASUREMENT gangi "Ist-Gang" UBYTE dez 1 100 0 255 FORMAT "%5.1" ECU_ADDRESS 0x3809B5 /end MEASUREMENT
/begin MEASUREMENT gwdkdlr_w "Änderung des Drosselklappen-Sollwinkels, Betrag für Kennlinieneingang" SWORD relDK_q0p00152 1 100 -50 49.9985 FORMAT "%8.5" ECU_ADDRESS 0xF944 /end MEASUREMENT
/begin MEASUREMENT gwdk_kge "Änderung des Drosselklappen-Sollwinkels, Betrag für Kennlinieneingang" UWORD relDK_q0p00152 1 100 0 99.9985 FORMAT "%8.5" ECU_ADDRESS 0x381D4E /end MEASUREMENT
/begin MEASUREMENT iasp1plaus_w "" UWORD spg_uw_b5 1 100 0 319.995 FORMAT "%8.4" ECU_ADDRESS 0x380E02 /end MEASUREMENT
/begin MEASUREMENT ignDelayCtr "" UBYTE dez 1 100 0 255 FORMAT "%5.1" ECU_ADDRESS 0xF7CD /end MEASUREMENT
/begin MEASUREMENT imlatm "integr. Luftmassenfluss ab Motorstart bis Max.wert" UBYTE m_ub_b23p3 1 100 0 23.2107 FORMAT "%5.2" ECU_ADDRESS 0x384832 /end MEASUREMENT
/begin MEASUREMENT imlatm_w "integr. Luftmassenfluss ab Startende bis max. Wert, (Word)" UWORD m_uw_b23p3 1 100 0 23.3013 FORMAT "%8.5" ECU_ADDRESS 0x384A3E /end MEASUREMENT
/begin MEASUREMENT imlbbo "Integrator Luftmasse für Erkennung Benzin im Öl" UBYTE m_ub_b23p3 1 100 0 23.2107 FORMAT "%5.2" ECU_ADDRESS 0x38400B /end MEASUREMENT
/begin MEASUREMENT iUipoti1_w "ADC-Wert incl. Kanalnummer Drosselklappen-Istwert-Poti 1" UWORD DEZ 1 100 0 65535 FORMAT "%8.2" ECU_ADDRESS 0xF824 /end MEASUREMENT
/begin MEASUREMENT iUipoti2_w "ADC-Wert incl. Kanalnummer Drosselklappen-Istwert-Poti 2" UWORD DEZ 1 100 0 65535 FORMAT "%8.2" ECU_ADDRESS 0xF820 /end MEASUREMENT
/begin MEASUREMENT iUspoti1_w "ADC-Wert incl. Kanalnummer, Sollwertpoti 1" UWORD DEZ 1 100 0 65535 FORMAT "%8.2" ECU_ADDRESS 0xF816 /end MEASUREMENT
/begin MEASUREMENT iUspoti2_w "ADC-Wert incl. Kanalnummer, Sollwertpoti 2" UWORD DEZ 1 100 0 65535 FORMAT "%8.2" ECU_ADDRESS 0xF814 /end MEASUREMENT
/begin MEASUREMENT iwmatmk_w "Wärmemenge für Kondenswasser-Taupunktende Kat (word)" UWORD q_q0p4551 1 100 0 29825.7 FORMAT "%8.2" ECU_ADDRESS 0x384A40 /end MEASUREMENT
/begin MEASUREMENT iwmatm_w "Wärmemenge für Kondenswasser-Taupunktende Abgas/Kat (word)" UWORD q_q0p4551 1 100 0 29825.7 FORMAT "%8.2" ECU_ADDRESS 0x384A42 /end MEASUREMENT
/begin MEASUREMENT kifz_w "Verstärkung des Fahrzeugmodells" UWORD fak_uw_b4864 1 100 0 4863.93 FORMAT "%8.3" ECU_ADDRESS 0x3825BE /end MEASUREMENT
/begin MEASUREMENT mdbes_w "Beschleunigungsmoment" SWORD rel_sw_b100 1 100 -100 99.9969 FORMAT "%8.4" ECU_ADDRESS 0x3825C0 /end MEASUREMENT
/begin MEASUREMENT minzahn "Minimale Zahnzahl ab TR-Marke ab dem Zündereignis stattfinden kann" UBYTE dez 1 100 0 255 FORMAT "%5.1" ECU_ADDRESS 0xF7CE /end MEASUREMENT
/begin MEASUREMENT mkar_w "Berechnetes Kupplungsmoment für Antiruckelfunktion" SWORD rel_sw_b100 1 100 -100 99.9969 FORMAT "%8.4" ECU_ADDRESS 0x3825C2 /end MEASUREMENT
/begin MEASUREMENT mlast_w "geschätztes Lastmoment" SWORD rel_sw_b100 1 100 -100 99.9969 FORMAT "%8.4" ECU_ADDRESS 0x3825C4 /end MEASUREMENT
/begin MEASUREMENT msntev_w "gewünschter normierter, überkritischer Massenstrom TEV" UWORD m_uw_b25p6 1 100 0 25.5996 FORMAT "%8.5" ECU_ADDRESS 0x382B0E /end MEASUREMENT
/begin MEASUREMENT mspcv "Massenstrom über PCV Ventil" UBYTE m_q0p1 1 100 0 25.5 FORMAT "%5.2" ECU_ADDRESS 0x384895 /end MEASUREMENT
/begin MEASUREMENT na_abs_c "" UBYTE dez 1 100 0 255 FORMAT "%5.1" ECU_ADDRESS 0xF969 /end MEASUREMENT
/begin MEASUREMENT na_rel_c "" UBYTE dez 1 100 0 255 FORMAT "%5.1" ECU_ADDRESS 0xF96A /end MEASUREMENT
/begin MEASUREMENT ndar_w "Differenzdrehzahl für Momenteneingriff" SWORD nmot_sw_q0p25 1 100 -8192 8191.75 FORMAT "%8.3" ECU_ADDRESS 0x3825C6 /end MEASUREMENT
/begin MEASUREMENT ndfibet_w "Betrag der gefilterten Differenzdrehzahl" UWORD nmot_uw_q0p25 1 100 0 16383.8 FORMAT "%8.2" ECU_ADDRESS 0x3825C8 /end MEASUREMENT
/begin MEASUREMENT ndfil_w "gefilterte Differenzdrehzahl" SWORD nmot_sw_q0p25 1 100 -8192 8191.75 FORMAT "%8.3" ECU_ADDRESS 0x3825CA /end MEASUREMENT
/begin MEASUREMENT ndiffog_w "Schwelle Drehzahldifferenz zum Resetieren der AR beim Verzögern" SWORD nmot_sw_q0p25 1 100 -8192 8191.75 FORMAT "%8.3" ECU_ADDRESS 0x3825CC /end MEASUREMENT
/begin MEASUREMENT ndiff_w "Differenzdrehzahl für LFR-HS-Verstärkungen" SWORD nmot_sw_q0p25 1 100 -8192 8191.75 FORMAT "%8.3" ECU_ADDRESS 0x3825CE /end MEASUREMENT
/begin MEASUREMENT ndnwtmn "Temperaturabhängige minimaldrehzahl für Diagnose Nockenwellensteuerung" UBYTE nmot_ub_q40 1 100 0 10200 FORMAT "%5.0" ECU_ADDRESS 0x384920 /end MEASUREMENT
/begin MEASUREMENT nmodiv_w "Drehzahl für Initialisierung ARMD berechnet aus Geschwindigkeit" UWORD nmot_uw_q0p25 1 100 0 16383.8 FORMAT "%8.2" ECU_ADDRESS 0x3825D0 /end MEASUREMENT
/begin MEASUREMENT nmod_w "Motordrehzahl aus Modell" UWORD nmot_uw_q0p25 1 100 0 16383.8 FORMAT "%8.2" ECU_ADDRESS 0x3825D2 /end MEASUREMENT
/begin MEASUREMENT nmotk1_w "Motordrehzahl 1 Synchro vorher" UWORD nmot_uw_q0p25 1 100 0 16383.8 FORMAT "%8.2" ECU_ADDRESS 0x3825D4 /end MEASUREMENT
/begin MEASUREMENT nmotk2_w "Motordrehzahl 2 Synchros vorher" UWORD nmot_uw_q0p25 1 100 0 16383.8 FORMAT "%8.2" ECU_ADDRESS 0x3825D6 /end MEASUREMENT
/begin MEASUREMENT nvquot_w "Quotient Motordrehzahl nmot / Fahrgeschwindigkeit vfzg" UWORD qnv_uw_b512 1 100 0 511.992 FORMAT "%8.4" ECU_ADDRESS 0x381CB0 /end MEASUREMENT
/begin MEASUREMENT ovlCtr "Schließzeit-Überlappsungszähler" UBYTE dez 1 100 0 255 FORMAT "%5.1" ECU_ADDRESS 0xF7CF /end MEASUREMENT
/begin MEASUREMENT pd_we_zy "" UWORD dez 1 100 0 65535 FORMAT "%8.2" ECU_ADDRESS 0xF98A /end MEASUREMENT
/begin MEASUREMENT redsolr "Realisierte Reduzierstufe" UBYTE dez 1 100 0 255 FORMAT "%5.1" ECU_ADDRESS 0x380A34 /end MEASUREMENT
/begin MEASUREMENT redsol_one "Berechnete Soll-Reduzierstufe - 1 zur Adress. von REDABM" UBYTE dez 1 100 0 255 FORMAT "%5.1" ECU_ADDRESS 0x380A35 /end MEASUREMENT
/begin MEASUREMENT restw_b1 "" UBYTE dez 1 100 0 255 FORMAT "%5.1" ECU_ADDRESS 0xF96B /end MEASUREMENT
/begin MEASUREMENT restw_b2 "" UBYTE dez 1 100 0 255 FORMAT "%5.1" ECU_ADDRESS 0xF96C /end MEASUREMENT
/begin MEASUREMENT rlatr "Lastschwelle für Abgastemperaturregelung" UBYTE rel_ub_q0p75 1 100 0 191.25 FORMAT "%5.1" ECU_ADDRESS 0x384891 /end MEASUREMENT
/begin MEASUREMENT segz "" UBYTE dez 1 100 0 255 FORMAT "%5.1" ARRAY_SIZE 4 ECU_ADDRESS 0xF96D /end MEASUREMENT
/begin MEASUREMENT slsninkr "Inkrementverfeinerung Schliessbeginnwinkel in 0.75 Grad" UBYTE dez 1 100 0 255 FORMAT "%5.1" ECU_ADDRESS 0xF7D0 /end MEASUREMENT
/begin MEASUREMENT slsninkr2 "Inkrementverfeinerung Schliessbeginnwinkel Überlappung nach Klopfen in 0,75 Grad" UBYTE dez 1 100 0 255 FORMAT "%5.1" ECU_ADDRESS 0xF7D1 /end MEASUREMENT
/begin MEASUREMENT slsninkr_r "Inkrementverfeinerung Schliessbeginnwinkel in 0.75 Grad abs. Winkel bzgl .TR0" UBYTE dez 1 100 0 255 FORMAT "%5.1" ECU_ADDRESS 0xF7D2 /end MEASUREMENT
/begin MEASUREMENT slsnzahn "Schliessbeginnwinkel in Zahnquantisierung 6 Grad" UBYTE dez 1 100 0 255 FORMAT "%5.1" ECU_ADDRESS 0xF7D3 /end MEASUREMENT
/begin MEASUREMENT slsnzahn2 "Schliessbeginnwinkel in Zahnquantisierung für Überlappung nach Klopfen 6 Grad" UBYTE dez 1 100 0 255 FORMAT "%5.1" ECU_ADDRESS 0xF7D4 /end MEASUREMENT
/begin MEASUREMENT slsnzahn_r "Schliessbeginnwinkel in Zahnquantisierung 6 Grad abs. Winkel bzgl. TR Zyl.0" UBYTE dez 1 100 0 255 FORMAT "%5.1" ECU_ADDRESS 0xF7D5 /end MEASUREMENT
/begin MEASUREMENT sn2zkact "Zeiger auf geschloßenen Zündkreis" UWORD dez 1 100 0 65535 FORMAT "%8.2" ECU_ADDRESS 0xF7EA /end MEASUREMENT
/begin MEASUREMENT sn2zkvek "Nächster zu schließender Zündkreis 2tes Schließereignis" UWORD dez 1 100 0 65535 FORMAT "%8.2" ECU_ADDRESS 0xF7EC /end MEASUREMENT
/begin MEASUREMENT snzkact "Zeiger auf geschloßenen Zündkreis" UWORD dez 1 100 0 65535 FORMAT "%8.2" ECU_ADDRESS 0xF7EE /end MEASUREMENT
/begin MEASUREMENT snzkvek "Nächster zu schließender Zündkreis" UWORD dez 1 100 0 65535 FORMAT "%8.2" ECU_ADDRESS 0xF7F0 /end MEASUREMENT
/begin MEASUREMENT stateaevab "Nr des aktiven Zustandes in AEVAB" UBYTE dez 1 100 0 255 FORMAT "%5.1" ECU_ADDRESS 0x380A36 /end MEASUREMENT
/begin MEASUREMENT swout "Schließwinkel" UWORD zw_azue_sy 1 100 0 49151.3 FORMAT "%8.2" ECU_ADDRESS 0xF7F2 /end MEASUREMENT
/begin MEASUREMENT S_bls "Schalter Bremslicht" UWORD B_TRUE 1 100 0 1 BIT_MASK 0x2 FORMAT "%13.11" ECU_ADDRESS 0xFD10 /end MEASUREMENT
/begin MEASUREMENT S_fgrat "Schalter Aus-Tip am FGR-Bedienhebelschalter" UWORD B_TRUE 1 100 0 1 BIT_MASK 0x4 FORMAT "%13.11" ECU_ADDRESS 0xFD10 /end MEASUREMENT
/begin MEASUREMENT S_fgrhs "Hauptschalter am FGR-Bedienhebel" UWORD B_TRUE 1 100 0 1 BIT_MASK 0x8 FORMAT "%13.11" ECU_ADDRESS 0xFD10 /end MEASUREMENT
/begin MEASUREMENT tabgkrm_w "Abgastemperatur im Krümmer aus Modell" UWORD temp_uw_q0p0195_o50 1 100 -50 1229.98 FORMAT "%8.3" ECU_ADDRESS 0x384A44 /end MEASUREMENT
/begin MEASUREMENT tabgm "Abgastemperatur vor Kat aus Modell" UBYTE temp_ub_q5_o50 1 100 -50 1225 FORMAT "%5.0" ECU_ADDRESS 0x384833 /end MEASUREMENT
/begin MEASUREMENT tabgmab "Abgastemperatur beim Abstellen des Motors" UBYTE temp_ub_q5_o50 1 100 -50 1225 FORMAT "%5.0" ECU_ADDRESS 0x38311E /end MEASUREMENT
/begin MEASUREMENT tabgmst "Abgastemperatur bei Motorstart" UBYTE temp_ub_q5_o50 1 100 -50 1225 FORMAT "%5.0" ECU_ADDRESS 0x384834 /end MEASUREMENT
/begin MEASUREMENT tabgm_w "Abgastemperatur vor Kat aus Modell (Word)" UWORD temp_uw_q0p0195_o50 1 100 -50 1229.98 FORMAT "%8.3" ECU_ADDRESS 0x384A46 /end MEASUREMENT
/begin MEASUREMENT tabgpr_w "Prädizierte Abgastemperatur" UWORD temp_uw_q0p0195_o50 1 100 -50 1229.98 FORMAT "%8.3" ECU_ADDRESS 0x384B90 /end MEASUREMENT
/begin MEASUREMENT tabgss_w "Sollwert der Abgastemperatur" UWORD temp_uw_q0p0195_o50 1 100 -50 1229.98 FORMAT "%8.3" ECU_ADDRESS 0x384B92 /end MEASUREMENT
/begin MEASUREMENT tabstatm_w "Abstellzeit im SG-Nachlauf für ATM" UWORD t1sxs_uw_q1 1 100 0 65535 FORMAT "%8.2" ECU_ADDRESS 0x384A48 /end MEASUREMENT
/begin MEASUREMENT tabstmx_w "Abstellzeit Maximumabfrage für ATM" UWORD t1sxs_uw_q1 1 100 0 65535 FORMAT "%8.2" ECU_ADDRESS 0x383A48 /end MEASUREMENT
/begin MEASUREMENT takrkf "stationäre Krümmerabgastemperatur ohne Korrekturen" UBYTE temp_ub_q5_o50 1 100 -50 1225 FORMAT "%5.0" ECU_ADDRESS 0x384835 /end MEASUREMENT
/begin MEASUREMENT takrstc "stationäre Abgastemperatur im Krümmer in Grad Celsius" UBYTE temp_ub_q5_o50 1 100 -50 1225 FORMAT "%5.0" ECU_ADDRESS 0x384836 /end MEASUREMENT
/begin MEASUREMENT tatakrml "Ausgang aus PT1-Glied Abgastemperatur-Einfluß auf tabgkrm" UBYTE temp_ub_q5_o50 1 100 -50 1225 FORMAT "%5.0" ECU_ADDRESS 0x384837 /end MEASUREMENT
/begin MEASUREMENT tateist "aktuelles Ist-Tastverhältnis Tankentlüftungsventil" UBYTE rel_ub_b99p6 1 100 0 99.6094 FORMAT "%5.2" ECU_ADDRESS 0x380B97 /end MEASUREMENT
/begin MEASUREMENT tateist_w "aktuelles Ist-Tastverhältnis Tankentlüftungsventil (16 Bit)" UWORD rel_uw_b100 1 100 0 99.9985 FORMAT "%8.5" ECU_ADDRESS 0x382B10 /end MEASUREMENT
/begin MEASUREMENT tateout "ausgegebenes Tastverhältnis für Tankentlüftungsventil" UBYTE rel_ub_b99p6 1 100 0 99.6094 FORMAT "%5.2" ECU_ADDRESS 0x380B98 /end MEASUREMENT
/begin MEASUREMENT tateout_w "ausgegebenes Tastverhältnis für Tankentlüftungsventil (16 Bit)" UWORD rel_uw_b100 1 100 0 99.9985 FORMAT "%8.5" ECU_ADDRESS 0x382B12 /end MEASUREMENT
/begin MEASUREMENT tateroh "Rohwert Tastverhältnis TEV" UBYTE rel_ub_b99p6 1 100 0 99.6094 FORMAT "%5.2" ECU_ADDRESS 0x380B99 /end MEASUREMENT
/begin MEASUREMENT tateroh_w "Rohwert Tastverhältnis TEV (16 Bit)" UWORD rel_uw_b100 1 100 0 99.9985 FORMAT "%8.5" ECU_ADDRESS 0x382B14 /end MEASUREMENT
/begin MEASUREMENT tatesoll "gewünschtes Soll-Tastverhältnis Tankentlüftungsventil" UBYTE rel_ub_b99p6 1 100 0 99.6094 FORMAT "%5.2" ECU_ADDRESS 0x380B9A /end MEASUREMENT
/begin MEASUREMENT tatesoll_w "gewünschtes Soll-Tastverhältnis Tankentlüftungsventil (16 Bit)" UWORD rel_uw_b100 1 100 0 99.9985 FORMAT "%8.5" ECU_ADDRESS 0x382B16 /end MEASUREMENT
/begin MEASUREMENT tatmaml "Ausgang aus PT1-Glied Abgastemperatur-Einfluß auf tabgm" UBYTE temp_ub_q5_o50 1 100 -50 1225 FORMAT "%5.0" ECU_ADDRESS 0x384838 /end MEASUREMENT
/begin MEASUREMENT tatmkf "Abgastemperatur vor Kat aus Kennfeld KFTATM" UBYTE temp_ub_q5_o50 1 100 -50 1225 FORMAT "%5.0" ECU_ADDRESS 0x384839 /end MEASUREMENT
/begin MEASUREMENT tatmrml "Ausgang aus PT1-Glied Rohrwandtemperatur-Einfluß auf tabgm" UBYTE temp_ub_q5_o50 1 100 -50 1225 FORMAT "%5.0" ECU_ADDRESS 0x38483A /end MEASUREMENT
/begin MEASUREMENT tatmsta "Abgastemperatur vor Kat aus Modell stationär" UBYTE temp_ub_q5_o50 1 100 -50 1225 FORMAT "%5.0" ECU_ADDRESS 0x38483B /end MEASUREMENT
/begin MEASUREMENT tatrkrml "Ausgang aus PT1-Glied Rohrwandtemperatur-Einfluß auf tabgkrm" UBYTE temp_ub_q5_o50 1 100 -50 1225 FORMAT "%5.0" ECU_ADDRESS 0x38483C /end MEASUREMENT
/begin MEASUREMENT tatu "Ansaugluft- oder Umgebungstemperatur" UBYTE temp_ub_q0p75_o48 1 100 -48 143.25 FORMAT "%5.1" ECU_ADDRESS 0x38483D /end MEASUREMENT
/begin MEASUREMENT tbdbkvp_l "Betriebsdauer BKV-Pumpe(long)" ULONG t20msxs_uw_q0p02 1 100 0 8.58993e+007 FORMAT "%13.4" ECU_ADDRESS 0x383C46 /end MEASUREMENT
/begin MEASUREMENT tbdbkvp_w "Betriebsdauer BKV-Pumpe(word)" UWORD t20msxs_q40p96 1 100 0 2.68431e+006 FORMAT "%8.0" ECU_ADDRESS 0x382CF4 /end MEASUREMENT
/begin MEASUREMENT tevper "Periodendauer bei Ansteuerung Tankentlüftungsventil" UBYTE t500usxms_ub_q0p5 1 100 0 127.5 FORMAT "%5.1" ECU_ADDRESS 0x384902 /end MEASUREMENT
/begin MEASUREMENT texoikm_w "Exotherme Temperaturerhöhung im Kat für tikatm" SWORD temp_q0p0195 1 100 -640 639.98 FORMAT "%8.4" ECU_ADDRESS 0x384A4A /end MEASUREMENT
/begin MEASUREMENT texom_w "Exotherme Temperaturerhöhung im Kat für tkatm" SWORD temp_q0p0195 1 100 -640 639.98 FORMAT "%8.4" ECU_ADDRESS 0x384A4C /end MEASUREMENT
/begin MEASUREMENT tikatm "Abgastemperatur im Katalysator aus Modell" UBYTE temp_ub_q5_o50 1 100 -50 1225 FORMAT "%5.0" ECU_ADDRESS 0x38483E /end MEASUREMENT
/begin MEASUREMENT tikatm_w "Abgastemperatur im Katalysator aus Modell" UWORD temp_uw_q0p0195_o50 1 100 -50 1229.98 FORMAT "%8.3" ECU_ADDRESS 0x384A4E /end MEASUREMENT
/begin MEASUREMENT tinkr "Zeit pro Winkelinkrement" UWORD dez 1 100 0 65535 FORMAT "%8.2" ECU_ADDRESS 0xF7F4 /end MEASUREMENT
/begin MEASUREMENT tistzyl "Zylindernummer der ersten Einspritzung und Zündung" UBYTE dez 1 100 0 255 FORMAT "%5.1" ECU_ADDRESS 0xF971 /end MEASUREMENT
/begin MEASUREMENT ti_ev0 "Einspritzzeit 1. Zylinder in Zündfolge" UWORD tinjection_sy 1 100 0 174.76 FORMAT "%8.4" ECU_ADDRESS 0xF98C /end MEASUREMENT
/begin MEASUREMENT ti_ev1 "Einspritzzeit 2. Zylinder in Zündfolge" UWORD tinjection_sy 1 100 0 174.76 FORMAT "%8.4" ECU_ADDRESS 0xF98E /end MEASUREMENT
/begin MEASUREMENT ti_ev2 "Einspritzzeit 3. Zylinder in Zündfolge" UWORD tinjection_sy 1 100 0 174.76 FORMAT "%8.4" ECU_ADDRESS 0xF990 /end MEASUREMENT
/begin MEASUREMENT ti_ev3 "Einspritzzeit 4. Zylinder in Zündfolge" UWORD tinjection_sy 1 100 0 174.76 FORMAT "%8.4" ECU_ADDRESS 0xF992 /end MEASUREMENT
/begin MEASUREMENT ti_sto_0 "ausgegebene Einspritzzeit für Nachspritzer 1. Zyl. in Zündfolge" UWORD tinjection_sy 1 100 0 174.76 FORMAT "%8.4" ECU_ADDRESS 0xF994 /end MEASUREMENT
/begin MEASUREMENT ti_sto_1 "ausgegebene Einspritzzeit für Nachspritzer 2. Zyl. in Zündfolge" UWORD tinjection_sy 1 100 0 174.76 FORMAT "%8.4" ECU_ADDRESS 0xF996 /end MEASUREMENT
/begin MEASUREMENT ti_sto_2 "ausgegebene Einspritzzeit für Nachspritzer 3. Zyl. in Zündfolge" UWORD tinjection_sy 1 100 0 174.76 FORMAT "%8.4" ECU_ADDRESS 0xF998 /end MEASUREMENT
/begin MEASUREMENT ti_sto_3 "ausgegebene Einspritzzeit für Nachspritzer 4. Zyl. in Zündfolge" UWORD tinjection_sy 1 100 0 174.76 FORMAT "%8.4" ECU_ADDRESS 0xF99A /end MEASUREMENT
/begin MEASUREMENT tkatm "Katalysatortemperatur aus Modell" UBYTE temp_ub_q5_o50 1 100 -50 1225 FORMAT "%5.0" ECU_ADDRESS 0x38483F /end MEASUREMENT
/begin MEASUREMENT tkatmab "Abgastemperatur hinter Kat beim Abstellen des Motors (Modell)" UBYTE temp_ub_q5_o50 1 100 -50 1225 FORMAT "%5.0" ECU_ADDRESS 0x38311F /end MEASUREMENT
/begin MEASUREMENT tkatmst "Katalysatortemperatur Modell Startwert = f(Abstellwert, Abstellzeit)" UBYTE temp_ub_q5_o50 1 100 -50 1225 FORMAT "%5.0" ECU_ADDRESS 0x384840 /end MEASUREMENT
/begin MEASUREMENT tkatm_w "Katalysatortemperatur aus Modell (Word)" UWORD temp_uw_q0p0195_o50 1 100 -50 1229.98 FORMAT "%8.3" ECU_ADDRESS 0x384A50 /end MEASUREMENT
/begin MEASUREMENT tmlastz "Abwärtszähler zum Resetieren der AR beim Verzögern" UBYTE t10msxs_ub_b2p55 1 100 0 2.55 FORMAT "%5.3" ECU_ADDRESS 0x380B1B /end MEASUREMENT
/begin MEASUREMENT tnmst1z "Verzögerungszeit Kupplungsschalter beim Hochschalten" UBYTE t10msxs_ub_b2p55 1 100 0 2.55 FORMAT "%5.3" ECU_ADDRESS 0x380B1C /end MEASUREMENT
/begin MEASUREMENT tnmst2z "Verzögerungszeit Kupplungsschalter beim Runterschalten" UBYTE t10msxs_ub_b2p55 1 100 0 2.55 FORMAT "%5.3" ECU_ADDRESS 0x380B1D /end MEASUREMENT
/begin MEASUREMENT tooth_rale "Erster rückdrehender Zahn im Segment" UBYTE kw_tooth_sy 1 100 0 1530 FORMAT "%5.0" ECU_ADDRESS 0x380972 /end MEASUREMENT
/begin MEASUREMENT tr_zahnabs "Winkellage in Geberzaehnen der TR-Marke bzgl. TR Marke Zyl. 0" UWORD dez 1 100 0 65535 FORMAT "%8.2" ECU_ADDRESS 0xF7F6 /end MEASUREMENT
/begin MEASUREMENT tvfznw_t "" UBYTE t10msxs_ub_b2p55 1 100 0 2.55 FORMAT "%5.3" ECU_ADDRESS 0xF972 /end MEASUREMENT
/begin MEASUREMENT tvrnr "Verzögerungszeit bis zum wirklichen Ev-Abschaltende" UBYTE dez 1 100 0 255 FORMAT "%5.1" ECU_ADDRESS 0x380A37 /end MEASUREMENT
/begin MEASUREMENT tvtevptu "Verzugszeit von TEV  (druck-, batteriespannung- und temperaturabhängig)" UBYTE t500usxms_ub_q0p5 1 100 0 127.5 FORMAT "%5.1" ECU_ADDRESS 0x384903 /end MEASUREMENT
/begin MEASUREMENT twdknlc "Zähler Motorstillstand nach KL.15 aus" UBYTE t100msxs_ub_b25p5 1 100 0 25.5 FORMAT "%5.2" ECU_ADDRESS 0x38485E /end MEASUREMENT
/begin MEASUREMENT tzarni "Zeitzähler AR nach Initialisierung" UBYTE t10msxs_ub_b2p55 1 100 0 2.55 FORMAT "%5.3" ECU_ADDRESS 0x380B1E /end MEASUREMENT
/begin MEASUREMENT tznd "Tatsächlich angesteuerte Schliesszeit in Zündbereich 1" UWORD tsegment_sy 1 100 0 43.69 FORMAT "%8.5" ECU_ADDRESS 0xF7F8 /end MEASUREMENT
/begin MEASUREMENT tznd2 "Tatsächlich angesteuerte Schliesszeit in Zündbereich 1 2tes Zündereignis" UWORD tsegment_sy 1 100 0 43.69 FORMAT "%8.5" ECU_ADDRESS 0xF7FA /end MEASUREMENT
/begin MEASUREMENT uagrvh_w "Spannung der AGR-Lagerückmeldung" UWORD spg_uw_q0p00488 1 100 0 319.995 FORMAT "%8.4" ECU_ADDRESS 0x380E04 /end MEASUREMENT
/begin MEASUREMENT ubdedis "Untere Hstereseschwelle zur DV-E Unterspannungserkennung 8Bit-Quant." UBYTE spg_q0p1 1 100 0 25.5 FORMAT "%5.2" ECU_ADDRESS 0x3809E4 /end MEASUREMENT
/begin MEASUREMENT ubdeen "Obere Hystereseschwelle zur DV-E Unterspannungserkennung 8 Bit" UBYTE spg_q0p1 1 100 0 25.5 FORMAT "%5.2" ECU_ADDRESS 0x3809E5 /end MEASUREMENT
/begin MEASUREMENT udkp1v_w "Verstärkte Spannung DK-Poti 1" UWORD spg_uw_q0p00488 1 100 0 319.995 FORMAT "%8.4" ECU_ADDRESS 0x380E06 /end MEASUREMENT
/begin MEASUREMENT udkp1_w "Spannung DK-Poti 1" UWORD spg_uw_q0p001222 1 100 0 80.0838 FORMAT "%8.5" ECU_ADDRESS 0x380E08 /end MEASUREMENT
/begin MEASUREMENT udkp2_w "Spannung DK-Poti 2" UWORD spg_uw_q0p001222 1 100 0 80.0838 FORMAT "%8.5" ECU_ADDRESS 0x380E0A /end MEASUREMENT
/begin MEASUREMENT udsbkv_w "Spannung Drucksensor Bremskraftverstärker" UWORD spg_uw_q0p00488 1 100 0 319.995 FORMAT "%8.4" ECU_ADDRESS 0x380E0C /end MEASUREMENT
/begin MEASUREMENT udsl_w "Spannung Drucksensor Ladedruck (word)" UWORD spg_uw_q0p00488 1 100 0 319.995 FORMAT "%8.4" ECU_ADDRESS 0x380E0E /end MEASUREMENT
/begin MEASUREMENT udst_w "Ausgangsspannung Tankdrucksensor nach AD-Wandler" UWORD spg_uw_q0p00488 1 100 0 319.995 FORMAT "%8.4" ECU_ADDRESS 0x380E10 /end MEASUREMENT
/begin MEASUREMENT udsu_w "Spannung Umgebungsdrucksensor (word 10-Bit von ADC)" UWORD spg_uw_q0p00488 1 100 0 319.995 FORMAT "%8.4" ECU_ADDRESS 0x380E12 /end MEASUREMENT
/begin MEASUREMENT uevges "Übersetzungsverhältnis gesamt" UBYTE fak_q0p1 1 100 0 25.5 FORMAT "%5.2" ECU_ADDRESS 0x3809B6 /end MEASUREMENT
/begin MEASUREMENT uhfm_w "HFM-Spannung" UWORD spg_uw_q0p00488 1 100 0 319.995 FORMAT "%8.4" ECU_ADDRESS 0x380E14 /end MEASUREMENT
/begin MEASUREMENT uhsv "Spannung an der Heizerendstufe vor Kat" UBYTE spg_ub_b5 1 100 0 4.98047 FORMAT "%5.3" ECU_ADDRESS 0x3808AF /end MEASUREMENT
/begin MEASUREMENT uhsv2 "Spannung an der Heizerendstufe 2 vor Kat" UBYTE spg_ub_b5 1 100 0 4.98047 FORMAT "%5.3" ECU_ADDRESS 0x3808B0 /end MEASUREMENT
/begin MEASUREMENT uldpe "Ausgangsspannung der LDP-Endstufe" UBYTE spg_ub_q0p019 1 100 0 4.98047 ECU_ADDRESS 0x3808B1 /end MEASUREMENT
/begin MEASUREMENT upwg1_w "Spannung PWG-Poti 1 (Word)" UWORD spg_uw_q0p00488 1 100 0 319.995 FORMAT "%8.4" ECU_ADDRESS 0x380E16 /end MEASUREMENT
/begin MEASUREMENT upwg2_w "Spannung PWG-Poti 2 (Word)" UWORD spg_uw_q0p00488 1 100 0 319.995 FORMAT "%8.4" ECU_ADDRESS 0x380E18 /end MEASUREMENT
/begin MEASUREMENT upwkdo_w "Schwelle PWG-Poti-Spannung zum Setzen der Kick-Down-Information" UWORD spg_uw_q0p00488 1 100 0 319.995 FORMAT "%8.4" ECU_ADDRESS 0x381CEC /end MEASUREMENT
/begin MEASUREMENT upwkdt_w "PWG-Poti-Spannung in der Kick-Down-Position temporär" UWORD spg_uw_q0p00488 1 100 0 319.995 FORMAT "%8.4" ECU_ADDRESS 0x381CEE /end MEASUREMENT
/begin MEASUREMENT upwkdu_w "Schwelle PWG-Poti-Spannung zum Rücksetzen der Kick-Down-Information" UWORD spg_uw_q0p00488 1 100 0 319.995 FORMAT "%8.4" ECU_ADDRESS 0x381CF0 /end MEASUREMENT
/begin MEASUREMENT upwkd_w "Gelernte Spannung von PWG-Poti 1 in der Kick-Down-Position" UWORD spg_uw_q0p00488 1 100 0 319.995 FORMAT "%8.4" ECU_ADDRESS 0x383A54 /end MEASUREMENT
/begin MEASUREMENT uulsuv2_w "Sondenspannung vor Kat einer Breitbandlambdasonde Bank2 (ADC-Wert)" UWORD spg_uw_b5 1 100 0 319.995 FORMAT "%8.4" ECU_ADDRESS 0x380E1A /end MEASUREMENT
/begin MEASUREMENT uulsuv_w "Sondenspannung vor Kat einer Breitbandlambdasonde (ADC-Wert)" UWORD spg_uw_b5 1 100 0 319.995 FORMAT "%8.4" ECU_ADDRESS 0x380E1C /end MEASUREMENT
/begin MEASUREMENT uushk_w "ADC-Spannung Lambdasonde hinter Katalysator (Word)" UWORD spg_uw_q0p00488 1 100 0 319.995 FORMAT "%8.4" ECU_ADDRESS 0x380E1E /end MEASUREMENT
/begin MEASUREMENT u_immo "" UBYTE spg_ub_b5 1 100 0 4.98047 FORMAT "%5.3" ECU_ADDRESS 0x3808B2 /end MEASUREMENT
/begin MEASUREMENT vkst_w "Gefördertes Kraftstoffvolumen" UWORD vol_q0p1 1 100 0 6553.5 FORMAT "%8.3" ECU_ADDRESS 0x3853FA /end MEASUREMENT
/begin MEASUREMENT wdkdlra_w "Alter Sollwert DK-Winkel in 12 Bit-Auflösung" UWORD relDK_q0p02441 1 100 0 1599.98 FORMAT "%8.3" ECU_ADDRESS 0x381D50 /end MEASUREMENT
/begin MEASUREMENT wdkdlr_w "Sollwert DK-Winkel in 12 Bit-Auflösung" UWORD relDK_q0p02441 1 100 0 1599.98 FORMAT "%8.3" ECU_ADDRESS 0xF946 /end MEASUREMENT
/begin MEASUREMENT wdksfi_w "aus wdks_w prädizierter DK-Winkel" SWORD relDK_q0p02441 1 100 -800 799.976 FORMAT "%8.4" ECU_ADDRESS 0x381D52 /end MEASUREMENT
/begin MEASUREMENT weestsb "Winkelgrenze Einspritzende für sim. Startauslösungen" UBYTE kw_q2p8125 1 100 0 717.188 FORMAT "%5.1" ECU_ADDRESS 0x3809E6 /end MEASUREMENT
/begin MEASUREMENT weests_r "" UBYTE kw_q2p8125 1 100 0 717.188 FORMAT "%5.1" ECU_ADDRESS 0xF973 /end MEASUREMENT
/begin MEASUREMENT winkl_b1 "" UWORD dez 1 100 0 65535 FORMAT "%8.2" ECU_ADDRESS 0xF99C /end MEASUREMENT
/begin MEASUREMENT winkl_b2 "" UWORD dez 1 100 0 65535 FORMAT "%8.2" ECU_ADDRESS 0xF99E /end MEASUREMENT
/begin MEASUREMENT wkw0rale_w "Winkel Kurbelwelle am Nullpunkt des Arbeitsspieles bei 1. rückdrehendem Zahn" UWORD kw_tooth_sy 1 100 0 393210 FORMAT "%8.1" ECU_ADDRESS 0x381A6C /end MEASUREMENT
/begin MEASUREMENT wkwas_kor "Kurbelwinkel im Arbeitsspiel mit Lückenkorrektur" UBYTE kw_tooth_sy 1 100 0 1530 FORMAT "%5.0" ECU_ADDRESS 0x380973 /end MEASUREMENT
/begin MEASUREMENT wkwrale_w "Winkel Kurbelwelle beim ersten rückdrehenden Zahn (word)" UWORD kw_tooth_sy 1 100 0 393210 FORMAT "%8.1" ECU_ADDRESS 0x381A6E /end MEASUREMENT
/begin MEASUREMENT wkwstop "Motorabstellposition im Arbeitsspiel" UBYTE kw_tooth_sy 1 100 0 1530 FORMAT "%5.0" ECU_ADDRESS 0x38311B /end MEASUREMENT
/begin MEASUREMENT wouta "ausgegebener Zündwinkel bei Doppelzündung: erster Zündkreis" UBYTE zw_azue_sy 1 100 0 191.25 FORMAT "%5.1" ARRAY_SIZE 4 ECU_ADDRESS 0xF7D6 /end MEASUREMENT
/begin MEASUREMENT woutst "Zündwinkelpuffer bei Überlappung" UBYTE zw_azue_sy 1 100 0 191.25 FORMAT "%5.1" ARRAY_SIZE 4 ECU_ADDRESS 0xF7DA /end MEASUREMENT
/begin MEASUREMENT wtans "A/D-Wert für Ansauglufttemperatur tans" UBYTE spg_ub_b5 1 100 0 4.98047 FORMAT "%5.3" ECU_ADDRESS 0x3808B3 /end MEASUREMENT
/begin MEASUREMENT wtaus_w "" UWORD spg_uw_b5 1 100 0 319.995 FORMAT "%8.4" ECU_ADDRESS 0x380E20 /end MEASUREMENT
/begin MEASUREMENT wtmot2_w "" UWORD spg_uw_b5 1 100 0 319.995 FORMAT "%8.4" ECU_ADDRESS 0x380E22 /end MEASUREMENT
/begin MEASUREMENT wtmot_w "A/D-Wert für tmot 10 bit" UWORD spg_uw_q0p00488 1 100 0 319.995 FORMAT "%8.4" ECU_ADDRESS 0x380E24 /end MEASUREMENT
/begin MEASUREMENT wtvkat "" UBYTE spg_ub_q0p019 1 100 0 4.98047 ECU_ADDRESS 0x3808B4 /end MEASUREMENT
/begin MEASUREMENT wub "Batteriespannung; vom AD-Wandler erfaßter Wert" UBYTE spg_ubatt 1 100 0 17.952 FORMAT "%5.2" ECU_ADDRESS 0x3808B5 /end MEASUREMENT
/begin MEASUREMENT wubr "Batteriespannung über Hauptrelais; vom AD-Wandler erfaßter Wert" UBYTE spg_ub_b28p5 1 100 0 28.3815 FORMAT "%5.2" ECU_ADDRESS 0x3808B6 /end MEASUREMENT
/begin MEASUREMENT wubr_w "Batteriespannung über Hauptrelais ;  ADC- Wert (16Bit aus 10Bit-Erfassung)" UWORD spg_ub_b28p5_w 1 100 0 1823.51 FORMAT "%8.3" ECU_ADDRESS 0x380E26 /end MEASUREMENT
/begin MEASUREMENT wub_w "Batteriespannung; vom AD-Wandler erfaßter Wert (16Bit aus 10Bit-Erfassung)" UWORD spg_ubatt_w 1 100 0 1153.42 FORMAT "%8.3" ECU_ADDRESS 0x380E28 /end MEASUREMENT
/begin MEASUREMENT wuhr "Ansteuerspannnung am HR-Pin" UBYTE spg_ub_b5 1 100 0 4.98047 FORMAT "%5.3" ECU_ADDRESS 0x3808B7 /end MEASUREMENT
/begin MEASUREMENT zkvek "Shiftkonstante für die Zündmaskenberechnung" UBYTE dez 1 100 0 255 FORMAT "%5.1" ECU_ADDRESS 0xF7DE /end MEASUREMENT
/begin MEASUREMENT zlkd "Zustand Kick-Down-Lernen" UBYTE dez 1 100 0 255 FORMAT "%5.1" ECU_ADDRESS 0x3809C4 /end MEASUREMENT
/begin MEASUREMENT zn2zksucc "Zeiger auf den  gezündeten Zündkreis 2tes Zündereignis" UWORD dez 1 100 0 65535 FORMAT "%8.2" ECU_ADDRESS 0xF7FC /end MEASUREMENT
/begin MEASUREMENT zn2zkvek "Nächster zu zündender Zündkreis 2tes Zündereignis" UWORD dez 1 100 0 65535 FORMAT "%8.2" ECU_ADDRESS 0xF7FE /end MEASUREMENT
/begin MEASUREMENT zndact "Flagbyte Ladephase aktiv" UBYTE dez 1 100 0 255 FORMAT "%5.1" ECU_ADDRESS 0xF7DF /end MEASUREMENT
/begin MEASUREMENT zndsucc "Flagbyte Zündung erfolgt" UBYTE dez 1 100 0 255 FORMAT "%5.1" ECU_ADDRESS 0xF7E0 /end MEASUREMENT
/begin MEASUREMENT znzksucc "Zeiger auf den  gezündeten Zündkreis" UWORD dez 1 100 0 65535 FORMAT "%8.2" ECU_ADDRESS 0xF800 /end MEASUREMENT
/begin MEASUREMENT znzkvek "Nächster zu zündender Zündkreis" UWORD dez 1 100 0 65535 FORMAT "%8.2" ECU_ADDRESS 0xF802 /end MEASUREMENT
/begin MEASUREMENT zouttmx "Maximale Programmlaufzeit von der TR Marke bis Ende AZUE" UWORD tsegment_sy 1 100 0 43.69 FORMAT "%8.5" ECU_ADDRESS 0xF804 /end MEASUREMENT
/begin MEASUREMENT zueninkr "Inkrementverfeinerung Zündwinkel" UBYTE dez 1 100 0 255 FORMAT "%5.1" ECU_ADDRESS 0xF7E1 /end MEASUREMENT
/begin MEASUREMENT zueninkr2 "Inkrementverfeinerung Zündwinkel 2tes Zündereignis" UBYTE dez 1 100 0 255 FORMAT "%5.1" ECU_ADDRESS 0xF7E2 /end MEASUREMENT
/begin MEASUREMENT zueninkr_r "Inkrementverfeinerung Zündwinkel Absolutwinkel" UBYTE dez 1 100 0 255 FORMAT "%5.1" ECU_ADDRESS 0xF7E3 /end MEASUREMENT
/begin MEASUREMENT zuentmx "Maximale Laufzeit von der TR-Marke bis zur Berechnung des Zündereignisses" UWORD tsegment_sy 1 100 0 43.69 FORMAT "%8.5" ECU_ADDRESS 0xF806 /end MEASUREMENT
/begin MEASUREMENT zuenzahn "Zündwinkel in Zahnquantisierung" UBYTE dez 1 100 0 255 FORMAT "%5.1" ECU_ADDRESS 0xF7E4 /end MEASUREMENT
/begin MEASUREMENT zuenzahn2 "Zündwinkel in Zahnquantisierung 2tes Zündereignis" UBYTE dez 1 100 0 255 FORMAT "%5.1" ECU_ADDRESS 0xF7E5 /end MEASUREMENT
/begin MEASUREMENT zuenzahn_r "Zündwinkel in Zahnquantisierung als Absolutwinkel bzgl TR-Marke Zyl. 0" UBYTE dez 1 100 0 255 FORMAT "%5.1" ECU_ADDRESS 0xF7E6 /end MEASUREMENT
/begin MEASUREMENT zuen_beg "Zylinder, bei dem erste Einspritzung stattgefunden hat" UBYTE dez 1 100 0 255 FORMAT "%5.1" ECU_ADDRESS 0xF974 /end MEASUREMENT
/begin MEASUREMENT zwmatm "Zähler für ATM-Wiederholstart und Faktor für Wärmemengen-Schwellen" UBYTE dez 1 100 0 255 FORMAT "%5.1" ECU_ADDRESS 0x383120 /end MEASUREMENT
/begin MEASUREMENT zwmatmf "Zähler für ATM-Wiederholstart und Faktor für Wärmemengen-Schwellwert upstream" UBYTE dez 1 100 0 255 FORMAT "%5.1" ECU_ADDRESS 0x383121 /end MEASUREMENT
/begin MEASUREMENT zwoutakt "Zündwinkel-Ausgabe : tatsächlich im aktuellen Segment ausgegebener Winkel" UBYTE zw_TR2OT_sy 1 100 -119.25 72 FORMAT "%5.1" ECU_ADDRESS 0xF7E7 /end MEASUREMENT
/begin MEASUREMENT zylvek_a "" UBYTE dez 1 100 0 255 FORMAT "%5.1" ECU_ADDRESS 0xF975 /end MEASUREMENT
/begin FUNCTION ABKVP "1.50      Ansteuerung Bremskraftverstärker-Pumpe" /begin DEF_CHARACTERISTIC TDBKVSTEND UBSQBKVMN UBSQBKVMX /end DEF_CHARACTERISTIC /begin REF_CHARACTERISTIC /end REF_CHARACTERISTIC /begin IN_MEASUREMENT B_bkvpa B_fabkv B_fdbkvp B_zbkvtest tnst_w ubsq /end IN_MEASUREMENT /begin OUT_MEASUREMENT aebkvph_w aebkvpl_w B_bkvp tbdbkvp_w /end OUT_MEASUREMENT /begin LOC_MEASUREMENT aebkvp_l tbdbkvp_l /end LOC_MEASUREMENT /begin SUB_FUNCTION /end SUB_FUNCTION /end FUNCTION
/begin FUNCTION ACIFI "9.90      Ausgabe für zylinderindividuelle Einspritzung"
 /begin DEF_CHARACTERISTIC CWESWEZ DTIABS DTIREL FWEAB FWEAUF FWEMXT FZN0 FZN1 FZN2 FZN3 FZNWN0 FZNWN1 FZNWN2 FZNWN3 TMESP TVFZNW WEESTSM WESSTO /end DEF_CHARACTERISTIC
 /begin REF_CHARACTERISTIC NMIN SNM16CIUB /end REF_CHARACTERISTIC
 /begin IN_MEASUREMENT B_kl15 B_nsp B_sa esst_snm16ciub evz_austot nmot nmot_w synstate synstate_o ti_b1 ti_b2 ti_tvu_w tmot tn2 weer wessbm zylvirt zzbank zzvirt zzyl /end IN_MEASUREMENT
 /begin OUT_MEASUREMENT anzti anztib anztib_w anzti_w B_encifi B_nwsaktiv B_nwsalt B_spontan0 B_spontan1 B_spontan2 B_spontan3 B_synti B_ti_cha0 B_ti_cha1 B_ti_cha2 B_ti_cha3 B_ti_out0 B_ti_out1 B_ti_out2 B_ti_out3 B_ti_wai0 B_ti_wai1 B_ti_wai2 B_ti_wai3 B_umsync cc_cha_0 cc_cha_1 cc_cha_2 cc_cha_3 fgezs0 fgezs1 fgezs2 fgezs3 fweg fwez0 fwez1 fwez2 fwez3 tistzyl ti_ev0 ti_ev1 ti_ev2 ti_ev3 ti_sto_0 ti_sto_1 ti_sto_2 ti_sto_3 tvfznw_t weests_r winkl_b1 winkl_b2 zuen_beg /end OUT_MEASUREMENT
 /begin LOC_MEASUREMENT B_cwesakt deltaseg_w na_abs_c na_rel_c pd_we_zy restw_b1 restw_b2 segz weestsb zylvek_a /end LOC_MEASUREMENT
 /begin SUB_FUNCTION /end SUB_FUNCTION
/end FUNCTION
/begin FUNCTION ADC "" /begin DEF_CHARACTERISTIC /end DEF_CHARACTERISTIC /begin REF_CHARACTERISTIC /end REF_CHARACTERISTIC /begin IN_MEASUREMENT /end IN_MEASUREMENT
 /begin OUT_MEASUREMENT B_sl iasp1plaus_w iUipoti1_w iUipoti2_w iUspoti1_w iUspoti2_w S_bls S_fgrat S_fgrhs uagrvh_w udkp1v_w udkp1_w udkp2_w udsbkv_w udsl_w udst_w udsu_w uhfm_w uhsv uhsv2 uldpe upwg1_w upwg2_w uulsuv2_w uulsuv_w uushk_w u_immo wtans wtaus_w wtmot2_w wtmot_w wtvkat wub wubr wubr_w wub_w wuhr /end OUT_MEASUREMENT
 /begin LOC_MEASUREMENT /end LOC_MEASUREMENT
 /begin SUB_FUNCTION /end SUB_FUNCTION
/end FUNCTION
/begin FUNCTION ADVE "3.60      Ansteuerung der DV-E mit dem DLR"
 /begin DEF_CHARACTERISTIC CWDKNOLU CWDLRIKL DANTGESWNV DANTGESWV DANTSCHWNV DANTSCHWV DKLAGERT DLRDWDKSS1 DLRDWDKSS2 DLRHAFTMN DLRHAFTST DLRIAMAXA DLRIKLPAR DLRININI DLRKDONLP0 DLRKDUNLP0 DLRKDUNLP1 DLRKDUNLP2 DLRKDUNLP3 DLRKIONLP0 DLRKIUNLP0 DLRKIUNLP1 DLRKIUNLP2 DLRKIUNLP3 DLRKPONLP0 DLRKPUNLP0 DLRKPUNLP1 DLRKPUNLP2 DLRKPUNLP3 DLRKREIS DLRKREISST DLRNLPD DLRPID0T DLRPID1T DLRPID2T DLRPIDMAX DLRPIDMIN DLRUBSOLL DLRUMABAND DLRUMAIINI DVEEST DWDKSBAMX DWDKSIKLS KDLRIDDVE TDKLAGDE TDLRHAFTMX TDLRPIDC TPWRSV TWDKNL UDKNLPTOL WDKBEWS WDKNLPTOL WDKREIB WDKSAPNOL WDKSTFEIN WDKSTGROB ZKUBDLR ZKWDKSPT1 /end DEF_CHARACTERISTIC
 /begin REF_CHARACTERISTIC /end REF_CHARACTERISTIC
 /begin IN_MEASUREMENT B_dcdisr B_dkaden B_dknolu B_dknot B_dkp1e B_dkp2e B_dkpiu B_dlrien B_dveeson B_i_ska_um B_kl15 B_lrnrdy B_nldve B_nmin B_nmot B_pwf B_st B_wdk1v B_wdk2sel dynPeriod nmot ub ubrsq udknlp1 udknlp2 udkp1_w udkp2_w wdkada_w wdkba_w wdknlp_w wdks_w wped /end IN_MEASUREMENT
 /begin OUT_MEASUREMENT B_apnoluv B_appnolu B_dcdisfr B_dlrbe B_dlrparc B_dlrpide B_dlrspid B_dlrumzu B_dveese B_dveesh B_dvete B_nlpne B_pwrsv B_ubdve B_ubpvg B_ub_ok B_wdksive dklagerc dlrspid_w dpwrsvc /end OUT_MEASUREMENT
 /begin LOC_MEASUREMENT B_dkbew B_dlrikla B_dlriklst B_iklrest B_iklstar B_wdksauf dlrd dlrhaftak dlri dlriamax dlriant_w dlrihaftc dlriklst_w dlrikl_w dlrini_w dlrkomp dlrndif_w dlrp dlrpidc dlrubrsq dveesc dwdkdlr_w gwdkdlr_w gwdk_kge twdknlc ubdedis ubdeen wdkdlra_w wdkdlr_w wdksfi_w /end LOC_MEASUREMENT
 /begin SUB_FUNCTION /end SUB_FUNCTION
/end FUNCTION
/begin FUNCTION AEKP "8.20      Ausgabe EKP-Ansteuerung"
 /begin DEF_CHARACTERISTIC ANZEKPVLMX PEKP TAPVLTM TNLEKPVL TZMIN TZZMX UBSTS VKSTEBF VKSTPVLAB VKSTPVLNL /end DEF_CHARACTERISTIC
 /begin REF_CHARACTERISTIC /end REF_CHARACTERISTIC
 /begin IN_MEASUREMENT B_abstnlgp B_airbag B_bbdecj B_desee B_kstebf B_nachlend B_nmot B_stend B_uhrrmin B_uhrrsec tabst_w tmotab tnachl_w ubsq /end IN_MEASUREMENT
 /begin OUT_MEASUREMENT B_ekp /end OUT_MEASUREMENT
 /begin LOC_MEASUREMENT aekp8bits anzekpvl B_ekpd B_ekps B_ekpvl B_ekpvla B_ekpvlz B_pvlab B_pvlnl B_tooth dekpub vkst_w /end LOC_MEASUREMENT
 /begin SUB_FUNCTION /end SUB_FUNCTION
/end FUNCTION
/begin FUNCTION AEVAB "6.30      Ausgabe Einspritzung Ev-Ausblendung" /begin DEF_CHARACTERISTIC CWEVAB REDABM /end DEF_CHARACTERISTIC /begin REF_CHARACTERISTIC /end REF_CHARACTERISTIC
 /begin IN_MEASUREMENT anzeausb B_dkuevab B_faevz B_phsnl devoff flgtiab redsol zyleausb zzyl /end IN_MEASUREMENT
 /begin OUT_MEASUREMENT abmf B_dmdstop B_nlphea evz_aus stateaevab /end OUT_MEASUREMENT
 /begin LOC_MEASUREMENT anzeab B_fophsnl B_nlpheai dmdevab eevx evrbgn_one redsolr redsol_one tvrnr /end LOC_MEASUREMENT
 /begin SUB_FUNCTION /end SUB_FUNCTION
/end FUNCTION
/begin FUNCTION AEVABU "1.10      Ausgabe EV-Abschaltung durch Überwachungsfunktionen bei EGAS" /begin DEF_CHARACTERISTIC NMXSKA /end DEF_CHARACTERISTIC /begin REF_CHARACTERISTIC /end REF_CHARACTERISTIC /begin IN_MEASUREMENT B_dknolu B_dkpu B_i_ska_um B_nmaxd nmot /end IN_MEASUREMENT /begin OUT_MEASUREMENT B_dkuevab B_evabu /end OUT_MEASUREMENT /begin LOC_MEASUREMENT B_skaevab /end LOC_MEASUREMENT /begin SUB_FUNCTION /end SUB_FUNCTION /end FUNCTION
/begin FUNCTION AEVABZK "1.30      Ausgabe Ev-Abschaltung %MDRED + Komplettabschaltung durch Überwachungsfunktionen" /begin DEF_CHARACTERISTIC /end DEF_CHARACTERISTIC /begin REF_CHARACTERISTIC /end REF_CHARACTERISTIC /begin IN_MEASUREMENT B_dmdstop B_dveada B_evabu evz_aus /end IN_MEASUREMENT /begin OUT_MEASUREMENT B_evasel evz_austot /end OUT_MEASUREMENT /begin LOC_MEASUREMENT /end LOC_MEASUREMENT /begin SUB_FUNCTION /end SUB_FUNCTION /end FUNCTION
/begin FUNCTION ALE "6.30      Auslauferkennung" /begin DEF_CHARACTERISTIC CWALE RALEZMAX TRD /end DEF_CHARACTERISTIC /begin REF_CHARACTERISTIC /end REF_CHARACTERISTIC
 /begin IN_MEASUREMENT B_luecke B_mluecke B_nlale B_nldg B_nmot B_phsnlinv B_startini B_stend B_zprel ttooth10ms wkwbzm0_w wkw_w /end IN_MEASUREMENT
 /begin OUT_MEASUREMENT aleNvBits B_ale wkwstop /end OUT_MEASUREMENT
 /begin LOC_MEASUREMENT B_enabale B_ralectr B_raleok tooth_rale wkw0rale_w wkwas_kor wkwrale_w /end LOC_MEASUREMENT
 /begin SUB_FUNCTION /end SUB_FUNCTION
/end FUNCTION
/begin FUNCTION ANWSE "1.10      Ansteuerung Nockenwellensteller geschaltet Einlass" /begin DEF_CHARACTERISTIC NWSOSE NWSUSE TVNWFE TVNWSE /end DEF_CHARACTERISTIC /begin REF_CHARACTERISTIC CWKVHR /end REF_CHARACTERISTIC /begin IN_MEASUREMENT B_genws B_kdhre B_nwrpose wnweos wnwsemx /end IN_MEASUREMENT /begin OUT_MEASUREMENT ANWSE_bits1 B_nwse /end OUT_MEASUREMENT /begin LOC_MEASUREMENT /end LOC_MEASUREMENT /begin SUB_FUNCTION /end SUB_FUNCTION /end FUNCTION
/begin FUNCTION ARMD "10.40     Momentenbasierte Antiruckelfunktion"
 /begin DEF_CHARACTERISTIC A0 A1 A2 B1 B2 CWARMD DMARMX DNFILO DVFZAR FLRAWG FLRHG_0_A FLRHG_1_A FLRHG_2_A FLRHG_3_A FRARAWG FRARHG_0_A FRARHG_1_A FRARHG_2_A FRARHG_3_A KFDMDADP KFDMDARO_0_A KFDMDARO_1_A KFDMDARO_2_A KFDMDARO_3_A KFDMDAROS KIFZGAWG KIFZGHG_0_A KIFZGHG_1_A KIFZGHG_2_A KIFZGHG_3_A NARAO NARASTG NARLLGA NDFILOG NDIFFOG NVG NVMNG NVMXG SMK08MDSW TAREIN TMAR TMLAST TVARS TVARSS TVKUPAR TVKUPHS TVKUPRS TZSPINI VARAU WPEDU /end DEF_CHARACTERISTIC
 /begin REF_CHARACTERISTIC SGA06MDUB /end REF_CHARACTERISTIC
 /begin IN_MEASUREMENT B_autget B_brems B_dashv B_fgr B_gwhs B_kuppl B_ll B_lsd B_mdein B_sa B_stend B_wk esst_sga06mdub gangi mdverl_w mifa_w misolv_w nmot nmot_w nvquot_w tmot vfzg vfzg_w wped_w /end IN_MEASUREMENT
 /begin OUT_MEASUREMENT B_ar dmar_w esst_smk08mdsw nmotk1_w nmotk2_w tmlastz tnmst1z tnmst2z /end OUT_MEASUREMENT
 /begin LOC_MEASUREMENT B_argf B_gfen B_hpnmot B_iniar B_iniar1 B_iniarv B_kupgw B_tpnmot B_tvars B_tvarss fdar flrar kifz_w mdbes_w mkar_w mlast_w ndar_w ndfibet_w ndfil_w ndiffog_w ndiff_w nmodiv_w nmod_w tzarni /end LOC_MEASUREMENT
 /begin SUB_FUNCTION /end SUB_FUNCTION
/end FUNCTION
/begin FUNCTION ASC0F "" /begin DEF_CHARACTERISTIC /end DEF_CHARACTERISTIC /begin REF_CHARACTERISTIC TIDLEMAX TIDLEMIN /end REF_CHARACTERISTIC
 /begin IN_MEASUREMENT B_0101_ack B_0101_ident B_0101_notadr B_0101_switch kwp71_bits nmot_w t_idle_ctr /end IN_MEASUREMENT
 /begin OUT_MEASUREMENT /end OUT_MEASUREMENT
 /begin LOC_MEASUREMENT /end LOC_MEASUREMENT
 /begin SUB_FUNCTION /end SUB_FUNCTION
/end FUNCTION
/begin FUNCTION ATEV "4.40      Ansteuerung Tankentlüftungsventil (Periodendauer)" /begin DEF_CHARACTERISTIC KFTEVP KFTVTEV TATEGMX TATEGRDO TATEGRDU TATEMSN TVTEVPS /end DEF_CHARACTERISTIC /begin REF_CHARACTERISTIC /end REF_CHARACTERISTIC
 /begin IN_MEASUREMENT B_dtes B_evloc B_tevtini msntevo_w msteo_w mstesoll_w nmot pspu tadtea tans ub /end IN_MEASUREMENT
 /begin OUT_MEASUREMENT B_tevtstp tateist tateist_w tateout tateout_w tatesoll tatesoll_w tevper /end OUT_MEASUREMENT
 /begin LOC_MEASUREMENT msntev_w tateroh tateroh_w tvtevptu /end LOC_MEASUREMENT
 /begin SUB_FUNCTION /end SUB_FUNCTION
/end FUNCTION
/begin FUNCTION ATM "53.10     Abgastemperaturmodell"
 /begin DEF_CHARACTERISTIC ATMTAKR ATMTANS CWATM DTUMTAT FATMRML_0_A FATMRML_1_A FATRKRML FWMABGW_0_A FWMABGW_1_A FWMKATW_0_A FWMKATW_1_A IMTUMTAT KATMEXML_0_A KATMEXML_1_A KATMIEXML_0_A KATMIEXML_1_A KFATLAK KFATMABKA_0_A KFATMABKA_1_A KFATMABKK_0_A KFATMABKK_1_A KFATMKR KFATMLA_0_A KFATMLA_1_A KFATMZW_0_A KFATMZW_1_A KFATZWK KFTATM_0_A KFTATM_1_A KFWMABG_0_A KFWMABG_1_A KFWMKAT_0_A KFWMKAT_1_A KLATMILAE KLATMIZWE KLATMLAE KLATMZWE_0_A KLATMZWE_1_A MSTPKTU NTUMTAT STS06TMUW STU05TMUB TABGMEX_0_A TABGMEX_1_A TASTBFA TATMKH TATMKRSA TATMKW TATMRTPK TATMSA_0_A TATMSA_1_A TATMSAE TATMSTI TATMTMOT TATMTP_0_A TATMTP_1_A TATMTRKH TATMWMK_0_A TATMWMK_1_A TIKATMOE TKATMOE TKATMTPMN TKSTBFA TNLATM TNLATMTM TNLATMTU TUMTAIT VTUMTAT WMABGKH_0_A WMABGKH_1_A WMKATKH_0_A WMKATKH_1_A ZATAKRML ZATMAML_0_A ZATMAML_1_A ZATMIKKML_0_A ZATMIKKML_1_A ZATMIKML_0_A ZATMIKML_1_A ZATMKKML_0_A ZATMKKML_1_A ZATMKML_0_A ZATMKML_1_A ZATMRML_0_A ZATMRML_1_A ZATRKRML /end DEF_CHARACTERISTIC
 /begin REF_CHARACTERISTIC SEZ06TMUB SLX06TMUW SML06TMUW SML07TMUW SMT06TMUW ST107TMUB ST307TMUB STM05TMUB /end REF_CHARACTERISTIC
 /begin IN_MEASUREMENT B_faatm B_kh B_kw B_ll B_nachlend B_nlatm B_nmot B_pwf B_sa B_st B_stend B_tfu B_trkh B_uhrrmin B_uhrrsec esst_sez06tmub esst_slx06tmuw esst_sml06tmuw esst_sml07tmuw esst_smt06tmuw esst_st107tmub esst_st307tmub esst_stm05tmub etazwist lamsbg_w ml ml_w msabg_w nmot rl tabst_w tans tmot tmst tumg vfzg /end IN_MEASUREMENT
 /begin OUT_MEASUREMENT B_atmtpa B_atmtpk esst_sts06tmuw esst_stu05tmub imlatm imlatm_w iwmatmk_w iwmatm_w tabgkrm_w tabgm tabgm_w tikatm tikatm_w tkatm tkatm_w zwmatm zwmatmf /end OUT_MEASUREMENT
 /begin LOC_MEASUREMENT ATMbits ATMbits1 B_atmll B_atmrtpk B_atmst B_atmtpf B_atmtpl B_msmntpk B_stndnl etazwimt tabgmab tabgmst tabstatm_w tabstmx_w takrkf takrstc tatakrml tatmaml tatmkf tatmrml tatmsta tatrkrml tatu texoikm_w texom_w tkatmab tkatmst /end LOC_MEASUREMENT
 /begin SUB_FUNCTION /end SUB_FUNCTION
/end FUNCTION
/begin FUNCTION ATR "1.100     Abgastemperaturregelung"
 /begin DEF_CHARACTERISTIC ATRI ATRP CATR DDTABGMN DDTABGMX DLATRMN DLATRNLN DTABGS KFRLATR KFTABGSS KLTABGPRN KLTTABGPR LATRO TTROFF /end DEF_CHARACTERISTIC
 /begin REF_CHARACTERISTIC /end REF_CHARACTERISTIC
 /begin IN_MEASUREMENT B_atsb B_bevab B_lalgf B_stend gangi lamvoa_w nmot nmot_w rl rl_w tabg_w tans /end IN_MEASUREMENT
 /begin OUT_MEASUREMENT B_atr B_atr2 dlamatr2_w dlamatr_w dlatr2_w dlatr_w /end OUT_MEASUREMENT
 /begin LOC_MEASUREMENT B_atrb B_atrnl B_atrsp B_atrsp2 dlatri_w dlatrnl_w dlatrp_w dtabgpr_w dtabprl_w rlatr tabgpr_w tabgss_w /end LOC_MEASUREMENT
 /begin SUB_FUNCTION /end SUB_FUNCTION
/end FUNCTION
/begin FUNCTION AZUE "5.60      Ausgabe Zündung" /begin DEF_CHARACTERISTIC CW_AZUE IGNDELAY TMZUB2MX ZWFUBAMN /end DEF_CHARACTERISTIC /begin REF_CHARACTERISTIC /end REF_CHARACTERISTIC
 /begin IN_MEASUREMENT B_airbag B_dls B_dopzue B_ff B_kl15 B_motstop B_nachl fubaanz nmot_w offz_w szfuba_w tmot wkwbzm0_w znachanz zwoutar /end IN_MEASUREMENT
 /begin OUT_MEASUREMENT azoffmsk_w B_zesync zndact zndsucc zwoutakt /end OUT_MEASUREMENT
 /begin LOC_MEASUREMENT azFadeStatBits azfdoff B_dopzue_i B_dzai B_ffsn2_i B_ff_i B_slsn2 B_sw0 B_sw1 B_z1 B_z1not B_z1_i B_zesync_d B_zws0 dzaCtr fbmxzahn fubaanz_i ignDelayCtr minzahn ovlCtr slsninkr slsninkr2 slsninkr_r slsnzahn slsnzahn2 slsnzahn_r sn2zkact sn2zkvek snzkact snzkvek swout tinkr tr_zahnabs tznd tznd2 wouta woutst zkvek zn2zksucc zn2zkvek znzksucc znzkvek zouttmx zueninkr zueninkr2 zueninkr_r zuentmx zuenzahn zuenzahn2 zuenzahn_r /end LOC_MEASUREMENT
 /begin SUB_FUNCTION /end SUB_FUNCTION
/end FUNCTION
/begin FUNCTION BBBO "3.30      Betriebsbereich Erkennung Benzin im Öl"
 /begin DEF_CHARACTERISTIC ABOINI ABOLRAR ABOMX CDPCV IMLKS MSNPCV TMSKS TMSTABO TMTKS TVREABO USVKKS /end DEF_CHARACTERISTIC
 /begin REF_CHARACTERISTIC /end REF_CHARACTERISTIC
 /begin IN_MEASUREMENT B_nmot B_pwf B_sa B_sbbvk ftho_w ml_w ps_w pu_w tmot tmst usvkk_w /end IN_MEASUREMENT
 /begin OUT_MEASUREMENT abo B_abor imlbbo /end OUT_MEASUREMENT
 /begin LOC_MEASUREMENT dpspu mspcv /end LOC_MEASUREMENT
 /begin SUB_FUNCTION /end SUB_FUNCTION
/end FUNCTION
/begin FUNCTION BBDLS "1.10      Betriebsbereich digitale Leerlaufstabilisierung" /begin DEF_CHARACTERISTIC CLSDKH NDLSO NDLSU /end DEF_CHARACTERISTIC /begin REF_CHARACTERISTIC /end REF_CHARACTERISTIC /begin IN_MEASUREMENT B_dknolu B_dkpu B_kh B_llr B_sa B_st nmotll nstat /end IN_MEASUREMENT /begin OUT_MEASUREMENT B_dls /end OUT_MEASUREMENT /begin LOC_MEASUREMENT B_buf B_dnn /end LOC_MEASUREMENT /begin SUB_FUNCTION /end SUB_FUNCTION /end FUNCTION
/begin FUNCTION BBDNWS "1.100     Betriebsbereitschaft Diagnose Nockenwelle"
 /begin DEF_CHARACTERISTIC KLNDNWMN NDNWMN NDNWMNFA NDNWMX TMDNWMN TMDNWMX TNWDSTEND TOELDNWMN TOELDNWMX /end DEF_CHARACTERISTIC
 /begin REF_CHARACTERISTIC /end REF_CHARACTERISTIC
 /begin IN_MEASUREMENT B_dnwfozea B_dnwfozee B_fanwsa B_fanwse B_fanwsea B_nwdfonws B_nwrpose B_nwvfe B_phade B_stend B_wnws0e nmot tmot tnst_w toelk_w /end IN_MEASUREMENT
 /begin OUT_MEASUREMENT B_dnwrpe B_dnws B_dnwse /end OUT_MEASUREMENT
 /begin LOC_MEASUREMENT B_dnwsfa B_nmotnwdf B_tmotnwdf B_tolnwdf ndnwtmn /end LOC_MEASUREMENT
 /begin SUB_FUNCTION /end SUB_FUNCTION
/end FUNCTION
/begin FUNCTION BBGANG "14.50     Betriebsbereich Gang"
 /begin DEF_CHARACTERISTIC IGESGA NGANGMIN_0_A NGANGMIN_1_A NGANGMIN_2_A NGANGMIN_3_A NVQUOT1O_0_A NVQUOT1O_1_A NVQUOT1O_2_A NVQUOT1O_3_A NVQUOT1U_0_A NVQUOT1U_1_A NVQUOT1U_2_A NVQUOT1U_3_A NVQUOT2O_0_A NVQUOT2O_1_A NVQUOT2O_2_A NVQUOT2O_3_A NVQUOT2U_0_A NVQUOT2U_1_A NVQUOT2U_2_A NVQUOT2U_3_A NVQUOT3O_0_A NVQUOT3O_1_A NVQUOT3O_2_A NVQUOT3O_3_A NVQUOT3U_0_A NVQUOT3U_1_A NVQUOT3U_2_A NVQUOT3U_3_A NVQUOT4O_0_A NVQUOT4O_1_A NVQUOT4O_2_A NVQUOT4O_3_A NVQUOT4U_0_A NVQUOT4U_1_A NVQUOT4U_2_A NVQUOT4U_3_A NVQUOT5O_0_A NVQUOT5O_1_A NVQUOT5O_2_A NVQUOT5O_3_A NVQUOT5U_0_A NVQUOT5U_1_A NVQUOT5U_2_A NVQUOT5U_3_A NVQUOT6O_0_A NVQUOT6O_1_A NVQUOT6O_2_A NVQUOT6O_3_A NVQUOT6U_0_A NVQUOT6U_1_A NVQUOT6U_2_A NVQUOT6U_3_A /end DEF_CHARACTERISTIC
 /begin REF_CHARACTERISTIC /end REF_CHARACTERISTIC
 /begin IN_MEASUREMENT B_autget B_cvt B_gang0 B_lowra B_tippg B_vnull gangauti nmot_w S_fs uefktget vfzg_w /end IN_MEASUREMENT
 /begin OUT_MEASUREMENT B_fs B_gwhs gangi nvquot_w uevges /end OUT_MEASUREMENT
 /begin LOC_MEASUREMENT /end LOC_MEASUREMENT
 /begin SUB_FUNCTION /end SUB_FUNCTION
/end FUNCTION
/begin FUNCTION BBKD "1.20      Berechnung der Kick-Down-Information"
 /begin DEF_CHARACTERISTIC CWBBKD DUPW12KD DUPWGLKD DUPWKDLB DUPWKDO DUPWKDU TKD TLKD UPWGKDMN UPWGKDMX UPWGKDO UPWGKDU UPWKDDF WPKDMN /end DEF_CHARACTERISTIC
 /begin REF_CHARACTERISTIC /end REF_CHARACTERISTIC
 /begin IN_MEASUREMENT B_autget B_fakd B_pwf B_pwgnotfr upwg1_w upwg2d_w upwgej_w wped_w /end IN_MEASUREMENT
 /begin OUT_MEASUREMENT BBKDbits bblkderf B_kd upwkdu_w upwkd_w zlkd /end OUT_MEASUREMENT
 /begin LOC_MEASUREMENT B_kdpos B_lkderf B_lkdfrg upwkdo_w upwkdt_w /end LOC_MEASUREMENT
 /begin SUB_FUNCTION /end SUB_FUNCTION
/end FUNCTION
/begin COMPU_METHOD B_TRUE "boolsche Zustände, positive Logik" TAB_VERB "%6.3" "" COMPU_TAB_REF B_TRUE /end COMPU_METHOD
/begin COMPU_VTAB B_TRUE "boolsche Zustände, positive Logik" TAB_VERB 2 0 "----" 1 "TRUE" /end COMPU_VTAB
/begin COMPU_METHOD DEZ "1 : 1 Umrechnug (dez/hex)" RAT_FUNC "%6.2" "" COEFFS 0 1 0 0 0 1 /end COMPU_METHOD
/begin COMPU_METHOD dez "1 : 1 Umrechnug (dez/hex)" RAT_FUNC "%6.2" "" COEFFS 0 1 0 0 0 1 /end COMPU_METHOD
/begin COMPU_METHOD DEZL "Dezimalzahl in 16-Bit-Hexzahl" RAT_FUNC "%6.2" "" COEFFS 0 1 0 0 0 1 /end COMPU_METHOD
/begin COMPU_METHOD fak_q0p00273 "" RAT_FUNC "%6.4" "-" COEFFS 0 256 0 0 0 0.7 /end COMPU_METHOD
/begin COMPU_METHOD fak_q0p1 "" RAT_FUNC "%6.3" "" COEFFS 0 1 0 0 0 0.1 /end COMPU_METHOD
/begin COMPU_METHOD fak_sb_b1 "" RAT_FUNC "%6.4" "-" COEFFS 0 256 0 0 0 2 /end COMPU_METHOD
/begin COMPU_METHOD fak_sw_b0p0625 "" RAT_FUNC "%8.7" "-" COEFFS 0 65536 0 0 0 0.125 /end COMPU_METHOD
/begin COMPU_METHOD fak_sw_b2 "" RAT_FUNC "%7.6" "-" COEFFS 0 65536 0 0 0 4 /end COMPU_METHOD
/begin COMPU_METHOD fak_sw_b8 "" RAT_FUNC "%6.5" "-" COEFFS 0 65536 0 0 0 16 /end COMPU_METHOD
/begin COMPU_METHOD fak_ub_b0p5 "" RAT_FUNC "%6.4" "-" COEFFS 0 256 0 0 0 0.5 /end COMPU_METHOD
/begin COMPU_METHOD fak_ub_b1 "" RAT_FUNC "%6.4" "-" COEFFS 0 256 0 0 0 1 /end COMPU_METHOD
/begin COMPU_METHOD fak_ub_b16 "" RAT_FUNC "%6.4" "-" COEFFS 0 256 0 0 0 16 /end COMPU_METHOD
/begin COMPU_METHOD fak_ub_b2 "" RAT_FUNC "%6.4" "-" COEFFS 0 256 0 0 0 2 /end COMPU_METHOD
/begin COMPU_METHOD fak_ub_b318p75 "" RAT_FUNC "%6.2" "-" COEFFS 0 256 0 0 0 318.75 /end COMPU_METHOD
/begin COMPU_METHOD fak_ub_b3p125 "" RAT_FUNC "%6.4" "%/Upm" COEFFS 0 2048 0 0 0 25 /end COMPU_METHOD
/begin COMPU_METHOD fak_uw_b16 "" RAT_FUNC "%6.5" "-" COEFFS 0 65536 0 0 0 16 /end COMPU_METHOD
/begin COMPU_METHOD fak_uw_b4864 "" RAT_FUNC "%6.4" "-" COEFFS 0 65536 0 0 0 4864 /end COMPU_METHOD
/begin COMPU_METHOD kw_q2p8125 "" RAT_FUNC "%6.2" "°KW" COEFFS 0 1 0 0 0 2.8125 /end COMPU_METHOD
/begin COMPU_METHOD kw_tooth_sy "" RAT_FUNC "%6.2" "°KW" COEFFS 0 0.166667 0 0 0 1 /end COMPU_METHOD
/begin COMPU_METHOD m_q0p1 "" RAT_FUNC "%6.3" "kg/h" COEFFS 0 10 0 0 0 1 /end COMPU_METHOD
/begin COMPU_METHOD m_ub_b23p3 "" RAT_FUNC "%6.3" "kg" COEFFS 0 2812.5 0 0 0 256 /end COMPU_METHOD
/begin COMPU_METHOD m_uw_b23p3 "" RAT_FUNC "%6.5" "kg" COEFFS 0 2812.5 0 0 0 1 /end COMPU_METHOD
/begin COMPU_METHOD m_uw_b25p6 "" RAT_FUNC "%6.5" "kg/h" COEFFS 0 65536 0 0 0 25.6 /end COMPU_METHOD
/begin COMPU_METHOD m_uw_b6553p5 "" RAT_FUNC "%6.3" "kg/h" COEFFS 0 1 0 0 0 0.1 /end COMPU_METHOD
/begin COMPU_METHOD nmot_sw_q0p25 "" RAT_FUNC "%6.3" "U/min" COEFFS 0 1 0 0 0 0.25 /end COMPU_METHOD
/begin COMPU_METHOD nmot_ub_q10 "" RAT_FUNC "%6.1" "U/min" COEFFS 0 1 0 0 0 10 /end COMPU_METHOD
/begin COMPU_METHOD nmot_ub_q40 "" RAT_FUNC "%6.1" "Upm" COEFFS 0 1 0 0 0 40 /end COMPU_METHOD
/begin COMPU_METHOD nmot_uw_q0p25 "" RAT_FUNC "%6.3" "U/min" COEFFS 0 1 0 0 0 0.25 /end COMPU_METHOD
/begin COMPU_METHOD p_ub_q10 "" RAT_FUNC "%6.1" "hPa" COEFFS 0 1 0 0 0 10 /end COMPU_METHOD
/begin COMPU_METHOD qnv_uw_b512 "" RAT_FUNC "%6.4" "(U/min)/(km/h)" COEFFS 0 65536 0 0 0 512 /end COMPU_METHOD
/begin COMPU_METHOD q_q0p4551 "" RAT_FUNC "%6.3" "kJ" COEFFS 0 36000 0 0 0 16384 /end COMPU_METHOD
/begin COMPU_METHOD relDK_q0p00152 "" RAT_FUNC "%6.4" "%DK" COEFFS 0 65536 0 0 0 100 /end COMPU_METHOD
/begin COMPU_METHOD relDK_q0p02441 "" RAT_FUNC "%6.4" "% DK" COEFFS 0 65536 0 0 0 1600 /end COMPU_METHOD
/begin COMPU_METHOD relDK_q0p0625 "" RAT_FUNC "%6.4" "%PWM/%DK" COEFFS 0 16 0 0 0 1 /end COMPU_METHOD
/begin COMPU_METHOD relDK_q1 "" RAT_FUNC "%6.2" "%PWM/%DK" COEFFS 0 1 0 0 0 1 /end COMPU_METHOD
/begin COMPU_METHOD relDK_q4 "" RAT_FUNC "%6.2" "%PWM/%DK" COEFFS 0 1 0 0 0 4 /end COMPU_METHOD
/begin COMPU_METHOD relDK_uw_b100 "" RAT_FUNC "%6.4" "% DK" COEFFS 0 65535 0 0 0 100 /end COMPU_METHOD
/begin COMPU_METHOD relPED_uw_b100 "" RAT_FUNC "%6.4" "% PED" COEFFS 0 65535 0 0 0 100 /end COMPU_METHOD
/begin COMPU_METHOD rel_q0p1957 "" RAT_FUNC "%6.3" "%" COEFFS 0 511 0 0 0 100 /end COMPU_METHOD
/begin COMPU_METHOD rel_sw_b100 "" RAT_FUNC "%6.4" "%" COEFFS 0 32768 0 0 0 100 /end COMPU_METHOD
/begin COMPU_METHOD rel_sw_q0p1953 "" RAT_FUNC "%6.3" "%" COEFFS 0 65536 0 0 0 12800 /end COMPU_METHOD
/begin COMPU_METHOD rel_ub_b100 "" RAT_FUNC "%6.3" "%" COEFFS 0 256 0 0 0 100 /end COMPU_METHOD
/begin COMPU_METHOD rel_ub_b127p5 "" RAT_FUNC "%6.3" "%" COEFFS 0 2 0 0 0 1 /end COMPU_METHOD
/begin COMPU_METHOD rel_ub_b99p6 "" RAT_FUNC "%6.3" "%" COEFFS 0 256 0 0 0 100 /end COMPU_METHOD
/begin COMPU_METHOD rel_ub_q0p75 "" RAT_FUNC "%6.3" "%" COEFFS 0 1 0 0 0 0.75 /end COMPU_METHOD
/begin COMPU_METHOD rel_uw_b100 "" RAT_FUNC "%6.4" "%" COEFFS 0 65536 0 0 0 100 /end COMPU_METHOD
/begin COMPU_METHOD rel_uw_q0p0234 "" RAT_FUNC "%6.4" "%" COEFFS 0 32 0 0 0 0.75 /end COMPU_METHOD
/begin COMPU_METHOD spg_q0p00488 "" RAT_FUNC "%6.4" "V" COEFFS 0 1024 0 0 0 5 /end COMPU_METHOD
/begin COMPU_METHOD spg_q0p1 "" RAT_FUNC "%6.3" "V" COEFFS 0 1 0 0 0 0.1 /end COMPU_METHOD
/begin COMPU_METHOD spg_ubatt "" RAT_FUNC "%6.4" "V" COEFFS 0 1 0 0 0 0.0704 /end COMPU_METHOD
/begin COMPU_METHOD spg_ubatt_w "" RAT_FUNC "%6.4" "V" COEFFS 0 1 0 0 0 0.0176 /end COMPU_METHOD
/begin COMPU_METHOD spg_ub_b28p5 "" RAT_FUNC "%6.3" "V" COEFFS 0 1 0 0 0 0.1113 /end COMPU_METHOD
/begin COMPU_METHOD spg_ub_b28p5_w "" RAT_FUNC "%6.4" "V" COEFFS 0 1 0 0 0 0.027825 /end COMPU_METHOD
/begin COMPU_METHOD spg_ub_b5 "" RAT_FUNC "%6.4" "V" COEFFS 0 256 0 0 0 5 /end COMPU_METHOD
/begin COMPU_METHOD spg_ub_q0p019 "" RAT_FUNC "%6.4" "V" COEFFS 0 256 0 0 0 5 /end COMPU_METHOD
/begin COMPU_METHOD spg_uw_b5 "" RAT_FUNC "%6.4" "V" COEFFS 0 1024 0 0 0 5 /end COMPU_METHOD
/begin COMPU_METHOD spg_uw_q0p001222 "" RAT_FUNC "%6.4" "V" COEFFS 0 1 0 0 0 0.001222 /end COMPU_METHOD
/begin COMPU_METHOD spg_uw_q0p00488 "" RAT_FUNC "%6.4" "V" COEFFS 0 1024 0 0 0 5 /end COMPU_METHOD
/begin COMPU_METHOD t100msxs_q0p0625 "" RAT_FUNC "%6.4" "s" COEFFS 0 16 0 0 0 1 /end COMPU_METHOD
/begin COMPU_METHOD t100msxs_ub_b25p5 "" RAT_FUNC "%6.3" "s" COEFFS 0 1 0 0 0 0.1 /end COMPU_METHOD
/begin COMPU_METHOD t100msxs_uw_b6553p6 "" RAT_FUNC "%6.3" "s" COEFFS 0 10 0 0 0 1 /end COMPU_METHOD
/begin COMPU_METHOD t10msxs_ub_b2p55 "" RAT_FUNC "%6.4" "s" COEFFS 0 1 0 0 0 0.01 /end COMPU_METHOD
/begin COMPU_METHOD t10msxs_uw_b655p35 "" RAT_FUNC "%6.4" "s" COEFFS 0 1 0 0 0 0.01 /end COMPU_METHOD
/begin COMPU_METHOD t1msxms_q1 "" RAT_FUNC "%6.2" "ms" COEFFS 0 1 0 0 0 1 /end COMPU_METHOD
/begin COMPU_METHOD t1sxs_uw_q1 "" RAT_FUNC "%6.2" "s" COEFFS 0 1 0 0 0 1 /end COMPU_METHOD
/begin COMPU_METHOD t20msxs_q40p96 "" RAT_FUNC "%6.1" "s" COEFFS 0 1 0 0 0 40.96 /end COMPU_METHOD
/begin COMPU_METHOD t20msxs_ub_b5p1 "" RAT_FUNC "%6.4" "s" COEFFS 0 1 0 0 0 0.02 /end COMPU_METHOD
/begin COMPU_METHOD t20msxs_uw_q0p02 "" RAT_FUNC "%6.4" "s" COEFFS 0 1 0 0 0 0.02 /end COMPU_METHOD
/begin COMPU_METHOD t500usxms_ub_q0p5 "" RAT_FUNC "%6.3" "ms" COEFFS 0 1 0 0 0 0.5 /end COMPU_METHOD
/begin COMPU_METHOD t50msxs_q0p05 "" RAT_FUNC "%6.4" "s" COEFFS 0 1 0 0 0 0.05 /end COMPU_METHOD
/begin COMPU_METHOD t50msxs_ub_b12p75 "" RAT_FUNC "%6.4" "s" COEFFS 0 1 0 0 0 0.05 /end COMPU_METHOD
/begin COMPU_METHOD tempacc_q0p0195 "" RAT_FUNC "%6.4" "K/s^2" COEFFS 0 256 0 0 0 5 /end COMPU_METHOD
/begin COMPU_METHOD tempg_q0p0195 "" RAT_FUNC "%6.4" "K/s" COEFFS 0 256 0 0 0 5 /end COMPU_METHOD
/begin COMPU_METHOD temp_q0p0195 "" RAT_FUNC "%6.4" "Grad C" COEFFS 0 256 0 0 0 5 /end COMPU_METHOD
/begin COMPU_METHOD temp_q0p0234_o273 "" RAT_FUNC "%6.1" "Grad C" COEFFS 0 1 273.15 0 0 0.0234375 /end COMPU_METHOD
/begin COMPU_METHOD temp_q5 "" RAT_FUNC "%6.2" "Grad C" COEFFS 0 1 0 0 0 5 /end COMPU_METHOD
/begin COMPU_METHOD temp_ub_b0p1 "" RAT_FUNC "%6.5" "1/Grad C" COEFFS 0 256 0 0 0 0.1 /end COMPU_METHOD
/begin COMPU_METHOD temp_ub_b191p25 "" RAT_FUNC "%6.3" "Grad C" COEFFS 0 1 0 0 0 0.75 /end COMPU_METHOD
/begin COMPU_METHOD temp_ub_q0p75_o48 "" RAT_FUNC "%6.2" "Grad C" COEFFS 0 1 48 0 0 0.75 /end COMPU_METHOD
/begin COMPU_METHOD temp_ub_q5_o50 "" RAT_FUNC "%6.2" "Grad C" COEFFS 0 1 50 0 0 5 /end COMPU_METHOD
/begin COMPU_METHOD temp_uw_q0p0195 "" RAT_FUNC "%6.4" "Grad C" COEFFS 0 256 0 0 0 5 /end COMPU_METHOD
/begin COMPU_METHOD temp_uw_q0p0195_o50 "" RAT_FUNC "%6.2" "Grad C" COEFFS 0 256 12800 0 0 5 /end COMPU_METHOD
/begin COMPU_METHOD tinjection_sy "" RAT_FUNC "%6.4" "ms" COEFFS 0 375 0 0 0 1 /end COMPU_METHOD
/begin COMPU_METHOD tsegment_sy "" RAT_FUNC "%6.5" "ms" COEFFS 0 1500 0 0 0 1 /end COMPU_METHOD
/begin COMPU_METHOD t_q0p2 "" RAT_FUNC "%6.3" "s" COEFFS 0 10 0 0 0 2 /end COMPU_METHOD
/begin COMPU_METHOD vfzg_ub_q1p25 "" RAT_FUNC "%6.2" "km/h" COEFFS 0 1 0 0 0 1.25 /end COMPU_METHOD
/begin COMPU_METHOD vol_q0p1 "" RAT_FUNC "%6.3" "mL" COEFFS 0 1 0 0 0 0.1 /end COMPU_METHOD
/begin COMPU_METHOD vs_q0p1 "" RAT_FUNC "%6.3" "mL/dT" COEFFS 0 1 0 0 0 0.1 /end COMPU_METHOD
/begin COMPU_METHOD zk100msxms_uw_b0p125 "" RAT_FUNC "%8.7" "1/(s*K)" COEFFS 0 524288 0 0 0 1 /end COMPU_METHOD
/begin COMPU_METHOD zk200msxs_uw_b13107 "" RAT_FUNC "%12.3" "s" COEFFS 0 0 13107.2 0 1 0 /end COMPU_METHOD
/begin COMPU_METHOD zw_azue_sy "" RAT_FUNC "%6.3" "Grad KW" COEFFS 0 1.33333 0 0 0 1 /end COMPU_METHOD
/begin COMPU_METHOD zw_TR2OT_sy "" RAT_FUNC "%6.2" "Grad KW" COEFFS 0 -1.33333 96 0 0 1 /end COMPU_METHOD
/begin COMPU_METHOD zw_TR2OT_teeth_sy "" RAT_FUNC "%6.3" "Grad KW" COEFFS 0 -0.166667 12 0 0 1 /end COMPU_METHOD
/begin RECORD_LAYOUT FkfNoShNoOffWUb FNC_VALUES 1 UBYTE COLUMN_DIR DIRECT /end RECORD_LAYOUT
/begin RECORD_LAYOUT FklWSw FNC_VALUES 1 SWORD COLUMN_DIR DIRECT /end RECORD_LAYOUT
/begin RECORD_LAYOUT FklWUb FNC_VALUES 1 UBYTE COLUMN_DIR DIRECT /end RECORD_LAYOUT
/begin RECORD_LAYOUT FklWUw FNC_VALUES 1 UWORD COLUMN_DIR DIRECT /end RECORD_LAYOUT
/begin RECORD_LAYOUT GkfWSb FNC_VALUES 1 SBYTE COLUMN_DIR DIRECT /end RECORD_LAYOUT
/begin RECORD_LAYOUT GkfWUb FNC_VALUES 1 UBYTE COLUMN_DIR DIRECT /end RECORD_LAYOUT
/begin RECORD_LAYOUT GkfWUw FNC_VALUES 1 UWORD COLUMN_DIR DIRECT /end RECORD_LAYOUT
/begin RECORD_LAYOUT GklWSb FNC_VALUES 1 SBYTE COLUMN_DIR DIRECT /end RECORD_LAYOUT
/begin RECORD_LAYOUT GklWUb FNC_VALUES 1 UBYTE COLUMN_DIR DIRECT /end RECORD_LAYOUT
/begin RECORD_LAYOUT GklWUw FNC_VALUES 1 UWORD COLUMN_DIR DIRECT /end RECORD_LAYOUT
/begin RECORD_LAYOUT KfAxUbAyUbSstxUbSstyUbWUb NO_AXIS_PTS_X 1 UBYTE NO_AXIS_PTS_Y 2 UBYTE AXIS_PTS_X 3 UBYTE INDEX_INCR DIRECT AXIS_PTS_Y 4 UBYTE INDEX_INCR DIRECT FNC_VALUES 5 UBYTE COLUMN_DIR DIRECT /end RECORD_LAYOUT
/begin RECORD_LAYOUT KfAxUbAyUbSstxUwSstyUwWUw NO_AXIS_PTS_X 1 UWORD NO_AXIS_PTS_Y 2 UWORD AXIS_PTS_X 3 UWORD INDEX_INCR DIRECT AXIS_PTS_Y 4 UWORD INDEX_INCR DIRECT FNC_VALUES 5 UWORD COLUMN_DIR DIRECT /end RECORD_LAYOUT
/begin RECORD_LAYOUT KlAUbSstUbWSb NO_AXIS_PTS_X 1 UBYTE AXIS_PTS_X 2 UBYTE INDEX_INCR DIRECT FNC_VALUES 3 SBYTE COLUMN_DIR DIRECT /end RECORD_LAYOUT
/begin RECORD_LAYOUT KlAUbSstUbWUb NO_AXIS_PTS_X 1 UBYTE AXIS_PTS_X 2 UBYTE INDEX_INCR DIRECT FNC_VALUES 3 UBYTE COLUMN_DIR DIRECT /end RECORD_LAYOUT
/begin RECORD_LAYOUT KlAUbSstUbWUw NO_AXIS_PTS_X 1 UBYTE AXIS_PTS_X 2 UBYTE INDEX_INCR DIRECT FNC_VALUES 3 UWORD COLUMN_DIR DIRECT /end RECORD_LAYOUT
/begin RECORD_LAYOUT KlAUwSstUwWUw NO_AXIS_PTS_X 1 UWORD AXIS_PTS_X 2 UWORD INDEX_INCR DIRECT FNC_VALUES 3 UWORD COLUMN_DIR DIRECT /end RECORD_LAYOUT
/begin RECORD_LAYOUT KwbUb FNC_VALUES 1 UBYTE COLUMN_DIR DIRECT /end RECORD_LAYOUT
/begin RECORD_LAYOUT KwSb FNC_VALUES 1 SBYTE COLUMN_DIR DIRECT /end RECORD_LAYOUT
/begin RECORD_LAYOUT KwSw FNC_VALUES 1 SWORD COLUMN_DIR DIRECT /end RECORD_LAYOUT
/begin RECORD_LAYOUT KwUb FNC_VALUES 1 UBYTE COLUMN_DIR DIRECT /end RECORD_LAYOUT
/begin RECORD_LAYOUT KwUw FNC_VALUES 1 UWORD COLUMN_DIR DIRECT /end RECORD_LAYOUT
/begin RECORD_LAYOUT SstASwSstSw NO_AXIS_PTS_X 1 SWORD AXIS_PTS_X 2 SWORD INDEX_INCR DIRECT /end RECORD_LAYOUT
/begin RECORD_LAYOUT SstAUbSstUb NO_AXIS_PTS_X 1 UBYTE AXIS_PTS_X 2 UBYTE INDEX_INCR DIRECT /end RECORD_LAYOUT
/begin RECORD_LAYOUT SstAUwSstUw NO_AXIS_PTS_X 1 UWORD AXIS_PTS_X 2 UWORD INDEX_INCR DIRECT /end RECORD_LAYOUT
/end MODULE
/end PROJECT
