ASAP2_VERSION 1 31
/begin PROJECT DEMO ""
/begin HEADER "" VERSION "1.2" /end HEADER
/begin MODULE MOD ""
/begin MOD_COMMON "" BYTE_ORDER MSB_LAST ALIGNMENT_BYTE 1 ALIGNMENT_WORD 2 ALIGNMENT_LONG 2 /end MOD_COMMON
/begin COMPU_METHOD ident "" RAT_FUNC "%3.0" "" COEFFS 0 1 0 0 0 1 /end COMPU_METHOD
/begin COMPU_METHOD recip "" RAT_FUNC "%6.1" "1/s" COEFFS 0 0 2560 0 1 0 /end COMPU_METHOD
/begin RECORD_LAYOUT Kf NO_AXIS_PTS_X 1 UBYTE AXIS_PTS_X 2 UBYTE FNC_VALUES 3 UWORD COLUMN_DIR DIRECT /end RECORD_LAYOUT
/begin RECORD_LAYOUT Scalar FNC_VALUES 1 UBYTE /end RECORD_LAYOUT
/begin CHARACTERISTIC Curve "a curve" CURVE 0x800200 Kf 0 recip 0 10 /begin AXIS_DESCR STD_AXIS NO_INPUT ident 4 0 10 /end AXIS_DESCR /end CHARACTERISTIC
/begin CHARACTERISTIC Val "a value" VALUE 0x800500 Scalar 0 ident 0 1 /end CHARACTERISTIC
/end MODULE
/end PROJECT
