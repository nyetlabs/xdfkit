ASAP2_VERSION 1 3
/begin PROJECT X505R_24d1_0 "4019.XX"
/begin HEADER "" VERSION "X505R_24d1_0" PROJECT_NO X505R_24d1_0 /end HEADER
/begin MODULE DIM ""
/begin MOD_COMMON "" BYTE_ORDER MSB_LAST ALIGNMENT_BYTE 1 ALIGNMENT_WORD 2 ALIGNMENT_LONG 2 /end MOD_COMMON
/begin CHARACTERISTIC ACSZNBM "BM-Zähler für Drehzahl=0 Erkennung nach Crashabschaltung" VALUE 0x812428 KwUb 255.0 dez 0.00 255.0 FORMAT "%5.1" /end CHARACTERISTIC
/begin CHARACTERISTIC ACSZRPH "PH-Zähler für Drehzahl=0 Erkennung nach Crashabschaltung" VALUE 0x812429 KwUb 255.0 dez 0.00 255.0 FORMAT "%5.1" /end CHARACTERISTIC
/begin CHARACTERISTIC ANZTPMX "Maximale Anzahl von hintereinander erlaubten Tips" VALUE 0x8189BB KwUb 255.0 dez 0.00 255.0 FORMAT "%5.1" /end CHARACTERISTIC
/begin CHARACTERISTIC ATISLATM "Anzti-Schwelle zur Umschaltung von lamns_w auf lamwl_w" CURVE 0x81BFBC GklWUw 50176.00 dez 0.00 50176.00 FORMAT "%8.2"
 /begin AXIS_DESCR COM_AXIS tmst temp_ub_q0p75_o48 12 -48.00 143.3 AXIS_PTS_REF STS12ESUB /end AXIS_DESCR
/end CHARACTERISTIC
/begin CHARACTERISTIC ATIWKSTM "Anzti-Schwelle zur Umschaltung von lamns_w auf lamwl_w bei Wiederholkaltstart" CURVE 0x81BFD4 GklWUw 50176.00 dez 0.00 50176.00 FORMAT "%8.2"
 /begin AXIS_DESCR COM_AXIS tmst temp_ub_q0p75_o48 12 -48.00 143.3 AXIS_PTS_REF STS12ESUB /end AXIS_DESCR
/end CHARACTERISTIC
/begin CHARACTERISTIC BFGRO "Obere Schwelle für Beschleunigung im FGR-Betrieb" VALUE 0x8145E8 KwSw 27.7802865 bfzg_sw_q4p239Em4 -13.8903552 13.8899313 /end CHARACTERISTIC
/begin CHARACTERISTIC BFGRU "Untere Schwelle für Beschleunigung im FGR-Betrieb" VALUE 0x8145EA KwSw 27.7802865 bfzg_sw_q4p239Em4 -13.8903552 13.8899313 /end CHARACTERISTIC
/begin CHARACTERISTIC BRABEVI_0_A "Beschleunigung bei Rampe Beschleunigen" CURVE 0x81C000 KlAUwSstUwWUw 27.7802865 bfzg_sw_q4p239Em4 0.00 27.7802865
 /begin AXIS_DESCR STD_AXIS vfgr_w vfzg_uw_b512 8 0.00 511.9922 FORMAT "%8.4" DEPOSIT ABSOLUTE /end AXIS_DESCR
/end CHARACTERISTIC
/begin CHARACTERISTIC BRABEVI_1_A "Beschleunigung bei Rampe Beschleunigen" CURVE 0x81C022 KlAUwSstUwWUw 27.7802865 bfzg_sw_q4p239Em4 0.00 27.7802865
 /begin AXIS_DESCR STD_AXIS vfgr_w vfzg_uw_b512 8 0.00 511.9922 FORMAT "%8.4" DEPOSIT ABSOLUTE /end AXIS_DESCR
/end CHARACTERISTIC
/begin CHARACTERISTIC BRATD "Beschleunigung (Betrag) bei Rampe Tip-Down" VALUE 0x81C044 KwUw 27.7802865 bfzg_sw_q4p239Em4 0.00 27.7802865 /end CHARACTERISTIC
/begin CHARACTERISTIC BRATU "Beschleunigung bei Rampe Tip-Up" VALUE 0x81C046 KwUw 27.7802865 bfzg_sw_q4p239Em4 0.00 27.7802865 /end CHARACTERISTIC
/begin CHARACTERISTIC CSGRA "Checksumme für GRA-Can-Botschaft" VALUE 0x810C48 KwUb 255.0 DEZ 0.00 255.0 FORMAT "%5.1" /end CHARACTERISTIC
/begin CHARACTERISTIC CUKA "Codewort ÜK-Adaption" VALUE 0x81119C KwUb 255.0 dez 0.00 255.0 FORMAT "%5.1" /end CHARACTERISTIC
/begin CHARACTERISTIC CWCS "Codewort für Auswertung der CAN-Crash-Info" VALUE 0x81A6C2 KwUb 255.0 DEZ 0.00 255.0 FORMAT "%5.1" /end CHARACTERISTIC
/begin CHARACTERISTIC CWFGRFULO "Codewort FGRFULO" VALUE 0x8189BC KwUb 255.0 dez 0.00 255.0 FORMAT "%5.1" /end CHARACTERISTIC
/begin CHARACTERISTIC CWFGRGA_0_A "Codewort für gangabhängiges FGR-Verbot" VALUE 0x8145F6 KwUb 255.0 dez 0.00 255.0 FORMAT "%5.1" /end CHARACTERISTIC
/begin CHARACTERISTIC CWFGRGA_1_A "Codewort für gangabhängiges FGR-Verbot" VALUE 0x8145F7 KwUb 255.0 dez 0.00 255.0 FORMAT "%5.1" /end CHARACTERISTIC
/begin CHARACTERISTIC CWFGRGABED "" VALUE 0x810C43 KwUb 255.0 dez 0.00 255.0 FORMAT "%5.1" /end CHARACTERISTIC
/begin CHARACTERISTIC CWFGRREGL_0_A "Codewort FGRREGL" VALUE 0x81BF16 KwUb 255.0 dez 0.00 255.0 FORMAT "%5.1" /end CHARACTERISTIC
/begin CHARACTERISTIC CWFGRREGL_1_A "Codewort FGRREGL" VALUE 0x81BF17 KwUb 255.0 dez 0.00 255.0 FORMAT "%5.1" /end CHARACTERISTIC
/begin CHARACTERISTIC CWFUEDK "Codewort FUEDK" VALUE 0x810D4A KwUb 255.0 dez 0.00 255.0 FORMAT "%5.1" /end CHARACTERISTIC
/begin CHARACTERISTIC CWFUEREG "Codewort Füllungsregler außerhalb Leerlauf aktiv" VALUE 0x810D3A KwUb 255.0 dez 0.00 255.0 FORMAT "%5.1" /end CHARACTERISTIC
/begin CHARACTERISTIC CWGGATS "Codewort Umschaltung Ersatztemperatur bei Sensorausfall" VALUE 0x819400 KwUb 255.0 dez 0.00 255.0 FORMAT "%5.1" /end CHARACTERISTIC
/begin CHARACTERISTIC CWGGEGAS "Codewort für GGEGAS" VALUE 0x810C1F KwUb 255.0 dez 0.00 255.0 FORMAT "%5.1" /end CHARACTERISTIC
/begin CHARACTERISTIC CWGGFGRH "Codewort  GGFGRH" VALUE 0x810A50 KwUb 255.0 dez 0.00 255.0 FORMAT "%5.1" /end CHARACTERISTIC
/begin CHARACTERISTIC CWKRAPP "Codewort für Applikation KR" VALUE 0x819629 KwUb 255.0 dez 0.00 255.0 FORMAT "%5.1" /end CHARACTERISTIC
/begin CHARACTERISTIC CWMSRCAN "Codewort für MSR/ASR über CAN" VALUE 0x81018B KwUb 255.0 DEZ 0.00 255.0 FORMAT "%5.1" /end CHARACTERISTIC
/begin CHARACTERISTIC CWNWREF "Nockenwellenverhalten im Start" VALUE 0x8109D8 KwUb 255.0 dez 0.00 255.0 FORMAT "%5.1" /end CHARACTERISTIC
/begin CHARACTERISTIC CWVWKNWS "Code Wort: Vorlagerungswinkelkorrektur bei NWS" VALUE 0x818D0C KwUb 255.0 dez 0.00 255.0 FORMAT "%5.1" /end CHARACTERISTIC
/begin CHARACTERISTIC CWWDKSPE "Codewort: prädizierende DK-Sollwertentjitterung aktiv" VALUE 0x810D5A KwUb 255.0 dez 0.00 255.0 FORMAT "%5.1" /end CHARACTERISTIC
/begin CHARACTERISTIC CWWL "Codewort für Warmlaufsteuerung" VALUE 0x818E20 KwUb 255.0 dez 0.00 255.0 FORMAT "%5.1" /end CHARACTERISTIC
/begin CHARACTERISTIC DBZ_AIR "obere Grenze für Botschaftszählerdifferenz" VALUE 0x81242A KwUb 255.0 DEZ 0.00 255.0 FORMAT "%5.1" /end CHARACTERISTIC
/begin CHARACTERISTIC DBZ_GRA "oberer Grenzwert für Botschaftszählerdifferenz GRA" VALUE 0x810C49 KwUb 255.0 DEZ 0.00 255.0 FORMAT "%5.1" /end CHARACTERISTIC
/begin CHARACTERISTIC DBZ_MN "kleinstes zulässiges Delta des Botschaftszählers in der Funktion" VALUE 0x81018C KwUb 255.0 DEZ 0.00 255.0 FORMAT "%5.1" /end CHARACTERISTIC
/begin CHARACTERISTIC DBZ_MX "Größtes zulässiges Delta des Botschaftszählers in der Funktion" VALUE 0x81018D KwUb 255.0 DEZ 0.00 255.0 FORMAT "%5.1" /end CHARACTERISTIC
/begin CHARACTERISTIC DFAFRG "Aufreglungsfaktor nach Einschalten des Füllungsreglers" VALUE 0x810D3B KwUb 0.9961 fak_ub_b1 0.00 0.9961 /end CHARACTERISTIC
/begin CHARACTERISTIC DKNOTBEGR "Sollwertbegrenzung bei DK-Potinotfahren als f(nmot)" CURVE 0x8153B4 KlAUbSstUbWUw 100.0000 relDK_uw_b100 0.00 100.0000 FORMAT "%8.4"
 /begin AXIS_DESCR STD_AXIS nmot nmot_ub_q40 8 0.00 10200. FORMAT "%5.0" DEPOSIT ABSOLUTE /end AXIS_DESCR
/end CHARACTERISTIC
/begin CHARACTERISTIC DKROKD "Obere Drehzahlschwelle für Nulltest-Diagnose Klopfregelung" VALUE 0x81962A KwUb 10200. nmot_ub_q40 0.00 10200. FORMAT "%5.0" /end CHARACTERISTIC
/begin CHARACTERISTIC DKROKMX "Maximaler Offsetkompensationswert" VALUE 0x8111B6 KwUb 4.980 spg_ub_b5 0.00 4.980 FORMAT "%5.3" /end CHARACTERISTIC
/begin CHARACTERISTIC DKROKO "Obere Drehzahlschwelle für Ermittlung Offsetkompensationswert" VALUE 0x81962B KwUb 10200. nmot_ub_q40 0.00 10200. FORMAT "%5.0" /end CHARACTERISTIC
/begin CHARACTERISTIC DLAMNSWL "max. Abweichung für lamnswl_w=1.0" VALUE 0x811027 KwUb 0.9961 fak_ub_b1 0.00 0.9961 /end CHARACTERISTIC
/begin CHARACTERISTIC DNFGRMX "Drehzahl-Differenz zu Maximaldrehzahl für FGR-Abschaltung" VALUE 0x8145EC KwUw 16383.75 nmot_uw_q0p25 0.00 16383.75 FORMAT "%8.2" /end CHARACTERISTIC
/begin CHARACTERISTIC DPDSVLU "Delta Druckwert für Signalvergleich Ladedruck mit Umgebungsdruck" VALUE 0x81BF62 KwUw 2559.961 p_uw_q0p039 0.00 2559.961 FORMAT "%8.3" /end CHARACTERISTIC
/begin CHARACTERISTIC DPUPS "Druckdifferenz für Umschaltung Referenzdruck vor Drosselklappe" VALUE 0x810D4B KwUb 2550. p_ub_q10 0.00 2550. FORMAT "%5.0" /end CHARACTERISTIC
/begin CHARACTERISTIC DPUPVDK "Differenzdruck pu-pvdk" CURVE 0x81BF64 KlAUwSstUwWUw 2559.961 p_uw_q0p039 0.00 2559.961 FORMAT "%8.3"
 /begin AXIS_DESCR STD_AXIS ml_w m_uw_b6553p5 8 0.00 6553.500 FORMAT "%8.3" DEPOSIT ABSOLUTE /end AXIS_DESCR
/end CHARACTERISTIC
/begin CHARACTERISTIC DRLSOLMF "Schwelle delta rlsol für Medianfilter" VALUE 0x815086 KwUw 1535.977 rel_uw_q0p0234 0.00 1535.977 FORMAT "%8.3" /end CHARACTERISTIC
/begin CHARACTERISTIC DSLGRAD "Gradient für Drucksensor Ladedruck" VALUE 0x814FBE KwUw 1023.984 dgrad_uw_q0p015 0.00 1023.984 FORMAT "%8.3" /end CHARACTERISTIC
/begin CHARACTERISTIC DSLOFS "Offset Drucksensor Ladedruck" VALUE 0x814FC0 KwSw 2559.961 p_sw_q0p039 -1280.000 1279.961 FORMAT "%8.3" /end CHARACTERISTIC
/begin CHARACTERISTIC DSTGRAD "Gradient für Umrechnung Spannung -> Druck bei Tankdrucksensor" VALUE 0x817084 KwUw 127.9980 adb_uw_q0p00195 0.00 127.9980 FORMAT "%8.4" /end CHARACTERISTIC
/begin CHARACTERISTIC DSTOFFS "Offset für Umrechnung Spannung -> Druck bei Tankdrucksensor" VALUE 0x817086 KwSw 330.0000 spg_sw_b5 -320.0000 10.00000 FORMAT "%8.4" /end CHARACTERISTIC
/begin CHARACTERISTIC DSUGRAD "Gradient für Drucksensor Umgebung" VALUE 0x81BF86 KwUw 1023.984 dgrad_uw_q0p015 0.00 1023.984 FORMAT "%8.3" /end CHARACTERISTIC
/begin CHARACTERISTIC DSUOFS "Offset Drucksensor Umgebung" VALUE 0x81BF88 KwSw 2559.961 p_sw_q0p039 -1280.000 1279.961 FORMAT "%8.3" /end CHARACTERISTIC
/begin CHARACTERISTIC DTAATSMN "Delta Tastverhältnis Abgastemperatursensor" VALUE 0x81D322 KwSw 99.99847 rel_sw_b50 -50.00000 49.99847 FORMAT "%8.5" /end CHARACTERISTIC
/begin CHARACTERISTIC DTMKI "Sicherheitsoffset zwischen Kühlmitteltemperatur aus Kombiinstrument und tmot" VALUE 0x819596 KwUb 191.3 temp_ub_b191p25 0.00 191.3 FORMAT "%5.1" /end CHARACTERISTIC
/begin CHARACTERISTIC DUDKP1HY "Offset für Hysterese bei Umschaltung auf verstärktes Signal von DK-Poti 1" VALUE 0x8144E2 KwUw 80.08377 spg_uw_q0p001222 0.00 80.08377 FORMAT "%8.5" /end CHARACTERISTIC
/begin CHARACTERISTIC DUKK "Schwelle für Kurzzeitanteil" VALUE 0x8156CA KwSw 12287.81 rel_sw_q0p1875 -6144.000 6143.813 FORMAT "%8.3" /end CHARACTERISTIC
/begin CHARACTERISTIC DVIVZMX "Max. zul. Abweichung zw. Istgeschw. und Zielgeschw. bei FGR-Konstantfahrt" VALUE 0x8145EE KwUw 511.9922 vfzg_uw_b512 0.00 511.9922 FORMAT "%8.4" /end CHARACTERISTIC
/begin CHARACTERISTIC DVIVZTMX "Maximales Delta zw. Ist- und Zielgeschw. für Tip-Erlaubnis" VALUE 0x81C048 KwUw 511.9922 vfzg_uw_q0p0078125 0.00 511.9922 FORMAT "%8.4" /end CHARACTERISTIC
/begin CHARACTERISTIC DVLLVO "Delta Geschwindigkeit für Rücksetzen Leerlauf-Verbot vom FGR" VALUE 0x81C1C4 KwUw 511.9922 vfzg_uw_q0p0078125 0.00 511.9922 FORMAT "%8.4" /end CHARACTERISTIC
/begin CHARACTERISTIC DVLLVU "Delta Geschwindigkeit für Setzen Leerlauf-Verbot vom FGR" VALUE 0x81C1C6 KwUw 511.9922 vfzg_uw_q0p0078125 0.00 511.9922 FORMAT "%8.4" /end CHARACTERISTIC
/begin CHARACTERISTIC DVSAVO "Delta Geschwindigkeit für Rücksetzen Schubabschalteverbot vom FGR" VALUE 0x81C1C8 KwUw 511.9922 vfzg_uw_q0p0078125 0.00 511.9922 FORMAT "%8.4" /end CHARACTERISTIC
/begin CHARACTERISTIC DVSAVU "Delta Geschwindigkeit für Setzen Schubabschalteverbot vom FGR" VALUE 0x81C1CA KwUw 511.9922 vfzg_uw_q0p0078125 0.00 511.9922 FORMAT "%8.4" /end CHARACTERISTIC
/begin CHARACTERISTIC DVSKNBGA_0_A "Delta Geschwindigkeit für Setzwertkorrektur nach Beschleunigen" CURVE 0x81C04A KlAUbSstUbWUw 511.9922 vfzg_uw_q0p0078125 0.00 511.9922 FORMAT "%8.4"
 /begin AXIS_DESCR STD_AXIS uevges fak_q0p1 8 0.00 25.50 FORMAT "%5.2" DEPOSIT ABSOLUTE /end AXIS_DESCR
/end CHARACTERISTIC
/begin CHARACTERISTIC DVSKNBGA_1_A "Delta Geschwindigkeit für Setzwertkorrektur nach Beschleunigen" CURVE 0x81C064 KlAUbSstUbWUw 511.9922 vfzg_uw_q0p0078125 0.00 511.9922 FORMAT "%8.4"
 /begin AXIS_DESCR STD_AXIS uevges fak_q0p1 8 0.00 25.50 FORMAT "%5.2" DEPOSIT ABSOLUTE /end AXIS_DESCR
/end CHARACTERISTIC
/begin CHARACTERISTIC DVSKNVGA_0_A "Delta Geschwindigkeit für Setzwertkorrektur nach Verzögern" CURVE 0x81C07E KlAUbSstUbWUw 511.9922 vfzg_uw_q0p0078125 0.00 511.9922 FORMAT "%8.4"
 /begin AXIS_DESCR STD_AXIS uevges fak_q0p1 8 0.00 25.50 FORMAT "%5.2" DEPOSIT ABSOLUTE /end AXIS_DESCR
/end CHARACTERISTIC
/begin CHARACTERISTIC DVSKNVGA_1_A "Delta Geschwindigkeit für Setzwertkorrektur nach Verzögern" CURVE 0x81C098 KlAUbSstUbWUw 511.9922 vfzg_uw_q0p0078125 0.00 511.9922 FORMAT "%8.4"
 /begin AXIS_DESCR STD_AXIS uevges fak_q0p1 8 0.00 25.50 FORMAT "%5.2" DEPOSIT ABSOLUTE /end AXIS_DESCR
/end CHARACTERISTIC
/begin CHARACTERISTIC DVSWKB "Maximal zulässige Änderung der Zielgeschwindigkeit nach Beschleunigung" VALUE 0x81C0B2 KwUw 511.9922 vfzg_uw_q0p0078125 0.00 511.9922 FORMAT "%8.4" /end CHARACTERISTIC
/begin CHARACTERISTIC DVSWKV "Maximal zulässige Änderung der Zielgeschwindigkeit nach Verzögerung" VALUE 0x81C0B4 KwUw 511.9922 vfzg_uw_q0p0078125 0.00 511.9922 FORMAT "%8.4" /end CHARACTERISTIC
/begin CHARACTERISTIC DVTIPUD "Änderung der Zielgeschwindigkeit bei Tip-Up oder Tip-Down" VALUE 0x81C0B6 KwUw 511.9922 vfzg_uw_q0p0078125 0.00 511.9922 FORMAT "%8.4" /end CHARACTERISTIC
/begin CHARACTERISTIC DVZVIMX "Max. zul. Abweichung zw. Zielgeschw. und Istgeschw. bei FGR-Konstantfahrt" VALUE 0x8145F0 KwUw 511.9922 vfzg_uw_b512 0.00 511.9922 FORMAT "%8.4" /end CHARACTERISTIC
/begin CHARACTERISTIC DVZVITMX "Maximales Delta zw. Ziel- und Istgeschw. für Tip-Erlaubnis" VALUE 0x81C0B8 KwUw 511.9922 vfzg_uw_q0p0078125 0.00 511.9922 FORMAT "%8.4" /end CHARACTERISTIC
/begin CHARACTERISTIC DVZVIWA "Delta zw. Ziel- und Istgeschw. für Übergang von Konstantfahrt in Wiederaufnahme" VALUE 0x81C0BA KwUw 511.9922 vfzg_uw_q0p0078125 0.00 511.9922 FORMAT "%8.4" /end CHARACTERISTIC
/begin CHARACTERISTIC DWDK12O "Maximal zulässige Abweichung zwischen den DK-Winkeln aus Poti 1 und 2" VALUE 0x810A74 KwUb 100.0 relDK_ub_b100 0.00 100.0 FORMAT "%5.1" /end CHARACTERISTIC
/begin CHARACTERISTIC DWDK13O "Maximal zulässige Abweichung zwischen DK-Winkel aus Poti 1 und Ersatzwert" VALUE 0x810A75 KwUb 100.0 relDK_ub_b100 0.00 100.0 FORMAT "%5.1" /end CHARACTERISTIC
/begin CHARACTERISTIC DWDK23O "Maximal zulässige Abweichung zwischen DK-Winkel aus Poti 2 und Ersatzwert" VALUE 0x810A76 KwUb 100.0 relDK_ub_b100 0.00 100.0 FORMAT "%5.1" /end CHARACTERISTIC
/begin CHARACTERISTIC DWDKUGD "Delta zum DK-Winkel ungedrosselt (Toleranz)" VALUE 0x815088 KwUw 99.99847 rel_uw_b100 0.00 99.99847 FORMAT "%8.5" /end CHARACTERISTIC
/begin CHARACTERISTIC DWEEMX "maximal zulässige Zunahme Winkel Einspritzende pro Syncro" VALUE 0x810DDA KwUb 1530. zw_ub_q6 0.00 1530. FORMAT "%5.0" /end CHARACTERISTIC
/begin CHARACTERISTIC DZZST "Anzahl Zähne bei Zahnunterdrückung im Start" VALUE 0x8109D9 KwUb 254.0 dez 0.00 254.0 FORMAT "%5.1" /end CHARACTERISTIC
/begin CHARACTERISTIC DZZSTNLP "Anzahl der Entprellzähne bei Notlauf-Phasengeber" VALUE 0x8109DA KwUb 254.0 dez 0.00 254.0 FORMAT "%5.1" /end CHARACTERISTIC
/begin CHARACTERISTIC ENTDKLL "Entjitterschwelle (Ink) für DK-Sollwert im Leerlauf (B_ll)" VALUE 0x810D5B KwUb 20.00 dez 0.00 20.00 FORMAT "%5.2" /end CHARACTERISTIC
/begin CHARACTERISTIC ENTDKNLL "Entjitterschwelle (Ink) für DK-Sollwert außerhalb Leerlauf (!B_ll)" VALUE 0x810D5C KwUb 20.00 dez 0.00 20.00 FORMAT "%5.2" /end CHARACTERISTIC
/begin CHARACTERISTIC EVTMODMNDK "min. Temperatur bei der Offset nicht zu DK-Kennlinie bei nmot=0 addiert wird" VALUE 0x810D4C KwUb 191.3 temp_ub_q0p75_o48 -48.00 143.3 FORMAT "%5.1" /end CHARACTERISTIC
/begin CHARACTERISTIC FGMRIDV "Gewichtungsfaktor für Reglerinitialisierung bei Wiederaufnahme" CURVE 0x81C1CC KlASwSstSwWSw 1.999939 fak_sw_b2 0.00 1.999939 FORMAT "%8.6"
 /begin AXIS_DESCR STD_AXIS dvzvi_w vfzg_sw_q0p00781 4 -256.0000 255.9922 FORMAT "%8.4" DEPOSIT ABSOLUTE /end AXIS_DESCR
/end CHARACTERISTIC
/begin AXIS_PTS FHO04ESUB "SST-Verteilung für Höhenfaktor" 0x81005B fho SstAUbSstUb 3.984 fak_ub_b4 4 0.00 3.984 FORMAT "%5.3" DEPOSIT ABSOLUTE /end AXIS_PTS
/begin CHARACTERISTIC FHOE "Ersatzwert für Höhe" VALUE 0x818A2F KwUb 3.984 fak_ub_b4 0.00 3.984 FORMAT "%5.3" /end CHARACTERISTIC
/begin CHARACTERISTIC FIMHU "Faktor Impuls hart" CURVE 0x811179 FklWUb 1.992 fak_ub_b2 0.00 1.992 FORMAT "%5.3"
 /begin AXIS_DESCR FIX_AXIS anzwefim dez 16 0.00 15.00 FORMAT "%5.2" FIX_AXIS_PAR 0 0 16 /end AXIS_DESCR
/end CHARACTERISTIC
/begin CHARACTERISTIC FIMWU "Faktor Impuls weich" CURVE 0x811189 FklWUb 1.992 fak_ub_b2 0.00 1.992 FORMAT "%5.3"
 /begin AXIS_DESCR FIX_AXIS anzwefim dez 16 0.00 15.00 FORMAT "%5.2" FIX_AXIS_PAR 0 0 16 /end AXIS_DESCR
/end CHARACTERISTIC
/begin CHARACTERISTIC FKUKAO "Obergrenze Korrekturfaktor in UK-Adaption" VALUE 0x81119D KwUb 3.984 fak_ub_b4 0.00 3.984 FORMAT "%5.3" /end CHARACTERISTIC
/begin CHARACTERISTIC FKUKAU "Untergrenze Korrekturfaktor in UK-Adaption" VALUE 0x81119E KwUb 3.875 fak_ub_b4 0.1094 3.984 FORMAT "%5.3" /end CHARACTERISTIC
/begin CHARACTERISTIC FLAMSBA "Faktor Lambdasoll bei Beschleunigungsanreicherung" VALUE 0x815716 KwUw 15.99976 fak_uw_b16 0.00 15.99976 FORMAT "%8.5" /end CHARACTERISTIC
/begin CHARACTERISTIC FLAMSVA "Faktor Lambdasoll bei Verzögerungsabmagerung" VALUE 0x815718 KwUw 15.99976 fak_uw_b16 0.00 15.99976 FORMAT "%8.5" /end CHARACTERISTIC
/begin CHARACTERISTIC FMFKRB0 "Filtermittenfrequenz Bereich 0" VALUE 0x81962C KwUb 255.0 fmfkr_dez 0.00 255.0 FORMAT "%5.1" /end CHARACTERISTIC
/begin CHARACTERISTIC FMFKRB1 "Filtermittenfrequenz Bereich 1" VALUE 0x81962D KwUb 255.0 fmfkr_dez 0.00 255.0 FORMAT "%5.1" /end CHARACTERISTIC
/begin CHARACTERISTIC FMFKRB2 "Filtermittenfrequenz Bereich 2" VALUE 0x81962E KwUb 255.0 fmfkr_dez 0.00 255.0 FORMAT "%5.1" /end CHARACTERISTIC
/begin CHARACTERISTIC FMFKRB3 "Filtermittenfrequenz Bereich 3" VALUE 0x81962F KwUb 255.0 fmfkr_dez 0.00 255.0 FORMAT "%5.1" /end CHARACTERISTIC
/begin CHARACTERISTIC FPLMRM "Wichtungsfaktor für P-Anteil Luftmassenregler" CURVE 0x810D3C KlAUbSstUbWUb 0.9961 fak_ub_b1 0.00 0.9961
 /begin AXIS_DESCR STD_AXIS tmot temp_ub_q0p75_o48 6 -48.00 143.3 FORMAT "%5.1" DEPOSIT ABSOLUTE /end AXIS_DESCR
/end CHARACTERISTIC
/begin CHARACTERISTIC FPWDKAPP "Drosselklappenkennlinie abh. von Fahrpedal nur f. Applik." CURVE 0x81508A KlAUwSstUwWUw 99.99847 rel_uw_b100 0.00 99.99847 FORMAT "%8.5"
 /begin AXIS_DESCR STD_AXIS wped_w relPED_uw_b100 16 0.00 100.0000 FORMAT "%8.4" DEPOSIT ABSOLUTE /end AXIS_DESCR
/end CHARACTERISTIC
/begin CHARACTERISTIC FSWKB "Beschleunigungsschwelle der Setzwertkorrektur" VALUE 0x81C0BC KwUw 19.99969 rel_uw_b20 0.00 19.99969 FORMAT "%8.5" /end CHARACTERISTIC
/begin CHARACTERISTIC FSWKV "Verzögerungsschwelle der Setzwertkorrektur" VALUE 0x81C0BE KwUw 19.99969 rel_uw_b20 0.00 19.99969 FORMAT "%8.5" /end CHARACTERISTIC
/begin CHARACTERISTIC FUEPMLD "Faktor für gleitender Übergang Druckmittelwert(Referenzdruck) beim Turbo" CURVE 0x81CBF2 KlAUwSstSwWUw 0.9999847 fak_uw_b1 0.00 0.9999847 FORMAT "%9.7"
 /begin AXIS_DESCR STD_AXIS lditv_w tv_sw_q0p005 4 -163.8400 163.8350 FORMAT "%8.4" DEPOSIT ABSOLUTE /end AXIS_DESCR
/end CHARACTERISTIC
/begin CHARACTERISTIC FUKABAKI "Init.-Wert adaptiver ÜK-Korrekturfaktor BA für kalten Motor" VALUE 0x81119F KwUb 3.984 fak_ub_b4 0.00 3.984 FORMAT "%5.3" /end CHARACTERISTIC
/begin CHARACTERISTIC FUKABAKO "Obergrenze adaptiver ÜK-Korrekturfaktor BA bei kaltem Motor" VALUE 0x8111A0 KwUb 3.984 fak_ub_b4 0.00 3.984 FORMAT "%5.3" /end CHARACTERISTIC
/begin CHARACTERISTIC FUKABAKU "Untergrenze adaptiver ÜK-Korrekturfaktor BA bei kaltem Motor" VALUE 0x8111A1 KwUb 3.875 fak_ub_b4 0.1094 3.984 FORMAT "%5.3" /end CHARACTERISTIC
/begin CHARACTERISTIC FUKABAWI "Init.-Wert adaptiver ÜK-Korrekturfaktor BA für warmen Motor" VALUE 0x8111A2 KwUb 3.984 fak_ub_b4 0.00 3.984 FORMAT "%5.3" /end CHARACTERISTIC
/begin CHARACTERISTIC FUKABAWO "Obergrenze adaptiver ÜK-Korrekturfaktor BA bei warmem Motor" VALUE 0x8111A3 KwUb 3.984 fak_ub_b4 0.00 3.984 FORMAT "%5.3" /end CHARACTERISTIC
/begin CHARACTERISTIC FUKABAWU "Untergrenze adaptiver ÜK-Korrekturfaktor BA bei warmem Motor" VALUE 0x8111A4 KwUb 3.875 fak_ub_b4 0.1094 3.984 FORMAT "%5.3" /end CHARACTERISTIC
/begin CHARACTERISTIC FUKAVAKI "Init.-Wert adaptiver ÜK-Korrekturfaktor VA für kalten Motor" VALUE 0x8111A5 KwUb 3.984 fak_ub_b4 0.00 3.984 FORMAT "%5.3" /end CHARACTERISTIC
/begin CHARACTERISTIC FUKAVAKO "Obergrenze adaptiver ÜK-Korrekturfaktor VA bei kaltem Motor" VALUE 0x8111A6 KwUb 3.984 fak_ub_b4 0.00 3.984 FORMAT "%5.3" /end CHARACTERISTIC
/begin CHARACTERISTIC FUKAVAKU "Untergrenze adaptiver ÜK-Korrekturfaktor VA bei kaltem Motor" VALUE 0x8111A7 KwUb 3.875 fak_ub_b4 0.1094 3.984 FORMAT "%5.3" /end CHARACTERISTIC
/begin CHARACTERISTIC FUKAVAWI "Init.-Wert adaptiver ÜK-Korrekturfaktor VA für warmen Motor" VALUE 0x8111A8 KwUb 3.984 fak_ub_b4 0.00 3.984 FORMAT "%5.3" /end CHARACTERISTIC
/begin CHARACTERISTIC FUKAVAWO "Obergrenze adaptiver ÜK-Korrekturfaktor VA bei warmem Motor" VALUE 0x8111A9 KwUb 3.984 fak_ub_b4 0.00 3.984 FORMAT "%5.3" /end CHARACTERISTIC
/begin CHARACTERISTIC FUKAVAWU "Untergrenze adaptiver ÜK-Korrekturfaktor VA bei warmem Motor" VALUE 0x8111AA KwUb 3.875 fak_ub_b4 0.1094 3.984 FORMAT "%5.3" /end CHARACTERISTIC
/begin CHARACTERISTIC FUKE "Faktor ÜK-Ersatzwert" VALUE 0x8156CC KwUw 7.999878 fak_uw_b8 0.00 7.999878 FORMAT "%8.6" /end CHARACTERISTIC
/begin CHARACTERISTIC FUKNSTHO "Hoehenfaktor ÜK im Nachstart" CURVE 0x8190B6 KlAUbSstUbWUb 1.992 fak_ub_b2 0.00 1.992 FORMAT "%5.3"
 /begin AXIS_DESCR STD_AXIS fho fak_ub_b4 6 0.00 3.984 FORMAT "%5.3" DEPOSIT ABSOLUTE /end AXIS_DESCR
/end CHARACTERISTIC
/begin CHARACTERISTIC FUKNSTM "Startwert Faktor ÜK im Nachstart" CURVE 0x8190C3 KlAUbSstUbWUb 3.984 fak_ub_b4 0.00 3.984 FORMAT "%5.3"
 /begin AXIS_DESCR STD_AXIS tmst temp_ub_q0p75_o48 9 -48.00 143.3 FORMAT "%5.1" DEPOSIT ABSOLUTE /end AXIS_DESCR
/end CHARACTERISTIC
/begin CHARACTERISTIC FVANST "Gewichtungsfaktor VA im Nachstart" VALUE 0x81119A KwUb 1.992 fak_ub_b2 0.00 1.992 FORMAT "%5.3" /end CHARACTERISTIC
/begin CHARACTERISTIC FVFKUKA "Gewichtung des Korrekturfaktors in UK-Adaption" VALUE 0x8111AB KwUb 7.969 fak_ub_b8 0.00 7.969 FORMAT "%5.3" /end CHARACTERISTIC
/begin CHARACTERISTIC FWEMRFA "Faktor Wiedereinsetzmenge über Fahrerwunschmoment" CURVE 0x8156B6 KlAUwSstUwWUb 1.992 fak_ub_b2 0.00 1.992 FORMAT "%5.3"
 /begin AXIS_DESCR STD_AXIS mrfa_w rel_uw_b200 6 0.00 199.9969 FORMAT "%8.4" DEPOSIT ABSOLUTE /end AXIS_DESCR
/end CHARACTERISTIC
/begin CHARACTERISTIC FWET "Faktor Wiedereinsetzmenge temperaturabhaengig" CURVE 0x818FEB KlAUbSstUbWUb 1.992 fak_ub_b2 0.00 1.992 FORMAT "%5.3"
 /begin AXIS_DESCR STD_AXIS tmot temp_ub_q0p75_o48 9 -48.00 143.3 FORMAT "%5.1" DEPOSIT ABSOLUTE /end AXIS_DESCR
/end CHARACTERISTIC
/begin CHARACTERISTIC FWFN "Faktor Wandfilm Drehzahleinfluss" VALUE 0x8156CE KwSw 2.999954 rel_sw_b1p5 -1.500000 1.499954 FORMAT "%8.6" /end CHARACTERISTIC
/begin CHARACTERISTIC ILMRMN "Minimalwert des Luftmassenreglers" VALUE 0x81500A KwSw 1535.977 rel_sw_q0p0234 -768.0000 767.9766 FORMAT "%8.4" /end CHARACTERISTIC
/begin CHARACTERISTIC ILMRMX "Maximalwert des Luftmassenreglers" VALUE 0x81500C KwSw 1535.977 rel_sw_q0p0234 -768.0000 767.9766 FORMAT "%8.4" /end CHARACTERISTIC
/begin CHARACTERISTIC ILMRN "Integratorverstärkung von Luftmassenregler" CURVE 0x818B10 GklWUb 7.969 fak_ub_b8 0.00 7.969 FORMAT "%5.3"
 /begin AXIS_DESCR COM_AXIS nmot nmot_ub_q40 8 0.00 10200. AXIS_PTS_REF SNM08FEUB /end AXIS_DESCR
/end CHARACTERISTIC
/begin CHARACTERISTIC KEMLN "Messfensterlänge für Klopfregelung" CURVE 0x819630 GklWUb 191.3 zw_ub_q0p75 0.00 191.3 FORMAT "%5.1"
 /begin AXIS_DESCR COM_AXIS nmot nmot_ub_q40 16 0.00 10200. AXIS_PTS_REF SNM16KRUB /end AXIS_DESCR
/end CHARACTERISTIC
/begin CHARACTERISTIC KFABAK "Aufteilungsfaktor Wandfilm bei BA" MAP 0x8190D6 GkfWUb 0.9961 fak_ub_b1 0.00 0.9961
 /begin AXIS_DESCR COM_AXIS tmot temp_ub_q0p75_o48 9 -48.00 143.3 AXIS_PTS_REF STM09ESUB /end AXIS_DESCR
 /begin AXIS_DESCR COM_AXIS nmot nmot_ub_q40 7 0.00 10200. AXIS_PTS_REF SNM07ESUB /end AXIS_DESCR
/end CHARACTERISTIC
/begin CHARACTERISTIC KFAVAK "Aufteilungsfaktor Wandfilm bei VA" MAP 0x819115 GkfWUb 0.9961 fak_ub_b1 0.00 0.9961
 /begin AXIS_DESCR COM_AXIS tmot temp_ub_q0p75_o48 9 -48.00 143.3 AXIS_PTS_REF STM09ESUB /end AXIS_DESCR
 /begin AXIS_DESCR COM_AXIS nmot nmot_ub_q40 7 0.00 10200. AXIS_PTS_REF SNM07ESUB /end AXIS_DESCR
/end CHARACTERISTIC
/begin CHARACTERISTIC KFBAKL "Faktor Beschleunigungsanreicherung (K+L-Anteil)" MAP 0x819154 GkfWUb 15.94 fak_ub_b16 0.00 15.94 FORMAT "%5.2"
 /begin AXIS_DESCR COM_AXIS tmot temp_ub_q0p75_o48 9 -48.00 143.3 AXIS_PTS_REF STM09ESUB /end AXIS_DESCR
 /begin AXIS_DESCR COM_AXIS nmot nmot_ub_q40 7 0.00 10200. AXIS_PTS_REF SNM07ESUB /end AXIS_DESCR
/end CHARACTERISTIC
/begin CHARACTERISTIC KFBALB "Faktor Beschleunigungsanreicherung Ladebereich" MAP 0x819193 KfAxUbAyUbSstxUbSstyUbWUb 3.984 fak_q0p015625 0.00 3.984 FORMAT "%5.3"
 /begin AXIS_DESCR STD_AXIS nmot nmot_ub_q40 6 0.00 10200. FORMAT "%5.0" DEPOSIT ABSOLUTE /end AXIS_DESCR
 /begin AXIS_DESCR STD_AXIS rlp rel_ub_q0p75 6 0.00 191.3 FORMAT "%5.1" DEPOSIT ABSOLUTE /end AXIS_DESCR
/end CHARACTERISTIC
/begin CHARACTERISTIC KFBRAWA_0_A "Sollbeschleunigung bei Wiederaufnahme" MAP 0x81C0C0 KfAxUwAyUwSstxUwSstyUwWUw 27.7802865 bfzg_sw_q4p239Em4 0.00 27.7802865
 /begin AXIS_DESCR STD_AXIS vfgr_w vfzg_uw_b512 8 0.00 511.9922 FORMAT "%8.4" DEPOSIT ABSOLUTE /end AXIS_DESCR
 /begin AXIS_DESCR STD_AXIS dvzi_w vfzg_uw_q0p0078125 6 0.00 511.9922 FORMAT "%8.4" DEPOSIT ABSOLUTE /end AXIS_DESCR
/end CHARACTERISTIC
/begin CHARACTERISTIC KFBRAWA_1_A "Sollbeschleunigung bei Wiederaufnahme" MAP 0x81C140 KfAxUwAyUwSstxUwSstyUwWUw 27.7802865 bfzg_sw_q4p239Em4 0.00 27.7802865
 /begin AXIS_DESCR STD_AXIS vfgr_w vfzg_uw_b512 8 0.00 511.9922 FORMAT "%8.4" DEPOSIT ABSOLUTE /end AXIS_DESCR
 /begin AXIS_DESCR STD_AXIS dvzi_w vfzg_uw_q0p0078125 6 0.00 511.9922 FORMAT "%8.4" DEPOSIT ABSOLUTE /end AXIS_DESCR
/end CHARACTERISTIC
/begin CHARACTERISTIC KFFWL_0_A "Kennfeld Warmlauffaktor" MAP 0x818E21 GkfWUb 1.992 fak_ub_b2 0.00 1.992 FORMAT "%5.3"
 /begin AXIS_DESCR COM_AXIS tmot temp_ub_q0p75_o48 12 -48.00 143.3 AXIS_PTS_REF STM12ESUB /end AXIS_DESCR
 /begin AXIS_DESCR COM_AXIS tmst temp_ub_q0p75_o48 12 -48.00 143.3 AXIS_PTS_REF STS12ESUB /end AXIS_DESCR
/end CHARACTERISTIC
/begin CHARACTERISTIC KFFWL_1_A "Kennfeld Warmlauffaktor" MAP 0x818EB1 GkfWUb 1.992 fak_ub_b2 0.00 1.992 FORMAT "%5.3"
 /begin AXIS_DESCR COM_AXIS tmot temp_ub_q0p75_o48 12 -48.00 143.3 AXIS_PTS_REF STM12ESUB /end AXIS_DESCR
 /begin AXIS_DESCR COM_AXIS tmst temp_ub_q0p75_o48 12 -48.00 143.3 AXIS_PTS_REF STS12ESUB /end AXIS_DESCR
/end CHARACTERISTIC
/begin CHARACTERISTIC KFFWLW "Kennfeld Wichtung Warmlauffaktor" MAP 0x811028 GkfWUb 0.9961 fak_ub_b1 0.00 0.9961
 /begin AXIS_DESCR COM_AXIS nmot nmot_ub_q40 12 0.00 10200. AXIS_PTS_REF SNM12ESUB /end AXIS_DESCR
 /begin AXIS_DESCR COM_AXIS rl rel_ub_q0p75 12 0.00 191.3 AXIS_PTS_REF SRL12ESUB /end AXIS_DESCR
/end CHARACTERISTIC
/begin CHARACTERISTIC KFFWLWKH "Kennfeld Wichtung Warmlauffaktor bei Katheizen" MAP 0x8110B8 GkfWSb 0.996093750 fak_sb_b0p5 -0.500000000 0.496093750 FORMAT "%11.9"
 /begin AXIS_DESCR COM_AXIS nmot nmot_ub_q40 12 0.00 10200. AXIS_PTS_REF SNM12ESUB /end AXIS_DESCR
 /begin AXIS_DESCR COM_AXIS rl rel_ub_q0p75 12 0.00 191.3 AXIS_PTS_REF SRL12ESUB /end AXIS_DESCR
/end CHARACTERISTIC
/begin CHARACTERISTIC KFKHFM "Korrekturkennfeld für HFM" MAP 0x810C4A KfAxUbAyUbSstxUbSstyUbWUb 1.992 fak_ub_b2 0.00 1.992 FORMAT "%5.3"
 /begin AXIS_DESCR STD_AXIS nmot nmot_ub_q40 14 0.00 10200. FORMAT "%5.0" DEPOSIT ABSOLUTE /end AXIS_DESCR
 /begin AXIS_DESCR STD_AXIS rl rel_ub_q0p75 14 0.00 191.3 FORMAT "%5.1" DEPOSIT ABSOLUTE /end AXIS_DESCR
/end CHARACTERISTIC
/begin CHARACTERISTIC KFLASWLR "Kennfeld Lambda-Motor-Soll im Warmlauf bei aktiver LR" MAP 0x818F41 GkfWUb 1.992 fak_ub_b2 0.00 1.992 FORMAT "%5.3"
 /begin AXIS_DESCR COM_AXIS tmot temp_ub_q0p75_o48 12 -48.00 143.3 AXIS_PTS_REF STM12ESUB /end AXIS_DESCR
 /begin AXIS_DESCR COM_AXIS tmst temp_ub_q0p75_o48 12 -48.00 143.3 AXIS_PTS_REF STS12ESUB /end AXIS_DESCR
/end CHARACTERISTIC
/begin CHARACTERISTIC KFLDFK "Ladedruck Filterkonstante" MAP 0x814FC2 KfAxUwAyUwSstxUwSstyUwWUw 655.34999985 zk10msxs_uw_b655 0.010000152590 655.36000000 FORMAT "%12.8"
 /begin AXIS_DESCR STD_AXIS nmot_w nmot_uw_q0p25 4 0.00 16383.75 FORMAT "%8.2" DEPOSIT ABSOLUTE /end AXIS_DESCR
 /begin AXIS_DESCR STD_AXIS psspvdkd_w fak_uw_b4 6 0.00 3.999939 FORMAT "%8.6" DEPOSIT ABSOLUTE /end AXIS_DESCR
/end CHARACTERISTIC
/begin CHARACTERISTIC KFMAKR "Kennfeld Meßfensteranfang Klopfregelung" MAP 0x819640 GkfWUb 191.3 zw_ub_q0p75 0.00 191.3 FORMAT "%5.1"
 /begin AXIS_DESCR COM_AXIS nmot nmot_ub_q40 16 0.00 10200. AXIS_PTS_REF SNM16KRUB /end AXIS_DESCR
 /begin AXIS_DESCR COM_AXIS rl rel_ub_q0p75 4 0.00 191.3 AXIS_PTS_REF SRL04KRUB /end AXIS_DESCR
/end CHARACTERISTIC
/begin CHARACTERISTIC KFPLMR "P-Anteil von Luftmassenregler" MAP 0x81500E KfAxUbAyUbSstxSwSstyUbWSw 1535.977 rel_sw_q0p0234 -768.0000 767.9766 FORMAT "%8.4"
 /begin AXIS_DESCR STD_AXIS drlm_w rel_sw_q0p0234 8 -768.0000 767.9766 FORMAT "%8.4" DEPOSIT ABSOLUTE /end AXIS_DESCR
 /begin AXIS_DESCR STD_AXIS nmotll nmot_ub_q10 6 0.00 2550. FORMAT "%5.0" DEPOSIT ABSOLUTE /end AXIS_DESCR
/end CHARACTERISTIC
/begin CHARACTERISTIC KFVAKL "Faktor Verzögerungsabmagerung (K+L-Anteil)" MAP 0x8191C5 GkfWUb 15.94 fak_ub_b16 0.00 15.94 FORMAT "%5.2"
 /begin AXIS_DESCR COM_AXIS tmot temp_ub_q0p75_o48 9 -48.00 143.3 AXIS_PTS_REF STM09ESUB /end AXIS_DESCR
 /begin AXIS_DESCR COM_AXIS nmot nmot_ub_q40 7 0.00 10200. AXIS_PTS_REF SNM07ESUB /end AXIS_DESCR
/end CHARACTERISTIC
/begin CHARACTERISTIC KFVALDIF "Wichtungsfaktor Verzögerungsabmagerung für Lambdaist > 1.0" MAP 0x819204 GkfWUb 0.9961 fak_ub_b1 0.00 0.9961
 /begin AXIS_DESCR COM_AXIS tmot temp_ub_q0p75_o48 9 -48.00 143.3 AXIS_PTS_REF STM09ESUB /end AXIS_DESCR
 /begin AXIS_DESCR COM_AXIS ladiff_w fak_sw_b1 5 0.00 1.999969 AXIS_PTS_REF SLA05ESUB /end AXIS_DESCR
/end CHARACTERISTIC
/begin CHARACTERISTIC KFVAWLA "Wichtung VA über lamsbg" MAP 0x81D1A4 KfAxUbAyUbSstxUbSstyUbWUb 3.984 fak_ub_b4 0.00 3.984 FORMAT "%5.3"
 /begin AXIS_DESCR STD_AXIS tmot temp_ub_q0p75_o48 3 -48.00 143.3 FORMAT "%5.1" DEPOSIT ABSOLUTE /end AXIS_DESCR
 /begin AXIS_DESCR STD_AXIS lamsbguk fak_ub_b4 3 0.00 3.984 FORMAT "%5.3" DEPOSIT ABSOLUTE /end AXIS_DESCR
/end CHARACTERISTIC
/begin CHARACTERISTIC KFVOFFS_0_A "Geschwindigkeits-Offset für FGR-Regler" MAP 0x81C1DE KfAxUwAyUwSstxUwSstyUwWUw 511.9922 vfzg_uw_q0p0078125 0.00 511.9922 FORMAT "%8.4"
 /begin AXIS_DESCR STD_AXIS vfgro_w vfzg_uw_q0p0078125 6 0.00 511.9922 FORMAT "%8.4" DEPOSIT ABSOLUTE /end AXIS_DESCR
 /begin AXIS_DESCR STD_AXIS uevges_w fak_q0p1 8 0.00 6553.500 FORMAT "%8.3" DEPOSIT ABSOLUTE /end AXIS_DESCR
/end CHARACTERISTIC
/begin CHARACTERISTIC KFVOFFS_1_A "Geschwindigkeits-Offset für FGR-Regler" MAP 0x81C25E KfAxUwAyUwSstxUwSstyUwWUw 511.9922 vfzg_uw_q0p0078125 0.00 511.9922 FORMAT "%8.4"
 /begin AXIS_DESCR STD_AXIS vfgro_w vfzg_uw_q0p0078125 6 0.00 511.9922 FORMAT "%8.4" DEPOSIT ABSOLUTE /end AXIS_DESCR
 /begin AXIS_DESCR STD_AXIS uevges_w fak_q0p1 8 0.00 6553.500 FORMAT "%8.3" DEPOSIT ABSOLUTE /end AXIS_DESCR
/end CHARACTERISTIC
/begin CHARACTERISTIC KFWDKMSN "Kennfeld für Drosselklappen-Sollwinkel" MAP 0x81CC04 KfAxUwAyUwSstxUwSstyUwWUw 99.99847 rel_uw_b100 0.00 99.99847 FORMAT "%8.5"
 /begin AXIS_DESCR STD_AXIS mlwdknf_w m_uw_b6553p5 16 0.00 6553.500 FORMAT "%8.3" DEPOSIT ABSOLUTE /end AXIS_DESCR
 /begin AXIS_DESCR STD_AXIS nmot_w nmot_uw_q0p25 6 0.00 16383.75 FORMAT "%8.2" DEPOSIT ABSOLUTE /end AXIS_DESCR
/end CHARACTERISTIC
/begin CHARACTERISTIC KFWDKPP "Ersatzwert für Drosselklappenwinkel aus Füllungssignal" MAP 0x810A77 KfAxUbAyUbSstxUbSstyUbWUb 100.0 relDK_ub_b100 0.00 100.0 FORMAT "%5.1"
 /begin AXIS_DESCR STD_AXIS nmot nmot_ub_q40 12 0.00 10200. FORMAT "%5.0" DEPOSIT ABSOLUTE /end AXIS_DESCR
 /begin AXIS_DESCR STD_AXIS rlvppl rel_ub_q0p75 12 0.00 191.3 FORMAT "%5.1" DEPOSIT ABSOLUTE /end AXIS_DESCR
/end CHARACTERISTIC
/begin CHARACTERISTIC KFWDKSMX "maximaler Solldrosselklappenwinkel" MAP 0x8150CC KfAxUwAyUwSstxUwSstyUwWUw 99.99847 rel_uw_b100 0.00 99.99847 FORMAT "%8.5"
 /begin AXIS_DESCR STD_AXIS nmot_w nmot_uw_q0p25 10 0.00 16383.75 FORMAT "%8.2" DEPOSIT ABSOLUTE /end AXIS_DESCR
 /begin AXIS_DESCR STD_AXIS fho_w fak_uw_b4 3 0.00 3.999939 FORMAT "%8.6" DEPOSIT ABSOLUTE /end AXIS_DESCR
/end CHARACTERISTIC
/begin CHARACTERISTIC KFWEE "Kennfeld Winkel Einspritzende" MAP 0x818D0D GkfWUb 1530. zw_ub_q6 0.00 1530. FORMAT "%5.0"
 /begin AXIS_DESCR COM_AXIS rl rel_ub_q0p75 8 0.00 191.3 AXIS_PTS_REF SRL08GKUB /end AXIS_DESCR
 /begin AXIS_DESCR COM_AXIS nmot nmot_ub_q40 8 0.00 10200. AXIS_PTS_REF SNM08GKUB /end AXIS_DESCR
/end CHARACTERISTIC
/begin CHARACTERISTIC KFWEEK "Kennfeld-Kalt Winkel Einspritzende" MAP 0x818D4D GkfWUb 1530. zw_ub_q6 0.00 1530. FORMAT "%5.0"
 /begin AXIS_DESCR COM_AXIS rl rel_ub_q0p75 8 0.00 191.3 AXIS_PTS_REF SRL08GKUB /end AXIS_DESCR
 /begin AXIS_DESCR COM_AXIS nmot nmot_ub_q40 8 0.00 10200. AXIS_PTS_REF SNM08GKUB /end AXIS_DESCR
/end CHARACTERISTIC
/begin CHARACTERISTIC KFWEEST "Kennfeld Winkel Einspritzende während Start" MAP 0x810DDB KfAxUbAyUbSstxUbSstyUbWUb 1530. zw_ub_q6 0.00 1530. FORMAT "%5.0"
 /begin AXIS_DESCR STD_AXIS tmot temp_ub_q0p75_o48 8 -48.00 143.3 FORMAT "%5.1" DEPOSIT ABSOLUTE /end AXIS_DESCR
 /begin AXIS_DESCR STD_AXIS anztib dez 8 0.00 255.0 FORMAT "%5.1" DEPOSIT ABSOLUTE /end AXIS_DESCR
/end CHARACTERISTIC
/begin CHARACTERISTIC KFWEETM "Kennfeld Winkel Einspritzende Temperaturkorrektur" MAP 0x81D008 KfAxUbAyUbSstxUbSstyUbWSb 1530. zw_sb_q6 -768.0 762.0 FORMAT "%5.1"
 /begin AXIS_DESCR STD_AXIS tmot temp_ub_q0p75_o48 8 -48.00 143.3 FORMAT "%5.1" DEPOSIT ABSOLUTE /end AXIS_DESCR
 /begin AXIS_DESCR STD_AXIS rl rel_ub_q0p75 6 0.00 191.3 FORMAT "%5.1" DEPOSIT ABSOLUTE /end AXIS_DESCR
/end CHARACTERISTIC
/begin CHARACTERISTIC KFWLHO "Kennfeld für Höhenabhängigkeit des Warmlauffaktors" MAP 0x811148 GkfWUb 3.984 fak_ub_b4 0.00 3.984 FORMAT "%5.3" /begin AXIS_DESCR COM_AXIS fho fak_ub_b4 4 0.00 3.984 AXIS_PTS_REF FHO04ESUB /end AXIS_DESCR
 /begin AXIS_DESCR COM_AXIS rl rel_ub_q0p75 12 0.00 191.3 AXIS_PTS_REF SRL12ESUB /end AXIS_DESCR
/end CHARACTERISTIC
/begin CHARACTERISTIC KKFFGRGA_0_A "Verstärkungsfaktor bei Konstantfahrt für FGR-Regler" CURVE 0x81C2DE KlAUwSstUwWUw 3199.951 rel_uw_b3200 0.00 3199.951 FORMAT "%8.3"
 /begin AXIS_DESCR STD_AXIS uevges_w fak_q0p1 8 0.00 6553.500 FORMAT "%8.3" DEPOSIT ABSOLUTE /end AXIS_DESCR
/end CHARACTERISTIC
/begin CHARACTERISTIC KKFFGRGA_1_A "Verstärkungsfaktor bei Konstantfahrt für FGR-Regler" CURVE 0x81C300 KlAUwSstUwWUw 3199.951 rel_uw_b3200 0.00 3199.951 FORMAT "%8.3"
 /begin AXIS_DESCR STD_AXIS uevges_w fak_q0p1 8 0.00 6553.500 FORMAT "%8.3" DEPOSIT ABSOLUTE /end AXIS_DESCR
/end CHARACTERISTIC
/begin CHARACTERISTIC KLDFAB "Gradientenbegrenzung für kldfpwm" VALUE 0x810056 KwUb 99.22 rel_ub_b99p6 0.3906 99.61 FORMAT "%5.2" /end CHARACTERISTIC
/begin CHARACTERISTIC KLDMASRL "Stellreserve bei ASR-Eingriff" CURVE 0x81018E KlAUbSstUbWUb 99.61 rel_ub_b99p6 0.00 99.61 FORMAT "%5.2"
 /begin AXIS_DESCR STD_AXIS nmot nmot_ub_q40 5 0.00 10200. FORMAT "%5.0" DEPOSIT ABSOLUTE /end AXIS_DESCR
/end CHARACTERISTIC
/begin CHARACTERISTIC KLDPDK "Druckabfall über Drosselklappe" CURVE 0x81CCF4 KlAUwSstUwWUw 2559.961 p_uw_q0p039 0.00 2559.961 FORMAT "%8.3"
 /begin AXIS_DESCR STD_AXIS mlkge_w m_uw_b6553p5 16 0.00 6553.500 FORMAT "%8.3" DEPOSIT ABSOLUTE /end AXIS_DESCR
/end CHARACTERISTIC
/begin CHARACTERISTIC KLTDS "Konvertierungskennlinie für Tankdrucksensor DS-T2" CURVE 0x817088 KlASwSstSwWSw 64.02769 p_sw_q0p000977 -32.01434 32.01336 FORMAT "%8.5"
 /begin AXIS_DESCR STD_AXIS pterw_w p_sw_q0p00244 6 -80.00000 79.99756 FORMAT "%8.5" DEPOSIT ABSOLUTE /end AXIS_DESCR
/end CHARACTERISTIC
/begin CHARACTERISTIC KRAFGRGA_0_A "Verstärkungsfaktor bei Rampe für FGR-Regler" CURVE 0x81C322 KlAUwSstUwWUw 3199.951 rel_uw_b3200 0.00 3199.951 FORMAT "%8.3"
 /begin AXIS_DESCR STD_AXIS uevges_w fak_q0p1 8 0.00 6553.500 FORMAT "%8.3" DEPOSIT ABSOLUTE /end AXIS_DESCR
/end CHARACTERISTIC
/begin CHARACTERISTIC KRAFGRGA_1_A "Verstärkungsfaktor bei Rampe für FGR-Regler" CURVE 0x81C344 KlAUwSstUwWUw 3199.951 rel_uw_b3200 0.00 3199.951 FORMAT "%8.3"
 /begin AXIS_DESCR STD_AXIS uevges_w fak_q0p1 8 0.00 6553.500 FORMAT "%8.3" DEPOSIT ABSOLUTE /end AXIS_DESCR
/end CHARACTERISTIC
/begin CHARACTERISTIC LADIFFVA "Schwelle für Wichtungsfaktor Verzögerungsabmagerung für Lambdaist > 1.0" VALUE 0x8156D0 KwSw 1.999969 fak_sw_b1 -1.000000 0.9999695 FORMAT "%8.6" /end CHARACTERISTIC
/begin CHARACTERISTIC LASWLTM "Offset Lambda-Motor-Soll bei inaktiver Lambdaregelung" CURVE 0x818FD1 GklWSb 1.992 fak_sb_b1 -1.000 0.9922 FORMAT "%5.3"
 /begin AXIS_DESCR COM_AXIS tmot temp_ub_q0p75_o48 12 -48.00 143.3 AXIS_PTS_REF STM12ESUB /end AXIS_DESCR
/end CHARACTERISTIC
/begin CHARACTERISTIC MLHFM "Linearisierung der Heißfilmspannung" CURVE 0x81466E FklNoOffWUw 6553.500 m_uw_b6553p5 0.00 6553.500 FORMAT "%8.3"
 /begin AXIS_DESCR FIX_AXIS uhfm_w spg_uw_q0p00488 512 0.00 4.995117 FORMAT "%8.6" FIX_AXIS_PAR 0 1 512 /end AXIS_DESCR
/end CHARACTERISTIC
/begin CHARACTERISTIC MLMIN "minimale HFM-Luftmasse" VALUE 0x814A6E KwSw 6553.500 m_sw_b3276p8 -3276.800 3276.700 FORMAT "%8.3" /end CHARACTERISTIC
/begin CHARACTERISTIC MLOFS "Kennlinienoffset HFM 5" VALUE 0x814A70 KwUw 6553.500 m_uw_b6553p5 0.00 6553.500 FORMAT "%8.3" /end CHARACTERISTIC
/begin CHARACTERISTIC MRFAVW "Schwelle zur Umschaltung des Vorlagerungswinkels bei max. Fahrerwunsches" CURVE 0x81D048 GklWUw 199.9969 rel_uw_b200 0.00 199.9969 FORMAT "%8.4"
 /begin AXIS_DESCR COM_AXIS nmot nmot_ub_q40 8 0.00 10200. AXIS_PTS_REF SNM08GKUB /end AXIS_DESCR
/end CHARACTERISTIC
/begin CHARACTERISTIC MRFGRIMX "Maximaler FGR-Initialisierungswert" CURVE 0x818A01 KlAUbSstUbWUb 199.2 rel_ub_b200 0.00 199.2 FORMAT "%5.1"
 /begin AXIS_DESCR STD_AXIS nmot nmot_ub_q40 6 0.00 10200. FORMAT "%5.0" DEPOSIT ABSOLUTE /end AXIS_DESCR
/end CHARACTERISTIC
/begin CHARACTERISTIC MRFGRLL "Schwelle relatives Moment vom Fahrgeschwindigkeitsregler für Erkennung Leerlauf" VALUE 0x81C366 KwUw 199.9969 rel_uw_b200 0.00 199.9969 FORMAT "%8.4" /end CHARACTERISTIC
/begin CHARACTERISTIC MRFGRMAX "Maximalwert für relatives Moment aus FGR" VALUE 0x81C368 KwUw 199.9969 rel_uw_b200 0.00 199.9969 FORMAT "%8.4" /end CHARACTERISTIC
/begin CHARACTERISTIC MRFGRSTA "Startwert für Relatives Moment bei Aktivierung FGR-Regler" VALUE 0x81C36A KwUw 199.9969 rel_uw_b200 0.00 199.9969 FORMAT "%8.4" /end CHARACTERISTIC
/begin CHARACTERISTIC MSRMDTMX "Größte zulässige Momenten-Zeit-Fläche bei der MSR-Topfplausibilisierung" VALUE 0x813306 KwSw 5111.922 mdt_sw_b2556 -2556.000 2555.922 FORMAT "%8.3" /end CHARACTERISTIC
/begin CHARACTERISTIC NDKPPU "Minimaldrehzahl für Plausibilisierung DK-Poti 2 nach unten im Normalbetrieb" VALUE 0x810B21 KwUb 10000. nmot_ub_q40 200.0 10200. FORMAT "%5.0" /end CHARACTERISTIC
/begin CHARACTERISTIC NDSVLO "obere Drehzahlschwelle für Signalvergleich Ladedruck mit Umgebungsdruck" VALUE 0x818A30 KwUb 10200. nmot_ub_q40 0.00 10200. FORMAT "%5.0" /end CHARACTERISTIC
/begin CHARACTERISTIC NDSVLU "Drehzahlschwelle für Signalvergleich Ladedruck mit Umgebungsdruck" VALUE 0x818A31 KwUb 10200. nmot_ub_q40 0.00 10200. FORMAT "%5.0" /end CHARACTERISTIC
/begin CHARACTERISTIC NFGRMIN "Min. zul. Drehzahl bei FGR-Betrieb" VALUE 0x8189B9 KwUb 10120. nmot_ub_q40 0.00 10120. FORMAT "%5.0" /end CHARACTERISTIC
/begin CHARACTERISTIC NKRFM1 "Drehzahlschwelle für Filtermittenfrequenz Bereich1" VALUE 0x819680 KwUb 10200. nmot_ub_q40 0.00 10200. FORMAT "%5.0" /end CHARACTERISTIC
/begin CHARACTERISTIC NKRFM2 "Drehzahlschwelle für Filtermittenfrequenz Bereich 2" VALUE 0x819681 KwUb 10200. nmot_ub_q40 0.00 10200. FORMAT "%5.0" /end CHARACTERISTIC
/begin CHARACTERISTIC NKRFM3 "Drehzahlschwelle für Filtermittenfrequenz Bereich 3" VALUE 0x819682 KwUb 10200. nmot_ub_q40 0.00 10200. FORMAT "%5.0" /end CHARACTERISTIC
/begin CHARACTERISTIC NMIN "Minimal Drehzahl" VALUE 0x813FBA KwUw 16383.75 nmot_uw_q0p25 0.00 16383.75 FORMAT "%8.2" /end CHARACTERISTIC
/begin CHARACTERISTIC NMOTDELAY "Wartezeit bis Motorstillstand erkannt" VALUE 0x81242B KwUb 2.550 t10msxs_ub_b2p55 0.00 2.550 FORMAT "%5.3" /end CHARACTERISTIC
/begin CHARACTERISTIC NMOTQSYN "Motordrehzahlschwelle zur Freigabe des Schnellstarts über PG Schnellstart" VALUE 0x813FBC KwUw 700.0000 nmot_uw_q0p25 0.00 700.0000 FORMAT "%8.4" /end CHARACTERISTIC
/begin CHARACTERISTIC NOASR "Wert für inaktiver ASR-Botschaft" VALUE 0x810199 KwUb 99.61 rel_ub_b99p6 0.00 99.61 FORMAT "%5.2" /end CHARACTERISTIC
/begin CHARACTERISTIC NRLMN "Minimaldrehzahl zur Berechnung von umsrln" VALUE 0x815126 KwUw 16383.75 nmot_ub_q0p25 0.00 16383.75 FORMAT "%8.2" /end CHARACTERISTIC
/begin CHARACTERISTIC NRLMNLLR "Minimaldrehzahl zur Berechnung von umsrln im LL" VALUE 0x815128 KwUw 16383.75 nmot_ub_q0p25 0.00 16383.75 FORMAT "%8.2" /end CHARACTERISTIC
/begin CHARACTERISTIC NUKAO "obere Drehzahlgrenze für ÜK-Adaption" VALUE 0x8111AC KwUb 10200. nmot_ub_q40 0.00 10200. FORMAT "%5.0" /end CHARACTERISTIC
/begin CHARACTERISTIC NUKAU "untere Drehzahlgrenze für ÜK-Adaption" VALUE 0x8111AD KwUb 10200. nmot_ub_q40 0.00 10200. FORMAT "%5.0" /end CHARACTERISTIC
/begin CHARACTERISTIC NVGDSLL "Drehzahlschwelle  für Drucksensorvergleich DSU/DSL im Leerlauf" VALUE 0x818A32 KwUb 10200. nmot_ub_q40 0.00 10200. FORMAT "%5.0" /end CHARACTERISTIC
/begin CHARACTERISTIC NWDK3 "Minimaldrehzahl für Berechnung DK-Winkel-Ersatzwert aus Füllungssignal" VALUE 0x810B22 KwUb 10000. nmot_ub_q40 200.0 10200. FORMAT "%5.0" /end CHARACTERISTIC
/begin CHARACTERISTIC OFQSYNADAP "Offset zwischen adaptierter Phasenflanke und Phasenflanke im Start" VALUE 0x813FBE KwSw 72.00000 kw_q0p0156 -36.00000 36.00000 FORMAT "%8.5" /end CHARACTERISTIC
/begin CHARACTERISTIC PH_MINSEG "Segmentlänge kurzes Segment beim Schnellstart-Phasengebersignal" VALUE 0x8109DB KwUb 90.00 kw_tooth_sy 0.00 90.00 FORMAT "%5.2" /end CHARACTERISTIC
/begin CHARACTERISTIC PLSOLAP "Applikationswert für Soll-Ladedruck" VALUE 0x81512A KwUw 2559.961 p_uw_q0p039 0.00 2559.961 FORMAT "%8.3" /end CHARACTERISTIC
/begin CHARACTERISTIC PUE "Ersatzwert für Umgebungsdruck" VALUE 0x81BF8A KwUw 2559.961 p_uw_q0p039 0.00 2559.961 FORMAT "%8.3" /end CHARACTERISTIC
/begin CHARACTERISTIC PUKANS "Pulsationskorrektur abhängig von Ansauglufttemperatur" CURVE 0x818A14 KlAUbSstUbWUb 1.992 fak_ub_b2 0.00 1.992 FORMAT "%5.3"
 /begin AXIS_DESCR STD_AXIS tans temp_ub_q0p75_o48 8 -48.00 143.3 FORMAT "%5.1" DEPOSIT ABSOLUTE /end AXIS_DESCR
/end CHARACTERISTIC
/begin CHARACTERISTIC PUMN "Umgebungsdruckbegrenzung minimal" VALUE 0x81BF8C KwUw 2559.961 p_uw_q0p039 0.00 2559.961 FORMAT "%8.3" /end CHARACTERISTIC
/begin CHARACTERISTIC PUMX "Umgebungsdruckbegrenzung maximal" VALUE 0x81BF8E KwUw 2559.961 p_uw_q0p039 0.00 2559.961 FORMAT "%8.3" /end CHARACTERISTIC
/begin CHARACTERISTIC PUSPSMX "max. Abweichung von Umgebungsdruck und Saugrohrdruck" VALUE 0x81BF90 KwUw 2559.961 p_uw_q0p039 0.00 2559.961 FORMAT "%8.3" /end CHARACTERISTIC
/begin CHARACTERISTIC PVDKMN "pvdk min. Schwelle für Fehlererkennung Ladedrucksensor" VALUE 0x81BF92 KwUw 2559.961 p_uw_q0p039 0.00 2559.961 FORMAT "%8.3" /end CHARACTERISTIC
/begin CHARACTERISTIC PVDKMX "Ladedruckgrenze für Diagnose max. Fehler" CURVE 0x81BF94 KlAUwSstUwWUw 2559.961 p_uw_q0p039 0.00 2559.961 FORMAT "%8.3"
 /begin AXIS_DESCR STD_AXIS nmot_w nmot_uw_q0p25 4 0.00 16383.75 FORMAT "%8.2" DEPOSIT ABSOLUTE /end AXIS_DESCR
/end CHARACTERISTIC
/begin CHARACTERISTIC PVDKPSMX "max. Abweichung von Saugrohrdruck und Druck vor Drosselklappe" VALUE 0x81BFA6 KwUw 2559.961 p_uw_q0p039 0.00 2559.961 FORMAT "%8.3" /end CHARACTERISTIC
/begin CHARACTERISTIC PVDKPUD "Schwelle unterhalb welcher die Diff. zw. pvdkds und pu als 0 ausgegeben wird" VALUE 0x818A33 KwUb 2550. p_ub_q10 0.00 2550. FORMAT "%5.0" /end CHARACTERISTIC
/begin CHARACTERISTIC RAMPASR "Rampensteilheit bei Aufregelung des ASR-Moments" VALUE 0x813308 KwUw 99.99695 rel_uw_b100 0.001525879 99.99847 FORMAT "%8.5" /end CHARACTERISTIC
/begin CHARACTERISTIC RKBAUM "rk-Schwelle für BA-Anzeige" CURVE 0x81D180 GklWSw 6143.813 rel_sw_q0p1875 0.00 6143.813 FORMAT "%8.3"
 /begin AXIS_DESCR COM_AXIS tmot temp_ub_q0p75_o48 9 -48.00 143.3 AXIS_PTS_REF STM09ESUB /end AXIS_DESCR
/end CHARACTERISTIC
/begin CHARACTERISTIC RKUKKLU "Schwelle Summe Kurz-/Langzeitanteil" VALUE 0x8156D2 KwSw 12287.81 rel_sw_q0p1875 -6144.000 6143.813 FORMAT "%8.3" /end CHARACTERISTIC
/begin CHARACTERISTIC RKUKKTU "Schwelle für Erkennung ÜK-Aktivität (Kurzzeitanteil)" VALUE 0x81571A KwSw 12287.81 rel_sw_q0p1875 -6144.000 6143.813 FORMAT "%8.3" /end CHARACTERISTIC
/begin CHARACTERISTIC RKVAUM "rk-Schwelle für VA-Anzeige" CURVE 0x81D192 GklWSw 6144.000 rel_sw_q0p1875 -6144.000 0.00 FORMAT "%8.3"
 /begin AXIS_DESCR COM_AXIS tmot temp_ub_q0p75_o48 9 -48.00 143.3 AXIS_PTS_REF STM09ESUB /end AXIS_DESCR
/end CHARACTERISTIC
/begin CHARACTERISTIC RLUKAO "obere Lastgrenze für ÜK-Adaption" VALUE 0x8111AE KwUb 191.3 rel_ub_q0p75 0.00 191.3 FORMAT "%5.1" /end CHARACTERISTIC
/begin CHARACTERISTIC RLUKAU "untere Lastgrenze für ÜK-Adaption" VALUE 0x8111AF KwUb 191.3 rel_ub_q0p75 0.00 191.3 FORMAT "%5.1" /end CHARACTERISTIC
/begin CHARACTERISTIC SENZZYL0 "Klopfsensor für SW-Zylinderzähler 0" VALUE 0x819683 KwUb 3.000 dezsub1 1.000 4.000 FORMAT "%5.3" /end CHARACTERISTIC
/begin CHARACTERISTIC SENZZYL1 "Klopfsensor für SW-Zylinderzähler 1" VALUE 0x819684 KwUb 3.000 dezsub1 1.000 4.000 FORMAT "%5.3" /end CHARACTERISTIC
/begin CHARACTERISTIC SENZZYL2 "Klopfsensor für SW-Zylinderzähler 2" VALUE 0x819685 KwUb 3.000 dezsub1 1.000 4.000 FORMAT "%5.3" /end CHARACTERISTIC
/begin CHARACTERISTIC SENZZYL3 "Klopfsensor für SW-Zylinderzähler 3" VALUE 0x819686 KwUb 3.000 dezsub1 1.000 4.000 FORMAT "%5.3" /end CHARACTERISTIC
/begin CHARACTERISTIC SENZZYL4 "Klopfsensor für SW-Zylinderzähler 4" VALUE 0x819687 KwUb 3.000 dezsub1 1.000 4.000 FORMAT "%5.3" /end CHARACTERISTIC
/begin CHARACTERISTIC SENZZYL5 "Klopfsensor für SW-Zylinderzähler 5" VALUE 0x819688 KwUb 3.000 dezsub1 1.000 4.000 FORMAT "%5.3" /end CHARACTERISTIC
/begin CHARACTERISTIC SENZZYL6 "Klopfsensor für SW-Zylinderzähler 6" VALUE 0x819689 KwUb 3.000 dezsub1 1.000 4.000 FORMAT "%5.3" /end CHARACTERISTIC
/begin CHARACTERISTIC SENZZYL7 "Klopfsensor für SW-Zylinderzähler 7" VALUE 0x81968A KwUb 3.000 dezsub1 1.000 4.000 FORMAT "%5.3" /end CHARACTERISTIC
/begin AXIS_PTS SLA05ESUB "Stützstellenverteilung Regelabweichung Lambda, 5 Sst." 0x81303E ladiff_w SstAUwSstUw 1.999969 fak_sw_b1 5 0.00 1.999969 FORMAT "%8.6" DEPOSIT ABSOLUTE /end AXIS_PTS
/begin AXIS_PTS SNM07ESUB "Stützstellenverteilung Drehzahl, 7 Sst." 0x81821C nmot SstAUbSstUb 10200. nmot_ub_q40 7 0.00 10200. FORMAT "%5.0" DEPOSIT ABSOLUTE /end AXIS_PTS
/begin AXIS_PTS SNM08FEUB "Stützstellenverteilung Drehzahl, 08 Sst., Füllungseingriffe" 0x818224 nmot SstAUbSstUb 10200. nmot_ub_q40 8 0.00 10200. FORMAT "%5.0" DEPOSIT ABSOLUTE /end AXIS_PTS
/begin AXIS_PTS SNM08GKUB "Stützstellenverteilung Gemischkontrolle 8 nmot Stützstellen" 0x818D8D nmot SstAUbSstUb 10200. nmot_ub_q40 8 0.00 10200. FORMAT "%5.0" DEPOSIT ABSOLUTE /end AXIS_PTS
/begin AXIS_PTS SNM12ESUB "SST-Verteilung für die Motordrehzahl nmot" 0x8100A2 nmot SstAUbSstUb 10200. nmot_ub_q40 12 0.00 10200. FORMAT "%5.0" DEPOSIT ABSOLUTE /end AXIS_PTS
/begin AXIS_PTS SNM16KRUB "Stützstellenverteilung Drehzahl, 16 Sst." 0x81826C nmot SstAUbSstUb 10200. nmot_ub_q40 16 0.00 10200. FORMAT "%5.0" DEPOSIT ABSOLUTE /end AXIS_PTS
/begin AXIS_PTS SRL04KRUB "Stützstellenverteilung relative Füllung, 4 Sst." 0x818281 rl SstAUbSstUb 191.3 rel_ub_q0p75 4 0.00 191.3 FORMAT "%5.1" DEPOSIT ABSOLUTE /end AXIS_PTS
/begin AXIS_PTS SRL08GKUB "Stützstellenverteilung Gemischkontrolle 8 rl Stützstellen" 0x818D96 rl SstAUbSstUb 191.3 rel_ub_q0p75 8 0.00 191.3 FORMAT "%5.1" DEPOSIT ABSOLUTE /end AXIS_PTS
/begin AXIS_PTS SRL12ESUB "Sst-Verteilung für die relative Füllung rl" 0x8100F7 rl SstAUbSstUb 191.3 rel_ub_q0p75 12 0.00 191.3 FORMAT "%5.1" DEPOSIT ABSOLUTE /end AXIS_PTS
/begin AXIS_PTS STM09ESUB "Stützstellenverteilung Motortemperatur, 9 Sst." 0x8182E5 tmot SstAUbSstUb 191.3 temp_ub_q0p75_o48 9 -48.00 143.3 FORMAT "%5.1" DEPOSIT ABSOLUTE /end AXIS_PTS
/begin AXIS_PTS STM12ESUB "SST-Verteilung für die Motortemperatur tmot" 0x810136 tmot SstAUbSstUb 191.3 temp_ub_q0p75_o48 12 -48.00 143.3 FORMAT "%5.1" DEPOSIT ABSOLUTE /end AXIS_PTS
/begin AXIS_PTS STS12ESUB "SST-Verteilung für Motorstarttemperatur" 0x81014C tmst SstAUbSstUb 191.3 temp_ub_q0p75_o48 12 -48.00 143.3 FORMAT "%5.1" DEPOSIT ABSOLUTE /end AXIS_PTS
/begin CHARACTERISTIC TABGTA "Abgastemperatur aus Sensor" CURVE 0x81D324 KlAUwSstUwWUw 1279.980 temp_uw_q0p0195_o50 -50.00000 1229.980 FORMAT "%8.3"
 /begin AXIS_DESCR STD_AXIS tabgta_kge rel_uw_b100 24 0.00 99.99847 FORMAT "%8.5" DEPOSIT ABSOLUTE /end AXIS_DESCR
/end CHARACTERISTIC
/begin CHARACTERISTIC TAIRCMX "Überwachungszeit für obere Grenze der Botschaftszählerdifferenz" VALUE 0x81242C KwUb 255.0 DEZ 0.00 255.0 FORMAT "%5.1" /end CHARACTERISTIC
/begin CHARACTERISTIC TAIRCNU "Überwachungszeit für untere Grenze der Botschaftszählerdifferenz" VALUE 0x81242D KwUb 5.100 t20msxs_ub_b5p1 0.00 5.100 FORMAT "%5.3" /end CHARACTERISTIC
/begin CHARACTERISTIC TAMSRCMX "Überwachungszeit für obere Grenze der Botschaftszählerdifferenz" VALUE 0x81019A KwUb 2.550 t10msxs_ub_b2p55 0.00 2.550 FORMAT "%5.3" /end CHARACTERISTIC
/begin CHARACTERISTIC TBPWMCS "Wartezeit bis Signalunterbrechung erkannt" VALUE 0x81A6C3 KwUb 2.550 t10msxs_ub_b2p55 0.00 2.550 FORMAT "%5.3" /end CHARACTERISTIC
/begin CHARACTERISTIC TCONT_HILO "Entprellzeit Signal Dauer- high- low" VALUE 0x81242E KwUb 1.270 t10msxs_ub_b2p55 0.00 1.270 FORMAT "%5.3" /end CHARACTERISTIC
/begin CHARACTERISTIC TCRCAN "Filterzeit für Crash-CAN-Signal" VALUE 0x81242F KwUb 255.0 DEZ 0.00 255.0 FORMAT "%5.1" /end CHARACTERISTIC
/begin CHARACTERISTIC TCSERC "Zeit zur sicheren Crash-CAN-Erkennung" VALUE 0x81A6C4 KwUb 12.75 t50msxs_ub_b12p75 0.00 12.75 FORMAT "%5.2" /end CHARACTERISTIC
/begin CHARACTERISTIC TCSERNPL "Zeit für fehlgeschlagene automatische Crashsignalerkennung" VALUE 0x81A6C5 KwUb 12.75 t50msxs_ub_b12p75 0.00 12.75 FORMAT "%5.2" /end CHARACTERISTIC
/begin CHARACTERISTIC TCSERP "Zeit zur sicheren Crash-PWM Erkennung" VALUE 0x81A6C6 KwUb 12.75 t50msxs_ub_b12p75 0.00 12.75 FORMAT "%5.2" /end CHARACTERISTIC
/begin CHARACTERISTIC TDDFL "Entprellzeit für Fehlereintrag Drucksensor Ladedruck" VALUE 0x818A34 KwUb 25.50 t100msxs_ub_b25p5 0.00 25.50 FORMAT "%5.2" /end CHARACTERISTIC
/begin CHARACTERISTIC TDDFLUGD "Entprellzeit für Fehlereintrag Drucksensor Ladedruck" VALUE 0x818A35 KwUb 25.50 t100msxs_ub_b25p5 0.00 25.50 FORMAT "%5.2" /end CHARACTERISTIC
/begin CHARACTERISTIC TDDFU "Entprellzeit für Fehlereintrag Druckksensor Umgebung" VALUE 0x818A36 KwUb 25.50 t100msxs_ub_b25p5 0.00 25.50 FORMAT "%5.2" /end CHARACTERISTIC
/begin CHARACTERISTIC TDDFUUGD "Entprellzeit für Fehlereintrag Druckksensor Umgebung" VALUE 0x818A37 KwUb 25.50 t100msxs_ub_b25p5 0.00 25.50 FORMAT "%5.2" /end CHARACTERISTIC
/begin CHARACTERISTIC TDKPAW "Zeit für DK-Poti-Auswahl" VALUE 0x810B23 KwUb 2.540 t10msxs_ub_b2p55 0.01000 2.550 FORMAT "%5.3" /end CHARACTERISTIC
/begin CHARACTERISTIC TDVGDSLL "Verzögerungszeit für Drucksensorvergleich DSU/DSL im Leerlauf" VALUE 0x818A38 KwUb 25.50 t100msxs_ub_b25p5 0.00 25.50 FORMAT "%5.2" /end CHARACTERISTIC
/begin CHARACTERISTIC TDVIVZ "Toleranzzeit bei zu großer Abweichung zw. Istgeschw. und Zielgeschw." VALUE 0x8145F2 KwUw 1310.700 t20msxs_uw_q0p02 0.00 1310.700 FORMAT "%8.3" /end CHARACTERISTIC
/begin CHARACTERISTIC TDVZVI "Toleranzzeit bei zu großer Abweichung zw. Zielgeschw. und Istgeschw." VALUE 0x8145F4 KwUw 1310.700 t20msxs_uw_q0p02 0.00 1310.700 FORMAT "%8.3" /end CHARACTERISTIC
/begin CHARACTERISTIC TEPBRKUP "Entprellzeit für Brems- und Kupplungsschalter" VALUE 0x810C20 KwUb 5.100 t20msxs_ub_b5p1 0.00 5.100 FORMAT "%5.3" /end CHARACTERISTIC
/begin CHARACTERISTIC TEPFGRH "Entprellzeit für FGR-Bedienhebel" VALUE 0x8188DD KwUb 5.100 t20msxs_ub_b5p1 0.00 5.100 FORMAT "%5.3" /end CHARACTERISTIC
/begin CHARACTERISTIC TFGRABS "Zeitkonstante zum Entprellen der FGR-Abschaltung bei ABS-Bremsung" VALUE 0x8189BA KwUb 0.4000 t20msxs_ub_b5p1 0.00 0.4000 /end CHARACTERISTIC
/begin CHARACTERISTIC TFGRAR "Rampenlaufzeit bei Komfortabschaltung des FGR" VALUE 0x818A0E KwUb 5.080 t20msxs_ub_b5p1 0.00 5.080 FORMAT "%5.3" /end CHARACTERISTIC
/begin CHARACTERISTIC TFGRFDY "Toleranzzeit für Eingriffe von Fahrdynamikfunktionen im FGR-Betrieb" VALUE 0x810C44 KwUb 5.100 t20msxs_ub_b5p1 0.00 5.100 FORMAT "%5.3" /end CHARACTERISTIC
/begin CHARACTERISTIC TFGRHE "Verzögerungszeit für Erkennung FGR-Bedienhebelfehler" VALUE 0x8188DE KwUb 5.100 t20msxs_ub_b5p1 0.00 5.100 FORMAT "%5.3" /end CHARACTERISTIC
/begin CHARACTERISTIC TFGRHSNP "Toleranzzeit für Unplausibilität FGR-Hauptschalter" VALUE 0x8188DF KwUb 5.100 t20msxs_ub_b5p1 0.00 5.100 FORMAT "%5.3" /end CHARACTERISTIC
/begin CHARACTERISTIC TFGRTIP "Zeit für Erkennung gehaltene FGR-Funktionstaste Beschleunigen oder Verzögern" VALUE 0x8188E0 KwUb 5.100 t20msxs_ub_b5p1 0.00 5.100 FORMAT "%5.3" /end CHARACTERISTIC
/begin CHARACTERISTIC TFGRUEOB "Toleranzzeit für Überschreiten der oberen Beschleunigungsschwelle im FGR-Betrieb" VALUE 0x810C45 KwUb 5.100 t20msxs_ub_b5p1 0.00 5.100 FORMAT "%5.3" /end CHARACTERISTIC
/begin CHARACTERISTIC TFGRUM "Toleranzzeit für Erkennung FGR-Betrieb in der Funktionsüberwachung" VALUE 0x810C46 KwUb 5.100 t20msxs_ub_b5p1 0.00 5.100 FORMAT "%5.3" /end CHARACTERISTIC
/begin CHARACTERISTIC TFGRUNUB "Toleranzzeit für Unterschreiten der unteren Beschl.schwelle im FGR-Betrieb" VALUE 0x810C47 KwUb 5.100 t20msxs_ub_b5p1 0.00 5.100 FORMAT "%5.3" /end CHARACTERISTIC
/begin CHARACTERISTIC TFWDKPN "Zeitkonstante für Filterung der DK-Winkel vor Vergl. mit Ersatzwert aus Füllung" CURVE 0x810B24 KlAUbSstUbWUb 2.54000 zk10msxs_ub_b2p55 0.0100000 2.55000 FORMAT "%7.5"
 /begin AXIS_DESCR STD_AXIS nmot nmot_ub_q40 6 0.00 10200. FORMAT "%5.0" DEPOSIT ABSOLUTE /end AXIS_DESCR
/end CHARACTERISTIC
/begin CHARACTERISTIC TFWDKSOF "Zeit für Soll-Drosselklappenfilterung" VALUE 0x810D4D KwUb 2.54000 zk10msxs_ub_b2p55 0.0100000 2.55000 FORMAT "%7.5" /end CHARACTERISTIC
/begin CHARACTERISTIC TGRACMX "Überwachungszähler für obere Grenze der Botschaftszählerdifferenz GRA" VALUE 0x818A10 KwUb 255.0 DEZ 0.00 255.0 FORMAT "%5.1" /end CHARACTERISTIC
/begin CHARACTERISTIC TGRACNU "Überwachungszeit für untere Grenze der Botschaftszählerdifferenz GRA" VALUE 0x818A11 KwUb 5.100 t20msxs_ub_b5p1 0.00 5.100 FORMAT "%5.3" /end CHARACTERISTIC
/begin CHARACTERISTIC TMCC650 "KR-testmode am Pin ADT des CC650" VALUE 0x81968B KwUb 255.0 dez 0.00 255.0 FORMAT "%5.1" /end CHARACTERISTIC
/begin CHARACTERISTIC TMKIMN "Temperaturschwelle für Umschaltung auf Ersatzsignal" VALUE 0x819597 KwUb 191.3 temp_ub_q0p75_o48 -48.00 143.3 FORMAT "%5.1" /end CHARACTERISTIC
/begin CHARACTERISTIC TMNUUKA "Minimalzeit zwischen 2 Adaptionsvorgängen (ÜK-Adaption)" VALUE 0x8111B0 KwUb 1.850 t10msxs_ub_b2p55 0.7000 2.550 FORMAT "%5.3" /end CHARACTERISTIC
/begin CHARACTERISTIC TMQSYN "Motortemperaturschwelle zur Freigabe PG-Schnellstart" VALUE 0x8109DC KwUb 191.3 temp_ub_q0p75_o48 -48.00 143.3 FORMAT "%5.1" /end CHARACTERISTIC
/begin CHARACTERISTIC TMSRCERR "Entprellzeit für irreversible ASR/MSR-Abschaltung bei Botschaftsfehler" VALUE 0x81019B KwUb 2.550 t10msxs_ub_b2p55 0.00 2.550 FORMAT "%5.3" /end CHARACTERISTIC
/begin CHARACTERISTIC TMSRCNU "Entprellzeit zur Berücksichtigung von Rasterversätzen im Botschaftszähler" VALUE 0x81019C KwUb 2.550 t10msxs_ub_b2p55 0.00 2.550 FORMAT "%5.3" /end CHARACTERISTIC
/begin CHARACTERISTIC TMUKAK "Temperaturbereich kalter Motor für ÜK-Adaption" VALUE 0x8111B1 KwUb 191.3 temp_ub_q0p75_o48 -48.00 143.3 FORMAT "%5.1" /end CHARACTERISTIC
/begin CHARACTERISTIC TMUKAU "untere Motortemperatur-Grenze für ÜK-Adaption" VALUE 0x8111B2 KwUb 191.3 temp_ub_q0p75_o48 -48.00 143.3 FORMAT "%5.1" /end CHARACTERISTIC
/begin CHARACTERISTIC TMUKAW "Temperaturbereich warmer Motor für ÜK-Adaption" VALUE 0x8111B3 KwUb 191.3 temp_ub_q0p75_o48 -48.00 143.3 FORMAT "%5.1" /end CHARACTERISTIC
/begin CHARACTERISTIC TN2FGRGA_0_A "Doppelte Nennerzeitkonstante für FGR-Regler" CURVE 0x81C36C KlAUwSstUwWUw 1310.660 t20msxs_uw_q0p02 0.02000000 1310.680 FORMAT "%8.3"
 /begin AXIS_DESCR STD_AXIS uevges_w fak_q0p1 8 0.00 6553.500 FORMAT "%8.3" DEPOSIT ABSOLUTE /end AXIS_DESCR
/end CHARACTERISTIC
/begin CHARACTERISTIC TN2FGRGA_1_A "Doppelte Nennerzeitkonstante für FGR-Regler" CURVE 0x81C38E KlAUwSstUwWUw 1310.660 t20msxs_uw_q0p02 0.02000000 1310.680 FORMAT "%8.3"
 /begin AXIS_DESCR STD_AXIS uevges_w fak_q0p1 8 0.00 6553.500 FORMAT "%8.3" DEPOSIT ABSOLUTE /end AXIS_DESCR
/end CHARACTERISTIC
/begin CHARACTERISTIC TNSUUK "Zeit UK-Unterdrückung im Nachstart" VALUE 0x81119B KwUb 25.50 t100msxs_ub_b25p5 0.00 25.50 FORMAT "%5.2" /end CHARACTERISTIC
/begin CHARACTERISTIC TNSUUKA "Verbotszeit ÜK-Adaption im Nachstart" VALUE 0x81571C KwUw 655.3500 t10msxs_uw_b655p35 0.00 655.3500 FORMAT "%8.4" /end CHARACTERISTIC
/begin CHARACTERISTIC TOOTAUS "Zeit für Nicht-Betätigung ON/OFF-Taster GRA zur erneuten Freigabe" VALUE 0x8188E1 KwUb 5.100 t20msxs_ub_b5p1 0.00 5.100 FORMAT "%5.3" /end CHARACTERISTIC
/begin CHARACTERISTIC TOOTEIN "Zeit für Hauptschalter ein bei ON/OFF-Taster GRA" VALUE 0x8188E2 KwUb 5.100 t20msxs_ub_b5p1 0.00 5.100 FORMAT "%5.3" /end CHARACTERISTIC
/begin CHARACTERISTIC TOOTULB "Zeit für Erkennung unplausibel lange Betätigung ON/OFF-Taster GRA" VALUE 0x81BF00 KwUw 1310.700 t20msxs_uw_b1310 0.00 1310.700 FORMAT "%8.3" /end CHARACTERISTIC
/begin CHARACTERISTIC TPREL "Zahnentprellzeit in der Initialisierung" VALUE 0x8109DD KwUb 0.1000 t10msxs_ub_b2p55 0.00 0.1000 /end CHARACTERISTIC
/begin CHARACTERISTIC TPUKUKA "Entprellzeit für Erkennung ÜK-Eingriff (ÜK-Adaption)" VALUE 0x8111B4 KwUb 2.550 t10msxs_ub_b2p55 0.00 2.550 FORMAT "%5.3" /end CHARACTERISTIC
/begin CHARACTERISTIC TSPUUKA "Sperrzeit fuer Freigabe UK-Adaption" VALUE 0x8111B5 KwUb 24.50 t100msxs_ub_b25p5 1.000 25.50 FORMAT "%5.2" /end CHARACTERISTIC
/begin CHARACTERISTIC TSWKNBGA_0_A "Zeit bis Setzwertkorrektur nach Ende Beschleunigen" CURVE 0x8189BD KlAUbSstUbWUb 5.100 t20msxs_ub_q0p02 0.00 5.100 FORMAT "%5.3"
 /begin AXIS_DESCR STD_AXIS uevges fak_q0p1 8 0.00 25.50 FORMAT "%5.2" DEPOSIT ABSOLUTE /end AXIS_DESCR
/end CHARACTERISTIC
/begin CHARACTERISTIC TSWKNBGA_1_A "Zeit bis Setzwertkorrektur nach Ende Beschleunigen" CURVE 0x8189CE KlAUbSstUbWUb 5.100 t20msxs_ub_q0p02 0.00 5.100 FORMAT "%5.3"
 /begin AXIS_DESCR STD_AXIS uevges fak_q0p1 8 0.00 25.50 FORMAT "%5.2" DEPOSIT ABSOLUTE /end AXIS_DESCR
/end CHARACTERISTIC
/begin CHARACTERISTIC TSWKNVGA_0_A "Zeit bis Setzwertkorrektur nach Ende Verzögern" CURVE 0x8189DF KlAUbSstUbWUb 5.100 t20msxs_ub_q0p02 0.00 5.100 FORMAT "%5.3"
 /begin AXIS_DESCR STD_AXIS uevges fak_q0p1 8 0.00 25.50 FORMAT "%5.2" DEPOSIT ABSOLUTE /end AXIS_DESCR
/end CHARACTERISTIC
/begin CHARACTERISTIC TSWKNVGA_1_A "Zeit bis Setzwertkorrektur nach Ende Verzögern" CURVE 0x8189F0 KlAUbSstUbWUb 5.100 t20msxs_ub_q0p02 0.00 5.100 FORMAT "%5.3"
 /begin AXIS_DESCR STD_AXIS uevges fak_q0p1 8 0.00 25.50 FORMAT "%5.2" DEPOSIT ABSOLUTE /end AXIS_DESCR
/end CHARACTERISTIC
/begin CHARACTERISTIC TVAG "Zeit für Gewichtungsfaktor VA aktiv" VALUE 0x819231 KwUb 25.50 t100msxs_ub_b25p5 0.00 25.50 FORMAT "%5.2" /end CHARACTERISTIC
/begin CHARACTERISTIC TVCAMSR "Entprellzeit nach Start Startende bei ASR/MSR-Fehler" VALUE 0x81330A KwUw 655.3500 t10msxs_uw_b655p35 0.00 655.3500 FORMAT "%8.4" /end CHARACTERISTIC
/begin CHARACTERISTIC TVEINGATS "Verzögerungszeit der Einschaltbedingung in der %GGATS" VALUE 0x819401 KwUb 25.50 t100msxs_ub_b25p5 0.00 25.50 FORMAT "%5.2" /end CHARACTERISTIC
/begin CHARACTERISTIC TVERBR "Verzögerungszeit für Bremsschalter-Plausibilitätsprüfung" VALUE 0x8188FF KwUb 25.50 t100msxs_ub_b25p5 0.00 25.50 FORMAT "%5.2" /end CHARACTERISTIC
/begin CHARACTERISTIC TVFRG "Verzögerundszeit nach Satrtende bis zur Freigabe des Füllungsreglers" VALUE 0x810D49 KwUb 12.75 t50msxs_ub_b12p75 0.00 12.75 FORMAT "%5.2" /end CHARACTERISTIC
/begin CHARACTERISTIC TVKUP "Verzögerungszeit für B_kupplv" VALUE 0x810C21 KwUb 5.100 t20msxs_ub_b5p1 0.00 5.100 FORMAT "%5.3" /end CHARACTERISTIC
/begin CHARACTERISTIC TVKUPV "Verzögerungszeit für Rücksetzen von B_kupplv" VALUE 0x81457E KwUw 1310.700 t20msxs_uw_q0p02 0.00 1310.700 FORMAT "%8.3" /end CHARACTERISTIC
/begin CHARACTERISTIC TVLADV_0_A "Zeitkonstante für Integrator bei vlast-Berechnung" CURVE 0x81C3B0 KlAUwSstSwWUw 1310.6999997 zk20msxs_uw_b1310 0.020000305180 1310.7200000 FORMAT "%12.7"
 /begin AXIS_DESCR STD_AXIS dvzvi_w vfzg_sw_q0p00781 8 -256.0000 255.9922 FORMAT "%8.4" DEPOSIT ABSOLUTE /end AXIS_DESCR
/end CHARACTERISTIC
/begin CHARACTERISTIC TVLADV_1_A "Zeitkonstante für Integrator bei vlast-Berechnung" CURVE 0x81C3D2 KlAUwSstSwWUw 1310.6999997 zk20msxs_uw_b1310 0.020000305180 1310.7200000 FORMAT "%12.7"
 /begin AXIS_DESCR STD_AXIS dvzvi_w vfzg_sw_q0p00781 8 -256.0000 255.9922 FORMAT "%8.4" DEPOSIT ABSOLUTE /end AXIS_DESCR
/end CHARACTERISTIC
/begin CHARACTERISTIC TVNOSIGATS "Verzögerungszeit der Bedingung B_nosigats" VALUE 0x819402 KwUb 25.50 t100msxs_ub_b25p5 0.00 25.50 FORMAT "%5.2" /end CHARACTERISTIC
/begin CHARACTERISTIC TVPDKP1 "Fehlertoleranzzeit bei Bereichsprüfung DK-Poti 1" VALUE 0x810B31 KwUb 2.540 t10msxs_ub_b2p55 0.01000 2.550 FORMAT "%5.3" /end CHARACTERISTIC
/begin CHARACTERISTIC TVPDKP2 "Fehlertoleranzzeit bei Bereichsprüfung DK-Poti 2" VALUE 0x810B32 KwUb 2.540 t10msxs_ub_b2p55 0.01000 2.550 FORMAT "%5.3" /end CHARACTERISTIC
/begin CHARACTERISTIC TVPWDK12 "Fehlertoleranzzeit bei Gleichlaufprüfung der DK-Potis" VALUE 0x810B33 KwUb 2.540 t10msxs_ub_b2p55 0.01000 2.550 FORMAT "%5.3" /end CHARACTERISTIC
/begin CHARACTERISTIC TVPWDK13 "Fehlertoleranzzeit bei Gleichlaufprüfung DK-Poti 1 und Ersatzwert aus Füllung" VALUE 0x810B34 KwUb 2.540 t10msxs_ub_b2p55 0.01000 2.550 FORMAT "%5.3" /end CHARACTERISTIC
/begin CHARACTERISTIC TVPWDK23 "Fehlertoleranzzeit bei Gleichlaufprüfung DK-Poti 2 und Ersatzwert aus Füllung" VALUE 0x810B35 KwUb 2.540 t10msxs_ub_b2p55 0.01000 2.550 FORMAT "%5.3" /end CHARACTERISTIC
/begin CHARACTERISTIC TVPWMCSR "Entprellzeit Fehler zurücksetzen" VALUE 0x81A6C7 KwUb 6.350 t50msxs_ub_b12p75 0.00 6.350 FORMAT "%5.3" /end CHARACTERISTIC
/begin CHARACTERISTIC TVPWMCSS "Entprellzeit Fehler setzen" VALUE 0x81A6C8 KwUb 6.350 t50msxs_ub_b12p75 0.00 6.350 FORMAT "%5.3" /end CHARACTERISTIC
/begin CHARACTERISTIC TVTMKIC "Entprellzeit für tmkic-Fehler" VALUE 0x81D5F4 KwUw 6553.500 t100msxs_uw_b6553p5 0.00 6553.500 FORMAT "%8.3" /end CHARACTERISTIC
/begin CHARACTERISTIC TVTMKIE "Entprellzeit für Umschaltung auf Ersatzwert bei tmkic-Fehler" VALUE 0x81D5F6 KwUw 6553.500 t100msxs_uw_b6553p5 0.00 6553.500 FORMAT "%8.3" /end CHARACTERISTIC
/begin CHARACTERISTIC TVUBGATS "Ausschaltverzögerung für Ubatt-Betriebsbereitschaft Abgastemperatursensor" VALUE 0x819403 KwUb 25.50 t100msxs_ub_b25p5 0.00 25.50 FORMAT "%5.2" /end CHARACTERISTIC
/begin CHARACTERISTIC TVWDKS "Verzögerungszeit für Drosselklappen-Sollwinkel" VALUE 0x810D5D KwUb 2.550 t10msxs_ub_b2p55 0.00 2.550 FORMAT "%5.3" /end CHARACTERISTIC
/begin CHARACTERISTIC TWDKSV "Zeitkonstante für Drosselklappensollwinkelfilterung" CURVE 0x81512C KlAUwSstUwWUw 655.34999985 zk10msxs_uw_b655 0.010000152590 655.36000000 FORMAT "%12.8"
 /begin AXIS_DESCR STD_AXIS pspvmin_w fak_uw_b2 6 0.00 1.999969 FORMAT "%8.6" DEPOSIT ABSOLUTE /end AXIS_DESCR
/end CHARACTERISTIC
/begin CHARACTERISTIC TWNSTA "Wartezeit nach Motorstart" VALUE 0x81BEFC KwUw 655.3500 t10msxs_uw_b655p35 0.00 655.3500 FORMAT "%8.4" /end CHARACTERISTIC
/begin CHARACTERISTIC TWNTAL "Wartezeit bis Nicht-Tankleer-Signal gültig ist" VALUE 0x81BEFE KwUw 13107.00 t200msxs_uw_q0p2 0.00 13107.00 FORMAT "%8.2" /end CHARACTERISTIC
/begin CHARACTERISTIC TZ2FGRGA_0_A "Doppelte Zählerzeitkonstante für FGR-Regler" CURVE 0x81C3F4 KlAUwSstUwWUw 1310.660 t20msxs_uw_q0p02 0.02000000 1310.680 FORMAT "%8.3"
 /begin AXIS_DESCR STD_AXIS uevges_w fak_q0p1 8 0.00 6553.500 FORMAT "%8.3" DEPOSIT ABSOLUTE /end AXIS_DESCR
/end CHARACTERISTIC
/begin CHARACTERISTIC TZ2FGRGA_1_A "Doppelte Zählerzeitkonstante für FGR-Regler" CURVE 0x81C416 KlAUwSstUwWUw 1310.660 t20msxs_uw_q0p02 0.02000000 1310.680 FORMAT "%8.3"
 /begin AXIS_DESCR STD_AXIS uevges_w fak_q0p1 8 0.00 6553.500 FORMAT "%8.3" DEPOSIT ABSOLUTE /end AXIS_DESCR
/end CHARACTERISTIC
/begin CHARACTERISTIC T_ASRFGR "Zeit für GRA-Abwurf bei ASR-Eingriff" VALUE 0x81019D KwUb 2.550 t10msxs_ub_b2p55 0.00 2.550 FORMAT "%5.3" /end CHARACTERISTIC
/begin CHARACTERISTIC T_NOMASR "Filterzeit bis Erkennung der Kommunikationsunterbrechung zu Knoten ASR" VALUE 0x81019E KwUb 2.550 t10msxs_ub_b2p55 0.00 2.550 FORMAT "%5.3" /end CHARACTERISTIC
/begin CHARACTERISTIC T_NOMASRTA "DCAN Timeoutzeit ASR Botschaft" VALUE 0x81019F KwUb 2.550 t10msxs_ub_b2p55 0.00 2.550 FORMAT "%5.3" /end CHARACTERISTIC
/begin CHARACTERISTIC T_NOMBR3 "CAN : Timeoutzeit für Botschaft Bremse 3" VALUE 0x8101A0 KwUb 2.550 t10msxs_ub_b2p55 0.00 2.550 FORMAT "%5.3" /end CHARACTERISTIC
/begin CHARACTERISTIC T_NOMGRA "Fehlerzeit GRA-Botschaft" VALUE 0x818A12 KwUb 5.100 t20msxs_ub_b5p1 0.00 5.100 FORMAT "%5.3" /end CHARACTERISTIC
/begin CHARACTERISTIC T_NOMGRATA "Timeoutzeit GRA-Botschaft" VALUE 0x818A13 KwUb 5.100 t20msxs_ub_b5p1 0.00 5.100 FORMAT "%5.3" /end CHARACTERISTIC
/begin CHARACTERISTIC UADPLMN "min. Spannungswert für Diagnose Drucksensor Ladedruck" VALUE 0x818A39 KwUb 4.980 spg_ub_b5 0.00 4.980 FORMAT "%5.3" /end CHARACTERISTIC
/begin CHARACTERISTIC UADPLMX "max. Spannungswert für Diagnose Drucksensor Ladedruck" VALUE 0x818A3A KwUb 4.980 spg_ub_b5 0.00 4.980 FORMAT "%5.3" /end CHARACTERISTIC
/begin CHARACTERISTIC UADPUMN "min. Spannungswert für Diagnose Drucksensor" VALUE 0x818A3B KwUb 4.9805 spg_ub_q0p019 0.00 4.9805 /end CHARACTERISTIC
/begin CHARACTERISTIC UADPUMX "max. Spannungswert für Diagnose Drucksensor" VALUE 0x818A3C KwUb 4.9805 spg_ub_q0p019 0.00 4.9805 /end CHARACTERISTIC
/begin CHARACTERISTIC UBGATSMN "Mindestbatteriespannung für Abgastemperatursensor" VALUE 0x819404 KwUb 25.50 spg_q0p1 0.00 25.50 FORMAT "%5.2" /end CHARACTERISTIC
/begin CHARACTERISTIC UBVDKPO "Batteriespannungsschwelle für Umschaltung auf verstärktes Signal von DK-Poti 1" VALUE 0x810B36 KwUb 17.95 spg_ubatt 0.00 17.95 FORMAT "%5.2" /end CHARACTERISTIC
/begin CHARACTERISTIC UBVDKPU "Batteriespannungsschwelle für Umschaltung auf unverstärktes Signal von DK-Poti 1" VALUE 0x810B37 KwUb 17.95 spg_ubatt 0.00 17.95 FORMAT "%5.2" /end CHARACTERISTIC
/begin CHARACTERISTIC UDKP1O "Maximale zulässige Spannung von DK-Poti 1" VALUE 0x810B38 KwUb 4.980 spg_ub_b5 0.00 4.980 FORMAT "%5.3" /end CHARACTERISTIC
/begin CHARACTERISTIC UDKP1U "Minimale zulässige Spannung von DK-Poti 1" VALUE 0x810B39 KwUb 4.980 spg_ub_b5 0.00 4.980 FORMAT "%5.3" /end CHARACTERISTIC
/begin CHARACTERISTIC UDKP2O "Maximale zulässige Spannung von DK-Poti 2" VALUE 0x810B3A KwUb 4.980 spg_ub_b5 0.00 4.980 FORMAT "%5.3" /end CHARACTERISTIC
/begin CHARACTERISTIC UDKP2U "Minimale zulässige Spannung von DK-Poti 2" VALUE 0x810B3B KwUb 4.980 spg_ub_b5 0.00 4.980 FORMAT "%5.3" /end CHARACTERISTIC
/begin CHARACTERISTIC UPWMCS "Ubatt-Schwelle für Diagnose Crash-Signal" VALUE 0x81A6C9 KwUb 17.95 spg_ubatt 0.00 17.95 FORMAT "%5.2" /end CHARACTERISTIC
/begin CHARACTERISTIC VFGREMAX "Maximale FGR-Einschaltgeschwindigkeit" VALUE 0x81BF0E KwUw 511.9922 vfzg_uw_q0p0078125 0.00 511.9922 FORMAT "%8.4" /end CHARACTERISTIC
/begin CHARACTERISTIC VFGREMIN "Minimale FGR-Einschaltgeschwindigkeit" VALUE 0x81BF10 KwUw 511.9922 vfzg_uw_q0p0078125 0.00 511.9922 FORMAT "%8.4" /end CHARACTERISTIC
/begin CHARACTERISTIC VFGRMAX "Maximal zulässige Geschwindigkeit im FGR-Betrieb" VALUE 0x81BF12 KwUw 511.9922 vfzg_uw_q0p0078125 0.00 511.9922 FORMAT "%8.4" /end CHARACTERISTIC
/begin CHARACTERISTIC VFGRMIN "Minimal zulässige Geschwindigkeit im FGR-Betrieb" VALUE 0x81BF14 KwUw 511.9922 vfzg_uw_q0p0078125 0.00 511.9922 FORMAT "%8.4" /end CHARACTERISTIC
/begin CHARACTERISTIC VLMXVZ_0_A "Maximalwert für vlast_w" CURVE 0x81C438 KlAUwSstUwWUw 511.9922 vfzg_uw_q0p0078125 0.00 511.9922 FORMAT "%8.4"
 /begin AXIS_DESCR STD_AXIS vziel_w vfzg_uw_q0p0078125 6 0.00 511.9922 FORMAT "%8.4" DEPOSIT ABSOLUTE /end AXIS_DESCR
/end CHARACTERISTIC
/begin CHARACTERISTIC VLMXVZ_1_A "Maximalwert für vlast_w" CURVE 0x81C452 KlAUwSstUwWUw 511.9922 vfzg_uw_q0p0078125 0.00 511.9922 FORMAT "%8.4"
 /begin AXIS_DESCR STD_AXIS vziel_w vfzg_uw_q0p0078125 6 0.00 511.9922 FORMAT "%8.4" DEPOSIT ABSOLUTE /end AXIS_DESCR
/end CHARACTERISTIC
/begin CHARACTERISTIC VMINAMSR "Geschwindigkeitschwelle für plausiblen MSR-Eingriff" VALUE 0x81330C KwUw 324.9950 vfzg_uw_b325 0.00 324.9950 FORMAT "%8.4" /end CHARACTERISTIC
/begin CHARACTERISTIC VPSSPLSWDK "Druckverhältnis zur Freigabe der DK-Überwegs bei DK-Winkel > DK-Winkel ung.-Schw" VALUE 0x815146 KwUw 1.999969 fak_uw_b2 0.00 1.999969 FORMAT "%8.6" /end CHARACTERISTIC
/begin CHARACTERISTIC VREGLMAX "Maximal zulässige Sollgeschwindigkeit für FGR" VALUE 0x81C1C0 KwUw 511.9922 vfzg_uw_q0p0078125 0.00 511.9922 FORMAT "%8.4" /end CHARACTERISTIC
/begin CHARACTERISTIC VREGLMIN "Minimal zulässige Sollgeschwindigkeit für FGR" VALUE 0x81C1C2 KwUw 511.9922 vfzg_uw_q0p0078125 0.00 511.9922 FORMAT "%8.4" /end CHARACTERISTIC
/begin CHARACTERISTIC WDKDSVLU "Drosselklappenschwelle für Drucksensorplausibilisierung" CURVE 0x818A3D KlAUbSstUbWUb 100.0 relDK_ub_b100 0.00 100.0 FORMAT "%5.1"
 /begin AXIS_DESCR STD_AXIS nmot nmot_ub_q40 6 0.00 10200. FORMAT "%5.0" DEPOSIT ABSOLUTE /end AXIS_DESCR
/end CHARACTERISTIC
/begin CHARACTERISTIC WDKPMXN "Maximaler Drosselklappenwinkel für Plausibilisierung mit Füllungssignal" CURVE 0x810B3C KlAUbSstUbWUb 100.0 relDK_ub_b100 0.00 100.0 FORMAT "%5.1"
 /begin AXIS_DESCR STD_AXIS nmot nmot_ub_q40 12 0.00 10200. FORMAT "%5.0" DEPOSIT ABSOLUTE /end AXIS_DESCR
/end CHARACTERISTIC
/begin CHARACTERISTIC WDKSAPP "Drosselklappensollwert für Applikationszwecke" VALUE 0x815148 KwUw 99.99847 rel_uw_b100 0.00 99.99847 FORMAT "%8.5" /end CHARACTERISTIC
/begin CHARACTERISTIC WDKSHYS "Drosselklappen-Hystereseschwelle für Aktivierung/Deaktivierung Überweg" VALUE 0x81514A KwUw 99.99847 rel_uw_b100 0.00 99.99847 FORMAT "%8.5" /end CHARACTERISTIC
/begin CHARACTERISTIC WDKSOFS "Offset zu appl. DK-Sollwinkel bei niedrigen Temperaturen" VALUE 0x81514C KwUw 99.99847 rel_uw_b100 0.00 99.99847 FORMAT "%8.5" /end CHARACTERISTIC
/begin CHARACTERISTIC WEAN "Winkel Einspritzabbruch" CURVE 0x818D9F GklWUb 1530. zw_ub_q6 0.00 1530. FORMAT "%5.0"
 /begin AXIS_DESCR COM_AXIS nmot nmot_ub_q40 8 0.00 10200. AXIS_PTS_REF SNM08GKUB /end AXIS_DESCR
/end CHARACTERISTIC
/begin CHARACTERISTIC WEEMRFAN "Winkel Einspritzende bei maximalem Fahrerwunsch" CURVE 0x818DA7 GklWUb 1530. zw_ub_q6 0.00 1530. FORMAT "%5.0"
 /begin AXIS_DESCR COM_AXIS nmot nmot_ub_q40 8 0.00 10200. AXIS_PTS_REF SNM08GKUB /end AXIS_DESCR
/end CHARACTERISTIC
/begin CHARACTERISTIC WEESTN "Winkel Einspritzende im Start" CURVE 0x810E2D KlAUbSstUbWUb 1530. zw_ub_q6 0.00 1530. FORMAT "%5.0"
 /begin AXIS_DESCR STD_AXIS nmot nmot_ub_q40 4 0.00 10200. FORMAT "%5.0" DEPOSIT ABSOLUTE /end AXIS_DESCR
/end CHARACTERISTIC
/begin CHARACTERISTIC WFRL "Kraftstoffwandfilmkennlinie" CURVE 0x8156D4 FklWUw 6143.906 rel_uw_b6144 0.00 6143.906 FORMAT "%8.3"
 /begin AXIS_DESCR FIX_AXIS rlp_w rel_uw_q0p0234 31 0.00 185.9766 FORMAT "%8.4" FIX_AXIS_PAR 0 8 31 /end AXIS_DESCR
/end CHARACTERISTIC
/begin CHARACTERISTIC WKVGDSLL "Drosselklappenschwelle für DSU/DSL Plausibilitätscheck nach Start" VALUE 0x818A4A KwUb 100.0 relDK_ub_b100 0.00 100.0 FORMAT "%5.1" /end CHARACTERISTIC
/begin CHARACTERISTIC ZBAKM "Abregelfaktor K-Speicher (tmot) BA" CURVE 0x819232 GklWUb 0.9961 fak_q0p0039 0.00 0.9961
 /begin AXIS_DESCR COM_AXIS tmot temp_ub_q0p75_o48 9 -48.00 143.3 AXIS_PTS_REF STM09ESUB /end AXIS_DESCR
/end CHARACTERISTIC
/begin CHARACTERISTIC ZBALM "Abregelfaktor L-Speicher (tmot) BA" CURVE 0x81923B GklWUb 0.1245 fak_ub_b0p125 0.00 0.1245 FORMAT "%6.4"
 /begin AXIS_DESCR COM_AXIS tmot temp_ub_q0p75_o48 9 -48.00 143.3 AXIS_PTS_REF STM09ESUB /end AXIS_DESCR
/end CHARACTERISTIC
/begin CHARACTERISTIC ZDELBMSRCH "Zusätzlicher Zahnoffset beim Warten auf BM im Schnellstart" VALUE 0x8109DE KwUb 6.000 dez 0.00 6.000 FORMAT "%5.3" /end CHARACTERISTIC
/begin CHARACTERISTIC ZDSU "Zeitkonstante für Filterung von pu und fho in GGDSU" VALUE 0x818A4B KwUb 25.4996 zk100msxs_ub_b25p5 0.100392 25.6000 FORMAT "%7.4" /end CHARACTERISTIC
/begin CHARACTERISTIC ZERBR "Fehlerzähler für Bremsschalter-Unplausibilitäten" VALUE 0x818900 KwUb 255.0 dez 0.00 255.0 FORMAT "%5.1" /end CHARACTERISTIC
/begin CHARACTERISTIC ZKFWLKH "Zeitkonstante Aufsteuerung Wichtung Warmlauffaktor bei Katheizen" VALUE 0x8156A6 KwUw 655.34999985 zk10msxs_uw_b655 0.010000152590 655.36000000 FORMAT "%12.8" /end CHARACTERISTIC
/begin CHARACTERISTIC ZKLANSWL "Zeitkonstante Filterung lamnswl_w" VALUE 0x8156A8 KwUw 655.34999985 zk10msxs_uw_b655 0.010000152590 655.36000000 FORMAT "%12.8" /end CHARACTERISTIC
/begin CHARACTERISTIC ZKPSFIL "Zeitkonstante für Filterung von Saugrohrdruck für KLAF-Berechnung in FUEDK" VALUE 0x81514E KwUw 655.34999985 zk10msxs_uw_b655 0.010000152590 655.36000000 FORMAT "%12.8" /end CHARACTERISTIC
/begin CHARACTERISTIC ZPVDKR "Zeitkonstante für pvdkr-Filterung" CURVE 0x815150 KlAUwSstUwWUw 655.34999985 zk10msxs_uw_b655 0.010000152590 655.36000000 FORMAT "%12.8"
 /begin AXIS_DESCR STD_AXIS vpsspu_w fak_uw_b4 6 0.00 3.999939 FORMAT "%8.6" DEPOSIT ABSOLUTE /end AXIS_DESCR
/end CHARACTERISTIC
/begin CHARACTERISTIC ZPWMCS "Anzahl Crash-Impulse bis Crash erkannt" VALUE 0x81A6CA KwUb 255.0 DEZ 0.00 255.0 FORMAT "%5.1" /end CHARACTERISTIC
/begin CHARACTERISTIC ZPWMCSMAX "Entprellzähler für Diagnose Crash-Signal" VALUE 0x81A6CB KwUb 255.0 DEZ 0.00 255.0 FORMAT "%5.1" /end CHARACTERISTIC
/begin CHARACTERISTIC ZTPREL "Anzahl Zähne während der Starterkennung" VALUE 0x8109DF KwUb 255.0 dez 0.00 255.0 FORMAT "%5.1" /end CHARACTERISTIC
/begin CHARACTERISTIC ZUKE "Zeitkonstante ÜK-Ersatzwert" VALUE 0x815712 KwUw 655.34999985 zk10msxs_uw_b655 0.010000152590 655.36000000 FORMAT "%12.8" /end CHARACTERISTIC
/begin CHARACTERISTIC ZUKNST "Abregelzeitkonstante ÜK-Faktor im Nachstart" VALUE 0x815714 KwUw 6553.4999985 zk100msxs_uw_b6553 0.10000152590 6553.6000000 FORMAT "%12.7" /end CHARACTERISTIC
/begin CHARACTERISTIC ZVAKM "Abregelfaktor K-Speicher (tmot) VA" CURVE 0x819244 GklWUb 0.9961 fak_q0p0039 0.00 0.9961
 /begin AXIS_DESCR COM_AXIS tmot temp_ub_q0p75_o48 9 -48.00 143.3 AXIS_PTS_REF STM09ESUB /end AXIS_DESCR
/end CHARACTERISTIC
/begin CHARACTERISTIC ZVALM "Abregelfaktor L-Speicher (tmot) VA" CURVE 0x81924D GklWUb 0.1245 fak_ub_b0p125 0.00 0.1245 FORMAT "%6.4"
 /begin AXIS_DESCR COM_AXIS tmot temp_ub_q0p75_o48 9 -48.00 143.3 AXIS_PTS_REF STM09ESUB /end AXIS_DESCR
/end CHARACTERISTIC
/begin CHARACTERISTIC ZZWEETM "Umschaltschwelle Vorlagerungswinkel" CURVE 0x818DAF KlAUbSstUbWUb 255.0 dez 0.00 255.0 FORMAT "%5.1"
 /begin AXIS_DESCR STD_AXIS tmst temp_ub_q0p75_o48 8 -48.00 143.3 FORMAT "%5.1" DEPOSIT ABSOLUTE /end AXIS_DESCR
/end CHARACTERISTIC
/begin MEASUREMENT abak "Aufteilungsfaktor Wandfilm bei BA" UBYTE fak_ub_b1 1 100 0 0.996094 ECU_ADDRESS 0x38487F /end MEASUREMENT
/begin MEASUREMENT anzfkuka "Anzahl berechnete Korrekturfaktoren während ÜK-Eingriff (ÜK-Adaption)" UBYTE dez 1 100 0 255 FORMAT "%5.1" ECU_ADDRESS 0x380A61 /end MEASUREMENT
/begin MEASUREMENT anzhfma_w "Anzahl der HFM-Abtastungen über ein Synchro" UWORD dez 1 100 0 65535 FORMAT "%8.2" ECU_ADDRESS 0xF9A2 /end MEASUREMENT
/begin MEASUREMENT anztip "Anzahl der hintereinander erfolgten Tip-Ups oder Tip-Downs" UBYTE dez 1 100 0 255 FORMAT "%5.1" ECU_ADDRESS 0x380A12 /end MEASUREMENT
/begin MEASUREMENT anztis "Anzahl vom CIFI initialisierter ti's (Synchro-Abtastung)" UBYTE dez 1 100 0 255 FORMAT "%5.1" ECU_ADDRESS 0x380A56 /end MEASUREMENT
/begin MEASUREMENT anzudsl_w "Anzahl Abtastungen Drucksensor Ladedruck über einem Segment(word)" UWORD dez 1 100 0 65535 FORMAT "%8.2" ECU_ADDRESS 0xF9C0 /end MEASUREMENT
/begin MEASUREMENT anzwefim "Anzahl der abgearbeiteten Wiedereinsetzfaktoren" UBYTE dez 1 100 0 255 FORMAT "%5.1" ECU_ADDRESS 0x380A53 /end MEASUREMENT
/begin MEASUREMENT avak "Aufteilungsfaktor Wandfilm bei VA" UBYTE fak_ub_b1 1 100 0 0.996094 ECU_ADDRESS 0x384880 /end MEASUREMENT
/begin MEASUREMENT azylwe "Anzahl wiedereingesetzter Zylinder" UBYTE dez 1 100 0 255 FORMAT "%5.1" ECU_ADDRESS 0x380A54 /end MEASUREMENT
/begin MEASUREMENT bfgrs_w "FGR-Sollbeschleunigung" UWORD bfzg_sw_q4p239Em4 1 100 0 27.7803 ECU_ADDRESS 0x381E18 /end MEASUREMENT
/begin MEASUREMENT bmLosCtr_w "Zähler (Word) Neusynchronisationen durch Lückenverlust" UWORD dez 1 100 0 65535 FORMAT "%8.2" ECU_ADDRESS 0x383A46 /end MEASUREMENT
/begin MEASUREMENT bmzzyl "Initialisierungswert Zylinderzähler nach erster Bezugsmarke" UBYTE dez 1 100 0 255 FORMAT "%5.1" ECU_ADDRESS 0x38097A /end MEASUREMENT
/begin MEASUREMENT brafgr_w "Rampenbeschleunigung FGR" UWORD bfzg_sw_q4p239Em4 1 100 0 27.7803 ECU_ADDRESS 0x381E1A /end MEASUREMENT
/begin MEASUREMENT bswk_w "Fahrzeugbeschleunigung vor Setzwertkorrektur" SWORD nmotg_sw_b13p89 1 100 -13.89 13.8896 FORMAT "%8.5" ECU_ADDRESS 0x381E1C /end MEASUREMENT
/begin MEASUREMENT bz_can "Botschaftszähler bei ASR/MSR" UBYTE DEZ 1 100 0 255 FORMAT "%5.1" ECU_ADDRESS 0x3808DB /end MEASUREMENT
/begin MEASUREMENT bz_diff "Botschaftszählerdifferenz Botschaft Bremse 1" UBYTE DEZ 1 100 0 255 FORMAT "%5.1" ECU_ADDRESS 0x3808DC /end MEASUREMENT
/begin MEASUREMENT bz_gra "CAN-Botschaftszähler für GRA" UBYTE DEZ 1 100 0 255 FORMAT "%5.1" ECU_ADDRESS 0x380A1A /end MEASUREMENT
/begin MEASUREMENT bz_msr "MSR-Botschaftszähler" UBYTE DEZ 1 100 0 255 FORMAT "%5.1" ECU_ADDRESS 0x3808DD /end MEASUREMENT
/begin MEASUREMENT B_absdia "Bedingung ABS in Diagnose (CAN-Info)" UWORD B_TRUE 1 100 0 1 BIT_MASK 0x2 FORMAT "%13.11" ECU_ADDRESS 0xFD1E /end MEASUREMENT
/begin MEASUREMENT B_absfgr "Bedingung ABS-Bremsung (als Abschaltbedingung für FGR)" UWORD B_TRUE 1 100 0 1 BIT_MASK 0x4 FORMAT "%13.11" ECU_ADDRESS 0xFD1E /end MEASUREMENT
/begin MEASUREMENT B_afgrbs "Bedingung Aktualisierung FGR-Bediensignale erforderlich" UBYTE B_TRUE 1 100 0 1 BIT_MASK 0x1 FORMAT "%13.11" ECU_ADDRESS 0x3809BE /end MEASUREMENT
/begin MEASUREMENT B_afwe "Bedingung Anzahl der Wiedereinsetzfaktoren" UWORD B_TRUE 1 100 0 1 BIT_MASK 0x1000 FORMAT "%13.11" ECU_ADDRESS 0xFD60 /end MEASUREMENT
/begin MEASUREMENT B_airbag "Bedingung Airbag ausgelöst" UWORD B_TRUE 1 100 0 1 BIT_MASK 0x200 FORMAT "%13.11" ECU_ADDRESS 0xFDB0 /end MEASUREMENT
/begin MEASUREMENT B_airbz "Bedingung Botschaftszähler der Airbag-Botschaft unplausibel" UWORD B_TRUE 1 100 0 1 BIT_MASK 0x400 FORMAT "%13.11" ECU_ADDRESS 0xFDB0 /end MEASUREMENT
/begin MEASUREMENT B_airbz1 "Bedingung Botschaftszählerdifferenz größer Grenzwert" UWORD B_TRUE 1 100 0 1 BIT_MASK 0x800 FORMAT "%13.11" ECU_ADDRESS 0xFDB0 /end MEASUREMENT
/begin MEASUREMENT B_airbz2 "Bedingung Botschaftszählerdifferenz = 0" UWORD B_TRUE 1 100 0 1 BIT_MASK 0x1000 FORMAT "%13.11" ECU_ADDRESS 0xFDB0 /end MEASUREMENT
/begin MEASUREMENT B_amsren "Bedingung ASR/MSR-Eingriff erlaubt" UWORD B_TRUE 1 100 0 1 BIT_MASK 0x8 FORMAT "%13.11" ECU_ADDRESS 0xFD1E /end MEASUREMENT
/begin MEASUREMENT B_amsrf "Bedingung ASR-MSR Konsistenzfehler" UWORD B_TRUE 1 100 0 1 BIT_MASK 0x10 FORMAT "%13.11" ECU_ADDRESS 0xFD1E /end MEASUREMENT
/begin MEASUREMENT B_amsrinpl "Bedingung ASR/MSR-Eingriff irreversibel verboten" UWORD B_TRUE 1 100 0 1 BIT_MASK 0x20 FORMAT "%13.11" ECU_ADDRESS 0xFD1E /end MEASUREMENT
/begin MEASUREMENT B_amsrknpl "Bedingung unplausible Konsistenzprüfung bei ASR/MSR" UWORD B_TRUE 1 100 0 1 BIT_MASK 0x40 FORMAT "%13.11" ECU_ADDRESS 0xFD1E /end MEASUREMENT
/begin MEASUREMENT B_amsrn "Bedingung ASR-MSR nicht aktiv" UWORD B_TRUE 1 100 0 1 BIT_MASK 0x80 FORMAT "%13.11" ECU_ADDRESS 0xFD1E /end MEASUREMENT
/begin MEASUREMENT B_amsr_t "Bedinung MSR zulässig (Master-SG)" UWORD B_TRUE 1 100 0 1 BIT_MASK 0x100 FORMAT "%13.11" ECU_ADDRESS 0xFD1E /end MEASUREMENT
/begin MEASUREMENT B_asrakt "ASR-Funktion aktiviert" UWORD B_TRUE 1 100 0 1 BIT_MASK 0x200 FORMAT "%13.11" ECU_ADDRESS 0xFD1E /end MEASUREMENT
/begin MEASUREMENT B_asresp "Bedingung ASR/ESP verbaut" UWORD B_TRUE 1 100 0 1 BIT_MASK 0x400 FORMAT "%13.11" ECU_ADDRESS 0xFD1E /end MEASUREMENT
/begin MEASUREMENT B_asr_can "Bedingung ASR-Anforderung über CAN" UWORD B_TRUE 1 100 0 1 BIT_MASK 0x800 FORMAT "%13.11" ECU_ADDRESS 0xFD1E /end MEASUREMENT
/begin MEASUREMENT B_atsb "Bedingung: Abgastemperatursensor betriebsbereit" UWORD B_TRUE 1 100 0 1 BIT_MASK 0x200 FORMAT "%13.11" ECU_ADDRESS 0xFD66 /end MEASUREMENT
/begin MEASUREMENT B_atsbt "" UBYTE B_TRUE 1 100 0 1 BIT_MASK 0x20 FORMAT "%13.11" ECU_ADDRESS 0x380A5D /end MEASUREMENT
/begin MEASUREMENT B_atsb_old "" UBYTE B_TRUE 1 100 0 1 BIT_MASK 0x10 FORMAT "%13.11" ECU_ADDRESS 0x380A5D /end MEASUREMENT
/begin MEASUREMENT B_atson "Betriebsbedingung für Abgastemperatursensor (ext. Signalbox) erfüllt" UBYTE B_TRUE 1 100 0 1 BIT_MASK 0x40 FORMAT "%13.11" ECU_ADDRESS 0x380A5D /end MEASUREMENT
/begin MEASUREMENT B_ba "Bedingung Beschleunigungsanreicherung (Anzeige)" UWORD B_TRUE 1 100 0 1 BIT_MASK 0x40 FORMAT "%13.11" ECU_ADDRESS 0xFD62 /end MEASUREMENT
/begin MEASUREMENT B_bag "Bedingung starke Beschleunigungsanreicherung" UWORD B_TRUE 1 100 0 1 BIT_MASK 0x80 FORMAT "%13.11" ECU_ADDRESS 0xFD62 /end MEASUREMENT
/begin MEASUREMENT B_bkva "Bedingung BKV angesteuert" UWORD B_TRUE 1 100 0 1 BIT_MASK 0x1000 FORMAT "%13.11" ECU_ADDRESS 0xFD1E /end MEASUREMENT
/begin MEASUREMENT B_bkvv "Bedingung BKV verbaut (für Auswertung Bremse)" UWORD B_TRUE 1 100 0 1 BIT_MASK 0x2000 FORMAT "%13.11" ECU_ADDRESS 0xFD1E /end MEASUREMENT
/begin MEASUREMENT B_bkvvc "Bedingung BKV verbaut (Rohsignal)" UWORD B_TRUE 1 100 0 1 BIT_MASK 0x4000 FORMAT "%13.11" ECU_ADDRESS 0xFD1E /end MEASUREMENT
/begin MEASUREMENT B_bl "Bedingung Bremslichtschalter betätigt" UWORD B_TRUE 1 100 0 1 BIT_MASK 0x8 FORMAT "%13.11" ECU_ADDRESS 0xFD4C /end MEASUREMENT
/begin MEASUREMENT B_bm "Bedingung Bezugsmarke erkannt" UWORD B_TRUE 1 100 0 1 BIT_MASK 0x400 FORMAT "%13.11" ECU_ADDRESS 0xFD2C /end MEASUREMENT
/begin MEASUREMENT B_br "Bedingung Bremstestschalter betätigt" UWORD B_TRUE 1 100 0 1 BIT_MASK 0x10 FORMAT "%13.11" ECU_ADDRESS 0xFD4C /end MEASUREMENT
/begin MEASUREMENT B_br1en "Bedingung Empfang Botschaft Bremse 1" UWORD B_TRUE 1 100 0 1 BIT_MASK 0x8000 FORMAT "%13.11" ECU_ADDRESS 0xFD1E /end MEASUREMENT
/begin MEASUREMENT B_br2k "Bedingung Bremse betätigt 2-kanalig erkannt" UWORD B_TRUE 1 100 0 1 BIT_MASK 0x20 FORMAT "%13.11" ECU_ADDRESS 0xFD4C /end MEASUREMENT
/begin MEASUREMENT B_brems "Bedingung Bremse betätigt" UWORD B_TRUE 1 100 0 1 BIT_MASK 0x40 FORMAT "%13.11" ECU_ADDRESS 0xFD4C /end MEASUREMENT
/begin MEASUREMENT B_c95bf0 "Ansteuersignal zum Einstellen der Filtermittenfrequenz des CC195 (Pin BF0)" UWORD B_TRUE 1 100 0 1 BIT_MASK 0x1000 FORMAT "%13.11" ECU_ADDRESS 0xFD6E /end MEASUREMENT
/begin MEASUREMENT B_c95bf1 "Ansteuersignal zum Einstellen der Filtermittenfrequenz des CC195 (Pin BF1)" UWORD B_TRUE 1 100 0 1 BIT_MASK 0x2000 FORMAT "%13.11" ECU_ADDRESS 0xFD6E /end MEASUREMENT
/begin MEASUREMENT B_c95bf2 "Ansteuersignal zum Einstellen der Filtermittenfrequenz des CC195 (Pin BF2)" UWORD B_TRUE 1 100 0 1 BIT_MASK 0x4000 FORMAT "%13.11" ECU_ADDRESS 0xFD6E /end MEASUREMENT
/begin MEASUREMENT B_c95bf3 "Ansteuersignal zum Eintstellen der Filtermittenfrequenz des CC195 (Pin BF3)" UWORD B_TRUE 1 100 0 1 BIT_MASK 0x8000 FORMAT "%13.11" ECU_ADDRESS 0xFD6E /end MEASUREMENT
/begin MEASUREMENT B_c95ks3 "Ansteuersignal für den Nulltest des CC195" UWORD B_TRUE 1 100 0 1 BIT_MASK 0x1 FORMAT "%13.11" ECU_ADDRESS 0xFD70 /end MEASUREMENT
/begin MEASUREMENT B_cfgra "Bedingung fehlerhafte CAN-Botschaft GRA-Bediensignale" UWORD B_TRUE 1 100 0 1 BIT_MASK 0x4 FORMAT "%13.11" ECU_ADDRESS 0xFD52 /end MEASUREMENT
/begin MEASUREMENT B_cfkuka "Bedingung Berechnung Korrekturfaktor UK-Adaption" UWORD B_TRUE 1 100 0 1 BIT_MASK 0x40 FORMAT "%13.11" ECU_ADDRESS 0xFD68 /end MEASUREMENT
/begin MEASUREMENT B_cfkuka2 "Bedingung Berechnung Korrekturfaktor UK-Adaption Bank 2" UWORD B_TRUE 1 100 0 1 BIT_MASK 0x80 FORMAT "%13.11" ECU_ADDRESS 0xFD68 /end MEASUREMENT
/begin MEASUREMENT B_cfuka "Bedingung UK-Adaptionsfaktor berechnen" UWORD B_TRUE 1 100 0 1 BIT_MASK 0x100 FORMAT "%13.11" ECU_ADDRESS 0xFD68 /end MEASUREMENT
/begin MEASUREMENT B_cfuka2 "Bedingung UK-Adaptionsfaktor berechnen (Bank 2)" UWORD B_TRUE 1 100 0 1 BIT_MASK 0x200 FORMAT "%13.11" ECU_ADDRESS 0xFD68 /end MEASUREMENT
/begin MEASUREMENT B_crcan "Bedingung Crash erkannt (aus plausibilisiertem CAN-Signal)" UBYTE B_TRUE 1 100 0 1 BIT_MASK 0x2 FORMAT "%13.11" ECU_ADDRESS 0x383253 /end MEASUREMENT
/begin MEASUREMENT B_crcan_20ms "" UWORD B_TRUE 1 100 0 1 BIT_MASK 0x2000 FORMAT "%13.11" ECU_ADDRESS 0xFDB0 /end MEASUREMENT
/begin MEASUREMENT B_crnmn "Bedingung Drehzahl=0 nach Crashabschaltung erkannt" UBYTE B_TRUE 1 100 0 1 BIT_MASK 0x8 FORMAT "%13.11" ECU_ADDRESS 0x383253 /end MEASUREMENT
/begin MEASUREMENT B_crstio "Bedingung i.O.-Start nach Crashabschaltung erkannt" UBYTE B_TRUE 1 100 0 1 BIT_MASK 0x4 FORMAT "%13.11" ECU_ADDRESS 0x383253 /end MEASUREMENT
/begin MEASUREMENT B_csernpl "Bedingung automatische Crashsignalerkennung unplausibel" UBYTE B_TRUE 1 100 0 1 BIT_MASK 0x1 FORMAT "%13.11" ECU_ADDRESS 0x380BEB /end MEASUREMENT
/begin MEASUREMENT B_csgra "Bedingung Checksummenfehler GRA-Botschaft" UWORD B_TRUE 1 100 0 1 BIT_MASK 0x8 FORMAT "%13.11" ECU_ADDRESS 0xFD52 /end MEASUREMENT
/begin MEASUREMENT B_dfp1 "" UBYTE B_TRUE 1 100 0 1 BIT_MASK 0x1 FORMAT "%13.11" ECU_ADDRESS 0x380A5D /end MEASUREMENT
/begin MEASUREMENT B_dfp2 "" UBYTE B_TRUE 1 100 0 1 BIT_MASK 0x2 FORMAT "%13.11" ECU_ADDRESS 0x380A5D /end MEASUREMENT
/begin MEASUREMENT B_dkp1e "Bedingung Fehler DK-Poti 1" UWORD B_TRUE 1 100 0 1 BIT_MASK 0x4 FORMAT "%13.11" ECU_ADDRESS 0xFD42 /end MEASUREMENT
/begin MEASUREMENT B_dkp1ev "Bedingung Vorläufige Bereichsverletzung DK-Poti 1" UWORD B_TRUE 1 100 0 1 BIT_MASK 0x8 FORMAT "%13.11" ECU_ADDRESS 0xFD42 /end MEASUREMENT
/begin MEASUREMENT B_dkp1mn "Bedingung Bereichsverletzung DK-Poti 1 nach unten" UWORD B_TRUE 1 100 0 1 BIT_MASK 0x10 FORMAT "%13.11" ECU_ADDRESS 0xFD42 /end MEASUREMENT
/begin MEASUREMENT B_dkp1mx "Bedingung Bereichsverletzung DK-Poti 1 nach oben" UWORD B_TRUE 1 100 0 1 BIT_MASK 0x20 FORMAT "%13.11" ECU_ADDRESS 0xFD42 /end MEASUREMENT
/begin MEASUREMENT B_dkp1np "Bedingung DK-Poti 1 unplausibel zu Ersatzwert aus Füllung" UWORD B_TRUE 1 100 0 1 BIT_MASK 0x40 FORMAT "%13.11" ECU_ADDRESS 0xFD42 /end MEASUREMENT
/begin MEASUREMENT B_dkp2e "Bedingung Fehler DK-Poti 2" UWORD B_TRUE 1 100 0 1 BIT_MASK 0x80 FORMAT "%13.11" ECU_ADDRESS 0xFD42 /end MEASUREMENT
/begin MEASUREMENT B_dkp2ev "Bedingung Vorläufige Bereichsverletzung DK-Poti 2" UWORD B_TRUE 1 100 0 1 BIT_MASK 0x100 FORMAT "%13.11" ECU_ADDRESS 0xFD42 /end MEASUREMENT
/begin MEASUREMENT B_dkp2mn "Bedingung Bereichsverletzung DK-Poti 2 nach unten" UWORD B_TRUE 1 100 0 1 BIT_MASK 0x200 FORMAT "%13.11" ECU_ADDRESS 0xFD42 /end MEASUREMENT
/begin MEASUREMENT B_dkp2mx "Bedingung Bereichsverletzung DK-Poti 2 nach oben" UWORD B_TRUE 1 100 0 1 BIT_MASK 0x400 FORMAT "%13.11" ECU_ADDRESS 0xFD42 /end MEASUREMENT
/begin MEASUREMENT B_dkp2np "Bedingung DK-Poti 2 unplausibel zu Ersatzwert aus Füllung" UWORD B_TRUE 1 100 0 1 BIT_MASK 0x800 FORMAT "%13.11" ECU_ADDRESS 0xFD42 /end MEASUREMENT
/begin MEASUREMENT B_dkpaw "Bedingung DK-Poti-Auswahl für DK-Sensor-Ersatzbetrieb" UWORD B_TRUE 1 100 0 1 BIT_MASK 0x1000 FORMAT "%13.11" ECU_ADDRESS 0xFD42 /end MEASUREMENT
/begin MEASUREMENT B_dksbeg "Bedingung DK-Sollwertbegrenzung" UWORD B_TRUE 1 100 0 1 BIT_MASK 0x2000 FORMAT "%13.11" ECU_ADDRESS 0xFD42 /end MEASUREMENT
/begin MEASUREMENT B_dnt "Aktive Diagnose: Klopfregelung Nulltest" UWORD B_TRUE 1 100 0 1 BIT_MASK 0x2 FORMAT "%13.11" ECU_ADDRESS 0xFD70 /end MEASUREMENT
/begin MEASUREMENT B_dntb "Bedingung Diagnose: Bereitschaft zum Nulltest (Nulltest im nächsten MF)" UWORD B_TRUE 1 100 0 1 BIT_MASK 0x4 FORMAT "%13.11" ECU_ADDRESS 0xFD70 /end MEASUREMENT
/begin MEASUREMENT B_dtp "Aktive Diagnose: Klopfregelung Testimpuls" UWORD B_TRUE 1 100 0 1 BIT_MASK 0x8 FORMAT "%13.11" ECU_ADDRESS 0xFD70 /end MEASUREMENT
/begin MEASUREMENT B_dtpb "Bedingung Diagnose: Bereitschaft zum Testpuls (Testpuls im nächsten MF)" UWORD B_TRUE 1 100 0 1 BIT_MASK 0x10 FORMAT "%13.11" ECU_ADDRESS 0xFD70 /end MEASUREMENT
/begin MEASUREMENT B_ecfuka "Bedingung ÜK-Adaptionsfaktor berechnen erlaubt" UWORD B_TRUE 1 100 0 1 BIT_MASK 0x400 FORMAT "%13.11" ECU_ADDRESS 0xFD68 /end MEASUREMENT
/begin MEASUREMENT B_edks "Bedingung Fehler Drosselklappen-Sensor" UWORD B_TRUE 1 100 0 1 BIT_MASK 0x4000 FORMAT "%13.11" ECU_ADDRESS 0xFD42 /end MEASUREMENT
/begin MEASUREMENT B_edsfgr "Bedingung EDS-Eingriff (als Abschaltbedingung für FGR)" UWORD B_TRUE 1 100 0 1 BIT_MASK 0x1 FORMAT "%13.11" ECU_ADDRESS 0xFD20 /end MEASUREMENT
/begin MEASUREMENT B_edsl "Bedingung Error Ladedrucksensor" UWORD B_TRUE 1 100 0 1 BIT_MASK 0x200 FORMAT "%13.11" ECU_ADDRESS 0xFD56 /end MEASUREMENT
/begin MEASUREMENT B_edsuu "Bedingung Error Umgebungsdrucksensor nicht zeitentprellt" UBYTE B_TRUE 1 100 0 1 BIT_MASK 0x1 FORMAT "%13.11" ECU_ADDRESS 0x383131 /end MEASUREMENT
/begin MEASUREMENT B_enqsyn "Bedingung Freigabe PG-Schnellstart" UWORD B_TRUE 1 100 0 1 BIT_MASK 0x800 FORMAT "%13.11" ECU_ADDRESS 0xFD2C /end MEASUREMENT
/begin MEASUREMENT B_epwmcs "Bedingung PWM-Crash-Sensor-Signal ist fehlerhaft" UBYTE B_TRUE 1 100 0 1 BIT_MASK 0x8 FORMAT "%13.11" ECU_ADDRESS 0x380BEB /end MEASUREMENT
/begin MEASUREMENT B_erbr "Bedingung Bremsschaltersignale unplausibel" UWORD B_TRUE 1 100 0 1 BIT_MASK 0x80 FORMAT "%13.11" ECU_ADDRESS 0xFD4C /end MEASUREMENT
/begin MEASUREMENT B_fabr "Bedingung Fahrer bremst aus CAN-Botschaft" UWORD B_TRUE 1 100 0 1 BIT_MASK 0x2 FORMAT "%13.11" ECU_ADDRESS 0xFD20 /end MEASUREMENT
/begin MEASUREMENT B_fbm "Bedingung Bezugsmarkenfehler => mindestens 1 Zahn zuviel oder zuwenig erkannt" UWORD B_TRUE 1 100 0 1 BIT_MASK 0x1000 FORMAT "%13.11" ECU_ADDRESS 0xFD2C /end MEASUREMENT
/begin MEASUREMENT B_fdyfgr "Bedingung Eingriff Fahrdynamikfunktion (als Abschaltbedingung für FGR)" UWORD B_TRUE 1 100 0 1 BIT_MASK 0x4 FORMAT "%13.11" ECU_ADDRESS 0xFD20 /end MEASUREMENT
/begin MEASUREMENT B_ffhsc "Bedingung B_fgrhsc gesetzt während B_fgrhs" UBYTE B_TRUE 1 100 0 1 BIT_MASK 0x2 FORMAT "%13.11" ECU_ADDRESS 0x3809BE /end MEASUREMENT
/begin MEASUREMENT B_fgootein "Bedingung Freigabe ON/OFF-Taster GRA für Einschalten" UBYTE B_TRUE 1 100 0 1 BIT_MASK 0x4 FORMAT "%13.11" ECU_ADDRESS 0x3809BE /end MEASUREMENT
/begin MEASUREMENT B_fgrab "FGR-/ACC-Abschaltung aus der Funktion" UWORD B_TRUE 1 100 0 1 BIT_MASK 0x2 FORMAT "%13.11" ECU_ADDRESS 0xFD52 /end MEASUREMENT
/begin MEASUREMENT B_fgrabz "Bedingung zusätzliche FGR-Abschaltung" UWORD B_TRUE 1 100 0 1 BIT_MASK 0x8 FORMAT "%13.11" ECU_ADDRESS 0xFD20 /end MEASUREMENT
/begin MEASUREMENT B_fgrat "Bedingung: Tip-Schalter Aus am FGR-Bedienteil betätigt" UWORD B_TRUE 1 100 0 1 BIT_MASK 0x4000 FORMAT "%13.11" ECU_ADDRESS 0xFD3E /end MEASUREMENT
/begin MEASUREMENT B_fgratc "Bedingung FGR-Tipschalter Aus betätigt (vom CAN)" UWORD B_TRUE 1 100 0 1 BIT_MASK 0x10 FORMAT "%13.11" ECU_ADDRESS 0xFD52 /end MEASUREMENT
/begin MEASUREMENT B_fgrbec "Bedingung FGR-Tipschalter Beschleunigen gehalten (vom CAN)" UWORD B_TRUE 1 100 0 1 BIT_MASK 0x20 FORMAT "%13.11" ECU_ADDRESS 0xFD52 /end MEASUREMENT
/begin MEASUREMENT B_fgrdvi "Bedingung FGR-Regler Initialisierung der gespeicherten Regelabweichung" UBYTE B_TRUE 1 100 0 1 BIT_MASK 0x1 FORMAT "%13.11" ECU_ADDRESS 0x380A19 /end MEASUREMENT
/begin MEASUREMENT B_fgren "Bedingung Fahrgeschwindigkeitsregelung aktiv (Enable)" UBYTE B_TRUE 1 100 0 1 BIT_MASK 0x1 FORMAT "%13.11" ECU_ADDRESS 0x380A18 /end MEASUREMENT
/begin MEASUREMENT B_fgrhe "Bedingung: FGR-Bedienteil-Fehler" UWORD B_TRUE 1 100 0 1 BIT_MASK 0x8000 FORMAT "%13.11" ECU_ADDRESS 0xFD3E /end MEASUREMENT
/begin MEASUREMENT B_fgrhec "Bedingung Fehler FGR-Bedienteil (vom CAN)" UWORD B_TRUE 1 100 0 1 BIT_MASK 0x40 FORMAT "%13.11" ECU_ADDRESS 0xFD52 /end MEASUREMENT
/begin MEASUREMENT B_fgrhev "Bedingung Fehler FGR-Bedienteil (vorläufig)" UBYTE B_TRUE 1 100 0 1 BIT_MASK 0x8 FORMAT "%13.11" ECU_ADDRESS 0x3809BE /end MEASUREMENT
/begin MEASUREMENT B_fgrhs "Bedingung FGR-Hauptschalter (über Hw-Leitung)" UBYTE B_TRUE 1 100 0 1 BIT_MASK 0x10 FORMAT "%13.11" ECU_ADDRESS 0x3809BE /end MEASUREMENT
/begin MEASUREMENT B_fgrhsa "Bedingung: FGR-Hauptschalter aus" UWORD B_TRUE 1 100 0 1 BIT_MASK 0x1 FORMAT "%13.11" ECU_ADDRESS 0xFD40 /end MEASUREMENT
/begin MEASUREMENT B_fgrhsc "Bedingung FGR-Hauptschalter ein (vom CAN)" UWORD B_TRUE 1 100 0 1 BIT_MASK 0x80 FORMAT "%13.11" ECU_ADDRESS 0xFD52 /end MEASUREMENT
/begin MEASUREMENT B_fgrsec "Bedingung FGR-Tipschalter Setzen betätigt (vom CAN)" UWORD B_TRUE 1 100 0 1 BIT_MASK 0x100 FORMAT "%13.11" ECU_ADDRESS 0xFD52 /end MEASUREMENT
/begin MEASUREMENT B_fgrtbe "Bedingung FGR-Taste Beschleunigen" UWORD B_TRUE 1 100 0 1 BIT_MASK 0x2 FORMAT "%13.11" ECU_ADDRESS 0xFD40 /end MEASUREMENT
/begin MEASUREMENT B_fgrtbh "Bedingung FGR-Taste Beschleunigen wird gehalten (kein Tip)" UWORD B_TRUE 1 100 0 1 BIT_MASK 0x4 FORMAT "%13.11" ECU_ADDRESS 0xFD40 /end MEASUREMENT
/begin MEASUREMENT B_fgrtdc "Bedingung FGR-Tipschalter Verzögern betätigt (vom CAN)" UWORD B_TRUE 1 100 0 1 BIT_MASK 0x200 FORMAT "%13.11" ECU_ADDRESS 0xFD52 /end MEASUREMENT
/begin MEASUREMENT B_fgrtse "Bedingung FGR-Taste Setzen" UWORD B_TRUE 1 100 0 1 BIT_MASK 0x8 FORMAT "%13.11" ECU_ADDRESS 0xFD40 /end MEASUREMENT
/begin MEASUREMENT B_fgrtuc "Bedingung FGR-Tipschalter Beschleunigen betätigt (vom CAN)" UWORD B_TRUE 1 100 0 1 BIT_MASK 0x400 FORMAT "%13.11" ECU_ADDRESS 0xFD52 /end MEASUREMENT
/begin MEASUREMENT B_fgrtve "Bedingung FGR-Taste Verzögern" UWORD B_TRUE 1 100 0 1 BIT_MASK 0x10 FORMAT "%13.11" ECU_ADDRESS 0xFD40 /end MEASUREMENT
/begin MEASUREMENT B_fgrtvh "Bedingung FGR-Taste Verzögern wird gehalten (kein Tip)" UWORD B_TRUE 1 100 0 1 BIT_MASK 0x20 FORMAT "%13.11" ECU_ADDRESS 0xFD40 /end MEASUREMENT
/begin MEASUREMENT B_fgrtwa "Bedingung FGR-Taste Wiederaufnahme" UWORD B_TRUE 1 100 0 1 BIT_MASK 0x40 FORMAT "%13.11" ECU_ADDRESS 0xFD40 /end MEASUREMENT
/begin MEASUREMENT B_fgrvec "Bedingung FGR-Tipschalter Verzögern gehalten (vom CAN)" UWORD B_TRUE 1 100 0 1 BIT_MASK 0x800 FORMAT "%13.11" ECU_ADDRESS 0xFD52 /end MEASUREMENT
/begin MEASUREMENT B_fgrwac "Bedingung FGR-Tipschalter Wiederaufnahme betätigt (vom CAN)" UWORD B_TRUE 1 100 0 1 BIT_MASK 0x1000 FORMAT "%13.11" ECU_ADDRESS 0xFD52 /end MEASUREMENT
/begin MEASUREMENT B_fkmsdks "Integratorstop fkmsdk" UWORD B_TRUE 1 100 0 1 BIT_MASK 0x20 FORMAT "%13.11" ECU_ADDRESS 0xFD58 /end MEASUREMENT
/begin MEASUREMENT B_fmfkrc "Filtermittenfrequenz des CC195/CC650 umgeschaltet" UWORD B_TRUE 1 100 0 1 BIT_MASK 0x20 FORMAT "%13.11" ECU_ADDRESS 0xFD70 /end MEASUREMENT
/begin MEASUREMENT B_fmfkrco "Filtermittenfrequenz umgeschaltet, neue Frequenz ist höher" UWORD B_TRUE 1 100 0 1 BIT_MASK 0x40 FORMAT "%13.11" ECU_ADDRESS 0xFD70 /end MEASUREMENT
/begin MEASUREMENT B_fmfkrcu "Filtermittenfrequenz umgeschaltet, neue Frequenz ist kleiner" UWORD B_TRUE 1 100 0 1 BIT_MASK 0x80 FORMAT "%13.11" ECU_ADDRESS 0xFD70 /end MEASUREMENT
/begin MEASUREMENT B_frgbs "Bedingung Freigabe Bediensignale Fahrgeschwindigkeitsregler" UBYTE B_TRUE 1 100 0 1 BIT_MASK 0x1 FORMAT "%13.11" ECU_ADDRESS 0x380A11 /end MEASUREMENT
/begin MEASUREMENT B_furena "Bedingung Aktivierung des Füllungsreglers" UWORD B_TRUE 1 100 0 1 BIT_MASK 0x4 FORMAT "%13.11" ECU_ADDRESS 0xFD58 /end MEASUREMENT
/begin MEASUREMENT B_furpen "Bedingung Füllungsregler P-Anteil aktiv" UWORD B_TRUE 1 100 0 1 BIT_MASK 0x8 FORMAT "%13.11" ECU_ADDRESS 0xFD58 /end MEASUREMENT
/begin MEASUREMENT B_fwe "Bedingung Faktor Wiedereinsetzen" UWORD B_TRUE 1 100 0 1 BIT_MASK 0x2000 FORMAT "%13.11" ECU_ADDRESS 0xFD60 /end MEASUREMENT
/begin MEASUREMENT B_grabz "Bedingung unplausibler Botschaftszähler GRA-Botschaft" UWORD B_TRUE 1 100 0 1 BIT_MASK 0x2000 FORMAT "%13.11" ECU_ADDRESS 0xFD52 /end MEASUREMENT
/begin MEASUREMENT B_grabz1 "Bedinung Botschaftszähler GRA: Zählerstandsänderung  nicht kontinuierlich" UWORD B_TRUE 1 100 0 1 BIT_MASK 0x4000 FORMAT "%13.11" ECU_ADDRESS 0xFD52 /end MEASUREMENT
/begin MEASUREMENT B_grabz2 "Bedingung Botschaftszähler GRA: Zählerstand  steht" UWORD B_TRUE 1 100 0 1 BIT_MASK 0x8000 FORMAT "%13.11" ECU_ADDRESS 0xFD52 /end MEASUREMENT
/begin MEASUREMENT B_hag "Bedingung Höhenadaption gültig" UWORD B_TRUE 1 100 0 1 BIT_MASK 0x400 FORMAT "%13.11" ECU_ADDRESS 0xFD56 /end MEASUREMENT
/begin MEASUREMENT B_hpwmcs "Bedingung PWM-Crash-Sensor-Signal i.O." UBYTE B_TRUE 1 100 0 1 BIT_MASK 0x4 FORMAT "%13.11" ECU_ADDRESS 0x380BEB /end MEASUREMENT
/begin MEASUREMENT B_kfvswk "Bedingung Konstantfahrt vor Setzwertkorrektur" UBYTE B_TRUE 1 100 0 1 BIT_MASK 0x1 FORMAT "%13.11" ECU_ADDRESS 0x380A13 /end MEASUREMENT
/begin MEASUREMENT B_kfvswkb "Bedingung: Setzwertkorrektur nach Beschleunigung" UBYTE B_TRUE 1 100 0 1 BIT_MASK 0x2 FORMAT "%13.11" ECU_ADDRESS 0x380A13 /end MEASUREMENT
/begin MEASUREMENT B_kfvswkv "Bedingung: Setzwertkorrektur nach Verzögerung" UBYTE B_TRUE 1 100 0 1 BIT_MASK 0x4 FORMAT "%13.11" ECU_ADDRESS 0x380A13 /end MEASUREMENT
/begin MEASUREMENT B_kfwee "Bedingung Kennfeld KFWEE aktiv" UWORD B_TRUE 1 100 0 1 BIT_MASK 0x20 FORMAT "%13.11" ECU_ADDRESS 0xFD5A /end MEASUREMENT
/begin MEASUREMENT B_klafbg "Eingangsgröße für KLAF ist begrenzt" UBYTE B_TRUE 1 100 0 1 BIT_MASK 0x2 FORMAT "%13.11" ECU_ADDRESS 0x380A24 /end MEASUREMENT
/begin MEASUREMENT B_kuppl "Bedingung Kupplungspedal betätigt" UWORD B_TRUE 1 100 0 1 BIT_MASK 0x100 FORMAT "%13.11" ECU_ADDRESS 0xFD4C /end MEASUREMENT
/begin MEASUREMENT B_kupplv "Bedingung Kupplung betätigt verzögert" UWORD B_TRUE 1 100 0 1 BIT_MASK 0x200 FORMAT "%13.11" ECU_ADDRESS 0xFD4C /end MEASUREMENT
/begin MEASUREMENT B_lawlon "lamwl_w ist aktiv" UWORD B_TRUE 1 100 0 1 BIT_MASK 0x80 FORMAT "%13.11" ECU_ADDRESS 0xFD5E /end MEASUREMENT
/begin MEASUREMENT B_ldrugd "Bedingung ungedrosselt, Freigabe durch LDR" UWORD B_TRUE 1 100 0 1 BIT_MASK 0x40 FORMAT "%13.11" ECU_ADDRESS 0xFD58 /end MEASUREMENT
/begin MEASUREMENT B_llvfgr "Bedingung Leerlauf-Verbot vom FGR" UBYTE B_TRUE 1 100 0 1 BIT_MASK 0x2 FORMAT "%13.11" ECU_ADDRESS 0x380A18 /end MEASUREMENT
/begin MEASUREMENT B_luecke "Aktuelles Segment liegt über der Referenzlücke" UWORD B_TRUE 1 100 0 1 BIT_MASK 0x2000 FORMAT "%13.11" ECU_ADDRESS 0xFD2C /end MEASUREMENT
/begin MEASUREMENT B_mfact "Bedingung Medianfilter aktiv" UBYTE B_TRUE 1 100 0 1 BIT_MASK 0x4 FORMAT "%13.11" ECU_ADDRESS 0x380A24 /end MEASUREMENT
/begin MEASUREMENT B_mluecke "Bedingung mittleres Lückensegment bei Motoren mit ungerader Zylinderanzahl" UWORD B_TRUE 1 100 0 1 BIT_MASK 0x4000 FORMAT "%13.11" ECU_ADDRESS 0xFD2C /end MEASUREMENT
/begin MEASUREMENT B_mrfamx "Vorlagerungswinkel über maximales Fahrerwunschmomment aktiv" UWORD B_TRUE 1 100 0 1 BIT_MASK 0x40 FORMAT "%13.11" ECU_ADDRESS 0xFD5A /end MEASUREMENT
/begin MEASUREMENT B_msrakt "MSR-Funktion aktiviert" UWORD B_TRUE 1 100 0 1 BIT_MASK 0x10 FORMAT "%13.11" ECU_ADDRESS 0xFD20 /end MEASUREMENT
/begin MEASUREMENT B_msrdis "Bedingung MSR-Eingriff nicht zugelassen" UWORD B_TRUE 1 100 0 1 BIT_MASK 0x20 FORMAT "%13.11" ECU_ADDRESS 0xFD20 /end MEASUREMENT
/begin MEASUREMENT B_msrphnpl "Bedingung MSR-Eingriff physikalisch nicht plausibel" UWORD B_TRUE 1 100 0 1 BIT_MASK 0x40 FORMAT "%13.11" ECU_ADDRESS 0xFD20 /end MEASUREMENT
/begin MEASUREMENT B_msrtnpl "Bedingung MSR-Eingriff aufgrund Topffunktion nicht plausibel" UWORD B_TRUE 1 100 0 1 BIT_MASK 0x80 FORMAT "%13.11" ECU_ADDRESS 0xFD20 /end MEASUREMENT
/begin MEASUREMENT B_msrvnpl "Bedingung MSR-Eingriff aufgrund Geschwindigkeitsschwelle nicht plausibel" UWORD B_TRUE 1 100 0 1 BIT_MASK 0x100 FORMAT "%13.11" ECU_ADDRESS 0xFD20 /end MEASUREMENT
/begin MEASUREMENT B_msr_can "Bedingung MSR-Anforderung über CAN" UWORD B_TRUE 1 100 0 1 BIT_MASK 0x200 FORMAT "%13.11" ECU_ADDRESS 0xFD20 /end MEASUREMENT
/begin MEASUREMENT B_neamsr "Bedingung Nachrichtenempfang Botschaft Bremse 1" UWORD B_TRUE 1 100 0 1 BIT_MASK 0x400 FORMAT "%13.11" ECU_ADDRESS 0xFD20 /end MEASUREMENT
/begin MEASUREMENT B_nebr3 "Bedingung Nachrichtenempfang Botschaft Bremse 3" UWORD B_TRUE 1 100 0 1 BIT_MASK 0x800 FORMAT "%13.11" ECU_ADDRESS 0xFD20 /end MEASUREMENT
/begin MEASUREMENT B_nmin "Bedingung Unterdrehzahl: n < NMIN" UWORD B_TRUE 1 100 0 1 BIT_MASK 0x8000 FORMAT "%13.11" ECU_ADDRESS 0xFD2C /end MEASUREMENT
/begin MEASUREMENT B_nmot "Bedingung Motordrehzahl: n > NMIN" UWORD B_TRUE 1 100 0 1 BIT_MASK 0x1 FORMAT "%13.11" ECU_ADDRESS 0xFD2E /end MEASUREMENT
/begin MEASUREMENT B_nobm "Bedingung BM-Lücke nach > 60 Zähnen nicht gefunden" UWORD B_TRUE 1 100 0 1 BIT_MASK 0x2 FORMAT "%13.11" ECU_ADDRESS 0xFD2E /end MEASUREMENT
/begin MEASUREMENT B_nobm1 "Bedingung 1. BM-Lücke nach Synchronisation nicht gefunden" UBYTE B_TRUE 1 100 0 1 BIT_MASK 0x1 FORMAT "%13.11" ECU_ADDRESS 0x38311C /end MEASUREMENT
/begin MEASUREMENT B_nomsr_fr "kein ASR-/MSR-Eingriff vom FR" UWORD B_TRUE 1 100 0 1 BIT_MASK 0x1000 FORMAT "%13.11" ECU_ADDRESS 0xFD20 /end MEASUREMENT
/begin MEASUREMENT B_nomsr_t "Bedingung MSR-Momentenvorgabe in diesem ME-SG nicht übernommen" UWORD B_TRUE 1 100 0 1 BIT_MASK 0x2000 FORMAT "%13.11" ECU_ADDRESS 0xFD20 /end MEASUREMENT
/begin MEASUREMENT B_noph "Phasengebersignal nicht gefunden" UWORD B_TRUE 1 100 0 1 BIT_MASK 0x4 FORMAT "%13.11" ECU_ADDRESS 0xFD2E /end MEASUREMENT
/begin MEASUREMENT B_npcanswe "Bedingung Schlechtwegeinfo (CAN) nicht plausibel" UWORD B_TRUE 1 100 0 1 BIT_MASK 0x4000 FORMAT "%13.11" ECU_ADDRESS 0xFD20 /end MEASUREMENT
/begin MEASUREMENT B_ntini "KR: Bedingung für Initialisierungs-Nulltest" UWORD B_TRUE 1 100 0 1 BIT_MASK 0x100 FORMAT "%13.11" ECU_ADDRESS 0xFD70 /end MEASUREMENT
/begin MEASUREMENT B_nuamsr "Bedingung Nachrichtenunterbrechung bei ASR/MSR" UWORD B_TRUE 1 100 0 1 BIT_MASK 0x8000 FORMAT "%13.11" ECU_ADDRESS 0xFD20 /end MEASUREMENT
/begin MEASUREMENT B_nugra "Bedingung Nachrichtenunterbrechung GRA-Botschaft" UWORD B_TRUE 1 100 0 1 BIT_MASK 0x1 FORMAT "%13.11" ECU_ADDRESS 0xFD54 /end MEASUREMENT
/begin MEASUREMENT B_pgxqsyn "Umschaltbedingung Phasengeber PG/PG2 für Schnellstart" UWORD B_TRUE 1 100 0 1 BIT_MASK 0x8 FORMAT "%13.11" ECU_ADDRESS 0xFD2E /end MEASUREMENT
/begin MEASUREMENT B_phaact "Bedingung Signal Phasensensor 1 high activ" UWORD B_TRUE 1 100 0 1 BIT_MASK 0x10 FORMAT "%13.11" ECU_ADDRESS 0xFD2E /end MEASUREMENT
/begin MEASUREMENT B_phase "Bedingung Phase low/high" UWORD B_TRUE 1 100 0 1 BIT_MASK 0x20 FORMAT "%13.11" ECU_ADDRESS 0xFD2E /end MEASUREMENT
/begin MEASUREMENT B_phw "Bedingung Phasenwechsel seit letztem Zahn während BM-Suche" UWORD B_TRUE 1 100 0 1 BIT_MASK 0x40 FORMAT "%13.11" ECU_ADDRESS 0xFD2E /end MEASUREMENT
/begin MEASUREMENT B_phwneg "Bedingung negative Phasenflanke im Schnellstart ausgewertet" UWORD B_TRUE 1 100 0 1 BIT_MASK 0x80 FORMAT "%13.11" ECU_ADDRESS 0xFD2E /end MEASUREMENT
/begin MEASUREMENT B_phwok "Bedingung Phasenwechsel erkannt" UWORD B_TRUE 1 100 0 1 BIT_MASK 0x100 FORMAT "%13.11" ECU_ADDRESS 0xFD2E /end MEASUREMENT
/begin MEASUREMENT B_phwpos "Bedingung positive Phasenflanke im Schnellstart ausgewertet" UWORD B_TRUE 1 100 0 1 BIT_MASK 0x200 FORMAT "%13.11" ECU_ADDRESS 0xFD2E /end MEASUREMENT
/begin MEASUREMENT B_pwmcs "Crash erkannt" UBYTE B_TRUE 1 100 0 1 BIT_MASK 0x1 FORMAT "%13.11" ECU_ADDRESS 0x383253 /end MEASUREMENT
/begin MEASUREMENT B_pwmcs_50ms "" UWORD B_TRUE 1 100 0 1 BIT_MASK 0x4000 FORMAT "%13.11" ECU_ADDRESS 0xFDB0 /end MEASUREMENT
/begin MEASUREMENT B_pwmfcs "Bedingung PWM-Signal vom Airbag-SG fehlerhaft" UWORD B_TRUE 1 100 0 1 BIT_MASK 0x8000 FORMAT "%13.11" ECU_ADDRESS 0xFDB0 /end MEASUREMENT
/begin MEASUREMENT B_qsyn "Bedingung Schnelle Synchronisation (quick)" UWORD B_TRUE 1 100 0 1 BIT_MASK 0x400 FORMAT "%13.11" ECU_ADDRESS 0xFD2E /end MEASUREMENT
/begin MEASUREMENT B_redkl "Freigabe Reduzierung ÜK-K- und -L-Anteil" UWORD B_TRUE 1 100 0 1 BIT_MASK 0x100 FORMAT "%13.11" ECU_ADDRESS 0xFD62 /end MEASUREMENT
/begin MEASUREMENT B_rfkuka "Bedingung Korrekturfaktor rücksetzen (ÜK-Adaption)" UWORD B_TRUE 1 100 0 1 BIT_MASK 0x800 FORMAT "%13.11" ECU_ADDRESS 0xFD68 /end MEASUREMENT
/begin MEASUREMENT B_rfkuka2 "Bedingung Korrekturfaktor rücksetzen (Bank 2) (ÜK-Adaption)" UWORD B_TRUE 1 100 0 1 BIT_MASK 0x1000 FORMAT "%13.11" ECU_ADDRESS 0xFD68 /end MEASUREMENT
/begin MEASUREMENT B_savfgr "Bedingung: Schubabschalteverbot durch FGR" UBYTE B_TRUE 1 100 0 1 BIT_MASK 0x4 FORMAT "%13.11" ECU_ADDRESS 0x380A18 /end MEASUREMENT
/begin MEASUREMENT B_savmsr "Bedingung Schubabschalteverbot bei MSR-Anforderung" UWORD B_TRUE 1 100 0 1 BIT_MASK 0x1 FORMAT "%13.11" ECU_ADDRESS 0xFD22 /end MEASUREMENT
/begin MEASUREMENT B_startini "Startbit für Erkennung der ersten Synchronisation nach KL15 ein" UWORD B_TRUE 1 100 0 1 BIT_MASK 0x800 FORMAT "%13.11" ECU_ADDRESS 0xFD2E /end MEASUREMENT
/begin MEASUREMENT B_stmodt "Bedingung Umschaltung auf Modelltemperatur" UBYTE B_TRUE 1 100 0 1 BIT_MASK 0x4 FORMAT "%13.11" ECU_ADDRESS 0x380A5D /end MEASUREMENT
/begin MEASUREMENT B_stndfr "Freigabe Füllungsregler nach Start" UWORD B_TRUE 1 100 0 1 BIT_MASK 0x10 FORMAT "%13.11" ECU_ADDRESS 0xFD58 /end MEASUREMENT
/begin MEASUREMENT B_stprel "Bedingung Entprellung von Drehzahlgebersignal gestartet" UBYTE B_TRUE 1 100 0 1 BIT_MASK 0x1 FORMAT "%13.11" ECU_ADDRESS 0x38097B /end MEASUREMENT
/begin MEASUREMENT B_swecan "Bedingung Schlechtwegstrecke CAN-Rohsignal" UWORD B_TRUE 1 100 0 1 BIT_MASK 0x2 FORMAT "%13.11" ECU_ADDRESS 0xFD22 /end MEASUREMENT
/begin MEASUREMENT B_swe_b "Bedingung Schlechtwegstrecke erkannt duch Bit über CAN (aus ABS-SG)" UWORD B_TRUE 1 100 0 1 BIT_MASK 0x4 FORMAT "%13.11" ECU_ADDRESS 0xFD22 /end MEASUREMENT
/begin MEASUREMENT B_syn "Bedingung Synchronisation erfolgt" UWORD B_TRUE 1 100 0 1 BIT_MASK 0x1000 FORMAT "%13.11" ECU_ADDRESS 0xFD2E /end MEASUREMENT
/begin MEASUREMENT B_synbmale "Bedingung: Kein Phasengeber für Synchronisation vorhanden" UWORD B_TRUE 1 100 0 1 BIT_MASK 0x2000 FORMAT "%13.11" ECU_ADDRESS 0xFD2E /end MEASUREMENT
/begin MEASUREMENT B_synph "Bedingung Synchronisation Phase" UWORD B_TRUE 1 100 0 1 BIT_MASK 0x4000 FORMAT "%13.11" ECU_ADDRESS 0xFD2E /end MEASUREMENT
/begin MEASUREMENT B_tairmx "" UWORD B_TRUE 1 100 0 1 BIT_MASK 0x1 FORMAT "%13.11" ECU_ADDRESS 0xFDB2 /end MEASUREMENT
/begin MEASUREMENT B_tairnu "" UWORD B_TRUE 1 100 0 1 BIT_MASK 0x2 FORMAT "%13.11" ECU_ADDRESS 0xFDB2 /end MEASUREMENT
/begin MEASUREMENT B_tal "Bedingung Tank leer bzw. Reserve" UBYTE B_TRUE 1 100 0 1 BIT_MASK 0x1 FORMAT "%13.11" ECU_ADDRESS 0x38312C /end MEASUREMENT
/begin MEASUREMENT B_talval "Bedingung : Bit Tank leer gültig" UWORD B_TRUE 1 100 0 1 BIT_MASK 0x40 FORMAT "%13.11" ECU_ADDRESS 0xFD3E /end MEASUREMENT
/begin MEASUREMENT B_tcrcan "" UWORD B_TRUE 1 100 0 1 BIT_MASK 0x4 FORMAT "%13.11" ECU_ADDRESS 0xFDB2 /end MEASUREMENT
/begin MEASUREMENT B_tgramx "" UWORD B_TRUE 1 100 0 1 BIT_MASK 0x2 FORMAT "%13.11" ECU_ADDRESS 0xFD54 /end MEASUREMENT
/begin MEASUREMENT B_tgranu "" UWORD B_TRUE 1 100 0 1 BIT_MASK 0x4 FORMAT "%13.11" ECU_ADDRESS 0xFD54 /end MEASUREMENT
/begin MEASUREMENT B_tmkib "Bedingung: Motortemperatur vom Kombiinstrument betriebsbereit" UWORD B_TRUE 1 100 0 1 BIT_MASK 0x2000 FORMAT "%13.11" ECU_ADDRESS 0xFD6A /end MEASUREMENT
/begin MEASUREMENT B_tmnuka "Bedingung: Minimalzeit zwischen 2 Adaptionsvorgänge läuft" UWORD B_TRUE 1 100 0 1 BIT_MASK 0x2000 FORMAT "%13.11" ECU_ADDRESS 0xFD68 /end MEASUREMENT
/begin MEASUREMENT B_tootaus "Bedingung B_fgrhs und B_fgrhsc für TOOTAUS nicht gesetzt" UBYTE B_TRUE 1 100 0 1 BIT_MASK 0x20 FORMAT "%13.11" ECU_ADDRESS 0x3809BE /end MEASUREMENT
/begin MEASUREMENT B_tootein "Bedingung B_fgrhs für TOOTEIN betätigt" UBYTE B_TRUE 1 100 0 1 BIT_MASK 0x40 FORMAT "%13.11" ECU_ADDRESS 0x3809BE /end MEASUREMENT
/begin MEASUREMENT B_tootulb "Bedingung ON/OFF-Taster GRA unplausibel lange betätigt" UBYTE B_TRUE 1 100 0 1 BIT_MASK 0x80 FORMAT "%13.11" ECU_ADDRESS 0x3809BE /end MEASUREMENT
/begin MEASUREMENT B_tpnt_aw "KR: Auswahl Nulltest oder Testimpuls" UWORD B_TRUE 1 100 0 1 BIT_MASK 0x200 FORMAT "%13.11" ECU_ADDRESS 0xFD70 /end MEASUREMENT
/begin MEASUREMENT B_tpnt_e "KR: Nulltest/Testimpuls freigegeben" UWORD B_TRUE 1 100 0 1 BIT_MASK 0x400 FORMAT "%13.11" ECU_ADDRESS 0xFD70 /end MEASUREMENT
/begin MEASUREMENT B_tveingats "" UBYTE B_TRUE 1 100 0 1 BIT_MASK 0x8 FORMAT "%13.11" ECU_ADDRESS 0x380A5D /end MEASUREMENT
/begin MEASUREMENT B_ubats "Bedingung: Mindestbatteriespannung für Abgastemperatursensor überschritten" UWORD B_TRUE 1 100 0 1 BIT_MASK 0x400 FORMAT "%13.11" ECU_ADDRESS 0xFD66 /end MEASUREMENT
/begin MEASUREMENT B_ubvdkp "Bedingung Batteriespannung ausreichend für Verstärkung von DK-Poti 1" UWORD B_TRUE 1 100 0 1 BIT_MASK 0x8000 FORMAT "%13.11" ECU_ADDRESS 0xFD42 /end MEASUREMENT
/begin MEASUREMENT B_udk1nv "Bedingung Spannung DK-Poti 1 oberhalb des Verstärkungsbereichs" UWORD B_TRUE 1 100 0 1 BIT_MASK 0x1 FORMAT "%13.11" ECU_ADDRESS 0xFD44 /end MEASUREMENT
/begin MEASUREMENT B_ugds "DK-Sollwinkel im ungedrosselten Bereich" UBYTE B_TRUE 1 100 0 1 BIT_MASK 0x8 FORMAT "%13.11" ECU_ADDRESS 0x380A24 /end MEASUREMENT
/begin MEASUREMENT B_uk1 "Einschaltbedingung Übergangskompensation" UWORD B_TRUE 1 100 0 1 BIT_MASK 0x200 FORMAT "%13.11" ECU_ADDRESS 0xFD62 /end MEASUREMENT
/begin MEASUREMENT B_uka "Freigabebedingung ÜK-Adaption" UWORD B_TRUE 1 100 0 1 BIT_MASK 0x4000 FORMAT "%13.11" ECU_ADDRESS 0xFD68 /end MEASUREMENT
/begin MEASUREMENT B_uka2 "Freigabebedingung ÜK-Adaption Zylinderbank 2" UWORD B_TRUE 1 100 0 1 BIT_MASK 0x8000 FORMAT "%13.11" ECU_ADDRESS 0xFD68 /end MEASUREMENT
/begin MEASUREMENT B_ukab "Bedingung gültiger Betriebsbereich für adaptive ÜK" UWORD B_TRUE 1 100 0 1 BIT_MASK 0x1 FORMAT "%13.11" ECU_ADDRESS 0xFD6A /end MEASUREMENT
/begin MEASUREMENT B_ukabat "Bedingung Beschleunigung totzeitverschoben (ÜK-Adaption)" UWORD B_TRUE 1 100 0 1 BIT_MASK 0x2 FORMAT "%13.11" ECU_ADDRESS 0xFD6A /end MEASUREMENT
/begin MEASUREMENT B_ukaukat "Bedingung:UK-Aktivität Anfang totzeitverschoben" UWORD B_TRUE 1 100 0 1 BIT_MASK 0x4 FORMAT "%13.11" ECU_ADDRESS 0xFD6A /end MEASUREMENT
/begin MEASUREMENT B_ukauket "Bedingung: UK-Aktivität Ende totzeitverschoben" UWORD B_TRUE 1 100 0 1 BIT_MASK 0x8 FORMAT "%13.11" ECU_ADDRESS 0xFD6A /end MEASUREMENT
/begin MEASUREMENT B_ukava "Bedingung Verzögerung (ÜK-Adaption)" UWORD B_TRUE 1 100 0 1 BIT_MASK 0x10 FORMAT "%13.11" ECU_ADDRESS 0xFD6A /end MEASUREMENT
/begin MEASUREMENT B_ukavat "Bedingung Verzögerung totzeitverschoben (ÜK-Adaption)" UWORD B_TRUE 1 100 0 1 BIT_MASK 0x20 FORMAT "%13.11" ECU_ADDRESS 0xFD6A /end MEASUREMENT
/begin MEASUREMENT B_uke "Einschaltbedingung ÜK-Ersatzwert" UWORD B_TRUE 1 100 0 1 BIT_MASK 0x400 FORMAT "%13.11" ECU_ADDRESS 0xFD62 /end MEASUREMENT
/begin MEASUREMENT B_ukg "Bedingung Ük wirkt stark" UWORD B_TRUE 1 100 0 1 BIT_MASK 0x800 FORMAT "%13.11" ECU_ADDRESS 0xFD62 /end MEASUREMENT
/begin MEASUREMENT B_ukk "Einschaltbedingung ÜK Kurzzeit-Anteil" UWORD B_TRUE 1 100 0 1 BIT_MASK 0x1000 FORMAT "%13.11" ECU_ADDRESS 0xFD62 /end MEASUREMENT
/begin MEASUREMENT B_ukns "Einschaltbedingung ÜK nach Start" UWORD B_TRUE 1 100 0 1 BIT_MASK 0x2000 FORMAT "%13.11" ECU_ADDRESS 0xFD62 /end MEASUREMENT
/begin MEASUREMENT B_va "Bedingung Verzögerungsabmagerung (Anzeige)" UWORD B_TRUE 1 100 0 1 BIT_MASK 0x4000 FORMAT "%13.11" ECU_ADDRESS 0xFD62 /end MEASUREMENT
/begin MEASUREMENT B_vaau "Bedingung Verzögerungsabmagerung Aufteilung" UWORD B_TRUE 1 100 0 1 BIT_MASK 0x8000 FORMAT "%13.11" ECU_ADDRESS 0xFD62 /end MEASUREMENT
/begin MEASUREMENT B_vabsff "Bedingung Geschwindigkeit aus Bremsenbotschaft ist fehlerhaft" UWORD B_TRUE 1 100 0 1 BIT_MASK 0x8 FORMAT "%13.11" ECU_ADDRESS 0xFD22 /end MEASUREMENT
/begin MEASUREMENT B_vag "Bedingung starke Verzögerungsabmagerung" UWORD B_TRUE 1 100 0 1 BIT_MASK 0x1 FORMAT "%13.11" ECU_ADDRESS 0xFD64 /end MEASUREMENT
/begin MEASUREMENT B_vak "Bedingung Verzögerungsabmagerung K-Anteil" UWORD B_TRUE 1 100 0 1 BIT_MASK 0x2 FORMAT "%13.11" ECU_ADDRESS 0xFD64 /end MEASUREMENT
/begin MEASUREMENT B_vakl "Bedingung Verzögerungsabmagerung L- und K-Anteil" UWORD B_TRUE 1 100 0 1 BIT_MASK 0x4 FORMAT "%13.11" ECU_ADDRESS 0xFD64 /end MEASUREMENT
/begin MEASUREMENT B_val "Bedingung Verzögerungsabmagerung L-Anteil" UWORD B_TRUE 1 100 0 1 BIT_MASK 0x8 FORMAT "%13.11" ECU_ADDRESS 0xFD64 /end MEASUREMENT
/begin MEASUREMENT B_vradhlff "Bedingung Radgeschwindigkeit hinten links aus Bremsenbotschaft fehlerhaft" UWORD B_TRUE 1 100 0 1 BIT_MASK 0x10 FORMAT "%13.11" ECU_ADDRESS 0xFD22 /end MEASUREMENT
/begin MEASUREMENT B_vradhrff "Bedingung Radgeschwindigkeit hinten rechts aus Bremsenbotschaft fehlerhaft" UWORD B_TRUE 1 100 0 1 BIT_MASK 0x20 FORMAT "%13.11" ECU_ADDRESS 0xFD22 /end MEASUREMENT
/begin MEASUREMENT B_vradvlff "Bedingung Radgeschwindigkeit vorne links aus Bremsenbotschaft fehlerhaft" UWORD B_TRUE 1 100 0 1 BIT_MASK 0x40 FORMAT "%13.11" ECU_ADDRESS 0xFD22 /end MEASUREMENT
/begin MEASUREMENT B_vradvrff "Bedingung Radgeschwindigkeit vorne rechts aus Bremsenbotschaft fehlerhaft" UWORD B_TRUE 1 100 0 1 BIT_MASK 0x80 FORMAT "%13.11" ECU_ADDRESS 0xFD22 /end MEASUREMENT
/begin MEASUREMENT B_wdk12ev "Bedingung Vorläufiger Gleichlauffehler der DK-Potis" UWORD B_TRUE 1 100 0 1 BIT_MASK 0x2 FORMAT "%13.11" ECU_ADDRESS 0xFD44 /end MEASUREMENT
/begin MEASUREMENT B_wdk13ev "Bedingung Vorläufige Unplausibilität zw. DK-Poti 1 und Ersatzwert aus Füllung" UWORD B_TRUE 1 100 0 1 BIT_MASK 0x4 FORMAT "%13.11" ECU_ADDRESS 0xFD44 /end MEASUREMENT
/begin MEASUREMENT B_wdk1v "Bedingung Berechnung des DK-Winkels aus verstärktem Signal von Poti 1" UWORD B_TRUE 1 100 0 1 BIT_MASK 0x8 FORMAT "%13.11" ECU_ADDRESS 0xFD44 /end MEASUREMENT
/begin MEASUREMENT B_wdk23ev "Bedingung Vorläufige Unplausibilität zw. DK-Poti 2 und Ersatzwert aus Füllung" UWORD B_TRUE 1 100 0 1 BIT_MASK 0x10 FORMAT "%13.11" ECU_ADDRESS 0xFD44 /end MEASUREMENT
/begin MEASUREMENT B_wdk2sel "Bedingung DK-Winkel-Berechnung für Lageregler aus Poti 2" UWORD B_TRUE 1 100 0 1 BIT_MASK 0x20 FORMAT "%13.11" ECU_ADDRESS 0xFD44 /end MEASUREMENT
/begin MEASUREMENT B_wdk2st "Bedingung DK-Winkel-Berechnung für Lageregler temporär aus Poti 2" UWORD B_TRUE 1 100 0 1 BIT_MASK 0x40 FORMAT "%13.11" ECU_ADDRESS 0xFD44 /end MEASUREMENT
/begin MEASUREMENT B_wdkap "Bedingung: DK-Sollwert aus appl. Kennlinie bzw. im Start aus Startwinkel" UBYTE B_TRUE 1 100 0 1 BIT_MASK 0x10 FORMAT "%13.11" ECU_ADDRESS 0x380A24 /end MEASUREMENT
/begin MEASUREMENT B_wf "Bedingung Wandfilmberechnung" UWORD B_TRUE 1 100 0 1 BIT_MASK 0x10 FORMAT "%13.11" ECU_ADDRESS 0xFD64 /end MEASUREMENT
/begin MEASUREMENT B_zprel "Bedingung Zahnentprellung erfolgt" UWORD B_TRUE 1 100 0 1 BIT_MASK 0x8000 FORMAT "%13.11" ECU_ADDRESS 0xFD2E /end MEASUREMENT
/begin MEASUREMENT B_zztab "Bedingung: Zahnzeitentabelle gültig" UWORD B_TRUE 1 100 0 1 BIT_MASK 0x1 FORMAT "%13.11" ECU_ADDRESS 0xFD30 /end MEASUREMENT
/begin MEASUREMENT cpaw1 "Zähler für Poti 1 bei DK-Poti-Auswahl" UBYTE dez 1 100 0 255 FORMAT "%5.1" ECU_ADDRESS 0x3809C5 /end MEASUREMENT
/begin MEASUREMENT cpaw2 "Zähler für Poti 2 bei DK-Poti-Auswahl" UBYTE dez 1 100 0 255 FORMAT "%5.1" ECU_ADDRESS 0x3809C6 /end MEASUREMENT
/begin MEASUREMENT crshDetect "" UBYTE DEZ 1 100 0 255 FORMAT "%5.1" ECU_ADDRESS 0x380BEA /end MEASUREMENT
/begin MEASUREMENT cserk "detektierte Signalquelle Crash-Sensor-Signal" UBYTE DEZ 1 100 0 255 FORMAT "%5.1" ECU_ADDRESS 0x383252 /end MEASUREMENT
/begin MEASUREMENT cs_gra "berechnte Checksumme der GRA-Botschaft" UBYTE DEZ 1 100 0 255 FORMAT "%5.1" ECU_ADDRESS 0x380A1B /end MEASUREMENT
/begin MEASUREMENT ctbetip "Zeitzähler für Tip-Erkennung FGR-Taste Beschleunigen" UBYTE t20msxs_ub_b5p1 1 100 0 5.1 FORMAT "%5.3" ECU_ADDRESS 0x3809B7 /end MEASUREMENT
/begin MEASUREMENT ctdkp1 "Fehlerzeitzähler für Bereichsprüfung DK-Poti 1" UBYTE t10msxs_ub_b2p55 1 100 0 2.55 FORMAT "%5.3" ECU_ADDRESS 0x3809C7 /end MEASUREMENT
/begin MEASUREMENT ctdkp2 "Fehlerzeitzähler für Bereichsprüfung DK-Poti 2" UBYTE t10msxs_ub_b2p55 1 100 0 2.55 FORMAT "%5.3" ECU_ADDRESS 0x3809C8 /end MEASUREMENT
/begin MEASUREMENT ctdkpaw "Zeitzähler für DK-Poti-Auswahl" UBYTE t10msxs_ub_b2p55 1 100 0 2.55 FORMAT "%5.3" ECU_ADDRESS 0x3809C9 /end MEASUREMENT
/begin MEASUREMENT ctepfgrh "Zeitzähler für Entprellung Schalter FGR-Bedienteil" UBYTE t20msxs_ub_b5p1 1 100 0 5.1 FORMAT "%5.3" ECU_ADDRESS 0x3809B8 /end MEASUREMENT
/begin MEASUREMENT ctfgrab "Zeitzähler für Weitergabe der FGR-Abschaltung an die Funktionsüberwachung" UBYTE t20msxs_ub_b5p1 1 100 0 5.1 FORMAT "%5.3" ECU_ADDRESS 0x380A17 /end MEASUREMENT
/begin MEASUREMENT ctfgrhe "Zeitzähler für Erkennung FGR-Bedienhebelfehler" UBYTE t20msxs_ub_b5p1 1 100 0 5.1 FORMAT "%5.3" ECU_ADDRESS 0x3809B9 /end MEASUREMENT
/begin MEASUREMENT cthsnp "Zeitzähler für Erkennung FGR-Hauptschalter nicht plausibel" UBYTE t20msxs_ub_b5p1 1 100 0 5.1 FORMAT "%5.3" ECU_ADDRESS 0x3809BA /end MEASUREMENT
/begin MEASUREMENT ctootaus "Zeitzähler für Berechnung B_tootaus" UBYTE t20msxs_ub_b5p1 1 100 0 5.1 FORMAT "%5.3" ECU_ADDRESS 0x3809BB /end MEASUREMENT
/begin MEASUREMENT ctootein "Zeitzähler für Berechnung B_tootein" UBYTE t20msxs_ub_b5p1 1 100 0 5.1 FORMAT "%5.3" ECU_ADDRESS 0x3809BC /end MEASUREMENT
/begin MEASUREMENT ctootulb_w "Zeitzähler für Berechnung B_tootulb" UWORD t20msxs_uw_b1310 1 100 0 1310.7 FORMAT "%8.3" ECU_ADDRESS 0x381CB2 /end MEASUREMENT
/begin MEASUREMENT ctrerbr "Fehlerzähler für Bremsschalter-Plausibilisierung" UBYTE dez 1 100 0 255 FORMAT "%5.1" ECU_ADDRESS 0x383130 /end MEASUREMENT
/begin MEASUREMENT ctvetip "Zeitzähler für Tip-Erkennung FGR-Taste Verzögern" UBYTE t20msxs_ub_b5p1 1 100 0 5.1 FORMAT "%5.3" ECU_ADDRESS 0x3809BD /end MEASUREMENT
/begin MEASUREMENT ctwdk12 "Fehlerzeitzähler für Gleichlaufprüfung der DK-Potis" UBYTE t10msxs_ub_b2p55 1 100 0 2.55 FORMAT "%5.3" ECU_ADDRESS 0x3809CA /end MEASUREMENT
/begin MEASUREMENT ctwdk13 "Fehlerzeitzähler für Plausibilitätsprüfung DK-Poti 1 mit Ersatzwert aus Füllung" UBYTE t10msxs_ub_b2p55 1 100 0 2.55 FORMAT "%5.3" ECU_ADDRESS 0x3809CB /end MEASUREMENT
/begin MEASUREMENT ctwdk23 "Fehlerzeitzähler für Plausibilitätsprüfung DK-Poti 2 mit Ersatzwert aus Füllung" UBYTE t10msxs_ub_b2p55 1 100 0 2.55 FORMAT "%5.3" ECU_ADDRESS 0x3809CC /end MEASUREMENT
/begin MEASUREMENT dmrar_w "Delta Relatives Moment bei Abschaltrampe FGR" UWORD rel_uw_b200 1 100 0 199.997 FORMAT "%8.4" ECU_ADDRESS 0x381E26 /end MEASUREMENT
/begin MEASUREMENT dpdk_w "Druckabfall über Drosselklappe" UWORD p_uw_q0p039 1 100 0 2559.96 FORMAT "%8.3" ECU_ADDRESS 0x384AE0 /end MEASUREMENT
/begin MEASUREMENT dpgNvBits "" UBYTE dez 1 100 0 255 FORMAT "%5.1" ECU_ADDRESS 0x38311C /end MEASUREMENT
/begin MEASUREMENT dpvdkspu_w "delta zwischen Druck vor Drosselklappe und Umgebungsdruck" UWORD p_uw_q0p039 1 100 0 2559.96 FORMAT "%8.3" ECU_ADDRESS 0x384AC0 /end MEASUREMENT
/begin MEASUREMENT drkuke_w "Delta relative Kraftstoffmasse Ersatzwert" UWORD rel_uw_q0p1875 1 100 0 12287.8 FORMAT "%8.2" ECU_ADDRESS 0x3820C8 /end MEASUREMENT
/begin MEASUREMENT drlfue_w "Lastkorrektur des Füllungsreglers" SWORD rel_sw_q0p0234 1 100 -768 767.977 FORMAT "%8.4" ECU_ADDRESS 0x381F5E /end MEASUREMENT
/begin MEASUREMENT drlm_w "Soll- Istwertdifferenz des Luftmassenreglers" SWORD rel_sw_q0p0234 1 100 -768 767.977 FORMAT "%8.4" ECU_ADDRESS 0x381F60 /end MEASUREMENT
/begin MEASUREMENT drlsolmf_w "delta Sollfüllung für medianfilter" UWORD rel_uw_q0p0234 1 100 0 1535.98 FORMAT "%8.3" ECU_ADDRESS 0x381F6A /end MEASUREMENT
/begin MEASUREMENT dvfgr_w "Regelabweichung beim FGR" SWORD vfzg_sw_q0p00781 1 100 -256 255.992 FORMAT "%8.4" ECU_ADDRESS 0x381E28 /end MEASUREMENT
/begin MEASUREMENT dvivr_w "Differenz zwischen Ist- und Sollgeschwindigkeit beim FGR" UWORD vfzg_uw_q0p00781 1 100 0 511.992 FORMAT "%8.4" ECU_ADDRESS 0x381E2A /end MEASUREMENT
/begin MEASUREMENT dvzi_w "Differenz zwischen Ziel- und Istgeschwindigkeit" UWORD vfzg_uw_q0p0078125 1 100 0 511.992 FORMAT "%8.4" ECU_ADDRESS 0x381E1E /end MEASUREMENT
/begin MEASUREMENT dvzvi_w "Differenz zwischen Ziel- und Istgeschwindigkeit" SWORD vfzg_sw_q0p00781 1 100 -256 255.992 FORMAT "%8.4" ECU_ADDRESS 0x381E2C /end MEASUREMENT
/begin MEASUREMENT dwdkba_w "Gradient DK-Winkel" SWORD relDK_q0p02441 1 100 -800 799.976 FORMAT "%8.4" ECU_ADDRESS 0x381CF8 /end MEASUREMENT
/begin MEASUREMENT dwdksumx_w "Delta Sollwinkel Drosselklappe Beginn ungedrosselt bis Maximum" UWORD rel_uw_b100 1 100 0 99.9985 FORMAT "%8.5" ECU_ADDRESS 0x384AE2 /end MEASUREMENT
/begin MEASUREMENT dwdksut_w "Delta Sollwinkel Drosselklappe ab Beginn ungedrosselt bei Turbo motor" UWORD rel_uw_b100 1 100 0 99.9985 FORMAT "%8.5" ECU_ADDRESS 0x381F6C /end MEASUREMENT
/begin MEASUREMENT dwdks_w "Änderung des Drosselklappen-Sollwinkels" UWORD relDK_uw_b100 1 100 0 100 FORMAT "%8.4" ECU_ADDRESS 0x381FDC /end MEASUREMENT
/begin MEASUREMENT dwfk_w "Wandfilmmengendifferenz Kurzzeitanteil" SWORD rel_sw_q0p1875 1 100 -6144 6143.81 FORMAT "%8.3" ECU_ADDRESS 0x3820CA /end MEASUREMENT
/begin MEASUREMENT dwfl_w "Wandfilmmengendifferenz Langzeitanteil" SWORD rel_sw_q0p1875 1 100 -6144 6143.81 FORMAT "%8.3" ECU_ADDRESS 0x3820CC /end MEASUREMENT
/begin MEASUREMENT dwf_w "Wandfilmmengendifferenz" SWORD rel_sw_q0p1875 1 100 -6144 6143.81 FORMAT "%8.3" ECU_ADDRESS 0x3820CE /end MEASUREMENT
/begin MEASUREMENT edge_ctr "Index der Phasenflanke bei erkannter Schnellstartposition" SBYTE dez 1 100 -128 127 FORMAT "%5.1" ECU_ADDRESS 0xF8C4 /end MEASUREMENT
/begin MEASUREMENT esst_snm08gkub "" UWORD dez 1 100 0 65535 FORMAT "%8.2" ECU_ADDRESS 0x384AFE /end MEASUREMENT
/begin MEASUREMENT esst_srl08gkub "" UWORD dez 1 100 0 65535 FORMAT "%8.2" ECU_ADDRESS 0x384B00 /end MEASUREMENT
/begin MEASUREMENT fbakl_w "Faktor K- und L-Anteil der ÜK bei BA" SWORD fak_sw_b256 1 100 -256 255.992 FORMAT "%8.4" ECU_ADDRESS 0x384B32 /end MEASUREMENT
/begin MEASUREMENT fbans "Nachstartfaktor der ÜK bei BA" UBYTE fak_ub_b8 1 100 0 7.96875 FORMAT "%5.3" ECU_ADDRESS 0x384881 /end MEASUREMENT
/begin MEASUREMENT fbans_w "Nachstartfaktor der ÜK bei BA" UWORD fak_uw_b8 1 100 0 7.99988 FORMAT "%8.6" ECU_ADDRESS 0x384B34 /end MEASUREMENT
/begin MEASUREMENT fbavst_w "Faktor ÜK-Verstellung bei Beschleunigungsanreicherung" SWORD fak_sw_b256 1 100 -256 255.992 FORMAT "%8.4" ECU_ADDRESS 0x384B36 /end MEASUREMENT
/begin MEASUREMENT fgrbesilokbits "" UBYTE dez 1 100 0 255 FORMAT "%5.1" ECU_ADDRESS 0x380A11 /end MEASUREMENT
/begin MEASUREMENT fgrfulolokbits "" UBYTE dez 1 100 0 255 FORMAT "%5.1" ECU_ADDRESS 0x380A13 /end MEASUREMENT
/begin MEASUREMENT fgrreglausbits "" UBYTE dez 1 100 0 255 FORMAT "%5.1" ECU_ADDRESS 0x380A18 /end MEASUREMENT
/begin MEASUREMENT fgrregllokbits "" UBYTE dez 1 100 0 255 FORMAT "%5.1" ECU_ADDRESS 0x380A19 /end MEASUREMENT
/begin MEASUREMENT fho "Korrekturfaktor Höhe" UBYTE fak_ub_b4 1 100 0 3.98438 FORMAT "%5.3" ECU_ADDRESS 0x384860 /end MEASUREMENT
/begin MEASUREMENT fho_w "Korrekturfaktor Höhe (word)" UWORD fak_uw_b4 1 100 0 3.99994 FORMAT "%8.6" ECU_ADDRESS 0x384AC2 /end MEASUREMENT
/begin MEASUREMENT fkhfm "HFM-Korrekturfaktor" UBYTE fak_ub_b2 1 100 0 1.99219 FORMAT "%5.3" ECU_ADDRESS 0x380A1C /end MEASUREMENT
/begin MEASUREMENT fklafs_w "Faktor Ausfluß (KLAF) für wdks Bestimmung" UWORD fak_uw_b1 1 100 0 0.999985 FORMAT "%9.7" ECU_ADDRESS 0x381F6E /end MEASUREMENT
/begin MEASUREMENT fkukaba2_w "Korrekturfaktor ÜK-Adaption BA Bank 2" UWORD fak_uw_b4 1 100 0 3.99994 FORMAT "%8.6" ECU_ADDRESS 0x38215E /end MEASUREMENT
/begin MEASUREMENT fkukaba_w "Korrekturfaktor ÜK-Adaption BA" UWORD fak_uw_b4 1 100 0 3.99994 FORMAT "%8.6" ECU_ADDRESS 0x382160 /end MEASUREMENT
/begin MEASUREMENT fkukas_w "Korrekturfaktor aufsummiert ÜK-Adaption" UWORD fak_q0p0625 1 100 0 4095.94 FORMAT "%8.3" ECU_ADDRESS 0x382162 /end MEASUREMENT
/begin MEASUREMENT fkukava2_w "Korrekturfaktor ÜK-Adaption VA Bank 2" UWORD fak_uw_b4 1 100 0 3.99994 FORMAT "%8.6" ECU_ADDRESS 0x382164 /end MEASUREMENT
/begin MEASUREMENT fkukava_w "Korrekturfaktor ÜK-Adaption VA" UWORD fak_uw_b4 1 100 0 3.99994 FORMAT "%8.6" ECU_ADDRESS 0x382166 /end MEASUREMENT
/begin MEASUREMENT fmfkrakt "Mittenfrequenz für Bandpaßfilter Klopfregelung" UBYTE fmfkr_dez 1 100 0 255 FORMAT "%5.1" ECU_ADDRESS 0x380A73 /end MEASUREMENT
/begin MEASUREMENT fmfkraktol "Mittenfrequenz für Bandpaßfilter Klopfregelung, alter Wert" UBYTE fmfkr_dez 1 100 0 255 FORMAT "%5.1" ECU_ADDRESS 0x380A74 /end MEASUREMENT
/begin MEASUREMENT fpvdkds "Faktor Druck vor Drosselklappe von Drucksensor" UBYTE fak_ub_b4 1 100 0 3.98438 FORMAT "%5.3" ECU_ADDRESS 0x380A21 /end MEASUREMENT
/begin MEASUREMENT fpvdkdsl_w "Faktor Druck vor Drosselklappe von Ladedrucksensor (word)" UWORD fak_uw_b4 1 100 0 3.99994 FORMAT "%8.6" ECU_ADDRESS 0x381F0A /end MEASUREMENT
/begin MEASUREMENT fpvdkdsu_w "Faktor Druck vor Drosselklappe von Umgebungsdrucksensor (word)" UWORD fak_uw_b4 1 100 0 3.99994 FORMAT "%8.6" ECU_ADDRESS 0x384AC4 /end MEASUREMENT
/begin MEASUREMENT fpvdkds_w "Faktor Druck vor Drosselklappe von Drucksensor (word)" UWORD fak_uw_b4 1 100 0 3.99994 FORMAT "%8.6" ECU_ADDRESS 0x381F0C /end MEASUREMENT
/begin MEASUREMENT frhodkr_w "Faktor Luftdichtekorrektur für DK-Durchfluß korrigiert (word)" UWORD fak_uw_b2 1 100 0 1.99997 FORMAT "%8.6" ECU_ADDRESS 0x381F70 /end MEASUREMENT
/begin MEASUREMENT frhol_w "Faktor Luftdichte f(Ansauglufttemp., Höhe) 16-Bit" UWORD fak_uw_b2 1 100 0 1.99997 FORMAT "%8.6" ECU_ADDRESS 0x384AC6 /end MEASUREMENT
/begin MEASUREMENT fuedkLocalBits "" UBYTE dez 1 100 0 255 FORMAT "%5.1" ECU_ADDRESS 0x380A24 /end MEASUREMENT
/begin MEASUREMENT fuepmld_w "faktor für gleitenden Übergang Druckmittelwert (Referenzdruck) bei Turbo" UWORD fak_uw_b1 1 100 0 0.999985 FORMAT "%9.7" ECU_ADDRESS 0x384AE4 /end MEASUREMENT
/begin MEASUREMENT fukabak_w "ÜK-Adaptionsfaktor (kalter Motor) BA" UWORD fak_uw_b4 1 100 0 3.99994 FORMAT "%8.6" ECU_ADDRESS 0x383A84 /end MEASUREMENT
/begin MEASUREMENT fukabaw_w "ÜK-Adaptionsfaktor (warmer Motor) BA" UWORD fak_uw_b4 1 100 0 3.99994 FORMAT "%8.6" ECU_ADDRESS 0x383A86 /end MEASUREMENT
/begin MEASUREMENT fukaba_w "ÜK-Adaptions-Faktor BA" UWORD fak_uw_b4 1 100 0 3.99994 FORMAT "%8.6" ECU_ADDRESS 0x384BA8 /end MEASUREMENT
/begin MEASUREMENT fukavak_w "ÜK-Adaptionsfaktor (kalter Motor) VA" UWORD fak_uw_b4 1 100 0 3.99994 FORMAT "%8.6" ECU_ADDRESS 0x383A88 /end MEASUREMENT
/begin MEASUREMENT fukavaw_w "ÜK-Adaptionsfaktor (warmer Motor) VA" UWORD fak_uw_b4 1 100 0 3.99994 FORMAT "%8.6" ECU_ADDRESS 0x383A8A /end MEASUREMENT
/begin MEASUREMENT fukava_w "ÜK-Adaptions-Faktor VA" UWORD fak_uw_b4 1 100 0 3.99994 FORMAT "%8.6" ECU_ADDRESS 0x384BAA /end MEASUREMENT
/begin MEASUREMENT fvaklw_w "Faktor K- und L-Anteil der ÜK bei VA, gewichtet lambdaabhängigem Faktor fvaladif" SWORD fak_sw_b256 1 100 -256 255.992 FORMAT "%8.4" ECU_ADDRESS 0x3820D0 /end MEASUREMENT
/begin MEASUREMENT fvakl_w "Faktor K- und L-Anteil der ÜK bei VA" SWORD fak_sw_b256 1 100 -256 255.992 FORMAT "%8.4" ECU_ADDRESS 0x384B38 /end MEASUREMENT
/begin MEASUREMENT fvaladif "Wichtungsfaktor Verzögerungsabmagerung bei Labdaist > 1.0" UBYTE fak_ub_b1 1 100 0 0.996094 ECU_ADDRESS 0x380A57 /end MEASUREMENT
/begin MEASUREMENT fvans "Nachstartfaktor der ÜK bei VA" UBYTE fak_ub_b8 1 100 0 7.96875 FORMAT "%5.3" ECU_ADDRESS 0x384882 /end MEASUREMENT
/begin MEASUREMENT fvavst_w "Faktor ÜK-Verstellung bei Verzögerungsabmagerung" SWORD fak_sw_b256 1 100 -256 255.992 FORMAT "%8.4" ECU_ADDRESS 0x384B3A /end MEASUREMENT
/begin MEASUREMENT fwe "Faktor Wiedereinsetzen" UBYTE fak_ub_b2 1 100 0 1.99219 FORMAT "%5.3" ECU_ADDRESS 0x380A55 /end MEASUREMENT
/begin MEASUREMENT fwl "Faktor Warmlauf" UBYTE fak_ub_b2 1 100 0 1.99219 FORMAT "%5.3" ECU_ADDRESS 0x380A4F /end MEASUREMENT
/begin MEASUREMENT gaptooth "Stand des Zahnzählers zur Lückenabfrage" UBYTE dez 1 100 0 255 FORMAT "%5.1" ECU_ADDRESS 0xF8C5 /end MEASUREMENT
/begin MEASUREMENT ggdpgBitsKgs "" UBYTE dez 1 100 0 255 FORMAT "%5.1" ECU_ADDRESS 0x38097B /end MEASUREMENT
/begin MEASUREMENT GgdsasNvBits "" UBYTE dez 1 100 0 255 FORMAT "%5.1" ECU_ADDRESS 0x383131 /end MEASUREMENT
/begin MEASUREMENT GGFGRHlokbits0 "" UBYTE dez 1 100 0 255 FORMAT "%5.1" ECU_ADDRESS 0x3809BE /end MEASUREMENT
/begin MEASUREMENT GGFSTbits "" UBYTE dez 1 100 0 255 FORMAT "%5.1" ECU_ADDRESS 0x38312C /end MEASUREMENT
/begin MEASUREMENT igod_w "Integratorgradient für Nulltest-Diagnose Klopfregelung" SWORD tknockintgrad_sy 1 100 -3661.82 3661.71 FORMAT "%8.3" ECU_ADDRESS 0x3822CE /end MEASUREMENT
/begin MEASUREMENT igokr_w "Integratorgradient für Offsetkorrektur Klopfregelung (Word)" SWORD tknockintgrad_sy 1 100 -3661.82 3661.71 FORMAT "%8.3" ECU_ADDRESS 0x3822D0 /end MEASUREMENT
/begin MEASUREMENT ikr "Integratorwert Klopfregelung offsetkorrigiert" UBYTE spg_ub_b5 1 100 0 4.98047 FORMAT "%5.3" ARRAY_SIZE 8 ECU_ADDRESS 0xE3E1 /end MEASUREMENT
/begin MEASUREMENT ikrma "Integratorwert Klopfregelung Meßfensteranfang" UBYTE spg_ub_b5 1 100 0 4.98047 FORMAT "%5.3" ECU_ADDRESS 0x380A75 /end MEASUREMENT
/begin MEASUREMENT ikrme "Integratorwert Klopfregelung Meßfensterende" UBYTE spg_ub_b5 1 100 0 4.98047 FORMAT "%5.3" ARRAY_SIZE 8 ECU_ADDRESS 0xE3E9 /end MEASUREMENT
/begin MEASUREMENT ikrmen "Integratorwert Klopfregelung Meßfensterende Nulltest" UBYTE spg_ub_b5 1 100 0 4.98047 FORMAT "%5.3" ECU_ADDRESS 0x380A76 /end MEASUREMENT
/begin MEASUREMENT ikrmet "Integratorwert Klopfregelung Meßfensterende Testimpuls" UBYTE spg_ub_b5 1 100 0 4.98047 FORMAT "%5.3" ECU_ADDRESS 0x380A77 /end MEASUREMENT
/begin MEASUREMENT ikr_tst "Integratorwert Klopfregelung offsetkorregiert rollierend mit Zyl.zähler" UBYTE spg_ub_b5 1 100 0 4.98047 FORMAT "%5.3" ECU_ADDRESS 0x380A78 /end MEASUREMENT
/begin MEASUREMENT iokkr "Integratoroffsetkorrektur Klopfregelung" UBYTE spg_ub_b5 1 100 0 4.98047 FORMAT "%5.3" ECU_ADDRESS 0x380A79 /end MEASUREMENT
/begin MEASUREMENT kfgr_w "Verstärkungsfaktor FGR-Regler" UWORD rel_uw_b3200 1 100 0 3199.95 FORMAT "%8.3" ECU_ADDRESS 0x381E2E /end MEASUREMENT
/begin MEASUREMENT kldfpwm "Generatorsignal (Kl. DFM) als PWM-Signal filtriert" UBYTE rel_ub_b99p6 1 100 0 99.6094 FORMAT "%5.2" ECU_ADDRESS 0xF7B0 /end MEASUREMENT
/begin MEASUREMENT ks_sym "Eingang des Klopfauswerte-IC" UBYTE dez 1 100 0 255 FORMAT "%5.1" ARRAY_SIZE 4 ECU_ADDRESS 0xE3F1 /end MEASUREMENT
/begin MEASUREMENT lamnswl_w "Lambda-Motor-Soll für Nachstart und Warmlauf" UWORD fak_uw_b16 1 100 0 15.9998 FORMAT "%8.5" ECU_ADDRESS 0x38208A /end MEASUREMENT
/begin MEASUREMENT lamsbguk "lamsbg_w zur KF-Adressierung in der ESUK" UBYTE fak_ub_b4 1 100 0 3.98438 FORMAT "%5.3" ECU_ADDRESS 0x380A58 /end MEASUREMENT
/begin MEASUREMENT lamwlrl_w "Offset Lambda-Motor-Soll für Warmlauf" SWORD fak_sw_b8 1 100 -8 7.99976 FORMAT "%8.6" ECU_ADDRESS 0x38208C /end MEASUREMENT
/begin MEASUREMENT lamwl_w "Lambda-Motor-Soll für Warmlauf" UWORD fak_uw_b16 1 100 0 15.9998 FORMAT "%8.5" ECU_ADDRESS 0x38208E /end MEASUREMENT
/begin MEASUREMENT ldfki_w "Ladedruck Filterzeitkonstante aus Kennfeld" UWORD zk10msxs_uw_b655 1 100 0.0100002 655.36 FORMAT "%12.8" ECU_ADDRESS 0x381F0E /end MEASUREMENT
/begin MEASUREMENT len_hiseg "Länge des letzten 'high' Phasensegmentes im Schnellstart" UBYTE dez 1 100 0 255 FORMAT "%5.1" ECU_ADDRESS 0xF8C6 /end MEASUREMENT
/begin MEASUREMENT len_loseg "Länge des letzten 'low' Phasensegmentes im Schnellstart" UBYTE dez 1 100 0 255 FORMAT "%5.1" ECU_ADDRESS 0xF8C7 /end MEASUREMENT
/begin MEASUREMENT miasrllk "indiziertes Soll-Motormoment für langsamen ASR-Eingriff" UBYTE rel_ub_b99p6 1 100 0 99.6094 FORMAT "%5.2" ECU_ADDRESS 0x3808DE /end MEASUREMENT
/begin MEASUREMENT miasrl_can "Anforderung ""langsamer ASR-Eingriff"" über CAN" UBYTE rel_ub_b99p6 1 100 0 99.6094 FORMAT "%5.2" ECU_ADDRESS 0x3808DF /end MEASUREMENT
/begin MEASUREMENT miasrl_w "Indiziertes Soll-Motormoment ASR für langsamen Eingriff" UWORD rel_uw_b100 1 100 0 99.9985 FORMAT "%8.5" ECU_ADDRESS 0x380F2A /end MEASUREMENT
/begin MEASUREMENT miasrslk "indiziertes Soll-Motormoment für schnellen ASR-Eingriff" UBYTE rel_ub_b99p6 1 100 0 99.6094 FORMAT "%5.2" ECU_ADDRESS 0x3808E0 /end MEASUREMENT
/begin MEASUREMENT miasrs_can "Anforderung ""schneller ASR-Eingriff"" über CAN" UBYTE rel_ub_b99p6 1 100 0 99.6094 FORMAT "%5.2" ECU_ADDRESS 0x3808E1 /end MEASUREMENT
/begin MEASUREMENT miasrs_w "Indiziertes Soll-Motormoment ASR für schnellen Eingriff" UWORD rel_uw_b100 1 100 0 99.9985 FORMAT "%8.5" ECU_ADDRESS 0x380F2C /end MEASUREMENT
/begin MEASUREMENT mimsrlk "MSR-Eingriffsmoment" UBYTE rel_ub_b99p6 1 100 0 99.6094 FORMAT "%5.2" ECU_ADDRESS 0x3808E2 /end MEASUREMENT
/begin MEASUREMENT mimsrllk "" UBYTE rel_ub_b99p6 1 100 0 99.6094 FORMAT "%5.2" ECU_ADDRESS 0x3808E3 /end MEASUREMENT
/begin MEASUREMENT mimsr_can "MSR-Wunsch über CAN" UBYTE rel_ub_b99p6 1 100 0 99.6094 FORMAT "%5.2" ECU_ADDRESS 0x3808E4 /end MEASUREMENT
/begin MEASUREMENT mimsr_w "Indiziertes Soll-Motormoment MSR" UWORD rel_uw_b100 1 100 0 99.9985 FORMAT "%8.5" ECU_ADDRESS 0x380F2E /end MEASUREMENT
/begin MEASUREMENT mlhfmas_w "aufsummierte Luftmasse über ein Synchro" UWORD m_uw_b6553p5 1 100 0 6553.5 FORMAT "%8.3" ECU_ADDRESS 0xF9A4 /end MEASUREMENT
/begin MEASUREMENT mlhfma_w "Luftmassenabtastwert von HFM 16-Bit" UWORD m_uw_b6553p5 1 100 0 6553.5 FORMAT "%8.3" ECU_ADDRESS 0xF9A6 /end MEASUREMENT
/begin MEASUREMENT mlhfmm_w "Luftmassen HFM-Mittelwert 16Bit-Wert" UWORD m_uw_b6553p5 1 100 0 6553.5 FORMAT "%8.3" ECU_ADDRESS 0xF9A8 /end MEASUREMENT
/begin MEASUREMENT mlkge_w "Eingang in Kennfeld KLDPDK" UWORD m_uw_b6553p5 1 100 0 6553.5 FORMAT "%8.3" ECU_ADDRESS 0x384AE6 /end MEASUREMENT
/begin MEASUREMENT mlsol_w "Soll-Luftmassenstrom" UWORD m_uw_b6553p5 1 100 0 6553.5 FORMAT "%8.3" ECU_ADDRESS 0x381F72 /end MEASUREMENT
/begin MEASUREMENT mlwdknf_w "gefilterter normierter Luftmassenstrom für Sollwinkelbestimmung Drosselklappe" UWORD m_uw_b6553p5 1 100 0 6553.5 FORMAT "%8.3" ECU_ADDRESS 0x381F74 /end MEASUREMENT
/begin MEASUREMENT mrfgri_w "Relatives Moment Initialisierungswert für FGR-Regler" UWORD rel_uw_b200 1 100 0 199.997 FORMAT "%8.4" ECU_ADDRESS 0x381E30 /end MEASUREMENT
/begin MEASUREMENT mrfgr_w "Relative Momentenanforderung von FGR" UWORD rel_uw_b200 1 100 0 199.997 FORMAT "%8.4" ECU_ADDRESS 0x381E32 /end MEASUREMENT
/begin MEASUREMENT msdks_w "Soll-Luftmassenstrom durch Drosselvorrichtung" UWORD m_uw_b6553p5 1 100 0 6553.5 FORMAT "%8.3" ECU_ADDRESS 0x381F76 /end MEASUREMENT
/begin MEASUREMENT mshfms_w "Massenstrom HFM (signed Größe)" SWORD m_sw_b3276p8 1 100 -3276.8 3276.7 FORMAT "%8.3" ECU_ADDRESS 0xF9AA /end MEASUREMENT
/begin MEASUREMENT mshfm_w "Massenstrom HFM 16-Bit Größe" UWORD m_uw_b6553p5 1 100 0 6553.5 FORMAT "%8.3" ECU_ADDRESS 0xF9AC /end MEASUREMENT
/begin MEASUREMENT msndkoos_w "Normierter Luftmassenstrom für Sollwinkelbestimmung Drosselklappe" UWORD m_uw_b6553p5 1 100 0 6553.5 FORMAT "%8.3" ECU_ADDRESS 0x381F78 /end MEASUREMENT
/begin MEASUREMENT msndks_w "Normierter Soll-Luftmassenstrom durch Drosselvorrichtung" UWORD m_uw_b6553p5 1 100 0 6553.5 FORMAT "%8.3" ECU_ADDRESS 0x381F7A /end MEASUREMENT
/begin MEASUREMENT msrmdt_w "Inhalt des MSR-Plausibilitätstopfes" SWORD mdt_sw_b2556 1 100 -2556 2555.92 FORMAT "%8.3" ECU_ADDRESS 0x380F30 /end MEASUREMENT
/begin MEASUREMENT nsynggdpg "Neusynchronisationsmonitor für GGDPG" UBYTE dez 1 100 0 255 FORMAT "%5.1" ECU_ADDRESS 0x38097C /end MEASUREMENT
/begin MEASUREMENT plsol "Soll-Ladedruck" UBYTE p_ub_q10 1 100 0 2550 FORMAT "%5.0" ECU_ADDRESS 0x380A25 /end MEASUREMENT
/begin MEASUREMENT plsol_w "Soll-Ladedruck" UWORD p_uw_q0p039 1 100 0 2559.96 FORMAT "%8.3" ECU_ADDRESS 0x381F7C /end MEASUREMENT
/begin MEASUREMENT psfil_w "gefilteter Saugrohdruck für KLAF-Berechnung in FUEDK" UWORD p_uw_q0p039 1 100 0 2559.96 FORMAT "%8.3" ECU_ADDRESS 0x381F7E /end MEASUREMENT
/begin MEASUREMENT pspvmin_w "Minimalauswahl aus pspvdk und psspvdk" UWORD fak_uw_b2 1 100 0 1.99997 FORMAT "%8.6" ECU_ADDRESS 0x381F80 /end MEASUREMENT
/begin MEASUREMENT pssol_w "Sollsaugrohrdruck" UWORD p_uw_q0p039 1 100 0 2559.96 FORMAT "%8.3" ECU_ADDRESS 0x381F82 /end MEASUREMENT
/begin MEASUREMENT psspvdkb_w "Verhältnis Soll-Saugrohrdruck zu Druck vor Drosselklappe begrenzt" UWORD fak_uw_b2 1 100 0 1.99997 FORMAT "%8.6" ECU_ADDRESS 0x381F84 /end MEASUREMENT
/begin MEASUREMENT psspvdkd_w "Verhältnis Sollsaugrohrdruck/Druck vor Drosselklappe von Drucksensor (word)" UWORD fak_uw_b4 1 100 0 3.99994 FORMAT "%8.6" ECU_ADDRESS 0x381F10 /end MEASUREMENT
/begin MEASUREMENT psspvdk_w "Verhältnis Soll-Saugrohrdruck zu Druck vor Drosselklappe" UWORD fak_uw_b2 1 100 0 1.99997 FORMAT "%8.6" ECU_ADDRESS 0x381F86 /end MEASUREMENT
/begin MEASUREMENT pte "Tankdifferenzdruck, Eingangssignal, (nach AD-Wandler)" SBYTE p_sb_q0p25 1 100 -32 31.75 FORMAT "%5.2" ECU_ADDRESS 0x380B9B /end MEASUREMENT
/begin MEASUREMENT pterw "Tankdruckrohwert (8 Bit)" SBYTE p_sb_q0p625 1 100 -80 79.375 FORMAT "%5.2" ECU_ADDRESS 0x380B9C /end MEASUREMENT
/begin MEASUREMENT pterw_w "Tankdruckrohwert (16 Bit)" SWORD p_sw_q0p00244 1 100 -80 79.9976 FORMAT "%8.5" ECU_ADDRESS 0x382B20 /end MEASUREMENT
/begin MEASUREMENT pte_w "Tankdifferenzdruck (16 Bit)" SWORD p_sw_q0p000977 1 100 -32.0143 32.0134 FORMAT "%8.5" ECU_ADDRESS 0x382B22 /end MEASUREMENT
/begin MEASUREMENT pu "Umgebungsdruck" UBYTE p_ub_q5 1 100 0 1275 FORMAT "%5.0" ECU_ADDRESS 0x384861 /end MEASUREMENT
/begin MEASUREMENT pus_w "Umgebungsdruck ohne Umschaltung auf Ersatzwert bei Sensorfehler" UWORD p_uw_q0p039 1 100 0 2559.96 FORMAT "%8.3" ECU_ADDRESS 0x384AC8 /end MEASUREMENT
/begin MEASUREMENT pu_w "Umgebungsdruck" UWORD p_uw_q0p039 1 100 0 2559.96 FORMAT "%8.3" ECU_ADDRESS 0x384ACA /end MEASUREMENT
/begin MEASUREMENT pvdkds "Druck vor Drosselklappe von Drucksensor" UBYTE p_ub_q10 1 100 0 2550 FORMAT "%5.0" ECU_ADDRESS 0x380A22 /end MEASUREMENT
/begin MEASUREMENT pvdkdsl_w "Druck vor Drosselklappe von Ladedrucksensor (word)" UWORD p_uw_q0p039 1 100 0 2559.96 FORMAT "%8.3" ECU_ADDRESS 0x381F12 /end MEASUREMENT
/begin MEASUREMENT pvdkdsu_w "Druck vor Drosselklappe von Umgebungsdrucksensor (word)" UWORD p_uw_q0p039 1 100 0 2559.96 FORMAT "%8.3" ECU_ADDRESS 0x384ACC /end MEASUREMENT
/begin MEASUREMENT pvdkds_w "Druck vor Drosselklappe von Drucksensor (word)" UWORD p_uw_q0p039 1 100 0 2559.96 FORMAT "%8.3" ECU_ADDRESS 0x381F14 /end MEASUREMENT
/begin MEASUREMENT pvdkmx_w "Maximaler Druck vor Drosselklappe Ausgangswert aus Kennlinie PVDKMX" UWORD p_uw_q0p039 1 100 0 2559.96 FORMAT "%8.3" ECU_ADDRESS 0x381F16 /end MEASUREMENT
/begin MEASUREMENT pvdkr_w "Referenzdruck vor Drosselklappe" UWORD p_uw_q0p039 1 100 0 2559.96 FORMAT "%8.3" ECU_ADDRESS 0x381F88 /end MEASUREMENT
/begin MEASUREMENT pvdksf_w "gefilterter Druck vor Drosselklappe (Ladedruck) vom Drucksensor" UWORD p_uw_q0p039 1 100 0 2559.96 FORMAT "%8.3" ECU_ADDRESS 0x381F18 /end MEASUREMENT
/begin MEASUREMENT pvdkspud "Differenz zwischen Umgebungsdruck und Druck vor Drosselklappe" UBYTE p_ub_q10 1 100 0 2550 FORMAT "%5.0" ECU_ADDRESS 0x384862 /end MEASUREMENT
/begin MEASUREMENT pvdks_w "Druck vor Drosselklappe ohne Umschaltung auf Ersatzwert bei Sensorfehler" UWORD p_uw_q0p039 1 100 0 2559.96 FORMAT "%8.3" ECU_ADDRESS 0x381F1A /end MEASUREMENT
/begin MEASUREMENT qzzyl "Initialisierungswert Zylinderzähler bei B_qsyn" UBYTE dez 1 100 0 255 FORMAT "%5.1" ECU_ADDRESS 0x38097D /end MEASUREMENT
/begin MEASUREMENT rkuke_w "rel. Kraftstoffmasse Übergangskompensation Ersatzwert" SWORD rel_sw_q0p1875 1 100 -6144 6143.81 FORMAT "%8.3" ECU_ADDRESS 0x3820D2 /end MEASUREMENT
/begin MEASUREMENT rkukg_w "rel. Kraftstoffmasse Übergangskompensation" SWORD rel_sw_b1536 1 100 -1536 1535.95 FORMAT "%8.3" ECU_ADDRESS 0x3820D4 /end MEASUREMENT
/begin MEASUREMENT rkukkl_w "Kurz- und Langzeitanteil der UK" SWORD rel_sw_q0p1875 1 100 -6144 6143.81 FORMAT "%8.3" ECU_ADDRESS 0x3820D6 /end MEASUREMENT
/begin MEASUREMENT rkukkt_w "rk-Kurzzeitanteil der UK totzeitverschoben (UK-Adaption)" SWORD rel_sw_q0p1875 1 100 -6144 6143.81 FORMAT "%8.3" ECU_ADDRESS 0x382168 /end MEASUREMENT
/begin MEASUREMENT rkukk_w "rk-Kurzzeitanteil der UK" SWORD rel_sw_q0p1875 1 100 -6144 6143.81 FORMAT "%8.3" ECU_ADDRESS 0x3820D8 /end MEASUREMENT
/begin MEASUREMENT rkukl_w "rk-Langzeitanteil der UK" SWORD rel_sw_q0p1875 1 100 -6144 6143.81 FORMAT "%8.3" ECU_ADDRESS 0x3820DA /end MEASUREMENT
/begin MEASUREMENT rkuk_w "rel. Kraftstoffmasse Übergangskompensation ohne Verstelleingriffe" SWORD rel_sw_q0p1875 1 100 -6144 6143.81 FORMAT "%8.3" ECU_ADDRESS 0x3820DC /end MEASUREMENT
/begin MEASUREMENT rlfgks_w "Korrigierte relative  Sollfrischluft (Luft, die über DK und TEV fließt)" UWORD rel_uw_q0p0234 1 100 0 1535.98 FORMAT "%8.3" ECU_ADDRESS 0x381F8A /end MEASUREMENT
/begin MEASUREMENT rlshk "Soll-Füllung höhenkorrigiert" UBYTE rel_ub_q0p75 1 100 0 191.25 FORMAT "%5.1" ECU_ADDRESS 0x38486C /end MEASUREMENT
/begin MEASUREMENT rlvppl "Relative Luftfüllung (dichtekorrigiert) für Berechnung DK-Winkel-Ersatzwert" UBYTE rel_ub_q0p75 1 100 0 191.25 FORMAT "%5.1" ECU_ADDRESS 0x3809CD /end MEASUREMENT
/begin MEASUREMENT sdwfk_w "Speicherinhalt der Wandfilmdifferenz für Kurzzeitanteil" SWORD rel_sw_q0p1875 1 100 -6144 6143.81 FORMAT "%8.3" ECU_ADDRESS 0x3820DE /end MEASUREMENT
/begin MEASUREMENT sdwfl_w "Speicherinhalt der Wandfilmdifferenz für Langzeitanteil" SWORD rel_sw_q0p1875 1 100 -6144 6143.81 FORMAT "%8.3" ECU_ADDRESS 0x3820E0 /end MEASUREMENT
/begin MEASUREMENT sen_c95 "Klopfsensoreingang am Klopfauswerte-IC" UBYTE dezsub1 1 100 1 256 FORMAT "%5.1" ARRAY_SIZE 8 ECU_ADDRESS 0x380A7A /end MEASUREMENT
/begin MEASUREMENT stateQsyn "Zustand der Schnellstart State-Machine GEN_QSYN" UBYTE dez 1 100 0 255 FORMAT "%5.1" ECU_ADDRESS 0xF8C8 /end MEASUREMENT
/begin MEASUREMENT stfgrab_w "Statuswort Abschaltbedingungen Fahrgeschwindigkeitsregler" UWORD dez 1 100 0 65535 FORMAT "%8.2" ECU_ADDRESS 0x381E08 /end MEASUREMENT
/begin MEASUREMENT stfgrbs_w "Statuswort Bediensignale Fahrgeschwindigkeitsregler" UWORD dez 1 100 0 65535 FORMAT "%8.2" ECU_ADDRESS 0x381E14 /end MEASUREMENT
/begin MEASUREMENT stfgrfl "Statusbyte FGR-Funktionslogik" UBYTE dez 1 100 0 255 FORMAT "%5.1" ECU_ADDRESS 0x380A14 /end MEASUREMENT
/begin MEASUREMENT taatsr_w "Tastverhältnis Abgastemperatursensor ungefiltert" UWORD rel_uw_b100 1 100 0 99.9985 FORMAT "%8.5" ECU_ADDRESS 0x384B72 /end MEASUREMENT
/begin MEASUREMENT taats_w "Tastverhältnis Abgastemperatursensor" UWORD rel_uw_b100 1 100 0 99.9985 FORMAT "%8.5" ECU_ADDRESS 0x384B74 /end MEASUREMENT
/begin MEASUREMENT tabgta_kge "" UWORD rel_uw_b100 1 100 0 99.9985 FORMAT "%8.5" ECU_ADDRESS 0x384B76 /end MEASUREMENT
/begin MEASUREMENT tabg_w "Abgastemperatur" UWORD temp_uw_q0p0195_o50 1 100 -50 1229.98 FORMAT "%8.3" ECU_ADDRESS 0x384B78 /end MEASUREMENT
/begin MEASUREMENT tatsst_w "Abgastemperatur aus Sensor nach Startende" UWORD temp_uw_q0p0195_o50 1 100 -50 1229.98 FORMAT "%8.3" ECU_ADDRESS 0x384B7A /end MEASUREMENT
/begin MEASUREMENT tats_w "Abgastemperatur aus Sensor" UWORD temp_uw_q0p0195_o50 1 100 -50 1229.98 FORMAT "%8.3" ECU_ADDRESS 0x384B7C /end MEASUREMENT
/begin MEASUREMENT tfwdks_w "Zeitkonstante für wdks Filterung" UWORD zk10msxs_uw_b655 1 100 0.0100002 655.36 FORMAT "%12.8" ECU_ADDRESS 0x381F8C /end MEASUREMENT
/begin MEASUREMENT timtalr_w "Timer für Verzögerung Reset Bit Tank leer" UWORD t200msxs_uw_q0p2 1 100 0 13107 FORMAT "%8.2" ECU_ADDRESS 0x384A94 /end MEASUREMENT
/begin MEASUREMENT timtals_w "Timer für Verzögerung Setzen Bit Tank leer" UWORD t200msxs_uw_q0p2 1 100 0 13107 FORMAT "%8.2" ECU_ADDRESS 0x384A96 /end MEASUREMENT
/begin MEASUREMENT tmCorCtr_w "Zähler Lückenkorrektur bei fehlendem Zahn" UWORD dez 1 100 0 65535 FORMAT "%8.2" ECU_ADDRESS 0x381A7A /end MEASUREMENT
/begin MEASUREMENT tmfa_w "Meßfensteranfang Klopfregelung" UWORD tknockcon_sy 1 100 0 0.17476 FORMAT "%9.7" ECU_ADDRESS 0x3822D2 /end MEASUREMENT
/begin MEASUREMENT tmfln_w "Meßfensterlänge während Nulltest, KR" UWORD tknockcon_sy 1 100 0 0.17476 FORMAT "%9.7" ECU_ADDRESS 0x3822D4 /end MEASUREMENT
/begin MEASUREMENT tmfl_w "Meßfensterlänge Klopfregelung" UWORD tknockcon_sy 1 100 0 0.17476 FORMAT "%9.7" ECU_ADDRESS 0x3822D6 /end MEASUREMENT
/begin MEASUREMENT tmki "Motortemperatur aus Kombiinstrument" UBYTE temp_ub_q0p75_o48 1 100 -48 143.25 FORMAT "%5.1" ECU_ADDRESS 0x3848B2 /end MEASUREMENT
/begin MEASUREMENT tmnuka "Minimalzeit zwischen 2 Adaptionsvorgängen (ÜK-Adaption)" UWORD t10msxs_ub_b2p55 1 100 0 655.35 FORMAT "%8.4" ECU_ADDRESS 0x38216A /end MEASUREMENT
/begin MEASUREMENT tn2fgr_w "Doppelte Nennerzeitkonstante FGR-Regler" UWORD t20msxs_uw_q0p02 1 100 0 1310.7 FORMAT "%8.3" ECU_ADDRESS 0x381E34 /end MEASUREMENT
/begin MEASUREMENT tnbm1_w "Zahnperiodenzeit des zweitletzten NBM Signals" UWORD dez 1 100 0 65535 FORMAT "%8.2" ECU_ADDRESS 0x381A7C /end MEASUREMENT
/begin MEASUREMENT tnbm2_w "Zahnperiodenzeit des drittletzten NBM Signals" UWORD dez 1 100 0 65535 FORMAT "%8.2" ECU_ADDRESS 0x381A7E /end MEASUREMENT
/begin MEASUREMENT tnbm_w "Zahnperiodenzeit des letzten NBM Signals" UWORD dez 1 100 0 65535 FORMAT "%8.2" ECU_ADDRESS 0x381A80 /end MEASUREMENT
/begin MEASUREMENT tpats "Periodendauer Abgastemperatursensor" UBYTE t100msxms_ub_b255 1 100 0 255 FORMAT "%5.1" ECU_ADDRESS 0x384890 /end MEASUREMENT
/begin MEASUREMENT tpbauka "Entrellzeit für Erkennung Beschleunigung (ÜK-Adaption)" UBYTE t10msxs_ub_b2p55 1 100 0 2.55 FORMAT "%5.3" ECU_ADDRESS 0x380A62 /end MEASUREMENT
/begin MEASUREMENT tpCorCtr_w "Zähler Lückenkorrektur bei einem zusätzlichen Zahn" UWORD dez 1 100 0 65535 FORMAT "%8.2" ECU_ADDRESS 0x381A82 /end MEASUREMENT
/begin MEASUREMENT tpnt_aktiv "Aktivierung von KR-Funktionen" UBYTE dez 1 100 0 255 FORMAT "%5.1" ECU_ADDRESS 0x380A82 /end MEASUREMENT
/begin MEASUREMENT tpvauka "Entprellzeit für Erkennung Verzögerung (ÜK-Adaption)" UBYTE t10msxs_ub_b2p55 1 100 0 2.55 FORMAT "%5.3" ECU_ADDRESS 0x380A63 /end MEASUREMENT
/begin MEASUREMENT tpwmcs "Periodendauer PWM- Signal vom Airbag- SG" UBYTE t10msxs_ub_b2p55 1 100 0 2.55 FORMAT "%5.3" ECU_ADDRESS 0x380BEC /end MEASUREMENT
/begin MEASUREMENT tspuka "Sperrzeit für Freigabe der ÜK-Adaption" UBYTE t100msxs_ub_b25p5 1 100 0 25.5 FORMAT "%5.2" ECU_ADDRESS 0x384893 /end MEASUREMENT
/begin MEASUREMENT tswk "Zeit für Setzwertkorrektur" UBYTE t20msxs_ub_b5p1 1 100 0 5.1 FORMAT "%5.3" ECU_ADDRESS 0x380A15 /end MEASUREMENT
/begin MEASUREMENT ttooth10ms "Zähler 10 ms Raster ohne Zahninterrupt" UBYTE dez 1 100 0 255 FORMAT "%5.1" ECU_ADDRESS 0x38097E /end MEASUREMENT
/begin MEASUREMENT tz2fgr_w "Doppelte Zählerzeitkonstante FGR-Regler" UWORD t20msxs_uw_q0p02 1 100 0 1310.7 FORMAT "%8.3" ECU_ADDRESS 0x381E36 /end MEASUREMENT
/begin MEASUREMENT UADKI "eingelesener Integratorwert von Klopfauswerteschaltung" UWORD dez 1 100 0 65535 FORMAT "%8.2" ECU_ADDRESS 0xF9D6 /end MEASUREMENT
/begin MEASUREMENT UADMFA "eingelesener Integratorwert von Klopfauswerteschaltung bei Meßfensteranfang" UWORD dez 1 100 0 65535 FORMAT "%8.2" ECU_ADDRESS 0xF9D8 /end MEASUREMENT
/begin MEASUREMENT uevges_w "Übersetzungsverhältnis gesamt" UWORD fak_q0p1 1 100 0 6553.5 FORMAT "%8.3" ECU_ADDRESS 0x381E38 /end MEASUREMENT
/begin MEASUREMENT uzkw_w "Kurbelwellen-Umdrehungszähler" UWORD dez 1 100 0 65535 FORMAT "%8.2" ECU_ADDRESS 0x381A84 /end MEASUREMENT
/begin MEASUREMENT vamsr_c "Rohwert Radgeschwindigkeit des AMSR gemittelt oder ausgewählt" UWORD vfzg_uw_b325 1 100 0 324.995 FORMAT "%8.4" ECU_ADDRESS 0x380F32 /end MEASUREMENT
/begin MEASUREMENT vamsr_w "Referenzgeschwindigkeit vom ASR/MSR-Steuergerät" UWORD vfzg_uw_b325 1 100 0 324.995 FORMAT "%8.4" ECU_ADDRESS 0x380F34 /end MEASUREMENT
/begin MEASUREMENT vfgro_w "Geschwindigkeit zur Adressierung von KFVOFFS" UWORD vfzg_uw_q0p0078125 1 100 0 511.992 FORMAT "%8.4" ECU_ADDRESS 0x381E3A /end MEASUREMENT
/begin MEASUREMENT vlast_w "Zusätzliche Offset-Geschwindigkeit für FGR-Regler bei höherer Last" UWORD vfzg_uw_q0p0078125 1 100 0 511.992 FORMAT "%8.4" ECU_ADDRESS 0x381E3C /end MEASUREMENT
/begin MEASUREMENT voffs_w "Offsetgeschwindigkeit für FGR-Regler" UWORD vfzg_uw_q0p0078125 1 100 0 511.992 FORMAT "%8.4" ECU_ADDRESS 0x381E3E /end MEASUREMENT
/begin MEASUREMENT vrad_hl_c "Rohwert Radgeschwindigkeit des AMSR hinten links gefiltert" UWORD vrad_uw_b655 1 100 0 654.99 FORMAT "%8.4" ECU_ADDRESS 0x380F36 /end MEASUREMENT
/begin MEASUREMENT vrad_hl_w "Radgeschwindigkeit hinten links" UWORD vrad_uw_b655 1 100 0 654.99 FORMAT "%8.4" ECU_ADDRESS 0x380F38 /end MEASUREMENT
/begin MEASUREMENT vrad_hr_c "Rohwert Radgeschwindigkeit des AMSR hinten rechts gefiltert" UWORD vrad_uw_b655 1 100 0 654.99 FORMAT "%8.4" ECU_ADDRESS 0x380F3A /end MEASUREMENT
/begin MEASUREMENT vrad_hr_w "Radgeschwindigkeit hinten rechts" UWORD vrad_uw_b655 1 100 0 654.99 FORMAT "%8.4" ECU_ADDRESS 0x380F3C /end MEASUREMENT
/begin MEASUREMENT vrad_vl_c "Rohwert Radgeschwindigkeit des AMSR vorne links  gefiltert" UWORD vrad_uw_b655 1 100 0 654.99 FORMAT "%8.4" ECU_ADDRESS 0x380F3E /end MEASUREMENT
/begin MEASUREMENT vrad_vl_w "Radgeschwindigkeit vorne links" UWORD vrad_uw_b655 1 100 0 654.99 FORMAT "%8.4" ECU_ADDRESS 0x380F40 /end MEASUREMENT
/begin MEASUREMENT vrad_vr_c "Rohwert Radgeschwindigkeit des AMSR vorne rechts  gefiltert" UWORD vrad_uw_b655 1 100 0 654.99 FORMAT "%8.4" ECU_ADDRESS 0x380F42 /end MEASUREMENT
/begin MEASUREMENT vrad_vr_w "Radgeschwindigkeit vorne rechts" UWORD vrad_uw_b655 1 100 0 654.99 FORMAT "%8.4" ECU_ADDRESS 0x380F44 /end MEASUREMENT
/begin MEASUREMENT vregl_w "Sollgeschwindigkeit für FGR-Regler" UWORD vfzg_uw_q0p0078125 1 100 0 511.992 FORMAT "%8.4" ECU_ADDRESS 0x381E20 /end MEASUREMENT
/begin MEASUREMENT vziel_w "Zielgeschwindigkeit FGR" UWORD vfzg_uw_q0p0078125 1 100 0 511.992 FORMAT "%8.4" ECU_ADDRESS 0x381E22 /end MEASUREMENT
/begin MEASUREMENT wdk1 "Drosselklappenwinkel aus Poti 1" UBYTE relDK_ub_b100 1 100 0 100 FORMAT "%5.1" ECU_ADDRESS 0x3809CE /end MEASUREMENT
/begin MEASUREMENT wdk1g "DK-Winkel aus Poti 1 begrenzt u. gefiltert für Vergl. mit Ersatzwert aus Füllung" UBYTE relDK_ub_b100 1 100 0 100 FORMAT "%5.1" ECU_ADDRESS 0x3809CF /end MEASUREMENT
/begin MEASUREMENT wdk1_w "DK-Winkel aus Poti 1" SWORD relDK_q0p02441 1 100 -800 799.976 FORMAT "%8.4" ECU_ADDRESS 0x381CFA /end MEASUREMENT
/begin MEASUREMENT wdk2 "Drosselklappenwinkel aus Poti 2" UBYTE relDK_ub_b100 1 100 0 100 FORMAT "%5.1" ECU_ADDRESS 0x3809D0 /end MEASUREMENT
/begin MEASUREMENT wdk2g "DK-Winkel aus Poti 2 begrenzt u. gefiltert für Vergl. mit Ersatzwert aus Füllung" UBYTE relDK_ub_b100 1 100 0 100 FORMAT "%5.1" ECU_ADDRESS 0x3809D1 /end MEASUREMENT
/begin MEASUREMENT wdk2_w "DK-Winkel aus Poti 2" SWORD relDK_q0p02441 1 100 -800 799.976 FORMAT "%8.4" ECU_ADDRESS 0x381CFC /end MEASUREMENT
/begin MEASUREMENT wdk3 "DK-Winkel-Ersatzwert aus Füllungssignal" UBYTE relDK_ub_b100 1 100 0 100 FORMAT "%5.1" ECU_ADDRESS 0x3809D2 /end MEASUREMENT
/begin MEASUREMENT wdkba "Drosselklappenwinkel bezogen auf unteren Anschlag" UBYTE relDK_ub_b100 1 100 0 100 FORMAT "%5.1" ECU_ADDRESS 0x3809D3 /end MEASUREMENT
/begin MEASUREMENT wdkba_w "Drosselklappenwinkel bezogen auf unteren Anschlag" SWORD relDK_q0p02441 1 100 -800 799.976 FORMAT "%8.4" ECU_ADDRESS 0xF932 /end MEASUREMENT
/begin MEASUREMENT wdkink_w "aktuelles Inkrement des DK-Sollwinkels" UWORD relDK_uw_b100 1 100 0 100 FORMAT "%8.4" ECU_ADDRESS 0x381FDE /end MEASUREMENT
/begin MEASUREMENT wdkpmx "Maximaler Drosselklappenwinkel für Plausibilisierung mit Füllungssignal" UBYTE relDK_ub_b100 1 100 0 100 FORMAT "%5.1" ECU_ADDRESS 0x3809D4 /end MEASUREMENT
/begin MEASUREMENT wdks "Sollwert DK-Winkel, bezogen auf unteren Anschlag" UBYTE relDK_ub_b100 1 100 0 100 FORMAT "%5.1" ECU_ADDRESS 0x380A26 /end MEASUREMENT
/begin MEASUREMENT wdksap_w "DK-Sollwinkel aus Applikationsblock" UWORD rel_uw_b100 1 100 0 99.9985 FORMAT "%8.5" ECU_ADDRESS 0x381F8E /end MEASUREMENT
/begin MEASUREMENT wdksba2_w "DK-Sollwinkel nach der Begrenzung, Wert aus Rechenraster n-2" UWORD relDK_uw_b100 1 100 0 100 FORMAT "%8.4" ECU_ADDRESS 0x381FE0 /end MEASUREMENT
/begin MEASUREMENT wdksba_w "DK-Sollwinkel nach der Begrenzung, Wert aus Rechenraster n-1" UWORD relDK_uw_b100 1 100 0 100 FORMAT "%8.4" ECU_ADDRESS 0x381FE2 /end MEASUREMENT
/begin MEASUREMENT wdksbugd_w "Solldrosselklappenwinkel aus Momentenstruktur auf ungedrosselten Winkel begrenzt" UWORD rel_uw_b100 1 100 0 99.9985 FORMAT "%8.5" ECU_ADDRESS 0x381F90 /end MEASUREMENT
/begin MEASUREMENT wdksb_w "DK-Sollwinkel nach der Begrenzung" UWORD relDK_uw_b100 1 100 0 100 FORMAT "%8.4" ECU_ADDRESS 0x381FE4 /end MEASUREMENT
/begin MEASUREMENT wdksfl "Flankenwechselanzeige für DK-Sollwert wdksap_w" SBYTE fak_sb_b1 1 100 -1 0.992188 FORMAT "%5.3" ECU_ADDRESS 0x380A27 /end MEASUREMENT
/begin MEASUREMENT wdksgv_w "Drosselklappen-Sollwinkel vor Applikationsschnittstelle (gefiltert)" UWORD rel_uw_b100 1 100 0 99.9985 FORMAT "%8.5" ECU_ADDRESS 0x381F92 /end MEASUREMENT
/begin MEASUREMENT wdksmx_w "max. Sollwert Drosselklappenwinkel" UWORD rel_uw_b100 1 100 0 99.9985 FORMAT "%8.5" ECU_ADDRESS 0x381F94 /end MEASUREMENT
/begin MEASUREMENT wdkspa_w "prädizierter DK-Winkel, Wert aus Rechenraster n-1" UWORD relDK_uw_b100 1 100 0 100 FORMAT "%8.4" ECU_ADDRESS 0x381FE6 /end MEASUREMENT
/begin MEASUREMENT wdksp_w "Prädizierter Drosselklappen-Sollwinkel" UWORD relDK_uw_b100 1 100 0 100 FORMAT "%8.4" ECU_ADDRESS 0x381FE8 /end MEASUREMENT
/begin MEASUREMENT wdksvfl "Flankenwechselanzeige für DK-Sollwert wdksapa_w" SBYTE fak_sb_b1 1 100 -1 0.992188 FORMAT "%5.3" ECU_ADDRESS 0x380A28 /end MEASUREMENT
/begin MEASUREMENT wdksv_w "Drosselklappen-Sollwinkel vor Applikationsschnittstelle (ungefiltert)" UWORD rel_uw_b100 1 100 0 99.9985 FORMAT "%8.5" ECU_ADDRESS 0x381F96 /end MEASUREMENT
/begin MEASUREMENT wdkswe_w "DK-Sollwertschwelle für prädiz. Entjitterung" UWORD relDK_uw_b100 1 100 0 100 FORMAT "%8.4" ECU_ADDRESS 0x381FEA /end MEASUREMENT
/begin MEASUREMENT wdks_w "Sollwert Drosselklappenwinkel, bezogen auf (unteren) Anschlag" UWORD relDK_uw_b100 1 100 0 100 FORMAT "%8.4" ECU_ADDRESS 0x381FEC /end MEASUREMENT
/begin MEASUREMENT wea "Winkelmarke Einspritzabbruch" UBYTE zw_ub_q6 1 100 0 1530 FORMAT "%5.0" ECU_ADDRESS 0x384876 /end MEASUREMENT
/begin MEASUREMENT wee "Winkel Einspritzende im Normalbetrieb" UBYTE zw_ub_q6 1 100 0 1530 FORMAT "%5.0" ECU_ADDRESS 0x380A3D /end MEASUREMENT
/begin MEASUREMENT weemrfa "Winkel Einspritzende im maximalem Fahrerwunschmomment" UBYTE zw_ub_q6 1 100 0 1530 FORMAT "%5.0" ECU_ADDRESS 0x384877 /end MEASUREMENT
/begin MEASUREMENT weenst "Winkel Einspritzende nach Startende" UBYTE zw_ub_q6 1 100 0 1530 FORMAT "%5.0" ECU_ADDRESS 0x384878 /end MEASUREMENT
/begin MEASUREMENT weer "Winkel Einspritzende resultierend" UBYTE kw_q2p8125 1 100 0 717.188 FORMAT "%5.1" ECU_ADDRESS 0x380A3E /end MEASUREMENT
/begin MEASUREMENT weest "Winkel Einspritzende im Start" UBYTE zw_ub_q6 1 100 0 1530 FORMAT "%5.0" ECU_ADDRESS 0x380A3F /end MEASUREMENT
/begin MEASUREMENT wf_w "Wandfilmmenge" SWORD rel_sw_q0p1875 1 100 -6144 6143.81 FORMAT "%8.3" ECU_ADDRESS 0x3820E2 /end MEASUREMENT
/begin MEASUREMENT wkwbzm0_w "Winkel Kurbelwelle am Nullpunkt des Arbeitsspiels: R_syn & zzyl = 0 (word)" UWORD kw_tooth_sy 1 100 0 393210 FORMAT "%8.1" ECU_ADDRESS 0xF8CE /end MEASUREMENT
/begin MEASUREMENT wkwneg_w "Winkel Kurbelwelle bei negativer Phasenflanke im Schnellstart" UWORD kw_tooth_sy 1 100 0 393210 FORMAT "%8.1" ECU_ADDRESS 0xF8D0 /end MEASUREMENT
/begin MEASUREMENT wkwpos_w "Winkel Kurbelwelle bei positiver Phasenflanke im Schnellstart" UWORD kw_tooth_sy 1 100 0 393210 FORMAT "%8.1" ECU_ADDRESS 0xF8D2 /end MEASUREMENT
/begin MEASUREMENT wkwstart_w "Winkel Kurbelwelle beim Überschreiten von NMIN im Schnellstart" UWORD kw_tooth_sy 1 100 0 393210 FORMAT "%8.1" ECU_ADDRESS 0xF8D4 /end MEASUREMENT
/begin MEASUREMENT wkwsyn_w "Winkel Kurbelwelle am Beginn des Synchros (word)" UWORD kw_tooth_sy 1 100 0 393210 FORMAT "%8.1" ECU_ADDRESS 0xF7A4 /end MEASUREMENT
/begin MEASUREMENT wkw_w "Winkel Kurbelwelle (word)" UWORD kw_tooth_sy 1 100 0 393210 FORMAT "%8.1" ECU_ADDRESS 0xFE50 /end MEASUREMENT
/begin MEASUREMENT wmfa "Meßfensteranfang in Grad Kurbelwinkel" UBYTE zw_ub_q0p75 1 100 0 191.25 FORMAT "%5.1" ECU_ADDRESS 0x380A83 /end MEASUREMENT
/begin MEASUREMENT wmfl "Meßfensterlänge in Grad Kurbelwinkel" UBYTE zw_ub_q0p75 1 100 0 191.25 FORMAT "%5.1" ECU_ADDRESS 0x380A84 /end MEASUREMENT
/begin MEASUREMENT zbake "Abregelfaktor Kurzzeitanteil bei BA" UBYTE fak_q0p0039 1 100 0 0.996094 ECU_ADDRESS 0x384883 /end MEASUREMENT
/begin MEASUREMENT zbale "Abregelfaktor Langzeitanteil bei BA" UBYTE fak_ub_b0p125 1 100 0 0.124512 FORMAT "%6.4" ECU_ADDRESS 0x384884 /end MEASUREMENT
/begin MEASUREMENT zdelay "Zahn-Delay-Zähler im Schnellstart" UBYTE dez 1 100 0 255 FORMAT "%5.1" ECU_ADDRESS 0xF8C9 /end MEASUREMENT
/begin MEASUREMENT znbm_w "Zähler Zahninterrupt (word)" UWORD dez 1 100 0 65535 FORMAT "%8.2" ECU_ADDRESS 0xFE50 /end MEASUREMENT
/begin MEASUREMENT zrph "Zähler Raster Phasensignal" UBYTE dez 1 100 0 255 FORMAT "%5.1" ECU_ADDRESS 0x38097F /end MEASUREMENT
/begin MEASUREMENT zstfgr "Zustand Fahrgeschwindigkeitsregler" UBYTE dez 1 100 0 255 FORMAT "%5.1" ECU_ADDRESS 0x380A16 /end MEASUREMENT
/begin MEASUREMENT ztpnt_a "KR: Zähler für die Freigabe von Nulltest oder Testimpuls" UBYTE dez 1 100 0 255 FORMAT "%5.1" ECU_ADDRESS 0x380A85 /end MEASUREMENT
/begin MEASUREMENT zvake "Abregelfaktor Kurzzeitanteil bei VA" UBYTE fak_q0p0039 1 100 0 0.996094 ECU_ADDRESS 0x384885 /end MEASUREMENT
/begin MEASUREMENT zvale "Abregelfaktor Langzeitanteil bei VA" UBYTE fak_ub_b0p125 1 100 0 0.124512 FORMAT "%6.4" ECU_ADDRESS 0x384886 /end MEASUREMENT
/begin MEASUREMENT zylvirt "Stand Zylinderzähler vor Umsynchronisation aus Schnellstart" UBYTE dez 1 100 0 255 FORMAT "%5.1" ECU_ADDRESS 0x380980 /end MEASUREMENT
/begin MEASUREMENT zzale_ini "Initialisierungswert Zahnzähler zzseg bei aktiver Auslauferkennung (B_ale)" UBYTE dez 1 100 0 255 FORMAT "%5.1" ECU_ADDRESS 0x380981 /end MEASUREMENT
/begin MEASUREMENT zzseg "Zahnzähler im Segment" UBYTE dez 1 100 0 255 FORMAT "%5.1" ECU_ADDRESS 0xFEC4 /end MEASUREMENT
/begin MEASUREMENT zztab "Zahnzeitentabelle" UWORD dez 1 100 0 65535 FORMAT "%8.2" ARRAY_SIZE 34 ECU_ADDRESS 0xF8D6 /end MEASUREMENT
/begin MEASUREMENT zzvirt "virtueller Zahnzähler im Start bis zur Synchronisation" UBYTE dez 1 100 0 255 FORMAT "%5.1" ECU_ADDRESS 0x380982 /end MEASUREMENT
/begin MEASUREMENT zzyl "SW-Zylinderzähler" UBYTE dez 1 100 0 255 FORMAT "%5.1" ECU_ADDRESS 0xF8CA /end MEASUREMENT
/begin MEASUREMENT zzyl_virt "Initialisierungswert Zylinderzähler bei aktiver Auslauferkennung (B_ale)" UBYTE dez 1 100 0 255 FORMAT "%5.1" ECU_ADDRESS 0x380983 /end MEASUREMENT
/begin FUNCTION ESUK "9.70      Einspritzung Übergangskompensation"
 /begin DEF_CHARACTERISTIC DUKK FUKE FUKNSTHO FUKNSTM FVANST FWFN KFABAK KFAVAK KFBAKL KFBALB KFVAKL KFVALDIF KFVAWLA LADIFFVA RKBAUM RKUKKLU RKVAUM TNSUUK TVAG WFRL ZBAKM ZBALM ZUKE ZUKNST ZVAKM ZVALM /end DEF_CHARACTERISTIC
 /begin REF_CHARACTERISTIC SLA05ESUB SNM07ESUB STM09ESUB /end REF_CHARACTERISTIC
 /begin IN_MEASUREMENT anzti B_ll B_nswo2 B_sa B_sbblsu B_sls B_slsoff B_st B_stend drlp_w esst_sla05esub esst_snm07esub esst_stm09esub fho fukaba_w fukava_w ladiff_w lamsbg_w nmot nmot_w rlp rlp_w tmot tmst vstfba vstfva /end IN_MEASUREMENT
 /begin OUT_MEASUREMENT B_ba B_bag B_ukg B_va B_vag B_vak fvaklw_w fvaladif lamsbguk rkukg_w /end OUT_MEASUREMENT
 /begin LOC_MEASUREMENT abak anztis avak B_redkl B_uk1 B_uke B_ukk B_ukns B_vaau B_vakl B_val B_wf drkuke_w dwfk_w dwfl_w dwf_w fbakl_w fbans fbans_w fbavst_w fvakl_w fvans fvavst_w rkuke_w rkukkl_w rkukk_w rkukl_w rkuk_w sdwfk_w sdwfl_w wf_w zbake zbale zvake zvale /end LOC_MEASUREMENT
 /begin SUB_FUNCTION /end SUB_FUNCTION
/end FUNCTION
/begin FUNCTION ESUKAS "5.20      Adaption der Übergangskompensation (mit stetiger Lambda-Regelung)"
 /begin DEF_CHARACTERISTIC CUKA FKUKAO FKUKAU FLAMSBA FLAMSVA FUKABAKI FUKABAKO FUKABAKU FUKABAWI FUKABAWO FUKABAWU FUKAVAKI FUKAVAKO FUKAVAKU FUKAVAWI FUKAVAWO FUKAVAWU FVFKUKA NUKAO NUKAU RKUKKTU RLUKAO RLUKAU TMNUUKA TMUKAK TMUKAU TMUKAW TNSUUKA TPUKUKA TSPUUKA /end DEF_CHARACTERISTIC
 /begin REF_CHARACTERISTIC /end REF_CHARACTERISTIC
 /begin IN_MEASUREMENT B_dktlp B_enws B_frmax B_frmin B_lrs B_mdarv B_nldg B_nswo1 B_pwf B_slp B_te B_tehb lamsbgt_w lamzak_w nmot rkukk_w rl tlrs_w tmot tnst_w /end IN_MEASUREMENT
 /begin OUT_MEASUREMENT fukaba_w fukava_w /end OUT_MEASUREMENT
 /begin LOC_MEASUREMENT anzfkuka B_cfkuka B_cfkuka2 B_cfuka B_cfuka2 B_ecfuka B_rfkuka B_rfkuka2 B_tmnuka B_uka B_uka2 B_ukab B_ukabat B_ukaukat B_ukauket B_ukava B_ukavat fkukaba2_w fkukaba_w fkukas_w fkukava2_w fkukava_w fukabak_w fukabaw_w fukavak_w fukavaw_w rkukkt_w tmnuka tpbauka tpvauka tspuka /end LOC_MEASUREMENT
 /begin SUB_FUNCTION /end SUB_FUNCTION
/end FUNCTION
/begin FUNCTION ESVW "3.50      Einspritzung: Berechnung der Vorlagerungswinkel"
 /begin DEF_CHARACTERISTIC CWVWKNWS DWEEMX KFWEE KFWEEK KFWEEST KFWEETM MRFAVW SNM08GKUB SRL08GKUB WEAN WEEMRFAN WEESTN ZZWEETM /end DEF_CHARACTERISTIC
 /begin REF_CHARACTERISTIC /end REF_CHARACTERISTIC
 /begin IN_MEASUREMENT anztib B_stend mrfa_w nmot rl tmot tmst uzkw_w vsvw wnwem wnwise_w wnwi_w /end IN_MEASUREMENT
 /begin OUT_MEASUREMENT esst_snm08gkub esst_srl08gkub wea wee weer /end OUT_MEASUREMENT
 /begin LOC_MEASUREMENT B_kfwee B_mrfamx weemrfa weenst weest /end LOC_MEASUREMENT
 /begin SUB_FUNCTION /end SUB_FUNCTION
/end FUNCTION
/begin FUNCTION ESWE "1.80      Einspritzung Schubabschalten Wiedereinsetzen" /begin DEF_CHARACTERISTIC FIMHU FIMWU FWEMRFA FWET /end DEF_CHARACTERISTIC /begin REF_CHARACTERISTIC /end REF_CHARACTERISTIC /begin IN_MEASUREMENT anzti B_ll B_sa mrfa_w tmot /end IN_MEASUREMENT /begin OUT_MEASUREMENT fwe /end OUT_MEASUREMENT /begin LOC_MEASUREMENT anzwefim azylwe B_afwe B_fwe /end LOC_MEASUREMENT /begin SUB_FUNCTION /end SUB_FUNCTION /end FUNCTION
/begin FUNCTION ESWL "13.30     Einspritzung Warmlauf"
 /begin DEF_CHARACTERISTIC ATISLATM ATIWKSTM CWWL DLAMNSWL KFFWL_0_A KFFWL_1_A KFFWLW KFFWLWKH KFLASWLR KFWLHO LASWLTM ZKFWLKH ZKLANSWL /end DEF_CHARACTERISTIC
 /begin REF_CHARACTERISTIC FHO04ESUB SNM12ESUB SRL12ESUB STM12ESUB STS12ESUB /end REF_CHARACTERISTIC
 /begin IN_MEASUREMENT anztib_w B_kh B_lrnda B_stend B_wks esst_fho04esub esst_snm12esub esst_srl12esub esst_stm12esub esst_sts12esub fho lamns_w nmot rl tmot tmst vstfwl /end IN_MEASUREMENT
 /begin OUT_MEASUREMENT fwl lamnswl_w lamwlrl_w /end OUT_MEASUREMENT
 /begin LOC_MEASUREMENT B_lawlon lamwl_w /end LOC_MEASUREMENT
 /begin SUB_FUNCTION /end SUB_FUNCTION
/end FUNCTION
/begin FUNCTION EVI "1.20      Interruptserviceroutinen bei Einspritzausgabe" /begin DEF_CHARACTERISTIC /end DEF_CHARACTERISTIC /begin REF_CHARACTERISTIC /end REF_CHARACTERISTIC
 /begin IN_MEASUREMENT B_spontan0 B_spontan1 B_spontan2 B_spontan3 B_ti_cha0 B_ti_cha1 B_ti_cha2 B_ti_cha3 B_ti_out0 B_ti_out1 B_ti_out2 B_ti_out3 B_ti_wai0 B_ti_wai1 B_ti_wai2 B_ti_wai3 cc_cha_0 cc_cha_1 cc_cha_2 cc_cha_3 ti_ev0 ti_ev1 ti_ev2 ti_ev3 ti_tvu_w /end IN_MEASUREMENT
 /begin OUT_MEASUREMENT /end OUT_MEASUREMENT
 /begin LOC_MEASUREMENT /end LOC_MEASUREMENT
 /begin SUB_FUNCTION /end SUB_FUNCTION
/end FUNCTION
/begin FUNCTION FE "3.10      Füllungseingriffe" /begin DEF_CHARACTERISTIC /end DEF_CHARACTERISTIC /begin REF_CHARACTERISTIC /end REF_CHARACTERISTIC /begin IN_MEASUREMENT fho_w rlsol_w /end IN_MEASUREMENT /begin OUT_MEASUREMENT rlshk /end OUT_MEASUREMENT /begin LOC_MEASUREMENT /end LOC_MEASUREMENT /begin SUB_FUNCTION /end SUB_FUNCTION /end FUNCTION
/begin FUNCTION FGRABED "1.70      Abschaltbedingungen Fahrgeschwindigkeitsregler"
 /begin DEF_CHARACTERISTIC BFGRO BFGRU CWFGRGA_0_A CWFGRGA_1_A CWFGRGABED DNFGRMX DVIVZMX DVZVIMX NFGRMIN TDVIVZ TDVZVI TFGRABS TFGRFDY TFGRUEOB TFGRUM TFGRUNUB VFGREMAX VFGREMIN VFGRMAX VFGRMIN /end DEF_CHARACTERISTIC
 /begin REF_CHARACTERISTIC /end REF_CHARACTERISTIC
 /begin IN_MEASUREMENT bfzgl_w B_absfgr B_acc B_airbag B_brems B_dknolu B_dkpu B_dksbeg B_fdyfgr B_fgr B_fgrat B_fgren B_fgrhe B_fgrhsa B_fgr_um B_gwhs B_kuppl B_nldg B_pwgnotfr gangi nmot_w nsber_w vfgr_w vziel_w zstfgr /end IN_MEASUREMENT
 /begin OUT_MEASUREMENT stfgrab_w /end OUT_MEASUREMENT
 /begin LOC_MEASUREMENT /end LOC_MEASUREMENT
 /begin SUB_FUNCTION /end SUB_FUNCTION
/end FUNCTION
/begin FUNCTION FGRBESI "1.20      Bediensignale Fahrgeschwindigkeitsregler" /begin DEF_CHARACTERISTIC /end DEF_CHARACTERISTIC /begin REF_CHARACTERISTIC /end REF_CHARACTERISTIC
 /begin IN_MEASUREMENT B_acc B_fgrtbe B_fgrtbh B_fgrtse B_fgrtve B_fgrtvh B_fgrtwa B_gra6p stfgrab_w /end IN_MEASUREMENT
 /begin OUT_MEASUREMENT stfgrbs_w /end OUT_MEASUREMENT
 /begin LOC_MEASUREMENT B_frgbs fgrbesilokbits /end LOC_MEASUREMENT
 /begin SUB_FUNCTION /end SUB_FUNCTION
/end FUNCTION
/begin FUNCTION FGRFULO "1.40      Funktionslogik Fahrgeschwindigkeitsregler"
 /begin DEF_CHARACTERISTIC ANZTPMX BRABEVI_0_A BRABEVI_1_A BRATD BRATU CWFGRFULO DVIVZTMX DVSKNBGA_0_A DVSKNBGA_1_A DVSKNVGA_0_A DVSKNVGA_1_A DVSWKB DVSWKV DVTIPUD DVZVITMX DVZVIWA FSWKB FSWKV KFBRAWA_0_A KFBRAWA_1_A TSWKNBGA_0_A TSWKNBGA_1_A TSWKNVGA_0_A TSWKNVGA_1_A VREGLMAX VREGLMIN /end DEF_CHARACTERISTIC
 /begin REF_CHARACTERISTIC MRFGRMAX VFGRMAX VFGRMIN /end REF_CHARACTERISTIC
 /begin IN_MEASUREMENT bfzgl_w B_acc B_fgr mrfgr_w stfgrab_w stfgrbs_w uevges vfgr_w /end IN_MEASUREMENT
 /begin OUT_MEASUREMENT bfgrs_w stfgrfl vregl_w vziel_w zstfgr /end OUT_MEASUREMENT
 /begin LOC_MEASUREMENT anztip brafgr_w bswk_w B_kfvswk B_kfvswkb B_kfvswkv dvzi_w fgrfulolokbits tswk /end LOC_MEASUREMENT
 /begin SUB_FUNCTION /end SUB_FUNCTION
/end FUNCTION
/begin FUNCTION FGRREGL "1.20      Regelalgorithmus Fahrgeschwindigkeitsregler"
 /begin DEF_CHARACTERISTIC CWFGRREGL_0_A CWFGRREGL_1_A DVLLVO DVLLVU DVSAVO DVSAVU FGMRIDV KFVOFFS_0_A KFVOFFS_1_A KKFFGRGA_0_A KKFFGRGA_1_A KRAFGRGA_0_A KRAFGRGA_1_A MRFGRIMX MRFGRLL MRFGRMAX MRFGRSTA TFGRAR TN2FGRGA_0_A TN2FGRGA_1_A TVLADV_0_A TVLADV_1_A TZ2FGRGA_0_A TZ2FGRGA_1_A VLMXVZ_0_A VLMXVZ_1_A /end DEF_CHARACTERISTIC
 /begin REF_CHARACTERISTIC /end REF_CHARACTERISTIC
 /begin IN_MEASUREMENT B_acc B_fgr B_savacc mracc_w mrped_w nmot stfgrab_w stfgrfl uevges vfgr_w vregl_w vziel_w zstfgr /end IN_MEASUREMENT
 /begin OUT_MEASUREMENT B_fgrab B_fgren B_llvfgr B_savfgr fgrreglausbits mrfgr_w /end OUT_MEASUREMENT
 /begin LOC_MEASUREMENT B_fgrdvi ctfgrab dmrar_w dvfgr_w dvivr_w dvzvi_w fgrregllokbits kfgr_w mrfgri_w tn2fgr_w tz2fgr_w uevges_w vfgro_w vlast_w voffs_w /end LOC_MEASUREMENT
 /begin SUB_FUNCTION /end SUB_FUNCTION
/end FUNCTION
/begin FUNCTION FUEDK "21.90     Füllungssteuerung (Berechnung DK-Sollwinkel)"
 /begin DEF_CHARACTERISTIC CWFUEDK DPUPS DRLSOLMF DWDKUGD EVTMODMNDK FPWDKAPP FUEPMLD KFWDKMSN KFWDKSMX KLDPDK NRLMN NRLMNLLR PLSOLAP TFWDKSOF TWDKSV VPSSPLSWDK WDKSAPP WDKSHYS WDKSOFS ZKPSFIL ZPVDKR /end DEF_CHARACTERISTIC
 /begin REF_CHARACTERISTIC KLAF KUMSRL PSPVDKUG /end REF_CHARACTERISTIC
 /begin IN_MEASUREMENT B_fpwdkap B_llrein B_lsd B_mgbget B_nmin B_nswo1 B_plsolap B_stend B_tfwdksom B_wdksap B_wdksom drlfue_w esst_snm12feub evtmod fho_w fkmsdk_w fpbrkds_w frhodk_w ftvdk fupsrl_w lditv_w mifafu_w milsol_w ml_w mrfamx_w mrfa_w msndko_w mste nmot nmot_w pdpld pirg_w pspvdk_w ps_w pu_w pvdk_w rlsol_w tfwdksom_w umsrln_w vpsspls_w vpsspu_w wdksom_w wdkugd_w wped_w /end IN_MEASUREMENT
 /begin OUT_MEASUREMENT B_fkmsdks B_ldrugd mlsol_w plsol plsol_w psfil_w pssol_w wdksap_w /end OUT_MEASUREMENT
 /begin LOC_MEASUREMENT B_klafbg B_mfact B_ugds B_wdkap dpdk_w drlsolmf_w dwdksumx_w dwdksut_w fklafs_w frhodkr_w fuedkLocalBits fuepmld_w mlkge_w mlwdknf_w msdks_w msndkoos_w msndks_w pspvmin_w psspvdkb_w psspvdk_w pvdkr_w rlfgks_w tfwdks_w wdksbugd_w wdksgv_w wdksmx_w wdksv_w /end LOC_MEASUREMENT
 /begin SUB_FUNCTION /end SUB_FUNCTION
/end FUNCTION
/begin FUNCTION FUEDKSA "1.20      Füllungsbeeinflussung über DK, Sollwertaufbereitung" /begin DEF_CHARACTERISTIC CWWDKSPE DKNOTBEGR ENTDKLL ENTDKNLL TVWDKS /end DEF_CHARACTERISTIC /begin REF_CHARACTERISTIC /end REF_CHARACTERISTIC
 /begin IN_MEASUREMENT B_dknolu B_dkpiu B_dksbeg B_i_ska_um B_ll B_wdk1v nmot wdknlp_w wdksap_w /end IN_MEASUREMENT
 /begin OUT_MEASUREMENT dwdks_w wdks wdksp_w wdks_w /end OUT_MEASUREMENT
 /begin LOC_MEASUREMENT wdkink_w wdksba2_w wdksba_w wdksb_w wdksfl wdkspa_w wdksvfl wdkswe_w /end LOC_MEASUREMENT
 /begin SUB_FUNCTION /end SUB_FUNCTION
/end FUNCTION
/begin FUNCTION FUEREG "6.10      Füllungsregelung" /begin DEF_CHARACTERISTIC CWFUEREG DFAFRG FPLMRM ILMRMN ILMRMX ILMRN KFPLMR TVFRG /end DEF_CHARACTERISTIC /begin REF_CHARACTERISTIC SNM08FEUB /end REF_CHARACTERISTIC
 /begin IN_MEASUREMENT B_fkmsdks B_llrpd B_nswo1 B_stend esst_snm08feub nmot nmotll rlsol_w rl_w tmot /end IN_MEASUREMENT
 /begin OUT_MEASUREMENT drlfue_w /end OUT_MEASUREMENT
 /begin LOC_MEASUREMENT B_furena B_furpen B_stndfr drlm_w /end LOC_MEASUREMENT
 /begin SUB_FUNCTION /end SUB_FUNCTION
/end FUNCTION
/begin FUNCTION GGATS "8.40      Gebergröße Abgastemperatursensor"
 /begin DEF_CHARACTERISTIC CWGGATS DTAATSMN TABGTA TVEINGATS TVNOSIGATS TVUBGATS UBGATSMN /end DEF_CHARACTERISTIC
 /begin REF_CHARACTERISTIC TPSATS /end REF_CHARACTERISTIC
 /begin IN_MEASUREMENT B_ekp B_nosigats P_ats tabgkrm_w tabgm_w tcchats_w tccpats_w ubsq /end IN_MEASUREMENT
 /begin OUT_MEASUREMENT B_atsb B_ubats tabg_w tatsst_w tats_w tpats /end OUT_MEASUREMENT
 /begin LOC_MEASUREMENT B_atsbt B_atsb_old B_atson B_dfp1 B_dfp2 B_stmodt B_tveingats taatsr_w taats_w tabgta_kge /end LOC_MEASUREMENT
 /begin SUB_FUNCTION /end SUB_FUNCTION
/end FUNCTION
/begin FUNCTION GGCASR "1.71      Gebergöße CAN-Signale für ASR/MSR"
 /begin DEF_CHARACTERISTIC CWMSRCAN DBZ_MN DBZ_MX KLDMASRL MSRMDTMX NOASR RAMPASR TAMSRCMX TMSRCERR TMSRCNU TVCAMSR T_ASRFGR T_NOMASR T_NOMASRTA T_NOMBR3 VMINAMSR /end DEF_CHARACTERISTIC
 /begin REF_CHARACTERISTIC CW_CAN_C CW_CAN_R_0___A CW_CAN_R_1___A CW_CAN_R_2___A CW_CAN_R_3___A MDNORM /end REF_CHARACTERISTIC
 /begin IN_MEASUREMENT B_amsrbot B_br3bot B_ctout B_nomsr_um B_statbr B_statmd mdverl_w nmot tnst_w /end IN_MEASUREMENT
 /begin OUT_MEASUREMENT bz_can bz_msr B_absdia B_absfgr B_amsren B_amsrf B_amsrinpl B_amsrn B_amsr_t B_asrakt B_asresp B_asr_can B_bkva B_bkvv B_bkvvc B_br1en B_edsfgr B_fabr B_fdyfgr B_fgrabz B_msrakt B_msrdis B_msrphnpl B_msr_can B_neamsr B_nebr3 B_nomsr_fr B_nomsr_t B_npcanswe B_savmsr B_swecan B_swe_b B_vabsff B_vradhlff B_vradhrff B_vradvlff B_vradvrff miasrllk miasrl_can miasrl_w miasrslk miasrs_can miasrs_w mimsrlk mimsrllk mimsr_can mimsr_w msrmdt_w vamsr_c vamsr_w vrad_hl_c vrad_hl_w vrad_hr_c vrad_hr_w vrad_vl_c vrad_vl_w vrad_vr_c vrad_vr_w /end OUT_MEASUREMENT
 /begin LOC_MEASUREMENT bz_diff B_amsrknpl B_msrtnpl B_msrvnpl B_nuamsr /end LOC_MEASUREMENT
 /begin SUB_FUNCTION /end SUB_FUNCTION
/end FUNCTION
/begin FUNCTION GGCGRA "1.20      Gebergröße GRA-Bedienhebel mit CAN" /begin DEF_CHARACTERISTIC CSGRA DBZ_GRA TGRACMX TGRACNU T_NOMGRA T_NOMGRATA /end DEF_CHARACTERISTIC
 /begin REF_CHARACTERISTIC CW_CAN_S_0___A CW_CAN_S_1___A CW_CAN_S_2___A CW_CAN_S_3___A /end REF_CHARACTERISTIC
 /begin IN_MEASUREMENT B_ctout B_fgrat B_fgrhsa B_fgrtbe B_fgrtbh B_fgrtse B_fgrtve B_fgrtvh B_fgrtwa B_grabot B_gracan /end IN_MEASUREMENT
 /begin OUT_MEASUREMENT bz_gra B_cfgra B_csgra B_fgratc B_fgrbec B_fgrhec B_fgrhsc B_fgrsec B_fgrtdc B_fgrtuc B_fgrvec B_fgrwac B_grabz B_grabz1 B_grabz2 B_nugra B_tgramx B_tgranu cs_gra /end OUT_MEASUREMENT
 /begin LOC_MEASUREMENT /end LOC_MEASUREMENT
 /begin SUB_FUNCTION /end SUB_FUNCTION
/end FUNCTION
/begin FUNCTION GGCS "4.10      Gebergröße Crash-Sensor"
 /begin DEF_CHARACTERISTIC ACSZNBM ACSZRPH CWCS DBZ_AIR NMOTDELAY TAIRCMX TAIRCNU TBPWMCS TCONT_HILO TCRCAN TCSERC TCSERNPL TCSERP TVPWMCSR TVPWMCSS UPWMCS ZPWMCS ZPWMCSMAX /end DEF_CHARACTERISTIC
 /begin REF_CHARACTERISTIC NSTNM /end REF_CHARACTERISTIC
 /begin IN_MEASUREMENT bz_air B_aircan B_airnbot B_csair B_csairio B_ctout B_kl15 B_nmin B_nmot B_nuair B_stend nmot nmot_w P_crsh tmot ub zrph /end IN_MEASUREMENT
 /begin OUT_MEASUREMENT B_airbag B_airbz B_airbz1 B_airbz2 B_crcan B_crnmn B_crstio B_csernpl B_epwmcs B_hpwmcs B_pwmcs B_tairmx B_tairnu B_tcrcan crshDetect cserk /end OUT_MEASUREMENT
 /begin LOC_MEASUREMENT B_crcan_20ms B_pwmcs_50ms B_pwmfcs tpwmcs /end LOC_MEASUREMENT
 /begin SUB_FUNCTION /end SUB_FUNCTION
/end FUNCTION
/begin FUNCTION GGDPG "14.60     Gebergröße: Drehzahlgeber und Phasengeber"
 /begin DEF_CHARACTERISTIC CWNWREF DZZST DZZSTNLP NMIN NMOTQSYN OFQSYNADAP PH_MINSEG TMQSYN TPREL ZDELBMSRCH ZTPREL /end DEF_CHARACTERISTIC
 /begin REF_CHARACTERISTIC /end REF_CHARACTERISTIC
 /begin IN_MEASUREMENT B_ale B_nldg B_nlph B_nosynph B_phad B_phnldg B_phsok B_pwf B_st B_synnldg nmot nmot_w tmot wkwstop wnwsp_w /end IN_MEASUREMENT
 /begin OUT_MEASUREMENT bmLosCtr_w B_bm B_fbm B_luecke B_mluecke B_nmin B_nmot B_nobm B_nobm1 B_noph B_phaact B_phase B_qsyn B_startini B_stprel B_syn B_synph B_zprel B_zztab dpgNvBits gaptooth ggdpgBitsKgs nsynggdpg tmCorCtr_w tnbm1_w tnbm2_w tnbm_w tpCorCtr_w ttooth10ms uzkw_w wkwbzm0_w wkwsyn_w wkw_w znbm_w zrph zylvirt zzseg zztab zzvirt zzyl /end OUT_MEASUREMENT
 /begin LOC_MEASUREMENT bmzzyl B_enqsyn B_pgxqsyn B_phw B_phwneg B_phwok B_phwpos B_synbmale edge_ctr len_hiseg len_loseg qzzyl stateQsyn wkwneg_w wkwpos_w wkwstart_w zdelay zzale_ini zzyl_virt /end LOC_MEASUREMENT
 /begin SUB_FUNCTION /end SUB_FUNCTION
/end FUNCTION
/begin FUNCTION GGDSAS "4.80      Gebergröße Drucksensoren außerhalb Saugrohr"
 /begin DEF_CHARACTERISTIC DPDSVLU DPUPVDK DSLGRAD DSLOFS DSUGRAD DSUOFS FHOE KFLDFK NDSVLO NDSVLU NVGDSLL PUE PUMN PUMX PUSPSMX PVDKMN PVDKMX PVDKPSMX PVDKPUD TDDFL TDDFLUGD TDDFU TDDFUUGD TDVGDSLL UADPLMN UADPLMX UADPUMN UADPUMX WDKDSVLU WKVGDSLL ZDSU /end DEF_CHARACTERISTIC
 /begin REF_CHARACTERISTIC /end REF_CHARACTERISTIC
 /begin IN_MEASUREMENT B_nmot ftu ml_w nmot nmot_w plsol_w pspvdk_w pssol_w ps_w udsl_w udsu_w wdkba /end IN_MEASUREMENT
 /begin OUT_MEASUREMENT B_edsl B_edsuu B_hag fho fho_w fpvdkds fpvdkds_w frhol_w GgdsasNvBits pu pus_w pu_w pvdkds pvdkds_w pvdkmx_w pvdksf_w pvdkspud pvdks_w /end OUT_MEASUREMENT
 /begin LOC_MEASUREMENT anzudsl_w dpvdkspu_w fpvdkdsl_w fpvdkdsu_w ldfki_w psspvdkd_w pvdkdsl_w pvdkdsu_w /end LOC_MEASUREMENT
 /begin SUB_FUNCTION /end SUB_FUNCTION
/end FUNCTION
/begin FUNCTION GGDST "3.10      Gebergröße Drucksensor Tank" /begin DEF_CHARACTERISTIC DSTGRAD DSTOFFS KLTDS /end DEF_CHARACTERISTIC /begin REF_CHARACTERISTIC /end REF_CHARACTERISTIC /begin IN_MEASUREMENT udst_w /end IN_MEASUREMENT /begin OUT_MEASUREMENT pte pterw pterw_w pte_w /end OUT_MEASUREMENT /begin LOC_MEASUREMENT /end LOC_MEASUREMENT /begin SUB_FUNCTION /end SUB_FUNCTION /end FUNCTION
/begin FUNCTION GGDVE "2.50      Gebergrößen Drosselklappensteller"
 /begin DEF_CHARACTERISTIC DUDKP1HY DWDK12O DWDK13O DWDK23O KFWDKPP NDKPPU NWDK3 TDKPAW TFWDKPN TVPDKP1 TVPDKP2 TVPWDK12 TVPWDK13 TVPWDK23 UBVDKPO UBVDKPU UDKP1O UDKP1U UDKP2O UDKP2U WDKPMXN /end DEF_CHARACTERISTIC
 /begin REF_CHARACTERISTIC /end REF_CHARACTERISTIC
 /begin IN_MEASUREMENT B_dkpu B_ehfm B_st B_ubpvg dkpstg_w fpvdkds ftvdk nmot rl ub udkp1a_w udkp1sv udkp1vo_w udkp1vv_w udkp1v_w udkp1_w udkp2a_w udkp2_w /end IN_MEASUREMENT
 /begin OUT_MEASUREMENT B_dkp1e B_dkp1mn B_dkp1mx B_dkp1np B_dkp2e B_dkp2mn B_dkp2mx B_dkp2np B_dkpaw B_dksbeg B_edks B_wdk1v B_wdk2sel dwdkba_w wdk1_w wdk2_w wdkba wdkba_w /end OUT_MEASUREMENT
 /begin LOC_MEASUREMENT B_dkp1ev B_dkp2ev B_ubvdkp B_udk1nv B_wdk12ev B_wdk13ev B_wdk23ev B_wdk2st cpaw1 cpaw2 ctdkp1 ctdkp2 ctdkpaw ctwdk12 ctwdk13 ctwdk23 rlvppl wdk1 wdk1g wdk2 wdk2g wdk3 wdkpmx /end LOC_MEASUREMENT
 /begin SUB_FUNCTION /end SUB_FUNCTION
/end FUNCTION
/begin FUNCTION GGEGAS "9.60      Gebergröße Brems- und Kupplungsschalter" /begin DEF_CHARACTERISTIC CWGGEGAS TEPBRKUP TVERBR TVKUP TVKUPV ZERBR /end DEF_CHARACTERISTIC /begin REF_CHARACTERISTIC /end REF_CHARACTERISTIC
 /begin IN_MEASUREMENT B_autget B_bkva B_bkvv B_fabr B_pwf B_vnull S_bls S_brs S_kupp /end IN_MEASUREMENT
 /begin OUT_MEASUREMENT B_br2k B_brems B_kuppl B_kupplv ctrerbr /end OUT_MEASUREMENT
 /begin LOC_MEASUREMENT B_bl B_br B_erbr /end LOC_MEASUREMENT
 /begin SUB_FUNCTION /end SUB_FUNCTION
/end FUNCTION
/begin FUNCTION GGFGRH "1.90      Gebergrößen Bedienhebel für Fahrgeschwindigkeitsregler"
 /begin DEF_CHARACTERISTIC CWGGFGRH TEPFGRH TFGRHE TFGRHSNP TFGRTIP TOOTAUS TOOTEIN TOOTULB /end DEF_CHARACTERISTIC
 /begin REF_CHARACTERISTIC /end REF_CHARACTERISTIC
 /begin IN_MEASUREMENT B_acc B_cfgra B_fgrabz B_fgratc B_fgrbec B_fgrhec B_fgrhsc B_fgrsec B_fgrtdc B_fgrte B_fgrtuc B_fgrvec B_fgrwac B_gra6p B_gracan S_fgrat S_fgrhs S_fgrsv S_fgrwb /end IN_MEASUREMENT
 /begin OUT_MEASUREMENT B_fgrat B_fgrhe B_fgrhsa B_fgrtbe B_fgrtbh B_fgrtse B_fgrtve B_fgrtvh B_fgrtwa /end OUT_MEASUREMENT
 /begin LOC_MEASUREMENT B_afgrbs B_ffhsc B_fgootein B_fgrhev B_fgrhs B_tootaus B_tootein B_tootulb ctbetip ctepfgrh ctfgrhe cthsnp ctootaus ctootein ctootulb_w ctvetip GGFGRHlokbits0 /end LOC_MEASUREMENT
 /begin SUB_FUNCTION /end SUB_FUNCTION
/end FUNCTION
/begin FUNCTION GGFST "11.30     Gebergröße Tankfüllstand" /begin DEF_CHARACTERISTIC TWNSTA TWNTAL /end DEF_CHARACTERISTIC /begin REF_CHARACTERISTIC /end REF_CHARACTERISTIC /begin IN_MEASUREMENT B_ckien B_pwf B_talcan S_tal tnst_w /end IN_MEASUREMENT /begin OUT_MEASUREMENT B_tal B_talval GGFSTbits /end OUT_MEASUREMENT /begin LOC_MEASUREMENT timtalr_w timtals_w /end LOC_MEASUREMENT /begin SUB_FUNCTION /end SUB_FUNCTION /end FUNCTION
/begin FUNCTION GGGTS "2.10      Gebergröße genaues Temperatursignal" /begin DEF_CHARACTERISTIC DTMKI TMKIMN TVTMKIC TVTMKIE /end DEF_CHARACTERISTIC /begin REF_CHARACTERISTIC /end REF_CHARACTERISTIC /begin IN_MEASUREMENT B_cdgts B_ckien B_ctout B_tmkicb tmew tmkic tmot /end IN_MEASUREMENT /begin OUT_MEASUREMENT B_tmkib tmki /end OUT_MEASUREMENT /begin LOC_MEASUREMENT /end LOC_MEASUREMENT /begin SUB_FUNCTION /end SUB_FUNCTION /end FUNCTION
/begin FUNCTION GGHFM "57.60     Gebersignal HFM" /begin DEF_CHARACTERISTIC KFKHFM MLHFM MLMIN MLOFS PUKANS /end DEF_CHARACTERISTIC /begin REF_CHARACTERISTIC /end REF_CHARACTERISTIC /begin IN_MEASUREMENT fnwue nmot rl tans uhfm_w /end IN_MEASUREMENT /begin OUT_MEASUREMENT mlhfmm_w mshfms_w mshfm_w /end OUT_MEASUREMENT /begin LOC_MEASUREMENT anzhfma_w fkhfm mlhfmas_w mlhfma_w /end LOC_MEASUREMENT /begin SUB_FUNCTION /end SUB_FUNCTION /end FUNCTION
/begin FUNCTION GGKLDF "1.10      Gebergröße Klemme DFM des Generators" /begin DEF_CHARACTERISTIC KLDFAB /end DEF_CHARACTERISTIC /begin REF_CHARACTERISTIC /end REF_CHARACTERISTIC /begin IN_MEASUREMENT nmot_w /end IN_MEASUREMENT /begin OUT_MEASUREMENT kldfpwm /end OUT_MEASUREMENT /begin LOC_MEASUREMENT /end LOC_MEASUREMENT /begin SUB_FUNCTION /end SUB_FUNCTION /end FUNCTION
/begin FUNCTION GGKS "4.40      Gebergröße Klopfsensor"
 /begin DEF_CHARACTERISTIC CWKRAPP DKROKD DKROKMX DKROKO FMFKRB0 FMFKRB1 FMFKRB2 FMFKRB3 KEMLN KFMAKR NKRFM1 NKRFM2 NKRFM3 SENZZYL0 SENZZYL1 SENZZYL2 SENZZYL3 SENZZYL4 SENZZYL5 SENZZYL6 SENZZYL7 TMCC650 /end DEF_CHARACTERISTIC
 /begin REF_CHARACTERISTIC CWDKRTP KRANH KRFHT KRFTP1 SNM16KRUB SRL04KRUB TMKR /end REF_CHARACTERISTIC
 /begin IN_MEASUREMENT B_kr B_st B_stend B_tmkr esst_snm16krub esst_srl04krub nmot rl tmot tn2 xzskrnt xzskrof xzskrtp zzylkr /end IN_MEASUREMENT
 /begin OUT_MEASUREMENT B_c95bf0 B_c95bf1 B_c95bf2 B_c95bf3 B_c95ks3 B_dnt B_dntb B_dtp B_dtpb B_fmfkrc B_fmfkrco B_fmfkrcu B_ntini B_tpnt_aw B_tpnt_e igod_w igokr_w ikr ikrma ikrme ikrmen ikrmet ikr_tst iokkr ks_sym sen_c95 tmfa_w tmfln_w tmfl_w tpnt_aktiv UADKI UADMFA wmfa wmfl ztpnt_a /end OUT_MEASUREMENT
 /begin LOC_MEASUREMENT fmfkrakt fmfkraktol /end LOC_MEASUREMENT
 /begin SUB_FUNCTION /end SUB_FUNCTION
/end FUNCTION
/begin FUNCTION GGKS_MF "" /begin DEF_CHARACTERISTIC /end DEF_CHARACTERISTIC /begin REF_CHARACTERISTIC /end REF_CHARACTERISTIC /begin IN_MEASUREMENT B_fmfkrc /end IN_MEASUREMENT /begin OUT_MEASUREMENT /end OUT_MEASUREMENT /begin LOC_MEASUREMENT /end LOC_MEASUREMENT /begin SUB_FUNCTION /end SUB_FUNCTION /end FUNCTION
/begin COMPU_METHOD adb_uw_q0p00195 "" RAT_FUNC "%6.4" "hPa/V" COEFFS 0 65536 0 0 0 128 /end COMPU_METHOD
/begin COMPU_METHOD bfzg_sw_q4p239Em4 "" RAT_FUNC "%10.7" "m/s^2" COEFFS 0 1 0 0 0 0.0004239 /end COMPU_METHOD
/begin COMPU_METHOD B_TRUE "boolsche Zustände, positive Logik" TAB_VERB "%6.3" "" COMPU_TAB_REF B_TRUE /end COMPU_METHOD
/begin COMPU_VTAB B_TRUE "boolsche Zustände, positive Logik" TAB_VERB 2 0 "----" 1 "TRUE" /end COMPU_VTAB
/begin COMPU_METHOD DEZ "1 : 1 Umrechnug (dez/hex)" RAT_FUNC "%6.2" "" COEFFS 0 1 0 0 0 1 /end COMPU_METHOD
/begin COMPU_METHOD dez "1 : 1 Umrechnug (dez/hex)" RAT_FUNC "%6.2" "" COEFFS 0 1 0 0 0 1 /end COMPU_METHOD
/begin COMPU_METHOD dezsub1 "" RAT_FUNC "%6.2" "-" COEFFS 0 1 -1 0 0 1 /end COMPU_METHOD
/begin COMPU_METHOD dgrad_uw_q0p015 "" RAT_FUNC "%6.4" "hPa/V" COEFFS 0 65536 0 0 0 1024 /end COMPU_METHOD
/begin COMPU_METHOD fak_q0p0039 "" RAT_FUNC "%6.4" "-" COEFFS 0 256 0 0 0 1 /end COMPU_METHOD
/begin COMPU_METHOD fak_q0p015625 "" RAT_FUNC "%6.4" "hPa/(g*s)" COEFFS 0 65536 0 0 0 1024 /end COMPU_METHOD
/begin COMPU_METHOD fak_q0p0625 "" RAT_FUNC "%6.4" "-" COEFFS 0 16 0 0 0 1 /end COMPU_METHOD
/begin COMPU_METHOD fak_q0p1 "" RAT_FUNC "%6.3" "" COEFFS 0 1 0 0 0 0.1 /end COMPU_METHOD
/begin COMPU_METHOD fak_sb_b0p5 "" RAT_FUNC "%10.6" "" COEFFS 0 256 0 0 0 1 /end COMPU_METHOD
/begin COMPU_METHOD fak_sb_b1 "" RAT_FUNC "%6.4" "-" COEFFS 0 256 0 0 0 2 /end COMPU_METHOD
/begin COMPU_METHOD fak_sw_b1 "" RAT_FUNC "%7.6" "-" COEFFS 0 65536 0 0 0 2 /end COMPU_METHOD
/begin COMPU_METHOD fak_sw_b2 "" RAT_FUNC "%7.6" "-" COEFFS 0 65536 0 0 0 4 /end COMPU_METHOD
/begin COMPU_METHOD fak_sw_b256 "" RAT_FUNC "%6.4" "-" COEFFS 0 65536 0 0 0 512 /end COMPU_METHOD
/begin COMPU_METHOD fak_sw_b8 "" RAT_FUNC "%6.5" "-" COEFFS 0 65536 0 0 0 16 /end COMPU_METHOD
/begin COMPU_METHOD fak_ub_b0p125 "" RAT_FUNC "%6.5" "-" COEFFS 0 256 0 0 0 0.125 /end COMPU_METHOD
/begin COMPU_METHOD fak_ub_b1 "" RAT_FUNC "%6.4" "-" COEFFS 0 256 0 0 0 1 /end COMPU_METHOD
/begin COMPU_METHOD fak_ub_b16 "" RAT_FUNC "%6.4" "-" COEFFS 0 256 0 0 0 16 /end COMPU_METHOD
/begin COMPU_METHOD fak_ub_b2 "" RAT_FUNC "%6.4" "-" COEFFS 0 256 0 0 0 2 /end COMPU_METHOD
/begin COMPU_METHOD fak_ub_b4 "" RAT_FUNC "%6.4" "-" COEFFS 0 256 0 0 0 4 /end COMPU_METHOD
/begin COMPU_METHOD fak_ub_b8 "" RAT_FUNC "%6.4" "-" COEFFS 0 256 0 0 0 8 /end COMPU_METHOD
/begin COMPU_METHOD fak_uw_b1 "" RAT_FUNC "%7.6" "-" COEFFS 0 65536 0 0 0 1 /end COMPU_METHOD
/begin COMPU_METHOD fak_uw_b16 "" RAT_FUNC "%6.5" "-" COEFFS 0 65536 0 0 0 16 /end COMPU_METHOD
/begin COMPU_METHOD fak_uw_b2 "" RAT_FUNC "%7.6" "-" COEFFS 0 65536 0 0 0 2 /end COMPU_METHOD
/begin COMPU_METHOD fak_uw_b4 "" RAT_FUNC "%7.6" "-" COEFFS 0 65536 0 0 0 4 /end COMPU_METHOD
/begin COMPU_METHOD fak_uw_b8 "" RAT_FUNC "%6.5" "-" COEFFS 0 65536 0 0 0 8 /end COMPU_METHOD
/begin COMPU_METHOD fmfkr_dez "" RAT_FUNC "%6.2" "kHz" COEFFS 0 1 0 0 0 1 /end COMPU_METHOD
/begin COMPU_METHOD kw_q0p0156 "" RAT_FUNC "%6.4" "°KW" COEFFS 0 64 0 0 0 1 /end COMPU_METHOD
/begin COMPU_METHOD kw_q2p8125 "" RAT_FUNC "%6.2" "°KW" COEFFS 0 1 0 0 0 2.8125 /end COMPU_METHOD
/begin COMPU_METHOD kw_tooth_sy "" RAT_FUNC "%6.2" "°KW" COEFFS 0 0.166667 0 0 0 1 /end COMPU_METHOD
/begin COMPU_METHOD mdt_sw_b2556 "" RAT_FUNC "%6.4" "Nms" COEFFS 0 65536 0 0 0 5112 /end COMPU_METHOD
/begin COMPU_METHOD m_sw_b3276p8 "" RAT_FUNC "%6.3" "kg/h" COEFFS 0 1 0 0 0 0.1 /end COMPU_METHOD
/begin COMPU_METHOD m_uw_b6553p5 "" RAT_FUNC "%6.3" "kg/h" COEFFS 0 1 0 0 0 0.1 /end COMPU_METHOD
/begin COMPU_METHOD nmotg_sw_b13p89 "" RAT_FUNC "%6.5" "m/(s**2)" COEFFS 0 2359.11 0 0 0 1 /end COMPU_METHOD
/begin COMPU_METHOD nmot_ub_q0p25 "" RAT_FUNC "%6.3" "U/min" COEFFS 0 1 0 0 0 0.25 /end COMPU_METHOD
/begin COMPU_METHOD nmot_ub_q10 "" RAT_FUNC "%6.1" "U/min" COEFFS 0 1 0 0 0 10 /end COMPU_METHOD
/begin COMPU_METHOD nmot_ub_q40 "" RAT_FUNC "%6.1" "Upm" COEFFS 0 1 0 0 0 40 /end COMPU_METHOD
/begin COMPU_METHOD nmot_uw_q0p25 "" RAT_FUNC "%6.3" "U/min" COEFFS 0 1 0 0 0 0.25 /end COMPU_METHOD
/begin COMPU_METHOD p_sb_q0p25 "" RAT_FUNC "%6.3" "hPa" COEFFS 0 1 0 0 0 0.25 /end COMPU_METHOD
/begin COMPU_METHOD p_sb_q0p625 "" RAT_FUNC "%6.3" "hPa" COEFFS 0 128 0 0 0 80 /end COMPU_METHOD
/begin COMPU_METHOD p_sw_q0p000977 "" RAT_FUNC "%6.5" "hPa" COEFFS 0 1 0 0 0 0.000977 /end COMPU_METHOD
/begin COMPU_METHOD p_sw_q0p00244 "" RAT_FUNC "%6.4" "hPa" COEFFS 0 32768 0 0 0 80 /end COMPU_METHOD
/begin COMPU_METHOD p_sw_q0p039 "" RAT_FUNC "%6.4" "hPa" COEFFS 0 256 0 0 0 10 /end COMPU_METHOD
/begin COMPU_METHOD p_ub_q10 "" RAT_FUNC "%6.1" "hPa" COEFFS 0 1 0 0 0 10 /end COMPU_METHOD
/begin COMPU_METHOD p_ub_q5 "" RAT_FUNC "%6.2" "hPa" COEFFS 0 1 0 0 0 5 /end COMPU_METHOD
/begin COMPU_METHOD p_uw_q0p039 "" RAT_FUNC "%6.4" "hPa" COEFFS 0 256 0 0 0 10 /end COMPU_METHOD
/begin COMPU_METHOD relDK_q0p02441 "" RAT_FUNC "%6.4" "% DK" COEFFS 0 65536 0 0 0 1600 /end COMPU_METHOD
/begin COMPU_METHOD relDK_ub_b100 "" RAT_FUNC "%6.3" "% DK" COEFFS 0 255 0 0 0 100 /end COMPU_METHOD
/begin COMPU_METHOD relDK_uw_b100 "" RAT_FUNC "%6.4" "% DK" COEFFS 0 65535 0 0 0 100 /end COMPU_METHOD
/begin COMPU_METHOD relPED_uw_b100 "" RAT_FUNC "%6.4" "% PED" COEFFS 0 65535 0 0 0 100 /end COMPU_METHOD
/begin COMPU_METHOD rel_sw_b1536 "" RAT_FUNC "%6.4" "%" COEFFS 0 65536 0 0 0 3072 /end COMPU_METHOD
/begin COMPU_METHOD rel_sw_b1p5 "" RAT_FUNC "%7.6" "%/(1/min)" COEFFS 0 32768 0 0 0 1.5 /end COMPU_METHOD
/begin COMPU_METHOD rel_sw_b50 "" RAT_FUNC "%6.4" "%" COEFFS 0 65536 0 0 0 100 /end COMPU_METHOD
/begin COMPU_METHOD rel_sw_q0p0234 "" RAT_FUNC "%6.4" "%/seg" COEFFS 0 32 0 0 0 0.75 /end COMPU_METHOD
/begin COMPU_METHOD rel_sw_q0p1875 "" RAT_FUNC "%6.3" "%" COEFFS 0 65536 0 0 0 12288 /end COMPU_METHOD
/begin COMPU_METHOD rel_ub_b200 "" RAT_FUNC "%6.3" "%" COEFFS 0 256 0 0 0 200 /end COMPU_METHOD
/begin COMPU_METHOD rel_ub_b99p6 "" RAT_FUNC "%6.3" "%" COEFFS 0 256 0 0 0 100 /end COMPU_METHOD
/begin COMPU_METHOD rel_ub_q0p75 "" RAT_FUNC "%6.3" "%" COEFFS 0 1 0 0 0 0.75 /end COMPU_METHOD
/begin COMPU_METHOD rel_uw_b100 "" RAT_FUNC "%6.4" "%" COEFFS 0 65536 0 0 0 100 /end COMPU_METHOD
/begin COMPU_METHOD rel_uw_b20 "" RAT_FUNC "%6.5" "km/h" COEFFS 0 65536 0 0 0 20 /end COMPU_METHOD
/begin COMPU_METHOD rel_uw_b200 "" RAT_FUNC "%6.4" "%" COEFFS 0 65536 0 0 0 200 /end COMPU_METHOD
/begin COMPU_METHOD rel_uw_b3200 "" RAT_FUNC "%6.4" "%/(km/h)" COEFFS 0 65536 0 0 0 3200 /end COMPU_METHOD
/begin COMPU_METHOD rel_uw_b6144 "" RAT_FUNC "%6.3" "%" COEFFS 0 65536 0 0 0 6144 /end COMPU_METHOD
/begin COMPU_METHOD rel_uw_q0p0234 "" RAT_FUNC "%6.4" "%" COEFFS 0 32 0 0 0 0.75 /end COMPU_METHOD
/begin COMPU_METHOD rel_uw_q0p1875 "" RAT_FUNC "%6.3" "%" COEFFS 0 65536 0 0 0 12288 /end COMPU_METHOD
/begin COMPU_METHOD spg_q0p1 "" RAT_FUNC "%6.3" "V" COEFFS 0 1 0 0 0 0.1 /end COMPU_METHOD
/begin COMPU_METHOD spg_sw_b5 "" RAT_FUNC "%6.4" "V" COEFFS 0 1024 0 0 0 10 /end COMPU_METHOD
/begin COMPU_METHOD spg_ubatt "" RAT_FUNC "%6.4" "V" COEFFS 0 1 0 0 0 0.0704 /end COMPU_METHOD
/begin COMPU_METHOD spg_ub_b5 "" RAT_FUNC "%6.4" "V" COEFFS 0 256 0 0 0 5 /end COMPU_METHOD
/begin COMPU_METHOD spg_ub_q0p019 "" RAT_FUNC "%6.4" "V" COEFFS 0 256 0 0 0 5 /end COMPU_METHOD
/begin COMPU_METHOD spg_uw_q0p001222 "" RAT_FUNC "%6.4" "V" COEFFS 0 1 0 0 0 0.001222 /end COMPU_METHOD
/begin COMPU_METHOD spg_uw_q0p00488 "" RAT_FUNC "%6.4" "V" COEFFS 0 1024 0 0 0 5 /end COMPU_METHOD
/begin COMPU_METHOD t100msxms_ub_b255 "" RAT_FUNC "%6.2" "ms" COEFFS 0 1 0 0 0 1 /end COMPU_METHOD
/begin COMPU_METHOD t100msxs_ub_b25p5 "" RAT_FUNC "%6.3" "s" COEFFS 0 1 0 0 0 0.1 /end COMPU_METHOD
/begin COMPU_METHOD t100msxs_uw_b6553p5 "" RAT_FUNC "%6.3" "s" COEFFS 0 1 0 0 0 0.1 /end COMPU_METHOD
/begin COMPU_METHOD t10msxs_ub_b2p55 "" RAT_FUNC "%6.4" "s" COEFFS 0 1 0 0 0 0.01 /end COMPU_METHOD
/begin COMPU_METHOD t10msxs_uw_b655p35 "" RAT_FUNC "%6.4" "s" COEFFS 0 1 0 0 0 0.01 /end COMPU_METHOD
/begin COMPU_METHOD t200msxs_uw_q0p2 "" RAT_FUNC "%6.3" "s" COEFFS 0 1 0 0 0 0.2 /end COMPU_METHOD
/begin COMPU_METHOD t20msxs_ub_b5p1 "" RAT_FUNC "%6.4" "s" COEFFS 0 1 0 0 0 0.02 /end COMPU_METHOD
/begin COMPU_METHOD t20msxs_ub_q0p02 "" RAT_FUNC "%6.4" "s" COEFFS 0 50 0 0 0 1 /end COMPU_METHOD
/begin COMPU_METHOD t20msxs_uw_b1310 "" RAT_FUNC "%6.4" "s" COEFFS 0 1 0 0 0 0.02 /end COMPU_METHOD
/begin COMPU_METHOD t20msxs_uw_q0p02 "" RAT_FUNC "%6.4" "s" COEFFS 0 1 0 0 0 0.02 /end COMPU_METHOD
/begin COMPU_METHOD t50msxs_ub_b12p75 "" RAT_FUNC "%6.4" "s" COEFFS 0 1 0 0 0 0.05 /end COMPU_METHOD
/begin COMPU_METHOD temp_ub_b191p25 "" RAT_FUNC "%6.3" "Grad C" COEFFS 0 1 0 0 0 0.75 /end COMPU_METHOD
/begin COMPU_METHOD temp_ub_q0p75_o48 "" RAT_FUNC "%6.2" "Grad C" COEFFS 0 1 48 0 0 0.75 /end COMPU_METHOD
/begin COMPU_METHOD temp_uw_q0p0195_o50 "" RAT_FUNC "%6.2" "Grad C" COEFFS 0 256 12800 0 0 5 /end COMPU_METHOD
/begin COMPU_METHOD tknockcon_sy "" RAT_FUNC "%8.7" "s" COEFFS 0 375000 0 0 0 1 /end COMPU_METHOD
/begin COMPU_METHOD tknockintgrad_sy "" RAT_FUNC "%6.3" "V/s" COEFFS 0 8.94855 0 0 0 1 /end COMPU_METHOD
/begin COMPU_METHOD tv_sw_q0p005 "" RAT_FUNC "%6.4" "%" COEFFS 0 1 0 0 0 0.005 /end COMPU_METHOD
/begin COMPU_METHOD vfzg_sw_q0p00781 "" RAT_FUNC "%6.4" "km/h" COEFFS 0 1 0 0 0 0.0078125 /end COMPU_METHOD
/begin COMPU_METHOD vfzg_uw_b325 "" RAT_FUNC "%6.4" "km/h" COEFFS 0 65536 0 0 0 325 /end COMPU_METHOD
/begin COMPU_METHOD vfzg_uw_b512 "" RAT_FUNC "%6.4" "km/h" COEFFS 0 65536 0 0 0 512 /end COMPU_METHOD
/begin COMPU_METHOD vfzg_uw_q0p00781 "" RAT_FUNC "%6.4" "km/h" COEFFS 0 1 0 0 0 0.0078125 /end COMPU_METHOD
/begin COMPU_METHOD vfzg_uw_q0p0078125 "" RAT_FUNC "%6.4" "km/h" COEFFS 0 1 0 0 0 0.0078125 /end COMPU_METHOD
/begin COMPU_METHOD vrad_uw_b655 "" RAT_FUNC "%6.4" "km/h" COEFFS 0 65536 0 0 0 655 /end COMPU_METHOD
/begin COMPU_METHOD zk100msxs_ub_b25p5 "" RAT_FUNC "%6.3" "s" COEFFS 0 0 256 0 10 0 /end COMPU_METHOD
/begin COMPU_METHOD zk100msxs_uw_b6553 "" RAT_FUNC "%12.4" "s" COEFFS 0 0 65536 0 10 0 /end COMPU_METHOD
/begin COMPU_METHOD zk10msxs_ub_b2p55 "" RAT_FUNC "%6.4" "s" COEFFS 0 0 255 0 100 0 /end COMPU_METHOD
/begin COMPU_METHOD zk10msxs_uw_b655 "" RAT_FUNC "%12.5" "s" COEFFS 0 0 65536 0 100 0 /end COMPU_METHOD
/begin COMPU_METHOD zk20msxs_uw_b1310 "" RAT_FUNC "%12.4" "s" COEFFS 0 0 65536 0 50 0 /end COMPU_METHOD
/begin COMPU_METHOD zw_sb_q6 "" RAT_FUNC "%6.2" "Grad KW" COEFFS 0 1 0 0 0 6 /end COMPU_METHOD
/begin COMPU_METHOD zw_ub_q0p75 "" RAT_FUNC "%6.3" "Grad KW" COEFFS 0 255 0 0 0 191.25 /end COMPU_METHOD
/begin COMPU_METHOD zw_ub_q6 "" RAT_FUNC "%6.2" "Grad KW" COEFFS 0 255 0 0 0 1530 /end COMPU_METHOD
/begin RECORD_LAYOUT FklNoOffWUw FNC_VALUES 1 UWORD COLUMN_DIR DIRECT /end RECORD_LAYOUT
/begin RECORD_LAYOUT FklWUb FNC_VALUES 1 UBYTE COLUMN_DIR DIRECT /end RECORD_LAYOUT
/begin RECORD_LAYOUT FklWUw FNC_VALUES 1 UWORD COLUMN_DIR DIRECT /end RECORD_LAYOUT
/begin RECORD_LAYOUT GkfWSb FNC_VALUES 1 SBYTE COLUMN_DIR DIRECT /end RECORD_LAYOUT
/begin RECORD_LAYOUT GkfWUb FNC_VALUES 1 UBYTE COLUMN_DIR DIRECT /end RECORD_LAYOUT
/begin RECORD_LAYOUT GklWSb FNC_VALUES 1 SBYTE COLUMN_DIR DIRECT /end RECORD_LAYOUT
/begin RECORD_LAYOUT GklWSw FNC_VALUES 1 SWORD COLUMN_DIR DIRECT /end RECORD_LAYOUT
/begin RECORD_LAYOUT GklWUb FNC_VALUES 1 UBYTE COLUMN_DIR DIRECT /end RECORD_LAYOUT
/begin RECORD_LAYOUT GklWUw FNC_VALUES 1 UWORD COLUMN_DIR DIRECT /end RECORD_LAYOUT
/begin RECORD_LAYOUT KfAxUbAyUbSstxSwSstyUbWSw NO_AXIS_PTS_X 1 UBYTE NO_AXIS_PTS_Y 2 UBYTE AXIS_PTS_X 3 SWORD INDEX_INCR DIRECT AXIS_PTS_Y 4 UBYTE INDEX_INCR DIRECT FNC_VALUES 5 SWORD COLUMN_DIR DIRECT /end RECORD_LAYOUT
/begin RECORD_LAYOUT KfAxUbAyUbSstxUbSstyUbWSb NO_AXIS_PTS_X 1 UBYTE NO_AXIS_PTS_Y 2 UBYTE AXIS_PTS_X 3 UBYTE INDEX_INCR DIRECT AXIS_PTS_Y 4 UBYTE INDEX_INCR DIRECT FNC_VALUES 5 SBYTE COLUMN_DIR DIRECT /end RECORD_LAYOUT
/begin RECORD_LAYOUT KfAxUbAyUbSstxUbSstyUbWUb NO_AXIS_PTS_X 1 UBYTE NO_AXIS_PTS_Y 2 UBYTE AXIS_PTS_X 3 UBYTE INDEX_INCR DIRECT AXIS_PTS_Y 4 UBYTE INDEX_INCR DIRECT FNC_VALUES 5 UBYTE COLUMN_DIR DIRECT /end RECORD_LAYOUT
/begin RECORD_LAYOUT KfAxUwAyUwSstxUwSstyUwWUw NO_AXIS_PTS_X 1 UWORD NO_AXIS_PTS_Y 2 UWORD AXIS_PTS_X 3 UWORD INDEX_INCR DIRECT AXIS_PTS_Y 4 UWORD INDEX_INCR DIRECT FNC_VALUES 5 UWORD COLUMN_DIR DIRECT /end RECORD_LAYOUT
/begin RECORD_LAYOUT KlASwSstSwWSw NO_AXIS_PTS_X 1 SWORD AXIS_PTS_X 2 SWORD INDEX_INCR DIRECT FNC_VALUES 3 SWORD COLUMN_DIR DIRECT /end RECORD_LAYOUT
/begin RECORD_LAYOUT KlAUbSstUbWUb NO_AXIS_PTS_X 1 UBYTE AXIS_PTS_X 2 UBYTE INDEX_INCR DIRECT FNC_VALUES 3 UBYTE COLUMN_DIR DIRECT /end RECORD_LAYOUT
/begin RECORD_LAYOUT KlAUbSstUbWUw NO_AXIS_PTS_X 1 UBYTE AXIS_PTS_X 2 UBYTE INDEX_INCR DIRECT FNC_VALUES 3 UWORD COLUMN_DIR DIRECT /end RECORD_LAYOUT
/begin RECORD_LAYOUT KlAUwSstSwWUw NO_AXIS_PTS_X 1 UWORD AXIS_PTS_X 2 SWORD INDEX_INCR DIRECT FNC_VALUES 3 UWORD COLUMN_DIR DIRECT /end RECORD_LAYOUT
/begin RECORD_LAYOUT KlAUwSstUwWUb NO_AXIS_PTS_X 1 UWORD AXIS_PTS_X 2 UWORD INDEX_INCR DIRECT FNC_VALUES 3 UBYTE COLUMN_DIR DIRECT /end RECORD_LAYOUT
/begin RECORD_LAYOUT KlAUwSstUwWUw NO_AXIS_PTS_X 1 UWORD AXIS_PTS_X 2 UWORD INDEX_INCR DIRECT FNC_VALUES 3 UWORD COLUMN_DIR DIRECT /end RECORD_LAYOUT
/begin RECORD_LAYOUT KwSw FNC_VALUES 1 SWORD COLUMN_DIR DIRECT /end RECORD_LAYOUT
/begin RECORD_LAYOUT KwUb FNC_VALUES 1 UBYTE COLUMN_DIR DIRECT /end RECORD_LAYOUT
/begin RECORD_LAYOUT KwUw FNC_VALUES 1 UWORD COLUMN_DIR DIRECT /end RECORD_LAYOUT
/begin RECORD_LAYOUT SstAUbSstUb NO_AXIS_PTS_X 1 UBYTE AXIS_PTS_X 2 UBYTE INDEX_INCR DIRECT /end RECORD_LAYOUT
/begin RECORD_LAYOUT SstAUwSstUw NO_AXIS_PTS_X 1 UWORD AXIS_PTS_X 2 UWORD INDEX_INCR DIRECT /end RECORD_LAYOUT
/end MODULE
/end PROJECT
