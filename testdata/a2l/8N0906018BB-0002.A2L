ASAP2_VERSION 1 3
/begin PROJECT X505R_24d1_0 "4019.XX"
/begin HEADER "" VERSION "X505R_24d1_0" PROJECT_NO X505R_24d1_0 /end HEADER
/begin MODULE DIM ""
/begin MOD_COMMON "" BYTE_ORDER MSB_LAST ALIGNMENT_BYTE 1 ALIGNMENT_WORD 2 ALIGNMENT_LONG 2 /end MOD_COMMON
/begin CHARACTERISTIC ANZDCVIO "Mindestanzahl i.O.-Prüfungen für Aussage 'System iO'" VALUE 0x81B408 KwUw 65535.00 dez 0.00 65535.00 FORMAT "%8.2" /end CHARACTERISTIC
/begin CHARACTERISTIC ANZDCVNIO "Mindestanzahl n.i.O.-Prüfungen für Aussage 'System niO'" VALUE 0x81B40A KwUw 65535.00 dez 0.00 65535.00 FORMAT "%8.2" /end CHARACTERISTIC
/begin CHARACTERISTIC ANZWDHMX "Maximale Anzahl von Diagnosewiederholungen innerhalb eines DCY" VALUE 0x81B40C KwUw 65535.00 dez 0.00 65535.00 FORMAT "%8.2" /end CHARACTERISTIC
/begin CHARACTERISTIC APULSMXA "Maximale Anzahl Impulse bei Einzelimpulsansteuerung" VALUE 0x810C33 KwUb 255.0 dez 0.00 255.0 FORMAT "%5.1" /end CHARACTERISTIC
/begin CHARACTERISTIC BUSOFFCTR "Zähler für Bus-off-Flanken bis Fehlerspeichereintrag" VALUE 0x810163 KwUb 255.0 DEZ 0.00 255.0 FORMAT "%5.1" /end CHARACTERISTIC
/begin CHARACTERISTIC BUSOFFTIME "Entprellzeit zum Rücksetzen von Bus-off-Fehler" VALUE 0x810164 KwUb 2.550 t10msxs_ub_b2p55 0.00 2.550 FORMAT "%5.3" /end CHARACTERISTIC
/begin CHARACTERISTIC CANVERS "CAN-Versionsbezeichnung" VALUE 0x810165 KwUb 255.0 DEZ 0.00 255.0 FORMAT "%5.1" /end CHARACTERISTIC
/begin CHARACTERISTIC CCMKBI "Kombiausgabe Hubraum" VALUE 0x818405 KwUb 25.50 vol_q0p1_l 0.00 25.50 FORMAT "%5.2" /end CHARACTERISTIC
/begin CHARACTERISTIC CDCAAV "Codewort CARB: Absperrventil Aktivkohlefilter (Funktion)" VAL_BLK 0x813378 KwbUw 65535.00 dez 0.00 65535.00 FORMAT "%8.2" NUMBER 4 /end CHARACTERISTIC
/begin CHARACTERISTIC CDCCAIR "Codewort CARB: Airbag-Botschaft" VAL_BLK 0x8133E8 KwbUw 65535.00 dez 0.00 65535.00 FORMAT "%8.2" NUMBER 4 /end CHARACTERISTIC
/begin CHARACTERISTIC CDCCAS "Codewort CARB: CAN-Schnittstelle, Timeout ASC" VAL_BLK 0x8133F8 KwbUw 65535.00 dez 0.00 65535.00 FORMAT "%8.2" NUMBER 4 /end CHARACTERISTIC
/begin CHARACTERISTIC CDCCAT "Codewort CARB: CAN-Schnittstelle, Timeout ASR" VAL_BLK 0x813400 KwbUw 65535.00 dez 0.00 65535.00 FORMAT "%8.2" NUMBER 4 /end CHARACTERISTIC
/begin CHARACTERISTIC CDCCGE "Codewort CARB: CAN-Schnittstelle, Timeout EGS" VAL_BLK 0x813408 KwbUw 65535.00 dez 0.00 65535.00 FORMAT "%8.2" NUMBER 4 /end CHARACTERISTIC
/begin CHARACTERISTIC CDCCGRA "Codewort CARB: GRA-Botschaft (Empfang)" VAL_BLK 0x813410 KwbUw 65535.00 dez 0.00 65535.00 FORMAT "%8.2" NUMBER 4 /end CHARACTERISTIC
/begin CHARACTERISTIC CDCCIF "Codewort CARB: CAN-Schnittstelle, interner Fehler" VAL_BLK 0x813418 KwbUw 65535.00 dez 0.00 65535.00 FORMAT "%8.2" NUMBER 4 /end CHARACTERISTIC
/begin CHARACTERISTIC CDCCINS "Codewort CARB: CAN-Schnittstelle, Timeout Instrument" VAL_BLK 0x813420 KwbUw 65535.00 dez 0.00 65535.00 FORMAT "%8.2" NUMBER 4 /end CHARACTERISTIC
/begin CHARACTERISTIC CDCCKLA "Codewort CARB: CAN-Schnittstelle, Timeout Klima" VAL_BLK 0x813428 KwbUw 65535.00 dez 0.00 65535.00 FORMAT "%8.2" NUMBER 4 /end CHARACTERISTIC
/begin CHARACTERISTIC CDCSWE "Codewort CARB:	Beschleunigungssensor der Schlechtwegeerkennung" VAL_BLK 0x813720 KwbUw 65535.00 dez 0.00 65535.00 FORMAT "%8.2" NUMBER 4 /end CHARACTERISTIC
/begin CHARACTERISTIC CDKAAV "Codewort Kunde: Absperrventil Aktivkohlefilter (Funktion)" VAL_BLK 0x813818 KwbUw 65535.00 dez 0.00 65535.00 FORMAT "%8.2" NUMBER 4 /end CHARACTERISTIC
/begin CHARACTERISTIC CDKCAIR "Codewort Kunde: Airbag-Botschaft" VAL_BLK 0x813888 KwbUw 65535.00 dez 0.00 65535.00 FORMAT "%8.2" NUMBER 4 /end CHARACTERISTIC
/begin CHARACTERISTIC CDKCAS "Codewort Kunde: CAN-Schnittstelle, Timeout ASC" VAL_BLK 0x813898 KwbUw 65535.00 dez 0.00 65535.00 FORMAT "%8.2" NUMBER 4 /end CHARACTERISTIC
/begin CHARACTERISTIC CDKCAT "Codewort Kunde: CAN-Schnittstelle, Timeout ASR" VAL_BLK 0x8138A0 KwbUw 65535.00 dez 0.00 65535.00 FORMAT "%8.2" NUMBER 4 /end CHARACTERISTIC
/begin CHARACTERISTIC CDKCGE "Codewort Kunde: CAN-Schnittstelle, Timeout EGS" VAL_BLK 0x8138A8 KwbUw 65535.00 dez 0.00 65535.00 FORMAT "%8.2" NUMBER 4 /end CHARACTERISTIC
/begin CHARACTERISTIC CDKCGRA "Codewort Kunde: GRA-Botschaft (Empfang)" VAL_BLK 0x8138B0 KwbUw 65535.00 dez 0.00 65535.00 FORMAT "%8.2" NUMBER 4 /end CHARACTERISTIC
/begin CHARACTERISTIC CDKCIF "Codewort Kunde: CAN-Schnittstelle, interner Fehler" VAL_BLK 0x8138B8 KwbUw 65535.00 dez 0.00 65535.00 FORMAT "%8.2" NUMBER 4 /end CHARACTERISTIC
/begin CHARACTERISTIC CDKCINS "Codewort Kunde: CAN- timeout, Instrumente" VAL_BLK 0x8138C0 KwbUw 65535.00 dez 0.00 65535.00 FORMAT "%8.2" NUMBER 4 /end CHARACTERISTIC
/begin CHARACTERISTIC CDKCKLA "Codewort Kunde: CAN-Schnittstelle, Timeout Klima" VAL_BLK 0x8138C8 KwbUw 65535.00 dez 0.00 65535.00 FORMAT "%8.2" NUMBER 4 /end CHARACTERISTIC
/begin CHARACTERISTIC CDKSWE "Codewort Kunde:	Beschleunigungssensor der Schlechtwegeerkennung" VAL_BLK 0x813BC0 KwbUw 65535.00 dez 0.00 65535.00 FORMAT "%8.2" NUMBER 4 /end CHARACTERISTIC
/begin CHARACTERISTIC CDTAAV "Codewort Tester: Absperrventil Aktivkohlefilter (Fkt)" VALUE 0x813CAC KwUw 65535.00 dez 0.00 65535.00 FORMAT "%8.2" /end CHARACTERISTIC
/begin CHARACTERISTIC CDTCAIR "Codewort Tester: Airbag-Botschaft" VALUE 0x813CC8 KwUw 65535.00 dez 0.00 65535.00 FORMAT "%8.2" /end CHARACTERISTIC
/begin CHARACTERISTIC CDTCAS "Codewort Tester: CAN-Schnittstelle, Timeout ASC" VALUE 0x813CCC KwUw 65535.00 dez 0.00 65535.00 FORMAT "%8.2" /end CHARACTERISTIC
/begin CHARACTERISTIC CDTCAT "" VALUE 0x813CCE KwUw 65535.00 dez 0.00 65535.00 FORMAT "%8.2" /end CHARACTERISTIC
/begin CHARACTERISTIC CDTCGE "Codewort Tester: CAN-Schnittstelle, Timeout EGS" VALUE 0x813CD0 KwUw 65535.00 dez 0.00 65535.00 FORMAT "%8.2" /end CHARACTERISTIC
/begin CHARACTERISTIC CDTCGRA "Codewort Tester: GRA-Botschaft (Empfang)" VALUE 0x813CD2 KwUw 65535.00 dez 0.00 65535.00 FORMAT "%8.2" /end CHARACTERISTIC
/begin CHARACTERISTIC CDTCIF "Codewort Tester: CAN-Schnittstelle, interner Fehler" VALUE 0x813CD4 KwUw 65535.00 dez 0.00 65535.00 FORMAT "%8.2" /end CHARACTERISTIC
/begin CHARACTERISTIC CDTCINS "Codewort Tester: CAN-Timeout, Instrumente" VALUE 0x813CD6 KwUw 65535.00 dez 0.00 65535.00 FORMAT "%8.2" /end CHARACTERISTIC
/begin CHARACTERISTIC CDTCKLA "Codewort Tester: CAN-Schnittstelle, Timeout Klima" VALUE 0x813CD8 KwUw 65535.00 dez 0.00 65535.00 FORMAT "%8.2" /end CHARACTERISTIC
/begin CHARACTERISTIC CDTSWE "Codewort Tester: Beschleunigungssensor Schlechtwegeerk." VALUE 0x813D96 KwUw 65535.00 dez 0.00 65535.00 FORMAT "%8.2" /end CHARACTERISTIC
/begin CHARACTERISTIC CL30LINE "30. Linie der Klassentabelle" VAL_BLK 0x81B636 KwbUb 255.0 dez 0.00 255.0 FORMAT "%5.1" NUMBER 14 /end CHARACTERISTIC
/begin CHARACTERISTIC CL31LINE "31. Linie der Klassentabelle" VAL_BLK 0x81B644 KwbUb 255.0 dez 0.00 255.0 FORMAT "%5.1" NUMBER 14 /end CHARACTERISTIC
/begin CHARACTERISTIC CL32LINE "32. Linie der Klassentabelle" VAL_BLK 0x81B652 KwbUb 255.0 dez 0.00 255.0 FORMAT "%5.1" NUMBER 14 /end CHARACTERISTIC
/begin CHARACTERISTIC CL33LINE "33. Linie der Klassentabelle" VAL_BLK 0x81B660 KwbUb 255.0 dez 0.00 255.0 FORMAT "%5.1" NUMBER 14 /end CHARACTERISTIC
/begin CHARACTERISTIC CL34LINE "34. Linie der Klassentabelle" VAL_BLK 0x81B66E KwbUb 255.0 dez 0.00 255.0 FORMAT "%5.1" NUMBER 14 /end CHARACTERISTIC
/begin CHARACTERISTIC CL35LINE "35. Linie der Klassentabelle" VAL_BLK 0x81B67C KwbUb 255.0 dez 0.00 255.0 FORMAT "%5.1" NUMBER 14 /end CHARACTERISTIC
/begin CHARACTERISTIC CL36LINE "36. Linie der Klassentabelle" VAL_BLK 0x81B68A KwbUb 255.0 dez 0.00 255.0 FORMAT "%5.1" NUMBER 14 /end CHARACTERISTIC
/begin CHARACTERISTIC CL37LINE "37. Linie der Klassentabelle" VAL_BLK 0x81B698 KwbUb 255.0 dez 0.00 255.0 FORMAT "%5.1" NUMBER 14 /end CHARACTERISTIC
/begin CHARACTERISTIC CL38LINE "38. Linie der Klassentabelle" VAL_BLK 0x81B6A6 KwbUb 255.0 dez 0.00 255.0 FORMAT "%5.1" NUMBER 14 /end CHARACTERISTIC
/begin CHARACTERISTIC CL39LINE "39. Linie der Klassentabelle" VAL_BLK 0x81B6B4 KwbUb 255.0 dez 0.00 255.0 FORMAT "%5.1" NUMBER 14 /end CHARACTERISTIC
/begin CHARACTERISTIC CLAAAV "Fehlerklasse: Tankdiagnose, AAV verstopft" VALUE 0x810765 KwUb 255.0 dez 0.00 255.0 FORMAT "%5.1" /end CHARACTERISTIC
/begin CHARACTERISTIC CLACAIR "Fehlerklasse: Airbag-Botschaft" VALUE 0x810773 KwUb 255.0 dez 0.00 255.0 FORMAT "%5.1" /end CHARACTERISTIC
/begin CHARACTERISTIC CLACAS "Fehlerklasse: CAN-Timeout ASC-Botschaft" VALUE 0x810775 KwUb 255.0 dez 0.00 255.0 FORMAT "%5.1" /end CHARACTERISTIC
/begin CHARACTERISTIC CLACAT "Fehlerklasse: CAN-Schnittstelle, Timeout ASR" VALUE 0x810776 KwUb 255.0 dez 0.00 255.0 FORMAT "%5.1" /end CHARACTERISTIC
/begin CHARACTERISTIC CLACGE "Fehlerklasse: CAN-Timeout EGS-Botschaft" VALUE 0x810777 KwUb 255.0 dez 0.00 255.0 FORMAT "%5.1" /end CHARACTERISTIC
/begin CHARACTERISTIC CLACGRA "Fehlerklasse: GRA-Botschaft (Empfang)" VALUE 0x810778 KwUb 255.0 dez 0.00 255.0 FORMAT "%5.1" /end CHARACTERISTIC
/begin CHARACTERISTIC CLACIF "Fehlerklasse: CAN-Schnittstelle, interner Fehler" VALUE 0x810779 KwUb 255.0 dez 0.00 255.0 FORMAT "%5.1" /end CHARACTERISTIC
/begin CHARACTERISTIC CLACINS "Fehlerklasse: CAN-Timeout Botschaft Kombiinstrument" VALUE 0x81077A KwUb 255.0 dez 0.00 255.0 FORMAT "%5.1" /end CHARACTERISTIC
/begin CHARACTERISTIC CLACKLA "" VALUE 0x81077B KwUb 255.0 dez 0.00 255.0 FORMAT "%5.1" /end CHARACTERISTIC
/begin CHARACTERISTIC CLASWE "Fehlerklasse: Beschleunigungssensor der Schlechtwegerkennung" VALUE 0x8107DA KwUb 255.0 dez 0.00 255.0 FORMAT "%5.1" /end CHARACTERISTIC
/begin CHARACTERISTIC CORTINC "Wert der bei Zahnkorrektur aufaddiert wird" VALUE 0x8109C0 KwUb 255.0 dez 0.00 255.0 FORMAT "%5.1" /end CHARACTERISTIC
/begin CHARACTERISTIC CORTINIT "Initialisierungswert für Zähler Zahnkorrektur" VALUE 0x8184A1 KwUb 255.0 dez 0.00 255.0 FORMAT "%5.1" /end CHARACTERISTIC
/begin CHARACTERISTIC CORTMX "Maximal zulässiger Wert für den Zahnkorrekturzähler" VALUE 0x8109C1 KwUb 255.0 dez 0.00 255.0 FORMAT "%5.1" /end CHARACTERISTIC
/begin CHARACTERISTIC CSAIR "Soll-Checksumme der Airbagbotschaft" VALUE 0x810166 KwUb 255.0 DEZ 0.00 255.0 FORMAT "%5.1" /end CHARACTERISTIC
/begin CHARACTERISTIC CWBBDECJ "Codewort Abwürgeschutz DECJ aktiv" VALUE 0x8189A1 KwUb 255.0 dez 0.00 255.0 FORMAT "%5.1" /end CHARACTERISTIC
/begin CHARACTERISTIC CWBKV "Codewort für Bremskraftverstärker" VALUE 0x829962 KwUw 65535.00 dez 0.00 65535.00 FORMAT "%8.2" /end CHARACTERISTIC
/begin CHARACTERISTIC CWCANKBI "Codewort für automatische Kombi-Botschafts-Erkennung" VALUE 0x810167 KwUb 255.0 DEZ 0.00 255.0 FORMAT "%5.1" /end CHARACTERISTIC
/begin CHARACTERISTIC CWCANLWS "Codewort für automatische Erkennung LWS-Botschaft" VALUE 0x810168 KwUb 255.0 DEZ 0.00 255.0 FORMAT "%5.1" /end CHARACTERISTIC
/begin CHARACTERISTIC CWCANMD "Codewort zur Bildung der CAN-Ausgabe Momentenangaben ungenau" VALUE 0x810169 KwUb 255.0 DEZ 0.00 255.0 FORMAT "%5.1" /end CHARACTERISTIC
/begin CHARACTERISTIC CWCAUVW "Codewort für Audi/VW CAN-Ausgabe" VALUE 0x81016A KwUb 255.0 DEZ 0.00 255.0 FORMAT "%5.1" /end CHARACTERISTIC
/begin CHARACTERISTIC CWCDCUM "Codewort zur Umschaltung der CDC's auf den jeweiligen Markt" VALUE 0x8184A0 KwUb 255.0 dez 0.00 255.0 FORMAT "%5.1" /end CHARACTERISTIC
/begin CHARACTERISTIC CWCFS "Codewort zum Bilden von S_fs" VALUE 0x81016B KwUb 255.0 DEZ 0.00 255.0 FORMAT "%5.1" /end CHARACTERISTIC
/begin CHARACTERISTIC CWDAAV "Codewort Diagnose Aktivkohlefilter-Absperrventil DAAV" VALUE 0x8189AB KwUb 255.0 dez 0.00 255.0 FORMAT "%5.1" /end CHARACTERISTIC
/begin CHARACTERISTIC CWDCV "Codewort für KGE-Diagnose zur Einstellung der Diagnosevarianten" VALUE 0x81B40E KwUw 65535.00 dez 0.00 65535.00 FORMAT "%8.2" /end CHARACTERISTIC
/begin CHARACTERISTIC CWDEGFE "Codewort für Abschaltung der Funktion %DEGFE" VALUE 0x818B0B KwUb 255.0 dez 0.00 255.0 FORMAT "%5.1" /end CHARACTERISTIC
/begin CHARACTERISTIC CWFLC "Codewort für Steuerung MIL-ON entsprechend OBDII / EOBD" VALUE 0x8109BD KwUb 255.0 dez 0.00 255.0 FORMAT "%5.1" /end CHARACTERISTIC
/begin CHARACTERISTIC CWGC_0_A "Getriebe-Codierung (CAN)" VALUE 0x8132F2 KwUb 255.0 DEZ 0.00 255.0 FORMAT "%5.1" /end CHARACTERISTIC
/begin CHARACTERISTIC CWGC_1_A "Getriebe-Codierung (CAN)" VALUE 0x8132F3 KwUb 255.0 DEZ 0.00 255.0 FORMAT "%5.1" /end CHARACTERISTIC
/begin CHARACTERISTIC CWGC_2_A "Getriebe-Codierung (CAN)" VALUE 0x8132F4 KwUb 255.0 DEZ 0.00 255.0 FORMAT "%5.1" /end CHARACTERISTIC
/begin CHARACTERISTIC CWGC_3_A "Getriebe-Codierung (CAN)" VALUE 0x8132F5 KwUb 255.0 DEZ 0.00 255.0 FORMAT "%5.1" /end CHARACTERISTIC
/begin CHARACTERISTIC CWGEEIN "Codewort für Übernahme der Getriebeanforderung" VALUE 0x81016C KwUb 255.0 DEZ 0.00 255.0 FORMAT "%5.1" /end CHARACTERISTIC
/begin CHARACTERISTIC CW_CAN_C "Codewort für Kodierfehlerüberwachung" VALUE 0x81016D KwUb 255.0 DEZ 0.00 255.0 FORMAT "%5.1" /end CHARACTERISTIC
/begin CHARACTERISTIC CW_CAN_R_0___A "Codewort für CAN-Empfangskonfiguration" VALUE 0x8132E2 KwUw 65535.00 DEZ 0.00 65535.00 FORMAT "%8.2" /end CHARACTERISTIC
/begin CHARACTERISTIC CW_CAN_R_1___A "Codewort für CAN-Empfangskonfiguration" VALUE 0x8132E4 KwUw 65535.00 DEZ 0.00 65535.00 FORMAT "%8.2" /end CHARACTERISTIC
/begin CHARACTERISTIC CW_CAN_R_2___A "Codewort für CAN-Empfangskonfiguration" VALUE 0x8132E6 KwUw 65535.00 DEZ 0.00 65535.00 FORMAT "%8.2" /end CHARACTERISTIC
/begin CHARACTERISTIC CW_CAN_R_3___A "Codewort für CAN-Empfangskonfiguration" VALUE 0x8132E8 KwUw 65535.00 DEZ 0.00 65535.00 FORMAT "%8.2" /end CHARACTERISTIC
/begin CHARACTERISTIC CW_CAN_S_0___A "Codewort für CAN-Sendekonfiguration" VALUE 0x8132EA KwUw 65535.00 DEZ 0.00 65535.00 FORMAT "%8.2" /end CHARACTERISTIC
/begin CHARACTERISTIC CW_CAN_S_1___A "Codewort für CAN-Sendekonfiguration" VALUE 0x8132EC KwUw 65535.00 DEZ 0.00 65535.00 FORMAT "%8.2" /end CHARACTERISTIC
/begin CHARACTERISTIC CW_CAN_S_2___A "Codewort für CAN-Sendekonfiguration" VALUE 0x8132EE KwUw 65535.00 DEZ 0.00 65535.00 FORMAT "%8.2" /end CHARACTERISTIC
/begin CHARACTERISTIC CW_CAN_S_3___A "Codewort für CAN-Sendekonfiguration" VALUE 0x8132F0 KwUw 65535.00 DEZ 0.00 65535.00 FORMAT "%8.2" /end CHARACTERISTIC
/begin CHARACTERISTIC DCVFHOU "Mindesthöhenfaktor zur Diagnosebereitschaft" VALUE 0x81B410 KwUw 3.999939 fak_uw_b4 0.00 3.999939 FORMAT "%8.6" /end CHARACTERISTIC
/begin CHARACTERISTIC DCVFRMMN "frm-Schwellwert für Freigabe der Diagnosebereitschaft" VALUE 0x81B412 KwUw 1.999969 fak_uw_b2 0.00 1.999969 FORMAT "%8.6" /end CHARACTERISTIC
/begin CHARACTERISTIC DCVLAMSMN "Min-Schwelle für lamsbg zur Freigabe der Diagnosebereitschaft" VALUE 0x81B414 KwUw 15.99976 fak_uw_b16 0.00 15.99976 FORMAT "%8.5" /end CHARACTERISTIC
/begin CHARACTERISTIC DCVLAMSMX "Max-Schwelle für lamsbg zur Freigabe der Diagnosebereitschaft" VALUE 0x81B416 KwUw 15.99976 fak_uw_b16 0.00 15.99976 FORMAT "%8.5" /end CHARACTERISTIC
/begin CHARACTERISTIC DCVLAMSO "Obere Schwelle für Zylinderabschaltung" VALUE 0x81B418 KwUw 15.99976 fak_uw_b16 0.00 15.99976 FORMAT "%8.5" /end CHARACTERISTIC
/begin CHARACTERISTIC DCVMLO "Maximaler Motorluftmassenstrom zur Diagnosebereitschaft" VALUE 0x81B41A KwUw 6553.500 m_uw_b6553p5 0.00 6553.500 FORMAT "%8.3" /end CHARACTERISTIC
/begin CHARACTERISTIC DCVRLO "Maximale Motorlast zur Diagnosebereitschaft" VALUE 0x81B41C KwUw 65535.00 rel_uw_q0p0234 0.00 65535.00 FORMAT "%8.2" /end CHARACTERISTIC
/begin CHARACTERISTIC DCVTAO "Maximale Ansauglufttemperatur zur Diagnosebereitschaft" VALUE 0x818483 KwUb 191.3 temp_ub_q0p75_o48 -48.00 143.3 FORMAT "%5.1" /end CHARACTERISTIC
/begin CHARACTERISTIC DCVTMU "Mindestmotortemperatur zur Diagnosebereitschaft" VALUE 0x818484 KwUb 191.3 temp_ub_q0p75_o48 -48.00 143.3 FORMAT "%5.1" /end CHARACTERISTIC
/begin CHARACTERISTIC DCVTNSTU "Mindestzeit nach Start bis Diagnosebereitschaft" VALUE 0x81B41E KwUw 655.3500 t10msxs_uw_b655p35 0.00 655.3500 FORMAT "%8.4" /end CHARACTERISTIC
/begin CHARACTERISTIC DCVVFZGO "Maximale Fahrzeuggeschwindigkeit zur Diagnosebereitschaft" VALUE 0x81B420 KwUw 511.9922 vfzg_uw_b512 0.00 511.9922 FORMAT "%8.4" /end CHARACTERISTIC
/begin CHARACTERISTIC DFPSLBIT "Selektionsbits für Kennzeichnung der aktivierten Fehlerpfade" VAL_BLK 0x81B6C2 KwbUw 65535.00 dez 0.00 65535.00 FORMAT "%8.2" NUMBER 16 /end CHARACTERISTIC
/begin CHARACTERISTIC DKAAVN "Maximaler Drosselklappenwinkel bei Leckdiagnose, DAAV" CURVE 0x810C34 KlAUbSstUbWUb 100.0 relDK_ub_b100 0.00 100.0 FORMAT "%5.1"
 /begin AXIS_DESCR STD_AXIS nmot nmot_ub_q40 6 0.00 10200. FORMAT "%5.0" DEPOSIT ABSOLUTE /end AXIS_DESCR
/end CHARACTERISTIC
/begin CHARACTERISTIC DKTLMTA "Max. Dauer tL-/wdkbl- Grenzwertüberschreitung" CURVE 0x8189AC KlAUbSstUbWUb 255.0 t1sxs_ub_b255 0.00 255.0 FORMAT "%5.1"
 /begin AXIS_DESCR STD_AXIS tfpg t1sxs_ub_b255 6 0.00 255.0 FORMAT "%5.1" DEPOSIT ABSOLUTE /end AXIS_DESCR
/end CHARACTERISTIC
/begin CHARACTERISTIC DLATRNP "Schwelle Delta Lambda für Erkennung unplausible Bankabweichung ATR" VALUE 0x819442 KwSb 1.992 fak_sb_b1 -1.000 0.9922 FORMAT "%5.3" /end CHARACTERISTIC
/begin CHARACTERISTIC DLEATRN "Schwelle Delta Lambda für Erkennung Fehler Abgastemperaturregelung" CURVE 0x81D464 KlAUbSstUbWSb 1.992 fak_sb_b1 -1.000 0.9922 FORMAT "%5.3"
 /begin AXIS_DESCR STD_AXIS nmot nmot_ub_q40 5 0.00 10200. FORMAT "%5.0" DEPOSIT ABSOLUTE /end AXIS_DESCR
/end CHARACTERISTIC
/begin CHARACTERISTIC DPBKVLE "zulässiger Druckanstieg bei Leckage" VALUE 0x8299C4 KwSw 2559.961 p_sw_q0p039 -1280.000 1279.961 FORMAT "%8.3" /end CHARACTERISTIC
/begin CHARACTERISTIC DPBKVP "Druckdelta, das in der Zeit TDDBKVP evakuiert werden kann" VALUE 0x8299BE KwUw 2559.961 p_uw_q0p039 0.00 2559.961 FORMAT "%8.3" /end CHARACTERISTIC
/begin CHARACTERISTIC DPBKVPMN "Toleranz von pubkv_w*FBKVP (min. Pump-Druck) und Toleranz Drucksensor im BKV" VALUE 0x8299C0 KwUw 2559.961 p_uw_q0p039 0.00 2559.961 FORMAT "%8.3" /end CHARACTERISTIC
/begin CHARACTERISTIC DPBKVSPS "Delta Druck zw. Sollbremskraftverstärkerdruck und Saugrohrdruck" VALUE 0x829964 KwUw 2559.961 p_uw_q0p039 0.00 2559.961 FORMAT "%8.3" /end CHARACTERISTIC
/begin CHARACTERISTIC DPBKVUKKPU "min. zuläs. Druckdiff. zw. pbkv und pu für Kompressorabschaltung" CURVE 0x829966 KlAUwSstUwWUw 2559.961 p_uw_q0p039 0.00 2559.961 FORMAT "%8.3"
 /begin AXIS_DESCR STD_AXIS pubkv_w p_uw_q0p039 4 0.00 2559.961 FORMAT "%8.3" DEPOSIT ABSOLUTE /end AXIS_DESCR
/end CHARACTERISTIC
/begin CHARACTERISTIC DPBKVUKNW "min. zuläs. Druckdiff. zw. pbkv und pu für NW-Umschaltung auf min. Überschneidun" CURVE 0x829978 KlAUwSstUwWUw 2559.961 p_uw_q0p039 0.00 2559.961 FORMAT "%8.3"
 /begin AXIS_DESCR STD_AXIS pubkv_w p_uw_q0p039 4 0.00 2559.961 FORMAT "%8.3" DEPOSIT ABSOLUTE /end AXIS_DESCR
/end CHARACTERISTIC
/begin CHARACTERISTIC DPBKVUKP "min. zuläs. Druckdif. zwischen BKV-Druck und pu für Pumpenansteuerung" CURVE 0x82998A KlAUwSstUwWUw 2559.961 p_uw_q0p039 0.00 2559.961 FORMAT "%8.3"
 /begin AXIS_DESCR STD_AXIS pubkv_w p_uw_q0p039 4 0.00 2559.961 FORMAT "%8.3" DEPOSIT ABSOLUTE /end AXIS_DESCR
/end CHARACTERISTIC
/begin CHARACTERISTIC DPBKVUKPU "min. zuläs. Druckdif. zw. BKV-Druck und pu ohne Betät. der Bremse abh. von pu" CURVE 0x82999C KlAUwSstUwWUw 2559.961 p_uw_q0p039 0.00 2559.961 FORMAT "%8.3"
 /begin AXIS_DESCR STD_AXIS pubkv_w p_uw_q0p039 4 0.00 2559.961 FORMAT "%8.3" DEPOSIT ABSOLUTE /end AXIS_DESCR
/end CHARACTERISTIC
/begin CHARACTERISTIC DPBKVUS "gewünschte Druckdifferenz zwischen Bremskraftverstärker und Umgebungsdruck" VALUE 0x81A6CE KwUb 1275. p_ub_q5 0.00 1275. FORMAT "%5.0" /end CHARACTERISTIC
/begin CHARACTERISTIC DPSBKV "Delta Druck für Plausibilität von Bremskraftverstärkerdruck mit Saugrohrdruck" VALUE 0x8299C6 KwUw 2559.961 p_uw_q0p039 0.00 2559.961 FORMAT "%8.3" /end CHARACTERISTIC
/begin CHARACTERISTIC DPSPBKVNPH "min. Druckdifferenz zw. ps und pbkv für Heilung npl-Fehler(Leckage)" VALUE 0x8299C8 KwSw 2559.961 p_sw_q0p039 -1280.000 1279.961 FORMAT "%8.3" /end CHARACTERISTIC
/begin CHARACTERISTIC DPUBKV "Delta Druck für Plaus. von Bremskraftverstärkerdruck mit Umgebungsdruck" VALUE 0x8299CA KwUw 2559.961 p_uw_q0p039 0.00 2559.961 FORMAT "%8.3" /end CHARACTERISTIC
/begin CHARACTERISTIC DPUFVMNA "Spezifische Druckdifferenz für Saugrohrdrucküberwachung" VALUE 0x8145AC KwSw 5119.922 p_uw_q0p078 -2560.000 2559.922 FORMAT "%8.3" /end CHARACTERISTIC
/begin CHARACTERISTIC DPUFVSMNA "Soll-Druckdifferenz für Saugrohrdrucküberwachung" VALUE 0x8145AE KwSw 5119.922 p_uw_q0p078 -2560.000 2559.922 FORMAT "%8.3" /end CHARACTERISTIC
/begin CHARACTERISTIC DTPAAV "Delta-Periodendauer zur Berechnung des Fensters bei Leckdiagnose" VALUE 0x8145B0 KwUw 655.3500 t10msxs_uw_b655p35 0.00 655.3500 FORMAT "%8.4" /end CHARACTERISTIC
/begin CHARACTERISTIC DTPATS "Toleranz Periodendauer Abgastemperatursensor" VALUE 0x81943D KwUb 255.0 t100msxms_ub_b255 0.00 255.0 FORMAT "%5.1" /end CHARACTERISTIC
/begin CHARACTERISTIC ESKONF "Konfiguration Endstufen" VAL_BLK 0x810C28 KwbUb 255.0 dez 0.00 255.0 FORMAT "%5.1" NUMBER 7 /end CHARACTERISTIC
/begin CHARACTERISTIC EVDCVM "Einschaltverzögerung Bereitschaft zu Meßbeginn" VALUE 0x81B422 KwUw 6553.500 t100msxs_uw_b6553p6 0.00 6553.500 FORMAT "%8.3" /end CHARACTERISTIC
/begin CHARACTERISTIC EVDCVP "Mindestpause zwischen zwei folgenden Diagnosedurchl. im selben DCY" VALUE 0x81B424 KwUw 6553.500 t100msxs_uw_b6553p6 0.00 6553.500 FORMAT "%8.3" /end CHARACTERISTIC
/begin CHARACTERISTIC FFTAAV "Freeze Frame Tabelle: Tankdiagnose, AAV verstopft" VAL_BLK 0x8107FB KwbUb 255.0 dez 0.00 255.0 FORMAT "%5.1" NUMBER 2 /end CHARACTERISTIC
/begin CHARACTERISTIC FFTCAIR "Freeze Frame Tabelle: Airbag-Botschaft" VAL_BLK 0x810817 KwbUb 255.0 dez 0.00 255.0 FORMAT "%5.1" NUMBER 2 /end CHARACTERISTIC
/begin CHARACTERISTIC FFTCAS "Freeze Frame Tabelle: CAN-Timeout ASC-Botschaft" VAL_BLK 0x81081B KwbUb 255.0 dez 0.00 255.0 FORMAT "%5.1" NUMBER 2 /end CHARACTERISTIC
/begin CHARACTERISTIC FFTCAT "Freeze Frame Tabelle: CAN-Schnittstelle, Timeout ASR" VAL_BLK 0x81081D KwbUb 255.0 dez 0.00 255.0 FORMAT "%5.1" NUMBER 2 /end CHARACTERISTIC
/begin CHARACTERISTIC FFTCGE "Freeze Frame Tabelle: CAN-Timeout EGS-Botschaft" VAL_BLK 0x81081F KwbUb 255.0 dez 0.00 255.0 FORMAT "%5.1" NUMBER 2 /end CHARACTERISTIC
/begin CHARACTERISTIC FFTCGRA "Freeze Frame Tabelle: GRA-Botschaft (Empfang)" VAL_BLK 0x810821 KwbUb 255.0 dez 0.00 255.0 FORMAT "%5.1" NUMBER 2 /end CHARACTERISTIC
/begin CHARACTERISTIC FFTCIF "Freeze Frame Tabelle: CAN-Schnittstelle, interner Fehler" VAL_BLK 0x810823 KwbUb 255.0 dez 0.00 255.0 FORMAT "%5.1" NUMBER 2 /end CHARACTERISTIC
/begin CHARACTERISTIC FFTCINS "Freeze Frame Tabelle: CAN-Timeout Instr.-Botschaft" VAL_BLK 0x810825 KwbUb 255.0 dez 0.00 255.0 FORMAT "%5.1" NUMBER 2 /end CHARACTERISTIC
/begin CHARACTERISTIC FFTCKLA "" VAL_BLK 0x810827 KwbUb 255.0 dez 0.00 255.0 FORMAT "%5.1" NUMBER 2 /end CHARACTERISTIC
/begin CHARACTERISTIC FFTSWE "Freeze Frame Tabelle: Beschleunigungssensor Schlechtwegeerk." VAL_BLK 0x8108E5 KwbUb 255.0 dez 0.00 255.0 FORMAT "%5.1" NUMBER 2 /end CHARACTERISTIC
/begin CHARACTERISTIC FMOTC "Motor-Codierung (CAN)" VALUE 0x81016E KwUb 255.0 DEZ 0.00 255.0 FORMAT "%5.1" /end CHARACTERISTIC
/begin CHARACTERISTIC FRADCVINI "fra Initialisierungswert für DCV" VALUE 0x81B426 KwUw 1.999969 fak_uw_b2 0.00 1.999969 FORMAT "%8.6" /end CHARACTERISTIC
/begin CHARACTERISTIC FRADCVSTO "Minimaler Wert des Gemischkorrekturfaktors zur Übernahme Adaptionswerte im Start" VALUE 0x81B428 KwUw 1.999969 fak_uw_b2 0.00 1.999969 FORMAT "%8.6" /end CHARACTERISTIC
/begin CHARACTERISTIC FRAKONST "Verhältnis stationärer Warm-LL-Luftmassenstrom MLO2 / (MLU4 - MLO2)" VALUE 0x81B42A KwUw 1.999969 fak_uw_b2 0.00 1.999969 FORMAT "%8.6" /end CHARACTERISTIC
/begin CHARACTERISTIC FRMULTOE "Schwelle Kenngröße frmulti im nio Bereich f. Leckageerkennung nach Drosselklappe" VALUE 0x81B42C KwUw 3.999939 fak_uw_b4 0.00 3.999939 FORMAT "%8.6" /end CHARACTERISTIC
/begin CHARACTERISTIC FRMULTOZ "Schwelle Kenngröße frmulti im nio Bereich f. Leckageerkennung vor Drosselklappe" VALUE 0x81B42E KwUw 3.999939 fak_uw_b4 0.00 3.999939 FORMAT "%8.6" /end CHARACTERISTIC
/begin CHARACTERISTIC FRMULTUE "Schwelle Kenngröße frmulti im io Bereich f. Leckageerkennung nach Drosselklappe" VALUE 0x81B430 KwUw 3.999939 fak_uw_b4 0.00 3.999939 FORMAT "%8.6" /end CHARACTERISTIC
/begin CHARACTERISTIC FRMULTUZ "Schwelle Kenngröße frmulti im io Bereich f. Leckageerkennung vor Drosselklappe" VALUE 0x81B432 KwUw 3.999939 fak_uw_b4 0.00 3.999939 FORMAT "%8.6" /end CHARACTERISTIC
/begin CHARACTERISTIC FWCBFT "Bewertungsfaktor Turbo für CAN-Ausgabe" VALUE 0x81016F KwUb 25.50 fak_q0p1 0.00 25.50 FORMAT "%5.2" /end CHARACTERISTIC
/begin CHARACTERISTIC FWCSBK "Steigung der Befüllungskennlinie für CAN-Ausgabe" VALUE 0x810170 KwUb 0.2550 volgrd_q0p001 0.00 0.2550 FORMAT "%6.4" /end CHARACTERISTIC
/begin CHARACTERISTIC FWTMUEBO "Tmot-Schwelle zum Setzen Temperaturüberschutz" VALUE 0x818406 KwUb 255.0 temp_ub_q0p75_o48 0.00 255.0 FORMAT "%5.1" /end CHARACTERISTIC
/begin CHARACTERISTIC FWTMUEBU "Tmot-Schwelle zum Rücksetzen Temperaturüberschutz" VALUE 0x818407 KwUb 255.0 temp_ub_q0p75_o48 0.00 255.0 FORMAT "%5.1" /end CHARACTERISTIC
/begin CHARACTERISTIC FWTOUEBO "Töl-Schwelle zum Setzen Temperaturüberschutz" VALUE 0x81B3E0 KwUw 65535.00 temp_q0p0234_o273 -0.009375000 65534.99 FORMAT "%8.2" /end CHARACTERISTIC
/begin CHARACTERISTIC FWTOUEBU "Töl-Schwelle zum Rücksetzen Temperaturüberschutz" VALUE 0x81B3E2 KwUw 65535.00 temp_q0p0234_o273 -0.009375000 65534.99 FORMAT "%8.2" /end CHARACTERISTIC
/begin CHARACTERISTIC KFFHOTMKO "Höhen- und Temperaturkorrektur der Kenngröße frmulti" MAP 0x818485 KfAxUbAyUbSstxUbSstyUbWUb 1.992 fak_ub_b2 0.00 1.992 FORMAT "%5.3"
 /begin AXIS_DESCR STD_AXIS tmot temp_ub_q0p75_o48 4 -48.00 143.3 FORMAT "%5.1" DEPOSIT ABSOLUTE /end AXIS_DESCR
 /begin AXIS_DESCR STD_AXIS fho fak_ub_b4 4 0.00 3.984 FORMAT "%5.3" DEPOSIT ABSOLUTE /end AXIS_DESCR
/end CHARACTERISTIC
/begin CHARACTERISTIC KFOELKBI "Ölniveauschwelle für Ausgabe an Kombi" MAP 0x818408 KfAxUbAyUbSstxUbSstyUbWUb 63.75 s_q63p75mm 0.00 63.75 FORMAT "%5.2"
 /begin AXIS_DESCR STD_AXIS kfoelkbi_nmot nmot_ub_q40 8 0.00 10200. FORMAT "%5.0" DEPOSIT ABSOLUTE /end AXIS_DESCR
 /begin AXIS_DESCR STD_AXIS tolc temp_ub_q1_o60 8 -60.00 195.0 FORMAT "%5.1" DEPOSIT ABSOLUTE /end AXIS_DESCR
/end CHARACTERISTIC
/begin CHARACTERISTIC KLLAMKORR "Korrekturkennlinie des gefilterten lamsoni Wertes" CURVE 0x81B434 KlAUbSstUwWUw 655.3500 fak_uw_q0p01 0.00 655.3500 FORMAT "%8.4"
 /begin AXIS_DESCR STD_AXIS lamsonif_w fak_uw_b16 8 0.00 15.99976 FORMAT "%8.5" DEPOSIT ABSOLUTE /end AXIS_DESCR
/end CHARACTERISTIC
/begin CHARACTERISTIC KLMIGENL "Kennlinie für Getriebeeingriff bei Ausfall der Getriebe-Botschaft" CURVE 0x810171 KlAUbSstUbWUb 99.61 rel_ub_b99p6 0.00 99.61 FORMAT "%5.2"
 /begin AXIS_DESCR STD_AXIS tmot temp_ub_q0p75_o48 5 -48.00 143.3 FORMAT "%5.1" DEPOSIT ABSOLUTE /end AXIS_DESCR
/end CHARACTERISTIC
/begin CHARACTERISTIC KLNSWLKORR "Korrekturkennlinie für Faktor Nachstart und Warmlauf" CURVE 0x81B456 KlAUwSstUwWUw 15.99976 fak_uw_b16 0.00 15.99976 FORMAT "%8.5"
 /begin AXIS_DESCR STD_AXIS fnswlx_w fak_uw_b16 5 0.00 15.99976 FORMAT "%8.5" DEPOSIT ABSOLUTE /end AXIS_DESCR
/end CHARACTERISTIC
/begin CHARACTERISTIC KLRKAKORR "Korrekturkennlinie zur Berechnung von frkadcv" CURVE 0x813E26 KlAUbSstSwWUw 655.3500 fak_uw_q0p01 0.00 655.3500 FORMAT "%8.4"
 /begin AXIS_DESCR STD_AXIS rkasst_w rel_sw_b1536 8 -1536.000 1535.953 FORMAT "%8.3" DEPOSIT ABSOLUTE /end AXIS_DESCR
/end CHARACTERISTIC
/begin CHARACTERISTIC KVNPZ "normierter Krafstoffverbrauch pro Zylinder für Kombiausgabe" VALUE 0x81017C KwUb 5100. kva_ub_q20 0.00 5100. FORMAT "%5.0" /end CHARACTERISTIC
/begin CHARACTERISTIC LBMINC "Wert der bei Bezugsmarkenverlust hinzuaddiert wird" VALUE 0x813FAA KwUw 65535.00 dez 0.00 65535.00 FORMAT "%8.2" /end CHARACTERISTIC
/begin CHARACTERISTIC LBMINIT "Initialisierungswert des Zählers Bezugsmarkenverlust, wenn SG zuvor im NLDG war" VALUE 0x813FAC KwUw 65535.00 dez 0.00 65535.00 FORMAT "%8.2" /end CHARACTERISTIC
/begin CHARACTERISTIC LBMMX "Maximalwert für Zähler Bezugsmarkenverlust" VALUE 0x813FAE KwUw 65535.00 dez 0.00 65535.00 FORMAT "%8.2" /end CHARACTERISTIC
/begin CHARACTERISTIC LBMSUB "Differenzwert zwischen der Fehlereintragsschwelle und der Notlaufanforderung" VALUE 0x81BAF2 KwUw 65535.00 dez 0.00 65535.00 FORMAT "%8.2" /end CHARACTERISTIC
/begin CHARACTERISTIC LSONHMX "Fehlerschwelle lamsonh_w" VALUE 0x81B46C KwUw 15.99976 fak_uw_b16 0.00 15.99976 FORMAT "%8.5" /end CHARACTERISTIC
/begin CHARACTERISTIC MDMAXKBI "maximales Drehmoment für Ausgabe an Kombi" VALUE 0x81017D KwUb 2550. md_ub_q10 0.00 2550. FORMAT "%5.0" /end CHARACTERISTIC
/begin CHARACTERISTIC MDNORM "Maximales indiziertes Motormoment für Moment-Normierung" VALUE 0x81017E KwUb 2550. md_ub_q10 0.00 2550. FORMAT "%5.0" /end CHARACTERISTIC
/begin CHARACTERISTIC MOTTYP "Motortyp für Ausgabe an Kombi" VALUE 0x81017F KwUb 255.0 DEZ 0.00 255.0 FORMAT "%5.1" /end CHARACTERISTIC
/begin CHARACTERISTIC MRFAMXKOAB "max. mrfa-Schwelle für Freigabe Klimakompressor abschalten" VALUE 0x8299AE KwUw 199.9969 rel_uw_b200 0.00 199.9969 FORMAT "%8.4" /end CHARACTERISTIC
/begin CHARACTERISTIC MSLGDCV "msndko-Initialisierungswert für DCV" VALUE 0x81B46E KwUw 6553.500 m_q0p1 0.00 6553.500 FORMAT "%8.3" /end CHARACTERISTIC
/begin CHARACTERISTIC MSTEAAV "Mindestluftmasse bei Fortsetzungsspülung" VALUE 0x8145B2 KwUw 4660.267 m_uw_b4660 0.00 4660.267 FORMAT "%8.3" /end CHARACTERISTIC
/begin CHARACTERISTIC MSTEAAVI "Mindestluftmasse bei Initialspülung DAAV" VALUE 0x8145B4 KwUw 4660.267 m_uw_b4660 0.00 4660.267 FORMAT "%8.3" /end CHARACTERISTIC
/begin CHARACTERISTIC MXNLN "Mindestanzahl von Zahnsignalen zur Heilung des NLDG" VALUE 0x8184A2 KwUb 255.0 dez 0.00 255.0 FORMAT "%5.1" /end CHARACTERISTIC
/begin CHARACTERISTIC NMAXKBI "Drehzahl bei maximalem Moment für Ausgabe an Kombi" VALUE 0x810180 KwUb 25500. nmot_ub_q100 0.00 25500. FORMAT "%5.0" /end CHARACTERISTIC
/begin CHARACTERISTIC NOBMINC "Wert der bei nicht erkannter Bezugsmarke aufaddiert wird" VALUE 0x8184A3 KwUb 255.0 dez 0.00 255.0 FORMAT "%5.1" /end CHARACTERISTIC
/begin CHARACTERISTIC NOBMINIT "Initialisierungswert für Zähler Bezugsmarkenverlust" VALUE 0x8184A4 KwUb 255.0 dez 0.00 255.0 FORMAT "%5.1" /end CHARACTERISTIC
/begin CHARACTERISTIC NOBMSTMX "Maximalwert für nicht erkannte Bezugsmarken im Start" VALUE 0x8184A5 KwUb 255.0 dez 0.00 255.0 FORMAT "%5.1" /end CHARACTERISTIC
/begin CHARACTERISTIC OPBKVUKKB "Offset zu DPBKVUKKPU bei betätigter Bremse" VALUE 0x8299B0 KwSw 2559.961 p_sw_q0p039 -1280.000 1279.961 FORMAT "%8.3" /end CHARACTERISTIC
/begin CHARACTERISTIC OPBKVUKNWB "Offset zu DPBKVUKNW bei betätigter Bremse" VALUE 0x8299B2 KwSw 2559.961 p_sw_q0p039 -1280.000 1279.961 FORMAT "%8.3" /end CHARACTERISTIC
/begin CHARACTERISTIC OPBKVUKPB "Offset zu DPBKVUKP bei betätigter Bremse" VALUE 0x8299B4 KwSw 2559.961 p_sw_q0p039 -1280.000 1279.961 FORMAT "%8.3" /end CHARACTERISTIC
/begin CHARACTERISTIC OPBKVUKPUB "Offset zu DPBKVUKPU bei betätigter Bremse" VALUE 0x8299B6 KwSw 2559.961 p_sw_q0p039 -1280.000 1279.961 FORMAT "%8.3" /end CHARACTERISTIC
/begin CHARACTERISTIC PBKVKRHY "Hysterese zur kritischen Obergrenze für Druck im Bremskraftverstärker" VALUE 0x8299B8 KwUw 2559.961 p_uw_q0p039 0.00 2559.961 FORMAT "%8.3" /end CHARACTERISTIC
/begin CHARACTERISTIC PBKVMN "min. möglicher Druck im Bremskraftverstärker" VALUE 0x8299CC KwUw 2559.961 p_uw_q0p039 0.00 2559.961 FORMAT "%8.3" /end CHARACTERISTIC
/begin CHARACTERISTIC PBKVMX "max. möglicher Druck im Bremskraftverstärker" VALUE 0x8299CE KwUw 2559.961 p_uw_q0p039 0.00 2559.961 FORMAT "%8.3" /end CHARACTERISTIC
/begin CHARACTERISTIC PGFLNL "Anzahl an Phasenflanken bis NLDG aufgerufen wird bei eingetragenem E_n" VALUE 0x8184A6 KwUb 255.0 dez 0.00 255.0 FORMAT "%5.1" /end CHARACTERISTIC
/begin CHARACTERISTIC PGFLWA "Anzahl PG-Flankenwechsel für DG-Fehler B_signal" VALUE 0x8109C2 KwUb 255.0 dez 0.00 255.0 FORMAT "%5.1" /end CHARACTERISTIC
/begin CHARACTERISTIC PMAXKBI "Kombiausgabe maximale Leistung" VALUE 0x8132DA KwUw 511.0000 kw_q1 0.00 511.0000 FORMAT "%8.4" /end CHARACTERISTIC
/begin CHARACTERISTIC RKADCVINI "rka-Initialisierungswert für DCV" VALUE 0x81B470 KwUw 3071.953 rel_sw_b1536 0.00 3071.953 FORMAT "%8.3" /end CHARACTERISTIC
/begin CHARACTERISTIC RKAKONST "Verhältnis NO / stationäre Warm-LL-Drehzahl" VALUE 0x81B472 KwUw 1.999969 fak_uw_b2 0.00 1.999969 FORMAT "%8.6" /end CHARACTERISTIC
/begin CHARACTERISTIC RLAAVMX "Maximale Last bei Diagnose AAV" VALUE 0x810C41 KwUb 191.3 rel_ub_q0p75 0.00 191.3 FORMAT "%5.1" /end CHARACTERISTIC
/begin CHARACTERISTIC SWDIVZERO "Wert zur Vermeidung einer Nulldivision" VALUE 0x81B474 KwUw 1.999969 fak_uw_b2 0.00 1.999969 FORMAT "%8.6" /end CHARACTERISTIC
/begin CHARACTERISTIC TAAV1SD "Zeitschwelle 1 für Erkennung AAV geschlossen" VALUE 0x8145B6 KwUw 655.3500 t10msxs_uw_b655p35 0.00 655.3500 FORMAT "%8.4" /end CHARACTERISTIC
/begin CHARACTERISTIC TAAV2SD "Zeitschwelle 2 für Erkennung AAV geschlossen" VALUE 0x8145B8 KwUw 655.3500 t10msxs_uw_b655p35 0.00 655.3500 FORMAT "%8.4" /end CHARACTERISTIC
/begin CHARACTERISTIC TAAVZMN "Minimale Zeit für TEV-zu vor Fortsetzung AAV-Diagnose" VALUE 0x8145BA KwUw 655.3500 t10msxs_uw_b655p35 0.00 655.3500 FORMAT "%8.4" /end CHARACTERISTIC
/begin CHARACTERISTIC TABSDTMN "Minimale Abstellzeit zur Startdiagnose des Temp.-Sensors" VALUE 0x81D442 KwUw 65535.00 t1sxs_uw_q1 0.00 65535.00 FORMAT "%8.2" /end CHARACTERISTIC
/begin CHARACTERISTIC TANSNVMX "Maximale Ansauglufttemperatur für die Startdiagnose" VALUE 0x81D444 KwUw 1279.980 temp_uw_q0p0195_o50 -50.00000 1229.980 FORMAT "%8.3" /end CHARACTERISTIC
/begin CHARACTERISTIC TATNVMN "Minimale modellierte Abgastemperatur zur Ausführung der phys. Diagnose" VALUE 0x81D446 KwUw 1279.980 temp_uw_q0p0195_o50 -50.00000 1229.980 FORMAT "%8.3" /end CHARACTERISTIC
/begin CHARACTERISTIC TATSMN "Temperaturschwelle für Min-Fehler Abgastemperatursensor" VALUE 0x81D448 KwUw 1279.980 temp_uw_q0p0195_o50 -50.00000 1229.980 FORMAT "%8.3" /end CHARACTERISTIC
/begin CHARACTERISTIC TATSMX "Temperaturschwelle für Max-Fehler Abgastemperatursensor" VALUE 0x81D44A KwUw 1279.980 temp_uw_q0p0195_o50 -50.00000 1229.980 FORMAT "%8.3" /end CHARACTERISTIC
/begin CHARACTERISTIC TATSNP "Temperaturschwelle für Nicht-Plausibel-Fehler Abgastemperatursensor" VALUE 0x81D44C KwUw 1279.980 temp_uw_q0p0195_o50 -50.00000 1229.980 FORMAT "%8.3" /end CHARACTERISTIC
/begin CHARACTERISTIC TDATSO "Obergrenze Abgastemperaturmodell für Diagnose Abgastemperatursensor" VALUE 0x81D44E KwUw 1279.980 temp_uw_q0p0195_o50 -50.00000 1229.980 FORMAT "%8.3" /end CHARACTERISTIC
/begin CHARACTERISTIC TDBBKVP "Einschaltverzögerung von B_bkvp für Diagnose" VALUE 0x81A6D7 KwUb 25.50 t100msxs_ub_b25p5 0.00 25.50 FORMAT "%5.2" /end CHARACTERISTIC
/begin CHARACTERISTIC TDBKVKOMAB "Verzögerungszeit der Forderung Klimakompressor abschalten" VALUE 0x81A6CF KwUb 5.100 t20msxs_ub_q0p02 0.00 5.100 FORMAT "%5.3" /end CHARACTERISTIC
/begin CHARACTERISTIC TDBKVNWAB "Verzögerungszeit für NW-Umschaltung min. Überschneidung" VALUE 0x81A6D0 KwUb 5.100 t20msxs_ub_q0p02 0.00 5.100 FORMAT "%5.3" /end CHARACTERISTIC
/begin CHARACTERISTIC TDBKVP "Verzögerung des Bits B_pbkvmn bei ausreichendem Saugrohrdruck" VALUE 0x81A6D1 KwUb 5.100 t20msxs_ub_q0p02 0.00 5.100 FORMAT "%5.3" /end CHARACTERISTIC
/begin CHARACTERISTIC TDBKVSTED "Einschaltverzögerung  der Steuerbits der BKV-Funktion nach Startende" VALUE 0x8299BA KwUw 655.3500 t10msxs_uw_b655p35 0.00 655.3500 FORMAT "%8.4" /end CHARACTERISTIC
/begin CHARACTERISTIC TDCVMN "Mindestmeßfensterlänge für die Bildung eines Ergebnisses" VALUE 0x81B476 KwUw 6553.500 t100msxs_uw_b6553p6 0.00 6553.500 FORMAT "%8.3" /end CHARACTERISTIC
/begin CHARACTERISTIC TDCVMX "Maximale Meßfensterlänge" VALUE 0x81B478 KwUw 6553.500 t100msxs_uw_b6553p6 0.00 6553.500 FORMAT "%8.3" /end CHARACTERISTIC
/begin CHARACTERISTIC TDDBKVP "Zeit, in der das Druckdelta DPBKVP durch die Pumpe evakuiert werden kann" VALUE 0x81A6D8 KwUb 25.50 t100msxs_ub_b25p5 0.00 25.50 FORMAT "%5.2" /end CHARACTERISTIC
/begin CHARACTERISTIC TDDEDBKVP "max. Einschaltdauer der elektrischen BKV-Pumpe" VALUE 0x8299BC KwUw 1310.700 t20msxs_uw_q0p02 0.00 1310.700 FORMAT "%8.3" /end CHARACTERISTIC
/begin CHARACTERISTIC TDDFBKV "Entprellzeit für Fehlereintrag DS Bremskraftverstärker" VALUE 0x81A6DC KwUb 25.50 t100msxs_ub_b25p5 0.00 25.50 FORMAT "%5.2" /end CHARACTERISTIC
/begin CHARACTERISTIC TDDHBKV "Entprellzeit für Setzen des Zyklusflags" VALUE 0x81A6DD KwUb 25.50 t100msxs_ub_b25p5 0.00 25.50 FORMAT "%5.2" /end CHARACTERISTIC
/begin CHARACTERISTIC TDDTATM "Maximale Temperaturdifferenz zum Abgastemperaturmodell" VALUE 0x81D450 KwUw 1279.980 temp_uw_q0p0195 0.00 1279.980 FORMAT "%8.3" /end CHARACTERISTIC
/begin CHARACTERISTIC TDDTATMFA "Maximale Temperaturdifferenz zum Abgastemperaturmodell im Testbetrieb" VALUE 0x81D452 KwUw 1279.980 temp_uw_q0p0195 0.00 1279.980 FORMAT "%8.3" /end CHARACTERISTIC
/begin CHARACTERISTIC TDDTRS "Temperaturdifferenz zur Referenzsensortemperatur beim Start" VALUE 0x81D454 KwUw 1279.980 temp_uw_q0p0195 0.00 1279.980 FORMAT "%8.3" /end CHARACTERISTIC
/begin CHARACTERISTIC TDEGFEMN "Zeitverzögerung für Setzen des MIN-Fehlers" VALUE 0x818B0C KwUb 25.50 t100msxs_ub_b25p5 0.00 25.50 FORMAT "%5.2" /end CHARACTERISTIC
/begin CHARACTERISTIC TDEGFEMX "Zeitverzögerung für Setzen des MAX-Fehlers" VALUE 0x818B0D KwUb 25.50 t100msxs_ub_b25p5 0.00 25.50 FORMAT "%5.2" /end CHARACTERISTIC
/begin CHARACTERISTIC TDEGFENO "Zeitverzögerung für Setzen des NO-Fehlers" VALUE 0x818B0E KwUb 25.50 t100msxs_ub_b25p5 0.00 25.50 FORMAT "%5.2" /end CHARACTERISTIC
/begin CHARACTERISTIC TDEGFEST "Zeitverzögerung nach Start" VALUE 0x818B0F KwUb 25.50 t100msxs_ub_b25p5 0.00 25.50 FORMAT "%5.2" /end CHARACTERISTIC
/begin CHARACTERISTIC TDPBKVMN "Verzögerungszeit der Bedingung BKV ohne ausreichenden Unterdruck" VALUE 0x81A6D2 KwUb 5.100 t20msxs_ub_q0p02 0.00 5.100 FORMAT "%5.3" /end CHARACTERISTIC
/begin CHARACTERISTIC TDPBKVMNP "Verzögerungszeit der Bedingung BKV ohne ausreichenden Unterdruck für BKV-Pumpe" VALUE 0x81A6D3 KwUb 5.100 t20msxs_ub_q0p02 0.00 5.100 FORMAT "%5.3" /end CHARACTERISTIC
/begin CHARACTERISTIC TDRSMX "Maximale Temperaturdifferenz zw. Wassertemperatur und Ansauglufttemperatur" VALUE 0x81D456 KwUw 1279.980 temp_uw_q0p0195 0.00 1279.980 FORMAT "%8.3" /end CHARACTERISTIC
/begin CHARACTERISTIC TEBKVNWAB "Entprellzeit für NW-Umschaltung min. Überschneidung" VALUE 0x81A6D4 KwUb 5.100 t20msxs_ub_q0p02 0.00 5.100 FORMAT "%5.3" /end CHARACTERISTIC
/begin CHARACTERISTIC TELLRSMV "Entprellzeit nach Bedingung B_llr zur Aktivierung des Sensor-Modell-Vergleich" VALUE 0x81D458 KwUw 65534.00 t1sxs_uw_q1 1.000000 65535.00 FORMAT "%8.2" /end CHARACTERISTIC
/begin CHARACTERISTIC TEPBKVMN "Entprellzeit von B_pbkvmn" VALUE 0x81A6D5 KwUb 5.100 t20msxs_ub_q0p02 0.00 5.100 FORMAT "%5.3" /end CHARACTERISTIC
/begin CHARACTERISTIC TEPBKVNB "Einschwingzeit der Bremskraftdruckreaktion nach Bremsen" VALUE 0x81A6DE KwUb 25.50 t100msxs_ub_b25p5 0.00 25.50 FORMAT "%5.2" /end CHARACTERISTIC
/begin CHARACTERISTIC TEPDNV "Entprellzeitkonstante für physikalische Diagnose nach dem Vorkatalysator" VALUE 0x81D45A KwUw 65534.00 t1sxs_uw_q1 1.000000 65535.00 FORMAT "%8.2" /end CHARACTERISTIC
/begin CHARACTERISTIC TEPDNVT "Entprellzeitkonstante für physikalische Diagnose nach dem Vorkatalysator, Tester" VALUE 0x81D45C KwUw 65534.00 t1sxs_uw_q1 1.000000 65535.00 FORMAT "%8.2" /end CHARACTERISTIC
/begin CHARACTERISTIC TEPPBKV "Entprellzeit für Schalter Druck Bremskraftverstärker" VALUE 0x81A6D6 KwUb 5.080 t20msxs_ub_q0p02 0.00 5.080 FORMAT "%5.3" /end CHARACTERISTIC
/begin CHARACTERISTIC TGLAAV "Schwelle zur Fehler AAV" VALUE 0x8145BC KwUw 655.3500 t10msxs_uw_b655p35 0.00 655.3500 FORMAT "%8.4" /end CHARACTERISTIC
/begin CHARACTERISTIC TMOFFMX "Max. Zeit im Graubereich (außerhalb iO/niO-Bereich) zur Bildung des Zyklus-Flags" VALUE 0x81B47A KwSw 6553.500 t100msxs_sw_b3276p8 -3276.800 3276.700 FORMAT "%8.3" /end CHARACTERISTIC
/begin CHARACTERISTIC TMOTABATS "Schwellwert für Abstelltemperatur zur Teildiagnose START" VALUE 0x81943E KwUb 191.3 temp_ub_q0p75_o48 -48.00 143.3 FORMAT "%5.1" /end CHARACTERISTIC
/begin CHARACTERISTIC TMOTNLDG "Temperaturschwelle für Drehzahlgeber-Notlauf" VALUE 0x8184A7 KwUb 191.3 temp_ub_q0p75_o48 -48.00 143.3 FORMAT "%5.1" /end CHARACTERISTIC
/begin CHARACTERISTIC TMOTNVMX "Maximale Motortemperatur für die Startdiagnose für Temperatursensor nVK" VALUE 0x81D45E KwUw 1279.980 temp_uw_q0p0195_o50 -50.00000 1229.980 FORMAT "%8.3" /end CHARACTERISTIC
/begin CHARACTERISTIC TMSNDKLTMN "Schwellwert für den Vergleich mit der aufsummierte Freigabezeit tmsndklt" VALUE 0x81B47C KwUw 6553.500 t100msxs_uw_b6553p6 0.00 6553.500 FORMAT "%8.3" /end CHARACTERISTIC
/begin CHARACTERISTIC TMSNDKOMN "Mindestadaptionszeit Leckluftmassenstrom" VALUE 0x81B47E KwUw 6553.500 t100msxs_uw_b6553p6 0.00 6553.500 FORMAT "%8.3" /end CHARACTERISTIC
/begin CHARACTERISTIC TNSTBKV "Zeit nach Startende und nichtfreigabe bis die Pumpe aktiv angesteuert wird" VALUE 0x8299C2 KwUw 655.3500 t10msxs_uw_b655p35 0.00 655.3500 FORMAT "%8.4" /end CHARACTERISTIC
/begin CHARACTERISTIC TPNSE "Prüfzeit nach Startende für DVE-Diagnose" VALUE 0x818901 KwUb 25.40 t100msxs_ub_b25p5 0.1000 25.50 FORMAT "%5.2" /end CHARACTERISTIC
/begin CHARACTERISTIC TPSATS "Sollwert Periodendauer Abgastemperatursensor" VALUE 0x81943F KwUb 255.0 t100msxms_ub_b255 0.00 255.0 FORMAT "%5.1" /end CHARACTERISTIC
/begin CHARACTERISTIC TPUPHA "Kennlinie für die Pumpzeit abhängig von den vorherigen Durchläufen" VAL_BLK 0x8145BE KwbUw 655.3500 t10msxs_uw_b655p35 0.00 655.3500 FORMAT "%8.4" NUMBER 8 /end CHARACTERISTIC
/begin CHARACTERISTIC TRKAUFA "Überwachungszeit Reedkontakt öffnet während Fast Pulse" VALUE 0x8145CE KwUw 655.3500 t10msxs_uw_b655p35 0.00 655.3500 FORMAT "%8.4" /end CHARACTERISTIC
/begin CHARACTERISTIC TSFAAV "Fehlersummenzeit: Absperrventil Aktivkohlefilter (Funktion)" VALUE 0x810921 KwUb 255.0 dez 0.00 255.0 FORMAT "%5.1" /end CHARACTERISTIC
/begin CHARACTERISTIC TSFCAIR "Fehlersummenzeit: Airbag-Botschaft" VALUE 0x81092F KwUb 255.0 dez 0.00 255.0 FORMAT "%5.1" /end CHARACTERISTIC
/begin CHARACTERISTIC TSFCAS "Fehlersummenzeit: CAN-Schnittstelle, Timeout ASC" VALUE 0x810931 KwUb 255.0 dez 0.00 255.0 FORMAT "%5.1" /end CHARACTERISTIC
/begin CHARACTERISTIC TSFCAT "Fehlersummenzeit: CAN-Schnittstelle, Timeout ASR" VALUE 0x810932 KwUb 255.0 dez 0.00 255.0 FORMAT "%5.1" /end CHARACTERISTIC
/begin CHARACTERISTIC TSFCGE "Fehlersummenzeit: CAN-Schnittstelle, Timeout EGS" VALUE 0x810933 KwUb 255.0 dez 0.00 255.0 FORMAT "%5.1" /end CHARACTERISTIC
/begin CHARACTERISTIC TSFCGRA "Fehlersummenzeit: GRA-Botschaft (Empfang)" VALUE 0x810934 KwUb 255.0 dez 0.00 255.0 FORMAT "%5.1" /end CHARACTERISTIC
/begin CHARACTERISTIC TSFCIF "Fehlersummenzeit: CAN-Schnittstelle, interner Fehler" VALUE 0x810935 KwUb 255.0 dez 0.00 255.0 FORMAT "%5.1" /end CHARACTERISTIC
/begin CHARACTERISTIC TSFCINS "Fehlersummenzeit: CAN-Schnittstelle, Timeout Instrument" VALUE 0x810936 KwUb 255.0 dez 0.00 255.0 FORMAT "%5.1" /end CHARACTERISTIC
/begin CHARACTERISTIC TSFCKLA "" VALUE 0x810937 KwUb 255.0 dez 0.00 255.0 FORMAT "%5.1" /end CHARACTERISTIC
/begin CHARACTERISTIC TSFSWE "Fehlersummenzeit: Beschleunigungssensor der Schlechtwegeerkennung" VALUE 0x810996 KwUb 255.0 dez 0.00 255.0 FORMAT "%5.1" /end CHARACTERISTIC
/begin CHARACTERISTIC TSRFPABA "Mindestschaltzeit Reed-Kontakt für Abbruch Fast Pulse" VALUE 0x8145D0 KwUw 655.3500 t10msxs_uw_b655p35 0.00 655.3500 FORMAT "%8.4" /end CHARACTERISTIC
/begin CHARACTERISTIC TTBRL "Zeit zwischen Betätigung der Bremse und setzen von B_brems=true (Leckage)" VALUE 0x8299D0 KwUw 3276.7499992 tz100msxs_uw_b3276p8 0.050000762951 3276.8000000 FORMAT "%12.7" /end CHARACTERISTIC
/begin CHARACTERISTIC TTOTAAV "Totzeit LDP- Sofortansteuerung während Fast Pulse" VALUE 0x8145D2 KwUw 655.3500 t10msxs_uw_b655p35 0.00 655.3500 FORMAT "%8.4" /end CHARACTERISTIC
/begin CHARACTERISTIC TVBATRF "Verzögerungszeit für Bedingung Fehler Abgastemperaturregelung" VALUE 0x819443 KwUb 25.50 t100msxs_ub_b25p5 0.00 25.50 FORMAT "%5.2" /end CHARACTERISTIC
/begin CHARACTERISTIC TVDCVLAM "Verzögerungszeit für Zylinderabschaltung" VALUE 0x81B480 KwUw 6553.500 t100msxs_uw_b6553p6 0.00 6553.500 FORMAT "%8.3" /end CHARACTERISTIC
/begin CHARACTERISTIC TVDIAGDCV "Verzögerungszeit Diagnosebereitschaft" VALUE 0x81B482 KwUw 6553.500 t100msxs_uw_b6553p6 0.00 6553.500 FORMAT "%8.3" /end CHARACTERISTIC
/begin CHARACTERISTIC TVEATRDR "Verzögerungszeit für Rücksetzen Fehler Bankunterschied ATR" VALUE 0x819444 KwUb 25.50 t100msxs_ub_b25p5 0.00 25.50 FORMAT "%5.2" /end CHARACTERISTIC
/begin CHARACTERISTIC TVEATRDS "Verzögerungszeit für Setzen Fehler Bankunterschied ATR" VALUE 0x819445 KwUb 25.50 t100msxs_ub_b25p5 0.00 25.50 FORMAT "%5.2" /end CHARACTERISTIC
/begin CHARACTERISTIC TVEATRR "Verzögerungszeit für Rücksetzen Fehler Abgastemperaturregelung" VALUE 0x819446 KwUb 25.50 t100msxs_ub_b25p5 0.00 25.50 FORMAT "%5.2" /end CHARACTERISTIC
/begin CHARACTERISTIC TVEATRS "Verzögerungszeit für Setzen Fehler Abgastemperaturregelung" VALUE 0x819447 KwUb 25.50 t100msxs_ub_b25p5 0.00 25.50 FORMAT "%5.2" /end CHARACTERISTIC
/begin CHARACTERISTIC TVEATSR "Verzögerungszeit für Erkennung fehlerfreier Abgastemperatursensor" VALUE 0x819440 KwUb 255.0 t_q1 0.00 255.0 FORMAT "%5.1" /end CHARACTERISTIC
/begin CHARACTERISTIC TVEATSS "Verzögerungszeit für Erkennung fehlerhafter Abgastemperatursensor" VALUE 0x819441 KwUb 255.0 t_q1 0.00 255.0 FORMAT "%5.1" /end CHARACTERISTIC
/begin CHARACTERISTIC TVEDCV "Haltezeit für Bedingung B_edcv" VALUE 0x81B484 KwUw 6553.500 t100msxs_uw_b6553p6 0.00 6553.500 FORMAT "%8.3" /end CHARACTERISTIC
/begin CHARACTERISTIC TVERRDET "Verzögerungszeit für Fehlererkennung" VALUE 0x81B486 KwUw 6553.500 t100msxs_uw_b6553p6 0.00 6553.500 FORMAT "%8.3" /end CHARACTERISTIC
/begin CHARACTERISTIC TVERREN "Wartezeit bis Fehlereintrag möglich" VALUE 0x81B488 KwUw 6553.500 t100msxs_uw_b6553p6 0.00 6553.500 FORMAT "%8.3" /end CHARACTERISTIC
/begin CHARACTERISTIC TVPBKVNB "Verzögerungszeit der Bremskraftdruckreaktion nach Bremsen" VALUE 0x81A6DF KwUb 25.50 t100msxs_ub_b25p5 0.00 25.50 FORMAT "%5.2" /end CHARACTERISTIC
/begin CHARACTERISTIC TVSTOST "Verzögerungszeit Übernahme Adaptionswerte im Start" VALUE 0x81B48A KwUw 6553.500 t100msxs_uw_b6553p6 0.00 6553.500 FORMAT "%8.3" /end CHARACTERISTIC
/begin CHARACTERISTIC TVZTANV "Zeitkonstante für Pt1-Glied zur Verzögerung der gemessenen und modellierten Temp" VALUE 0x81D460 KwUw 65534.000000 zk1sxs_uw_b65535 1.0000000000 65535.000000 FORMAT "%12.6" /end CHARACTERISTIC
/begin CHARACTERISTIC TVZTANVT "Zeitkonstante für Pt1-Glied zur Verzögerung der gem. und mod. Temp, Tester" VALUE 0x81D462 KwUw 65534.000000 zk1sxs_uw_b65535 1.0000000000 65535.000000 FORMAT "%12.6" /end CHARACTERISTIC
/begin CHARACTERISTIC TWBDCY "Wartezeit für Erkennung Bedingung 'driving cycle'" VALUE 0x81B404 KwUw 13107.00 t200msxs_uw_q0p2 0.00 13107.00 FORMAT "%8.2" /end CHARACTERISTIC
/begin CHARACTERISTIC T_GEUEW "Überwachungszeit für Getriebeeingriff (nur ZW-Eingriff)" VALUE 0x8132DC KwUw 655.3500 t10msxs_uw_b655p35 0.00 655.3500 FORMAT "%8.4" /end CHARACTERISTIC
/begin CHARACTERISTIC T_KLIMADEADCTR "" VALUE 0x810181 KwUb 255.0 dez 0.00 255.0 FORMAT "%5.1" /end CHARACTERISTIC
/begin CHARACTERISTIC T_KOM1CLDEAD "" VALUE 0x810182 KwUb 255.0 dez 0.00 255.0 FORMAT "%5.1" /end CHARACTERISTIC
/begin CHARACTERISTIC T_NOMAIR "Timeoutzeit für Airbagbotschaft" VALUE 0x810183 KwUb 5.100 t20msxs_ub_b5p1 0.00 5.100 FORMAT "%5.3" /end CHARACTERISTIC
/begin CHARACTERISTIC T_NOMAIRTA "verlängerte Timeoutzeit für Airbagbotschaft" VALUE 0x810184 KwUb 5.100 t20msxs_ub_b5p1 0.00 5.100 FORMAT "%5.3" /end CHARACTERISTIC
/begin CHARACTERISTIC T_NOMBSG "Timeoutzeit BSG-Botschaft" VALUE 0x81845A KwUb 25.50 t100msxs_ub_b25p5 0.00 25.50 FORMAT "%5.2" /end CHARACTERISTIC
/begin CHARACTERISTIC T_NOMEGS "Filterzeit bis Erkennung der Kommunikationsunterbrechung zu Knoten EGS" VALUE 0x810185 KwUb 2.550 t10msxs_ub_b2p55 0.00 2.550 FORMAT "%5.3" /end CHARACTERISTIC
/begin CHARACTERISTIC T_NOMKBI "DCAN Timeoutzeit Kombi Botschaft" VALUE 0x81845B KwUb 25.50 t100msxs_ub_b25p5 0.00 25.50 FORMAT "%5.2" /end CHARACTERISTIC
/begin CHARACTERISTIC T_NOMKBI1 "Timeoutzeit Botschaft Kombi1" VALUE 0x810186 KwUb 2.550 t10msxs_ub_b2p55 0.00 2.550 FORMAT "%5.3" /end CHARACTERISTIC
/begin CHARACTERISTIC T_NOMKBI23 "Timeoutzeit Botschaft Kombi2 und 3" VALUE 0x81845C KwUb 102.0 t400msxs_ub_b102 0.00 102.0 FORMAT "%5.1" /end CHARACTERISTIC
/begin CHARACTERISTIC T_NOMKLA "Timeoutzeit Botschaft Clima1" VALUE 0x810187 KwUb 2.550 t10msxs_ub_b2p55 0.00 2.550 FORMAT "%5.3" /end CHARACTERISTIC
/begin CHARACTERISTIC T_NOMLWS "CAN Timeoutzeit Lenkwinkelsensor Botschaft" VALUE 0x810188 KwUb 2.550 t10msxs_ub_b2p55 0.00 2.550 FORMAT "%5.3" /end CHARACTERISTIC
/begin CHARACTERISTIC T_SFSEN "Zeit nach Startende für Auswertung Fahrstufe S_fs" VALUE 0x8132DE KwUw 655.3500 t10msxs_uw_b655p35 0.00 655.3500 FORMAT "%8.4" /end CHARACTERISTIC
/begin CHARACTERISTIC UBDEKPMN "Batteriespannungsschwelle Prüfpulse" VALUE 0x8189A2 KwUb 17.95 spg_ubatt 0.00 17.95 FORMAT "%5.2" /end CHARACTERISTIC
/begin CHARACTERISTIC UDSBKVMN "min. Spannungswert für Diagnose DS Bremskraftverstärker" VALUE 0x81A6E0 KwUb 4.980 spg_ub_b5 0.00 4.980 FORMAT "%5.3" /end CHARACTERISTIC
/begin CHARACTERISTIC UDSBKVMX "max. Spannungswert für Diagnose DS Bremskraftverstärker" VALUE 0x81A6E1 KwUb 4.980 spg_ub_b5 0.00 4.980 FORMAT "%5.3" /end CHARACTERISTIC
/begin CHARACTERISTIC VANZKBI "Kombiausgabe Anzahl Ventil" VALUE 0x810189 KwUb 255.0 DEZ 0.00 255.0 FORMAT "%5.1" /end CHARACTERISTIC
/begin CHARACTERISTIC VDCVMXE "Fehlerschwelle für Leckageerkennung nach Drosselklappe" VALUE 0x81B48C KwSw 65.53500 fak_sw_q0p001 -32.76800 32.76700 FORMAT "%8.5" /end CHARACTERISTIC
/begin CHARACTERISTIC VDCVMXZ "Fehlerschwelle für Leckageerkennung vor Drosselklappe" VALUE 0x81B48E KwSw 65.53500 fak_sw_q0p001 -32.76800 32.76700 FORMAT "%8.5" /end CHARACTERISTIC
/begin CHARACTERISTIC VGNL "Geschwindigkeitsschwelle für Momenteneingriff bei Ausfall der Getriebe-Botschaft" VALUE 0x81845D KwUb 318.8 vfzg_ub_q1p25 0.00 318.8 FORMAT "%5.1" /end CHARACTERISTIC
/begin CHARACTERISTIC WZLDPMXA "Max. Anzahl Wiederholversuche nach Unterbrechung bei erkanntem Leck" VALUE 0x810C42 KwUb 255.0 dez 0.00 255.0 FORMAT "%5.1" /end CHARACTERISTIC
/begin CHARACTERISTIC ZCANAIR "Zähler für Codierfehlererkennung der Airbagbotschaft" VALUE 0x81018A KwUb 5.100 t20msxs_ub_b5p1 0.00 5.100 FORMAT "%5.3" /end CHARACTERISTIC
/begin CHARACTERISTIC ZDCVLAM "Zeitkonstante zur Filterung von lamsoni_w" VALUE 0x81B490 KwUw 6553.4999985 zk100msxs_uw_b6553 0.10000152590 6553.6000000 FORMAT "%12.7" /end CHARACTERISTIC
/begin CHARACTERISTIC ZTOELKBI "Zeitkonstante für nmot-Filter" VALUE 0x8132E0 KwUw 655.3500 t10msxs_uw_b655p35 0.00 655.3500 FORMAT "%8.4" /end CHARACTERISTIC
/begin MEASUREMENT anzpulsa "Zähler für Gesamtimpulsanzahl bei Einzelimpulsansteuerung" UBYTE dez 1 100 0 255 FORMAT "%5.1" ECU_ADDRESS 0x380A07 /end MEASUREMENT
/begin MEASUREMENT azdcvio_w "Anzahl i.O.-Prüfungen" UWORD dez 1 100 0 65535 FORMAT "%8.2" ECU_ADDRESS 0x3849E6 /end MEASUREMENT
/begin MEASUREMENT azdcvnio_w "Anzahl n.i.O.-Prüfungen" UWORD dez 1 100 0 65535 FORMAT "%8.2" ECU_ADDRESS 0x3849E8 /end MEASUREMENT
/begin MEASUREMENT azwdh_w "Anzahl Diagnosewiederholungen" UWORD dez 1 100 0 65535 FORMAT "%8.2" ECU_ADDRESS 0x3849EA /end MEASUREMENT
/begin MEASUREMENT bbd2ctr "" UBYTE dez 1 100 0 255 FORMAT "%5.1" ECU_ADDRESS 0x384823 /end MEASUREMENT
/begin MEASUREMENT bbdcy "Byte für Bedingung B_dcy als Triggerevent in DCLA" UBYTE dez 1 100 0 255 FORMAT "%5.1" ECU_ADDRESS 0x380940 /end MEASUREMENT
/begin MEASUREMENT bbno "Byte für Bedingung B_no  als Triggerevent in DCLA" UBYTE dez 1 100 0 255 FORMAT "%5.1" ECU_ADDRESS 0x383103 /end MEASUREMENT
/begin MEASUREMENT bbsp3 "Byte für Bedingung B_sp3 als Triggerevent in DCLA" UBYTE dez 1 100 0 255 FORMAT "%5.1" ECU_ADDRESS 0x383104 /end MEASUREMENT
/begin MEASUREMENT bbtim "Byte für Bedingung B_tim als Triggerevent in DCLA" UBYTE dez 1 100 0 255 FORMAT "%5.1" ECU_ADDRESS 0x380941 /end MEASUREMENT
/begin MEASUREMENT bfgrsc "FGR-Sollbeschleunigung für CAN-Ausgabe" UBYTE bfgrsc_ub_q0p024_o3p984 1 100 -3.984 2.136 FORMAT "%5.3" ECU_ADDRESS 0x3808B8 /end MEASUREMENT
/begin MEASUREMENT BKVlokbits0 "" UBYTE dez 1 100 0 255 FORMAT "%5.1" ECU_ADDRESS 0x380BEE /end MEASUREMENT
/begin MEASUREMENT bkvpea_ctr "" UBYTE dez 1 100 0 255 FORMAT "%5.1" ECU_ADDRESS 0x384934 /end MEASUREMENT
/begin MEASUREMENT bkvpena_ctr "" UWORD dez 1 100 0 1 BIT_MASK 0x1 FORMAT "%5.3" ECU_ADDRESS 0x384935 /end MEASUREMENT
/begin MEASUREMENT bz_air "Botschaftszähler der Airbag-Botschaft" UBYTE DEZ 1 100 0 255 FORMAT "%5.1" ECU_ADDRESS 0x3808B9 /end MEASUREMENT
/begin MEASUREMENT bz_cang1 "Botschaftszähler der Botschaft Getriebe 1" UBYTE DEZ 1 100 0 255 FORMAT "%5.1" ECU_ADDRESS 0x3808BA /end MEASUREMENT
/begin MEASUREMENT bz_cange "Botschaftszähler aus Getriebe 2" UBYTE DEZ 1 100 0 255 FORMAT "%5.1" ECU_ADDRESS 0x3808BB /end MEASUREMENT
/begin MEASUREMENT bz_cmf "Botschaftszähler für Botschaft Motor Flexia" UBYTE DEZ 1 100 0 255 FORMAT "%5.1" ECU_ADDRESS 0x3808BC /end MEASUREMENT
/begin MEASUREMENT bz_mot6 "Botschaftszähler Motor6" UBYTE DEZ 1 100 0 255 FORMAT "%5.1" ECU_ADDRESS 0x3808BD /end MEASUREMENT
/begin MEASUREMENT B_aakuppl "Anforderung Adaption Kupplung Homogenbetrieb vom Getriebe" UWORD B_TRUE 1 100 0 1 BIT_MASK 0x200 FORMAT "%13.11" ECU_ADDRESS 0xFD10 /end MEASUREMENT
/begin MEASUREMENT B_aava "Bedingung Endstufendiagnose AAV auf" UWORD B_TRUE 1 100 0 1 BIT_MASK 0x8000 FORMAT "%13.11" ECU_ADDRESS 0xFD50 /end MEASUREMENT
/begin MEASUREMENT B_aavabb "Flag DAAV-Abbruch" UBYTE B_TRUE 1 100 0 1 BIT_MASK 0x4 FORMAT "%13.11" ECU_ADDRESS 0x380A09 /end MEASUREMENT
/begin MEASUREMENT B_aavf "Fehler AAV" UBYTE B_TRUE 1 100 0 1 BIT_MASK 0x1 FORMAT "%13.11" ECU_ADDRESS 0x380A09 /end MEASUREMENT
/begin MEASUREMENT B_aavz "Bedingung Endstufendiagnose AAV zu" UWORD B_TRUE 1 100 0 1 BIT_MASK 0x1 FORMAT "%13.11" ECU_ADDRESS 0xFD52 /end MEASUREMENT
/begin MEASUREMENT B_accenc "Bedingung ADR über Login freigeschaltet (bei KL15 ein)" UWORD B_TRUE 1 100 0 1 BIT_MASK 0x400 FORMAT "%13.11" ECU_ADDRESS 0xFD10 /end MEASUREMENT
/begin MEASUREMENT B_aircan "Bedingung Crash vom Airbag-SG" UWORD B_TRUE 1 100 0 1 BIT_MASK 0x800 FORMAT "%13.11" ECU_ADDRESS 0xFD10 /end MEASUREMENT
/begin MEASUREMENT B_airnbot "Bedingung keine Airbagbotschaft empfangen" UWORD B_TRUE 1 100 0 1 BIT_MASK 0x1000 FORMAT "%13.11" ECU_ADDRESS 0xFD10 /end MEASUREMENT
/begin MEASUREMENT B_amsrbot "Bedingung Botschaft Bremse 1 wird empfangen" UWORD B_TRUE 1 100 0 1 BIT_MASK 0x2000 FORMAT "%13.11" ECU_ADDRESS 0xFD10 /end MEASUREMENT
/begin MEASUREMENT B_amsrnbot "Bedingung keine neue ASR/MSR-Botschaft erhalten" UWORD B_TRUE 1 100 0 1 BIT_MASK 0x4000 FORMAT "%13.11" ECU_ADDRESS 0xFD10 /end MEASUREMENT
/begin MEASUREMENT B_anlfr "Bedingung Anlasser Freigabe (CAN)" UWORD B_TRUE 1 100 0 1 BIT_MASK 0x8000 FORMAT "%13.11" ECU_ADDRESS 0xFD10 /end MEASUREMENT
/begin MEASUREMENT B_atrd "Bedingung: Abgastemperaturregelung Differenz" UWORD B_TRUE 1 100 0 1 BIT_MASK 0x2 FORMAT "%13.11" ECU_ADDRESS 0xFD68 /end MEASUREMENT
/begin MEASUREMENT B_atrd2 "Bedingung: Abgastemperaturregelung Differenz Bank 2" UWORD B_TRUE 1 100 0 1 BIT_MASK 0x4 FORMAT "%13.11" ECU_ADDRESS 0xFD68 /end MEASUREMENT
/begin MEASUREMENT B_atrf "Bedingung Fehler Abgastemperaturregelung" UWORD B_TRUE 1 100 0 1 BIT_MASK 0x8 FORMAT "%13.11" ECU_ADDRESS 0xFD68 /end MEASUREMENT
/begin MEASUREMENT B_avcair "" UWORD B_TRUE 1 100 0 1 BIT_MASK 0x1000 FORMAT "%13.11" ECU_ADDRESS 0x383928 /end MEASUREMENT
/begin MEASUREMENT B_avcas "" UWORD B_TRUE 1 100 0 1 BIT_MASK 0x1000 FORMAT "%13.11" ECU_ADDRESS 0x38392C /end MEASUREMENT
/begin MEASUREMENT B_avcat "" UWORD B_TRUE 1 100 0 1 BIT_MASK 0x1000 FORMAT "%13.11" ECU_ADDRESS 0x38392E /end MEASUREMENT
/begin MEASUREMENT B_avcge "" UWORD B_TRUE 1 100 0 1 BIT_MASK 0x1000 FORMAT "%13.11" ECU_ADDRESS 0x383930 /end MEASUREMENT
/begin MEASUREMENT B_avcgra "" UWORD B_TRUE 1 100 0 1 BIT_MASK 0x1000 FORMAT "%13.11" ECU_ADDRESS 0x383932 /end MEASUREMENT
/begin MEASUREMENT B_avcif "" UWORD B_TRUE 1 100 0 1 BIT_MASK 0x1000 FORMAT "%13.11" ECU_ADDRESS 0x383934 /end MEASUREMENT
/begin MEASUREMENT B_avcins "" UWORD B_TRUE 1 100 0 1 BIT_MASK 0x1000 FORMAT "%13.11" ECU_ADDRESS 0x383936 /end MEASUREMENT
/begin MEASUREMENT B_avckla "" UWORD B_TRUE 1 100 0 1 BIT_MASK 0x1000 FORMAT "%13.11" ECU_ADDRESS 0x383938 /end MEASUREMENT
/begin MEASUREMENT B_bbdecj "Bedingung Abwürgschutz DECJ" UWORD B_TRUE 1 100 0 1 BIT_MASK 0x4 FORMAT "%13.11" ECU_ADDRESS 0xFD50 /end MEASUREMENT
/begin MEASUREMENT B_bbubr "Bedingung Betriebsbereich Endstufendiagnose durch Versorgungsfehler abschaltbar" UWORD B_TRUE 1 100 0 1 BIT_MASK 0x8 FORMAT "%13.11" ECU_ADDRESS 0xFD50 /end MEASUREMENT
/begin MEASUREMENT B_beaav "Bedingung Bandende-Funktionsanforderung für AAV" UWORD B_TRUE 1 100 0 1 BIT_MASK 0x20 FORMAT "%13.11" ECU_ADDRESS 0x38390C /end MEASUREMENT
/begin MEASUREMENT B_becair "Bedingung Bandende Funktionsanforderung : Airbag-Botschaft" UWORD B_TRUE 1 100 0 1 BIT_MASK 0x20 FORMAT "%13.11" ECU_ADDRESS 0x383928 /end MEASUREMENT
/begin MEASUREMENT B_becas "Bedingung Bandende-Funktionsanforderung: CAN-Schnittstelle ABS" UWORD B_TRUE 1 100 0 1 BIT_MASK 0x20 FORMAT "%13.11" ECU_ADDRESS 0x38392C /end MEASUREMENT
/begin MEASUREMENT B_becat "Bedingung Bandende Funktionsanforderung : CAN-Schnittstelle, Timeout ASR" UWORD B_TRUE 1 100 0 1 BIT_MASK 0x20 FORMAT "%13.11" ECU_ADDRESS 0x38392E /end MEASUREMENT
/begin MEASUREMENT B_becge "Bedingung Bandende-Funktionsanforderung: CAN-Schnittstelle TCM" UWORD B_TRUE 1 100 0 1 BIT_MASK 0x20 FORMAT "%13.11" ECU_ADDRESS 0x383930 /end MEASUREMENT
/begin MEASUREMENT B_becgra "Bedingung: Bandendefunktionanford. für Signalfehler CAN-Timeout Botschaft GRA" UWORD B_TRUE 1 100 0 1 BIT_MASK 0x20 FORMAT "%13.11" ECU_ADDRESS 0x383932 /end MEASUREMENT
/begin MEASUREMENT B_becif "Bedingung Bandende-Funktionsanforderung CAN-Schnittstelle interner Fehler" UWORD B_TRUE 1 100 0 1 BIT_MASK 0x20 FORMAT "%13.11" ECU_ADDRESS 0x383934 /end MEASUREMENT
/begin MEASUREMENT B_becins "Bedingung Bandende Funktionsanforderung : Botschaft Kombi" UWORD B_TRUE 1 100 0 1 BIT_MASK 0x20 FORMAT "%13.11" ECU_ADDRESS 0x383936 /end MEASUREMENT
/begin MEASUREMENT B_beckla "Bedingung Bandende Funktionsanforderung : Botschaft Klima" UWORD B_TRUE 1 100 0 1 BIT_MASK 0x20 FORMAT "%13.11" ECU_ADDRESS 0x383938 /end MEASUREMENT
/begin MEASUREMENT B_beswe "Bedingung Bandende-Funktionsanforderung Beschleunigungss. f Schlechtwegerkennung" UWORD B_TRUE 1 100 0 1 BIT_MASK 0x20 FORMAT "%13.11" ECU_ADDRESS 0x3839F6 /end MEASUREMENT
/begin MEASUREMENT B_bkaav "Bedingung Ersatzwert aktiv Tankdiagnose, AAV defekt geschlossen" UWORD B_TRUE 1 100 0 1 BIT_MASK 0x40 FORMAT "%13.11" ECU_ADDRESS 0x38390C /end MEASUREMENT
/begin MEASUREMENT B_bkcair "Bedingung : Airbag-Botschaft" UWORD B_TRUE 1 100 0 1 BIT_MASK 0x40 FORMAT "%13.11" ECU_ADDRESS 0x383928 /end MEASUREMENT
/begin MEASUREMENT B_bkcas "Bedingung: CAN-Schnittstelle, Timeout ASC" UWORD B_TRUE 1 100 0 1 BIT_MASK 0x40 FORMAT "%13.11" ECU_ADDRESS 0x38392C /end MEASUREMENT
/begin MEASUREMENT B_bkcat "Bedingung: CAN-Schnittstelle, Timeout ASR" UWORD B_TRUE 1 100 0 1 BIT_MASK 0x40 FORMAT "%13.11" ECU_ADDRESS 0x38392E /end MEASUREMENT
/begin MEASUREMENT B_bkcge "Bedingung: CAN-Schnittstelle, Timeout EGS" UWORD B_TRUE 1 100 0 1 BIT_MASK 0x40 FORMAT "%13.11" ECU_ADDRESS 0x383930 /end MEASUREMENT
/begin MEASUREMENT B_bkcgra "Bedingung: CAN-Schnittstelle, Timeout Botschaft GRA" UWORD B_TRUE 1 100 0 1 BIT_MASK 0x40 FORMAT "%13.11" ECU_ADDRESS 0x383932 /end MEASUREMENT
/begin MEASUREMENT B_bkcif "Bedingung: CAN-Schnittstelle, interner Fehler" UWORD B_TRUE 1 100 0 1 BIT_MASK 0x40 FORMAT "%13.11" ECU_ADDRESS 0x383934 /end MEASUREMENT
/begin MEASUREMENT B_bkcins "Bedingung: CAN-Schnittstelle, Timeout Instrument" UWORD B_TRUE 1 100 0 1 BIT_MASK 0x40 FORMAT "%13.11" ECU_ADDRESS 0x383936 /end MEASUREMENT
/begin MEASUREMENT B_bkckla "Bedingung : Botschaft Klima" UWORD B_TRUE 1 100 0 1 BIT_MASK 0x40 FORMAT "%13.11" ECU_ADDRESS 0x383938 /end MEASUREMENT
/begin MEASUREMENT B_bkswe "Bedingung Ersatzwert aktiv: Schlechtwegerkennung" UWORD B_TRUE 1 100 0 1 BIT_MASK 0x40 FORMAT "%13.11" ECU_ADDRESS 0x3839F6 /end MEASUREMENT
/begin MEASUREMENT B_bkvagrab "Bedingung AGR aus wegen Bremskraftverstärker" UWORD B_TRUE 1 100 0 1 BIT_MASK 0x8 FORMAT "%13.11" ECU_ADDRESS 0xFDB2 /end MEASUREMENT
/begin MEASUREMENT B_bkvkoma "Bedingung: (Klima-) Kompressor abschalten, da nicht genügend Unterdruck in BKV" UBYTE B_TRUE 1 100 0 1 BIT_MASK 0x2 FORMAT "%13.11" ECU_ADDRESS 0x380BEE /end MEASUREMENT
/begin MEASUREMENT B_bkvkomab "Bedingung: (Klima-) Kompressor abschalten, da nicht genügend Unterdruck in BKV" UWORD B_TRUE 1 100 0 1 BIT_MASK 0x10 FORMAT "%13.11" ECU_ADDRESS 0xFDB2 /end MEASUREMENT
/begin MEASUREMENT B_bkvleer "Bedingung Bremskraftverstärker ohne ausreichenden Unterdruck" UWORD B_TRUE 1 100 0 1 BIT_MASK 0x20 FORMAT "%13.11" ECU_ADDRESS 0xFDB2 /end MEASUREMENT
/begin MEASUREMENT B_bkvnpler "Bedingung: Npl-Fehler BKV" UBYTE B_TRUE 1 100 0 1 BIT_MASK 0x1 FORMAT "%13.11" ECU_ADDRESS 0x384933 /end MEASUREMENT
/begin MEASUREMENT B_bkvnplh "Bedingung: Healing npl-Fehler" UBYTE B_TRUE 1 100 0 1 BIT_MASK 0x4 FORMAT "%13.11" ECU_ADDRESS 0x384933 /end MEASUREMENT
/begin MEASUREMENT B_bkvnwab "Bedingung Nockenwelle in Position mit min- Überschneidung wenn BKV leeer" UWORD B_TRUE 1 100 0 1 BIT_MASK 0x40 FORMAT "%13.11" ECU_ADDRESS 0xFDB2 /end MEASUREMENT
/begin MEASUREMENT B_bkvnwum "Bedingung Nockenwelle in Position mit min- Überschneidung wenn BKV leer" UBYTE B_TRUE 1 100 0 1 BIT_MASK 0x4 FORMAT "%13.11" ECU_ADDRESS 0x380BEE /end MEASUREMENT
/begin MEASUREMENT B_bkvpa "Bedingung: Bremskraftverstärker-Pumpe ansteuern, da BKV zu wenig unterdruck" UWORD B_TRUE 1 100 0 1 BIT_MASK 0x80 FORMAT "%13.11" ECU_ADDRESS 0xFDB2 /end MEASUREMENT
/begin MEASUREMENT B_bkvpea "Bedingung: Endstufe BKV Pumpe angesteuert" UBYTE B_TRUE 1 100 0 1 BIT_MASK 0x1 FORMAT "%13.11" ECU_ADDRESS 0x380BF0 /end MEASUREMENT
/begin MEASUREMENT B_bkvpena "Bedingung: Endstufe BKV-Pumpe nicht angesteuert" UBYTE B_TRUE 1 100 0 1 BIT_MASK 0x2 FORMAT "%13.11" ECU_ADDRESS 0x380BF0 /end MEASUREMENT
/begin MEASUREMENT B_br3bot "Bedingung Botschaft Bremse 3 wurde empfangen" UWORD B_TRUE 1 100 0 1 BIT_MASK 0x1 FORMAT "%13.11" ECU_ADDRESS 0xFD12 /end MEASUREMENT
/begin MEASUREMENT B_bus_off "Bedingung CAN Busoff erkannt" UWORD B_TRUE 1 100 0 1 BIT_MASK 0x2 FORMAT "%13.11" ECU_ADDRESS 0xFD12 /end MEASUREMENT
/begin MEASUREMENT B_cankbi "Bedingung Kombi-Botschaft erkannt" UBYTE B_TRUE 1 100 0 1 BIT_MASK 0x1 FORMAT "%13.11" ECU_ADDRESS 0x38304D /end MEASUREMENT
/begin MEASUREMENT B_canlws "Bedingung LWS-Botschaft erkannt (bei autom. Erkennung)" UBYTE B_TRUE 1 100 0 1 BIT_MASK 0x4 FORMAT "%13.11" ECU_ADDRESS 0x38304D /end MEASUREMENT
/begin MEASUREMENT B_cdma "Bedingung Ausgabe doppelte Momente auf CAN" UWORD B_TRUE 1 100 0 1 BIT_MASK 0x4 FORMAT "%13.11" ECU_ADDRESS 0xFD12 /end MEASUREMENT
/begin MEASUREMENT B_ckien "Bedingung CAN-Übertragung vom Kombiinstrument enable" UWORD B_TRUE 1 100 0 1 BIT_MASK 0x8 FORMAT "%13.11" ECU_ADDRESS 0xFD12 /end MEASUREMENT
/begin MEASUREMENT B_claav "Bedingung Fehlerflag ""AKF-Absperrventil verstopft"" löschen" UWORD B_TRUE 1 100 0 1 BIT_MASK 0x80 FORMAT "%13.11" ECU_ADDRESS 0x38390C /end MEASUREMENT
/begin MEASUREMENT B_clcair "Bedingung Fehlerpfad  cair löschen" UWORD B_TRUE 1 100 0 1 BIT_MASK 0x80 FORMAT "%13.11" ECU_ADDRESS 0x383928 /end MEASUREMENT
/begin MEASUREMENT B_clcas "Bedingung Fehlerpfad CAS löschen" UWORD B_TRUE 1 100 0 1 BIT_MASK 0x80 FORMAT "%13.11" ECU_ADDRESS 0x38392C /end MEASUREMENT
/begin MEASUREMENT B_clcat "Bedingung Fehlerpfad CAT löschen" UWORD B_TRUE 1 100 0 1 BIT_MASK 0x80 FORMAT "%13.11" ECU_ADDRESS 0x38392E /end MEASUREMENT
/begin MEASUREMENT B_clcge "Bedingung Fehlerpfad CGE löschen" UWORD B_TRUE 1 100 0 1 BIT_MASK 0x80 FORMAT "%13.11" ECU_ADDRESS 0x383930 /end MEASUREMENT
/begin MEASUREMENT B_clcgra "Bedingung Fehlerpfad  cgra löschen" UWORD B_TRUE 1 100 0 1 BIT_MASK 0x80 FORMAT "%13.11" ECU_ADDRESS 0x383932 /end MEASUREMENT
/begin MEASUREMENT B_clcif "Bedingung Fehlerpfad CIF löschen" UWORD B_TRUE 1 100 0 1 BIT_MASK 0x80 FORMAT "%13.11" ECU_ADDRESS 0x383934 /end MEASUREMENT
/begin MEASUREMENT B_clcins "Bedingung Fehlerpfad CINS löschen" UWORD B_TRUE 1 100 0 1 BIT_MASK 0x80 FORMAT "%13.11" ECU_ADDRESS 0x383936 /end MEASUREMENT
/begin MEASUREMENT B_clckla "Bedingung Fehlerpfad  ckla löschen" UWORD B_TRUE 1 100 0 1 BIT_MASK 0x80 FORMAT "%13.11" ECU_ADDRESS 0x383938 /end MEASUREMENT
/begin MEASUREMENT B_clswe "Flag : Fehlerpfad Diagnose Beschleunigungssensor löschen" UWORD B_TRUE 1 100 0 1 BIT_MASK 0x80 FORMAT "%13.11" ECU_ADDRESS 0x3839F6 /end MEASUREMENT
/begin MEASUREMENT B_csair "Bedingung Checksummenfehler in der Airbag-Botschaft" UWORD B_TRUE 1 100 0 1 BIT_MASK 0x10 FORMAT "%13.11" ECU_ADDRESS 0xFD12 /end MEASUREMENT
/begin MEASUREMENT B_csairio "Bedinung Checksumme Airbag-Botschaft fehlerfrei" UWORD B_TRUE 1 100 0 1 BIT_MASK 0x20 FORMAT "%13.11" ECU_ADDRESS 0xFD12 /end MEASUREMENT
/begin MEASUREMENT B_ctout "Bedingung: CAN-timeout Prüfung" UWORD B_TRUE 1 100 0 1 BIT_MASK 0x40 FORMAT "%13.11" ECU_ADDRESS 0xFD12 /end MEASUREMENT
/begin MEASUREMENT B_cvtad "Bedingung Adaptionsfreigabe bei CVT-Getriebe" UWORD B_TRUE 1 100 0 1 BIT_MASK 0x80 FORMAT "%13.11" ECU_ADDRESS 0xFD12 /end MEASUREMENT
/begin MEASUREMENT B_daav "Aktive Diagnose: Absperrventil Aktivkohlefilter (Funktion)" UBYTE B_TRUE 1 100 0 1 BIT_MASK 0x1 FORMAT "%13.11" ECU_ADDRESS 0x380A08 /end MEASUREMENT
/begin MEASUREMENT B_daavf "DAAV ist prinzipiell freigegeben" UBYTE B_TRUE 1 100 0 1 BIT_MASK 0x1 FORMAT "%13.11" ECU_ADDRESS 0x380A0A /end MEASUREMENT
/begin MEASUREMENT B_daavreq "Bedingung Anforderungen aus DAAV gültig" UBYTE B_TRUE 1 100 0 1 BIT_MASK 0x8 FORMAT "%13.11" ECU_ADDRESS 0x380A08 /end MEASUREMENT
/begin MEASUREMENT B_daavte "Anforderung TEV schließen aus AAV-Diagnose" UBYTE B_TRUE 1 100 0 1 BIT_MASK 0x2 FORMAT "%13.11" ECU_ADDRESS 0x380A08 /end MEASUREMENT
/begin MEASUREMENT B_dbkvpa "Bedingung: Diagnose BKV-Pumpe aktiv" UBYTE B_TRUE 1 100 0 1 BIT_MASK 0x1 FORMAT "%13.11" ECU_ADDRESS 0x384932 /end MEASUREMENT
/begin MEASUREMENT B_dcva "Bedingung KGE-Diagnose aktiv" UBYTE B_TRUE 1 100 0 1 BIT_MASK 0x1 FORMAT "%13.11" ECU_ADDRESS 0x380947 /end MEASUREMENT
/begin MEASUREMENT B_dcvausw "Bedingung KGE-Diagnose-Bildung eines Ergebnisses möglich" UBYTE B_TRUE 1 100 0 1 BIT_MASK 0x2 FORMAT "%13.11" ECU_ADDRESS 0x380947 /end MEASUREMENT
/begin MEASUREMENT B_dcvb "Bedingung KGE-Diagnose-Bereitschaft" UBYTE B_TRUE 1 100 0 1 BIT_MASK 0x4 FORMAT "%13.11" ECU_ADDRESS 0x380947 /end MEASUREMENT
/begin MEASUREMENT B_dcve "Bedingung Leckage erkannt" UBYTE B_TRUE 1 100 0 1 BIT_MASK 0x10 FORMAT "%13.11" ECU_ADDRESS 0x380946 /end MEASUREMENT
/begin MEASUREMENT B_dcverr "Bedingung KGE-Diagnose-Sperrung durch externe E-Flags" UBYTE B_TRUE 1 100 0 1 BIT_MASK 0x8 FORMAT "%13.11" ECU_ADDRESS 0x380947 /end MEASUREMENT
/begin MEASUREMENT B_dcvio "Bedingung KGE-Diagnose-Diagnoseergebnis ist iO" UBYTE B_TRUE 1 100 0 1 BIT_MASK 0x10 FORMAT "%13.11" ECU_ADDRESS 0x380947 /end MEASUREMENT
/begin MEASUREMENT B_dcvm "Bedingung KGE-Diagnose-Meßbeginn" UBYTE B_TRUE 1 100 0 1 BIT_MASK 0x20 FORMAT "%13.11" ECU_ADDRESS 0x380947 /end MEASUREMENT
/begin MEASUREMENT B_dcvnio "Bedingung KGE-Diagnose-Diagnoseergebnis ist niO" UBYTE B_TRUE 1 100 0 1 BIT_MASK 0x40 FORMAT "%13.11" ECU_ADDRESS 0x380947 /end MEASUREMENT
/begin MEASUREMENT B_dcvwdh "Bedingung Wiederholungsprüfung (im selben DCY) zugelassen" UBYTE B_TRUE 1 100 0 1 BIT_MASK 0x80 FORMAT "%13.11" ECU_ADDRESS 0x380947 /end MEASUREMENT
/begin MEASUREMENT B_dcy "Bedingung 'driving cycle' erkannt" UBYTE B_TRUE 1 100 0 1 BIT_MASK 0x1 FORMAT "%13.11" ECU_ADDRESS 0x380940 /end MEASUREMENT
/begin MEASUREMENT B_desee "Diagnose Endstufe: Eingangsbedingungen erfüllt" UWORD B_TRUE 1 100 0 1 BIT_MASK 0x10 FORMAT "%13.11" ECU_ADDRESS 0xFD50 /end MEASUREMENT
/begin MEASUREMENT B_dnmcan "Vorzeichen Drehzahlgradient für CAN-Ausgabe" UWORD B_TRUE 1 100 0 1 BIT_MASK 0x100 FORMAT "%13.11" ECU_ADDRESS 0xFD12 /end MEASUREMENT
/begin MEASUREMENT B_dpumna "Bedingung minimale Differenz Umgebungsdruck - Saugrohrdruck unterschritten" UBYTE B_TRUE 1 100 0 1 BIT_MASK 0x20 FORMAT "%13.11" ECU_ADDRESS 0x380A0A /end MEASUREMENT
/begin MEASUREMENT B_ebkvl "Bedingung: Leckage bei BKV-DS" UBYTE B_TRUE 1 100 0 1 BIT_MASK 0x8 FORMAT "%13.11" ECU_ADDRESS 0x384933 /end MEASUREMENT
/begin MEASUREMENT B_ectal "Bedingung Tankinfo vom Kombi ist fehlerhaft" UWORD B_TRUE 1 100 0 1 BIT_MASK 0x200 FORMAT "%13.11" ECU_ADDRESS 0xFD12 /end MEASUREMENT
/begin MEASUREMENT B_ecv "Bedingung lokales Error-Flag gesetzt" UBYTE B_TRUE 1 100 0 1 BIT_MASK 0x1 FORMAT "%13.11" ECU_ADDRESS 0x383114 /end MEASUREMENT
/begin MEASUREMENT B_edctrip "" UBYTE B_TRUE 1 100 0 1 BIT_MASK 0x2 FORMAT "%13.11" ECU_ADDRESS 0x380948 /end MEASUREMENT
/begin MEASUREMENT B_edcvab "Einspritzventile wegen defekter Kurbelgehäuseentl. ausblenden" UBYTE B_TRUE 1 100 0 1 BIT_MASK 0x1 FORMAT "%13.11" ECU_ADDRESS 0x380946 /end MEASUREMENT
/begin MEASUREMENT B_edcve "Bedingung Leckage erkannt (lokales Fehlerflag für eine Leckage nach DK)" UBYTE B_TRUE 1 100 0 1 BIT_MASK 0x2 FORMAT "%13.11" ECU_ADDRESS 0x380946 /end MEASUREMENT
/begin MEASUREMENT B_edcvez "Bedingung Leckage erkannt (lokales Fehlerflag für Leckage vor und nach DK)" UBYTE B_TRUE 1 100 0 1 BIT_MASK 0x8 FORMAT "%13.11" ECU_ADDRESS 0x380946 /end MEASUREMENT
/begin MEASUREMENT B_edcvtrip "Leckage während des Trips's erkannt" UBYTE B_TRUE 1 100 0 1 BIT_MASK 0x1 FORMAT "%13.11" ECU_ADDRESS 0x38094B /end MEASUREMENT
/begin MEASUREMENT B_edcvv "Bedingung Leckage erkannt (lokales,allgemeines Fehlerflag), verzögert" UBYTE B_TRUE 1 100 0 1 BIT_MASK 0x4 FORMAT "%13.11" ECU_ADDRESS 0x380948 /end MEASUREMENT
/begin MEASUREMENT B_edcvz "Bedingung Leckage erkannt (lokales Fehlerflag für eine Leckage vor DK)" UBYTE B_TRUE 1 100 0 1 BIT_MASK 0x4 FORMAT "%13.11" ECU_ADDRESS 0x380946 /end MEASUREMENT
/begin MEASUREMENT B_eev "Bedingung Endstufenfehler EV" UWORD B_TRUE 1 100 0 1 BIT_MASK 0x40 FORMAT "%13.11" ECU_ADDRESS 0xFD50 /end MEASUREMENT
/begin MEASUREMENT B_ehfmfe "Bedingung: Fehler HFM aus DEGFE" UBYTE B_TRUE 1 100 0 1 BIT_MASK 0x1 FORMAT "%13.11" ECU_ADDRESS 0x38486A /end MEASUREMENT
/begin MEASUREMENT B_emnats "Statusbit: Min-Fehler Abgastemperatursensor erkannt" UBYTE B_TRUE 1 100 0 1 BIT_MASK 0x1 FORMAT "%13.11" ECU_ADDRESS 0x380A5E /end MEASUREMENT
/begin MEASUREMENT B_emncv "Bedingung: MIN-Fehler DCV" UBYTE B_TRUE 1 100 0 1 BIT_MASK 0x8 FORMAT "%13.11" ECU_ADDRESS 0x380948 /end MEASUREMENT
/begin MEASUREMENT B_emxats "Statusbit: Max-Fehler Abgastemperatursensor erkannt" UBYTE B_TRUE 1 100 0 1 BIT_MASK 0x4 FORMAT "%13.11" ECU_ADDRESS 0x380A5E /end MEASUREMENT
/begin MEASUREMENT B_emxcv "Bedingung: MAX-Fehler DCV" UBYTE B_TRUE 1 100 0 1 BIT_MASK 0x10 FORMAT "%13.11" ECU_ADDRESS 0x38094A /end MEASUREMENT
/begin MEASUREMENT B_emxcvi "Bedingung: Interner MAX-Fehler DCV" UBYTE B_TRUE 1 100 0 1 BIT_MASK 0x10 FORMAT "%13.11" ECU_ADDRESS 0x380948 /end MEASUREMENT
/begin MEASUREMENT B_enabddg "Ausblendung der Drehzahlgeberdiagnose für E_bm" UBYTE B_TRUE 1 100 0 1 BIT_MASK 0x1 FORMAT "%13.11" ECU_ADDRESS 0x380966 /end MEASUREMENT
/begin MEASUREMENT B_enpats "Statusbit: Nichtplausibel-Fehler Abgastemperatursensor erkannt" UBYTE B_TRUE 1 100 0 1 BIT_MASK 0x2 FORMAT "%13.11" ECU_ADDRESS 0x380A5E /end MEASUREMENT
/begin MEASUREMENT B_enstodcv "Bedingung Übernahme Adaptionswerte im Start" UBYTE B_TRUE 1 100 0 1 BIT_MASK 0x20 FORMAT "%13.11" ECU_ADDRESS 0x380948 /end MEASUREMENT
/begin MEASUREMENT B_enstofra "Teilbedingung Übernahme Adaptionswerte im Start" UBYTE B_TRUE 1 100 0 1 BIT_MASK 0x8 FORMAT "%13.11" ECU_ADDRESS 0x383114 /end MEASUREMENT
/begin MEASUREMENT B_epcden "Bedingung Endtsufendiagnose EPCL erlaubt" UBYTE B_TRUE 1 100 0 1 BIT_MASK 0x2 FORMAT "%13.11" ECU_ADDRESS 0x38304D /end MEASUREMENT
/begin MEASUREMENT B_erraav "Bedingung Fehlerbit erfüllt" UBYTE B_TRUE 1 100 0 1 BIT_MASK 0x2 FORMAT "%13.11" ECU_ADDRESS 0x380A0A /end MEASUREMENT
/begin MEASUREMENT B_esdia "Endstufendiagnose aktiv" UWORD B_TRUE 1 100 0 1 BIT_MASK 0x20 FORMAT "%13.11" ECU_ADDRESS 0xFD50 /end MEASUREMENT
/begin MEASUREMENT B_esenats "Bedingung: Fehlermeldung aus der Teildiagnose DIAGTAT-B1" UBYTE B_TRUE 1 100 0 1 BIT_MASK 0x10 FORMAT "%13.11" ECU_ADDRESS 0x380A60 /end MEASUREMENT
/begin MEASUREMENT B_esiats "Statusbit: Signalfehler Abgastemperatursensor erkannt" UBYTE B_TRUE 1 100 0 1 BIT_MASK 0x8 FORMAT "%13.11" ECU_ADDRESS 0x380A5E /end MEASUREMENT
/begin MEASUREMENT B_faaava "Kurztrip DLDP aktiviert in DAAV" UBYTE B_TRUE 1 100 0 1 BIT_MASK 0x2 FORMAT "%13.11" ECU_ADDRESS 0x380A09 /end MEASUREMENT
/begin MEASUREMENT B_faatson "Bedingung Funktionsanforderung Abgastemperatursensor aktiv" UBYTE B_TRUE 1 100 0 1 BIT_MASK 0x4 FORMAT "%13.11" ECU_ADDRESS 0x380A5F /end MEASUREMENT
/begin MEASUREMENT B_fatr "Bedingung Fehler Abgastemperaturregelung Bank 1" UWORD B_TRUE 1 100 0 1 BIT_MASK 0x10 FORMAT "%13.11" ECU_ADDRESS 0xFD68 /end MEASUREMENT
/begin MEASUREMENT B_fatr2 "Bedingung Fehler Abgastemperaturregelung Bank 2" UWORD B_TRUE 1 100 0 1 BIT_MASK 0x20 FORMAT "%13.11" ECU_ADDRESS 0xFD68 /end MEASUREMENT
/begin MEASUREMENT B_fbkvpa "Bedingung: Freigabe BKV-Pumpe ansteuern" UWORD B_TRUE 1 100 0 1 BIT_MASK 0x100 FORMAT "%13.11" ECU_ADDRESS 0xFDB2 /end MEASUREMENT
/begin MEASUREMENT B_fdbkvp "Bedingung: Freigabe Diagnose Bremskraftverstärker-Pumpe" UBYTE B_TRUE 1 100 0 1 BIT_MASK 0x2 FORMAT "%13.11" ECU_ADDRESS 0x384931 /end MEASUREMENT
/begin MEASUREMENT B_feva10 "Bedingung kurze Lastüberschreitung rl über Maxwert" UBYTE B_TRUE 1 100 0 1 BIT_MASK 0x2 FORMAT "%13.11" ECU_ADDRESS 0x380A0C /end MEASUREMENT
/begin MEASUREMENT B_feva11 "Bedingung TEV nicht erfüllt" UBYTE B_TRUE 1 100 0 1 BIT_MASK 0x4 FORMAT "%13.11" ECU_ADDRESS 0x380A0C /end MEASUREMENT
/begin MEASUREMENT B_feva12 "Bedingung Reedkontakt öffnet in der Fast Pulse Phase" UBYTE B_TRUE 1 100 0 1 BIT_MASK 0x8 FORMAT "%13.11" ECU_ADDRESS 0x380A0C /end MEASUREMENT
/begin MEASUREMENT B_feva9 "Bedingung lange Lastüberschreitung rl über Maxwert" UBYTE B_TRUE 1 100 0 1 BIT_MASK 0x1 FORMAT "%13.11" ECU_ADDRESS 0x380A0C /end MEASUREMENT
/begin MEASUREMENT B_fku "Bedingung Kupplungsfehler aus Botschaft Getriebe 2" UWORD B_TRUE 1 100 0 1 BIT_MASK 0x400 FORMAT "%13.11" ECU_ADDRESS 0xFD12 /end MEASUREMENT
/begin MEASUREMENT B_fpbkvmx "Freigabe: BKV-Druck genügend gross" UBYTE B_TRUE 1 100 0 1 BIT_MASK 0x4 FORMAT "%13.11" ECU_ADDRESS 0x384931 /end MEASUREMENT
/begin MEASUREMENT B_fpchka "Bedingung Prüfung auf Abbruch Fast Pulse" UBYTE B_TRUE 1 100 0 1 BIT_MASK 0x4 FORMAT "%13.11" ECU_ADDRESS 0x380A0A /end MEASUREMENT
/begin MEASUREMENT B_fstcanok "CAN: Bedingung Tankfuellstands-Message okay" UWORD B_TRUE 1 100 0 1 BIT_MASK 0x800 FORMAT "%13.11" ECU_ADDRESS 0xFD12 /end MEASUREMENT
/begin MEASUREMENT B_ftaav "Bedingung Fehlereintrag durch Tester für AAV" UWORD B_TRUE 1 100 0 1 BIT_MASK 0x10 FORMAT "%13.11" ECU_ADDRESS 0x38390C /end MEASUREMENT
/begin MEASUREMENT B_ftcair "Bedingung Fehlereintrag durch Tester : Airbag-Botschaft" UWORD B_TRUE 1 100 0 1 BIT_MASK 0x10 FORMAT "%13.11" ECU_ADDRESS 0x383928 /end MEASUREMENT
/begin MEASUREMENT B_ftcas "Bedingung Fehlereintrag durch Tester: CAN-Schnittstelle ABS" UWORD B_TRUE 1 100 0 1 BIT_MASK 0x10 FORMAT "%13.11" ECU_ADDRESS 0x38392C /end MEASUREMENT
/begin MEASUREMENT B_ftcat "Bedingung Fehlereintrag durch Tester : CAN-Schnittstelle, Timeout ASR" UWORD B_TRUE 1 100 0 1 BIT_MASK 0x10 FORMAT "%13.11" ECU_ADDRESS 0x38392E /end MEASUREMENT
/begin MEASUREMENT B_ftcge "Bedingung Fehlereintrag durch Tester: CAN-Schnittstelle TCM" UWORD B_TRUE 1 100 0 1 BIT_MASK 0x10 FORMAT "%13.11" ECU_ADDRESS 0x383930 /end MEASUREMENT
/begin MEASUREMENT B_ftcgra "Bedingung Fehlereintrag durch Tester für CAN-Timeout Botschaft GRA" UWORD B_TRUE 1 100 0 1 BIT_MASK 0x10 FORMAT "%13.11" ECU_ADDRESS 0x383932 /end MEASUREMENT
/begin MEASUREMENT B_ftcif "Bedingung Fehlereintrag durch Tester : CAN im Zustand Bus-Off" UWORD B_TRUE 1 100 0 1 BIT_MASK 0x10 FORMAT "%13.11" ECU_ADDRESS 0x383934 /end MEASUREMENT
/begin MEASUREMENT B_ftcins "Bedingung Fehlereintrag durch Tester : Botschaft Kombi" UWORD B_TRUE 1 100 0 1 BIT_MASK 0x10 FORMAT "%13.11" ECU_ADDRESS 0x383936 /end MEASUREMENT
/begin MEASUREMENT B_ftckla "Bedingung Fehlereintrag durch Tester : Botschaft Klima" UWORD B_TRUE 1 100 0 1 BIT_MASK 0x10 FORMAT "%13.11" ECU_ADDRESS 0x383938 /end MEASUREMENT
/begin MEASUREMENT B_ftswe "Bedingung Fehlereintrag durch Tester:  Schlechtwegerkennung" UWORD B_TRUE 1 100 0 1 BIT_MASK 0x10 FORMAT "%13.11" ECU_ADDRESS 0x3839F6 /end MEASUREMENT
/begin MEASUREMENT B_ge1bot "Bedingung Getriebe1-Botschaft empfangen" UWORD B_TRUE 1 100 0 1 BIT_MASK 0x1000 FORMAT "%13.11" ECU_ADDRESS 0xFD12 /end MEASUREMENT
/begin MEASUREMENT B_ge2bot "Bedingung Getriebe2-Botschaft empfangen" UWORD B_TRUE 1 100 0 1 BIT_MASK 0x2000 FORMAT "%13.11" ECU_ADDRESS 0xFD12 /end MEASUREMENT
/begin MEASUREMENT B_geco "Bedingung Ecomatic-Betrieb vom Getriebe" UWORD B_TRUE 1 100 0 1 BIT_MASK 0x4000 FORMAT "%13.11" ECU_ADDRESS 0xFD12 /end MEASUREMENT
/begin MEASUREMENT B_gekoa "Bedingung Kompressor wegen Getriebeeingriff abschalten" UWORD B_TRUE 1 100 0 1 BIT_MASK 0x8000 FORMAT "%13.11" ECU_ADDRESS 0xFD12 /end MEASUREMENT
/begin MEASUREMENT B_genot "Bedingung Getriebe-Notlauf" UWORD B_TRUE 1 100 0 1 BIT_MASK 0x1 FORMAT "%13.11" ECU_ADDRESS 0xFD14 /end MEASUREMENT
/begin MEASUREMENT B_ges "Bedingung Getriebeschutz über Zylinderausblendung" UWORD B_TRUE 1 100 0 1 BIT_MASK 0x2 FORMAT "%13.11" ECU_ADDRESS 0xFD14 /end MEASUREMENT
/begin MEASUREMENT B_geuew "Bedingung Zeitüberwachung Getriebeeingriff (CAN)" UWORD B_TRUE 1 100 0 1 BIT_MASK 0x4 FORMAT "%13.11" ECU_ADDRESS 0xFD14 /end MEASUREMENT
/begin MEASUREMENT B_grabot "Bedingung GRA-Botschaft empfangen" UWORD B_TRUE 1 100 0 1 BIT_MASK 0x8 FORMAT "%13.11" ECU_ADDRESS 0xFD14 /end MEASUREMENT
/begin MEASUREMENT B_gsaf "Bedingung Getriebe-Schalteingriff-Anforderung" UWORD B_TRUE 1 100 0 1 BIT_MASK 0x10 FORMAT "%13.11" ECU_ADDRESS 0xFD14 /end MEASUREMENT
/begin MEASUREMENT B_gsch "Bedingung Getriebeschaltung aktiv" UWORD B_TRUE 1 100 0 1 BIT_MASK 0x20 FORMAT "%13.11" ECU_ADDRESS 0xFD14 /end MEASUREMENT
/begin MEASUREMENT B_hbkvl "Bedingung: es liegt kein npl. Fehler durch Leckage in BKV vor" UBYTE B_TRUE 1 100 0 1 BIT_MASK 0x2 FORMAT "%13.11" ECU_ADDRESS 0x384933 /end MEASUREMENT
/begin MEASUREMENT B_inimsdks "Bedingung Umschaltung auf MSLGDCV als Startwert" UBYTE B_TRUE 1 100 0 1 BIT_MASK 0x2 FORMAT "%13.11" ECU_ADDRESS 0x38094B /end MEASUREMENT
/begin MEASUREMENT B_kooffc "Bedingung für hartes Kompressorabschalten aus Bordnetz über CAN" UWORD B_TRUE 1 100 0 1 BIT_MASK 0x40 FORMAT "%13.11" ECU_ADDRESS 0xFD14 /end MEASUREMENT
/begin MEASUREMENT B_lamx "Bedingung: frm_w und lamsbg_w im Diagnosebereich" UBYTE B_TRUE 1 100 0 1 BIT_MASK 0x4 FORMAT "%13.11" ECU_ADDRESS 0x38094B /end MEASUREMENT
/begin MEASUREMENT B_lowra "Bedingung Zwischengelege für Low Range zugeschaltet" UWORD B_TRUE 1 100 0 1 BIT_MASK 0x80 FORMAT "%13.11" ECU_ADDRESS 0xFD14 /end MEASUREMENT
/begin MEASUREMENT B_lwsbot "Bedingung LWS-Botschaft empfangen" UWORD B_TRUE 1 100 0 1 BIT_MASK 0x100 FORMAT "%13.11" ECU_ADDRESS 0xFD14 /end MEASUREMENT
/begin MEASUREMENT B_lwser "Fehler im Lenkwinkelsensorpfad" UWORD B_TRUE 1 100 0 1 BIT_MASK 0x200 FORMAT "%13.11" ECU_ADDRESS 0xFD14 /end MEASUREMENT
/begin MEASUREMENT B_lwsok "Bedingung LWS-Caninfo ist fehlerfrei" UWORD B_TRUE 1 100 0 1 BIT_MASK 0x400 FORMAT "%13.11" ECU_ADDRESS 0xFD14 /end MEASUREMENT
/begin MEASUREMENT B_mdwaner "Bedingung Fehler auf mdwan_w" UWORD B_TRUE 1 100 0 1 BIT_MASK 0x800 FORMAT "%13.11" ECU_ADDRESS 0xFD14 /end MEASUREMENT
/begin MEASUREMENT B_messea "Flag Periodendauermessung (Stage 5) beendet" UBYTE B_TRUE 1 100 0 1 BIT_MASK 0x8 FORMAT "%13.11" ECU_ADDRESS 0x380A09 /end MEASUREMENT
/begin MEASUREMENT B_mgbget "Bedingung Momentengradientenbegrenzung aktiv" UWORD B_TRUE 1 100 0 1 BIT_MASK 0x1000 FORMAT "%13.11" ECU_ADDRESS 0xFD14 /end MEASUREMENT
/begin MEASUREMENT B_milfb "MIL-Ansteuerung fremdbestimmt durch externes SG" UWORD B_TRUE 1 100 0 1 BIT_MASK 0x2000 FORMAT "%13.11" ECU_ADDRESS 0xFD14 /end MEASUREMENT
/begin MEASUREMENT B_milfbg "Bedingung MIL-Ansteuerung vom Getriebe" UWORD B_TRUE 1 100 0 1 BIT_MASK 0x4000 FORMAT "%13.11" ECU_ADDRESS 0xFD14 /end MEASUREMENT
/begin MEASUREMENT B_mnaav "Fehlertyp 'Minimalwert' erkannt (AKF-Absperrventil verstopft)" UWORD B_TRUE 1 100 0 1 BIT_MASK 0x200 FORMAT "%13.11" ECU_ADDRESS 0x38390C /end MEASUREMENT
/begin MEASUREMENT B_mncair "Fehlertyp min. : Airbag-Botschaft" UWORD B_TRUE 1 100 0 1 BIT_MASK 0x200 FORMAT "%13.11" ECU_ADDRESS 0x383928 /end MEASUREMENT
/begin MEASUREMENT B_mncas "Fehlertyp min.: CAN-Schnittstelle, Timeout ASC" UWORD B_TRUE 1 100 0 1 BIT_MASK 0x200 FORMAT "%13.11" ECU_ADDRESS 0x38392C /end MEASUREMENT
/begin MEASUREMENT B_mncat "Fehlertyp min.: CAN-Schnittstelle, Timeout ASR" UWORD B_TRUE 1 100 0 1 BIT_MASK 0x200 FORMAT "%13.11" ECU_ADDRESS 0x38392E /end MEASUREMENT
/begin MEASUREMENT B_mncge "Fehlertyp min.: CAN-Schnittstelle, Timeout EGS" UWORD B_TRUE 1 100 0 1 BIT_MASK 0x200 FORMAT "%13.11" ECU_ADDRESS 0x383930 /end MEASUREMENT
/begin MEASUREMENT B_mncgra "Fehlertyp : Min-Fehler GRA-Botschaft" UWORD B_TRUE 1 100 0 1 BIT_MASK 0x200 FORMAT "%13.11" ECU_ADDRESS 0x383932 /end MEASUREMENT
/begin MEASUREMENT B_mncif "Fehlertyp min.: CAN-Schnittstelle, interner Fehler" UWORD B_TRUE 1 100 0 1 BIT_MASK 0x200 FORMAT "%13.11" ECU_ADDRESS 0x383934 /end MEASUREMENT
/begin MEASUREMENT B_mncins "Fehlertyp min.: CAN-Schnittstelle, Timeout Instrument" UWORD B_TRUE 1 100 0 1 BIT_MASK 0x200 FORMAT "%13.11" ECU_ADDRESS 0x383936 /end MEASUREMENT
/begin MEASUREMENT B_mnckla "Fehlertyp min. : Botschaft Klima" UWORD B_TRUE 1 100 0 1 BIT_MASK 0x200 FORMAT "%13.11" ECU_ADDRESS 0x383938 /end MEASUREMENT
/begin MEASUREMENT B_mnswe "Beschleunigungssensorsignal kleiner als Plausibilitätsschwelle" UWORD B_TRUE 1 100 0 1 BIT_MASK 0x200 FORMAT "%13.11" ECU_ADDRESS 0x3839F6 /end MEASUREMENT
/begin MEASUREMENT B_motaus "CAN-Signal: ""Motor AUS""-Anforderung vom F1-Getriebe (KUP)" UWORD B_TRUE 1 100 0 1 BIT_MASK 0x8000 FORMAT "%13.11" ECU_ADDRESS 0xFD14 /end MEASUREMENT
/begin MEASUREMENT B_mxaav "Fehlertyp 'Maximalwert' erkannt (AAV verstopft)" UWORD B_TRUE 1 100 0 1 BIT_MASK 0x100 FORMAT "%13.11" ECU_ADDRESS 0x38390C /end MEASUREMENT
/begin MEASUREMENT B_mxcair "Fehlertyp max. : Airbag-Botschaft" UWORD B_TRUE 1 100 0 1 BIT_MASK 0x100 FORMAT "%13.11" ECU_ADDRESS 0x383928 /end MEASUREMENT
/begin MEASUREMENT B_mxcas "Fehlertyp max.: CAN-Schnittstelle, Timeout Botschaft ASC" UWORD B_TRUE 1 100 0 1 BIT_MASK 0x100 FORMAT "%13.11" ECU_ADDRESS 0x38392C /end MEASUREMENT
/begin MEASUREMENT B_mxcat "Fehlertyp max.: CAN-Schnittstelle, Timeout ASR" UWORD B_TRUE 1 100 0 1 BIT_MASK 0x100 FORMAT "%13.11" ECU_ADDRESS 0x38392E /end MEASUREMENT
/begin MEASUREMENT B_mxcge "Fehlertyp max.: CAN-Schnittstelle, Timeout EGS" UWORD B_TRUE 1 100 0 1 BIT_MASK 0x100 FORMAT "%13.11" ECU_ADDRESS 0x383930 /end MEASUREMENT
/begin MEASUREMENT B_mxcgra "Fehlertyp : Max-Fehler GRA-Botschaft" UWORD B_TRUE 1 100 0 1 BIT_MASK 0x100 FORMAT "%13.11" ECU_ADDRESS 0x383932 /end MEASUREMENT
/begin MEASUREMENT B_mxcif "Fehlertyp max.: CAN-Schnittstelle, interner Fehler            2" UWORD B_TRUE 1 100 0 1 BIT_MASK 0x100 FORMAT "%13.11" ECU_ADDRESS 0x383934 /end MEASUREMENT
/begin MEASUREMENT B_mxcins "Fehlertyp max.: CAN-Schnittstelle, Timeout Instrument" UWORD B_TRUE 1 100 0 1 BIT_MASK 0x100 FORMAT "%13.11" ECU_ADDRESS 0x383936 /end MEASUREMENT
/begin MEASUREMENT B_mxckla "Fehlertyp max. : Botschaft Klima" UWORD B_TRUE 1 100 0 1 BIT_MASK 0x100 FORMAT "%13.11" ECU_ADDRESS 0x383938 /end MEASUREMENT
/begin MEASUREMENT B_mxswe "Beschleunigungssensorsignal größer als Plausibilitätsschwelle" UWORD B_TRUE 1 100 0 1 BIT_MASK 0x100 FORMAT "%13.11" ECU_ADDRESS 0x3839F6 /end MEASUREMENT
/begin MEASUREMENT B_neair "Bedingung Nachrichtenempfang Botschaft Airbag" UWORD B_TRUE 1 100 0 1 BIT_MASK 0x1 FORMAT "%13.11" ECU_ADDRESS 0xFD16 /end MEASUREMENT
/begin MEASUREMENT B_nlbm "Bedingung für NLDG wenn Bezugsmarke häufig verloren wird" UWORD B_TRUE 1 100 0 1 BIT_MASK 0x4000 FORMAT "%13.11" ECU_ADDRESS 0xFD28 /end MEASUREMENT
/begin MEASUREMENT B_nlbzanf "Anforderung von Bordnetzmangement zur Anhebung der Leerlaufdrehzahl" UWORD B_TRUE 1 100 0 1 BIT_MASK 0x2 FORMAT "%13.11" ECU_ADDRESS 0xFD16 /end MEASUREMENT
/begin MEASUREMENT B_nldg "Bedingung Drehzahlgeber-Notlauf ist aktiv." UWORD B_TRUE 1 100 0 1 BIT_MASK 0x8000 FORMAT "%13.11" ECU_ADDRESS 0xFD28 /end MEASUREMENT
/begin MEASUREMENT B_nlnobm "Bedingung für NLDG wenn keine Bezugsmarke gefunden wurde" UWORD B_TRUE 1 100 0 1 BIT_MASK 0x1 FORMAT "%13.11" ECU_ADDRESS 0xFD2A /end MEASUREMENT
/begin MEASUREMENT B_nlnon "Bedingung für NLDG wenn keine Zahnsignale vorhanden sind" UWORD B_TRUE 1 100 0 1 BIT_MASK 0x2 FORMAT "%13.11" ECU_ADDRESS 0xFD2A /end MEASUREMENT
/begin MEASUREMENT B_no "unendlich-Trigger für Fehlerpfadmanagement" UBYTE B_TRUE 1 100 0 1 BIT_MASK 0x1 FORMAT "%13.11" ECU_ADDRESS 0x383103 /end MEASUREMENT
/begin MEASUREMENT B_nobmflr1 "Es liegen keine Bezugsmarkenverluste vor" UWORD B_TRUE 1 100 0 1 BIT_MASK 0x4 FORMAT "%13.11" ECU_ADDRESS 0xFD2A /end MEASUREMENT
/begin MEASUREMENT B_nobmflr2 "Bezugsmarke wurde im Start richtig erkannt" UWORD B_TRUE 1 100 0 1 BIT_MASK 0x8 FORMAT "%13.11" ECU_ADDRESS 0xFD2A /end MEASUREMENT
/begin MEASUREMENT B_nocorflr "Es wurden keine Zahnkorrekturen vorgenommen" UWORD B_TRUE 1 100 0 1 BIT_MASK 0x10 FORMAT "%13.11" ECU_ADDRESS 0xFD2A /end MEASUREMENT
/begin MEASUREMENT B_npaav "Fehlertyp 'unplausibles Prüfresultat' erkannt (AAV verstopft)" UWORD B_TRUE 1 100 0 1 BIT_MASK 0x800 FORMAT "%13.11" ECU_ADDRESS 0x38390C /end MEASUREMENT
/begin MEASUREMENT B_npcair "Fehlertyp : Airbag-Botschaft" UWORD B_TRUE 1 100 0 1 BIT_MASK 0x800 FORMAT "%13.11" ECU_ADDRESS 0x383928 /end MEASUREMENT
/begin MEASUREMENT B_npcas "Fehlertyp: CAN-Schnittstelle, Timeout ASC" UWORD B_TRUE 1 100 0 1 BIT_MASK 0x800 FORMAT "%13.11" ECU_ADDRESS 0x38392C /end MEASUREMENT
/begin MEASUREMENT B_npcat "Fehlertyp: CAN-Schnittstelle Timeout ASR" UWORD B_TRUE 1 100 0 1 BIT_MASK 0x800 FORMAT "%13.11" ECU_ADDRESS 0x38392E /end MEASUREMENT
/begin MEASUREMENT B_npcge "Fehlerart:CAN-Schnittstelle, Timeout EGS" UWORD B_TRUE 1 100 0 1 BIT_MASK 0x800 FORMAT "%13.11" ECU_ADDRESS 0x383930 /end MEASUREMENT
/begin MEASUREMENT B_npcgra "Fehlertyp : unplausibles Signal in der GRA-Botschaft" UWORD B_TRUE 1 100 0 1 BIT_MASK 0x800 FORMAT "%13.11" ECU_ADDRESS 0x383932 /end MEASUREMENT
/begin MEASUREMENT B_npcif "Fehlertyp: nicht plausibles Signal vom CAN (bus-off)" UWORD B_TRUE 1 100 0 1 BIT_MASK 0x800 FORMAT "%13.11" ECU_ADDRESS 0x383934 /end MEASUREMENT
/begin MEASUREMENT B_npcins "Fehlerart:CAN-Schnittstelle, Timeout Instrument" UWORD B_TRUE 1 100 0 1 BIT_MASK 0x800 FORMAT "%13.11" ECU_ADDRESS 0x383936 /end MEASUREMENT
/begin MEASUREMENT B_npckla "Bedingung Plausibilitätsfehler der Clima-CAN-Botschaft" UWORD B_TRUE 1 100 0 1 BIT_MASK 0x800 FORMAT "%13.11" ECU_ADDRESS 0x383938 /end MEASUREMENT
/begin MEASUREMENT B_npswe "Beschleunigungssensorsignal ist nicht plausibel" UWORD B_TRUE 1 100 0 1 BIT_MASK 0x800 FORMAT "%13.11" ECU_ADDRESS 0x3839F6 /end MEASUREMENT
/begin MEASUREMENT B_nuair "Bedingung Nachrichtenunterbrechung Airbag-Botschaft" UWORD B_TRUE 1 100 0 1 BIT_MASK 0x4 FORMAT "%13.11" ECU_ADDRESS 0xFD16 /end MEASUREMENT
/begin MEASUREMENT B_nukla "Bedingung Nachrichtenunterbrechung Klima-Botschaft" UWORD B_TRUE 1 100 0 1 BIT_MASK 0x8 FORMAT "%13.11" ECU_ADDRESS 0xFD16 /end MEASUREMENT
/begin MEASUREMENT B_pbkvmn "Bedingung Bremskraftverstärker-Druck minimieren" UBYTE B_TRUE 1 100 0 1 BIT_MASK 0x1 FORMAT "%13.11" ECU_ADDRESS 0x380BEE /end MEASUREMENT
/begin MEASUREMENT B_pbkvmnp "Bedingung: Bremskraftverstärkerdruck durch BKV-Pumpe minimieren" UBYTE B_TRUE 1 100 0 1 BIT_MASK 0x8 FORMAT "%13.11" ECU_ADDRESS 0x380BEE /end MEASUREMENT
/begin MEASUREMENT B_pdcva "Prüfbit" UBYTE B_TRUE 1 100 0 1 BIT_MASK 0x1 FORMAT "%13.11" ECU_ADDRESS 0x380949 /end MEASUREMENT
/begin MEASUREMENT B_pdcvaa "Bedingung: Teilfunktion DCVMBX erfüllt" UBYTE B_TRUE 1 100 0 1 BIT_MASK 0x8 FORMAT "%13.11" ECU_ADDRESS 0x38094A /end MEASUREMENT
/begin MEASUREMENT B_pdcvb "Prüfbit" UBYTE B_TRUE 1 100 0 1 BIT_MASK 0x2 FORMAT "%13.11" ECU_ADDRESS 0x380949 /end MEASUREMENT
/begin MEASUREMENT B_pdcvc "Prüfbit" UBYTE B_TRUE 1 100 0 1 BIT_MASK 0x4 FORMAT "%13.11" ECU_ADDRESS 0x380949 /end MEASUREMENT
/begin MEASUREMENT B_pdcvf "Prüfbit" UBYTE B_TRUE 1 100 0 1 BIT_MASK 0x8 FORMAT "%13.11" ECU_ADDRESS 0x380949 /end MEASUREMENT
/begin MEASUREMENT B_pdcvg "Prüfbit" UBYTE B_TRUE 1 100 0 1 BIT_MASK 0x10 FORMAT "%13.11" ECU_ADDRESS 0x380949 /end MEASUREMENT
/begin MEASUREMENT B_pdcvh "Prüfbit" UBYTE B_TRUE 1 100 0 1 BIT_MASK 0x20 FORMAT "%13.11" ECU_ADDRESS 0x380949 /end MEASUREMENT
/begin MEASUREMENT B_pdcvi "Prüfbit" UBYTE B_TRUE 1 100 0 1 BIT_MASK 0x1 FORMAT "%13.11" ECU_ADDRESS 0x38094A /end MEASUREMENT
/begin MEASUREMENT B_pdcvj "Prüfbit" UBYTE B_TRUE 1 100 0 1 BIT_MASK 0x2 FORMAT "%13.11" ECU_ADDRESS 0x38094A /end MEASUREMENT
/begin MEASUREMENT B_pdcvk "Prüfbit" UBYTE B_TRUE 1 100 0 1 BIT_MASK 0x4 FORMAT "%13.11" ECU_ADDRESS 0x38094A /end MEASUREMENT
/begin MEASUREMENT B_pdcvo "Prüfbit" UBYTE B_TRUE 1 100 0 1 BIT_MASK 0x20 FORMAT "%13.11" ECU_ADDRESS 0x38094A /end MEASUREMENT
/begin MEASUREMENT B_pdcvp "Prüfbit" UBYTE B_TRUE 1 100 0 1 BIT_MASK 0x40 FORMAT "%13.11" ECU_ADDRESS 0x38094A /end MEASUREMENT
/begin MEASUREMENT B_pwfast "Bedingung Powerfail lag einmalig an, bis zum nächsten Motorstart" UBYTE B_TRUE 1 100 0 1 BIT_MASK 0x1 FORMAT "%13.11" ECU_ADDRESS 0x383138 /end MEASUREMENT
/begin MEASUREMENT B_pycair "" UWORD B_TRUE 1 100 0 1 BIT_MASK 0x2000 FORMAT "%13.11" ECU_ADDRESS 0x383928 /end MEASUREMENT
/begin MEASUREMENT B_pycas "" UWORD B_TRUE 1 100 0 1 BIT_MASK 0x2000 FORMAT "%13.11" ECU_ADDRESS 0x38392C /end MEASUREMENT
/begin MEASUREMENT B_pycat "" UWORD B_TRUE 1 100 0 1 BIT_MASK 0x2000 FORMAT "%13.11" ECU_ADDRESS 0x38392E /end MEASUREMENT
/begin MEASUREMENT B_pycge "" UWORD B_TRUE 1 100 0 1 BIT_MASK 0x2000 FORMAT "%13.11" ECU_ADDRESS 0x383930 /end MEASUREMENT
/begin MEASUREMENT B_pycgra "" UWORD B_TRUE 1 100 0 1 BIT_MASK 0x2000 FORMAT "%13.11" ECU_ADDRESS 0x383932 /end MEASUREMENT
/begin MEASUREMENT B_pycif "" UWORD B_TRUE 1 100 0 1 BIT_MASK 0x2000 FORMAT "%13.11" ECU_ADDRESS 0x383934 /end MEASUREMENT
/begin MEASUREMENT B_pycins "" UWORD B_TRUE 1 100 0 1 BIT_MASK 0x2000 FORMAT "%13.11" ECU_ADDRESS 0x383936 /end MEASUREMENT
/begin MEASUREMENT B_pyckla "" UWORD B_TRUE 1 100 0 1 BIT_MASK 0x2000 FORMAT "%13.11" ECU_ADDRESS 0x383938 /end MEASUREMENT
/begin MEASUREMENT B_rdbkvp "Bedingung: Rücksetzen der Diagnose BKV-Pumpe" UBYTE B_TRUE 1 100 0 1 BIT_MASK 0x2 FORMAT "%13.11" ECU_ADDRESS 0x384932 /end MEASUREMENT
/begin MEASUREMENT B_rdbkvpps "Bedingung: Rücksetzen der Diagnose BKV-Pumpe, da ps BKV evakuiert" UBYTE B_TRUE 1 100 0 1 BIT_MASK 0x8 FORMAT "%13.11" ECU_ADDRESS 0x384932 /end MEASUREMENT
/begin MEASUREMENT B_resmode "Anforderung aus DAAV Reset LDP-Schaltmodus" UBYTE B_TRUE 1 100 0 1 BIT_MASK 0x4 FORMAT "%13.11" ECU_ADDRESS 0x380A08 /end MEASUREMENT
/begin MEASUREMENT B_rkacka "Bedingung Überwachung Reedkontakt auf aktiv" UBYTE B_TRUE 1 100 0 1 BIT_MASK 0x8 FORMAT "%13.11" ECU_ADDRESS 0x380A0A /end MEASUREMENT
/begin MEASUREMENT B_rkzcka "Bedingung Überwachung Reedkontakt zu aktiv" UBYTE B_TRUE 1 100 0 1 BIT_MASK 0x10 FORMAT "%13.11" ECU_ADDRESS 0x380A0A /end MEASUREMENT
/begin MEASUREMENT B_rtdbkvl "Bedingung: Rücksetzen der Leckagediagnose des BKV" UBYTE B_TRUE 1 100 0 1 BIT_MASK 0x10 FORMAT "%13.11" ECU_ADDRESS 0x384933 /end MEASUREMENT
/begin MEASUREMENT B_rtdbkvp "Bedingung: Reset getriggert von Diagnose BKV-Pumpe" UBYTE B_TRUE 1 100 0 1 BIT_MASK 0x4 FORMAT "%13.11" ECU_ADDRESS 0x384932 /end MEASUREMENT
/begin MEASUREMENT B_sacc "Bedingung Klima-Anforderung aktiv aus CAN-Botschaft Clima1" UWORD B_TRUE 1 100 0 1 BIT_MASK 0x10 FORMAT "%13.11" ECU_ADDRESS 0xFD16 /end MEASUREMENT
/begin MEASUREMENT B_sacvt "Bedingung Schubabschaltunterstützung für CVT-Getriebe" UWORD B_TRUE 1 100 0 1 BIT_MASK 0x20 FORMAT "%13.11" ECU_ADDRESS 0xFD16 /end MEASUREMENT
/begin MEASUREMENT B_sccair "" UWORD B_TRUE 1 100 0 1 BIT_MASK 0x4000 FORMAT "%13.11" ECU_ADDRESS 0x383928 /end MEASUREMENT
/begin MEASUREMENT B_sccas "" UWORD B_TRUE 1 100 0 1 BIT_MASK 0x4000 FORMAT "%13.11" ECU_ADDRESS 0x38392C /end MEASUREMENT
/begin MEASUREMENT B_sccat "" UWORD B_TRUE 1 100 0 1 BIT_MASK 0x4000 FORMAT "%13.11" ECU_ADDRESS 0x38392E /end MEASUREMENT
/begin MEASUREMENT B_sccge "" UWORD B_TRUE 1 100 0 1 BIT_MASK 0x4000 FORMAT "%13.11" ECU_ADDRESS 0x383930 /end MEASUREMENT
/begin MEASUREMENT B_sccgra "" UWORD B_TRUE 1 100 0 1 BIT_MASK 0x4000 FORMAT "%13.11" ECU_ADDRESS 0x383932 /end MEASUREMENT
/begin MEASUREMENT B_sccif "" UWORD B_TRUE 1 100 0 1 BIT_MASK 0x4000 FORMAT "%13.11" ECU_ADDRESS 0x383934 /end MEASUREMENT
/begin MEASUREMENT B_sccins "" UWORD B_TRUE 1 100 0 1 BIT_MASK 0x4000 FORMAT "%13.11" ECU_ADDRESS 0x383936 /end MEASUREMENT
/begin MEASUREMENT B_scckla "" UWORD B_TRUE 1 100 0 1 BIT_MASK 0x4000 FORMAT "%13.11" ECU_ADDRESS 0x383938 /end MEASUREMENT
/begin MEASUREMENT B_setmnbm "Bedingung für B_MNBM=1 wird erfüllt" UBYTE B_TRUE 1 100 0 1 BIT_MASK 0x2 FORMAT "%13.11" ECU_ADDRESS 0x380966 /end MEASUREMENT
/begin MEASUREMENT B_setmxbm "Bedingung für B_MXBM=1 wird erfüllt" UBYTE B_TRUE 1 100 0 1 BIT_MASK 0x4 FORMAT "%13.11" ECU_ADDRESS 0x380966 /end MEASUREMENT
/begin MEASUREMENT B_setnpbm "Bedingung für B_NPBM=1 wird erfüllt" UBYTE B_TRUE 1 100 0 1 BIT_MASK 0x8 FORMAT "%13.11" ECU_ADDRESS 0x380966 /end MEASUREMENT
/begin MEASUREMENT B_setsibm "Bedingung für B_SIBM=1 wird erfüllt" UBYTE B_TRUE 1 100 0 1 BIT_MASK 0x10 FORMAT "%13.11" ECU_ADDRESS 0x380966 /end MEASUREMENT
/begin MEASUREMENT B_siaav "Fehlerart: AAV verstopft" UWORD B_TRUE 1 100 0 1 BIT_MASK 0x400 FORMAT "%13.11" ECU_ADDRESS 0x38390C /end MEASUREMENT
/begin MEASUREMENT B_sicair "Fehlertyp : Airbag-Botschaft" UWORD B_TRUE 1 100 0 1 BIT_MASK 0x400 FORMAT "%13.11" ECU_ADDRESS 0x383928 /end MEASUREMENT
/begin MEASUREMENT B_sicas "Signalfehler CAN-Timeout ASC-Botschaften" UWORD B_TRUE 1 100 0 1 BIT_MASK 0x400 FORMAT "%13.11" ECU_ADDRESS 0x38392C /end MEASUREMENT
/begin MEASUREMENT B_sicat "Fehlertyp: ASR/MSR Codierfehler" UWORD B_TRUE 1 100 0 1 BIT_MASK 0x400 FORMAT "%13.11" ECU_ADDRESS 0x38392E /end MEASUREMENT
/begin MEASUREMENT B_sicge "Signalfehler CAN-Timeout EGS-Botschaft" UWORD B_TRUE 1 100 0 1 BIT_MASK 0x400 FORMAT "%13.11" ECU_ADDRESS 0x383930 /end MEASUREMENT
/begin MEASUREMENT B_sicgra "Bedingung Signalfehler GRA-Botschaft" UWORD B_TRUE 1 100 0 1 BIT_MASK 0x400 FORMAT "%13.11" ECU_ADDRESS 0x383932 /end MEASUREMENT
/begin MEASUREMENT B_sicif "Signalfehler CAN-Schnittstelle (Bus off)" UWORD B_TRUE 1 100 0 1 BIT_MASK 0x400 FORMAT "%13.11" ECU_ADDRESS 0x383934 /end MEASUREMENT
/begin MEASUREMENT B_sicins "Signalfehler CAN-Timeout Botschaft Kombi-Instruments" UWORD B_TRUE 1 100 0 1 BIT_MASK 0x400 FORMAT "%13.11" ECU_ADDRESS 0x383936 /end MEASUREMENT
/begin MEASUREMENT B_sickla "Fehlertyp sig. : Botschaft Klima" UWORD B_TRUE 1 100 0 1 BIT_MASK 0x400 FORMAT "%13.11" ECU_ADDRESS 0x383938 /end MEASUREMENT
/begin MEASUREMENT B_siswe "Fehlertyp: Geschwindigkeitssignal nicht vorhanden" UWORD B_TRUE 1 100 0 1 BIT_MASK 0x400 FORMAT "%13.11" ECU_ADDRESS 0x3839F6 /end MEASUREMENT
/begin MEASUREMENT B_skoc "Bedingung Kompressoranforderung aktiv aus CAN-Botschaft Clima 1" UWORD B_TRUE 1 100 0 1 BIT_MASK 0x40 FORMAT "%13.11" ECU_ADDRESS 0xFD16 /end MEASUREMENT
/begin MEASUREMENT B_sksc "Bedingung heizb. Heckscheibe eingeschaltet aus CAN-Botschaft Clima1" UWORD B_TRUE 1 100 0 1 BIT_MASK 0x80 FORMAT "%13.11" ECU_ADDRESS 0xFD16 /end MEASUREMENT
/begin MEASUREMENT B_sp3 "Spezial-Bereichs-Trigger der Diagnose Kraftstoffversorgungssystem" UBYTE B_TRUE 1 100 0 1 BIT_MASK 0x1 FORMAT "%13.11" ECU_ADDRESS 0x383104 /end MEASUREMENT
/begin MEASUREMENT B_statbr "Status Bremseneingriff über CAN" UWORD B_TRUE 1 100 0 1 BIT_MASK 0x100 FORMAT "%13.11" ECU_ADDRESS 0xFD16 /end MEASUREMENT
/begin MEASUREMENT B_statge "Status Getriebeeingriff über CAN" UWORD B_TRUE 1 100 0 1 BIT_MASK 0x200 FORMAT "%13.11" ECU_ADDRESS 0xFD16 /end MEASUREMENT
/begin MEASUREMENT B_statgec "Bedingung Getriebestatus für CAN-Ausgabe" UWORD B_TRUE 1 100 0 1 BIT_MASK 0x400 FORMAT "%13.11" ECU_ADDRESS 0xFD16 /end MEASUREMENT
/begin MEASUREMENT B_statmd "Status Momentensignale für CAN" UWORD B_TRUE 1 100 0 1 BIT_MASK 0x800 FORMAT "%13.11" ECU_ADDRESS 0xFD16 /end MEASUREMENT
/begin MEASUREMENT B_statmdc "Bedingung Momentenstatus für CAN-Ausgabe" UWORD B_TRUE 1 100 0 1 BIT_MASK 0x1000 FORMAT "%13.11" ECU_ADDRESS 0xFD16 /end MEASUREMENT
/begin MEASUREMENT B_statme "Bedingung Momenteneingriff ASR/MSR/ESP statisch nicht erfüllbar" UWORD B_TRUE 1 100 0 1 BIT_MASK 0x2000 FORMAT "%13.11" ECU_ADDRESS 0xFD16 /end MEASUREMENT
/begin MEASUREMENT B_statme_t "Bedingung Momentenstatus vom Master für Slave" UWORD B_TRUE 1 100 0 1 BIT_MASK 0x4000 FORMAT "%13.11" ECU_ADDRESS 0xFD16 /end MEASUREMENT
/begin MEASUREMENT B_statnb "Bedingung Normalbetrieb (für CAN-Ausgabe)" UWORD B_TRUE 1 100 0 1 BIT_MASK 0x8000 FORMAT "%13.11" ECU_ADDRESS 0xFD16 /end MEASUREMENT
/begin MEASUREMENT B_statto "Bedingung ASR-Timeout erkannt (für CAN-Ausgabe)" UWORD B_TRUE 1 100 0 1 BIT_MASK 0x1 FORMAT "%13.11" ECU_ADDRESS 0xFD18 /end MEASUREMENT
/begin MEASUREMENT B_stattoc "Status Bremsen-SG für CAN-Ausgabe" UWORD B_TRUE 1 100 0 1 BIT_MASK 0x2 FORMAT "%13.11" ECU_ADDRESS 0xFD18 /end MEASUREMENT
/begin MEASUREMENT B_syserr "Bedingung für mind. 1 Fehler (E_abc) im System erkannt (maskiert)" UBYTE B_TRUE 1 100 0 1 BIT_MASK 0x2 FORMAT "%13.11" ECU_ADDRESS 0x384823 /end MEASUREMENT
/begin MEASUREMENT B_syserrk "Bedingung für mind. 1 Fehler (E_abc) im System erkannt (unmaskiert)" UBYTE B_TRUE 1 100 0 1 BIT_MASK 0x4 FORMAT "%13.11" ECU_ADDRESS 0x384823 /end MEASUREMENT
/begin MEASUREMENT B_tabcan "Fehlerstatus Standzeit" UWORD B_TRUE 1 100 0 1 BIT_MASK 0x4 FORMAT "%13.11" ECU_ADDRESS 0xFD18 /end MEASUREMENT
/begin MEASUREMENT B_talcan "Bedingung Tank leer aus Kombi-Botschaft" UWORD B_TRUE 1 100 0 1 BIT_MASK 0x8 FORMAT "%13.11" ECU_ADDRESS 0xFD18 /end MEASUREMENT
/begin MEASUREMENT B_talkbi "Bedingung Tank leer vom Kombi" UWORD B_TRUE 1 100 0 1 BIT_MASK 0x10 FORMAT "%13.11" ECU_ADDRESS 0xFD18 /end MEASUREMENT
/begin MEASUREMENT B_tdcvmn "Bedingung KGE-Diagnose-Mindestmeßfensterl. f. die Bildung eines Erg. erreicht" UBYTE B_TRUE 1 100 0 1 BIT_MASK 0x40 FORMAT "%13.11" ECU_ADDRESS 0x380948 /end MEASUREMENT
/begin MEASUREMENT B_tdcvmx "Bedingung KGE-Diagnose-Maximale Meßfensterlänge erreicht" UBYTE B_TRUE 1 100 0 1 BIT_MASK 0x80 FORMAT "%13.11" ECU_ADDRESS 0x380948 /end MEASUREMENT
/begin MEASUREMENT B_tepaav "Bedingung Spülphase und prinzipielle Freigabe TEB" UBYTE B_TRUE 1 100 0 1 BIT_MASK 0x10 FORMAT "%13.11" ECU_ADDRESS 0x380A09 /end MEASUREMENT
/begin MEASUREMENT B_tepvb "Bedingung Tankentlüftungsphase verboten" UBYTE B_TRUE 1 100 0 1 BIT_MASK 0x4 FORMAT "%13.11" ECU_ADDRESS 0x38486A /end MEASUREMENT
/begin MEASUREMENT B_tfstok "CAN: Fuellstandssignal Geber 1 okay" UWORD B_TRUE 1 100 0 1 BIT_MASK 0x20 FORMAT "%13.11" ECU_ADDRESS 0xFD18 /end MEASUREMENT
/begin MEASUREMENT B_tim "Zeit-Trigger für Fehlerpfadmanagement" UBYTE B_TRUE 1 100 0 1 BIT_MASK 0x1 FORMAT "%13.11" ECU_ADDRESS 0x380941 /end MEASUREMENT
/begin MEASUREMENT B_tippg "Bedingung Wählhebel in Stellung ""Tippgasse""" UWORD B_TRUE 1 100 0 1 BIT_MASK 0x40 FORMAT "%13.11" ECU_ADDRESS 0xFD18 /end MEASUREMENT
/begin MEASUREMENT B_tmkicb "Bedingung Motortemperatur aus Kombibotschaft auswertbar" UWORD B_TRUE 1 100 0 1 BIT_MASK 0x80 FORMAT "%13.11" ECU_ADDRESS 0xFD18 /end MEASUREMENT
/begin MEASUREMENT B_tnvkhoff "Bedingung Wirkung Katalysatorheizen nicht mehr vorhanden" UBYTE B_TRUE 1 100 0 1 BIT_MASK 0x8 FORMAT "%13.11" ECU_ADDRESS 0x380A5F /end MEASUREMENT
/begin MEASUREMENT B_tnvksma "Bedingung Sensor-Modell-Vergleich aktiv" UBYTE B_TRUE 1 100 0 1 BIT_MASK 0x8 FORMAT "%13.11" ECU_ADDRESS 0x380A60 /end MEASUREMENT
/begin MEASUREMENT B_tnvksmv "Bedingung Sensor-Modell-Vergleich findet statt aufgrund stationär Bedingungen" UBYTE B_TRUE 1 100 0 1 BIT_MASK 0x1 FORMAT "%13.11" ECU_ADDRESS 0x380A5F /end MEASUREMENT
/begin MEASUREMENT B_tnvp "Bedingung: Plausibilitätsfehler" UBYTE B_TRUE 1 100 0 1 BIT_MASK 0x1 FORMAT "%13.11" ECU_ADDRESS 0x380A60 /end MEASUREMENT
/begin MEASUREMENT B_tnvpdmv "Bedingung: passive Diagnose durch Modellvgl. liefert Fehler, nach d. Vorkat." UBYTE B_TRUE 1 100 0 1 BIT_MASK 0x2 FORMAT "%13.11" ECU_ADDRESS 0x380A60 /end MEASUREMENT
/begin MEASUREMENT B_tnvpstd "Bedingung: physikalische Startdiagnose liefert Fehler nach dem Vorkatalysator" UBYTE B_TRUE 1 100 0 1 BIT_MASK 0x4 FORMAT "%13.11" ECU_ADDRESS 0x380A60 /end MEASUREMENT
/begin MEASUREMENT B_tnvzstd "Bedingung: Startdiagnose ist abgelaufen (Zyklusflag) hinter dem Vorkatalysator" UBYTE B_TRUE 1 100 0 1 BIT_MASK 0x2 FORMAT "%13.11" ECU_ADDRESS 0x380A5F /end MEASUREMENT
/begin MEASUREMENT B_tolcb "Bed. Fehlerstatus Öltemperatur aus Kombibotschaft od. aus COWIV abhängig von LH" UWORD B_TRUE 1 100 0 1 BIT_MASK 0x100 FORMAT "%13.11" ECU_ADDRESS 0xFD18 /end MEASUREMENT
/begin MEASUREMENT B_tolueb "Bedingung Öltemperaturschutz" UWORD B_TRUE 1 100 0 1 BIT_MASK 0x200 FORMAT "%13.11" ECU_ADDRESS 0xFD18 /end MEASUREMENT
/begin MEASUREMENT B_tpstaba "Flag Stabilitätskriteriom erfüllt" UBYTE B_TRUE 1 100 0 1 BIT_MASK 0x20 FORMAT "%13.11" ECU_ADDRESS 0x380A09 /end MEASUREMENT
/begin MEASUREMENT B_trip "Flag für erfüllten 'trip'" UBYTE B_TRUE 1 100 0 1 BIT_MASK 0x1 FORMAT "%13.11" ECU_ADDRESS 0x384823 /end MEASUREMENT
/begin MEASUREMENT B_tumcb "Bedingung kein Fehler in CAN-Umgebungstemperaturinformation" UWORD B_TRUE 1 100 0 1 BIT_MASK 0x400 FORMAT "%13.11" ECU_ADDRESS 0xFD18 /end MEASUREMENT
/begin MEASUREMENT B_wk "Bedingung: Wandlerkupplung überbrückt" UWORD B_TRUE 1 100 0 1 BIT_MASK 0x800 FORMAT "%13.11" ECU_ADDRESS 0xFD18 /end MEASUREMENT
/begin MEASUREMENT B_wkauf "Bedingung Wandlerkupplung offen" UWORD B_TRUE 1 100 0 1 BIT_MASK 0x1000 FORMAT "%13.11" ECU_ADDRESS 0xFD18 /end MEASUREMENT
/begin MEASUREMENT B_wkr "Bedingung für Wandlerkupplung geregelt" UWORD B_TRUE 1 100 0 1 BIT_MASK 0x2000 FORMAT "%13.11" ECU_ADDRESS 0xFD18 /end MEASUREMENT
/begin MEASUREMENT B_zbkvtest "Bedingung: Zyklusflag noch nicht gesetzt, daher aktive BKV-Pumpen-Test" UBYTE B_TRUE 1 100 0 1 BIT_MASK 0x1 FORMAT "%13.11" ECU_ADDRESS 0x384931 /end MEASUREMENT
/begin MEASUREMENT B_zcv "Bedingung internes Zyklusflag aus Z_cv gesetzt" UBYTE B_TRUE 1 100 0 1 BIT_MASK 0x2 FORMAT "%13.11" ECU_ADDRESS 0x383114 /end MEASUREMENT
/begin MEASUREMENT B_zdcv "Zyklusflag setzen" UBYTE B_TRUE 1 100 0 1 BIT_MASK 0x10 FORMAT "%13.11" ECU_ADDRESS 0x38094B /end MEASUREMENT
/begin MEASUREMENT B_zdsbkvm "Bedingung: Setzen des Zyklusflags möglich" UBYTE B_TRUE 1 100 0 1 BIT_MASK 0x20 FORMAT "%13.11" ECU_ADDRESS 0x384933 /end MEASUREMENT
/begin MEASUREMENT B_zges "Bedingung Zwischengasanforderung vom Getriebe-SG" UWORD B_TRUE 1 100 0 1 BIT_MASK 0x4000 FORMAT "%13.11" ECU_ADDRESS 0xFD18 /end MEASUREMENT
/begin MEASUREMENT B_zhfmfe "Bedingung: Fehler HFM aus DEGFE gültig" UBYTE B_TRUE 1 100 0 1 BIT_MASK 0x2 FORMAT "%13.11" ECU_ADDRESS 0x38486A /end MEASUREMENT
/begin MEASUREMENT can_nv_bits "" UBYTE dez 1 100 0 255 FORMAT "%5.1" ECU_ADDRESS 0x38304D /end MEASUREMENT
/begin MEASUREMENT countoe_w "Kenngröße frmulti im niO Bereich f. Leckageerkennung nach DK" UWORD t100msxs_uw_b6553p6 1 100 0 6553.5 FORMAT "%8.3" ECU_ADDRESS 0x3849EC /end MEASUREMENT
/begin MEASUREMENT countoz_w "Kenngröße frmulti im niO Bereich f. Leckageerkennung vor DK" UWORD t100msxs_uw_b6553p6 1 100 0 6553.5 FORMAT "%8.3" ECU_ADDRESS 0x3849EE /end MEASUREMENT
/begin MEASUREMENT countue_w "Kenngröße frmulti im iO Bereich f. Leckageerkennung nach DK" UWORD t100msxs_uw_b6553p6 1 100 0 6553.5 FORMAT "%8.3" ECU_ADDRESS 0x3849F0 /end MEASUREMENT
/begin MEASUREMENT countuz_w "Kenngröße frmulti im iO Bereich f. Leckageerkennung vor DK" UWORD t100msxs_uw_b6553p6 1 100 0 6553.5 FORMAT "%8.3" ECU_ADDRESS 0x3849F2 /end MEASUREMENT
/begin MEASUREMENT cs_air "Checksumme in der Botschaft Airbag" UBYTE DEZ 1 100 0 255 FORMAT "%5.1" ECU_ADDRESS 0x3808BE /end MEASUREMENT
/begin MEASUREMENT cs_mot6 "Checksumme Motor6" UBYTE DEZ 1 100 0 255 FORMAT "%5.1" ECU_ADDRESS 0x3808BF /end MEASUREMENT
/begin MEASUREMENT ctrerf1 "Zähler für Anzahl  Fehlerflags E_dfp = 1 im System seit powerfail (gefiltert)" UBYTE dez 1 100 0 255 FORMAT "%5.1" ECU_ADDRESS 0x384824 /end MEASUREMENT
/begin MEASUREMENT ctrerfk1 "Zähler für Anzahl  Fehlerflags E_dfp = 1 im System seit powerfail (ungefiltert)" UBYTE dez 1 100 0 255 FORMAT "%5.1" ECU_ADDRESS 0x384825 /end MEASUREMENT
/begin MEASUREMENT ctrrdy1 "Zähler für Anzahl geprüfter Fehlerpfade im System seit powerfail" UBYTE dez 1 100 0 255 FORMAT "%5.1" ECU_ADDRESS 0x384826 /end MEASUREMENT
/begin MEASUREMENT ctrsfp "Zähler für Anzahl Fehlerpfade im System" UBYTE dez 1 100 0 255 FORMAT "%5.1" ECU_ADDRESS 0x384827 /end MEASUREMENT
/begin MEASUREMENT ctrzyf0 "Zähler für Anzahl ungeprüfter Fehlerpfade im System seit Start" UBYTE dez 1 100 0 255 FORMAT "%5.1" ECU_ADDRESS 0x384828 /end MEASUREMENT
/begin MEASUREMENT ctrzyf1 "Zähler für Anzahl geprüfter Fehlerpfade im System seit Start" UBYTE dez 1 100 0 255 FORMAT "%5.1" ECU_ADDRESS 0x384829 /end MEASUREMENT
/begin MEASUREMENT daavLokBits1 "" UBYTE dez 1 100 0 255 FORMAT "%5.1" ECU_ADDRESS 0x380A09 /end MEASUREMENT
/begin MEASUREMENT daavLokBits2 "" UBYTE dez 1 100 0 255 FORMAT "%5.1" ECU_ADDRESS 0x380A0A /end MEASUREMENT
/begin MEASUREMENT dbkvpelokbits "" UBYTE dez 1 100 0 255 FORMAT "%5.1" ECU_ADDRESS 0x380BF0 /end MEASUREMENT
/begin MEASUREMENT dcounte_w "Zeitdifferenz f. Leckageerkennung nach DK" SWORD t100msxs_sw_b3276p8 1 100 -3276.8 3276.7 FORMAT "%8.3" ECU_ADDRESS 0x3849F4 /end MEASUREMENT
/begin MEASUREMENT dcountz_w "Zeitdifferenz f. Leckageerkennung vor DK" SWORD t100msxs_sw_b3276p8 1 100 -3276.8 3276.7 FORMAT "%8.3" ECU_ADDRESS 0x3849F6 /end MEASUREMENT
/begin MEASUREMENT dcycnt "Driving cycle - counter" UWORD dez 1 100 0 65535 FORMAT "%8.2" ECU_ADDRESS 0x384020 /end MEASUREMENT
/begin MEASUREMENT DEGFEausbits "" UBYTE dez 1 100 0 255 FORMAT "%5.1" ECU_ADDRESS 0x38486A /end MEASUREMENT
/begin MEASUREMENT dfcmFcm "" UBYTE dez 1 100 0 255 FORMAT "%5.1" ECU_ADDRESS 0x383105 /end MEASUREMENT
/begin MEASUREMENT dfcmNo "" UBYTE dez 1 100 0 255 FORMAT "%5.1" ECU_ADDRESS 0x383106 /end MEASUREMENT
/begin MEASUREMENT dfcmSfp "" UBYTE dez 1 100 0 255 FORMAT "%5.1" ECU_ADDRESS 0x383107 /end MEASUREMENT
/begin MEASUREMENT dfpmEpclState "" UWORD dez 1 100 0 65535 FORMAT "%8.2" ECU_ADDRESS 0x38365E /end MEASUREMENT
/begin MEASUREMENT dfpmMilState "" UWORD dez 1 100 0 65535 FORMAT "%8.2" ECU_ADDRESS 0x38365F /end MEASUREMENT
/begin MEASUREMENT dfp_ap "aktueller Fehler für Dauerlaufmessung" UBYTE dez 1 100 0 255 FORMAT "%5.1" ECU_ADDRESS 0x383108 /end MEASUREMENT
/begin MEASUREMENT dleatr "Schwelle Delta Lambda für Erkennung Fehler Abgastemperaturregelung" SBYTE fak_sb_b1 1 100 -1 0.992188 FORMAT "%5.3" ECU_ADDRESS 0x384892 /end MEASUREMENT
/begin MEASUREMENT dlws_w "Lenkwinkelgeschwindigkeit  über CAN" SWORD dlw_sw_q0p04375 1 100 -1434.04 1434 FORMAT "%8.3" ECU_ADDRESS 0x380E78 /end MEASUREMENT
/begin MEASUREMENT dmsndko_w "Änderung von msndko (normierter Leckluftmassenstrom über DK) seit Start" SWORD m_sw_b3276p8 1 100 -3276.8 3276.7 FORMAT "%8.3" ECU_ADDRESS 0x3849F8 /end MEASUREMENT
/begin MEASUREMENT dnmcan "Drehzahlgradient für CAN-Ausgabe" UBYTE dez 1 100 0 255 FORMAT "%5.1" ECU_ADDRESS 0x3808C0 /end MEASUREMENT
/begin MEASUREMENT dpbkvae_w "Differenz des Drucks bei nichtbetätigter Bremse" SWORD p_sw_q0p039 1 100 -1280 1279.96 FORMAT "%8.3" ECU_ADDRESS 0x385422 /end MEASUREMENT
/begin MEASUREMENT dpbkvpa_w "Druckdelta zw.  aktuellem  BKV-Druck und BKV-Druck beim Einschalten der Pumpe" UWORD p_uw_q0p039 1 100 0 2559.96 FORMAT "%8.3" ECU_ADDRESS 0x385418 /end MEASUREMENT
/begin MEASUREMENT dpbkvukb_w "min. zulässige Druckdif. zwischen BKV-Druck und pu mit Betätigung der Bremse" UWORD p_uw_q0p039 1 100 0 2559.96 FORMAT "%8.3" ECU_ADDRESS 0x382CC0 /end MEASUREMENT
/begin MEASUREMENT dpbkvukk_w "min. zulässige Druckdif. zwischen BKV-Druck und pu für Abschaltung Klimakom." UWORD p_uw_q0p039 1 100 0 2559.96 FORMAT "%8.3" ECU_ADDRESS 0x382CC2 /end MEASUREMENT
/begin MEASUREMENT dpbkvukp_w "min. zulässige Druckdif. zw. pbkv  und pu für Ansteuerung BKV-Pumpe" UWORD p_uw_q0p039 1 100 0 2559.96 FORMAT "%8.3" ECU_ADDRESS 0x382CC4 /end MEASUREMENT
/begin MEASUREMENT dpbkvukr_w "min. zulässige Druckdif. zwischen BKV-Druck und Umgebungsdruck" UWORD p_uw_q0p039 1 100 0 2559.96 FORMAT "%8.3" ECU_ADDRESS 0x382CC6 /end MEASUREMENT
/begin MEASUREMENT dpbkvuk_w "min. zulässige Druckdif. zwischen BKV-Druck und pu ohne Betätigung der Bremse" UWORD p_uw_q0p039 1 100 0 2559.96 FORMAT "%8.3" ECU_ADDRESS 0x382CC8 /end MEASUREMENT
/begin MEASUREMENT dpbkvunw_w "min. zul. Druckdif. zw. pbkv und pu für NW-Umschaltung" UWORD p_uw_q0p039 1 100 0 2559.96 FORMAT "%8.3" ECU_ADDRESS 0x382CCA /end MEASUREMENT
/begin MEASUREMENT dpbukkb_w "min. zul. Druckdif. zw. pbkv und pu für Absch. Klimakom. beim Bremsen" UWORD p_uw_q0p039 1 100 0 2559.96 FORMAT "%8.3" ECU_ADDRESS 0x382CCC /end MEASUREMENT
/begin MEASUREMENT dpbukk_w "min. zul. Druckdif. zw. pbkv und pu für Absch. Klimakom. ohne zu Bremsen" UWORD p_uw_q0p039 1 100 0 2559.96 FORMAT "%8.3" ECU_ADDRESS 0x382CCE /end MEASUREMENT
/begin MEASUREMENT dpbuknwb_w "min. zul. Druckdif. zw. pbkv und pu für NW-Umschaltung beim Bremsen" UWORD p_uw_q0p039 1 100 0 2559.96 FORMAT "%8.3" ECU_ADDRESS 0x382CD0 /end MEASUREMENT
/begin MEASUREMENT dpbuknw_w "min. zul. Druckdif. zw. pbkv und pu für NW-Umschaltung ohne zu Bremsen" UWORD p_uw_q0p039 1 100 0 2559.96 FORMAT "%8.3" ECU_ADDRESS 0x382CD2 /end MEASUREMENT
/begin MEASUREMENT dpbukpb_w "min. zulässige Druckdif. zw. pbkv  und pu für Ansteuerung BKV-Pumpe mit Bremsen" UWORD p_uw_q0p039 1 100 0 2559.96 FORMAT "%8.3" ECU_ADDRESS 0x382CD4 /end MEASUREMENT
/begin MEASUREMENT dpbukp_w "min. zulässige Druckdif. zw. pbkv  und pu für Ansteuerung BKV-Pumpe ohne Bremsen" UWORD p_uw_q0p039 1 100 0 2559.96 FORMAT "%8.3" ECU_ADDRESS 0x382CD6 /end MEASUREMENT
/begin MEASUREMENT dpua_w "Druckdifferenz Umgebungsdruck - Saugrohrdruck" SWORD p_uw_q0p078 1 100 -2560 2559.92 FORMAT "%8.3" ECU_ADDRESS 0x381DE2 /end MEASUREMENT
/begin MEASUREMENT E_aav "Errorflag: Absperrventil Aktivkohlefilter (Funktion)" UWORD B_TRUE 1 100 0 1 BIT_MASK 0x1 FORMAT "%13.11" ECU_ADDRESS 0x38390C /end MEASUREMENT
/begin MEASUREMENT E_cair "Fehlerflag : Timeout Airbag-Botschaft" UWORD B_TRUE 1 100 0 1 BIT_MASK 0x1 FORMAT "%13.11" ECU_ADDRESS 0x383928 /end MEASUREMENT
/begin MEASUREMENT E_cas "Errorflag: CAN-Schnittstelle, Timeout ASC" UWORD B_TRUE 1 100 0 1 BIT_MASK 0x1 FORMAT "%13.11" ECU_ADDRESS 0x38392C /end MEASUREMENT
/begin MEASUREMENT E_cat "Errorflag: CAN-Schnittstelle, Timeout Bremsbotschaft setzen" UWORD B_TRUE 1 100 0 1 BIT_MASK 0x1 FORMAT "%13.11" ECU_ADDRESS 0x38392E /end MEASUREMENT
/begin MEASUREMENT E_cge "Errorflag: CAN-Schnittstelle, Timeout EGS" UWORD B_TRUE 1 100 0 1 BIT_MASK 0x1 FORMAT "%13.11" ECU_ADDRESS 0x383930 /end MEASUREMENT
/begin MEASUREMENT E_cgra "Errorflag : Timeout GRA-Botschaft" UWORD B_TRUE 1 100 0 1 BIT_MASK 0x1 FORMAT "%13.11" ECU_ADDRESS 0x383932 /end MEASUREMENT
/begin MEASUREMENT E_cif "Errorflag: CAN-Schnittstelle, interner Fehler" UWORD B_TRUE 1 100 0 1 BIT_MASK 0x1 FORMAT "%13.11" ECU_ADDRESS 0x383934 /end MEASUREMENT
/begin MEASUREMENT E_cins "Errorflag: CAN-Schnittstelle, Timeout Instrument" UWORD B_TRUE 1 100 0 1 BIT_MASK 0x1 FORMAT "%13.11" ECU_ADDRESS 0x383936 /end MEASUREMENT
/begin MEASUREMENT E_ckla "Errorflag: CAN-Kommunikation zum KLA-SG gestört" UWORD B_TRUE 1 100 0 1 BIT_MASK 0x1 FORMAT "%13.11" ECU_ADDRESS 0x383938 /end MEASUREMENT
/begin MEASUREMENT E_swe "Errorflag: Beschleunigungssensor der Schlechtwegeerkennung" UWORD B_TRUE 1 100 0 1 BIT_MASK 0x1 FORMAT "%13.11" ECU_ADDRESS 0x3839F6 /end MEASUREMENT
/begin MEASUREMENT fcmcla_0_A "" UBYTE default 1 100 0 255 FORMAT "%5.1" ECU_ADDRESS 0x383665 /end MEASUREMENT
/begin MEASUREMENT fcmcla_1_A "" UBYTE default 1 100 0 255 FORMAT "%5.1" ECU_ADDRESS 0x383687 /end MEASUREMENT
/begin MEASUREMENT fcmcla_2_A "" UBYTE default 1 100 0 255 FORMAT "%5.1" ECU_ADDRESS 0x3836A9 /end MEASUREMENT
/begin MEASUREMENT fcmcla_3_A "" UBYTE default 1 100 0 255 FORMAT "%5.1" ECU_ADDRESS 0x3836CB /end MEASUREMENT
/begin MEASUREMENT fcmcla_4_A "" UBYTE default 1 100 0 255 FORMAT "%5.1" ECU_ADDRESS 0x3836ED /end MEASUREMENT
/begin MEASUREMENT fcmdfp_0_A "" UBYTE default 1 100 0 255 FORMAT "%5.1" ECU_ADDRESS 0x383660 /end MEASUREMENT
/begin MEASUREMENT fcmdfp_1_A "" UBYTE default 1 100 0 255 FORMAT "%5.1" ECU_ADDRESS 0x383682 /end MEASUREMENT
/begin MEASUREMENT fcmdfp_2_A "" UBYTE default 1 100 0 255 FORMAT "%5.1" ECU_ADDRESS 0x3836A4 /end MEASUREMENT
/begin MEASUREMENT fcmdfp_3_A "" UBYTE default 1 100 0 255 FORMAT "%5.1" ECU_ADDRESS 0x3836C6 /end MEASUREMENT
/begin MEASUREMENT fcmdfp_4_A "" UBYTE default 1 100 0 255 FORMAT "%5.1" ECU_ADDRESS 0x3836E8 /end MEASUREMENT
/begin MEASUREMENT fcmdlc_0_A "" UBYTE default 1 100 0 255 FORMAT "%5.1" ECU_ADDRESS 0x383668 /end MEASUREMENT
/begin MEASUREMENT fcmdlc_1_A "" UBYTE default 1 100 0 255 FORMAT "%5.1" ECU_ADDRESS 0x38368A /end MEASUREMENT
/begin MEASUREMENT fcmdlc_2_A "" UBYTE default 1 100 0 255 FORMAT "%5.1" ECU_ADDRESS 0x3836AC /end MEASUREMENT
/begin MEASUREMENT fcmdlc_3_A "" UBYTE default 1 100 0 255 FORMAT "%5.1" ECU_ADDRESS 0x3836CE /end MEASUREMENT
/begin MEASUREMENT fcmdlc_4_A "" UBYTE default 1 100 0 255 FORMAT "%5.1" ECU_ADDRESS 0x3836F0 /end MEASUREMENT
/begin MEASUREMENT fcmEnd "Anzahl Einträge im Fehlerspeicher" UBYTE dez 1 100 0 255 FORMAT "%5.1" ECU_ADDRESS 0x383109 /end MEASUREMENT
/begin MEASUREMENT fcmfes_0_A "" UBYTE default 1 100 0 255 FORMAT "%5.1" ECU_ADDRESS 0x383664 /end MEASUREMENT
/begin MEASUREMENT fcmfes_1_A "" UBYTE default 1 100 0 255 FORMAT "%5.1" ECU_ADDRESS 0x383686 /end MEASUREMENT
/begin MEASUREMENT fcmfes_2_A "" UBYTE default 1 100 0 255 FORMAT "%5.1" ECU_ADDRESS 0x3836A8 /end MEASUREMENT
/begin MEASUREMENT fcmfes_3_A "" UBYTE default 1 100 0 255 FORMAT "%5.1" ECU_ADDRESS 0x3836CA /end MEASUREMENT
/begin MEASUREMENT fcmfes_4_A "" UBYTE default 1 100 0 255 FORMAT "%5.1" ECU_ADDRESS 0x3836EC /end MEASUREMENT
/begin MEASUREMENT fcmflc_0_A "" UBYTE default 1 100 0 255 FORMAT "%5.1" ECU_ADDRESS 0x383666 /end MEASUREMENT
/begin MEASUREMENT fcmflc_1_A "" UBYTE default 1 100 0 255 FORMAT "%5.1" ECU_ADDRESS 0x383688 /end MEASUREMENT
/begin MEASUREMENT fcmflc_2_A "" UBYTE default 1 100 0 255 FORMAT "%5.1" ECU_ADDRESS 0x3836AA /end MEASUREMENT
/begin MEASUREMENT fcmflc_3_A "" UBYTE default 1 100 0 255 FORMAT "%5.1" ECU_ADDRESS 0x3836CC /end MEASUREMENT
/begin MEASUREMENT fcmflc_4_A "" UBYTE default 1 100 0 255 FORMAT "%5.1" ECU_ADDRESS 0x3836EE /end MEASUREMENT
/begin MEASUREMENT fcmfps_0_A "" UBYTE default 1 100 0 255 FORMAT "%5.1" ECU_ADDRESS 0x383662 /end MEASUREMENT
/begin MEASUREMENT fcmfps_1_A "" UBYTE default 1 100 0 255 FORMAT "%5.1" ECU_ADDRESS 0x383684 /end MEASUREMENT
/begin MEASUREMENT fcmfps_2_A "" UBYTE default 1 100 0 255 FORMAT "%5.1" ECU_ADDRESS 0x3836A6 /end MEASUREMENT
/begin MEASUREMENT fcmfps_3_A "" UBYTE default 1 100 0 255 FORMAT "%5.1" ECU_ADDRESS 0x3836C8 /end MEASUREMENT
/begin MEASUREMENT fcmfps_4_A "" UBYTE default 1 100 0 255 FORMAT "%5.1" ECU_ADDRESS 0x3836EA /end MEASUREMENT
/begin MEASUREMENT fcmfrz0_0_A "" UBYTE default 1 100 0 255 FORMAT "%5.1" ECU_ADDRESS 0x383669 /end MEASUREMENT
/begin MEASUREMENT fcmfrz0_1_A "" UBYTE default 1 100 0 255 FORMAT "%5.1" ECU_ADDRESS 0x38368B /end MEASUREMENT
/begin MEASUREMENT fcmfrz0_2_A "" UBYTE default 1 100 0 255 FORMAT "%5.1" ECU_ADDRESS 0x3836AD /end MEASUREMENT
/begin MEASUREMENT fcmfrz0_3_A "" UBYTE default 1 100 0 255 FORMAT "%5.1" ECU_ADDRESS 0x3836CF /end MEASUREMENT
/begin MEASUREMENT fcmfrz0_4_A "" UBYTE default 1 100 0 255 FORMAT "%5.1" ECU_ADDRESS 0x3836F1 /end MEASUREMENT
/begin MEASUREMENT fcmfrz1_0_A "" UBYTE default 1 100 0 255 FORMAT "%5.1" ECU_ADDRESS 0x38366A /end MEASUREMENT
/begin MEASUREMENT fcmfrz1_1_A "" UBYTE default 1 100 0 255 FORMAT "%5.1" ECU_ADDRESS 0x38368C /end MEASUREMENT
/begin MEASUREMENT fcmfrz1_2_A "" UBYTE default 1 100 0 255 FORMAT "%5.1" ECU_ADDRESS 0x3836AE /end MEASUREMENT
/begin MEASUREMENT fcmfrz1_3_A "" UBYTE default 1 100 0 255 FORMAT "%5.1" ECU_ADDRESS 0x3836D0 /end MEASUREMENT
/begin MEASUREMENT fcmfrz1_4_A "" UBYTE default 1 100 0 255 FORMAT "%5.1" ECU_ADDRESS 0x3836F2 /end MEASUREMENT
/begin MEASUREMENT fcmfrz10_0_A "" UBYTE default 1 100 0 255 FORMAT "%5.1" ECU_ADDRESS 0x383673 /end MEASUREMENT
/begin MEASUREMENT fcmfrz10_1_A "" UBYTE default 1 100 0 255 FORMAT "%5.1" ECU_ADDRESS 0x383695 /end MEASUREMENT
/begin MEASUREMENT fcmfrz10_2_A "" UBYTE default 1 100 0 255 FORMAT "%5.1" ECU_ADDRESS 0x3836B7 /end MEASUREMENT
/begin MEASUREMENT fcmfrz10_3_A "" UBYTE default 1 100 0 255 FORMAT "%5.1" ECU_ADDRESS 0x3836D9 /end MEASUREMENT
/begin MEASUREMENT fcmfrz10_4_A "" UBYTE default 1 100 0 255 FORMAT "%5.1" ECU_ADDRESS 0x3836FB /end MEASUREMENT
/begin MEASUREMENT fcmfrz2_0_A "" UBYTE default 1 100 0 255 FORMAT "%5.1" ECU_ADDRESS 0x38366B /end MEASUREMENT
/begin MEASUREMENT fcmfrz2_1_A "" UBYTE default 1 100 0 255 FORMAT "%5.1" ECU_ADDRESS 0x38368D /end MEASUREMENT
/begin MEASUREMENT fcmfrz2_2_A "" UBYTE default 1 100 0 255 FORMAT "%5.1" ECU_ADDRESS 0x3836AF /end MEASUREMENT
/begin MEASUREMENT fcmfrz2_3_A "" UBYTE default 1 100 0 255 FORMAT "%5.1" ECU_ADDRESS 0x3836D1 /end MEASUREMENT
/begin MEASUREMENT fcmfrz2_4_A "" UBYTE default 1 100 0 255 FORMAT "%5.1" ECU_ADDRESS 0x3836F3 /end MEASUREMENT
/begin MEASUREMENT fcmfrz3_0_A "" UBYTE default 1 100 0 255 FORMAT "%5.1" ECU_ADDRESS 0x38366C /end MEASUREMENT
/begin MEASUREMENT fcmfrz3_1_A "" UBYTE default 1 100 0 255 FORMAT "%5.1" ECU_ADDRESS 0x38368E /end MEASUREMENT
/begin MEASUREMENT fcmfrz3_2_A "" UBYTE default 1 100 0 255 FORMAT "%5.1" ECU_ADDRESS 0x3836B0 /end MEASUREMENT
/begin MEASUREMENT fcmfrz3_3_A "" UBYTE default 1 100 0 255 FORMAT "%5.1" ECU_ADDRESS 0x3836D2 /end MEASUREMENT
/begin MEASUREMENT fcmfrz3_4_A "" UBYTE default 1 100 0 255 FORMAT "%5.1" ECU_ADDRESS 0x3836F4 /end MEASUREMENT
/begin MEASUREMENT fcmfrz4_0_A "" UBYTE default 1 100 0 255 FORMAT "%5.1" ECU_ADDRESS 0x38366D /end MEASUREMENT
/begin MEASUREMENT fcmfrz4_1_A "" UBYTE default 1 100 0 255 FORMAT "%5.1" ECU_ADDRESS 0x38368F /end MEASUREMENT
/begin MEASUREMENT fcmfrz4_2_A "" UBYTE default 1 100 0 255 FORMAT "%5.1" ECU_ADDRESS 0x3836B1 /end MEASUREMENT
/begin MEASUREMENT fcmfrz4_3_A "" UBYTE default 1 100 0 255 FORMAT "%5.1" ECU_ADDRESS 0x3836D3 /end MEASUREMENT
/begin MEASUREMENT fcmfrz4_4_A "" UBYTE default 1 100 0 255 FORMAT "%5.1" ECU_ADDRESS 0x3836F5 /end MEASUREMENT
/begin MEASUREMENT fcmfrz5_0_A "" UBYTE default 1 100 0 255 FORMAT "%5.1" ECU_ADDRESS 0x38366E /end MEASUREMENT
/begin MEASUREMENT fcmfrz5_1_A "" UBYTE default 1 100 0 255 FORMAT "%5.1" ECU_ADDRESS 0x383690 /end MEASUREMENT
/begin MEASUREMENT fcmfrz5_2_A "" UBYTE default 1 100 0 255 FORMAT "%5.1" ECU_ADDRESS 0x3836B2 /end MEASUREMENT
/begin MEASUREMENT fcmfrz5_3_A "" UBYTE default 1 100 0 255 FORMAT "%5.1" ECU_ADDRESS 0x3836D4 /end MEASUREMENT
/begin MEASUREMENT fcmfrz5_4_A "" UBYTE default 1 100 0 255 FORMAT "%5.1" ECU_ADDRESS 0x3836F6 /end MEASUREMENT
/begin MEASUREMENT fcmfrz6_0_A "" UBYTE default 1 100 0 255 FORMAT "%5.1" ECU_ADDRESS 0x38366F /end MEASUREMENT
/begin MEASUREMENT fcmfrz6_1_A "" UBYTE default 1 100 0 255 FORMAT "%5.1" ECU_ADDRESS 0x383691 /end MEASUREMENT
/begin MEASUREMENT fcmfrz6_2_A "" UBYTE default 1 100 0 255 FORMAT "%5.1" ECU_ADDRESS 0x3836B3 /end MEASUREMENT
/begin MEASUREMENT fcmfrz6_3_A "" UBYTE default 1 100 0 255 FORMAT "%5.1" ECU_ADDRESS 0x3836D5 /end MEASUREMENT
/begin MEASUREMENT fcmfrz6_4_A "" UBYTE default 1 100 0 255 FORMAT "%5.1" ECU_ADDRESS 0x3836F7 /end MEASUREMENT
/begin MEASUREMENT fcmfrz7_0_A "" UBYTE default 1 100 0 255 FORMAT "%5.1" ECU_ADDRESS 0x383670 /end MEASUREMENT
/begin MEASUREMENT fcmfrz7_1_A "" UBYTE default 1 100 0 255 FORMAT "%5.1" ECU_ADDRESS 0x383692 /end MEASUREMENT
/begin MEASUREMENT fcmfrz7_2_A "" UBYTE default 1 100 0 255 FORMAT "%5.1" ECU_ADDRESS 0x3836B4 /end MEASUREMENT
/begin MEASUREMENT fcmfrz7_3_A "" UBYTE default 1 100 0 255 FORMAT "%5.1" ECU_ADDRESS 0x3836D6 /end MEASUREMENT
/begin MEASUREMENT fcmfrz7_4_A "" UBYTE default 1 100 0 255 FORMAT "%5.1" ECU_ADDRESS 0x3836F8 /end MEASUREMENT
/begin MEASUREMENT fcmfrz8_0_A "" UBYTE default 1 100 0 255 FORMAT "%5.1" ECU_ADDRESS 0x383671 /end MEASUREMENT
/begin MEASUREMENT fcmfrz8_1_A "" UBYTE default 1 100 0 255 FORMAT "%5.1" ECU_ADDRESS 0x383693 /end MEASUREMENT
/begin MEASUREMENT fcmfrz8_2_A "" UBYTE default 1 100 0 255 FORMAT "%5.1" ECU_ADDRESS 0x3836B5 /end MEASUREMENT
/begin MEASUREMENT fcmfrz8_3_A "" UBYTE default 1 100 0 255 FORMAT "%5.1" ECU_ADDRESS 0x3836D7 /end MEASUREMENT
/begin MEASUREMENT fcmfrz8_4_A "" UBYTE default 1 100 0 255 FORMAT "%5.1" ECU_ADDRESS 0x3836F9 /end MEASUREMENT
/begin MEASUREMENT fcmfrz9_0_A "" UBYTE default 1 100 0 255 FORMAT "%5.1" ECU_ADDRESS 0x383672 /end MEASUREMENT
/begin MEASUREMENT fcmfrz9_1_A "" UBYTE default 1 100 0 255 FORMAT "%5.1" ECU_ADDRESS 0x383694 /end MEASUREMENT
/begin MEASUREMENT fcmfrz9_2_A "" UBYTE default 1 100 0 255 FORMAT "%5.1" ECU_ADDRESS 0x3836B6 /end MEASUREMENT
/begin MEASUREMENT fcmfrz9_3_A "" UBYTE default 1 100 0 255 FORMAT "%5.1" ECU_ADDRESS 0x3836D8 /end MEASUREMENT
/begin MEASUREMENT fcmfrz9_4_A "" UBYTE default 1 100 0 255 FORMAT "%5.1" ECU_ADDRESS 0x3836FA /end MEASUREMENT
/begin MEASUREMENT fcmhlc_0_A "" UBYTE default 1 100 0 255 FORMAT "%5.1" ECU_ADDRESS 0x383667 /end MEASUREMENT
/begin MEASUREMENT fcmhlc_1_A "" UBYTE default 1 100 0 255 FORMAT "%5.1" ECU_ADDRESS 0x383689 /end MEASUREMENT
/begin MEASUREMENT fcmhlc_2_A "" UBYTE default 1 100 0 255 FORMAT "%5.1" ECU_ADDRESS 0x3836AB /end MEASUREMENT
/begin MEASUREMENT fcmhlc_3_A "" UBYTE default 1 100 0 255 FORMAT "%5.1" ECU_ADDRESS 0x3836CD /end MEASUREMENT
/begin MEASUREMENT fcmhlc_4_A "" UBYTE default 1 100 0 255 FORMAT "%5.1" ECU_ADDRESS 0x3836EF /end MEASUREMENT
/begin MEASUREMENT fcmhz_0_A "" UBYTE default 1 100 0 255 FORMAT "%5.1" ECU_ADDRESS 0x383680 /end MEASUREMENT
/begin MEASUREMENT fcmhz_1_A "" UBYTE default 1 100 0 255 FORMAT "%5.1" ECU_ADDRESS 0x3836A2 /end MEASUREMENT
/begin MEASUREMENT fcmhz_2_A "" UBYTE default 1 100 0 255 FORMAT "%5.1" ECU_ADDRESS 0x3836C4 /end MEASUREMENT
/begin MEASUREMENT fcmhz_3_A "" UBYTE default 1 100 0 255 FORMAT "%5.1" ECU_ADDRESS 0x3836E6 /end MEASUREMENT
/begin MEASUREMENT fcmhz_4_A "" UBYTE default 1 100 0 255 FORMAT "%5.1" ECU_ADDRESS 0x383708 /end MEASUREMENT
/begin MEASUREMENT FCMTab "" UWORD dez 1 100 0 65535 FORMAT "%8.2" ECU_ADDRESS 0x383660 /end MEASUREMENT
/begin MEASUREMENT fcmtsf_0_A "" UBYTE default 1 100 0 255 FORMAT "%5.1" ECU_ADDRESS 0x383661 /end MEASUREMENT
/begin MEASUREMENT fcmtsf_1_A "" UBYTE default 1 100 0 255 FORMAT "%5.1" ECU_ADDRESS 0x383683 /end MEASUREMENT
/begin MEASUREMENT fcmtsf_2_A "" UBYTE default 1 100 0 255 FORMAT "%5.1" ECU_ADDRESS 0x3836A5 /end MEASUREMENT
/begin MEASUREMENT fcmtsf_3_A "" UBYTE default 1 100 0 255 FORMAT "%5.1" ECU_ADDRESS 0x3836C7 /end MEASUREMENT
/begin MEASUREMENT fcmtsf_4_A "" UBYTE default 1 100 0 255 FORMAT "%5.1" ECU_ADDRESS 0x3836E9 /end MEASUREMENT
/begin MEASUREMENT fcmtyp_0_A "" UBYTE default 1 100 0 255 FORMAT "%5.1" ECU_ADDRESS 0x383663 /end MEASUREMENT
/begin MEASUREMENT fcmtyp_1_A "" UBYTE default 1 100 0 255 FORMAT "%5.1" ECU_ADDRESS 0x383685 /end MEASUREMENT
/begin MEASUREMENT fcmtyp_2_A "" UBYTE default 1 100 0 255 FORMAT "%5.1" ECU_ADDRESS 0x3836A7 /end MEASUREMENT
/begin MEASUREMENT fcmtyp_3_A "" UBYTE default 1 100 0 255 FORMAT "%5.1" ECU_ADDRESS 0x3836C9 /end MEASUREMENT
/begin MEASUREMENT fcmtyp_4_A "" UBYTE default 1 100 0 255 FORMAT "%5.1" ECU_ADDRESS 0x3836EB /end MEASUREMENT
/begin MEASUREMENT flgddg "" UBYTE dez 1 100 0 255 FORMAT "%5.1" ECU_ADDRESS 0x380966 /end MEASUREMENT
/begin MEASUREMENT fmsndko_w "Umrechnung der msndko-Änderung seit Start in eine multplikative Größe" UWORD fak_uw_b4 1 100 0 3.99994 FORMAT "%8.6" ECU_ADDRESS 0x3849FA /end MEASUREMENT
/begin MEASUREMENT fmsndk_w "Umrechnung der msndko-Änderung in eine multiplikative Größe" UWORD fak_uw_b4 1 100 0 3.99994 FORMAT "%8.6" ECU_ADDRESS 0x3849FC /end MEASUREMENT
/begin MEASUREMENT fnswlx_w "Faktor Nachstart und Warmlauf für Kennlinie" UWORD fak_uw_b16 1 100 0 15.9998 FORMAT "%8.5" ECU_ADDRESS 0x3849FE /end MEASUREMENT
/begin MEASUREMENT fppcnta "Zähler Pumpphasen bei Fast Pulse" UBYTE dez 1 100 0 255 FORMAT "%5.1" ECU_ADDRESS 0x380A0B /end MEASUREMENT
/begin MEASUREMENT fr2_u "Lambda-Regler-Ausgang; Bank2 (Byte)" UBYTE fak_ub_b2 1 100 0 1.99219 FORMAT "%5.3" ECU_ADDRESS 0x38094C /end MEASUREMENT
/begin MEASUREMENT fra2_u "multiplikative Gemischkorrektur der Gemischadaption (Byte)" UBYTE fak_ub_b2 1 100 0 1.99219 FORMAT "%5.3" ECU_ADDRESS 0x38094D /end MEASUREMENT
/begin MEASUREMENT fradcv_w "Berücksichtigung von fra in frmulti" UWORD fak_uw_b2 1 100 0 1.99997 FORMAT "%8.6" ECU_ADDRESS 0x384A00 /end MEASUREMENT
/begin MEASUREMENT frakorr_w "" UWORD fak_uw_q0p0001 1 100 0 6.5535 FORMAT "%8.6" ECU_ADDRESS 0x384A02 /end MEASUREMENT
/begin MEASUREMENT frast_w "fra im Start" UWORD fak_uw_b2 1 100 0 1.99997 FORMAT "%8.6" ECU_ADDRESS 0x384022 /end MEASUREMENT
/begin MEASUREMENT fra_u "multiplikative Gemischkorrektur der Gemischadaption (Byte)" UBYTE fak_ub_b2 1 100 0 1.99219 FORMAT "%5.3" ECU_ADDRESS 0x38094E /end MEASUREMENT
/begin MEASUREMENT frkadcv_w "Berücksichtigung von rka in frmulti" UWORD fak_uw_b4 1 100 0 3.99994 FORMAT "%8.6" ECU_ADDRESS 0x384A04 /end MEASUREMENT
/begin MEASUREMENT frkakorr_w "Korrekturwert 2" UWORD fak_uw_q0p0001 1 100 0 6.5535 FORMAT "%8.6" ECU_ADDRESS 0x384A06 /end MEASUREMENT
/begin MEASUREMENT frmulti_w "Kenngröße zur Erkennung einer Leckage" UWORD fak_uw_b4 1 100 0 3.99994 FORMAT "%8.6" ECU_ADDRESS 0x384A08 /end MEASUREMENT
/begin MEASUREMENT fr_u "Lambda-Regler-Ausgang (Byte)" UBYTE fak_ub_b2 1 100 0 1.99219 FORMAT "%5.3" ECU_ADDRESS 0x38094F /end MEASUREMENT
/begin MEASUREMENT fvdaav "" UBYTE dez 1 100 0 255 FORMAT "%5.1" ECU_ADDRESS 0x380A0C /end MEASUREMENT
/begin MEASUREMENT gangauti "bei Automatikgetriebe über CAN empfangener aktueller Gang" UBYTE DEZ 1 100 0 255 FORMAT "%5.1" ECU_ADDRESS 0x3808C1 /end MEASUREMENT
/begin MEASUREMENT gwhpos "Getriebe-Wählhebelposition" UBYTE DEZ 1 100 0 255 FORMAT "%5.1" ECU_ADDRESS 0x3808C2 /end MEASUREMENT
/begin MEASUREMENT imsteaav_w "Luftmassenintegrator zur Freigabe DAAV (word)" UWORD m_uw_b4660 1 100 0 4660.27 FORMAT "%8.3" ECU_ADDRESS 0x381DE4 /end MEASUREMENT
/begin MEASUREMENT kfoelkbi_nmot "" UBYTE nmot_ub_q40 1 100 0 10200 FORMAT "%5.0" ECU_ADDRESS 0x3808C3 /end MEASUREMENT
/begin MEASUREMENT klahc "Angeforderte Kühlleistungsanhebung über CAN" UBYTE DEZ 1 100 0 255 FORMAT "%5.1" ECU_ADDRESS 0x3808C4 /end MEASUREMENT
/begin MEASUREMENT km01tr "Triggersignal vom Kombi (Quantisierung 1km)" UWORD s_q1_km 1 100 0 65535 FORMAT "%8.2" ECU_ADDRESS 0x3849C6 /end MEASUREMENT
/begin MEASUREMENT kmstand_w "Fahrstrecke des Fahrzeugs als Information über CAN" UWORD s_q6_km 1 100 0 393210 FORMAT "%8.1" ECU_ADDRESS 0x3849C8 /end MEASUREMENT
/begin MEASUREMENT lamsonif_w "Lambda-Istwert gefiltert" UWORD fak_uw_b16 1 100 0 15.9998 FORMAT "%8.5" ECU_ADDRESS 0x384A0A /end MEASUREMENT
/begin MEASUREMENT lws_w "Lenkwinkel" SWORD lw_sw_q0p04375 1 100 -1434.04 1434 FORMAT "%8.3" ECU_ADDRESS 0x380E7A /end MEASUREMENT
/begin MEASUREMENT mdgbeg "Momentengradientenbegrenzung durch Getriebe" UBYTE md_ub_q10 1 100 0 2550 FORMAT "%5.0" ECU_ADDRESS 0x3808C5 /end MEASUREMENT
/begin MEASUREMENT mdgrad_w "Momentengradientenbegrenzung durch Getriebe" UWORD rel_uw_b728 1 100 0 9999.85 FORMAT "%4.0" ECU_ADDRESS 0x380E7C /end MEASUREMENT
/begin MEASUREMENT mdverlc "Verlustmoment für CAN-Ausgabe" UBYTE rel_ub_b100 1 100 0 99.6094 FORMAT "%5.2" ECU_ADDRESS 0x3808C6 /end MEASUREMENT
/begin MEASUREMENT mdwancan "Drehmomentaufnahme des Wandlers über CAN" UBYTE rel_ub_b99p6 1 100 0 99.6094 FORMAT "%5.2" ECU_ADDRESS 0x3808C7 /end MEASUREMENT
/begin MEASUREMENT miautgetc "Istmoment für Getriebe (CAN-Ausgabe)" UBYTE rel_ub_b100 1 100 0 99.6094 FORMAT "%5.2" ECU_ADDRESS 0x3808C8 /end MEASUREMENT
/begin MEASUREMENT miautgsc "Sollmoment Für Getriebe (CAN-Ausgbae)" UBYTE rel_ub_b100 1 100 0 99.6094 FORMAT "%5.2" ECU_ADDRESS 0x3808C9 /end MEASUREMENT
/begin MEASUREMENT miges_w "Indiziertes Soll-Motormoment für Getriebeschutz" UWORD rel_uw_b100 1 100 0 99.9985 FORMAT "%8.5" ECU_ADDRESS 0x380E7E /end MEASUREMENT
/begin MEASUREMENT migs_can "Indiziertes Sollmoment für Getriebeeingriff (CAN-Signal)" UBYTE rel_ub_b100 1 100 0 99.6094 FORMAT "%5.2" ECU_ADDRESS 0x3808CA /end MEASUREMENT
/begin MEASUREMENT migs_w "Indiziertes Soll-Motormoment GS für schnellen Eingriff" UWORD rel_uw_b100 1 100 0 99.9985 FORMAT "%8.5" ECU_ADDRESS 0x380E80 /end MEASUREMENT
/begin MEASUREMENT miistc "indiziertes Motormoment Hochdruckphase Istwert für Ausgabe auf CAN-Bus" UBYTE rel_ub_b100 1 100 0 99.6094 FORMAT "%5.2" ECU_ADDRESS 0x384817 /end MEASUREMENT
/begin MEASUREMENT mizwmnc "indiziertes Motormoment beim spätesten Zündwinkel für CAN-Ausgabe" UBYTE rel_ub_b100 1 100 0 99.6094 FORMAT "%5.2" ECU_ADDRESS 0x3808CB /end MEASUREMENT
/begin MEASUREMENT mkllsc "Kompressorlüfterlastsignal aus CAN-Botschaft Clima 1" UBYTE rel_q0p39 1 100 0 99.6094 FORMAT "%5.2" ECU_ADDRESS 0x3808CC /end MEASUREMENT
/begin MEASUREMENT mkolsc "Kompressorlastsignal aus CAN-Botschaft Clima1" UBYTE md_q0p25 1 100 0 63.75 FORMAT "%5.2" ECU_ADDRESS 0x3808CD /end MEASUREMENT
/begin MEASUREMENT modedaavrq "Gewünschter LDP-Schaltmodus" UBYTE dez 1 100 0 255 FORMAT "%5.1" ECU_ADDRESS 0x380A0D /end MEASUREMENT
/begin MEASUREMENT msndkost_w "msndko (normierter Leckluftmassenstrom über DK) im Start" UWORD m_uw_b6553p5 1 100 0 6553.5 FORMAT "%8.3" ECU_ADDRESS 0x384024 /end MEASUREMENT
/begin MEASUREMENT nllcvt1 " Drehzahlvorgabe aus CVT-Getriebe" UBYTE nmot_ub_q10 1 100 0 2550 FORMAT "%5.0" ECU_ADDRESS 0x3808CE /end MEASUREMENT
/begin MEASUREMENT nsyw "Getriebesynchronisationswunschdrehzahl" UBYTE nmot_ub_q25 1 100 0 6375 FORMAT "%5.0" ECU_ADDRESS 0x3808CF /end MEASUREMENT
/begin MEASUREMENT nsywin "inverierte Getriebesynchronisationswunschdrehzahl" UBYTE DEZ 1 100 0 255 FORMAT "%5.1" ECU_ADDRESS 0x3808D0 /end MEASUREMENT
/begin MEASUREMENT pbkva_w "Druck beim Loslassen der Bremse im BKV" UWORD p_uw_q0p039 1 100 0 2559.96 FORMAT "%8.3" ECU_ADDRESS 0x385424 /end MEASUREMENT
/begin MEASUREMENT pbkvel_w "Druck beim Betätigen der Bremse (Leckage)" UWORD p_uw_q0p039 1 100 0 2559.96 FORMAT "%8.3" ECU_ADDRESS 0x385426 /end MEASUREMENT
/begin MEASUREMENT pbkvpaus_w "Ausschaltschwelle der BKV-Pumpe" UWORD p_uw_q0p039 1 100 0 2559.96 FORMAT "%8.3" ECU_ADDRESS 0x38541A /end MEASUREMENT
/begin MEASUREMENT pbkvpdf_w "Druck der durch BKV-Pumpe erreicht werden kann, für Diagnosenfreigabe" UWORD p_uw_q0p039 1 100 0 2559.96 FORMAT "%8.3" ECU_ADDRESS 0x38541C /end MEASUREMENT
/begin MEASUREMENT pbkvprd_w "Druck der durch BKV-Pumpe erreicht werden kann, für Sperren der Diagnose" UWORD p_uw_q0p039 1 100 0 2559.96 FORMAT "%8.3" ECU_ADDRESS 0x38541E /end MEASUREMENT
/begin MEASUREMENT pbkvp_w "gespeicherter BKV-Druck, wenn Diagnose freigegeben wird" UWORD p_uw_q0p039 1 100 0 2559.96 FORMAT "%8.3" ECU_ADDRESS 0x385420 /end MEASUREMENT
/begin MEASUREMENT pdcva_w "Prüfgröße" SWORD t100msxs_sw_b3276p8 1 100 -3276.8 3276.7 FORMAT "%8.3" ECU_ADDRESS 0x384A0C /end MEASUREMENT
/begin MEASUREMENT pdcvb_w "Prüfgröße" SWORD fak_sw_q0p001 1 100 -32.768 32.767 FORMAT "%8.5" ECU_ADDRESS 0x384A0E /end MEASUREMENT
/begin MEASUREMENT pdcvcc_w "Prüfgröße" SWORD fak_sw_b4 1 100 -4 3.99988 FORMAT "%8.6" ECU_ADDRESS 0x384A10 /end MEASUREMENT
/begin MEASUREMENT pdcvdd_w "Prüfgröße" SWORD fak_sw_b4 1 100 -4 3.99988 FORMAT "%8.6" ECU_ADDRESS 0x384A12 /end MEASUREMENT
/begin MEASUREMENT pdcvee_w "Prüfgröße" UWORD fak_uw_b4 1 100 0 3.99994 FORMAT "%8.6" ECU_ADDRESS 0x384A14 /end MEASUREMENT
/begin MEASUREMENT pdcvff_w "Prüfgröße" UWORD fak_uw_b4 1 100 0 3.99994 FORMAT "%8.6" ECU_ADDRESS 0x384A16 /end MEASUREMENT
/begin MEASUREMENT pdcvgg_w "Prüfgröße" UWORD fak_uw_b4 1 100 0 3.99994 FORMAT "%8.6" ECU_ADDRESS 0x384A18 /end MEASUREMENT
/begin MEASUREMENT pdcvii_w "Prüfgröße" UWORD fak_uw_b2 1 100 0 1.99997 FORMAT "%8.6" ECU_ADDRESS 0x384A1A /end MEASUREMENT
/begin MEASUREMENT pkodrc "Kompressordrucksignal" UBYTE p_q0p2 1 100 0 51 FORMAT "%5.2" ECU_ADDRESS 0x3808D1 /end MEASUREMENT
/begin MEASUREMENT psbkva_w "aktiver Saugrohrdruck zum Evakuieren des BKV" UWORD p_uw_q0p039 1 100 0 2559.96 FORMAT "%8.3" ECU_ADDRESS 0x382CD8 /end MEASUREMENT
/begin MEASUREMENT psbkv_w "benötigter Saugrohrdruck, falls nicht genügend Unterdruck im Bremskraftverst." UWORD p_uw_q0p039 1 100 0 2559.96 FORMAT "%8.3" ECU_ADDRESS 0x382CDA /end MEASUREMENT
/begin MEASUREMENT psmxbkvg "geforderter max. Saugrohrdruck für Bremsunterdruckspeicher" UBYTE p_ub_q10 1 100 0 2550 FORMAT "%5.0" ECU_ADDRESS 0x380BEF /end MEASUREMENT
/begin MEASUREMENT psmxbkvg_w "geforderter max. Saugrohrdruck für Bremsunterdruckspeicher" UWORD p_uw_q0p039 1 100 0 2559.96 FORMAT "%8.3" ECU_ADDRESS 0x382CDC /end MEASUREMENT
/begin MEASUREMENT rinh2_u "Istwert (Byte) Innenwiderstand Ri-Nernstzelle der Lambdasonde hinter KAT Bank2" UBYTE r_ub_q64 1 100 0 16320 FORMAT "%5.0" ECU_ADDRESS 0x380950 /end MEASUREMENT
/begin MEASUREMENT rinh_u "Istwert (Byte) Innenwiderstand Ri-Nernstzelle der Lambdasonde hinter KAT" UBYTE r_ub_q64 1 100 0 16320 FORMAT "%5.0" ECU_ADDRESS 0x380951 /end MEASUREMENT
/begin MEASUREMENT rinv2_u "Istwert (Byte) Innenwiderstand Ri-Nernstzelle der Lambdasonde vor KAT Bank2" UBYTE r_ub_q64 1 100 0 16320 FORMAT "%5.0" ECU_ADDRESS 0x380952 /end MEASUREMENT
/begin MEASUREMENT rinv_u "Istwert (Byte) Innenwiderstand Ri-Nernstzelle der Lambdasonde vor KAT" UBYTE r_ub_q64 1 100 0 16320 FORMAT "%5.0" ECU_ADDRESS 0x380953 /end MEASUREMENT
/begin MEASUREMENT rkadcv_w "Änderung von rka seit Start" SWORD rel_sw_b1536 1 100 -1536 1535.95 FORMAT "%8.3" ECU_ADDRESS 0x384A1C /end MEASUREMENT
/begin MEASUREMENT rkasst_w "Änderung von rka seit Start" SWORD rel_sw_b1536 1 100 -1536 1535.95 FORMAT "%8.3" ECU_ADDRESS 0x384A1E /end MEASUREMENT
/begin MEASUREMENT rkast_w "rka im Start" SWORD rel_sw_b1536 1 100 -1536 1535.95 FORMAT "%8.3" ECU_ADDRESS 0x384026 /end MEASUREMENT
/begin MEASUREMENT rsmcnta "Zähler Wiederholversuche nach Unterbrechung bei erkanntem Leck" UBYTE dez 1 100 0 255 FORMAT "%5.1" ECU_ADDRESS 0x380A0E /end MEASUREMENT
/begin MEASUREMENT sbmcorm "Summierer für Lückenkorrektur um minus einen Zahn" UBYTE dez 1 100 0 255 FORMAT "%5.1" ECU_ADDRESS 0x380967 /end MEASUREMENT
/begin MEASUREMENT sbmcorp "Summierer für Lückenkorrektur um plus einen Zahn" UBYTE dez 1 100 0 255 FORMAT "%5.1" ECU_ADDRESS 0x380968 /end MEASUREMENT
/begin MEASUREMENT sbmlos_w "Summierer für Bezugsmarkenverluste" UWORD dez 1 100 0 65535 FORMAT "%8.2" ECU_ADDRESS 0x383A38 /end MEASUREMENT
/begin MEASUREMENT sfpaav "Status Fehlerpfad: Tankdiagnose, AAV defekt geschlossen" UWORD default 1 100 0 65535 FORMAT "%8.2" ECU_ADDRESS 0x38390C /end MEASUREMENT
/begin MEASUREMENT sfpcair "Status Fehlerpfad : Airbag-Botschaft" UWORD dez 1 100 0 65535 FORMAT "%8.2" ECU_ADDRESS 0x383928 /end MEASUREMENT
/begin MEASUREMENT sfpcas "Status Fehlerpfad: Diagnose CAN-Timeout ASC-Schnittstelle" UWORD dez 1 100 0 65535 FORMAT "%8.2" ECU_ADDRESS 0x38392C /end MEASUREMENT
/begin MEASUREMENT sfpcat "Status Fehlerpfad: CAN-Schnittstelle, Timeout ASC" UWORD dez 1 100 0 65535 FORMAT "%8.2" ECU_ADDRESS 0x38392E /end MEASUREMENT
/begin MEASUREMENT sfpcge "Status Fehlerpfad: Diagnose CAN-Timeout EGS-Schnittstelle" UWORD dez 1 100 0 65535 FORMAT "%8.2" ECU_ADDRESS 0x383930 /end MEASUREMENT
/begin MEASUREMENT sfpcgra "Status Fehlerpfad: CAN-Schnittstelle, Timeout Botschaft GRA" UWORD dez 1 100 0 65535 FORMAT "%8.2" ECU_ADDRESS 0x383932 /end MEASUREMENT
/begin MEASUREMENT sfpcif "Status Fehlerpfad: CAN im Zustand Bus-Off" UWORD dez 1 100 0 65535 FORMAT "%8.2" ECU_ADDRESS 0x383934 /end MEASUREMENT
/begin MEASUREMENT sfpcins "Status Fehlerpfad: Diagnose CAN-Timeout Kombiinstr." UWORD dez 1 100 0 65535 FORMAT "%8.2" ECU_ADDRESS 0x383936 /end MEASUREMENT
/begin MEASUREMENT sfpckla "Status Fehlerpfad: Diagnose CAN-Timeout Klima" UWORD dez 1 100 0 65535 FORMAT "%8.2" ECU_ADDRESS 0x383938 /end MEASUREMENT
/begin MEASUREMENT sfpswe "Status Fehlerpfad: Schlechtwegerkennung" UWORD dez 1 100 0 65535 FORMAT "%8.2" ECU_ADDRESS 0x3839F6 /end MEASUREMENT
/begin MEASUREMENT snobm "Summierer für nicht gefundene Bezugsmarken im Start" UBYTE dez 1 100 0 255 FORMAT "%5.1" ECU_ADDRESS 0x383116 /end MEASUREMENT
/begin MEASUREMENT statgra "Status GRA für Ausgabe auf CAN" UBYTE DEZ 1 100 0 255 FORMAT "%5.1" ECU_ADDRESS 0x3808D2 /end MEASUREMENT
/begin MEASUREMENT stptra "Zustandspointer der DAAV" UBYTE dez 1 100 0 255 FORMAT "%5.1" ECU_ADDRESS 0x380A0F /end MEASUREMENT
/begin MEASUREMENT S_fs "Schalter Fahrstufe" UWORD B_TRUE 1 100 0 1 BIT_MASK 0x8000 FORMAT "%13.11" ECU_ADDRESS 0xFD18 /end MEASUREMENT
/begin MEASUREMENT tabcan_w "Standzeit aus Kombi-Botschaft" UWORD t_q4_s 1 100 0 262140 FORMAT "%8.1" ECU_ADDRESS 0x3849CA /end MEASUREMENT
/begin MEASUREMENT tanskst_w "Ansauglufttemperatur vor Start" UWORD temp_uw_q0p0195_o50 1 100 -50 1229.98 FORMAT "%8.3" ECU_ADDRESS 0x384B94 /end MEASUREMENT
/begin MEASUREMENT tanvkdg_w "Tiefpassgefilterte gemessene Abgastemperatur hinter dem Vorkatalysator" UWORD temp_uw_q0p0195_o50 1 100 -50 1229.98 FORMAT "%8.3" ECU_ADDRESS 0x384B96 /end MEASUREMENT
/begin MEASUREMENT tanvkmg_w "Tiefpassgefilterte modellierte Abgastemperatur hinter dem Vorkatalysator" UWORD temp_uw_q0p0195_o50 1 100 -50 1229.98 FORMAT "%8.3" ECU_ADDRESS 0x384B98 /end MEASUREMENT
/begin MEASUREMENT tanvksmn_w "Minimale Temperaturschwelle der Abgastemperatur hinter dem Vorkat. beim Start" UWORD temp_uw_q0p0195_o50 1 100 -50 1229.98 FORMAT "%8.3" ECU_ADDRESS 0x384B9A /end MEASUREMENT
/begin MEASUREMENT tanvksmx_w "Maximale Temperaturschwelle der Abgastemperatur hinter dem Vorkat. beim Start" UWORD temp_uw_q0p0195_o50 1 100 -50 1229.98 FORMAT "%8.3" ECU_ADDRESS 0x384B9C /end MEASUREMENT
/begin MEASUREMENT tdaufpa "Bereitstellung Zeitdauer Fast Pulse" UWORD t10msxs_uw_b655p35 1 100 0 655.35 FORMAT "%8.4" ECU_ADDRESS 0x381DE6 /end MEASUREMENT
/begin MEASUREMENT tdcvmsub_w "Signalverweilzeit im Graubereich" SWORD t100msxs_sw_b3276p8 1 100 -3276.8 3276.7 FORMAT "%8.3" ECU_ADDRESS 0x384A20 /end MEASUREMENT
/begin MEASUREMENT tdcvm_w "Aktuelle Meßzeit" UWORD t100msxs_uw_b6553p6 1 100 0 6553.5 FORMAT "%8.3" ECU_ADDRESS 0x384A22 /end MEASUREMENT
/begin MEASUREMENT tddtatmx_w "Temperaturdifferenz TDDTATM oder TDDTATMFA" UWORD temp_uw_q0p0195 1 100 0 1279.98 FORMAT "%8.3" ECU_ADDRESS 0x384B9E /end MEASUREMENT
/begin MEASUREMENT tdrsnvk_w "Temperaturdifferenz der Referenzsensoren in der Funktion %DGGTNVK" UWORD temp_uw_q0p0195 1 100 0 1279.98 FORMAT "%8.3" ECU_ADDRESS 0x384BA0 /end MEASUREMENT
/begin MEASUREMENT tepdnvx_w "Entprellzeitkonstante TEPDNV oder TEPDNVT" UWORD t_q1 1 100 0 65535 FORMAT "%8.2" ECU_ADDRESS 0x384BA2 /end MEASUREMENT
/begin MEASUREMENT tfst "Tankfüllstand" UBYTE vol_q1_l 1 100 0 255 FORMAT "%5.1" ECU_ADDRESS 0x3808D3 /end MEASUREMENT
/begin MEASUREMENT timrsa "Timer für Periode" UWORD t10msxs_uw_b655p35 1 100 0 655.35 FORMAT "%8.4" ECU_ADDRESS 0x381DE8 /end MEASUREMENT
/begin MEASUREMENT timzaav "Timer für Meßzeit" UWORD t10msxs_uw_b655p35 1 100 0 655.35 FORMAT "%8.4" ECU_ADDRESS 0x381DEA /end MEASUREMENT
/begin MEASUREMENT tldktima "Timer Überwachungszeit Überschreitung der tL-/wdkbl- Schwelle" UWORD t10msxs_uw_b655p35 1 100 0 655.35 FORMAT "%8.4" ECU_ADDRESS 0x381DEC /end MEASUREMENT
/begin MEASUREMENT tldpeina "Timer für Sofortansteuerung während FastPulse" UWORD t10msxs_uw_b655p35 1 100 0 655.35 FORMAT "%8.4" ECU_ADDRESS 0x381DEE /end MEASUREMENT
/begin MEASUREMENT tldppmwa "Gleitender Mittelwert Periodendauer bei Leckdiagnose" UWORD t10msxs_uw_b655p35 1 100 0 655.35 FORMAT "%8.4" ECU_ADDRESS 0x381DF0 /end MEASUREMENT
/begin MEASUREMENT tmfdcvm_w "Aktuelle Meßfensterzeit" UWORD t100msxs_uw_b6553p6 1 100 0 6553.5 FORMAT "%8.3" ECU_ADDRESS 0x384A24 /end MEASUREMENT
/begin MEASUREMENT tmkic "Motortemperatur aus Kombibotschaft" UBYTE temp_ub_q0p75_o48 1 100 -48 143.25 FORMAT "%5.1" ECU_ADDRESS 0x3808D4 /end MEASUREMENT
/begin MEASUREMENT tmotkst_w "Motortemperatur vor Start" UWORD temp_uw_q0p0195_o50 1 100 -50 1229.98 FORMAT "%8.3" ECU_ADDRESS 0x384BA4 /end MEASUREMENT
/begin MEASUREMENT tmot_u "Motor-Temperatur mit def. Quantisierung für FSP-Umwelten" UBYTE temp_ub_q1_o40 1 100 -40 215 FORMAT "%5.1" ECU_ADDRESS 0x380954 /end MEASUREMENT
/begin MEASUREMENT tmsndklt_w "Aufsummierte Freigabezeit des langsamen additiven Massenstromabgleichs" UWORD t100msxs_uw_b6553p5 1 100 0 6553.5 FORMAT "%8.3" ECU_ADDRESS 0x384A26 /end MEASUREMENT
/begin MEASUREMENT tmsndko_w "Adaptionszeit Leckluftmassenstrom" UWORD t100msxs_uw_b6553p6 1 100 0 6553.5 FORMAT "%8.3" ECU_ADDRESS 0x384A28 /end MEASUREMENT
/begin MEASUREMENT tolc "Öltemperatur aus Kombibotschaft od. aus COWIV abhängig von LH" UBYTE temp_ub_q1_o60 1 100 -60 195 FORMAT "%5.1" ECU_ADDRESS 0x3808D5 /end MEASUREMENT
/begin MEASUREMENT tpfifoaav "FIFO-Speicher für Periodendauer" UWORD t10msxs_uw_b655p35 1 100 0 655.35 FORMAT "%8.4" ARRAY_SIZE 4 ECU_ADDRESS 0x381DF2 /end MEASUREMENT
/begin MEASUREMENT tpmeanva_w "Mittelwert der Periodendauern" UWORD t10msxs_uw_b655p35 1 100 0 655.35 FORMAT "%8.4" ECU_ADDRESS 0x381DFA /end MEASUREMENT
/begin MEASUREMENT tpsvkmf2_u "gefilterter Periodendauerwert des Sondensignals vor Kat, Bank2 (Byte)" UBYTE t10msxs_ub_b10p2 1 100 0 10.2 FORMAT "%5.2" ECU_ADDRESS 0x380955 /end MEASUREMENT
/begin MEASUREMENT tpsvkmf_u "gefilterter Periodendauerwert des Sondensignals vor Kat. (Byte)" UBYTE t10msxs_ub_b10p2 1 100 0 10.2 FORMAT "%5.2" ECU_ADDRESS 0x380956 /end MEASUREMENT
/begin MEASUREMENT trklowa "Timer zur Überwachung Reedkontakt öffnet während Fast Pulse" UWORD t10msxs_uw_b655p35 1 100 0 655.35 FORMAT "%8.4" ECU_ADDRESS 0x381DFC /end MEASUREMENT
/begin MEASUREMENT tsyn "Getriebesynchronisationswunschzeit" UBYTE t_q20_ms 1 100 0 5100 FORMAT "%5.0" ECU_ADDRESS 0x3808D6 /end MEASUREMENT
/begin MEASUREMENT tumc "Umgebungstemperatur aus CAN Botschaft" UBYTE temp_ub_q0p75_o48 1 100 -48 143.25 FORMAT "%5.1" ECU_ADDRESS 0x3808D7 /end MEASUREMENT
/begin MEASUREMENT tvluessc "Lüfteransteuerung über Klimabotschaft ( CAN )" UBYTE rel_q0p4 1 100 0 102 FORMAT "%5.1" ECU_ADDRESS 0x3808D8 /end MEASUREMENT
/begin MEASUREMENT tvztanvx_w "Zeitkonstante TVZTANV oder TVZTANVT für Tiefpassfilter" UWORD t_q1 1 100 0 65535 FORMAT "%8.2" ECU_ADDRESS 0x384BA6 /end MEASUREMENT
/begin MEASUREMENT TYP_aav "Fehlertyp: Tankdiagnose, AAV verstopft" UWORD B_TRUE 1 100 0 1 BIT_MASK 0xf00 FORMAT "%13.11" ECU_ADDRESS 0x38390C /end MEASUREMENT
/begin MEASUREMENT TYP_cair "" UWORD B_TRUE 1 100 0 1 BIT_MASK 0xf00 FORMAT "%13.11" ECU_ADDRESS 0x383928 /end MEASUREMENT
/begin MEASUREMENT TYP_cas "" UWORD B_TRUE 1 100 0 1 BIT_MASK 0xf00 FORMAT "%13.11" ECU_ADDRESS 0x38392C /end MEASUREMENT
/begin MEASUREMENT TYP_cat "" UWORD B_TRUE 1 100 0 1 BIT_MASK 0xf00 FORMAT "%13.11" ECU_ADDRESS 0x38392E /end MEASUREMENT
/begin MEASUREMENT TYP_cge "" UWORD B_TRUE 1 100 0 1 BIT_MASK 0xf00 FORMAT "%13.11" ECU_ADDRESS 0x383930 /end MEASUREMENT
/begin MEASUREMENT TYP_cgra "" UWORD B_TRUE 1 100 0 1 BIT_MASK 0xf00 FORMAT "%13.11" ECU_ADDRESS 0x383932 /end MEASUREMENT
/begin MEASUREMENT TYP_cif "Fehlertyp: CAN im Zustand Bus-Off" UWORD B_TRUE 1 100 0 1 BIT_MASK 0xf00 FORMAT "%13.11" ECU_ADDRESS 0x383934 /end MEASUREMENT
/begin MEASUREMENT TYP_cins "" UWORD B_TRUE 1 100 0 1 BIT_MASK 0xf00 FORMAT "%13.11" ECU_ADDRESS 0x383936 /end MEASUREMENT
/begin MEASUREMENT TYP_ckla "" UWORD B_TRUE 1 100 0 1 BIT_MASK 0xf00 FORMAT "%13.11" ECU_ADDRESS 0x383938 /end MEASUREMENT
/begin MEASUREMENT TYP_swe "" UWORD B_TRUE 1 100 0 1 BIT_MASK 0xf00 FORMAT "%13.11" ECU_ADDRESS 0x3839F6 /end MEASUREMENT
/begin MEASUREMENT udkp1_u "Spannung Drosselklappen-Poti 1 (Byte)" UBYTE spg_ub_b5 1 100 0 4.98047 FORMAT "%5.3" ECU_ADDRESS 0x380957 /end MEASUREMENT
/begin MEASUREMENT udkp2_u "Spannung Drosselklappen-Poti 2 (Byte)" UBYTE spg_ub_b5 1 100 0 4.98047 FORMAT "%5.3" ECU_ADDRESS 0x380958 /end MEASUREMENT
/begin MEASUREMENT uefktget "Übertragungsfunktion (Mrad/Mkurbelwelle) von der Getriebesteuerung" UBYTE uefktget_ub_b25p4 1 100 0 25.5 FORMAT "%5.2" ECU_ADDRESS 0x3808D9 /end MEASUREMENT
/begin MEASUREMENT upwg1_u "Spannung PWG-Poti 1 (Byte)" UBYTE spg_ub_b5 1 100 0 4.98047 FORMAT "%5.3" ECU_ADDRESS 0x380959 /end MEASUREMENT
/begin MEASUREMENT upwg2d_u "Verdoppelte PWG-Poti-2-Spannung (Byte)" UBYTE spg_ub_b5 1 100 0 4.98047 FORMAT "%5.3" ECU_ADDRESS 0x38095A /end MEASUREMENT
/begin MEASUREMENT upwg2_u "Spannung PWG-Poti 2 (Byte)" UBYTE spg_ub_b5 1 100 0 4.98047 FORMAT "%5.3" ECU_ADDRESS 0x38095B /end MEASUREMENT
/begin MEASUREMENT vdcve_w "dimesionslose Auswertegröße (-1...+1) für Leckageerkennung nach DK" SWORD fak_sw_q0p001 1 100 -32.768 32.767 FORMAT "%8.5" ECU_ADDRESS 0x384A2A /end MEASUREMENT
/begin MEASUREMENT vdcvz_w "dimesionslose Auswertegröße (-1...+1) für Leckageerkennung vor DK" SWORD fak_sw_q0p001 1 100 -32.768 32.767 FORMAT "%8.5" ECU_ADDRESS 0x384A2C /end MEASUREMENT
/begin MEASUREMENT vfzgkb_w "Geschwindigkeit aus Kombi-Botschaft" UWORD vfzgkb_uw_b655 1 100 0 654.99 FORMAT "%8.4" ECU_ADDRESS 0x380E82 /end MEASUREMENT
/begin MEASUREMENT vfzg_u "Fahrzeuggeschwindigkeit, mit def. Quantisierung für Tester" UBYTE vfzg_q1p0 1 100 0 255 FORMAT "%5.1" ECU_ADDRESS 0x38095C /end MEASUREMENT
/begin MEASUREMENT vzgrac "GRA-Zielgeschwindigkeit für CAN-Ausgabe" UBYTE vfzg_ub_q1p25 1 100 0 318.75 FORMAT "%5.1" ECU_ADDRESS 0x3808DA /end MEASUREMENT
/begin MEASUREMENT wzctoa "Zähler Wiederholversuche Close to Open Check" UBYTE dez 1 100 0 255 FORMAT "%5.1" ECU_ADDRESS 0x380A10 /end MEASUREMENT
/begin MEASUREMENT zkwnpbm_w "Zähler für Anzahl von Umdrehungen von Init. oder Löschen des Fehlerspeicher" UWORD dez 1 100 0 65535 FORMAT "%8.2" ECU_ADDRESS 0x381A46 /end MEASUREMENT
/begin MEASUREMENT Z_aav "Zyklusflag: Absperrventil Aktivkohlefilter (Funktion)" UWORD B_TRUE 1 100 0 1 BIT_MASK 0x2 FORMAT "%13.11" ECU_ADDRESS 0x38390C /end MEASUREMENT
/begin MEASUREMENT Z_cair "Zyklusflag : Timeout Airbag-Botschaft" UWORD B_TRUE 1 100 0 1 BIT_MASK 0x2 FORMAT "%13.11" ECU_ADDRESS 0x383928 /end MEASUREMENT
/begin MEASUREMENT Z_cas "Zyklusflag: CAN-Schnittstelle, Timeout ASC" UWORD B_TRUE 1 100 0 1 BIT_MASK 0x2 FORMAT "%13.11" ECU_ADDRESS 0x38392C /end MEASUREMENT
/begin MEASUREMENT Z_cat "Zyklusflag: CAN-Schnittstelle, Timeout Bremsbotschaft setzen" UWORD B_TRUE 1 100 0 1 BIT_MASK 0x2 FORMAT "%13.11" ECU_ADDRESS 0x38392E /end MEASUREMENT
/begin MEASUREMENT Z_cge "Zyklusflag: CAN-Schnittstelle, Timeout EGS" UWORD B_TRUE 1 100 0 1 BIT_MASK 0x2 FORMAT "%13.11" ECU_ADDRESS 0x383930 /end MEASUREMENT
/begin MEASUREMENT Z_cgra "Zyklusflag : Timeout GRA-Botschaft" UWORD B_TRUE 1 100 0 1 BIT_MASK 0x2 FORMAT "%13.11" ECU_ADDRESS 0x383932 /end MEASUREMENT
/begin MEASUREMENT Z_cif "Zyklusflag: CAN-Schnittstelle, interner Fehler" UWORD B_TRUE 1 100 0 1 BIT_MASK 0x2 FORMAT "%13.11" ECU_ADDRESS 0x383934 /end MEASUREMENT
/begin MEASUREMENT Z_cins "Zyklusflag: CAN-Schnittstelle, Timeout Instrument" UWORD B_TRUE 1 100 0 1 BIT_MASK 0x2 FORMAT "%13.11" ECU_ADDRESS 0x383936 /end MEASUREMENT
/begin MEASUREMENT Z_ckla "Zyklusflag: CAN-Kommunikation zum KLA-SG gestört" UWORD B_TRUE 1 100 0 1 BIT_MASK 0x2 FORMAT "%13.11" ECU_ADDRESS 0x383938 /end MEASUREMENT
/begin MEASUREMENT Z_ev "Zyklusflag: Einspritzventil Endstufe" UWORD B_TRUE 1 100 0 1 BIT_MASK 0x80 FORMAT "%13.11" ECU_ADDRESS 0xFD50 /end MEASUREMENT
/begin MEASUREMENT Z_swe "Zyklusflag: Beschleunigungssensor der Schlechtwegeerkennung" UWORD B_TRUE 1 100 0 1 BIT_MASK 0x2 FORMAT "%13.11" ECU_ADDRESS 0x3839F6 /end MEASUREMENT
/begin FUNCTION BKV "2.70      Drucksteuerung für Bremskraftverstärker"
 /begin DEF_CHARACTERISTIC CWBKV DPBKVSPS DPBKVUKKPU DPBKVUKNW DPBKVUKP DPBKVUKPU DPBKVUS MRFAMXKOAB OPBKVUKKB OPBKVUKNWB OPBKVUKPB OPBKVUKPUB PBKVKRHY TDBKVKOMAB TDBKVNWAB TDBKVP TDBKVSTED TDDEDBKVP TDPBKVMN TDPBKVMNP TEBKVNWAB TEPBKVMN TEPPBKV /end DEF_CHARACTERISTIC
 /begin REF_CHARACTERISTIC /end REF_CHARACTERISTIC
 /begin IN_MEASUREMENT B_bkvp B_brems B_cdbkvp B_kh B_ll dpbkvu_w mrfa_w psspbkv_w ps_w pubkv_w tnst_w /end IN_MEASUREMENT
 /begin OUT_MEASUREMENT B_bkvagrab B_bkvkomab B_bkvleer B_bkvnwab B_bkvpa dpbkvukp_w psmxbkvg psmxbkvg_w /end OUT_MEASUREMENT
 /begin LOC_MEASUREMENT BKVlokbits0 B_bkvkoma B_bkvnwum B_fbkvpa B_pbkvmn B_pbkvmnp dpbkvukb_w dpbkvukk_w dpbkvukr_w dpbkvuk_w dpbkvunw_w dpbukkb_w dpbukk_w dpbuknwb_w dpbuknw_w dpbukpb_w dpbukp_w psbkva_w psbkv_w /end LOC_MEASUREMENT
 /begin SUB_FUNCTION /end SUB_FUNCTION
/end FUNCTION
/begin FUNCTION CAN "119.20    CAN-Signalliste"
 /begin DEF_CHARACTERISTIC BUSOFFCTR BUSOFFTIME CANVERS CCMKBI CSAIR CWCANKBI CWCANLWS CWCANMD CWCAUVW CWCFS CWGC_0_A CWGC_1_A CWGC_2_A CWGC_3_A CWGEEIN CW_CAN_C CW_CAN_R_0___A CW_CAN_R_1___A CW_CAN_R_2___A CW_CAN_R_3___A CW_CAN_S_0___A CW_CAN_S_1___A CW_CAN_S_2___A CW_CAN_S_3___A FMOTC FWCBFT FWCSBK FWTMUEBO FWTMUEBU FWTOUEBO FWTOUEBU KFOELKBI KLMIGENL KVNPZ MDMAXKBI MDNORM MOTTYP NMAXKBI PMAXKBI T_GEUEW T_KLIMADEADCTR T_KOM1CLDEAD T_NOMAIR T_NOMAIRTA T_NOMBSG T_NOMEGS T_NOMKBI T_NOMKBI1 T_NOMKBI23 T_NOMKLA T_NOMLWS T_SFSEN VANZKBI VGNL ZCANAIR ZTOELKBI /end DEF_CHARACTERISTIC
 /begin REF_CHARACTERISTIC CWCS MDIMX NOASR /end REF_CHARACTERISTIC
 /begin IN_MEASUREMENT bfgrsbr bfgrs_w B_acc B_accen B_autget B_bl B_br B_dknolu B_dkpu B_epcl B_fgr B_fgrbr B_fgren B_fgrhsa B_fgrte B_fgrtse B_gracan B_i_ska_fr B_kd B_kl15 B_koe B_kosrc B_kov B_kuppl B_kvakbi B_ll B_mil B_msr B_nlbzakt B_nldg B_nmin B_png B_st B_stend B_wdk2sel cserk fcmEnd fgnsol fho kldfpwm kvakbi_w mdverl_w miautget_w miautgs_w mifab_w mifa_w miist_w milsol_w mimax_w mimin_w misol_w mivbeg_w mizwmn_w mrfamx_w mrfgr_w mrped_w nmot nmot_w nstat pvdkds S_bls S_brs tans tmot tnst_w toelk_w ub udkp1_w udkp2_w vfzg vregl_w vziel_w wdkba wpedv_w wpfgr_w zstfgr /end IN_MEASUREMENT
 /begin OUT_MEASUREMENT bfgrsc bz_air bz_cang1 bz_cange bz_cmf bz_mot6 B_aakuppl B_accenc B_aircan B_airnbot B_amsrbot B_amsrnbot B_anlfr B_br3bot B_bus_off B_cankbi B_canlws B_cdma B_ckien B_csair B_csairio B_ctout B_cvtad B_ectal B_epcden B_fku B_fstcanok B_ge1bot B_ge2bot B_geco B_gekoa B_genot B_ges B_geuew B_grabot B_gsaf B_gsch B_kooffc B_lowra B_lwsbot B_lwser B_lwsok B_mdwaner B_mgbget B_milfb B_milfbg B_motaus B_neair B_nlbzanf B_nuair B_nukla B_sacc B_sacvt B_skoc B_sksc B_statbr B_statge B_statgec B_statmd B_statmdc B_statme B_statme_t B_statnb B_statto B_stattoc B_tabcan B_talcan B_talkbi B_tfstok B_tippg B_tmkicb B_tolcb B_tolueb B_tumcb B_wk B_wkauf B_wkr B_zges can_nv_bits cs_air cs_mot6 dlws_w gangauti gwhpos klahc km01tr kmstand_w lws_w mdgbeg mdgrad_w mdverlc mdwancan miautgetc miautgsc miges_w migs_can migs_w miistc mizwmnc mkllsc mkolsc nllcvt1 nsyw nsywin pkodrc statgra S_fs tabcan_w tfst tmkic tolc tsyn tumc tvluessc uefktget vfzgkb_w vzgrac /end OUT_MEASUREMENT
 /begin LOC_MEASUREMENT B_dnmcan dnmcan kfoelkbi_nmot /end LOC_MEASUREMENT
 /begin SUB_FUNCTION /end SUB_FUNCTION
/end FUNCTION
/begin FUNCTION CAN_DST "" /begin DEF_CHARACTERISTIC /end DEF_CHARACTERISTIC /begin REF_CHARACTERISTIC /end REF_CHARACTERISTIC /begin IN_MEASUREMENT B_ctout /end IN_MEASUREMENT /begin OUT_MEASUREMENT /end OUT_MEASUREMENT /begin LOC_MEASUREMENT /end LOC_MEASUREMENT /begin SUB_FUNCTION /end SUB_FUNCTION /end FUNCTION
/begin FUNCTION D2CTR "2.30      Diagnose; Ereigniscounter für Systembeobachtung" /begin DEF_CHARACTERISTIC DFPSLBIT /end DEF_CHARACTERISTIC /begin REF_CHARACTERISTIC /end REF_CHARACTERISTIC /begin IN_MEASUREMENT /end IN_MEASUREMENT
 /begin OUT_MEASUREMENT bbd2ctr B_syserr B_syserrk B_trip ctrerf1 ctrerfk1 ctrrdy1 ctrsfp ctrzyf0 ctrzyf1 /end OUT_MEASUREMENT
 /begin LOC_MEASUREMENT /end LOC_MEASUREMENT
 /begin SUB_FUNCTION /end SUB_FUNCTION
/end FUNCTION
/begin FUNCTION DAAV "1.20      Diagnose AAV-Ventil"
 /begin DEF_CHARACTERISTIC APULSMXA CWDAAV DKAAVN DKTLMTA DPUFVMNA DPUFVSMNA DTPAAV MSTEAAV MSTEAAVI RLAAVMX TAAV1SD TAAV2SD TAAVZMN TGLAAV TPUPHA TRKAUFA TSRFPABA TTOTAAV WZLDPMXA /end DEF_CHARACTERISTIC
 /begin REF_CHARACTERISTIC CWBAESEL TLDPRKO TPFIFOANZ VALDPMN WZLDPRO /end REF_CHARACTERISTIC
 /begin IN_MEASUREMENT B_cdldp B_dtes B_extaav B_fa B_faldp B_ldp B_ldpi B_lrar B_m8te B_nmin B_tef B_tep ftefsoll_w mstedte_w mstesoll_w nmot ps_w pu_w rl stptr tateout tfpg vfzg wdkba /end IN_MEASUREMENT
 /begin OUT_MEASUREMENT B_daav B_daavreq B_daavte B_resmode modedaavrq /end OUT_MEASUREMENT
 /begin LOC_MEASUREMENT anzpulsa B_aavabb B_aavf B_daavf B_dpumna B_erraav B_faaava B_feva10 B_feva11 B_feva12 B_feva9 B_fpchka B_messea B_rkacka B_rkzcka B_tepaav B_tpstaba daavLokBits1 daavLokBits2 dpua_w fppcnta fvdaav imsteaav_w rsmcnta stptra tdaufpa timrsa timzaav tldktima tldpeina tldppmwa tpfifoaav tpmeanva_w trklowa wzctoa /end LOC_MEASUREMENT
 /begin SUB_FUNCTION /end SUB_FUNCTION
/end FUNCTION
/begin FUNCTION DAAVE "11.40     Diagnose; Plausibiltätsprüfung Absperrventil Aktivkohlebehälter Endstufe" /begin DEF_CHARACTERISTIC /end DEF_CHARACTERISTIC /begin REF_CHARACTERISTIC /end REF_CHARACTERISTIC /begin IN_MEASUREMENT B_aav B_desee /end IN_MEASUREMENT /begin OUT_MEASUREMENT B_aava B_aavz /end OUT_MEASUREMENT /begin LOC_MEASUREMENT /end LOC_MEASUREMENT /begin SUB_FUNCTION /end SUB_FUNCTION /end FUNCTION
/begin FUNCTION DATR "1.20      Diagnose Abgastemperaturregelung" /begin DEF_CHARACTERISTIC DLATRNP DLEATRN TVBATRF TVEATRDR TVEATRDS TVEATRR TVEATRS /end DEF_CHARACTERISTIC /begin REF_CHARACTERISTIC /end REF_CHARACTERISTIC /begin IN_MEASUREMENT B_atr B_atr2 B_cdatr cd_bits1_w dlatr2_w dlatr_w nmot /end IN_MEASUREMENT /begin OUT_MEASUREMENT B_atrf dleatr /end OUT_MEASUREMENT /begin LOC_MEASUREMENT B_atrd B_atrd2 B_fatr B_fatr2 /end LOC_MEASUREMENT /begin SUB_FUNCTION /end SUB_FUNCTION /end FUNCTION
/begin FUNCTION DATS "2.40      Diagnose Abgastemperatursensor"
 /begin DEF_CHARACTERISTIC DTPATS TABSDTMN TANSNVMX TATNVMN TATSMN TATSMX TATSNP TDATSO TDDTATM TDDTATMFA TDDTRS TDRSMX TELLRSMV TEPDNV TEPDNVT TMOTABATS TMOTNVMX TPSATS TVEATSR TVEATSS TVZTANV TVZTANVT /end DEF_CHARACTERISTIC
 /begin REF_CHARACTERISTIC /end REF_CHARACTERISTIC
 /begin IN_MEASUREMENT B_atsb B_cdats B_fa B_faats B_kh B_ll B_llr B_mdarv B_mdkat B_nmot B_pwf B_sa B_stend tabgkrm_w tabst_w tansk_w tatsst_w tats_w tmotab tmotk_w tpats /end IN_MEASUREMENT
 /begin OUT_MEASUREMENT tanskst_w tmotkst_w /end OUT_MEASUREMENT
 /begin LOC_MEASUREMENT B_emnats B_emxats B_enpats B_esenats B_esiats B_faatson B_pwfast B_tnvkhoff B_tnvksma B_tnvksmv B_tnvp B_tnvpdmv B_tnvpstd B_tnvzstd tanvkdg_w tanvkmg_w tanvksmn_w tanvksmx_w tddtatmx_w tdrsnvk_w tepdnvx_w tvztanvx_w /end LOC_MEASUREMENT
 /begin SUB_FUNCTION /end SUB_FUNCTION
/end FUNCTION
/begin FUNCTION DBKVP "1.50      Diagnose Bremskraftverstärker-Pumpe" /begin DEF_CHARACTERISTIC DPBKVP DPBKVPMN TDBBKVP TDDBKVP TNSTBKV /end DEF_CHARACTERISTIC /begin REF_CHARACTERISTIC FBKVP PBKVKRHY /end REF_CHARACTERISTIC
 /begin IN_MEASUREMENT B_bkvp B_brems B_cdbkvp dpbkvukp_w pbkv_w psspbkv_w ps_w pubkv_w tnst_w /end IN_MEASUREMENT
 /begin OUT_MEASUREMENT B_fdbkvp B_fpbkvmx B_zbkvtest /end OUT_MEASUREMENT
 /begin LOC_MEASUREMENT B_dbkvpa B_rdbkvp B_rdbkvpps B_rtdbkvp dpbkvpa_w pbkvpaus_w pbkvpdf_w pbkvprd_w pbkvp_w /end LOC_MEASUREMENT
 /begin SUB_FUNCTION /end SUB_FUNCTION
/end FUNCTION
/begin FUNCTION DBKVPE "1.10      Endstufendiagnose Bremskraftverstärker-Pumpe" /begin DEF_CHARACTERISTIC /end DEF_CHARACTERISTIC /begin REF_CHARACTERISTIC /end REF_CHARACTERISTIC /begin IN_MEASUREMENT B_bkvp B_desee /end IN_MEASUREMENT /begin OUT_MEASUREMENT /end OUT_MEASUREMENT /begin LOC_MEASUREMENT bkvpea_ctr bkvpena_ctr B_bkvpea B_bkvpena dbkvpelokbits /end LOC_MEASUREMENT /begin SUB_FUNCTION /end SUB_FUNCTION /end FUNCTION
/begin FUNCTION DCDACC "2.10      Diagnose; Zugriff auf Testerdaten" /begin DEF_CHARACTERISTIC CWCDCUM /end DEF_CHARACTERISTIC /begin REF_CHARACTERISTIC /end REF_CHARACTERISTIC /begin IN_MEASUREMENT /end IN_MEASUREMENT /begin OUT_MEASUREMENT /end OUT_MEASUREMENT /begin LOC_MEASUREMENT /end LOC_MEASUREMENT /begin SUB_FUNCTION /end SUB_FUNCTION /end FUNCTION
/begin FUNCTION DCLA "7.10      OBDII; Klassentabelle"
 /begin DEF_CHARACTERISTIC CL30LINE CL31LINE CL32LINE CL33LINE CL34LINE CL35LINE CL36LINE CL37LINE CL38LINE CL39LINE CWFLC /end DEF_CHARACTERISTIC
 /begin REF_CHARACTERISTIC /end REF_CHARACTERISTIC
 /begin IN_MEASUREMENT /end IN_MEASUREMENT
 /begin OUT_MEASUREMENT /end OUT_MEASUREMENT
 /begin LOC_MEASUREMENT /end LOC_MEASUREMENT
 /begin SUB_FUNCTION /end SUB_FUNCTION
/end FUNCTION
/begin FUNCTION DCV "1.40      Diagnose Kurbelgehäuseentlüftung"
 /begin DEF_CHARACTERISTIC ANZDCVIO ANZDCVNIO ANZWDHMX CWDCV DCVFHOU DCVFRMMN DCVLAMSMN DCVLAMSMX DCVLAMSO DCVMLO DCVRLO DCVTAO DCVTMU DCVTNSTU DCVVFZGO EVDCVM EVDCVP FRADCVINI FRADCVSTO FRAKONST FRMULTOE FRMULTOZ FRMULTUE FRMULTUZ KFFHOTMKO KLLAMKORR KLNSWLKORR KLRKAKORR LSONHMX MSLGDCV RKADCVINI RKAKONST SWDIVZERO TDCVMN TDCVMX TMOFFMX TMSNDKLTMN TMSNDKOMN TVDCVLAM TVDIAGDCV TVEDCV TVERRDET TVERREN TVSTOST VDCVMXE VDCVMXZ ZDCVLAM /end DEF_CHARACTERISTIC
 /begin REF_CHARACTERISTIC /end REF_CHARACTERISTIC
 /begin IN_MEASUREMENT B_dtes B_ehfm B_inimsdko B_llr B_lr B_msndko B_pwf B_sbbhk B_sls B_stend B_te fho fho_w fnswl_w frao_w frat_w frau_w fra_w frm_w lamsbg_w lamsonh_w lamsoni_w ml_w msndko_w rkat_w rkaz_w rka_w rl_w tans tmot tnst_w vfzg_w /end IN_MEASUREMENT
 /begin OUT_MEASUREMENT B_dcve B_ecv B_edcvab B_edcve B_edcvez B_edcvz B_enstofra B_zcv vdcve_w vdcvz_w /end OUT_MEASUREMENT
 /begin LOC_MEASUREMENT azdcvio_w azdcvnio_w azwdh_w B_dcva B_dcvausw B_dcvb B_dcverr B_dcvio B_dcvm B_dcvnio B_dcvwdh B_edctrip B_edcvtrip B_edcvv B_emncv B_emxcv B_emxcvi B_enstodcv B_inimsdks B_lamx B_pdcva B_pdcvaa B_pdcvb B_pdcvc B_pdcvf B_pdcvg B_pdcvh B_pdcvi B_pdcvj B_pdcvk B_pdcvo B_pdcvp B_tdcvmn B_tdcvmx B_zdcv countoe_w countoz_w countue_w countuz_w dcounte_w dcountz_w dmsndko_w fmsndko_w fmsndk_w fnswlx_w fradcv_w frakorr_w frast_w frkadcv_w frkakorr_w frmulti_w lamsonif_w msndkost_w pdcva_w pdcvb_w pdcvcc_w pdcvdd_w pdcvee_w pdcvff_w pdcvgg_w pdcvii_w rkadcv_w rkasst_w rkast_w tdcvmsub_w tdcvm_w tmfdcvm_w tmsndklt_w tmsndko_w /end LOC_MEASUREMENT
 /begin SUB_FUNCTION /end SUB_FUNCTION
/end FUNCTION
/begin FUNCTION DDCY "15.10     OBDII; Erfüllung Bedingung 'driving cycle'" /begin DEF_CHARACTERISTIC TWBDCY /end DEF_CHARACTERISTIC /begin REF_CHARACTERISTIC /end REF_CHARACTERISTIC /begin IN_MEASUREMENT B_pwf B_stend /end IN_MEASUREMENT /begin OUT_MEASUREMENT bbdcy B_dcy dcycnt /end OUT_MEASUREMENT /begin LOC_MEASUREMENT /end LOC_MEASUREMENT /begin SUB_FUNCTION /end SUB_FUNCTION /end FUNCTION
/begin FUNCTION DDG "10.80     Diagnose Drehzahlgeber"
 /begin DEF_CHARACTERISTIC CORTINC CORTINIT CORTMX LBMINC LBMINIT LBMMX LBMSUB MXNLN NOBMINC NOBMINIT NOBMSTMX PGFLNL PGFLWA TMOTNLDG /end DEF_CHARACTERISTIC
 /begin REF_CHARACTERISTIC /end REF_CHARACTERISTIC
 /begin IN_MEASUREMENT bmLosCtr_w B_bm B_fbm B_motstop B_nmin B_nophnldg B_pwf B_synnldg B_zprel nmotllfil nstat nsynnldg tmCorCtr_w tmot tpCorCtr_w vfzg_w wkw_w znbm_w zrph /end IN_MEASUREMENT
 /begin OUT_MEASUREMENT B_nldg /end OUT_MEASUREMENT
 /begin LOC_MEASUREMENT B_enabddg B_nlbm B_nlnobm B_nlnon B_nobmflr1 B_nobmflr2 B_nocorflr B_setmnbm B_setmxbm B_setnpbm B_setsibm flgddg sbmcorm sbmcorp sbmlos_w snobm zkwnpbm_w /end LOC_MEASUREMENT
 /begin SUB_FUNCTION /end SUB_FUNCTION
/end FUNCTION
/begin FUNCTION DDPL "9.20      Diagnose; Plausibilitätsprüfung Dauerversorgung (OBDII)" /begin DEF_CHARACTERISTIC /end DEF_CHARACTERISTIC /begin REF_CHARACTERISTIC /end REF_CHARACTERISTIC /begin IN_MEASUREMENT B_pwfCsErr /end IN_MEASUREMENT /begin OUT_MEASUREMENT /end OUT_MEASUREMENT /begin LOC_MEASUREMENT /end LOC_MEASUREMENT /begin SUB_FUNCTION /end SUB_FUNCTION /end FUNCTION
/begin FUNCTION DDSBKV "1.80      Diagnose Drucksensor im Bremskraftverstärker"
 /begin DEF_CHARACTERISTIC DPBKVLE DPSBKV DPSPBKVNPH DPUBKV PBKVMN PBKVMX TDDFBKV TDDHBKV TEPBKVNB TTBRL TVPBKVNB UDSBKVMN UDSBKVMX /end DEF_CHARACTERISTIC
 /begin REF_CHARACTERISTIC /end REF_CHARACTERISTIC
 /begin IN_MEASUREMENT B_brems B_cddsbkv B_ehfm pbkv_w ps_w pu_w udsbkv_w /end IN_MEASUREMENT
 /begin OUT_MEASUREMENT /end OUT_MEASUREMENT
 /begin LOC_MEASUREMENT B_bkvnpler B_bkvnplh B_ebkvl B_hbkvl B_rtdbkvl B_zdsbkvm dpbkvae_w pbkva_w pbkvel_w /end LOC_MEASUREMENT
 /begin SUB_FUNCTION /end SUB_FUNCTION
/end FUNCTION
/begin FUNCTION DDVE "7.30      Diagnose: EGAS-Steller DV-E" /begin DEF_CHARACTERISTIC TPNSE /end DEF_CHARACTERISTIC /begin REF_CHARACTERISTIC /end REF_CHARACTERISTIC
 /begin IN_MEASUREMENT B_abgle B_dkaden B_dkp1e B_dkp1mn B_dkp1mx B_dkp1np B_dkp2e B_dkp2mn B_dkp2mx B_dkp2np B_dlrbe B_dlrpide B_dveese B_fproab B_fproe B_fprook B_fprordy B_fprovb B_fprrdy B_fprzab B_fprze B_fprzvb B_lrnakt B_lrnerf B_lrnrdy B_lrnvb B_lrnws B_nlpe B_nlperf B_nlpnew B_pwf B_stend B_umae B_umauab B_wdksive dveadchst fprstep_c lrnstep_c /end IN_MEASUREMENT
 /begin OUT_MEASUREMENT /end OUT_MEASUREMENT
 /begin LOC_MEASUREMENT /end LOC_MEASUREMENT
 /begin SUB_FUNCTION /end SUB_FUNCTION
/end FUNCTION
/begin FUNCTION DECJ "14.30     Diagnose; Endstufe CJ4x/9x" /begin DEF_CHARACTERISTIC CWBBDECJ /end DEF_CHARACTERISTIC /begin REF_CHARACTERISTIC /end REF_CHARACTERISTIC /begin IN_MEASUREMENT B_airbag B_dhrnio B_nmin B_ubrk B_ubrmax nmot ub /end IN_MEASUREMENT /begin OUT_MEASUREMENT B_bbdecj B_bbubr B_desee B_esdia /end OUT_MEASUREMENT /begin LOC_MEASUREMENT /end LOC_MEASUREMENT /begin SUB_FUNCTION /end SUB_FUNCTION /end FUNCTION
/begin FUNCTION DEGFE "2.30      Diagnose der Eingangsgrößen Füllungserfassung" /begin DEF_CHARACTERISTIC CWDEGFE TDEGFEMN TDEGFEMX TDEGFENO TDEGFEST /end DEF_CHARACTERISTIC /begin REF_CHARACTERISTIC /end REF_CHARACTERISTIC /begin IN_MEASUREMENT B_fkmsmn B_fkmsmx B_fkpvmn B_fkpvmx B_stend /end IN_MEASUREMENT /begin OUT_MEASUREMENT B_ehfmfe B_tepvb B_zhfmfe DEGFEausbits /end OUT_MEASUREMENT /begin LOC_MEASUREMENT /end LOC_MEASUREMENT /begin SUB_FUNCTION /end SUB_FUNCTION /end FUNCTION
/begin FUNCTION DEKON "Konfiguration der Endstufendiagnose" /begin DEF_CHARACTERISTIC ESKONF /end DEF_CHARACTERISTIC /begin REF_CHARACTERISTIC /end REF_CHARACTERISTIC /begin IN_MEASUREMENT /end IN_MEASUREMENT /begin OUT_MEASUREMENT /end OUT_MEASUREMENT /begin LOC_MEASUREMENT /end LOC_MEASUREMENT /begin SUB_FUNCTION /end SUB_FUNCTION /end FUNCTION
/begin FUNCTION DEKPE "11.20     Diagnose; Elektrokraftstoffpumpe Endstufe" /begin DEF_CHARACTERISTIC UBDEKPMN /end DEF_CHARACTERISTIC /begin REF_CHARACTERISTIC /end REF_CHARACTERISTIC /begin IN_MEASUREMENT B_desee ub /end IN_MEASUREMENT /begin OUT_MEASUREMENT /end OUT_MEASUREMENT /begin LOC_MEASUREMENT /end LOC_MEASUREMENT /begin SUB_FUNCTION /end SUB_FUNCTION /end FUNCTION
/begin FUNCTION DEPCLE "1.20      Diagnose EPCL-Endstufe" /begin DEF_CHARACTERISTIC /end DEF_CHARACTERISTIC /begin REF_CHARACTERISTIC /end REF_CHARACTERISTIC /begin IN_MEASUREMENT B_desee B_epcl /end IN_MEASUREMENT /begin OUT_MEASUREMENT /end OUT_MEASUREMENT /begin LOC_MEASUREMENT /end LOC_MEASUREMENT /begin SUB_FUNCTION /end SUB_FUNCTION /end FUNCTION
/begin FUNCTION DEVE "6.40      Diagnose; Einspritzventil - Endstufe" /begin DEF_CHARACTERISTIC /end DEF_CHARACTERISTIC /begin REF_CHARACTERISTIC /end REF_CHARACTERISTIC /begin IN_MEASUREMENT B_desee B_sa B_stend evz_austot /end IN_MEASUREMENT /begin OUT_MEASUREMENT B_eev Z_ev /end OUT_MEASUREMENT /begin LOC_MEASUREMENT /end LOC_MEASUREMENT /begin SUB_FUNCTION /end SUB_FUNCTION /end FUNCTION
/begin FUNCTION DFFT "1.60      Diagnose; Freeze Frame Auswahltabelle" /begin DEF_CHARACTERISTIC /end DEF_CHARACTERISTIC /begin REF_CHARACTERISTIC /end REF_CHARACTERISTIC
 /begin IN_MEASUREMENT egaspfad flglrs fr2_u fra2_u fra_u fr_u gangi mizuvfil mi_duf mi_um ml mpfad nmot pu rinh_u rinv_u rl rml rstpfad skapfad tabgm tans tfst tkatm tmew tmot tmotlin tmot_u tmrw tpsvkmf_u tumg ub udkp1_u udkp2_u uhsv upwg1_u upwg2d_u upwg2_u ushk usvk usvk2 vfzg_u wdkba wdks wped /end IN_MEASUREMENT
 /begin OUT_MEASUREMENT /end OUT_MEASUREMENT
 /begin LOC_MEASUREMENT /end LOC_MEASUREMENT
 /begin SUB_FUNCTION /end SUB_FUNCTION
/end FUNCTION
/begin FUNCTION DFFTCNV "3.30      Diagnose; Freeze Frame Tabelle, Konvertierung zu Bytes" /begin DEF_CHARACTERISTIC /end DEF_CHARACTERISTIC /begin REF_CHARACTERISTIC NMAX /end REF_CHARACTERISTIC
 /begin IN_MEASUREMENT fra_w fr_w nmot_w rinh_w rl_w tmotlin udkp1_w udkp2_w upwg1_w upwg2d_w upwg2_w vfzg /end IN_MEASUREMENT
 /begin OUT_MEASUREMENT fr2_u fra2_u fra_u fr_u rinh2_u rinh_u rinv2_u rinv_u tmot_u tpsvkmf2_u tpsvkmf_u udkp1_u udkp2_u upwg1_u upwg2d_u upwg2_u vfzg_u /end OUT_MEASUREMENT
 /begin LOC_MEASUREMENT /end LOC_MEASUREMENT
 /begin SUB_FUNCTION /end SUB_FUNCTION
/end FUNCTION
/begin FUNCTION DFFTK "9.10      Diagnose; Kundenspezifische Auswahlliste für Freeze Frame-Werte" /begin DEF_CHARACTERISTIC /end DEF_CHARACTERISTIC /begin REF_CHARACTERISTIC /end REF_CHARACTERISTIC /begin IN_MEASUREMENT /end IN_MEASUREMENT /begin OUT_MEASUREMENT /end OUT_MEASUREMENT /begin LOC_MEASUREMENT /end LOC_MEASUREMENT /begin SUB_FUNCTION /end SUB_FUNCTION /end FUNCTION
/begin FUNCTION DFPM "3.40      OBDII; Fehlerpfadmanager" /begin DEF_CHARACTERISTIC /end DEF_CHARACTERISTIC /begin REF_CHARACTERISTIC CWFLC /end REF_CHARACTERISTIC
 /begin IN_MEASUREMENT bbwuc B_pwf egaspfad mi_duf mpfad nmot rstpfad skapfad tans tmot tmotlin top_w ushk usvk vfzg /end IN_MEASUREMENT
 /begin OUT_MEASUREMENT bbno bbsp3 bbtim B_no B_sp3 B_tim dfcmFcm dfcmNo dfcmSfp dfpmEpclState dfpmMilState dfp_ap fcmcla_0_A fcmcla_1_A fcmcla_2_A fcmcla_3_A fcmcla_4_A fcmdfp_0_A fcmdfp_1_A fcmdfp_2_A fcmdfp_3_A fcmdfp_4_A fcmdlc_0_A fcmdlc_1_A fcmdlc_2_A fcmdlc_3_A fcmdlc_4_A fcmEnd fcmfes_0_A fcmfes_1_A fcmfes_2_A fcmfes_3_A fcmfes_4_A fcmflc_0_A fcmflc_1_A fcmflc_2_A fcmflc_3_A fcmflc_4_A fcmfps_0_A fcmfps_1_A fcmfps_2_A fcmfps_3_A fcmfps_4_A fcmfrz0_0_A fcmfrz0_1_A fcmfrz0_2_A fcmfrz0_3_A fcmfrz0_4_A fcmfrz1_0_A fcmfrz1_1_A fcmfrz1_2_A fcmfrz1_3_A fcmfrz1_4_A fcmfrz10_0_A fcmfrz10_1_A fcmfrz10_2_A fcmfrz10_3_A fcmfrz10_4_A fcmfrz2_0_A fcmfrz2_1_A fcmfrz2_2_A fcmfrz2_3_A fcmfrz2_4_A fcmfrz3_0_A fcmfrz3_1_A fcmfrz3_2_A fcmfrz3_3_A fcmfrz3_4_A fcmfrz4_0_A fcmfrz4_1_A fcmfrz4_2_A fcmfrz4_3_A fcmfrz4_4_A fcmfrz5_0_A fcmfrz5_1_A fcmfrz5_2_A fcmfrz5_3_A fcmfrz5_4_A fcmfrz6_0_A fcmfrz6_1_A fcmfrz6_2_A fcmfrz6_3_A fcmfrz6_4_A fcmfrz7_0_A fcmfrz7_1_A fcmfrz7_2_A fcmfrz7_3_A fcmfrz7_4_A fcmfrz8_0_A fcmfrz8_1_A fcmfrz8_2_A fcmfrz8_3_A fcmfrz8_4_A fcmfrz9_0_A fcmfrz9_1_A fcmfrz9_2_A fcmfrz9_3_A fcmfrz9_4_A fcmhlc_0_A fcmhlc_1_A fcmhlc_2_A fcmhlc_3_A fcmhlc_4_A fcmhz_0_A fcmhz_1_A fcmhz_2_A fcmhz_3_A fcmhz_4_A FCMTab fcmtsf_0_A fcmtsf_1_A fcmtsf_2_A fcmtsf_3_A fcmtsf_4_A fcmtyp_0_A fcmtyp_1_A fcmtyp_2_A fcmtyp_3_A fcmtyp_4_A /end OUT_MEASUREMENT
 /begin LOC_MEASUREMENT /end LOC_MEASUREMENT
 /begin SUB_FUNCTION /end SUB_FUNCTION
/end FUNCTION
/begin FUNCTION DFPMEEP "3.50      Diagnose; Fehlerpfadmanager, EEPROM-Speicherung" /begin DEF_CHARACTERISTIC /end DEF_CHARACTERISTIC /begin REF_CHARACTERISTIC CWFLC /end REF_CHARACTERISTIC /begin IN_MEASUREMENT B_pwf dfcmNo fcmEnd FCMTab ffzdfp /end IN_MEASUREMENT /begin OUT_MEASUREMENT /end OUT_MEASUREMENT /begin LOC_MEASUREMENT /end LOC_MEASUREMENT /begin SUB_FUNCTION /end SUB_FUNCTION /end FUNCTION
/begin FUNCTION DFPMNL "2.10      Diagnose Fehlerpfadmanagement im Nachlauf" /begin DEF_CHARACTERISTIC /end DEF_CHARACTERISTIC /begin REF_CHARACTERISTIC CWFLC /end REF_CHARACTERISTIC /begin IN_MEASUREMENT B_nlobd fcmEnd /end IN_MEASUREMENT /begin OUT_MEASUREMENT /end OUT_MEASUREMENT /begin LOC_MEASUREMENT /end LOC_MEASUREMENT /begin SUB_FUNCTION /end SUB_FUNCTION /end FUNCTION
/begin FUNCTION DFPMOVF "2.10      Diagnose Fehlerpfadmanagement, Memory Overflow" /begin DEF_CHARACTERISTIC /end DEF_CHARACTERISTIC /begin REF_CHARACTERISTIC CWFLC /end REF_CHARACTERISTIC /begin IN_MEASUREMENT fcmEnd /end IN_MEASUREMENT /begin OUT_MEASUREMENT /end OUT_MEASUREMENT /begin LOC_MEASUREMENT /end LOC_MEASUREMENT /begin SUB_FUNCTION /end SUB_FUNCTION /end FUNCTION
/begin FUNCTION DFPMPWF "1.10      Diagnose Fehlerpfadmanagement; Erkennung Powerfail" /begin DEF_CHARACTERISTIC /end DEF_CHARACTERISTIC /begin REF_CHARACTERISTIC /end REF_CHARACTERISTIC /begin IN_MEASUREMENT fcmEnd /end IN_MEASUREMENT /begin OUT_MEASUREMENT /end OUT_MEASUREMENT /begin LOC_MEASUREMENT /end LOC_MEASUREMENT /begin SUB_FUNCTION /end SUB_FUNCTION /end FUNCTION
/begin FUNCTION DFPM_BGRBS "" /begin DEF_CHARACTERISTIC CDCSWE CDKSWE CDTSWE CLASWE FFTSWE TSFSWE /end DEF_CHARACTERISTIC /begin REF_CHARACTERISTIC /end REF_CHARACTERISTIC /begin IN_MEASUREMENT /end IN_MEASUREMENT
 /begin OUT_MEASUREMENT B_beswe B_bkswe B_clswe B_ftswe B_mnswe B_mxswe B_npswe B_siswe E_swe sfpswe TYP_swe Z_swe /end OUT_MEASUREMENT
 /begin LOC_MEASUREMENT /end LOC_MEASUREMENT
 /begin SUB_FUNCTION /end SUB_FUNCTION
/end FUNCTION
/begin FUNCTION DFPM_CAIR "" /begin DEF_CHARACTERISTIC CDCCAIR CDKCAIR CDTCAIR CLACAIR FFTCAIR TSFCAIR /end DEF_CHARACTERISTIC /begin REF_CHARACTERISTIC /end REF_CHARACTERISTIC /begin IN_MEASUREMENT /end IN_MEASUREMENT
 /begin OUT_MEASUREMENT B_avcair B_becair B_bkcair B_clcair B_ftcair B_mncair B_mxcair B_npcair B_pycair B_sccair B_sicair E_cair sfpcair TYP_cair Z_cair /end OUT_MEASUREMENT
 /begin LOC_MEASUREMENT /end LOC_MEASUREMENT
 /begin SUB_FUNCTION /end SUB_FUNCTION
/end FUNCTION
/begin FUNCTION DFPM_CALL "" /begin DEF_CHARACTERISTIC /end DEF_CHARACTERISTIC /begin REF_CHARACTERISTIC /end REF_CHARACTERISTIC /begin IN_MEASUREMENT /end IN_MEASUREMENT /begin OUT_MEASUREMENT /end OUT_MEASUREMENT /begin LOC_MEASUREMENT /end LOC_MEASUREMENT /begin SUB_FUNCTION /end SUB_FUNCTION /end FUNCTION
/begin FUNCTION DFPM_CAS "" /begin DEF_CHARACTERISTIC CDCCAS CDKCAS CDTCAS CLACAS FFTCAS TSFCAS /end DEF_CHARACTERISTIC /begin REF_CHARACTERISTIC /end REF_CHARACTERISTIC /begin IN_MEASUREMENT /end IN_MEASUREMENT
 /begin OUT_MEASUREMENT B_avcas B_becas B_bkcas B_clcas B_ftcas B_mncas B_mxcas B_npcas B_pycas B_sccas B_sicas E_cas sfpcas TYP_cas Z_cas /end OUT_MEASUREMENT
 /begin LOC_MEASUREMENT /end LOC_MEASUREMENT
 /begin SUB_FUNCTION /end SUB_FUNCTION
/end FUNCTION
/begin FUNCTION DFPM_CAT "" /begin DEF_CHARACTERISTIC CDCCAT CDKCAT CDTCAT CLACAT FFTCAT TSFCAT /end DEF_CHARACTERISTIC /begin REF_CHARACTERISTIC /end REF_CHARACTERISTIC /begin IN_MEASUREMENT /end IN_MEASUREMENT
 /begin OUT_MEASUREMENT B_avcat B_becat B_bkcat B_clcat B_ftcat B_mncat B_mxcat B_npcat B_pycat B_sccat B_sicat E_cat sfpcat TYP_cat Z_cat /end OUT_MEASUREMENT
 /begin LOC_MEASUREMENT /end LOC_MEASUREMENT
 /begin SUB_FUNCTION /end SUB_FUNCTION
/end FUNCTION
/begin FUNCTION DFPM_CBSG "" /begin DEF_CHARACTERISTIC /end DEF_CHARACTERISTIC /begin REF_CHARACTERISTIC /end REF_CHARACTERISTIC /begin IN_MEASUREMENT /end IN_MEASUREMENT /begin OUT_MEASUREMENT /end OUT_MEASUREMENT /begin LOC_MEASUREMENT /end LOC_MEASUREMENT /begin SUB_FUNCTION /end SUB_FUNCTION /end FUNCTION
/begin FUNCTION DFPM_CGE "" /begin DEF_CHARACTERISTIC CDCCGE CDKCGE CDTCGE CLACGE FFTCGE TSFCGE /end DEF_CHARACTERISTIC /begin REF_CHARACTERISTIC /end REF_CHARACTERISTIC /begin IN_MEASUREMENT /end IN_MEASUREMENT
 /begin OUT_MEASUREMENT B_avcge B_becge B_bkcge B_clcge B_ftcge B_mncge B_mxcge B_npcge B_pycge B_sccge B_sicge E_cge sfpcge TYP_cge Z_cge /end OUT_MEASUREMENT
 /begin LOC_MEASUREMENT /end LOC_MEASUREMENT
 /begin SUB_FUNCTION /end SUB_FUNCTION
/end FUNCTION
/begin FUNCTION DFPM_CGRA "" /begin DEF_CHARACTERISTIC CDCCGRA CDKCGRA CDTCGRA CLACGRA FFTCGRA TSFCGRA /end DEF_CHARACTERISTIC /begin REF_CHARACTERISTIC /end REF_CHARACTERISTIC /begin IN_MEASUREMENT /end IN_MEASUREMENT
 /begin OUT_MEASUREMENT B_avcgra B_becgra B_bkcgra B_clcgra B_ftcgra B_mncgra B_mxcgra B_npcgra B_pycgra B_sccgra B_sicgra E_cgra sfpcgra TYP_cgra Z_cgra /end OUT_MEASUREMENT
 /begin LOC_MEASUREMENT /end LOC_MEASUREMENT
 /begin SUB_FUNCTION /end SUB_FUNCTION
/end FUNCTION
/begin FUNCTION DFPM_CIF "" /begin DEF_CHARACTERISTIC CDCCIF CDKCIF CDTCIF CLACIF FFTCIF TSFCIF /end DEF_CHARACTERISTIC /begin REF_CHARACTERISTIC /end REF_CHARACTERISTIC /begin IN_MEASUREMENT /end IN_MEASUREMENT
 /begin OUT_MEASUREMENT B_avcif B_becif B_bkcif B_clcif B_ftcif B_mncif B_mxcif B_npcif B_pycif B_sccif B_sicif E_cif sfpcif TYP_cif Z_cif /end OUT_MEASUREMENT
 /begin LOC_MEASUREMENT /end LOC_MEASUREMENT
 /begin SUB_FUNCTION /end SUB_FUNCTION
/end FUNCTION
/begin FUNCTION DFPM_CINS "" /begin DEF_CHARACTERISTIC CDCCINS CDKCINS CDTCINS CLACINS FFTCINS TSFCINS /end DEF_CHARACTERISTIC /begin REF_CHARACTERISTIC /end REF_CHARACTERISTIC /begin IN_MEASUREMENT /end IN_MEASUREMENT
 /begin OUT_MEASUREMENT B_avcins B_becins B_bkcins B_clcins B_ftcins B_mncins B_mxcins B_npcins B_pycins B_sccins B_sicins E_cins sfpcins TYP_cins Z_cins /end OUT_MEASUREMENT
 /begin LOC_MEASUREMENT /end LOC_MEASUREMENT
 /begin SUB_FUNCTION /end SUB_FUNCTION
/end FUNCTION
/begin FUNCTION DFPM_CKLA "" /begin DEF_CHARACTERISTIC CDCCKLA CDKCKLA CDTCKLA CLACKLA FFTCKLA TSFCKLA /end DEF_CHARACTERISTIC /begin REF_CHARACTERISTIC /end REF_CHARACTERISTIC /begin IN_MEASUREMENT /end IN_MEASUREMENT
 /begin OUT_MEASUREMENT B_avckla B_beckla B_bkckla B_clckla B_ftckla B_mnckla B_mxckla B_npckla B_pyckla B_scckla B_sickla E_ckla sfpckla TYP_ckla Z_ckla /end OUT_MEASUREMENT
 /begin LOC_MEASUREMENT /end LOC_MEASUREMENT
 /begin SUB_FUNCTION /end SUB_FUNCTION
/end FUNCTION
/begin FUNCTION DFPM_CLWS "" /begin DEF_CHARACTERISTIC /end DEF_CHARACTERISTIC /begin REF_CHARACTERISTIC /end REF_CHARACTERISTIC /begin IN_MEASUREMENT /end IN_MEASUREMENT /begin OUT_MEASUREMENT /end OUT_MEASUREMENT /begin LOC_MEASUREMENT /end LOC_MEASUREMENT /begin SUB_FUNCTION /end SUB_FUNCTION /end FUNCTION
/begin FUNCTION DFPM_CNIV "" /begin DEF_CHARACTERISTIC /end DEF_CHARACTERISTIC /begin REF_CHARACTERISTIC /end REF_CHARACTERISTIC /begin IN_MEASUREMENT /end IN_MEASUREMENT /begin OUT_MEASUREMENT /end OUT_MEASUREMENT /begin LOC_MEASUREMENT /end LOC_MEASUREMENT /begin SUB_FUNCTION /end SUB_FUNCTION /end FUNCTION
/begin FUNCTION DFPM_CZAS "" /begin DEF_CHARACTERISTIC /end DEF_CHARACTERISTIC /begin REF_CHARACTERISTIC /end REF_CHARACTERISTIC /begin IN_MEASUREMENT /end IN_MEASUREMENT /begin OUT_MEASUREMENT /end OUT_MEASUREMENT /begin LOC_MEASUREMENT /end LOC_MEASUREMENT /begin SUB_FUNCTION /end SUB_FUNCTION /end FUNCTION
/begin FUNCTION DFPM_DAAV "" /begin DEF_CHARACTERISTIC CDCAAV CDKAAV CDTAAV CLAAAV FFTAAV TSFAAV /end DEF_CHARACTERISTIC /begin REF_CHARACTERISTIC /end REF_CHARACTERISTIC /begin IN_MEASUREMENT /end IN_MEASUREMENT
 /begin OUT_MEASUREMENT B_beaav B_bkaav B_claav B_ftaav B_mnaav B_mxaav B_npaav B_siaav E_aav sfpaav TYP_aav Z_aav /end OUT_MEASUREMENT
 /begin LOC_MEASUREMENT /end LOC_MEASUREMENT
 /begin SUB_FUNCTION /end SUB_FUNCTION
/end FUNCTION
/begin COMPU_METHOD bfgrsc_ub_q0p024_o3p984 "" RAT_FUNC "%6.3" "m/s^2" COEFFS 0 1 3.984 0 0 0.024 /end COMPU_METHOD
/begin COMPU_METHOD B_TRUE "boolsche Zustände, positive Logik" TAB_VERB "%6.3" "" COMPU_TAB_REF B_TRUE /end COMPU_METHOD
/begin COMPU_VTAB B_TRUE "boolsche Zustände, positive Logik" TAB_VERB 2 0 "----" 1 "TRUE" /end COMPU_VTAB
/begin COMPU_METHOD DEZ "1 : 1 Umrechnug (dez/hex)" RAT_FUNC "%6.2" "" COEFFS 0 1 0 0 0 1 /end COMPU_METHOD
/begin COMPU_METHOD dez "1 : 1 Umrechnug (dez/hex)" RAT_FUNC "%6.2" "" COEFFS 0 1 0 0 0 1 /end COMPU_METHOD
/begin COMPU_METHOD dlw_sw_q0p04375 "" RAT_FUNC "%6.4" "°/s" COEFFS 0 32767 0 0 0 1434 /end COMPU_METHOD
/begin COMPU_METHOD fak_q0p1 "" RAT_FUNC "%6.3" "" COEFFS 0 1 0 0 0 0.1 /end COMPU_METHOD
/begin COMPU_METHOD fak_sb_b1 "" RAT_FUNC "%6.4" "-" COEFFS 0 256 0 0 0 2 /end COMPU_METHOD
/begin COMPU_METHOD fak_sw_b4 "" RAT_FUNC "%6.5" "-" COEFFS 0 65536 0 0 0 8 /end COMPU_METHOD
/begin COMPU_METHOD fak_sw_q0p001 "" RAT_FUNC "%6.5" "" COEFFS 0 32768 0 0 0 32.768 /end COMPU_METHOD
/begin COMPU_METHOD fak_ub_b2 "" RAT_FUNC "%6.4" "-" COEFFS 0 256 0 0 0 2 /end COMPU_METHOD
/begin COMPU_METHOD fak_ub_b4 "" RAT_FUNC "%6.4" "-" COEFFS 0 256 0 0 0 4 /end COMPU_METHOD
/begin COMPU_METHOD fak_uw_b16 "" RAT_FUNC "%6.5" "-" COEFFS 0 65536 0 0 0 16 /end COMPU_METHOD
/begin COMPU_METHOD fak_uw_b2 "" RAT_FUNC "%7.6" "-" COEFFS 0 65536 0 0 0 2 /end COMPU_METHOD
/begin COMPU_METHOD fak_uw_b4 "" RAT_FUNC "%7.6" "-" COEFFS 0 65536 0 0 0 4 /end COMPU_METHOD
/begin COMPU_METHOD fak_uw_q0p0001 "" RAT_FUNC "%7.6" "" COEFFS 0 65536 0 0 0 6.5536 /end COMPU_METHOD
/begin COMPU_METHOD fak_uw_q0p01 "" RAT_FUNC "%6.4" "" COEFFS 0 1 0 0 0 0.01 /end COMPU_METHOD
/begin COMPU_METHOD kva_ub_q20 "" RAT_FUNC "%6.1" "L/Zyl." COEFFS 0 1 0 0 0 20 /end COMPU_METHOD
/begin COMPU_METHOD kw_q1 "" RAT_FUNC "%6.2" "°KW" COEFFS 0 1 0 0 0 1 /end COMPU_METHOD
/begin COMPU_METHOD lw_sw_q0p04375 "" RAT_FUNC "%6.4" "°" COEFFS 0 32767 0 0 0 1434 /end COMPU_METHOD
/begin COMPU_METHOD md_q0p25 "" RAT_FUNC "%6.3" "Nm" COEFFS 0 65536 0 0 0 16384 /end COMPU_METHOD
/begin COMPU_METHOD md_ub_q10 "" RAT_FUNC "%6.1" "Nm" COEFFS 0 1 0 0 0 10 /end COMPU_METHOD
/begin COMPU_METHOD m_q0p1 "" RAT_FUNC "%6.3" "kg/h" COEFFS 0 10 0 0 0 1 /end COMPU_METHOD
/begin COMPU_METHOD m_sw_b3276p8 "" RAT_FUNC "%6.3" "kg/h" COEFFS 0 1 0 0 0 0.1 /end COMPU_METHOD
/begin COMPU_METHOD m_uw_b4660 "" RAT_FUNC "%6.4" "g" COEFFS 0 3600 0 0 0 256 /end COMPU_METHOD
/begin COMPU_METHOD m_uw_b6553p5 "" RAT_FUNC "%6.3" "kg/h" COEFFS 0 1 0 0 0 0.1 /end COMPU_METHOD
/begin COMPU_METHOD nmot_ub_q10 "" RAT_FUNC "%6.1" "U/min" COEFFS 0 1 0 0 0 10 /end COMPU_METHOD
/begin COMPU_METHOD nmot_ub_q100 "" RAT_FUNC "%6.0" "U/min" COEFFS 0 1 0 0 0 100 /end COMPU_METHOD
/begin COMPU_METHOD nmot_ub_q25 "" RAT_FUNC "%6.1" "Upm" COEFFS 0 1 0 0 0 25 /end COMPU_METHOD
/begin COMPU_METHOD nmot_ub_q40 "" RAT_FUNC "%6.1" "Upm" COEFFS 0 1 0 0 0 40 /end COMPU_METHOD
/begin COMPU_METHOD p_q0p2 "" RAT_FUNC "%6.3" "bar" COEFFS 0 5 0 0 0 1 /end COMPU_METHOD
/begin COMPU_METHOD p_sw_q0p039 "" RAT_FUNC "%6.4" "hPa" COEFFS 0 256 0 0 0 10 /end COMPU_METHOD
/begin COMPU_METHOD p_ub_q10 "" RAT_FUNC "%6.1" "hPa" COEFFS 0 1 0 0 0 10 /end COMPU_METHOD
/begin COMPU_METHOD p_ub_q5 "" RAT_FUNC "%6.2" "hPa" COEFFS 0 1 0 0 0 5 /end COMPU_METHOD
/begin COMPU_METHOD p_uw_q0p039 "" RAT_FUNC "%6.4" "hPa" COEFFS 0 256 0 0 0 10 /end COMPU_METHOD
/begin COMPU_METHOD p_uw_q0p078 "" RAT_FUNC "%6.4" "hpa" COEFFS 0 256 0 0 0 20 /end COMPU_METHOD
/begin COMPU_METHOD relDK_ub_b100 "" RAT_FUNC "%6.3" "% DK" COEFFS 0 255 0 0 0 100 /end COMPU_METHOD
/begin COMPU_METHOD rel_q0p39 "" RAT_FUNC "%6.3" "%" COEFFS 0 256 0 0 0 100 /end COMPU_METHOD
/begin COMPU_METHOD rel_q0p4 "" RAT_FUNC "%6.3" "%" COEFFS 0 1 0 0 0 0.4 /end COMPU_METHOD
/begin COMPU_METHOD rel_sw_b1536 "" RAT_FUNC "%6.4" "%" COEFFS 0 65536 0 0 0 3072 /end COMPU_METHOD
/begin COMPU_METHOD rel_ub_b100 "" RAT_FUNC "%6.3" "%" COEFFS 0 256 0 0 0 100 /end COMPU_METHOD
/begin COMPU_METHOD rel_ub_b99p6 "" RAT_FUNC "%6.3" "%" COEFFS 0 256 0 0 0 100 /end COMPU_METHOD
/begin COMPU_METHOD rel_ub_q0p75 "" RAT_FUNC "%6.3" "%" COEFFS 0 1 0 0 0 0.75 /end COMPU_METHOD
/begin COMPU_METHOD rel_uw_b100 "" RAT_FUNC "%6.4" "%" COEFFS 0 65536 0 0 0 100 /end COMPU_METHOD
/begin COMPU_METHOD rel_uw_b200 "" RAT_FUNC "%6.4" "%" COEFFS 0 65536 0 0 0 200 /end COMPU_METHOD
/begin COMPU_METHOD rel_uw_b728 "" RAT_FUNC "%4.2" "%/s" COEFFS 0 6.5536 0 0 0 1 /end COMPU_METHOD
/begin COMPU_METHOD rel_uw_q0p0234 "" RAT_FUNC "%6.4" "%" COEFFS 0 32 0 0 0 0.75 /end COMPU_METHOD
/begin COMPU_METHOD r_ub_q64 "" RAT_FUNC "%6.1" "Ohm" COEFFS 0 1 0 0 0 64 /end COMPU_METHOD
/begin COMPU_METHOD spg_ubatt "" RAT_FUNC "%6.4" "V" COEFFS 0 1 0 0 0 0.0704 /end COMPU_METHOD
/begin COMPU_METHOD spg_ub_b5 "" RAT_FUNC "%6.4" "V" COEFFS 0 256 0 0 0 5 /end COMPU_METHOD
/begin COMPU_METHOD s_q1_km "" RAT_FUNC "%6.2" "km" COEFFS 0 1 0 0 0 1 /end COMPU_METHOD
/begin COMPU_METHOD s_q63p75mm "" RAT_FUNC "%6.3" "mm" COEFFS 0 1 0 0 0 0.25 /end COMPU_METHOD
/begin COMPU_METHOD s_q6_km "" RAT_FUNC "%6.2" "km" COEFFS 0 1 0 0 0 6 /end COMPU_METHOD
/begin COMPU_METHOD t100msxms_ub_b255 "" RAT_FUNC "%6.2" "ms" COEFFS 0 1 0 0 0 1 /end COMPU_METHOD
/begin COMPU_METHOD t100msxs_sw_b3276p8 "" RAT_FUNC "%6.3" "s" COEFFS 0 10 0 0 0 1 /end COMPU_METHOD
/begin COMPU_METHOD t100msxs_ub_b25p5 "" RAT_FUNC "%6.3" "s" COEFFS 0 1 0 0 0 0.1 /end COMPU_METHOD
/begin COMPU_METHOD t100msxs_uw_b6553p5 "" RAT_FUNC "%6.3" "s" COEFFS 0 1 0 0 0 0.1 /end COMPU_METHOD
/begin COMPU_METHOD t100msxs_uw_b6553p6 "" RAT_FUNC "%6.3" "s" COEFFS 0 10 0 0 0 1 /end COMPU_METHOD
/begin COMPU_METHOD t10msxs_ub_b10p2 "" RAT_FUNC "%6.4" "s" COEFFS 0 1 0 0 0 0.04 /end COMPU_METHOD
/begin COMPU_METHOD t10msxs_ub_b2p55 "" RAT_FUNC "%6.4" "s" COEFFS 0 1 0 0 0 0.01 /end COMPU_METHOD
/begin COMPU_METHOD t10msxs_uw_b655p35 "" RAT_FUNC "%6.4" "s" COEFFS 0 1 0 0 0 0.01 /end COMPU_METHOD
/begin COMPU_METHOD t1sxs_ub_b255 "" RAT_FUNC "%6.2" "s" COEFFS 0 1 0 0 0 1 /end COMPU_METHOD
/begin COMPU_METHOD t1sxs_uw_q1 "" RAT_FUNC "%6.2" "s" COEFFS 0 1 0 0 0 1 /end COMPU_METHOD
/begin COMPU_METHOD t200msxs_uw_q0p2 "" RAT_FUNC "%6.3" "s" COEFFS 0 1 0 0 0 0.2 /end COMPU_METHOD
/begin COMPU_METHOD t20msxs_ub_b5p1 "" RAT_FUNC "%6.4" "s" COEFFS 0 1 0 0 0 0.02 /end COMPU_METHOD
/begin COMPU_METHOD t20msxs_ub_q0p02 "" RAT_FUNC "%6.4" "s" COEFFS 0 50 0 0 0 1 /end COMPU_METHOD
/begin COMPU_METHOD t20msxs_uw_q0p02 "" RAT_FUNC "%6.4" "s" COEFFS 0 1 0 0 0 0.02 /end COMPU_METHOD
/begin COMPU_METHOD t400msxs_ub_b102 "" RAT_FUNC "%6.3" "s" COEFFS 0 1 0 0 0 0.4 /end COMPU_METHOD
/begin COMPU_METHOD temp_q0p0234_o273 "" RAT_FUNC "%6.1" "Grad C" COEFFS 0 1 273.15 0 0 0.0234375 /end COMPU_METHOD
/begin COMPU_METHOD temp_ub_q0p75_o48 "" RAT_FUNC "%6.2" "Grad C" COEFFS 0 1 48 0 0 0.75 /end COMPU_METHOD
/begin COMPU_METHOD temp_ub_q1_o40 "" RAT_FUNC "%6.2" "Grad C" COEFFS 0 1 40 0 0 1 /end COMPU_METHOD
/begin COMPU_METHOD temp_ub_q1_o60 "" RAT_FUNC "%6.2" "Grad C" COEFFS 0 1 60 0 0 1 /end COMPU_METHOD
/begin COMPU_METHOD temp_uw_q0p0195 "" RAT_FUNC "%6.4" "Grad C" COEFFS 0 256 0 0 0 5 /end COMPU_METHOD
/begin COMPU_METHOD temp_uw_q0p0195_o50 "" RAT_FUNC "%6.2" "Grad C" COEFFS 0 256 12800 0 0 5 /end COMPU_METHOD
/begin COMPU_METHOD tz100msxs_uw_b3276p8 "" RAT_FUNC "%6.1" "s" COEFFS 0 0 3276.8 0 1 0 /end COMPU_METHOD
/begin COMPU_METHOD t_q1 "" RAT_FUNC "%6.2" "s" COEFFS 0 1 0 0 0 1 /end COMPU_METHOD
/begin COMPU_METHOD t_q20_ms "" RAT_FUNC "%6.1" "ms" COEFFS 0 1 0 0 0 20 /end COMPU_METHOD
/begin COMPU_METHOD t_q4_s "" RAT_FUNC "%6.2" "s" COEFFS 0 1 0 0 0 4 /end COMPU_METHOD
/begin COMPU_METHOD uefktget_ub_b25p4 "" RAT_FUNC "%6.3" "" COEFFS 0 10 0 0 0 1 /end COMPU_METHOD
/begin COMPU_METHOD vfzgkb_uw_b655 "" RAT_FUNC "%6.4" "km/h" COEFFS 0 65536 0 0 0 655 /end COMPU_METHOD
/begin COMPU_METHOD vfzg_q1p0 "" RAT_FUNC "%6.2" "km/h" COEFFS 0 1 0 0 0 1 /end COMPU_METHOD
/begin COMPU_METHOD vfzg_ub_q1p25 "" RAT_FUNC "%6.2" "km/h" COEFFS 0 1 0 0 0 1.25 /end COMPU_METHOD
/begin COMPU_METHOD vfzg_uw_b512 "" RAT_FUNC "%6.4" "km/h" COEFFS 0 65536 0 0 0 512 /end COMPU_METHOD
/begin COMPU_METHOD volgrd_q0p001 "" RAT_FUNC "%6.5" "L/mm" COEFFS 0 1 0 0 0 0.001 /end COMPU_METHOD
/begin COMPU_METHOD vol_q0p1_l "" RAT_FUNC "%6.3" "L" COEFFS 0 1 0 0 0 0.1 /end COMPU_METHOD
/begin COMPU_METHOD vol_q1_l "" RAT_FUNC "%6.2" "L" COEFFS 0 1 0 0 0 1 /end COMPU_METHOD
/begin COMPU_METHOD zk100msxs_uw_b6553 "" RAT_FUNC "%12.4" "s" COEFFS 0 0 65536 0 10 0 /end COMPU_METHOD
/begin COMPU_METHOD zk1sxs_uw_b65535 "" RAT_FUNC "%6.0" "s" COEFFS 0 0 65535 0 1 0 /end COMPU_METHOD
/begin COMPU_METHOD default "" RAT_FUNC "%6.2" "" COEFFS 0 1 0 0 0 1 /end COMPU_METHOD
/begin RECORD_LAYOUT KfAxUbAyUbSstxUbSstyUbWUb NO_AXIS_PTS_X 1 UBYTE NO_AXIS_PTS_Y 2 UBYTE AXIS_PTS_X 3 UBYTE INDEX_INCR DIRECT AXIS_PTS_Y 4 UBYTE INDEX_INCR DIRECT FNC_VALUES 5 UBYTE COLUMN_DIR DIRECT /end RECORD_LAYOUT
/begin RECORD_LAYOUT KlAUbSstSwWUw NO_AXIS_PTS_X 1 UWORD AXIS_PTS_X 2 SWORD INDEX_INCR DIRECT FNC_VALUES 3 UWORD COLUMN_DIR DIRECT /end RECORD_LAYOUT
/begin RECORD_LAYOUT KlAUbSstUbWSb NO_AXIS_PTS_X 1 UBYTE AXIS_PTS_X 2 UBYTE INDEX_INCR DIRECT FNC_VALUES 3 SBYTE COLUMN_DIR DIRECT /end RECORD_LAYOUT
/begin RECORD_LAYOUT KlAUbSstUbWUb NO_AXIS_PTS_X 1 UBYTE AXIS_PTS_X 2 UBYTE INDEX_INCR DIRECT FNC_VALUES 3 UBYTE COLUMN_DIR DIRECT /end RECORD_LAYOUT
/begin RECORD_LAYOUT KlAUbSstUwWUw NO_AXIS_PTS_X 1 UWORD AXIS_PTS_X 2 UWORD INDEX_INCR DIRECT FNC_VALUES 3 UWORD COLUMN_DIR DIRECT /end RECORD_LAYOUT
/begin RECORD_LAYOUT KlAUwSstUwWUw NO_AXIS_PTS_X 1 UWORD AXIS_PTS_X 2 UWORD INDEX_INCR DIRECT FNC_VALUES 3 UWORD COLUMN_DIR DIRECT /end RECORD_LAYOUT
/begin RECORD_LAYOUT KwbUb FNC_VALUES 1 UBYTE COLUMN_DIR DIRECT /end RECORD_LAYOUT
/begin RECORD_LAYOUT KwbUw FNC_VALUES 1 UWORD COLUMN_DIR DIRECT /end RECORD_LAYOUT
/begin RECORD_LAYOUT KwSb FNC_VALUES 1 SBYTE COLUMN_DIR DIRECT /end RECORD_LAYOUT
/begin RECORD_LAYOUT KwSw FNC_VALUES 1 SWORD COLUMN_DIR DIRECT /end RECORD_LAYOUT
/begin RECORD_LAYOUT KwUb FNC_VALUES 1 UBYTE COLUMN_DIR DIRECT /end RECORD_LAYOUT
/begin RECORD_LAYOUT KwUw FNC_VALUES 1 UWORD COLUMN_DIR DIRECT /end RECORD_LAYOUT
/end MODULE
/end PROJECT
