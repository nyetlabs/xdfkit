ASAP2_VERSION 1 3
/begin PROJECT X505R_24d1_0 "4019.XX"
/begin HEADER "" VERSION "X505R_24d1_0" PROJECT_NO X505R_24d1_0 /end HEADER
/begin MODULE DIM ""
/begin MOD_COMMON "" BYTE_ORDER MSB_LAST ALIGNMENT_BYTE 1 ALIGNMENT_WORD 2 ALIGNMENT_LONG 2 /end MOD_COMMON
/begin CHARACTERISTIC BZ_MSR_UC "" VALUE 0x811A7A KwUb 255.0 dez 0.00 255.0 FORMAT "%5.1" /end CHARACTERISTIC
/begin CHARACTERISTIC CNOKT "Codewort Niederoktan-Kraftstoff" VALUE 0x81A386 KwUb 255.0 dez 0.00 255.0 FORMAT "%5.1" /end CHARACTERISTIC
/begin CHARACTERISTIC CWKHZW "Codewort für spätesten Zündwinkel bei Katheizen" VALUE 0x81203D KwUb 255.0 dez 0.00 255.0 FORMAT "%5.1" /end CHARACTERISTIC
/begin CHARACTERISTIC CWVSV "Codewort für Deaktivierung VS_VERST (CWVSV = 0: VS_VERST nicht aktiv)" VALUE 0x810162 KwUb 255.0 dez 0.00 255.0 FORMAT "%5.1" /end CHARACTERISTIC
/begin CHARACTERISTIC CW_FUBND "Codewort für Funkenbandzündung" VALUE 0x81A507 KwUb 255.0 dez 0.00 255.0 FORMAT "%5.1" /end CHARACTERISTIC
/begin CHARACTERISTIC CW_NOROMCHKRESET "" VALUE 0x811C15 KwUb 255.0 dez 0.00 255.0 FORMAT "%5.1" /end CHARACTERISTIC
/begin CHARACTERISTIC DBZ_MN_UC "kleinstes zulässiges Delta des Botschaftszählers f. Befehlstest" VALUE 0x811A7B KwUb 255.0 dez 0.00 255.0 FORMAT "%5.1" /end CHARACTERISTIC
/begin CHARACTERISTIC DBZ_MX_UC "größtes zulässiges Delta des Botschaftszählers f. Befehlstest" VALUE 0x811A7C KwUb 255.0 dez 0.00 255.0 FORMAT "%5.1" /end CHARACTERISTIC
/begin CHARACTERISTIC DNTIPDYN "Einschaltschwelle Drehzahdynamik für Tip-In Offset auf spätesten Zündwinkel" VALUE 0x81203E KwSb 25500. nmotg_sb_q100 -12800. 12700. FORMAT "%5.0" /end CHARACTERISTIC
/begin CHARACTERISTIC DTSDRL "Laständerungsgradientenschwelle für Lastdynamikauslösung" VALUE 0x817432 KwSw 1535.977 rel_sw_q0p0234 -768.0000 767.9766 FORMAT "%8.4" /end CHARACTERISTIC
/begin CHARACTERISTIC DUBZS "Spannungsversatz zwischen SG und ZS" VALUE 0x81A508 KwUb 17.95 spg_ubatt 0.00 17.95 FORMAT "%5.2" /end CHARACTERISTIC
/begin CHARACTERISTIC DZWAML "Auf/Abregelgeschwindigkeit zwischen den Begrenzungskennfeldern" CURVE 0x82982A KlAUbSstUbWSb 191.3 zw_sb_q0p75 -96.00 95.25 FORMAT "%5.2"
 /begin AXIS_DESCR STD_AXIS ml m_ub_b1020 12 0.00 1020. FORMAT "%5.0" DEPOSIT ABSOLUTE /end AXIS_DESCR
/end CHARACTERISTIC
/begin CHARACTERISTIC DZWDYN "Frühverschiebung des Brenngrenzenzündwinkels bei Tip-In" CURVE 0x81A37A GklWSb 191.3 zw_sb_q0p75 -96.00 95.25 FORMAT "%5.2"
 /begin AXIS_DESCR COM_AXIS tmot temp_ub_q0p75_o48 6 -48.00 143.3 AXIS_PTS_REF STM06__UB /end AXIS_DESCR
/end CHARACTERISTIC
/begin CHARACTERISTIC DZWNWSUE "Delta Zündwinkel abhängig von Nockenwellenüberschneidung" CURVE 0x8173EA KlAUbSstUbWSb 191.3 zw_sb_q0p75 -96.00 95.25 FORMAT "%5.2"
 /begin AXIS_DESCR STD_AXIS wnwue kw_q0p5 10 0.00 127.5 FORMAT "%5.1" DEPOSIT ABSOLUTE /end AXIS_DESCR
/end CHARACTERISTIC
/begin CHARACTERISTIC DZWSPM "Delta spätester Zündwinkel abhängig von Motortemperatur" CURVE 0x81A380 GklWSb 191.3 zw_sb_q0p75 -96.00 95.25 FORMAT "%5.2"
 /begin AXIS_DESCR COM_AXIS tmot temp_ub_q0p75_o48 6 -48.00 143.3 AXIS_PTS_REF STM06__UB /end AXIS_DESCR
/end CHARACTERISTIC
/begin CHARACTERISTIC DZWSTTA "Delta Zündwinkel im Start" CURVE 0x82987C KlAUbSstUbWSb 191.3 zw_sb_q0p75 -96.00 95.25 FORMAT "%5.2"
 /begin AXIS_DESCR STD_AXIS tans temp_ub_q0p75_o48 6 -48.00 143.3 FORMAT "%5.1" DEPOSIT ABSOLUTE /end AXIS_DESCR
/end CHARACTERISTIC
/begin CHARACTERISTIC FFLDZ "Folgefunkenladezeit" CURVE 0x82988A KlAUbSstUbWUw 43.69000 tsegment_sy 0.00 43.69000 FORMAT "%8.5"
 /begin AXIS_DESCR STD_AXIS ub spg_ubatt 8 0.00 17.95 FORMAT "%5.2" DEPOSIT ABSOLUTE /end AXIS_DESCR
/end CHARACTERISTIC
/begin CHARACTERISTIC FSWTM "Faktor Schließwinkelkorrektur tmot-abhängig" CURVE 0x81A509 KlAUbSstUbWUb 1.992 fak_ub_b2 0.00 1.992 FORMAT "%5.3"
 /begin AXIS_DESCR STD_AXIS tmot temp_ub_q0p75_o48 5 -48.00 143.3 FORMAT "%5.1" DEPOSIT ABSOLUTE /end AXIS_DESCR
/end CHARACTERISTIC
/begin CHARACTERISTIC FSZTM "Faktor Schließzeitkorrektur tmot-abhängig" CURVE 0x81A514 KlAUbSstUbWUb 1.992 fak_ub_b2 0.00 1.992 FORMAT "%5.3"
 /begin AXIS_DESCR STD_AXIS tmot temp_ub_q0p75_o48 5 -48.00 143.3 FORMAT "%5.1" DEPOSIT ABSOLUTE /end AXIS_DESCR
/end CHARACTERISTIC
/begin CHARACTERISTIC FTOMN "minimale Öffnungszeit" VALUE 0x81A51F KwUb 25.50 txms_ub_q0p1 0.00 25.50 FORMAT "%5.2" /end CHARACTERISTIC
/begin CHARACTERISTIC FTSDRLW "Faktor Schließzeit bei Lastdynamik" CURVE 0x817434 KlAUwSstSwWUw 7.999878 fak_uw_b8 0.00 7.999878 FORMAT "%8.6"
 /begin AXIS_DESCR STD_AXIS tsdrlmx_w rel_sw_q0p0234 6 -768.0000 767.9766 FORMAT "%8.4" DEPOSIT ABSOLUTE /end AXIS_DESCR
/end CHARACTERISTIC
/begin CHARACTERISTIC FUBAOF "Offenzeit für Funkenbandzündung" VALUE 0x8298A4 KwUw 43.69000 tsegment_sy 0.00 43.69000 FORMAT "%8.5" /end CHARACTERISTIC
/begin CHARACTERISTIC FWNMOT "Einschaltschwelle nmot für Funkenbandzündung" VALUE 0x81A520 KwUb 10200. nmot_ub_q40 0.00 10200. FORMAT "%5.0" /end CHARACTERISTIC
/begin CHARACTERISTIC FZWKHMX "Normierung für Faktor Momentenreserve Katheizen" VALUE 0x81203F KwUb 1.992 fak_ub_b2 0.00 1.992 FORMAT "%5.3" /end CHARACTERISTIC
/begin CHARACTERISTIC FZWWLRLN "Wichtung Delta-Zündwinkel im Warmlauf" MAP 0x812283 GkfWUb 1.992 fak_ub_b2 0.00 1.992 FORMAT "%5.3"
 /begin AXIS_DESCR COM_AXIS nmot nmot_ub_q40 12 0.00 10200. AXIS_PTS_REF SNM12ESUB /end AXIS_DESCR
 /begin AXIS_DESCR COM_AXIS rl rel_ub_q0p75 6 0.00 191.3 AXIS_PTS_REF SRL06ESUB /end AXIS_DESCR
/end CHARACTERISTIC
/begin CHARACTERISTIC KFDZK "delta Zündwinkel bei Dauerklopfen" MAP 0x81A387 GkfWSb 191.3 zw_sb_q0p75 -96.00 95.25 FORMAT "%5.2"
 /begin AXIS_DESCR COM_AXIS nmot_w nmot_uw_q0p25 16 0.00 16383.75 AXIS_PTS_REF SNM16ZUUW /end AXIS_DESCR
 /begin AXIS_DESCR COM_AXIS rl_w rel_uw_q0p0234 12 0.00 1535.977 AXIS_PTS_REF SRL12ZUUW /end AXIS_DESCR
/end CHARACTERISTIC
/begin CHARACTERISTIC KFDZWKG "Zündwinkelkorrektur durch Verschieben der Klopfgrenze" MAP 0x829844 KfAxUbAyUbSstxUbSstyUbWSb 191.3 zw_sb_q0p75 -96.00 95.25 FORMAT "%5.2"
 /begin AXIS_DESCR STD_AXIS nmot nmot_ub_q40 8 0.00 10200. FORMAT "%5.0" DEPOSIT ABSOLUTE /end AXIS_DESCR
 /begin AXIS_DESCR STD_AXIS lambas fak_ub_b2 5 0.00 1.992 FORMAT "%5.3" DEPOSIT ABSOLUTE /end AXIS_DESCR
/end CHARACTERISTIC
/begin CHARACTERISTIC KFDZWOB "Delta Zündwinkel Zündwinkeloverboost" MAP 0x8297D4 KfAxUbAyUbSstxUbSstyUbWSb 191.3 zw_sb_q0p75 -96.00 95.25 FORMAT "%5.2"
 /begin AXIS_DESCR STD_AXIS nmot nmot_ub_q40 4 0.00 10200. FORMAT "%5.0" DEPOSIT ABSOLUTE /end AXIS_DESCR
 /begin AXIS_DESCR STD_AXIS rl rel_ub_q0p75 4 0.00 191.3 FORMAT "%5.1" DEPOSIT ABSOLUTE /end AXIS_DESCR
/end CHARACTERISTIC
/begin CHARACTERISTIC KFFFANZ "Anzahl Folgefunken" MAP 0x81A521 KfAxUbAyUbSstxUbSstyUbWUb 255.0 dez 0.00 255.0 FORMAT "%5.1"
 /begin AXIS_DESCR STD_AXIS tmot temp_ub_q0p75_o48 8 -48.00 143.3 FORMAT "%5.1" DEPOSIT ABSOLUTE /end AXIS_DESCR
 /begin AXIS_DESCR STD_AXIS nmot nmot_ub_q40 5 0.00 10200. FORMAT "%5.0" DEPOSIT ABSOLUTE /end AXIS_DESCR
/end CHARACTERISTIC
/begin CHARACTERISTIC KFMDZOF_UC "Kennfeld für Offset-Toleranz in Abhängigkeit vom zul. Moment im Befehlstest" MAP 0x811B34 GkfWUb 99.61 rel_ub_b99p6 0.00 99.61 FORMAT "%5.2"
 /begin AXIS_DESCR COM_AXIS mz_uc rel_ub_b99p6 8 0.00 99.61 AXIS_PTS_REF MDV08_UC /end AXIS_DESCR
 /begin AXIS_DESCR COM_AXIS nmot_uc nmot_ub_q40 8 0.00 10200. AXIS_PTS_REF NMV08_UC /end AXIS_DESCR
/end CHARACTERISTIC
/begin CHARACTERISTIC KFMI_UC "Kennfeld optimales Motormoment im Befehlstest" MAP 0x811AA3 GkfWUb 99.61 rel_ub_b99p6 0.00 99.61 FORMAT "%5.2"
 /begin AXIS_DESCR COM_AXIS rl_uc rel_ub_q0p75 8 0.00 191.3 AXIS_PTS_REF RLV08_UC /end AXIS_DESCR
 /begin AXIS_DESCR COM_AXIS nmot_uc nmot_ub_q40 8 0.00 10200. AXIS_PTS_REF NZWV08_UC /end AXIS_DESCR
/end CHARACTERISTIC
/begin CHARACTERISTIC KFMPED_UC "Kennfeld für zulässiges Moment aus der Pedalstellung im Befehlstest" MAP 0x811B74 GkfWUb 99.61 rel_ub_b99p6 0.00 99.61 FORMAT "%5.2"
 /begin AXIS_DESCR COM_AXIS spsn_uc spg_ub_q0p019 8 0.00 4.9805 AXIS_PTS_REF SPSNV08_UC /end AXIS_DESCR
 /begin AXIS_DESCR COM_AXIS nmot_uc nmot_ub_q40 8 0.00 10200. AXIS_PTS_REF NMV08_UC /end AXIS_DESCR
/end CHARACTERISTIC
/begin CHARACTERISTIC KFMPNS_UC "Kennfeld für zul. Moment aus Pedalstellung bei kaltem Motor im Befehlstest" MAP 0x811BB4 GkfWUb 99.61 rel_ub_b99p6 0.00 99.61 FORMAT "%5.2"
 /begin AXIS_DESCR COM_AXIS spsn_uc spg_ub_q0p019 8 0.00 4.9805 AXIS_PTS_REF SPSNV08_UC /end AXIS_DESCR
 /begin AXIS_DESCR COM_AXIS nmot_uc nmot_ub_q40 8 0.00 10200. AXIS_PTS_REF NMV08_UC /end AXIS_DESCR
/end CHARACTERISTIC
/begin CHARACTERISTIC KFSWKFZK "Schwelle der ZW-Spätverstellungen für ZW-Kennfeldumschaltung" MAP 0x81A447 GkfWUb 191.3 zw_ub_qn0p75 -191.3 0.00 FORMAT "%5.1"
 /begin AXIS_DESCR COM_AXIS nmot_w nmot_uw_q0p25 16 0.00 16383.75 AXIS_PTS_REF SNM16ZUUW /end AXIS_DESCR
 /begin AXIS_DESCR COM_AXIS rl_w rel_uw_q0p0234 12 0.00 1535.977 AXIS_PTS_REF SRL12ZUUW /end AXIS_DESCR
/end CHARACTERISTIC
/begin CHARACTERISTIC KFSZDUB "Schließzeitkorrektur in Abhängigkeit von UB" MAP 0x81A558 KfAxUbAyUbSstxUbSstyUbWUb 7.969 fak_ub_b8 0.00 7.969 FORMAT "%5.3"
 /begin AXIS_DESCR STD_AXIS uzue spg_ubatt 7 0.00 17.95 FORMAT "%5.2" DEPOSIT ABSOLUTE /end AXIS_DESCR
 /begin AXIS_DESCR STD_AXIS tsrldyn txms_ub_q0p1 16 0.00 25.50 FORMAT "%5.2" DEPOSIT ABSOLUTE /end AXIS_DESCR
/end CHARACTERISTIC
/begin CHARACTERISTIC KFSZT "Schließzeit-Kennfeld" MAP 0x81A5E1 KfAxUbAyUbSstxUbSstyUbWUb 25.50 txms_ub_q0p1 0.00 25.50 FORMAT "%5.2"
 /begin AXIS_DESCR STD_AXIS ub spg_ubatt 8 0.00 17.95 FORMAT "%5.2" DEPOSIT ABSOLUTE /end AXIS_DESCR
 /begin AXIS_DESCR STD_AXIS nmot nmot_ub_q40 8 0.00 10200. FORMAT "%5.0" DEPOSIT ABSOLUTE /end AXIS_DESCR
/end CHARACTERISTIC
/begin CHARACTERISTIC KFTSDYN "Schließzeitkorrektur in Abhängigkeit des Drehzahlgradienten" MAP 0x8298A6 KfAxUbAyUbSstxSwSstyUbWUw 7.999878 fak_uw_b8 0.00 7.999878 FORMAT "%8.6"
 /begin AXIS_DESCR STD_AXIS ngfil_w nmotg_sw_q0p39 3 -12800.16 12799.77 FORMAT "%8.2" DEPOSIT ABSOLUTE /end AXIS_DESCR
 /begin AXIS_DESCR STD_AXIS nmot nmot_ub_q40 8 0.00 10200. FORMAT "%5.0" DEPOSIT ABSOLUTE /end AXIS_DESCR
/end CHARACTERISTIC
/begin CHARACTERISTIC KFTSRL "Schließzeitkennfeld" MAP 0x81A633 KfAxUbAyUbSstxUbSstyUbWUb 25.50 txms_ub_q0p1 0.00 25.50 FORMAT "%5.2"
 /begin AXIS_DESCR STD_AXIS nmot nmot_ub_q40 9 0.00 10200. FORMAT "%5.0" DEPOSIT ABSOLUTE /end AXIS_DESCR
 /begin AXIS_DESCR STD_AXIS rl rel_ub_q0p75 10 0.00 191.3 FORMAT "%5.1" DEPOSIT ABSOLUTE /end AXIS_DESCR
/end CHARACTERISTIC
/begin CHARACTERISTIC KFTZWOB "Zeitkonstante Zündwinkeloverboost" MAP 0x8297EE KfAxUbAyUbSstxUbSstyUbWSb 51.00 t200msxs_sb_b25p5 -25.60 25.40 FORMAT "%5.2"
 /begin AXIS_DESCR STD_AXIS nmot nmot_ub_q40 4 0.00 10200. FORMAT "%5.0" DEPOSIT ABSOLUTE /end AXIS_DESCR
 /begin AXIS_DESCR STD_AXIS rl rel_ub_q0p75 4 0.00 191.3 FORMAT "%5.1" DEPOSIT ABSOLUTE /end AXIS_DESCR
/end CHARACTERISTIC
/begin CHARACTERISTIC KFZW "Zündwinkelkennfeld" MAP 0x812102 GkfWSb 191.3 zw_sb_q0p75 -96.00 95.25 FORMAT "%5.2"
 /begin AXIS_DESCR COM_AXIS nmot_w nmot_uw_q0p25 16 0.00 16383.75 AXIS_PTS_REF SNM16ZUUW /end AXIS_DESCR
 /begin AXIS_DESCR COM_AXIS rl_w rel_uw_q0p0234 12 0.00 1535.977 AXIS_PTS_REF SRL12ZUUW /end AXIS_DESCR
/end CHARACTERISTIC
/begin CHARACTERISTIC KFZW2 "Zündwinkelkennfeld Variante 2" MAP 0x8121C2 GkfWSb 191.3 zw_sb_q0p75 -96.00 95.25 FORMAT "%5.2"
 /begin AXIS_DESCR COM_AXIS nmot_w nmot_uw_q0p25 16 0.00 16383.75 AXIS_PTS_REF SNM16ZUUW /end AXIS_DESCR
 /begin AXIS_DESCR COM_AXIS rl_w rel_uw_q0p0234 12 0.00 1535.977 AXIS_PTS_REF SRL12ZUUW /end AXIS_DESCR
/end CHARACTERISTIC
/begin CHARACTERISTIC KFZWMN "Min-Zündwinkel" MAP 0x8171B2 KfAxUbAyUbSstxUbSstyUbWSb 191.3 zw_sb_q0p75 -96.00 95.25 FORMAT "%5.2"
 /begin AXIS_DESCR STD_AXIS nmot nmot_ub_q40 16 0.00 10200. FORMAT "%5.0" DEPOSIT ABSOLUTE /end AXIS_DESCR
 /begin AXIS_DESCR STD_AXIS rl rel_ub_q0p75 12 0.00 191.3 FORMAT "%5.1" DEPOSIT ABSOLUTE /end AXIS_DESCR
/end CHARACTERISTIC
/begin CHARACTERISTIC KFZWMNKH "Min-Zündwinkel Katheizen" MAP 0x817290 KfAxUbAyUbSstxUbSstyUbWSb 191.3 zw_sb_q0p75 -96.00 95.25 FORMAT "%5.2"
 /begin AXIS_DESCR STD_AXIS nmot nmot_ub_q40 6 0.00 10200. FORMAT "%5.0" DEPOSIT ABSOLUTE /end AXIS_DESCR
 /begin AXIS_DESCR STD_AXIS rl rel_ub_q0p75 12 0.00 191.3 FORMAT "%5.1" DEPOSIT ABSOLUTE /end AXIS_DESCR
/end CHARACTERISTIC
/begin CHARACTERISTIC KFZWMNST "Min-Zündwinkel für Start und Nachstart" MAP 0x8172EC KfAxUbAyUbSstxUbSstyUbWSb 191.3 zw_sb_q0p75 -96.00 95.25 FORMAT "%5.2"
 /begin AXIS_DESCR STD_AXIS nmot nmot_ub_q40 16 0.00 10200. FORMAT "%5.0" DEPOSIT ABSOLUTE /end AXIS_DESCR
 /begin AXIS_DESCR STD_AXIS rl rel_ub_q0p75 12 0.00 191.3 FORMAT "%5.1" DEPOSIT ABSOLUTE /end AXIS_DESCR
/end CHARACTERISTIC
/begin CHARACTERISTIC KFZWMS "Kennfeld mit dauerhaft spätest möglichem Zündwinkel" MAP 0x812040 GkfWSb 191.3 zw_sb_q0p75 -96.00 95.25 FORMAT "%5.2"
 /begin AXIS_DESCR COM_AXIS nmot_w nmot_uw_q0p25 16 0.00 16383.75 AXIS_PTS_REF SNM16ZUUW /end AXIS_DESCR
 /begin AXIS_DESCR COM_AXIS rl_w rel_uw_q0p0234 12 0.00 1535.977 AXIS_PTS_REF SRL12ZUUW /end AXIS_DESCR
/end CHARACTERISTIC
/begin CHARACTERISTIC KFZWSTTM "Zündwinkel im Start" MAP 0x817400 KfAxUbAyUbSstxUbSstyUbWSb 191.3 zw_sb_q0p75 -96.00 95.25 FORMAT "%5.2"
 /begin AXIS_DESCR STD_AXIS nmot nmot_ub_q40 6 0.00 10200. FORMAT "%5.0" DEPOSIT ABSOLUTE /end AXIS_DESCR
 /begin AXIS_DESCR STD_AXIS tmst temp_ub_q0p75_o48 6 -48.00 143.3 FORMAT "%5.1" DEPOSIT ABSOLUTE /end AXIS_DESCR
/end CHARACTERISTIC
/begin CHARACTERISTIC KFZWWLNM "Delta Zündwinkel im Warmlauf" MAP 0x8122CB GkfWSb 191.3 zw_sb_q0p75 -96.00 95.25 FORMAT "%5.2"
 /begin AXIS_DESCR COM_AXIS nmot nmot_ub_q40 12 0.00 10200. AXIS_PTS_REF SNM12ESUB /end AXIS_DESCR
 /begin AXIS_DESCR COM_AXIS tans temp_ub_q0p75_o48 12 -48.00 143.3 AXIS_PTS_REF STA12WLUB /end AXIS_DESCR
/end CHARACTERISTIC
/begin CHARACTERISTIC KFZWWLRL "Delta Zündwinkel im Warmlauf" MAP 0x81235B GkfWSb 191.3 zw_sb_q0p75 -96.00 95.25 FORMAT "%5.2"
 /begin AXIS_DESCR COM_AXIS tmot temp_ub_q0p75_o48 12 -48.00 143.3 AXIS_PTS_REF STM12ESUB /end AXIS_DESCR
 /begin AXIS_DESCR COM_AXIS rl rel_ub_q0p75 6 0.00 191.3 AXIS_PTS_REF SRL06ESUB /end AXIS_DESCR
/end CHARACTERISTIC
/begin CHARACTERISTIC KFZW_UC "Kennfeld für optimalen Zündwinkel im Befehlstest" MAP 0x811AE3 GkfWSb 191.3 zw_sb_q0p75 -96.00 95.25 FORMAT "%5.2"
 /begin AXIS_DESCR COM_AXIS rl_uc rel_ub_q0p75 8 0.00 191.3 AXIS_PTS_REF RLV08_UC /end AXIS_DESCR
 /begin AXIS_DESCR COM_AXIS nmot_uc nmot_ub_q40 8 0.00 10200. AXIS_PTS_REF NZWV08_UC /end AXIS_DESCR
/end CHARACTERISTIC
/begin CHARACTERISTIC KIVMXG "Verstärkungsfaktor I-Anteil der VMAX-Regelung" CURVE 0x81FBBC FklWUw 499.984741 rel_q0p007629 0.00762939453 499.992371
 /begin AXIS_DESCR FIX_AXIS gangi dez 8 0.00 7.000 FORMAT "%5.3" FIX_AXIS_PAR 0 0 8 /end AXIS_DESCR
/end CHARACTERISTIC
/begin CHARACTERISTIC KLETAZW_UC "ZW-Wirkungsgrad in Abhängigkeit von delta ZW im Befehlstest" CURVE 0x811B23 KlAUbSstUbWUb 127.5 rel_ub_b127p5 0.00 127.5 FORMAT "%5.1"
 /begin AXIS_DESCR STD_AXIS dzw_uc zw_ub_q0p75 8 0.00 191.3 FORMAT "%5.1" DEPOSIT ABSOLUTE /end AXIS_DESCR
/end CHARACTERISTIC
/begin CHARACTERISTIC KLNPED_UC "pedalsollwertabh. Drehzahlbegr. in der DK-Antrieb-Ersatzfunktion; Befehlstest" CURVE 0x811C00 KlAUbSstUbWUb 10200. nmot_ub_q40 0.00 10200. FORMAT "%5.0"
 /begin AXIS_DESCR STD_AXIS spsn_uc spg_ub_q0p019 8 0.00 4.9805 DEPOSIT ABSOLUTE /end AXIS_DESCR
/end CHARACTERISTIC
/begin CHARACTERISTIC KLZWBSMN "spätest möglicher Basiszündwinkel" CURVE 0x8297C2 KlAUbSstUbWSb 191.3 zw_sb_q0p75 -96.00 95.25 FORMAT "%5.2"
 /begin AXIS_DESCR STD_AXIS nmot nmot_ub_q40 8 0.00 10200. FORMAT "%5.0" DEPOSIT ABSOLUTE /end AXIS_DESCR
/end CHARACTERISTIC
/begin CHARACTERISTIC KLZZWMNST "KL Zeitkonstante für Abregelung ZW-Begrenzung im Nachstart" CURVE 0x8173CA KlAUbSstUbWUw 655.34999985 zk10msxs_uw_b655 0.010000152590 655.36000000 FORMAT "%12.8"
 /begin AXIS_DESCR STD_AXIS tmst temp_ub_q0p75_o48 8 -48.00 143.3 FORMAT "%5.1" DEPOSIT ABSOLUTE /end AXIS_DESCR
/end CHARACTERISTIC
/begin CHARACTERISTIC KPVMXG "Verstärkungsfaktor P-Anteil der VMAX-Regelung" CURVE 0x819F19 FklWUb 99.70 rel_ub_q0p391 0.00 99.70 FORMAT "%5.2"
 /begin AXIS_DESCR FIX_AXIS gangi dez 8 0.00 7.000 FORMAT "%5.3" FIX_AXIS_PAR 0 0 8 /end AXIS_DESCR
/end CHARACTERISTIC
/begin AXIS_PTS MDV08_UC "Stützstellenverteilung für Moment im Befehlstest" 0x811BF4 mz_uc SstAUbSstUb 99.61 rel_ub_b99p6 8 0.00 99.61 FORMAT "%5.2" DEPOSIT ABSOLUTE /end AXIS_PTS
/begin CHARACTERISTIC MSRC_T_UC "Fehlerzeit für MSR-Eingriff-Überwachung des Befehlstests" VALUE 0x811A7D KwUb 10200.0 t40ms_ub_b10200 0.00 10200.0 FORMAT "%7.1" /end CHARACTERISTIC
/begin CHARACTERISTIC MVER_T_UC "Fehlerzeit beim Momentenvergleich im Befehlstest" VALUE 0x811BFF KwUb 10200.0 t40ms_ub_b10200 0.00 10200.0 FORMAT "%7.1" /end CHARACTERISTIC
/begin CHARACTERISTIC MZFFIL_UC "Filter-Zeitkonstante für verzögertes Moment im Befehlstest" VALUE 0x811BFD KwUb 10159.4 zk40ms_ub_b10200 40.6299 10200.0 FORMAT "%7.1" /end CHARACTERISTIC
/begin CHARACTERISTIC MZFTV_UC "Verzugszeit für zulässiges Moment mz_um im Befehlstest" VALUE 0x811BFE KwUb 280.000 t40ms_ub_b10200 40.0000 320.000 FORMAT "%7.3" /end CHARACTERISTIC
/begin CHARACTERISTIC NACHANZ "" VALUE 0x811F72 KwUb 255.0 dez 0.00 255.0 FORMAT "%5.1" /end CHARACTERISTIC
/begin CHARACTERISTIC NMNZUESA "untere nmot-Schwelle für Ausgabe TSMNSA" VALUE 0x81A6A2 KwUb 10200. nmot_ub_q40 0.00 10200. FORMAT "%5.0" /end CHARACTERISTIC
/begin AXIS_PTS NMV08_UC "Stützstellenverteilung für Motordrehzahl im Befehlstest" 0x811A7F nmot_uc SstAUbSstUb 10200. nmot_ub_q40 8 0.00 10200. FORMAT "%5.0" DEPOSIT ABSOLUTE /end AXIS_PTS
/begin CHARACTERISTIC NMXZUESA "obere nmot-Schwelle für Ausgabe TSMNSA" VALUE 0x81A6A3 KwUb 10200. nmot_ub_q40 0.00 10200. FORMAT "%5.0" /end CHARACTERISTIC
/begin CHARACTERISTIC NOASR_UC "" VALUE 0x811A7E KwUb 99.61 rel_ub_q0p3906 0.00 99.61 FORMAT "%5.2" /end CHARACTERISTIC
/begin CHARACTERISTIC NOREA_UC "" VALUE 0x811C11 KwUb 255.0 dez 0.00 255.0 FORMAT "%5.1" /end CHARACTERISTIC
/begin AXIS_PTS NZWV08_UC "" 0x811A88 nmot_uc SstAUbSstUb 10200. nmot_ub_q40 8 0.00 10200. FORMAT "%5.0" DEPOSIT ABSOLUTE /end AXIS_PTS
/begin CHARACTERISTIC REAC_T1_UC "Fehlerzeit bei der Funktions-Fehlerreaktionsüberwachung im Befehlstest" VALUE 0x811C12 KwUb 10200.0 t40ms_ub_b10200 0.00 10200.0 FORMAT "%7.1" /end CHARACTERISTIC
/begin CHARACTERISTIC REAC_T2_UC "Fehlerzeit bei der Funktionsüberwachungs-Fehlerreaktionsüberw. im Befehlstest" VALUE 0x811C13 KwUb 10200.0 t40ms_ub_b10200 0.00 10200.0 FORMAT "%7.1" /end CHARACTERISTIC
/begin AXIS_PTS RLV08_UC "Stutzstellenverteilung für Lastinfo im Befehlstest" 0x811A91 rl_uc SstAUbSstUb 191.3 rel_ub_q0p75 8 0.00 191.3 FORMAT "%5.1" DEPOSIT ABSOLUTE /end AXIS_PTS
/begin CHARACTERISTIC ROMRSTA_UM "maximale Anzahl Resets bei Fehlererkennung im ROM-Check in der Initialisierung" VALUE 0x81421A KwUb 255.0 dez 0.00 255.0 FORMAT "%5.1" /end CHARACTERISTIC
/begin CHARACTERISTIC SKA_DRHZ_UC "" VALUE 0x811C14 KwUb 10200. nmot_ub_q40 0.00 10200. FORMAT "%5.0" /end CHARACTERISTIC
/begin AXIS_PTS SNM08__UB "Stützstellenverteilung Drehzahl, 8 Sst." 0x818236 nmot SstAUbSstUb 10200. nmot_ub_q40 8 0.00 10200. FORMAT "%5.0" DEPOSIT ABSOLUTE /end AXIS_PTS
/begin AXIS_PTS SNM12ESUB "SST-Verteilung für die Motordrehzahl nmot" 0x8100A2 nmot SstAUbSstUb 10200. nmot_ub_q40 12 0.00 10200. FORMAT "%5.0" DEPOSIT ABSOLUTE /end AXIS_PTS
/begin AXIS_PTS SNM16ZUUW "Stützstellenverteilung Drehzahl, 16 Sst." 0x813110 nmot_w SstAUwSstUw 16383.75 nmot_uw_q0p25 16 0.00 16383.75 FORMAT "%8.2" DEPOSIT ABSOLUTE /end AXIS_PTS
/begin AXIS_PTS SPSNV08_UC "Stützstellenverteilung für Pedalwert im Befehlstest" 0x811A9A spsn_uc SstAUbSstUb 4.9805 spg_ub_q0p019 8 0.00 4.9805 DEPOSIT ABSOLUTE /end AXIS_PTS
/begin AXIS_PTS SRL06ESUB "Sst-Verteilung für die relative Füllung rl" 0x8100DC rl SstAUbSstUb 191.3 rel_ub_q0p75 6 0.00 191.3 FORMAT "%5.1" DEPOSIT ABSOLUTE /end AXIS_PTS
/begin AXIS_PTS SRL12ZUUW "Stützstellenverteilung relative Luftfüllung, 12 St." 0x813162 rl_w SstAUwSstUw 1535.977 rel_uw_q0p0234 12 0.00 1535.977 FORMAT "%8.3" DEPOSIT ABSOLUTE /end AXIS_PTS
/begin AXIS_PTS STA12WLUB "SST-Verteilung für die Ansauglufttemperatur" 0x81010D tans SstAUbSstUb 191.3 temp_ub_q0p75_o48 12 -48.00 143.3 FORMAT "%5.1" DEPOSIT ABSOLUTE /end AXIS_PTS
/begin AXIS_PTS STM06__UB "Stützstellenverteilung Motortemperatur, 6 Sst." 0x8182CC tmot SstAUbSstUb 191.3 temp_ub_q0p75_o48 6 -48.00 143.3 FORMAT "%5.1" DEPOSIT ABSOLUTE /end AXIS_PTS
/begin AXIS_PTS STM12ESUB "SST-Verteilung für die Motortemperatur tmot" 0x810136 tmot SstAUbSstUb 191.3 temp_ub_q0p75_o48 12 -48.00 143.3 FORMAT "%5.1" DEPOSIT ABSOLUTE /end AXIS_PTS
/begin CHARACTERISTIC TFWDKSOM "Zeitkonstante für Drosselklappensollwinkelfilterung bei Kl15 aus" VALUE 0x8153CE KwUw 655.34999985 zk10msxs_uw_b655 0.010000152590 655.36000000 FORMAT "%12.8" /end CHARACTERISTIC
/begin CHARACTERISTIC TSMNSA "Ladezeit bei SA" VALUE 0x81A6A4 KwUb 25.50 txms_ub_q0p1 0.00 25.50 FORMAT "%5.2" /end CHARACTERISTIC
/begin CHARACTERISTIC TSMX "Ladezeitbegrenzung" VALUE 0x81A6A5 KwUb 25.50 txms_ub_q0p1 0.00 25.50 FORMAT "%5.2" /end CHARACTERISTIC
/begin CHARACTERISTIC TSMXNL "Ladezeitbegrenzung im Fehlerfall" VALUE 0x81A6A6 KwUb 25.50 txms_ub_q0p1 0.00 25.50 FORMAT "%5.2" /end CHARACTERISTIC
/begin CHARACTERISTIC TSWKR "Totzeit für Summen-ZW-Spätverstellabfrage" VALUE 0x812282 KwUb 25.50 t100msxs_ub_b25p5 0.00 25.50 FORMAT "%5.2" /end CHARACTERISTIC
/begin CHARACTERISTIC TTIPINEN "Zeit bis zur Abfrage auf Kraftschluß bei Drehzahldynamik" VALUE 0x812100 KwUb 2.550 t10msxs_ub_b2p55 0.00 2.550 FORMAT "%5.3" /end CHARACTERISTIC
/begin CHARACTERISTIC TTIPINON "Einschaltzeit Tip-In Offset auf spätesten Zündwinkel" VALUE 0x812101 KwUb 12.75 t50msxs_ub_b12p75 0.00 12.75 FORMAT "%5.2" /end CHARACTERISTIC
/begin CHARACTERISTIC TVMXPRG "Geschwindigkeits-Prädiktionszeit für VMAX-Regelung" CURVE 0x819F21 FklWUb 5.100 t20msxs_ub_q0p02 0.00 5.100 FORMAT "%5.3"
 /begin AXIS_DESCR FIX_AXIS gangi dez 8 0.00 7.000 FORMAT "%5.3" FIX_AXIS_PAR 0 0 8 /end AXIS_DESCR
/end CHARACTERISTIC
/begin CHARACTERISTIC TVZWMSA "Zeit bis zum Übergehen auf Dauerspätbegrenzung" VALUE 0x8173E4 KwUw 655.3500 t10msxs_uw_b655p35 0.00 655.3500 FORMAT "%8.4" /end CHARACTERISTIC
/begin CHARACTERISTIC TVZWMSE "Zeit bis zum Übergehen auf Dynamikspätbegrenzung" VALUE 0x8173E6 KwUw 655.3500 t10msxs_uw_b655p35 0.00 655.3500 FORMAT "%8.4" /end CHARACTERISTIC
/begin CHARACTERISTIC TZSUDYN "Dauer des Dynamikvorhalts" CURVE 0x8123A3 KlAUbSstUbWUb 2.550 t10msxs_ub_b2p55 0.00 2.550 FORMAT "%5.3"
 /begin AXIS_DESCR STD_AXIS nmot nmot_ub_q40 6 0.00 10200. FORMAT "%5.0" DEPOSIT ABSOLUTE /end AXIS_DESCR
/end CHARACTERISTIC
/begin CHARACTERISTIC VARTAB "Tabelle der zuläßigen Varianten" VAL_BLK 0x828B1A KwbUw 32767.00 dez 0.00 32767.00 FORMAT "%8.2" NUMBER 324 /end CHARACTERISTIC
/begin CHARACTERISTIC VMIN_UC "Minimalgeschwindigkeit für FGR-Betrieb im Befehlstest" VALUE 0x816B54 KwUw 511.9922 vfzg_uw_q0p00781 0.00 511.9922 FORMAT "%8.4" /end CHARACTERISTIC
/begin CHARACTERISTIC WDKSNLN "Sollwinkel für Drosselklappe bei Kl15 aus" CURVE 0x8153D0 KlAUwSstUwWUw 99.99847 rel_uw_b100 0.00 99.99847 FORMAT "%8.5"
 /begin AXIS_DESCR STD_AXIS nmot_w nmot_uw_q0p25 8 0.00 16383.75 FORMAT "%8.2" DEPOSIT ABSOLUTE /end AXIS_DESCR
/end CHARACTERISTIC
/begin CHARACTERISTIC WDZWOBT "Wichtung DZWOB über evtmod" CURVE 0x81A371 KlAUbSstUbWUb 1.992 fak_ub_b2 0.00 1.992 FORMAT "%5.3"
 /begin AXIS_DESCR STD_AXIS evtmod temp_ub_q0p75_o48 4 -48.00 143.3 FORMAT "%5.1" DEPOSIT ABSOLUTE /end AXIS_DESCR
/end CHARACTERISTIC
/begin CHARACTERISTIC WPHN "Phasengang" CURVE 0x81A369 GklWSb 191.3 zw_sb_q0p75 -96.00 95.25 FORMAT "%5.2"
 /begin AXIS_DESCR COM_AXIS nmot nmot_ub_q40 8 0.00 10200. AXIS_PTS_REF SNM08__UB /end AXIS_DESCR
/end CHARACTERISTIC
/begin CHARACTERISTIC ZWAPPL "Applikationsschnittstelle Zündwinkelverstellung" VALUE 0x811F73 KwSb 191.3 zw_sb_q0p75 -96.00 95.25 FORMAT "%5.2" /end CHARACTERISTIC
/begin CHARACTERISTIC ZWSPTIP "Zeit für Freischalten des TIPIN-Offsets auf den spätesten Zündwinkel" VALUE 0x8173E8 KwUw 655.3500 t10msxs_uw_b655p35 0.00 655.3500 FORMAT "%8.4" /end CHARACTERISTIC
/begin MEASUREMENT B_ff "Bedingung Folgefunkenzündung" UWORD B_TRUE 1 100 0 1 BIT_MASK 0x800 FORMAT "%13.11" ECU_ADDRESS 0xFDA4 /end MEASUREMENT
/begin MEASUREMENT B_fgr_uc "FGR-/ACC-Momenteneingriff im Befehlstest erlaubt" UWORD B_TRUE 1 100 0 1 BIT_MASK 0x4 FORMAT "%13.11" ECU_ADDRESS 0xFD96 /end MEASUREMENT
/begin MEASUREMENT b_flags_uc "Ebene 3 Byte für Botschaftüberwachung (alte Toggle Bits)" UBYTE dez 1 100 0 255 FORMAT "%5.1" ECU_ADDRESS 0x380B45 /end MEASUREMENT
/begin MEASUREMENT B_i_ska_uc "Ebene 3 irreversibles Fehlerbit fuer BT" UWORD B_TRUE 1 100 0 1 BIT_MASK 0x40 FORMAT "%13.11" ECU_ADDRESS 0xFD96 /end MEASUREMENT
/begin MEASUREMENT B_kfzk "Bedingung Kennfeld Klopfschutz" UWORD B_TRUE 1 100 0 1 BIT_MASK 0x400 FORMAT "%13.11" ECU_ADDRESS 0xFDA4 /end MEASUREMENT
/begin MEASUREMENT B_mcacti "Bedingung McMESS aktiv" UWORD B_TRUE 1 100 0 1 BIT_MASK 0x8000 FORMAT "%13.11" ECU_ADDRESS 0xFD0E /end MEASUREMENT
/begin MEASUREMENT B_nkons_uc "" UWORD B_TRUE 1 100 0 1 BIT_MASK 0x8 FORMAT "%13.11" ECU_ADDRESS 0xFD96 /end MEASUREMENT
/begin MEASUREMENT B_nomsr_uc "MSR-Momentenvorgabe im Befehlstest nicht übernommen" UWORD B_TRUE 1 100 0 1 BIT_MASK 0x10 FORMAT "%13.11" ECU_ADDRESS 0xFD96 /end MEASUREMENT
/begin MEASUREMENT B_nosgs_uc "SGS-Momentenvorgabe im Befehlstest nicht übernommen" UWORD B_TRUE 1 100 0 1 BIT_MASK 0x1 FORMAT "%13.11" ECU_ADDRESS 0xFD96 /end MEASUREMENT
/begin MEASUREMENT B_swdy "Bedingung Lastdynamik bei Schließzeitberechnung" UWORD B_TRUE 1 100 0 1 BIT_MASK 0x1000 FORMAT "%13.11" ECU_ADDRESS 0xFDA4 /end MEASUREMENT
/begin MEASUREMENT B_tfwdksom "Zeitkonstante für Filterung Drosselklappenwinkel ohne Momentenstruktur aktiv" UWORD B_TRUE 1 100 0 1 BIT_MASK 0x100 FORMAT "%13.11" ECU_ADDRESS 0xFD58 /end MEASUREMENT
/begin MEASUREMENT B_vmax "Bedingung VMAX-Regelung aktiv" UWORD B_TRUE 1 100 0 1 BIT_MASK 0x4000 FORMAT "%13.11" ECU_ADDRESS 0xFD8E /end MEASUREMENT
/begin MEASUREMENT B_wdksom "Drosselklappensollwinkel ohne Momentenstruktur aktiv" UWORD B_TRUE 1 100 0 1 BIT_MASK 0x200 FORMAT "%13.11" ECU_ADDRESS 0xFD58 /end MEASUREMENT
/begin MEASUREMENT B_zb "Bedingung Schließzeitausgabe" UWORD B_TRUE 1 100 0 1 BIT_MASK 0x2000 FORMAT "%13.11" ECU_ADDRESS 0xFDA4 /end MEASUREMENT
/begin MEASUREMENT B_zuesa "Bedingung Schließwinkelausgabe bei SA" UWORD B_TRUE 1 100 0 1 BIT_MASK 0x4000 FORMAT "%13.11" ECU_ADDRESS 0xFDA4 /end MEASUREMENT
/begin MEASUREMENT B_zwkra "Bedingung: Zündwinkel der KR wird ausgegeben" UWORD B_TRUE 1 100 0 1 BIT_MASK 0x4 FORMAT "%13.11" ECU_ADDRESS 0xFDA4 /end MEASUREMENT
/begin MEASUREMENT B_zwmnste "Bedingung Abregelung der Zündwinkelspätbegrenzung erfüllt" UWORD B_TRUE 1 100 0 1 BIT_MASK 0x40 FORMAT "%13.11" ECU_ADDRESS 0xFDA4 /end MEASUREMENT
/begin MEASUREMENT B_zwms "Bedingung Motorschutz-Zündwinkelbegrenzung" UWORD B_TRUE 1 100 0 1 BIT_MASK 0x80 FORMAT "%13.11" ECU_ADDRESS 0xFDA4 /end MEASUREMENT
/begin MEASUREMENT B_zwspae "Bedingung: Zündwinkel zwspae bei Schubabschaltung wird ausgegeben" UWORD B_TRUE 1 100 0 1 BIT_MASK 0x8 FORMAT "%13.11" ECU_ADDRESS 0xFDA4 /end MEASUREMENT
/begin MEASUREMENT delayedTime_w "" UWORD t_wdt_high 1 100 0 89477.1 FORMAT "%8.2" ECU_ADDRESS 0x383AB6 /end MEASUREMENT
/begin MEASUREMENT dvsi_w "Abweichung zwischen Soll- und Istgeschwindigkeit der VMAX-Regelung" SWORD vfzg_sw_q0p00781 1 100 -256 255.992 FORMAT "%8.4" ECU_ADDRESS 0x384C78 /end MEASUREMENT
/begin MEASUREMENT dzwdyn "" SBYTE zw_sb_q0p75 1 100 -96 95.25 FORMAT "%5.2" ECU_ADDRESS 0x380BD1 /end MEASUREMENT
/begin MEASUREMENT dzwkg "Delta-Zündwinkel Verschiebung Klopfgrenze" SBYTE zw_sb_q0p75 1 100 -96 95.25 FORMAT "%5.2" ECU_ADDRESS 0x380BD9 /end MEASUREMENT
/begin MEASUREMENT dzwmna "Min-Zündwinkel Änderungsgeschwindigeit zw. Brenngrenze und Motorschutz" SBYTE zw_sb_q0p75 1 100 -96 95.25 FORMAT "%5.2" ECU_ADDRESS 0x380BD2 /end MEASUREMENT
/begin MEASUREMENT dzwnwsu "" SBYTE zw_sb_q0p75 1 100 -96 95.25 FORMAT "%5.2" ECU_ADDRESS 0x380BDA /end MEASUREMENT
/begin MEASUREMENT dzwob "Delta Zündwinkel Zündwinkeloverboost" SBYTE zw_sb_q0p75 1 100 -96 95.25 FORMAT "%5.2" ECU_ADDRESS 0x38492D /end MEASUREMENT
/begin MEASUREMENT dzwspae "Korrektur-Zündwinkel für den spätest erlaubten Zündwinkel" SBYTE zw_sb_q0p75 1 100 -96 95.25 FORMAT "%5.2" ECU_ADDRESS 0x380BD3 /end MEASUREMENT
/begin MEASUREMENT dzwwl "Delta Zuendwinkel aus Warmlauf" SBYTE zw_sb_q0p75 1 100 -96 95.25 FORMAT "%5.2" ECU_ADDRESS 0x380BDE /end MEASUREMENT
/begin MEASUREMENT dzwzk "delta Zündwinkel bei Dauerklopfen" SBYTE zw_sb_q0p75 1 100 -96 95.25 FORMAT "%5.2" ECU_ADDRESS 0x380BDB /end MEASUREMENT
/begin MEASUREMENT dzw_uc "Delta Zündwinkel zwischen zwopt und zwout im Befehlstest" UBYTE zw_ub_q0p75 1 100 0 191.25 FORMAT "%5.1" ECU_ADDRESS 0x380B59 /end MEASUREMENT
/begin MEASUREMENT ei_msrc_uc "irreversibles Fehlerbit bei der MSR-Überwachung im Befehlstest" UWORD B_TRUE 1 100 0 1 BIT_MASK 0x20 FORMAT "%13.11" ECU_ADDRESS 0xFD96 /end MEASUREMENT
/begin MEASUREMENT ei_mver_uc "Ebene 3 irreversibles Fehlerbit fuer URCMVER aus BT" UWORD B_TRUE 1 100 0 1 BIT_MASK 0x80 FORMAT "%13.11" ECU_ADDRESS 0xFD96 /end MEASUREMENT
/begin MEASUREMENT ei_reac_uc "Ebene 3 irreversibles Fehlerbit fuer UFREAC aus BT" UWORD B_TRUE 1 100 0 1 BIT_MASK 0x100 FORMAT "%13.11" ECU_ADDRESS 0xFD96 /end MEASUREMENT
/begin MEASUREMENT ei_sgsc_uc "irreversibles Fehlerbit bei der SGS-Überwachung im Befehlstest" UWORD B_TRUE 1 100 0 1 BIT_MASK 0x2 FORMAT "%13.11" ECU_ADDRESS 0xFD96 /end MEASUREMENT
/begin MEASUREMENT etazwmn "Minimum-Zündwinkelwirkungsgrad" UBYTE rel_ub_b127p5 1 100 0 127.5 FORMAT "%5.1" ECU_ADDRESS 0xFA34 /end MEASUREMENT
/begin MEASUREMENT etazw_uc "Ist-Zündwinkelwirkungsgrad im Befehlstest" UBYTE rel_ub_b127p5 1 100 0 127.5 FORMAT "%5.1" ECU_ADDRESS 0x380B5A /end MEASUREMENT
/begin MEASUREMENT ftsdrl "Faktor Lastdynamik zur Schließzeitberechnung" UBYTE fak_ub_b8 1 100 0 7.96875 FORMAT "%5.3" ECU_ADDRESS 0x380BE0 /end MEASUREMENT
/begin MEASUREMENT ftsdyn "Faktor Drehzahldynamik zur Schließzeitberechnung" UBYTE fak_ub_b8 1 100 0 7.96875 FORMAT "%5.3" ECU_ADDRESS 0x380BE1 /end MEASUREMENT
/begin MEASUREMENT ftsub "Faktor Batterieabhängigkeit bei Schließzeitberechnung" UBYTE fak_ub_b8 1 100 0 7.96875 FORMAT "%5.3" ECU_ADDRESS 0x380BE2 /end MEASUREMENT
/begin MEASUREMENT fubaanz "Anzahl der Funkenpakete Funkenbandzündung" UBYTE dez 1 100 0 255 FORMAT "%5.1" ECU_ADDRESS 0x380BE3 /end MEASUREMENT
/begin MEASUREMENT mdif_w_uc "Differenz zwischen zulässigem und Ist-Moment im Befehlstest" SWORD rel_ub_q0p3906 1 100 -12800 12799.6 FORMAT "%8.2" ECU_ADDRESS 0x3828FE /end MEASUREMENT
/begin MEASUREMENT mdst08_uc "" UWORD dez 1 100 0 65535 FORMAT "%8.2" ECU_ADDRESS 0x3828FC /end MEASUREMENT
/begin MEASUREMENT mfgr_uc "Momentenwunsch aus der Fahrgeschwindigkeitsregelung im Befehlstest" UBYTE rel_ub_q0p3906 1 100 0 99.6094 FORMAT "%5.2" ECU_ADDRESS 0x380B56 /end MEASUREMENT
/begin MEASUREMENT miopt_uc "optimales indiziertes Moment im Befehlstest" UBYTE rel_ub_b99p6 1 100 0 99.6094 FORMAT "%5.2" ECU_ADDRESS 0x380B5B /end MEASUREMENT
/begin MEASUREMENT mivmxi_w "I-Anteil des indizierten Sollmoments der VMAX-Regelung" UWORD rel_uw_b100 1 100 0 99.9985 FORMAT "%8.5" ECU_ADDRESS 0x384C7A /end MEASUREMENT
/begin MEASUREMENT mivmxp_w "P-Anteil des indizierten Sollmoments der VMAX-Regelung" SWORD rel_sw_b100 1 100 -100 99.9969 FORMAT "%8.4" ECU_ADDRESS 0x384C7C /end MEASUREMENT
/begin MEASUREMENT mivmx_w "Indiziertes Sollmoment der VMAX-Regelung" UWORD rel_uw_b100 1 100 0 99.9985 FORMAT "%8.5" ECU_ADDRESS 0x384C7E /end MEASUREMENT
/begin MEASUREMENT mi_uc "Berechnetes Ist-Moment im Befehlstest" UBYTE rel_ub_b99p6 1 100 0 99.6094 FORMAT "%5.2" ECU_ADDRESS 0x380B5C /end MEASUREMENT
/begin MEASUREMENT mmsr_uc "zulässiger MSR-Momentenwunsch für die Funktionsüberwachung" UBYTE rel_ub_q0p3906 1 100 0 99.6094 FORMAT "%5.2" ECU_ADDRESS 0x380B57 /end MEASUREMENT
/begin MEASUREMENT mped_uc "zulässiges indiziertes Moment aus Fahrpedal im Befehlstest" UBYTE rel_ub_b99p6 1 100 0 99.6094 FORMAT "%5.2" ECU_ADDRESS 0x380B5E /end MEASUREMENT
/begin MEASUREMENT msgs_uc "Soll- Motormoment aus Getriebeüberwachung im Befehlstest" UBYTE rel_ub_q0p3906 1 100 0 99.6094 FORMAT "%5.2" ECU_ADDRESS 0x380856 /end MEASUREMENT
/begin MEASUREMENT msrc_c_uc "Fehlerzähler für MSR-Überwachung des Befehlstestes" UBYTE t40ms_ub_b10200 1 100 0 10200 FORMAT "%7.1" ECU_ADDRESS 0x380B58 /end MEASUREMENT
/begin MEASUREMENT mver_c_uc "Fehlerzähler für Momentenvergleich im Befehlstest" UBYTE t40ms_ub_b10200 1 100 0 10200 FORMAT "%7.1" ECU_ADDRESS 0x380B6C /end MEASUREMENT
/begin MEASUREMENT mzfo_uc "Gefiltertes zulässiges Moment inclusive Offset im Befehlstest" UBYTE rel_ub_q0p3906 1 100 0 99.6094 FORMAT "%5.2" ECU_ADDRESS 0x380B6D /end MEASUREMENT
/begin MEASUREMENT mzf_low_uc "" UBYTE rel_ub_q0p00153 1 100 0 0.389074 ECU_ADDRESS 0x380B61 /end MEASUREMENT
/begin MEASUREMENT mzf_ptr_uc "" UBYTE dez 1 100 0 255 FORMAT "%5.1" ECU_ADDRESS 0x380B62 /end MEASUREMENT
/begin MEASUREMENT mzf_reg_uc "" UBYTE rel_ub_q0p3906 1 100 0 99.6094 FORMAT "%5.2" ARRAY_SIZE 8 ECU_ADDRESS 0x380B63 /end MEASUREMENT
/begin MEASUREMENT mzf_uc "gefiltertes zulässiges Moment im Befehlstest" UBYTE rel_ub_q0p3906 1 100 0 99.6094 FORMAT "%5.2" ECU_ADDRESS 0x380B6B /end MEASUREMENT
/begin MEASUREMENT mzo_uc "Toleranz-Offset für das zulässige Moment im Befehlstest" UBYTE rel_ub_b99p6 1 100 0 99.6094 FORMAT "%5.2" ECU_ADDRESS 0x380B5F /end MEASUREMENT
/begin MEASUREMENT mz_uc "resultierendes zulässiges Moment im Befehlstest" UBYTE rel_ub_b99p6 1 100 0 99.6094 FORMAT "%5.2" ECU_ADDRESS 0x380B60 /end MEASUREMENT
/begin MEASUREMENT nska_uc "Grenzdrehzahl bei aktiver Fehlerreaktion im Befehlstest" UBYTE nmot_ub_q40 1 100 0 10200 FORMAT "%5.0" ECU_ADDRESS 0x380B6E /end MEASUREMENT
/begin MEASUREMENT n_flags_uc "Byte für Nachstart-Bits des Befehlstestes" UBYTE dez 1 100 0 255 FORMAT "%5.1" ECU_ADDRESS 0x380B46 /end MEASUREMENT
/begin MEASUREMENT offz_w "Offenzeit Funkenpakete Funkenbandzündung" UWORD tsegment_sy 1 100 0 43.69 FORMAT "%8.5" ECU_ADDRESS 0x382C32 /end MEASUREMENT
/begin MEASUREMENT pmcod_w "Parametercode der Variantencodierung" UWORD dez 1 100 0 65535 FORMAT "%8.2" ECU_ADDRESS 0x3853F6 /end MEASUREMENT
/begin MEASUREMENT reac_c1_uc "Fehlerzähler 1 für Fehlerreaktionsüberwachung im Befehlstest" UBYTE t40ms_ub_b10200 1 100 0 10200 FORMAT "%7.1" ECU_ADDRESS 0x380B6F /end MEASUREMENT
/begin MEASUREMENT reac_c2_uc "Fehlerzähler 2 für Fehlerreaktionsüberwachung im Befehlstest" UBYTE t40ms_ub_b10200 1 100 0 10200 FORMAT "%7.1" ECU_ADDRESS 0x380B70 /end MEASUREMENT
/begin MEASUREMENT romRstC_um "Zähler im DauerRAM für Resets bei ROM-Check-Fehler in der Init. in der FU" UBYTE dez 1 100 0 255 FORMAT "%5.1" ECU_ADDRESS 0x3831FD /end MEASUREMENT
/begin MEASUREMENT rst_tv_active "" UBYTE dez 1 100 0 255 FORMAT "%5.1" ECU_ADDRESS 0x3831FC /end MEASUREMENT
/begin MEASUREMENT r_flags_uc "Byte für Fehlerreaktions-Bits des Befehlstest" UBYTE dez 1 100 0 255 FORMAT "%5.1" ECU_ADDRESS 0x380B47 /end MEASUREMENT
/begin MEASUREMENT sgsc_c_uc "Fehlerzähler für Getriebeüberwachung des Befehlstestes" UBYTE t40ms_ub_b10200 1 100 0 10200 FORMAT "%7.1" ECU_ADDRESS 0x380B55 /end MEASUREMENT
/begin MEASUREMENT szfuba_w "Schließzeit Funkenband" UWORD tsegment_sy 1 100 0 43.69 FORMAT "%8.5" ECU_ADDRESS 0x382C34 /end MEASUREMENT
/begin MEASUREMENT szout_w "Schließzeitausgabe" UWORD txms_uw_q0p1 1 100 0 6553.5 FORMAT "%8.3" ECU_ADDRESS 0x382C36 /end MEASUREMENT
/begin MEASUREMENT szrl_w "korrigierte Schließzeit zur Winkelausgabe" UWORD txms_uw_q0p1 1 100 0 6553.5 FORMAT "%8.3" ECU_ADDRESS 0x382C38 /end MEASUREMENT
/begin MEASUREMENT sztcalc_w "Schliesszeit in Timer 1 Inkrementen" UWORD DEZL 1 100 0 65535 FORMAT "%8.2" ECU_ADDRESS 0x382C3A /end MEASUREMENT
/begin MEASUREMENT s_flags_uc "Byte für Status-Bits des Befehlstests" UBYTE dez 1 100 0 255 FORMAT "%5.1" ECU_ADDRESS 0x380B48 /end MEASUREMENT
/begin MEASUREMENT tfwdksom_w "Zeitkonstante für Filterung Drosselklappenwinkel ohne Momentenstruktur" UWORD zk10msxs_uw_b655 1 100 0.0100002 655.36 FORMAT "%12.8" ECU_ADDRESS 0x381FFA /end MEASUREMENT
/begin MEASUREMENT tsdrlmx_w "max. drlsolf für Lastdynamik" SWORD rel_sw_q0p0234 1 100 -768 767.977 FORMAT "%8.4" ECU_ADDRESS 0x382C3C /end MEASUREMENT
/begin MEASUREMENT tsrl "lastabhängige Schließzeit" UBYTE txms_ub_q0p1 1 100 0 25.5 FORMAT "%5.2" ECU_ADDRESS 0x380BE4 /end MEASUREMENT
/begin MEASUREMENT tsrldyn "Last- und Dynamikkorrigierte Schließzeit" UBYTE txms_ub_q0p1 1 100 0 25.5 FORMAT "%5.2" ECU_ADDRESS 0x380BE5 /end MEASUREMENT
/begin MEASUREMENT tzsCtr "" UBYTE dez 1 100 0 255 FORMAT "%5.1" ECU_ADDRESS 0x380BE6 /end MEASUREMENT
/begin MEASUREMENT t_flags_uc "Byte für Tempomat-Bits des Befehlstests" UBYTE dez 1 100 0 255 FORMAT "%5.1" ECU_ADDRESS 0x380B49 /end MEASUREMENT
/begin MEASUREMENT ubn "" UWORD B_TRUE 1 100 0 1 BIT_MASK 0x8000 FORMAT "%13.11" ECU_ADDRESS 0xFDA4 /end MEASUREMENT
/begin MEASUREMENT urmcksco "Checksumme über Code der Funktionsüberwachung im zyklischen ROM-Test" UWORD dez 1 100 0 65535 FORMAT "%8.2" ARRAY_SIZE 2 ECU_ADDRESS 0x383AB8 /end MEASUREMENT
/begin MEASUREMENT urmcksda "Checksumme über Daten der Funktionsüberwachung im zyklischen ROM-Test" UWORD dez 1 100 0 65535 FORMAT "%8.2" ARRAY_SIZE 2 ECU_ADDRESS 0x383ABC /end MEASUREMENT
/begin MEASUREMENT urmpatco "Patch-Adresse im Code der Funktionsüberwachung für Überprüfung zykl. ROM-Test" UWORD dez 1 100 0 65535 FORMAT "%8.2" ARRAY_SIZE 2 ECU_ADDRESS 0x382900 /end MEASUREMENT
/begin MEASUREMENT uzue "" UBYTE spg_ubatt 1 100 0 17.952 FORMAT "%5.2" ECU_ADDRESS 0x380BE7 /end MEASUREMENT
/begin MEASUREMENT vivmx_w "Istgeschwindigkeit der VMAX-Regelung" UWORD vfzg_uw_q0p00781 1 100 0 511.992 FORMAT "%8.4" ECU_ADDRESS 0x384C80 /end MEASUREMENT
/begin MEASUREMENT vkAbgas1 "" UBYTE dez 1 100 0 255 FORMAT "%5.1" ECU_ADDRESS 0xFA28 /end MEASUREMENT
/begin MEASUREMENT vkAbgas2 "" UBYTE dez 1 100 0 255 FORMAT "%5.1" ECU_ADDRESS 0xFA29 /end MEASUREMENT
/begin MEASUREMENT vkAntrieb "" UBYTE dez 1 100 0 255 FORMAT "%5.1" ECU_ADDRESS 0xFA2A /end MEASUREMENT
/begin MEASUREMENT vkASRAntrieb "" UBYTE dez 1 100 0 255 FORMAT "%5.1" ECU_ADDRESS 0xFA2B /end MEASUREMENT
/begin MEASUREMENT vkGetriebe "" UBYTE dez 1 100 0 255 FORMAT "%5.1" ECU_ADDRESS 0xFA2C /end MEASUREMENT
/begin MEASUREMENT vsdmr "Vorgabe Drehmomentreserve über Verstellsystem VSxy" UBYTE rel_ub_q0p3906 1 100 0 99.6094 FORMAT "%5.2" ECU_ADDRESS 0x38089D /end MEASUREMENT
/begin MEASUREMENT vsfpses "Faktor zur Verstellung Saugrohrdruck zur Applikation Einspritzung" UBYTE fak_ub_b2 1 100 0 1.99219 FORMAT "%5.3" ECU_ADDRESS 0x38089E /end MEASUREMENT
/begin MEASUREMENT vsfrk "Korrektur der relativen Kraftstoffmasse über Verstellsysteme" UBYTE fak_ub_b1p25_o0p75 1 100 0.75 1.24805 FORMAT "%5.3" ECU_ADDRESS 0x38089F /end MEASUREMENT
/begin MEASUREMENT vske "verstellbarer Offset für Klopferkennungsschwelle über VS20" SBYTE fak_ub_b16 1 100 -8 7.9375 FORMAT "%5.3" ECU_ADDRESS 0x3808A0 /end MEASUREMENT
/begin MEASUREMENT vsldtv "Verstellgröße LDR-Tastverhältnis vom VSx-System zur Applikation" UBYTE tv_ub_b100 1 100 0 99.6094 FORMAT "%5.2" ECU_ADDRESS 0x3808A1 /end MEASUREMENT
/begin MEASUREMENT vsns "Änderung der Solldrehzahl über Verstellsystem VSxy" UBYTE nmot_ub_q10 1 100 0 2550 FORMAT "%5.0" ECU_ADDRESS 0x3808A2 /end MEASUREMENT
/begin MEASUREMENT vsrlmx "Additive Füllungskorrektur für rlmx vom Verstellsystem" SBYTE rel_sb_q0p75 1 100 -96 95.25 FORMAT "%5.2" ECU_ADDRESS 0x3808A3 /end MEASUREMENT
/begin MEASUREMENT vsvmx_w "Sollgeschwindigkeit der VMAX-Regelung" UWORD vfzg_uw_q0p00781 1 100 0 511.992 FORMAT "%8.4" ECU_ADDRESS 0x384C82 /end MEASUREMENT
/begin MEASUREMENT vsvw "Änderung Einspritzvorlagerungswinkel über Verstellsystem" SBYTE zw_sb_q6 1 100 -768 762 FORMAT "%5.1" ECU_ADDRESS 0x3808A4 /end MEASUREMENT
/begin MEASUREMENT vswnws "Änderung der Winkel Nockenwelle (variable NWS) über Verstellsystem VSxy" UBYTE wkw_ub_q0p25 1 100 0 63.75 FORMAT "%5.2" ECU_ADDRESS 0x3808A5 /end MEASUREMENT
/begin MEASUREMENT vszw "Zündwinkelkorrektur durch Verstellsystem" SBYTE zw_sb_q0p75 1 100 -96 95.25 FORMAT "%5.2" ECU_ADDRESS 0x3808A6 /end MEASUREMENT
/begin MEASUREMENT vszwkr "Zylinderindividuelle ZW-Verstellung durch Verstellsystem" SBYTE zw_sb_q0p75 1 100 -96 95.25 FORMAT "%5.2" ARRAY_SIZE 8 ECU_ADDRESS 0x3808A7 /end MEASUREMENT
/begin MEASUREMENT wdksom_w "Drosselklappensollwinkel ohne Momentenstruktur" UWORD rel_uw_b100 1 100 0 99.9985 FORMAT "%8.5" ECU_ADDRESS 0x381FFC /end MEASUREMENT
/begin MEASUREMENT wphg "Zündwinkel DG-Phasenkorrektur" SBYTE zw_sb_q0p75 1 100 -96 95.25 FORMAT "%5.2" ECU_ADDRESS 0x380BC3 /end MEASUREMENT
/begin MEASUREMENT zbezdldr "Zykluszähler LDR-Diagnose" UBYTE dez 1 100 0 255 FORMAT "%5.1" ECU_ADDRESS 0x384014 /end MEASUREMENT
/begin MEASUREMENT znachanz "Anzahl der Zündungen im Nachlauf" UBYTE dez 1 100 0 255 FORMAT "%5.1" ECU_ADDRESS 0xFA2E /end MEASUREMENT
/begin MEASUREMENT zwbas "Basiszündwinkel" SBYTE zw_sb_q0p75 1 100 -96 95.25 FORMAT "%5.2" ECU_ADDRESS 0xFA2F /end MEASUREMENT
/begin MEASUREMENT zwbasar "Basiszündwinkelarray" SBYTE zw_sb_q0p75 1 100 -96 95.25 FORMAT "%5.2" ARRAY_SIZE 4 ECU_ADDRESS 0x380BC4 /end MEASUREMENT
/begin MEASUREMENT zwgru "Grundzündwinkel" SBYTE zw_sb_q0p75 1 100 -96 95.25 FORMAT "%5.2" ECU_ADDRESS 0x380BDC /end MEASUREMENT
/begin MEASUREMENT zwist "Ist-Zündwinkel" SBYTE zw_sb_q0p75 1 100 -96 95.25 FORMAT "%5.2" ECU_ADDRESS 0xFA30 /end MEASUREMENT
/begin MEASUREMENT zwkrafld "Bitmuster des zyl.ind. abgelegten B_zwkra" UBYTE dez 1 100 0 255 FORMAT "%5.1" ECU_ADDRESS 0xFA31 /end MEASUREMENT
/begin MEASUREMENT zwmn "Spätester Zündwinkel" SBYTE zw_sb_q0p75 1 100 -96 95.25 FORMAT "%5.2" ECU_ADDRESS 0x380BD4 /end MEASUREMENT
/begin MEASUREMENT zwmnd "dynamisch spätest zulässiger Zündwinkel" SBYTE zw_sb_q0p75 1 100 -96 95.25 FORMAT "%5.2" ECU_ADDRESS 0x380BD5 /end MEASUREMENT
/begin MEASUREMENT zwmnms "dauerhaft spätest möglicher Zündwinkel" SBYTE zw_sb_q0p75 1 100 -96 95.25 FORMAT "%5.2" ECU_ADDRESS 0x380BD6 /end MEASUREMENT
/begin MEASUREMENT zwnst "" SBYTE zw_sb_q0p75 1 100 -96 95.25 FORMAT "%5.2" ECU_ADDRESS 0x380BD7 /end MEASUREMENT
/begin MEASUREMENT zwnws "Grundzündwinkel mit Berücksichtigung von Nockenwellensteuerung" SBYTE zw_sb_q0p75 1 100 -96 95.25 FORMAT "%5.2" ECU_ADDRESS 0x380BDD /end MEASUREMENT
/begin MEASUREMENT zwopt_uc "optimaler Zündwinkel im Befehlstest" SBYTE zw_sb_q0p75 1 100 -96 95.25 FORMAT "%5.2" ECU_ADDRESS 0x380B5D /end MEASUREMENT
/begin MEASUREMENT zwout "Zündwinkel-Ausgabe" SBYTE zw_sb_q0p75 1 100 -96 95.25 FORMAT "%5.2" ECU_ADDRESS 0xFA32 /end MEASUREMENT
/begin MEASUREMENT zwoutar "Zündwinkel-Ausgabe Array" SBYTE zw_sb_q0p75 1 100 -96 95.25 FORMAT "%5.2" ARRAY_SIZE 4 ECU_ADDRESS 0x380BC8 /end MEASUREMENT
/begin MEASUREMENT zwoutcpl "Einerkomplement des Zündwinkels für die Funktionsüberwachung" SBYTE zw_sb_q0p75 1 100 -96 95.25 FORMAT "%5.2" ECU_ADDRESS 0x380BCC /end MEASUREMENT
/begin MEASUREMENT zwspae "Spätester Zündwinkel" SBYTE zw_sb_q0p75 1 100 -96 95.25 FORMAT "%5.2" ECU_ADDRESS 0x380BD8 /end MEASUREMENT
/begin MEASUREMENT zwstt "Zündwinkel im Start" SBYTE zw_sb_q0p75 1 100 -96 95.25 FORMAT "%5.2" ECU_ADDRESS 0x380BDF /end MEASUREMENT
/begin MEASUREMENT zwzyl1 "Zündwinkel Zylinder 1" SBYTE zw_sb_q0p75 1 100 -96 95.25 FORMAT "%5.2" ECU_ADDRESS 0x380BCD /end MEASUREMENT
/begin MEASUREMENT z_flags_uc "Byte für Status-Bits beim 2-SG-Konzept im Befehlstestes" UBYTE dez 1 100 0 255 FORMAT "%5.1" ECU_ADDRESS 0x380B4A /end MEASUREMENT
/begin FUNCTION URCFGRC "" /begin DEF_CHARACTERISTIC VMIN_UC /end DEF_CHARACTERISTIC /begin REF_CHARACTERISTIC /end REF_CHARACTERISTIC /begin IN_MEASUREMENT B_fgrfr_uc mifa_uc vfzg_uc /end IN_MEASUREMENT /begin OUT_MEASUREMENT B_fgr_uc mfgr_uc /end OUT_MEASUREMENT /begin LOC_MEASUREMENT /end LOC_MEASUREMENT /begin SUB_FUNCTION /end SUB_FUNCTION /end FUNCTION
/begin FUNCTION URCMIST "" /begin DEF_CHARACTERISTIC KFMI_UC KFZW_UC KLETAZW_UC /end DEF_CHARACTERISTIC /begin REF_CHARACTERISTIC NZWV08_UC RLV08_UC /end REF_CHARACTERISTIC /begin IN_MEASUREMENT nmot_uc nzwst08_uc rlst08_uc rl_uc zwout_uc /end IN_MEASUREMENT /begin OUT_MEASUREMENT mi_uc /end OUT_MEASUREMENT /begin LOC_MEASUREMENT dzw_uc etazw_uc miopt_uc zwopt_uc /end LOC_MEASUREMENT /begin SUB_FUNCTION /end SUB_FUNCTION /end FUNCTION
/begin FUNCTION URCMSRC "" /begin DEF_CHARACTERISTIC BZ_MSR_UC DBZ_MN_UC DBZ_MX_UC MSRC_T_UC NOASR_UC /end DEF_CHARACTERISTIC /begin REF_CHARACTERISTIC /end REF_CHARACTERISTIC /begin IN_MEASUREMENT bzmsr_a_uc bz_msr_uc B_nomsrfr_uc /end IN_MEASUREMENT /begin OUT_MEASUREMENT B_nomsr_uc ei_msrc_uc mmsr_uc msrc_c_uc /end OUT_MEASUREMENT /begin LOC_MEASUREMENT B_nkons_uc /end LOC_MEASUREMENT /begin SUB_FUNCTION /end SUB_FUNCTION /end FUNCTION
/begin FUNCTION URCMVER "" /begin DEF_CHARACTERISTIC MVER_T_UC /end DEF_CHARACTERISTIC /begin REF_CHARACTERISTIC /end REF_CHARACTERISTIC /begin IN_MEASUREMENT mi_uc mzf_uc mzo_uc /end IN_MEASUREMENT /begin OUT_MEASUREMENT B_i_ska_uc ei_mver_uc /end OUT_MEASUREMENT /begin LOC_MEASUREMENT mdif_w_uc mver_c_uc mzfo_uc /end LOC_MEASUREMENT /begin SUB_FUNCTION /end SUB_FUNCTION /end FUNCTION
/begin FUNCTION URCMZF "" /begin DEF_CHARACTERISTIC MZFFIL_UC MZFTV_UC /end DEF_CHARACTERISTIC /begin REF_CHARACTERISTIC /end REF_CHARACTERISTIC /begin IN_MEASUREMENT mz_uc /end IN_MEASUREMENT /begin OUT_MEASUREMENT mzf_uc /end OUT_MEASUREMENT /begin LOC_MEASUREMENT mzf_low_uc mzf_ptr_uc mzf_reg_uc /end LOC_MEASUREMENT /begin SUB_FUNCTION /end SUB_FUNCTION /end FUNCTION
/begin FUNCTION URCMZUL "" /begin DEF_CHARACTERISTIC KFMDZOF_UC KFMPED_UC KFMPNS_UC MDV08_UC /end DEF_CHARACTERISTIC /begin REF_CHARACTERISTIC NMV08_UC SPSNV08_UC /end REF_CHARACTERISTIC
 /begin IN_MEASUREMENT mfgr_uc mmsr_uc msgs_uc nmot_uc nmst08_uc spsnst08_uc spsn_uc /end IN_MEASUREMENT
 /begin OUT_MEASUREMENT mdst08_uc mzo_uc mz_uc /end OUT_MEASUREMENT
 /begin LOC_MEASUREMENT mped_uc /end LOC_MEASUREMENT
 /begin SUB_FUNCTION /end SUB_FUNCTION
/end FUNCTION
/begin FUNCTION URCRAM "" /begin DEF_CHARACTERISTIC /end DEF_CHARACTERISTIC /begin REF_CHARACTERISTIC /end REF_CHARACTERISTIC /begin IN_MEASUREMENT /end IN_MEASUREMENT
 /begin OUT_MEASUREMENT b_flags_uc n_flags_uc r_flags_uc s_flags_uc t_flags_uc z_flags_uc /end OUT_MEASUREMENT
 /begin LOC_MEASUREMENT /end LOC_MEASUREMENT
 /begin SUB_FUNCTION /end SUB_FUNCTION
/end FUNCTION
/begin FUNCTION URCREAC "" /begin DEF_CHARACTERISTIC KLNPED_UC NOREA_UC REAC_T1_UC REAC_T2_UC SKA_DRHZ_UC /end DEF_CHARACTERISTIC /begin REF_CHARACTERISTIC /end REF_CHARACTERISTIC /begin IN_MEASUREMENT B_i_ska_uc evz_aus_uc nmot_uc spsn_uc /end IN_MEASUREMENT /begin OUT_MEASUREMENT ei_reac_uc /end OUT_MEASUREMENT /begin LOC_MEASUREMENT nska_uc reac_c1_uc reac_c2_uc /end LOC_MEASUREMENT /begin SUB_FUNCTION /end SUB_FUNCTION /end FUNCTION
/begin FUNCTION URCREF "" /begin DEF_CHARACTERISTIC /end DEF_CHARACTERISTIC /begin REF_CHARACTERISTIC MZFTV_UC /end REF_CHARACTERISTIC
 /begin IN_MEASUREMENT msrc_c_uc mver_c_uc mzf_low_uc mzf_ptr_uc mzf_reg_uc mzf_uc reac_c1_uc reac_c2_uc sgsc_c_uc /end IN_MEASUREMENT
 /begin OUT_MEASUREMENT /end OUT_MEASUREMENT
 /begin LOC_MEASUREMENT /end LOC_MEASUREMENT
 /begin SUB_FUNCTION /end SUB_FUNCTION
/end FUNCTION
/begin FUNCTION URCSGSC "" /begin DEF_CHARACTERISTIC /end DEF_CHARACTERISTIC /begin REF_CHARACTERISTIC /end REF_CHARACTERISTIC /begin IN_MEASUREMENT /end IN_MEASUREMENT /begin OUT_MEASUREMENT B_nosgs_uc ei_sgsc_uc msgs_uc sgsc_c_uc /end OUT_MEASUREMENT /begin LOC_MEASUREMENT /end LOC_MEASUREMENT /begin SUB_FUNCTION /end SUB_FUNCTION /end FUNCTION
/begin FUNCTION URDELAY "" /begin DEF_CHARACTERISTIC /end DEF_CHARACTERISTIC /begin REF_CHARACTERISTIC NOREA_UM RST_TV_UM WAIT_T_UM /end REF_CHARACTERISTIC /begin IN_MEASUREMENT rst_tv /end IN_MEASUREMENT /begin OUT_MEASUREMENT delayedTime_w rst_tv_active /end OUT_MEASUREMENT /begin LOC_MEASUREMENT /end LOC_MEASUREMENT /begin SUB_FUNCTION /end SUB_FUNCTION /end FUNCTION
/begin FUNCTION URMEM "3.10      EGAS Überwachungskonzept: Zyklischer Speichertest" /begin DEF_CHARACTERISTIC /end DEF_CHARACTERISTIC /begin REF_CHARACTERISTIC /end REF_CHARACTERISTIC /begin IN_MEASUREMENT /end IN_MEASUREMENT /begin OUT_MEASUREMENT urmcksco urmcksda urmpatco /end OUT_MEASUREMENT /begin LOC_MEASUREMENT /end LOC_MEASUREMENT /begin SUB_FUNCTION /end SUB_FUNCTION /end FUNCTION
/begin FUNCTION URRAM "2.10      EGAS Überwachungskonzept: RAM-Test" /begin DEF_CHARACTERISTIC /end DEF_CHARACTERISTIC /begin REF_CHARACTERISTIC /end REF_CHARACTERISTIC /begin IN_MEASUREMENT /end IN_MEASUREMENT /begin OUT_MEASUREMENT /end OUT_MEASUREMENT /begin LOC_MEASUREMENT /end LOC_MEASUREMENT /begin SUB_FUNCTION /end SUB_FUNCTION /end FUNCTION
/begin FUNCTION URROM "2.20      EGAS Überwachungskonzept: ROM-Test" /begin DEF_CHARACTERISTIC CW_NOROMCHKRESET ROMRSTA_UM /end DEF_CHARACTERISTIC /begin REF_CHARACTERISTIC /end REF_CHARACTERISTIC /begin IN_MEASUREMENT B_nlsiko swOffDlBits /end IN_MEASUREMENT /begin OUT_MEASUREMENT romRstC_um /end OUT_MEASUREMENT /begin LOC_MEASUREMENT /end LOC_MEASUREMENT /begin SUB_FUNCTION /end SUB_FUNCTION /end FUNCTION
/begin FUNCTION VAR "290.210   Variantencodierung" /begin DEF_CHARACTERISTIC VARTAB /end DEF_CHARACTERISTIC /begin REF_CHARACTERISTIC /end REF_CHARACTERISTIC /begin IN_MEASUREMENT /end IN_MEASUREMENT /begin OUT_MEASUREMENT vkAbgas1 vkAbgas2 vkAntrieb vkASRAntrieb vkGetriebe /end OUT_MEASUREMENT /begin LOC_MEASUREMENT /end LOC_MEASUREMENT /begin SUB_FUNCTION /end SUB_FUNCTION /end FUNCTION
/begin FUNCTION VAR_DST "" /begin DEF_CHARACTERISTIC /end DEF_CHARACTERISTIC /begin REF_CHARACTERISTIC VARDEF VARTAB /end REF_CHARACTERISTIC /begin IN_MEASUREMENT /end IN_MEASUREMENT /begin OUT_MEASUREMENT /end OUT_MEASUREMENT /begin LOC_MEASUREMENT pmcod_w /end LOC_MEASUREMENT /begin SUB_FUNCTION /end SUB_FUNCTION /end FUNCTION
/begin FUNCTION VMAXMD "5.10      Drehmomentanforderung von VMAX-Regelung" /begin DEF_CHARACTERISTIC KIVMXG KPVMXG TVMXPRG /end DEF_CHARACTERISTIC /begin REF_CHARACTERISTIC /end REF_CHARACTERISTIC /begin IN_MEASUREMENT bfzgl_w dmllri_w gangi mifab_w mimin_w vfzg_w vmax_w /end IN_MEASUREMENT /begin OUT_MEASUREMENT B_vmax mivmx_w /end OUT_MEASUREMENT /begin LOC_MEASUREMENT dvsi_w mivmxi_w mivmxp_w vivmx_w vsvmx_w /end LOC_MEASUREMENT /begin SUB_FUNCTION /end SUB_FUNCTION /end FUNCTION
/begin FUNCTION VS_VERST "2.40      Verstellparameter für McMess" /begin DEF_CHARACTERISTIC CWVSV /end DEF_CHARACTERISTIC /begin REF_CHARACTERISTIC /end REF_CHARACTERISTIC /begin IN_MEASUREMENT /end IN_MEASUREMENT
 /begin OUT_MEASUREMENT vsdmr vsfpses vsfrk vske vsldtv vsns vsrlmx vsvw vswnws vszw vszwkr /end OUT_MEASUREMENT
 /begin LOC_MEASUREMENT B_mcacti /end LOC_MEASUREMENT
 /begin SUB_FUNCTION /end SUB_FUNCTION
/end FUNCTION
/begin FUNCTION WDKSOM "1.10      Berechnung Drosselklappensollwinkel ohne Momentenstruktur" /begin DEF_CHARACTERISTIC TFWDKSOM WDKSNLN /end DEF_CHARACTERISTIC /begin REF_CHARACTERISTIC /end REF_CHARACTERISTIC /begin IN_MEASUREMENT nmot_w /end IN_MEASUREMENT /begin OUT_MEASUREMENT B_tfwdksom B_wdksom tfwdksom_w wdksom_w /end OUT_MEASUREMENT /begin LOC_MEASUREMENT /end LOC_MEASUREMENT /begin SUB_FUNCTION /end SUB_FUNCTION /end FUNCTION
/begin FUNCTION ZLDRD "1.10" /begin DEF_CHARACTERISTIC /end DEF_CHARACTERISTIC /begin REF_CHARACTERISTIC /end REF_CHARACTERISTIC /begin IN_MEASUREMENT /end IN_MEASUREMENT /begin OUT_MEASUREMENT zbezdldr /end OUT_MEASUREMENT /begin LOC_MEASUREMENT /end LOC_MEASUREMENT /begin SUB_FUNCTION /end SUB_FUNCTION /end FUNCTION
/begin FUNCTION ZUE "282.130   Grundfunktion - Zündung" /begin DEF_CHARACTERISTIC KLZWBSMN NACHANZ WPHN ZWAPPL /end DEF_CHARACTERISTIC /begin REF_CHARACTERISTIC SNM08__UB /end REF_CHARACTERISTIC
 /begin IN_MEASUREMENT B_llrein B_nozwe B_sa B_zwappl dwkrz dzwob dzwwl dzwzk esst_snm08__ub nmot redist vstdzw vszw wkrdy zwgru zwsol zwspae zwstt zzylzue /end IN_MEASUREMENT
 /begin OUT_MEASUREMENT B_zwkra B_zwspae znachanz zwbas zwbasar zwist zwkrafld zwout zwoutar zwoutcpl zwzyl1 /end OUT_MEASUREMENT
 /begin LOC_MEASUREMENT wphg /end LOC_MEASUREMENT
 /begin SUB_FUNCTION /end SUB_FUNCTION
/end FUNCTION
/begin FUNCTION ZUESZ "3.50      Zündung, Berechnung Schließzeit"
 /begin DEF_CHARACTERISTIC CW_FUBND DTSDRL DUBZS FFLDZ FSWTM FSZTM FTOMN FTSDRLW FUBAOF FWNMOT KFFFANZ KFSZDUB KFSZT KFTSDYN KFTSRL NMNZUESA NMXZUESA TSMNSA TSMX TSMXNL TZSUDYN /end DEF_CHARACTERISTIC
 /begin REF_CHARACTERISTIC /end REF_CHARACTERISTIC
 /begin IN_MEASUREMENT B_lsd B_sa drlsolf_w E_dk E_lm ngfil ngfil_w nmot nmot_w rl tmot ub wped /end IN_MEASUREMENT
 /begin OUT_MEASUREMENT B_ff fubaanz offz_w szfuba_w sztcalc_w /end OUT_MEASUREMENT
 /begin LOC_MEASUREMENT B_swdy B_zb B_zuesa ftsdrl ftsdyn ftsub szout_w szrl_w tsdrlmx_w tsrl tsrldyn tzsCtr ubn uzue /end LOC_MEASUREMENT
 /begin SUB_FUNCTION /end SUB_FUNCTION
/end FUNCTION
/begin FUNCTION ZWGRU "23.110    Grundzündwinkel" /begin DEF_CHARACTERISTIC CNOKT DZWNWSUE KFDZK KFDZWKG KFSWKFZK KFZW KFZW2 TSWKR /end DEF_CHARACTERISTIC /begin REF_CHARACTERISTIC SNM16ZUUW SRL12ZUUW /end REF_CHARACTERISTIC
 /begin IN_MEASUREMENT B_krdws dzwoag dzwol esst_snm16zuuw esst_srl12zuuw fnwue lambas nmot nmot_w rl_w wkrma wnwue /end IN_MEASUREMENT
 /begin OUT_MEASUREMENT B_kfzk dzwkg dzwnwsu dzwzk zwgru /end OUT_MEASUREMENT
 /begin LOC_MEASUREMENT zwnws /end LOC_MEASUREMENT
 /begin SUB_FUNCTION /end SUB_FUNCTION
/end FUNCTION
/begin FUNCTION ZWMIN "5.10      Berechnung des spätest erlaubten Zündwinkels"
 /begin DEF_CHARACTERISTIC CWKHZW DNTIPDYN DZWAML DZWDYN DZWSPM FZWKHMX KFZWMN KFZWMNKH KFZWMNST KFZWMS KLZZWMNST TTIPINEN TTIPINON TVZWMSA TVZWMSE ZWSPTIP /end DEF_CHARACTERISTIC
 /begin REF_CHARACTERISTIC ETADZW SNM16ZUUW SRL12ZUUW STM06__UB /end REF_CHARACTERISTIC
 /begin IN_MEASUREMENT B_kh B_kuppl B_kw B_sa B_st dzwoag dzw_kge esst_snm16zuuw esst_srl12zuuw esst_stm06__ub fmdkh gangi migs_w misolv_w misol_w ml ngfil nmot nmot_w rl rl_w tmot tmst tnst_w zwist zwopt /end IN_MEASUREMENT
 /begin OUT_MEASUREMENT dzwspae etazwmn zwspae /end OUT_MEASUREMENT
 /begin LOC_MEASUREMENT B_zwmnste B_zwms dzwdyn dzwmna zwmn zwmnd zwmnms zwnst /end LOC_MEASUREMENT
 /begin SUB_FUNCTION /end SUB_FUNCTION
/end FUNCTION
/begin FUNCTION ZWOB "4.10      Zündwinkel - Overboost" /begin DEF_CHARACTERISTIC KFDZWOB KFTZWOB WDZWOBT /end DEF_CHARACTERISTIC /begin REF_CHARACTERISTIC /end REF_CHARACTERISTIC /begin IN_MEASUREMENT evtmod nmot nmot_w rl rl_w /end IN_MEASUREMENT /begin OUT_MEASUREMENT dzwob /end OUT_MEASUREMENT /begin LOC_MEASUREMENT /end LOC_MEASUREMENT /begin SUB_FUNCTION /end SUB_FUNCTION /end FUNCTION
/begin FUNCTION ZWSTT "4.30      Zündung im Start" /begin DEF_CHARACTERISTIC DZWSTTA KFZWSTTM /end DEF_CHARACTERISTIC /begin REF_CHARACTERISTIC /end REF_CHARACTERISTIC /begin IN_MEASUREMENT B_llrein nmot tans tmst /end IN_MEASUREMENT /begin OUT_MEASUREMENT zwstt /end OUT_MEASUREMENT /begin LOC_MEASUREMENT /end LOC_MEASUREMENT /begin SUB_FUNCTION /end SUB_FUNCTION /end FUNCTION
/begin FUNCTION ZWWL "5.40      Warmlauf Zündwinkel" /begin DEF_CHARACTERISTIC FZWWLRLN KFZWWLNM KFZWWLRL /end DEF_CHARACTERISTIC /begin REF_CHARACTERISTIC SNM12ESUB SRL06ESUB STA12WLUB STM12ESUB /end REF_CHARACTERISTIC
 /begin IN_MEASUREMENT esst_snm12esub esst_srl06esub esst_sta12wlub esst_stm12esub nmot rl tans tmot /end IN_MEASUREMENT
 /begin OUT_MEASUREMENT dzwwl /end OUT_MEASUREMENT
 /begin LOC_MEASUREMENT /end LOC_MEASUREMENT
 /begin SUB_FUNCTION /end SUB_FUNCTION
/end FUNCTION
/begin COMPU_METHOD B_TRUE "boolsche Zustände, positive Logik" TAB_VERB "%6.3" "" COMPU_TAB_REF B_TRUE /end COMPU_METHOD
/begin COMPU_VTAB B_TRUE "boolsche Zustände, positive Logik" TAB_VERB 2 0 "----" 1 "TRUE" /end COMPU_VTAB
/begin COMPU_METHOD dez "1 : 1 Umrechnug (dez/hex)" RAT_FUNC "%6.2" "" COEFFS 0 1 0 0 0 1 /end COMPU_METHOD
/begin COMPU_METHOD DEZL "Dezimalzahl in 16-Bit-Hexzahl" RAT_FUNC "%6.2" "" COEFFS 0 1 0 0 0 1 /end COMPU_METHOD
/begin COMPU_METHOD fak_ub_b16 "" RAT_FUNC "%6.4" "-" COEFFS 0 256 0 0 0 16 /end COMPU_METHOD
/begin COMPU_METHOD fak_ub_b1p25_o0p75 "" RAT_FUNC "%6.3" "-" COEFFS 0 1 -0.75 0 0 0.00195313 /end COMPU_METHOD
/begin COMPU_METHOD fak_ub_b2 "" RAT_FUNC "%6.4" "-" COEFFS 0 256 0 0 0 2 /end COMPU_METHOD
/begin COMPU_METHOD fak_ub_b8 "" RAT_FUNC "%6.4" "-" COEFFS 0 256 0 0 0 8 /end COMPU_METHOD
/begin COMPU_METHOD fak_uw_b8 "" RAT_FUNC "%6.5" "-" COEFFS 0 65536 0 0 0 8 /end COMPU_METHOD
/begin COMPU_METHOD kw_q0p5 "" RAT_FUNC "%6.3" "°KW" COEFFS 0 2 0 0 0 1 /end COMPU_METHOD
/begin COMPU_METHOD m_ub_b1020 "" RAT_FUNC "%6.2" "kg/h" COEFFS 0 1 0 0 0 4 /end COMPU_METHOD
/begin COMPU_METHOD nmotg_sb_q100 "" RAT_FUNC "%6.0" "U/min/s" COEFFS 0 1 0 0 0 100 /end COMPU_METHOD
/begin COMPU_METHOD nmotg_sw_q0p39 "" RAT_FUNC "%6.3" "U/min/s" COEFFS 0 1 0 0 0 0.39063 /end COMPU_METHOD
/begin COMPU_METHOD nmot_ub_q10 "" RAT_FUNC "%6.1" "U/min" COEFFS 0 1 0 0 0 10 /end COMPU_METHOD
/begin COMPU_METHOD nmot_ub_q40 "" RAT_FUNC "%6.1" "Upm" COEFFS 0 1 0 0 0 40 /end COMPU_METHOD
/begin COMPU_METHOD nmot_uw_q0p25 "" RAT_FUNC "%6.3" "U/min" COEFFS 0 1 0 0 0 0.25 /end COMPU_METHOD
/begin COMPU_METHOD rel_q0p007629 "" RAT_FUNC "%10.6" "%/(km/h)/s" COEFFS 0 65536 0 0 0 500 /end COMPU_METHOD
/begin COMPU_METHOD rel_sb_q0p75 "" RAT_FUNC "%6.3" "%" COEFFS 0 1 0 0 0 0.75 /end COMPU_METHOD
/begin COMPU_METHOD rel_sw_b100 "" RAT_FUNC "%6.4" "%" COEFFS 0 32768 0 0 0 100 /end COMPU_METHOD
/begin COMPU_METHOD rel_sw_q0p0234 "" RAT_FUNC "%6.4" "%/seg" COEFFS 0 32 0 0 0 0.75 /end COMPU_METHOD
/begin COMPU_METHOD rel_ub_b127p5 "" RAT_FUNC "%6.3" "%" COEFFS 0 2 0 0 0 1 /end COMPU_METHOD
/begin COMPU_METHOD rel_ub_b99p6 "" RAT_FUNC "%6.3" "%" COEFFS 0 256 0 0 0 100 /end COMPU_METHOD
/begin COMPU_METHOD rel_ub_q0p00153 "" RAT_FUNC "%6.4" "%" COEFFS 0 256 0 0 0 0.3906 /end COMPU_METHOD
/begin COMPU_METHOD rel_ub_q0p3906 "" RAT_FUNC "%6.3" "%" COEFFS 0 256 0 0 0 100 /end COMPU_METHOD
/begin COMPU_METHOD rel_ub_q0p391 "" RAT_FUNC "%6.3" "%/km/h" COEFFS 0 1 0 0 0 0.391 /end COMPU_METHOD
/begin COMPU_METHOD rel_ub_q0p75 "" RAT_FUNC "%6.3" "%" COEFFS 0 1 0 0 0 0.75 /end COMPU_METHOD
/begin COMPU_METHOD rel_uw_b100 "" RAT_FUNC "%6.4" "%" COEFFS 0 65536 0 0 0 100 /end COMPU_METHOD
/begin COMPU_METHOD rel_uw_q0p0234 "" RAT_FUNC "%6.4" "%" COEFFS 0 32 0 0 0 0.75 /end COMPU_METHOD
/begin COMPU_METHOD spg_ubatt "" RAT_FUNC "%6.4" "V" COEFFS 0 1 0 0 0 0.0704 /end COMPU_METHOD
/begin COMPU_METHOD spg_ub_q0p019 "" RAT_FUNC "%6.4" "V" COEFFS 0 256 0 0 0 5 /end COMPU_METHOD
/begin COMPU_METHOD t100msxs_ub_b25p5 "" RAT_FUNC "%6.3" "s" COEFFS 0 1 0 0 0 0.1 /end COMPU_METHOD
/begin COMPU_METHOD t10msxs_ub_b2p55 "" RAT_FUNC "%6.4" "s" COEFFS 0 1 0 0 0 0.01 /end COMPU_METHOD
/begin COMPU_METHOD t10msxs_uw_b655p35 "" RAT_FUNC "%6.4" "s" COEFFS 0 1 0 0 0 0.01 /end COMPU_METHOD
/begin COMPU_METHOD t200msxs_sb_b25p5 "" RAT_FUNC "%6.3" "s" COEFFS 0 1 0 0 0 0.2 /end COMPU_METHOD
/begin COMPU_METHOD t20msxs_ub_q0p02 "" RAT_FUNC "%6.4" "s" COEFFS 0 50 0 0 0 1 /end COMPU_METHOD
/begin COMPU_METHOD t40ms_ub_b10200 "" RAT_FUNC "%7.2" "ms" COEFFS 0 1 0 0 0 40 /end COMPU_METHOD
/begin COMPU_METHOD t50msxs_ub_b12p75 "" RAT_FUNC "%6.4" "s" COEFFS 0 1 0 0 0 0.05 /end COMPU_METHOD
/begin COMPU_METHOD temp_ub_q0p75_o48 "" RAT_FUNC "%6.2" "Grad C" COEFFS 0 1 48 0 0 0.75 /end COMPU_METHOD
/begin COMPU_METHOD tsegment_sy "" RAT_FUNC "%6.5" "ms" COEFFS 0 1500 0 0 0 1 /end COMPU_METHOD
/begin COMPU_METHOD tv_ub_b100 "" RAT_FUNC "%6.3" "%" COEFFS 0 256 0 0 0 100 /end COMPU_METHOD
/begin COMPU_METHOD txms_ub_q0p1 "" RAT_FUNC "%6.3" "ms" COEFFS 0 10 0 0 0 1 /end COMPU_METHOD
/begin COMPU_METHOD txms_uw_q0p1 "" RAT_FUNC "%6.3" "ms" COEFFS 0 10 0 0 0 1 /end COMPU_METHOD
/begin COMPU_METHOD t_q0p001 "" RAT_FUNC "%6.5" "s" COEFFS 0 1000 0 0 0 1 /end COMPU_METHOD
/begin COMPU_METHOD t_wdt_high "" RAT_FUNC "%6.2" "ms" COEFFS 0 0.732422 0 0 0 1 /end COMPU_METHOD
/begin COMPU_METHOD vfzg_sw_q0p00781 "" RAT_FUNC "%6.4" "km/h" COEFFS 0 1 0 0 0 0.0078125 /end COMPU_METHOD
/begin COMPU_METHOD vfzg_uw_q0p00781 "" RAT_FUNC "%6.4" "km/h" COEFFS 0 1 0 0 0 0.0078125 /end COMPU_METHOD
/begin COMPU_METHOD wkw_ub_q0p25 "" RAT_FUNC "%6.3" "° KW" COEFFS 0 100 0 0 0 25 /end COMPU_METHOD
/begin COMPU_METHOD zk10msxs_uw_b655 "" RAT_FUNC "%12.5" "s" COEFFS 0 0 65536 0 100 0 /end COMPU_METHOD
/begin COMPU_METHOD zk40ms_ub_b10200 "" RAT_FUNC "%6.1" "ms" COEFFS 0 0 10240 0 1 40 /end COMPU_METHOD
/begin COMPU_METHOD zw_sb_q0p75 "" RAT_FUNC "%6.3" "grad KW" COEFFS 0 255 0 0 0 191.25 /end COMPU_METHOD
/begin COMPU_METHOD zw_sb_q6 "" RAT_FUNC "%6.2" "Grad KW" COEFFS 0 1 0 0 0 6 /end COMPU_METHOD
/begin COMPU_METHOD zw_ub_q0p75 "" RAT_FUNC "%6.3" "Grad KW" COEFFS 0 255 0 0 0 191.25 /end COMPU_METHOD
/begin COMPU_METHOD zw_ub_qn0p75 "" RAT_FUNC "%6.4" "grad KW" COEFFS 0 1 0 0 0 -0.75 /end COMPU_METHOD
/begin RECORD_LAYOUT FklWUb FNC_VALUES 1 UBYTE COLUMN_DIR DIRECT /end RECORD_LAYOUT
/begin RECORD_LAYOUT FklWUw FNC_VALUES 1 UWORD COLUMN_DIR DIRECT /end RECORD_LAYOUT
/begin RECORD_LAYOUT GkfWSb FNC_VALUES 1 SBYTE COLUMN_DIR DIRECT /end RECORD_LAYOUT
/begin RECORD_LAYOUT GkfWUb FNC_VALUES 1 UBYTE COLUMN_DIR DIRECT /end RECORD_LAYOUT
/begin RECORD_LAYOUT GklWSb FNC_VALUES 1 SBYTE COLUMN_DIR DIRECT /end RECORD_LAYOUT
/begin RECORD_LAYOUT KfAxUbAyUbSstxSwSstyUbWUw NO_AXIS_PTS_X 1 UBYTE NO_AXIS_PTS_Y 2 UBYTE AXIS_PTS_X 3 SWORD INDEX_INCR DIRECT AXIS_PTS_Y 4 UBYTE INDEX_INCR DIRECT FNC_VALUES 5 UWORD COLUMN_DIR DIRECT /end RECORD_LAYOUT
/begin RECORD_LAYOUT KfAxUbAyUbSstxUbSstyUbWSb NO_AXIS_PTS_X 1 UBYTE NO_AXIS_PTS_Y 2 UBYTE AXIS_PTS_X 3 UBYTE INDEX_INCR DIRECT AXIS_PTS_Y 4 UBYTE INDEX_INCR DIRECT FNC_VALUES 5 SBYTE COLUMN_DIR DIRECT /end RECORD_LAYOUT
/begin RECORD_LAYOUT KfAxUbAyUbSstxUbSstyUbWUb NO_AXIS_PTS_X 1 UBYTE NO_AXIS_PTS_Y 2 UBYTE AXIS_PTS_X 3 UBYTE INDEX_INCR DIRECT AXIS_PTS_Y 4 UBYTE INDEX_INCR DIRECT FNC_VALUES 5 UBYTE COLUMN_DIR DIRECT /end RECORD_LAYOUT
/begin RECORD_LAYOUT KlAUbSstUbWSb NO_AXIS_PTS_X 1 UBYTE AXIS_PTS_X 2 UBYTE INDEX_INCR DIRECT FNC_VALUES 3 SBYTE COLUMN_DIR DIRECT /end RECORD_LAYOUT
/begin RECORD_LAYOUT KlAUbSstUbWUb NO_AXIS_PTS_X 1 UBYTE AXIS_PTS_X 2 UBYTE INDEX_INCR DIRECT FNC_VALUES 3 UBYTE COLUMN_DIR DIRECT /end RECORD_LAYOUT
/begin RECORD_LAYOUT KlAUbSstUbWUw NO_AXIS_PTS_X 1 UBYTE AXIS_PTS_X 2 UBYTE INDEX_INCR DIRECT FNC_VALUES 3 UWORD COLUMN_DIR DIRECT /end RECORD_LAYOUT
/begin RECORD_LAYOUT KlAUwSstSwWUw NO_AXIS_PTS_X 1 UWORD AXIS_PTS_X 2 SWORD INDEX_INCR DIRECT FNC_VALUES 3 UWORD COLUMN_DIR DIRECT /end RECORD_LAYOUT
/begin RECORD_LAYOUT KlAUwSstUwWUw NO_AXIS_PTS_X 1 UWORD AXIS_PTS_X 2 UWORD INDEX_INCR DIRECT FNC_VALUES 3 UWORD COLUMN_DIR DIRECT /end RECORD_LAYOUT
/begin RECORD_LAYOUT KwbUw FNC_VALUES 1 UWORD COLUMN_DIR DIRECT /end RECORD_LAYOUT
/begin RECORD_LAYOUT KwSb FNC_VALUES 1 SBYTE COLUMN_DIR DIRECT /end RECORD_LAYOUT
/begin RECORD_LAYOUT KwSw FNC_VALUES 1 SWORD COLUMN_DIR DIRECT /end RECORD_LAYOUT
/begin RECORD_LAYOUT KwUb FNC_VALUES 1 UBYTE COLUMN_DIR DIRECT /end RECORD_LAYOUT
/begin RECORD_LAYOUT KwUw FNC_VALUES 1 UWORD COLUMN_DIR DIRECT /end RECORD_LAYOUT
/begin RECORD_LAYOUT SstAUbSstUb NO_AXIS_PTS_X 1 UBYTE AXIS_PTS_X 2 UBYTE INDEX_INCR DIRECT /end RECORD_LAYOUT
/begin RECORD_LAYOUT SstAUwSstUw NO_AXIS_PTS_X 1 UWORD AXIS_PTS_X 2 UWORD INDEX_INCR DIRECT /end RECORD_LAYOUT
/end MODULE
/end PROJECT
