/* Erstellt von DAMOS++ V1.22 Win2000 */
ASAP2_VERSION 1 3
/begin PROJECT S1103A_25G5_0 "S1103A"
/begin HEADER "" VERSION "S1103A_25G5_0" PROJECT_NO S1103A_25G5_0 /end HEADER
/begin MODULE DIM ""
/begin MOD_PAR "S1103A" VERSION "PrV = S25g5 mit A0" ADDR_EPK 0x8FCCCD EPK "43/1/ME7.1.1C3/5/S1103A//25G5/DstA0/140605/" CUSTOMER_NO "5" USER "" PHONE_NO "" CPU_TYPE "S80166" ECU "ME7.1.1C3"
 /begin MEMORY_SEGMENT Pst0 "" RESERVED FLASH INTERN 0x0 0x8000 -1 -1 -1 -1 -1 /begin IF_DATA ETK ADDRESS_MAPPING 0x0 0x0 0x8000 /end IF_DATA /end MEMORY_SEGMENT
 /begin MEMORY_SEGMENT Pst18000 "" RESERVED FLASH INTERN 0x18000 0x8000 -1 -1 -1 -1 -1 /begin IF_DATA ETK ADDRESS_MAPPING 0x18000 0x18000 0x8000 /end IF_DATA /end MEMORY_SEGMENT
 /begin MEMORY_SEGMENT Pst20000 "" RESERVED FLASH INTERN 0x20000 0xB0000 -1 -1 -1 -1 -1 /begin IF_DATA ETK ADDRESS_MAPPING 0x20000 0x20000 0xB0000 /end IF_DATA /end MEMORY_SEGMENT
 /begin MEMORY_SEGMENT Pst800000 "" CODE EPROM EXTERN 0x800000 0xE0000 -1 -1 -1 -1 -1 /begin IF_DATA ETK ADDRESS_MAPPING 0x800000 0x800000 0xE0000 /end IF_DATA /end MEMORY_SEGMENT
 /begin MEMORY_SEGMENT Dst8E0000 "" DATA EPROM EXTERN 0x8E0000 0x20000 -1 -1 -1 -1 -1 /begin IF_DATA ETK ADDRESS_MAPPING 0x8E0000 0x8E0000 0x20000 /end IF_DATA /end MEMORY_SEGMENT
 /begin MEMORY_SEGMENT ExtRam380000 "" VARIABLES RAM EXTERN 0x380000 0x6000 -1 -1 -1 -1 -1 /begin IF_DATA ETK ADDRESS_MAPPING 0x380000 0x380000 0x6000 /end IF_DATA /begin IF_DATA ASAP1B_MCMESS ADDRESS_MAPPING 0x380000 0x388000 0x6000 /end IF_DATA /end MEMORY_SEGMENT
 /begin MEMORY_SEGMENT ExtRam386000 "" VARIABLES RAM EXTERN 0x386000 0x2000 -1 -1 -1 -1 -1 /begin IF_DATA ETK ADDRESS_MAPPING 0x386000 0x386000 0x2000 /end IF_DATA /begin IF_DATA ASAP1B_MCMESS ADDRESS_MAPPING 0x386000 0x386000 0x2000 /end IF_DATA /end MEMORY_SEGMENT
 /begin MEMORY_SEGMENT ExtRam388000 "" VARIABLES RAM EXTERN 0x388000 0x200 -1 -1 -1 -1 -1 /begin IF_DATA ETK ADDRESS_MAPPING 0x388000 0x388000 0x200 /end IF_DATA /begin IF_DATA ASAP1B_MCMESS ADDRESS_MAPPING 0x388000 0x388000 0x200 /end IF_DATA /end MEMORY_SEGMENT
 SYSTEM_CONSTANT "ANZ_VARTAB" "16"
 SYSTEM_CONSTANT "ANZ_VARTABC" "16"
 SYSTEM_CONSTANT "CANDF_V321" "6"
 SYSTEM_CONSTANT "CANDF_V423" "18"
 SYSTEM_CONSTANT "CANDF_V424" "19"
 SYSTEM_CONSTANT "CANDF_V425" "20"
 SYSTEM_CONSTANT "CANDF_V435" "25"
 SYSTEM_CONSTANT "CANDF_V436" "26"
 SYSTEM_CONSTANT "CANDF_V456" "37"
 SYSTEM_CONSTANT "CANDF_V465" "38"
 SYSTEM_CONSTANT "CANDF_V466" "39"
 SYSTEM_CONSTANT "CANDF_V476" "44"
 SYSTEM_CONSTANT "CANDF_V477" "45"
 SYSTEM_CONSTANT "EPK_MAX_LEN" "80"
 SYSTEM_CONSTANT "ETK_PR_CHECK" "1"
 SYSTEM_CONSTANT "EXT_RAM_ENABLE" "1"
 SYSTEM_CONSTANT "SK_ME711" "1"
 SYSTEM_CONSTANT "SK_PEASIC" "1"
 SYSTEM_CONSTANT "SK_UMASIC" "1"
 SYSTEM_CONSTANT "SWOFFDL_REQUEST_MASK" "8191"
 SYSTEM_CONSTANT "SY_2HFM" "0"
 SYSTEM_CONSTANT "SY_2SG" "0"
 SYSTEM_CONSTANT "SY_2SGHST" "0"
 SYSTEM_CONSTANT "SY_2SLS" "0"
 SYSTEM_CONSTANT "SY_2TEV" "0"
 SYSTEM_CONSTANT "SY_AAU" "1"
 SYSTEM_CONSTANT "SY_AAV" "0"
 SYSTEM_CONSTANT "SY_ABGKL" "1"
 SYSTEM_CONSTANT "SY_ABGY" "0"
 SYSTEM_CONSTANT "SY_ABGYVBP" "0"
 SYSTEM_CONSTANT "SY_ABMZND" "0"
 SYSTEM_CONSTANT "SY_ACTRQCM" "0"
 SYSTEM_CONSTANT "SY_ADR" "0"
 SYSTEM_CONSTANT "SY_AEKPBI" "0"
 SYSTEM_CONSTANT "SY_AEKPBIV" "0"
 SYSTEM_CONSTANT "SY_AFR" "0"
 SYSTEM_CONSTANT "SY_AGR" "0"
 SYSTEM_CONSTANT "SY_AGRCLV" "0"
 SYSTEM_CONSTANT "SY_AGRGSTA" "0"
 SYSTEM_CONSTANT "SY_AGRKOMP" "0"
 SYSTEM_CONSTANT "SY_AGRVBP" "0"
 SYSTEM_CONSTANT "SY_AGR_DSS" "0"
 SYSTEM_CONSTANT "SY_AHRLSU" "0"
 SYSTEM_CONSTANT "SY_AIRBAG" "1"
 SYSTEM_CONSTANT "SY_ALLRAD" "0"
 SYSTEM_CONSTANT "SY_ALLRAD_NIVEAU" "0"
 SYSTEM_CONSTANT "SY_ANZLUE" "2"
 SYSTEM_CONSTANT "SY_ASAP" "130"
 SYSTEM_CONSTANT "SY_ASCCLFM" "0"
 SYSTEM_CONSTANT "SY_ASG" "0"
 SYSTEM_CONSTANT "SY_ASICRUN" "1"
 SYSTEM_CONSTANT "SY_ASICRUNTIME" "1"
 SYSTEM_CONSTANT "SY_ASM" "0"
 SYSTEM_CONSTANT "SY_ASR" "1"
 SYSTEM_CONSTANT "SY_ASTIKR" "0"
 SYSTEM_CONSTANT "SY_ASTIKR2" "0"
 SYSTEM_CONSTANT "SY_ASTNHK" "0"
 SYSTEM_CONSTANT "SY_ASTNHK2" "0"
 SYSTEM_CONSTANT "SY_ASTNTL" "0"
 SYSTEM_CONSTANT "SY_ASTNTL2" "0"
 SYSTEM_CONSTANT "SY_ASTNVK" "0"
 SYSTEM_CONSTANT "SY_ASTNVK2" "0"
 SYSTEM_CONSTANT "SY_ASTVHK" "0"
 SYSTEM_CONSTANT "SY_ASTVHK2" "0"
 SYSTEM_CONSTANT "SY_ASTVVK" "0"
 SYSTEM_CONSTANT "SY_ASTVVK2" "0"
 SYSTEM_CONSTANT "SY_ASV" "0"
 SYSTEM_CONSTANT "SY_ATLB" "0"
 SYSTEM_CONSTANT "SY_ATMLA" "0"
 SYSTEM_CONSTANT "SY_ATMST" "0"
 SYSTEM_CONSTANT "SY_ATMZA" "0"
 SYSTEM_CONSTANT "SY_ATR" "0"
 SYSTEM_CONSTANT "SY_AWUE" "0"
 SYSTEM_CONSTANT "SY_AZUESHF" "3"
 SYSTEM_CONSTANT "SY_B2B_KOS" "0"
 SYSTEM_CONSTANT "SY_B2B_PROKON" "0"
 SYSTEM_CONSTANT "SY_B2B_TKMWL" "0"
 SYSTEM_CONSTANT "SY_BATTSG" "0"
 SYSTEM_CONSTANT "SY_BBPHSYN" "1"
 SYSTEM_CONSTANT "SY_BDE" "0"
 SYSTEM_CONSTANT "SY_BELA" "1"
 SYSTEM_CONSTANT "SY_BGSRM" "0"
 SYSTEM_CONSTANT "SY_BGVMX" "1"
 SYSTEM_CONSTANT "SY_BGVZS" "0"
 SYSTEM_CONSTANT "SY_BH" "0"
 SYSTEM_CONSTANT "SY_BIRE" "0"
 SYSTEM_CONSTANT "SY_BKS" "0"
 SYSTEM_CONSTANT "SY_BKV" "0"
 SYSTEM_CONSTANT "SY_BKVP" "3"
 SYSTEM_CONSTANT "SY_BLOOP" "0"
 SYSTEM_CONSTANT "SY_BNWSX" "0"
 SYSTEM_CONSTANT "SY_BUKDIAG" "1"
 SYSTEM_CONSTANT "SY_C167CS" "1"
 SYSTEM_CONSTANT "SY_C167CS_IRAM" "2"
 SYSTEM_CONSTANT "SY_C167CS_XRAM" "2"
 SYSTEM_CONSTANT "SY_CAN" "3"
 SYSTEM_CONSTANT "SY_CANAC" "1"
 SYSTEM_CONSTANT "SY_CANACC" "0"
 SYSTEM_CONSTANT "SY_CANADR" "1"
 SYSTEM_CONSTANT "SY_CANAIR" "1"
 SYSTEM_CONSTANT "SY_CANALL" "0"
 SYSTEM_CONSTANT "SY_CANASY" "0"
 SYSTEM_CONSTANT "SY_CANBEM" "0"
 SYSTEM_CONSTANT "SY_CANBR2" "3"
 SYSTEM_CONSTANT "SY_CANBR3" "3"
 SYSTEM_CONSTANT "SY_CANBR5" "0"
 SYSTEM_CONSTANT "SY_CANBR8" "0"
 SYSTEM_CONSTANT "SY_CANBSG" "2"
 SYSTEM_CONSTANT "SY_CANCINS" "2"
 SYSTEM_CONSTANT "SY_CANCLA" "2"
 SYSTEM_CONSTANT "SY_CANDIA1" "0"
 SYSTEM_CONSTANT "SY_CANGAT" "1"
 SYSTEM_CONSTANT "SY_CANGE2" "1"
 SYSTEM_CONSTANT "SY_CANGE3" "0"
 SYSTEM_CONSTANT "SY_CANGE6" "0"
 SYSTEM_CONSTANT "SY_CANGRA" "5"
 SYSTEM_CONSTANT "SY_CANLHV" "39"
 SYSTEM_CONSTANT "SY_CANLWS" "2"
 SYSTEM_CONSTANT "SY_CANMUX_KC" "0"
 SYSTEM_CONSTANT "SY_CANMUX_KK" "0"
 SYSTEM_CONSTANT "SY_CANMUX_MM" "0"
 SYSTEM_CONSTANT "SY_CANNIV" "0"
 SYSTEM_CONSTANT "SY_CANNOHK" "0"
 SYSTEM_CONSTANT "SY_CANPB1" "0"
 SYSTEM_CONSTANT "SY_CANTOG" "2"
 SYSTEM_CONSTANT "SY_CANZAS" "2"
 SYSTEM_CONSTANT "SY_CAN_B" "1"
 SYSTEM_CONSTANT "SY_CAN_C" "1"
 SYSTEM_CONSTANT "SY_CAN_CONFIG" "28"
 SYSTEM_CONSTANT "SY_CDCSIZE" "4"
 SYSTEM_CONSTANT "SY_CDKSIZE" "4"
 SYSTEM_CONSTANT "SY_CDTSIZE" "1"
 SYSTEM_CONSTANT "SY_CFMST" "0"
 SYSTEM_CONSTANT "SY_CHKPROC" "71131"
 SYSTEM_CONSTANT "SY_CIDSIZE" "1"
 SYSTEM_CONSTANT "SY_CIFIF" "0"
 SYSTEM_CONSTANT "SY_CJ110" "0"
 SYSTEM_CONSTANT "SY_CJ120" "0"
 SYSTEM_CONSTANT "SY_CJ125" "2"
 SYSTEM_CONSTANT "SY_CJ830" "0"
 SYSTEM_CONSTANT "SY_CJ830RST" "0"
 SYSTEM_CONSTANT "SY_CKA" "0"
 SYSTEM_CONSTANT "SY_CKBI" "0"
 SYSTEM_CONSTANT "SY_CLASIZE" "1"
 SYSTEM_CONSTANT "SY_CNG" "0"
 SYSTEM_CONSTANT "SY_CONFSL" "1"
 SYSTEM_CONSTANT "SY_COPOTI" "0"
 SYSTEM_CONSTANT "SY_CRCTAB" "2"
 SYSTEM_CONSTANT "SY_CSBVAR" "0"
 SYSTEM_CONSTANT "SY_CVNSIZE" "1"
 SYSTEM_CONSTANT "SY_CVT" "1"
 SYSTEM_CONSTANT "SY_DAAV" "0"
 SYSTEM_CONSTANT "SY_DAGRFC" "4"
 SYSTEM_CONSTANT "SY_DCDACC" "2"
 SYSTEM_CONSTANT "SY_DCPV" "1"
 SYSTEM_CONSTANT "SY_DCSAVE" "0"
 SYSTEM_CONSTANT "SY_DCV" "0"
 SYSTEM_CONSTANT "SY_DDYLSU" "0"
 SYSTEM_CONSTANT "SY_DECOS" "0"
 SYSTEM_CONSTANT "SY_DEGFE" "2"
 SYSTEM_CONSTANT "SY_DELFCMS" "0"
 SYSTEM_CONSTANT "SY_DFLP" "0"
 SYSTEM_CONSTANT "SY_DFP16BT" "1"
 SYSTEM_CONSTANT "SY_DFPANZ" "193"
 SYSTEM_CONSTANT "SY_DFPMEEP" "0"
 SYSTEM_CONSTANT "SY_DFPMENV" "2"
 SYSTEM_CONSTANT "SY_DFPMFFR" "0"
 SYSTEM_CONSTANT "SY_DFPMTIM" "4"
 SYSTEM_CONSTANT "SY_DFPMVAR" "3"
 SYSTEM_CONSTANT "SY_DFPM_DATA_FAR" "1"
 SYSTEM_CONSTANT "SY_DFP_ANZ" "2"
 SYSTEM_CONSTANT "SY_DGANZ" "1"
 SYSTEM_CONSTANT "SY_DHELSU" "0"
 SYSTEM_CONSTANT "SY_DIADRL" "0"
 SYSTEM_CONSTANT "SY_DIBLKL" "0"
 SYSTEM_CONSTANT "SY_DIMONL" "0"
 SYSTEM_CONSTANT "SY_DIPRGL" "0"
 SYSTEM_CONSTANT "SY_DIPROC" "0"
 SYSTEM_CONSTANT "SY_DISFFDATA" "1"
 SYSTEM_CONSTANT "SY_DIVARL" "0"
 SYSTEM_CONSTANT "SY_DKAT" "1"
 SYSTEM_CONSTANT "SY_DKATEF" "0"
 SYSTEM_CONSTANT "SY_DKATLRS" "1"
 SYSTEM_CONSTANT "SY_DKATNO" "0"
 SYSTEM_CONSTANT "SY_DKATSP" "0"
 SYSTEM_CONSTANT "SY_DKATSPF" "0"
 SYSTEM_CONSTANT "SY_DKATTH" "0"
 SYSTEM_CONSTANT "SY_DKHZ" "0"
 SYSTEM_CONSTANT "SY_DKTSPFK" "0"
 SYSTEM_CONSTANT "SY_DKTSPHK" "0"
 SYSTEM_CONSTANT "SY_DKZEROP" "0"
 SYSTEM_CONSTANT "SY_DLCKD" "40"
 SYSTEM_CONSTANT "SY_DLCPEN" "40"
 SYSTEM_CONSTANT "SY_DLDP" "0"
 SYSTEM_CONSTANT "SY_DLS" "1"
 SYSTEM_CONSTANT "SY_DLSFHV" "0"
 SYSTEM_CONSTANT "SY_DLSFV" "0"
 SYSTEM_CONSTANT "SY_DLSHV" "1"
 SYSTEM_CONSTANT "SY_DLSU" "0"
 SYSTEM_CONSTANT "SY_DLSUV" "1"
 SYSTEM_CONSTANT "SY_DMDDVS" "0"
 SYSTEM_CONSTANT "SY_DMDVAR" "2"
 SYSTEM_CONSTANT "SY_DMDZAG" "1"
 SYSTEM_CONSTANT "SY_DMTL" "0"
 SYSTEM_CONSTANT "SY_DOPZW" "0"
 SYSTEM_CONSTANT "SY_DSGIDCK" "0"
 SYSTEM_CONSTANT "SY_DSKNO" "0"
 SYSTEM_CONSTANT "SY_DSKVND" "0"
 SYSTEM_CONSTANT "SY_DSL10MS" "0"
 SYSTEM_CONSTANT "SY_DSL2MS" "0"
 SYSTEM_CONSTANT "SY_DSM" "0"
 SYSTEM_CONSTANT "SY_DSS" "0"
 SYSTEM_CONSTANT "SY_DSU" "0"
 SYSTEM_CONSTANT "SY_DSVDK" "0"
 SYSTEM_CONSTANT "SY_DTANKL" "1"
 SYSTEM_CONSTANT "SY_DTES" "2"
 SYSTEM_CONSTANT "SY_DTHM" "0"
 SYSTEM_CONSTANT "SY_DUZND" "0"
 SYSTEM_CONSTANT "SY_DVEADA" "1"
 SYSTEM_CONSTANT "SY_DVEATT" "0"
 SYSTEM_CONSTANT "SY_DVEKOOR" "0"
 SYSTEM_CONSTANT "SY_EEPPK" "0"
 SYSTEM_CONSTANT "SY_EEPROM" "1"
 SYSTEM_CONSTANT "SY_EEPROM_ADDRESS_MODE" "1"
 SYSTEM_CONSTANT "SY_EEPROM_SIZE" "2048"
 SYSTEM_CONSTANT "SY_EE_FZINFO" "1"
 SYSTEM_CONSTANT "SY_EFL" "1"
 SYSTEM_CONSTANT "SY_EGAS" "1"
 SYSTEM_CONSTANT "SY_EGFE" "9"
 SYSTEM_CONSTANT "SY_EKPRMK" "1"
 SYSTEM_CONSTANT "SY_ELKUP" "0"
 SYSTEM_CONSTANT "SY_ENVBLOK" "2"
 SYSTEM_CONSTANT "SY_EOLT" "1"
 SYSTEM_CONSTANT "SY_ERCOS_TIMER_INPUT_SEL" "5"
 SYSTEM_CONSTANT "SY_ESNWS" "0"
 SYSTEM_CONSTANT "SY_ESTZ" "0"
 SYSTEM_CONSTANT "SY_ESUKNGN" "0"
 SYSTEM_CONSTANT "SY_ETKBYP" "0"
 SYSTEM_CONSTANT "SY_ETKMAXNUMEX" "1"
 SYSTEM_CONSTANT "SY_ETRART" "0"
 SYSTEM_CONSTANT "SY_EXHDEVE" "0"
 SYSTEM_CONSTANT "SY_FACLADP" "1"
 SYSTEM_CONSTANT "SY_FANT" "1"
 SYSTEM_CONSTANT "SY_FARRAM_EN" "1"
 SYSTEM_CONSTANT "SY_FAWSP" "0"
 SYSTEM_CONSTANT "SY_FCMDISP" "20"
 SYSTEM_CONSTANT "SY_FCMEELN" "5"
 SYSTEM_CONSTANT "SY_FCMIRD" "0"
 SYSTEM_CONSTANT "SY_FCMSIZE" "20"
 SYSTEM_CONSTANT "SY_FDTHM" "0"
 SYSTEM_CONSTANT "SY_FFCSIZE" "11"
 SYSTEM_CONSTANT "SY_FFESIZE" "0"
 SYSTEM_CONSTANT "SY_FFTSIZE" "2"
 SYSTEM_CONSTANT "SY_FFZ" "0"
 SYSTEM_CONSTANT "SY_FGRABZ" "0"
 SYSTEM_CONSTANT "SY_FGRAGWE" "0"
 SYSTEM_CONSTANT "SY_FGREWP" "0"
 SYSTEM_CONSTANT "SY_FGRPLUS" "0"
 SYSTEM_CONSTANT "SY_FKAT" "1"
 SYSTEM_CONSTANT "SY_FKAT2" "1"
 SYSTEM_CONSTANT "SY_FLASH_SIZE" "1024"
 SYSTEM_CONSTANT "SY_FLBOOT_V" "0"
 SYSTEM_CONSTANT "SY_FLUQ" "45"
 SYSTEM_CONSTANT "SY_FREQ_CPU" "40000"
 SYSTEM_CONSTANT "SY_FRROM_V" "1537"
 SYSTEM_CONSTANT "SY_FSGM" "0"
 SYSTEM_CONSTANT "SY_FTYOPT" "0"
 SYSTEM_CONSTANT "SY_FWFGR" "0"
 SYSTEM_CONSTANT "SY_GAP" "2"
 SYSTEM_CONSTANT "SY_GAS" "0"
 SYSTEM_CONSTANT "SY_GEFZFRM" "0"
 SYSTEM_CONSTANT "SY_GGGTS" "0"
 SYSTEM_CONSTANT "SY_GLST" "0"
 SYSTEM_CONSTANT "SY_GRDWOF" "0"
 SYSTEM_CONSTANT "SY_GRDWRT" "72"
 SYSTEM_CONSTANT "SY_GRUNDWERT" "72"
 SYSTEM_CONSTANT "SY_HBR" "0"
 SYSTEM_CONSTANT "SY_HDP" "0"
 SYSTEM_CONSTANT "SY_HFM" "1"
 SYSTEM_CONSTANT "SY_HFM2" "0"
 SYSTEM_CONSTANT "SY_HFMKOMP" "1"
 SYSTEM_CONSTANT "SY_HKAT" "1"
 SYSTEM_CONSTANT "SY_HKAT2" "1"
 SYSTEM_CONSTANT "SY_HKS" "0"
 SYSTEM_CONSTANT "SY_HLA" "0"
 SYSTEM_CONSTANT "SY_HLCCARB" "4"
 SYSTEM_CONSTANT "SY_HLSFFET" "0"
 SYSTEM_CONSTANT "SY_HLSHFET" "0"
 SYSTEM_CONSTANT "SY_HMM" "0"
 SYSTEM_CONSTANT "SY_HOMAGR" "0"
 SYSTEM_CONSTANT "SY_HSP" "0"
 SYSTEM_CONSTANT "SY_HWCONFIG_SLS" "0"
 SYSTEM_CONSTANT "SY_HWMSG" "0"
 SYSTEM_CONSTANT "SY_INGASOS" "8"
 SYSTEM_CONSTANT "SY_INHIBIT" "0"
 SYSTEM_CONSTANT "SY_INI_OBD" "1"
 SYSTEM_CONSTANT "SY_INJTIM_PRE" "128"
 SYSTEM_CONSTANT "SY_INTFLASH_SIZE" "768"
 SYSTEM_CONSTANT "SY_ISOPROT" "0"
 SYSTEM_CONSTANT "SY_ISOTP" "0"
 SYSTEM_CONSTANT "SY_IUMPR" "0"
 SYSTEM_CONSTANT "SY_IUMPREE" "0"
 SYSTEM_CONSTANT "SY_KHFMDY" "0"
 SYSTEM_CONSTANT "SY_KHSLS" "0"
 SYSTEM_CONSTANT "SY_KL50" "0"
 SYSTEM_CONSTANT "SY_KLDF" "1"
 SYSTEM_CONSTANT "SY_KMTR" "1"
 SYSTEM_CONSTANT "SY_KMTREG" "0"
 SYSTEM_CONSTANT "SY_KNWS" "1"
 SYSTEM_CONSTANT "SY_KOAC" "1"
 SYSTEM_CONSTANT "SY_KOBIDIR" "0"
 SYSTEM_CONSTANT "SY_KOEVAB" "1"
 SYSTEM_CONSTANT "SY_KONSERVIERUNG" "711039"
 SYSTEM_CONSTANT "SY_KOPWM" "2"
 SYSTEM_CONSTANT "SY_KORL" "0"
 SYSTEM_CONSTANT "SY_KORRZ" "1"
 SYSTEM_CONSTANT "SY_KRDY" "0"
 SYSTEM_CONSTANT "SY_KRMFTIM_PRE" "128"
 SYSTEM_CONSTANT "SY_KRNDY" "0"
 SYSTEM_CONSTANT "SY_KRSAINT" "0"
 SYSTEM_CONSTANT "SY_KR_EXT" "1"
 SYSTEM_CONSTANT "SY_KR_INT" "0"
 SYSTEM_CONSTANT "SY_KS1" "3"
 SYSTEM_CONSTANT "SY_KS2" "2"
 SYSTEM_CONSTANT "SY_KS3" "0"
 SYSTEM_CONSTANT "SY_KS4" "1"
 SYSTEM_CONSTANT "SY_KSZA" "4"
 SYSTEM_CONSTANT "SY_KUPFGR" "0"
 SYSTEM_CONSTANT "SY_KUPOT" "0"
 SYSTEM_CONSTANT "SY_KWP2000VAG" "1"
 SYSTEM_CONSTANT "SY_KWP71" "0"
 SYSTEM_CONSTANT "SY_LAMBTS" "1"
 SYSTEM_CONSTANT "SY_LBK" "0"
 SYSTEM_CONSTANT "SY_LBKGSTA" "0"
 SYSTEM_CONSTANT "SY_LECK" "0"
 SYSTEM_CONSTANT "SY_LENKH" "1"
 SYSTEM_CONSTANT "SY_LENKHILFE_PORT" "0"
 SYSTEM_CONSTANT "SY_LFS" "3"
 SYSTEM_CONSTANT "SY_LLR" "0"
 SYSTEM_CONSTANT "SY_LOWRA" "0"
 SYSTEM_CONSTANT "SY_LR2PAR" "1"
 SYSTEM_CONSTANT "SY_LRFKEF" "0"
 SYSTEM_CONSTANT "SY_LRFKEFC" "0"
 SYSTEM_CONSTANT "SY_LRFKEFM" "0"
 SYSTEM_CONSTANT "SY_LRHCAS" "0"
 SYSTEM_CONSTANT "SY_LRSEZ" "0"
 SYSTEM_CONSTANT "SY_LS" "0"
 SYSTEM_CONSTANT "SY_LSAGETR" "0"
 SYSTEM_CONSTANT "SY_LSFHV" "0"
 SYSTEM_CONSTANT "SY_LSFNHK" "1"
 SYSTEM_CONSTANT "SY_LSFNHK2" "1"
 SYSTEM_CONSTANT "SY_LSFNVK" "0"
 SYSTEM_CONSTANT "SY_LSFNVK2" "0"
 SYSTEM_CONSTANT "SY_LSFV" "0"
 SYSTEM_CONSTANT "SY_LSFVVK" "0"
 SYSTEM_CONSTANT "SY_LSFVVK2" "0"
 SYSTEM_CONSTANT "SY_LSHV" "1"
 SYSTEM_CONSTANT "SY_LSUGR" "1"
 SYSTEM_CONSTANT "SY_LSUIKR" "0"
 SYSTEM_CONSTANT "SY_LSUIKR2" "0"
 SYSTEM_CONSTANT "SY_LSUMRS" "0"
 SYSTEM_CONSTANT "SY_LSUSTA" "0"
 SYSTEM_CONSTANT "SY_LSVL" "0"
 SYSTEM_CONSTANT "SY_LSVV" "0"
 SYSTEM_CONSTANT "SY_LUART" "0"
 SYSTEM_CONSTANT "SY_LUEFTKONF" "33"
 SYSTEM_CONSTANT "SY_LUEKONF" "9249"
 SYSTEM_CONSTANT "SY_LUFAK" "202.661983231672"
 SYSTEM_CONSTANT "SY_LUFIKL" "0"
 SYSTEM_CONSTANT "SY_LUR" "0"
 SYSTEM_CONSTANT "SY_LUV" "0"
 SYSTEM_CONSTANT "SY_LUVE" "0"
 SYSTEM_CONSTANT "SY_LWS" "1"
 SYSTEM_CONSTANT "SY_LZ_BOOT" "0"
 SYSTEM_CONSTANT "SY_M1I00A" "191"
 SYSTEM_CONSTANT "SY_M1I00B" "159"
 SYSTEM_CONSTANT "SY_M1I00C" "232"
 SYSTEM_CONSTANT "SY_M1I00D" "145"
 SYSTEM_CONSTANT "SY_M1I20A" "128"
 SYSTEM_CONSTANT "SY_M1I20B" "0"
 SYSTEM_CONSTANT "SY_M1I20C" "17"
 SYSTEM_CONSTANT "SY_M1I20D" "0"
 SYSTEM_CONSTANT "SY_M2I00A" "127"
 SYSTEM_CONSTANT "SY_M2I00B" "152"
 SYSTEM_CONSTANT "SY_M2I00C" "0"
 SYSTEM_CONSTANT "SY_M2I00D" "0"
 SYSTEM_CONSTANT "SY_M5IH00A" "195"
 SYSTEM_CONSTANT "SY_M5IH00B" "0"
 SYSTEM_CONSTANT "SY_M5IH00C" "0"
 SYSTEM_CONSTANT "SY_M5IH00D" "0"
 SYSTEM_CONSTANT "SY_M5IH20A" "0"
 SYSTEM_CONSTANT "SY_M5IH20B" "0"
 SYSTEM_CONSTANT "SY_M5IH20C" "0"
 SYSTEM_CONSTANT "SY_M5IH20D" "0"
 SYSTEM_CONSTANT "SY_M5IH40A" "0"
 SYSTEM_CONSTANT "SY_M5IH40B" "0"
 SYSTEM_CONSTANT "SY_M5IH40C" "0"
 SYSTEM_CONSTANT "SY_M5IH40D" "0"
 SYSTEM_CONSTANT "SY_M5IH60A" "0"
 SYSTEM_CONSTANT "SY_M5IH60B" "0"
 SYSTEM_CONSTANT "SY_M5IH60C" "0"
 SYSTEM_CONSTANT "SY_M5IH60D" "0"
 SYSTEM_CONSTANT "SY_M5IH80A" "0"
 SYSTEM_CONSTANT "SY_M5IH80B" "0"
 SYSTEM_CONSTANT "SY_M5IH80C" "0"
 SYSTEM_CONSTANT "SY_M5IH80D" "0"
 SYSTEM_CONSTANT "SY_M5IV00A" "0"
 SYSTEM_CONSTANT "SY_M5IV00B" "0"
 SYSTEM_CONSTANT "SY_M5IV00C" "0"
 SYSTEM_CONSTANT "SY_M5IV00D" "1"
 SYSTEM_CONSTANT "SY_M5IV20A" "0"
 SYSTEM_CONSTANT "SY_M5IV20B" "0"
 SYSTEM_CONSTANT "SY_M5IV20C" "0"
 SYSTEM_CONSTANT "SY_M5IV20D" "1"
 SYSTEM_CONSTANT "SY_M5IV40A" "0"
 SYSTEM_CONSTANT "SY_M5IV40B" "0"
 SYSTEM_CONSTANT "SY_M5IV40C" "0"
 SYSTEM_CONSTANT "SY_M5IV40D" "1"
 SYSTEM_CONSTANT "SY_M5IV60A" "0"
 SYSTEM_CONSTANT "SY_M5IV60B" "0"
 SYSTEM_CONSTANT "SY_M5IV60C" "0"
 SYSTEM_CONSTANT "SY_M5IV60D" "1"
 SYSTEM_CONSTANT "SY_M5IV80A" "240"
 SYSTEM_CONSTANT "SY_M5IV80B" "0"
 SYSTEM_CONSTANT "SY_M5IV80C" "0"
 SYSTEM_CONSTANT "SY_M5IV80D" "0"
 SYSTEM_CONSTANT "SY_M6I00A" "168"
 SYSTEM_CONSTANT "SY_M6I00B" "0"
 SYSTEM_CONSTANT "SY_M6I00C" "0"
 SYSTEM_CONSTANT "SY_M6I00D" "0"
 SYSTEM_CONSTANT "SY_M7VAR" "0"
 SYSTEM_CONSTANT "SY_M8I00B" "0"
 SYSTEM_CONSTANT "SY_M8I00C" "0"
 SYSTEM_CONSTANT "SY_M8I00D" "0"
 SYSTEM_CONSTANT "SY_M8I00E" "0"
 SYSTEM_CONSTANT "SY_M9CALID" "0"
 SYSTEM_CONSTANT "SY_M9CVN" "0"
 SYSTEM_CONSTANT "SY_M9I00A" "60"
 SYSTEM_CONSTANT "SY_M9I00B" "0"
 SYSTEM_CONSTANT "SY_M9I00C" "0"
 SYSTEM_CONSTANT "SY_M9I00D" "0"
 SYSTEM_CONSTANT "SY_MAGER" "0"
 SYSTEM_CONSTANT "SY_MAX_EV" "8"
 SYSTEM_CONSTANT "SY_MDASG" "1"
 SYSTEM_CONSTANT "SY_MDGSL" "0"
 SYSTEM_CONSTANT "SY_MDZUL" "6"
 SYSTEM_CONSTANT "SY_ME711_ESK" "16"
 SYSTEM_CONSTANT "SY_MFCCMODE1" "1"
 SYSTEM_CONSTANT "SY_MNA" "0"
 SYSTEM_CONSTANT "SY_MOST" "0"
 SYSTEM_CONSTANT "SY_MOXKFP" "0"
 SYSTEM_CONSTANT "SY_MSGRED" "0"
 SYSTEM_CONSTANT "SY_MWB19" "0"
 SYSTEM_CONSTANT "SY_MWBCAN" "0"
 SYSTEM_CONSTANT "SY_MWBKR" "0"
 SYSTEM_CONSTANT "SY_NCVNMX" "65535"
 SYSTEM_CONSTANT "SY_NLDG" "1"
 SYSTEM_CONSTANT "SY_NOHK" "0"
 SYSTEM_CONSTANT "SY_NOHK2" "0"
 SYSTEM_CONSTANT "SY_NOKT" "1"
 SYSTEM_CONSTANT "SY_NOXKAT" "0"
 SYSTEM_CONSTANT "SY_NOXKAT2" "0"
 SYSTEM_CONSTANT "SY_NO_ROMCODE_IN_FLASH" "1"
 SYSTEM_CONSTANT "SY_NSAD" "0"
 SYSTEM_CONSTANT "SY_NUMGAP" "1"
 SYSTEM_CONSTANT "SY_NWGA" "2"
 SYSTEM_CONSTANT "SY_NWGA2" "0"
 SYSTEM_CONSTANT "SY_NWGE" "1"
 SYSTEM_CONSTANT "SY_NWGE2" "0"
 SYSTEM_CONSTANT "SY_NWRA" "0"
 SYSTEM_CONSTANT "SY_NWRE" "1"
 SYSTEM_CONSTANT "SY_NWROI" "1"
 SYSTEM_CONSTANT "SY_NWS" "2"
 SYSTEM_CONSTANT "SY_NWSA" "2"
 SYSTEM_CONSTANT "SY_NWSTIM_PRE" "32"
 SYSTEM_CONSTANT "SY_NWVAR" "3"
 SYSTEM_CONSTANT "SY_NZUEB" "80"
 SYSTEM_CONSTANT "SY_OBDCERT" "2"
 SYSTEM_CONSTANT "SY_OBP" "0"
 SYSTEM_CONSTANT "SY_ONCHIP_ROMFLASH" "2"
 SYSTEM_CONSTANT "SY_OVERSIZE" "2"
 SYSTEM_CONSTANT "SY_OVLLIM" "3"
 SYSTEM_CONSTANT "SY_PBRPW" "1"
 SYSTEM_CONSTANT "SY_PEDABS" "0"
 SYSTEM_CONSTANT "SY_PGRAD" "4"
 SYSTEM_CONSTANT "SY_PGRAD2" "4"
 SYSTEM_CONSTANT "SY_PGRAD3" "0"
 SYSTEM_CONSTANT "SY_PGRAD4" "0"
 SYSTEM_CONSTANT "SY_PGTPO" "0"
 SYSTEM_CONSTANT "SY_PH2OFST" "0"
 SYSTEM_CONSTANT "SY_PHASEP" "0"
 SYSTEM_CONSTANT "SY_PHTWIN" "1"
 SYSTEM_CONSTANT "SY_PID41" "0"
 SYSTEM_CONSTANT "SY_PID41A" "0"
 SYSTEM_CONSTANT "SY_PROGCAN" "1"
 SYSTEM_CONSTANT "SY_PROZESSLAUFZEIT" "1"
 SYSTEM_CONSTANT "SY_PWFDEEP" "0"
 SYSTEM_CONSTANT "SY_RDE" "1"
 SYSTEM_CONSTANT "SY_REDMX" "6"
 SYSTEM_CONSTANT "SY_REVTIM_PRE" "32"
 SYSTEM_CONSTANT "SY_RLAPP" "1"
 SYSTEM_CONSTANT "SY_SAACC" "1"
 SYSTEM_CONSTANT "SY_SALSU" "0"
 SYSTEM_CONSTANT "SY_SCHICHT" "0"
 SYSTEM_CONSTANT "SY_SDFP" "0"
 SYSTEM_CONSTANT "SY_SGANZ" "1"
 SYSTEM_CONSTANT "SY_SGHWIDX" "1"
 SYSTEM_CONSTANT "SY_SGIDEXT" "1"
 SYSTEM_CONSTANT "SY_SHK_OT" "1"
 SYSTEM_CONSTANT "SY_SLPANST" "0"
 SYSTEM_CONSTANT "SY_SLPANZ" "1"
 SYSTEM_CONSTANT "SY_SLS" "88"
 SYSTEM_CONSTANT "SY_SLSHK" "0"
 SYSTEM_CONSTANT "SY_SLVANST" "0"
 SYSTEM_CONSTANT "SY_SLVANZ" "1"
 SYSTEM_CONSTANT "SY_SLWG" "0"
 SYSTEM_CONSTANT "SY_SPRSTRT" "0"
 SYSTEM_CONSTANT "SY_SSC" "1"
 SYSTEM_CONSTANT "SY_SSPB" "0"
 SYSTEM_CONSTANT "SY_ST10" "5"
 SYSTEM_CONSTANT "SY_ST10STEP" "31"
 SYSTEM_CONSTANT "SY_STA" "0"
 SYSTEM_CONSTANT "SY_STADAP" "1"
 SYSTEM_CONSTANT "SY_STARTPAKET" "1"
 SYSTEM_CONSTANT "SY_STASTO" "0"
 SYSTEM_CONSTANT "SY_STERBTS" "1"
 SYSTEM_CONSTANT "SY_STEREO" "1"
 SYSTEM_CONSTANT "SY_STERFK" "0"
 SYSTEM_CONSTANT "SY_STERHK" "1"
 SYSTEM_CONSTANT "SY_STERSY" "0"
 SYSTEM_CONSTANT "SY_STERVK" "1"
 SYSTEM_CONSTANT "SY_STETLR" "1"
 SYSTEM_CONSTANT "SY_STIL" "1"
 SYSTEM_CONSTANT "SY_STVR" "0"
 SYSTEM_CONSTANT "SY_SU" "1"
 SYSTEM_CONSTANT "SY_SUP" "1"
 SYSTEM_CONSTANT "SY_SWEISR" "0"
 SYSTEM_CONSTANT "SY_SWE_B" "0"
 SYSTEM_CONSTANT "SY_SWE_C" "1"
 SYSTEM_CONSTANT "SY_SWE_K" "0"
 SYSTEM_CONSTANT "SY_SWE_S" "0"
 SYSTEM_CONSTANT "SY_T2DCHEX" "1"
 SYSTEM_CONSTANT "SY_T6MDTHM" "0"
 SYSTEM_CONSTANT "SY_TABST" "1"
 SYSTEM_CONSTANT "SY_TAGR" "0"
 SYSTEM_CONSTANT "SY_TCNS" "1"
 SYSTEM_CONSTANT "SY_TCOMIF" "0"
 SYSTEM_CONSTANT "SY_TDZW" "1"
 SYSTEM_CONSTANT "SY_TEBF" "1"
 SYSTEM_CONSTANT "SY_TEETH" "60"
 SYSTEM_CONSTANT "SY_TEVE2" "0"
 SYSTEM_CONSTANT "SY_TFA" "1"
 SYSTEM_CONSTANT "SY_TFAOPL" "1"
 SYSTEM_CONSTANT "SY_TFBA" "1"
 SYSTEM_CONSTANT "SY_TFMA" "1"
 SYSTEM_CONSTANT "SY_TFMAP" "1"
 SYSTEM_CONSTANT "SY_TFMHST" "0"
 SYSTEM_CONSTANT "SY_TFMO" "0"
 SYSTEM_CONSTANT "SY_TFNS" "1"
 SYSTEM_CONSTANT "SY_TFOL" "0"
 SYSTEM_CONSTANT "SY_TFRK" "1"
 SYSTEM_CONSTANT "SY_TFST" "1"
 SYSTEM_CONSTANT "SY_TFUMG" "2"
 SYSTEM_CONSTANT "SY_TFVA" "1"
 SYSTEM_CONSTANT "SY_TFWL" "1"
 SYSTEM_CONSTANT "SY_THYDRO" "0"
 SYSTEM_CONSTANT "SY_TIMER1_PRESCALER" "32"
 SYSTEM_CONSTANT "SY_TIMER2_PRESCALER" "16"
 SYSTEM_CONSTANT "SY_TIMER3_PRESCALER" "64"
 SYSTEM_CONSTANT "SY_TIMER8_PRESCALER" "128"
 SYSTEM_CONSTANT "SY_TKA" "1"
 SYSTEM_CONSTANT "SY_TKAA" "1"
 SYSTEM_CONSTANT "SY_TKAT" "0"
 SYSTEM_CONSTANT "SY_TKSBT" "0"
 SYSTEM_CONSTANT "SY_TLDR" "0"
 SYSTEM_CONSTANT "SY_TLR" "1"
 SYSTEM_CONSTANT "SY_TLRARES" "0"
 SYSTEM_CONSTANT "SY_TLRASP" "0"
 SYSTEM_CONSTANT "SY_TN" "0"
 SYSTEM_CONSTANT "SY_TP20" "1"
 SYSTEM_CONSTANT "SY_TRLX" "1"
 SYSTEM_CONSTANT "SY_TSFSIZE" "1"
 SYSTEM_CONSTANT "SY_TUM" "1"
 SYSTEM_CONSTANT "SY_TUMG" "0"
 SYSTEM_CONSTANT "SY_TUN" "2"
 SYSTEM_CONSTANT "SY_TUNKEY" "1"
 SYSTEM_CONSTANT "SY_TUNKEY1" "1"
 SYSTEM_CONSTANT "SY_TURBO" "0"
 SYSTEM_CONSTANT "SY_TVVR" "1"
 SYSTEM_CONSTANT "SY_TWAN" "0"
 SYSTEM_CONSTANT "SY_TWDKS" "0"
 SYSTEM_CONSTANT "SY_TWSLP" "0"
 SYSTEM_CONSTANT "SY_UB13V" "185"
 SYSTEM_CONSTANT "SY_UB1ADC" "0"
 SYSTEM_CONSTANT "SY_UBDEDIS" "92"
 SYSTEM_CONSTANT "SY_UBDEEN" "106"
 SYSTEM_CONSTANT "SY_UBKL15" "0"
 SYSTEM_CONSTANT "SY_UBOKDIS" "87"
 SYSTEM_CONSTANT "SY_UBOKEN" "102"
 SYSTEM_CONSTANT "SY_UBR" "1"
 SYSTEM_CONSTANT "SY_UBRSQ_W" "1128"
 SYSTEM_CONSTANT "SY_UBSQ_W" "720"
 SYSTEM_CONSTANT "SY_UHR" "4"
 SYSTEM_CONSTANT "SY_UMALS" "0"
 SYSTEM_CONSTANT "SY_USOFF" "205"
 SYSTEM_CONSTANT "SY_VAR" "445"
 SYSTEM_CONSTANT "SY_VARCODE" "0"
 SYSTEM_CONSTANT "SY_VS" "0"
 SYSTEM_CONSTANT "SY_VVT" "0"
 SYSTEM_CONSTANT "SY_WDTINPUT_SEL" "1"
 SYSTEM_CONSTANT "SY_WFS" "4"
 SYSTEM_CONSTANT "SY_WMAX" "78"
 SYSTEM_CONSTANT "SY_WMIN" "-32"
 SYSTEM_CONSTANT "SY_WNBM" "6"
 SYSTEM_CONSTANT "SY_WPHN" "1"
 SYSTEM_CONSTANT "SY_WSM" "0"
 SYSTEM_CONSTANT "SY_WUBISO" "0"
 SYSTEM_CONSTANT "SY_ZAS" "0"
 SYSTEM_CONSTANT "SY_ZIZWV" "1"
 SYSTEM_CONSTANT "SY_ZMS" "0"
 SYSTEM_CONSTANT "SY_ZNDAUS" "1"
 SYSTEM_CONSTANT "SY_ZP_LAMREG_EUII" "0"
 SYSTEM_CONSTANT "SY_ZWCALC" "1"
 SYSTEM_CONSTANT "SY_ZWP2" "0"
 SYSTEM_CONSTANT "SY_ZYLZA" "6"
 SYSTEM_CONSTANT "SY_ZYLZG" "6"
 SYSTEM_CONSTANT "SY_ZZBANK" "42"
 SYSTEM_CONSTANT "SY_ZZLAM" "0"
 SYSTEM_CONSTANT "SY_ZZRL" "56"
 SYSTEM_CONSTANT "TSROHRES" "1000"
 SYSTEM_CONSTANT "VARKOD" "1" /end MOD_PAR
/begin MOD_COMMON "" BYTE_ORDER MSB_LAST ALIGNMENT_BYTE 1 ALIGNMENT_WORD 2 ALIGNMENT_LONG 2 /end MOD_COMMON
/* --- AgI-Objekt für ETK (ASAP V1.3B0), Stand 1.0 16.7.98 --- */
/begin IF_DATA ETK
 /begin TP_BLOB /*version:*/ 0x1000002 /*pba:*/ 0x0 /*reset_cfg:*/ 0xFFFFFF07
  /begin DISTAB_CFG /*dsptab:*/ 0xC /*dat_mod:*/ 0x2 /*rfg:*/ 0x2 /*trgsegad:*/ 0x388000 /*trg_cfg:*/ 0x1020100 TRG_MOD /*Id:*/ 0x0 /*trg_mod:*/ 0x27 0x0 0x0 0x0 /end DISTAB_CFG
  /begin ETK_PRESENCE_CHECK 0x8FBFF8 ETK_PATTERN 0x45 0x54 0x4B 0x37 0x31 /end ETK_PRESENCE_CHECK
  CODE_CHK /*prg_data:*/ 0x8F0000 /*prg_length:*/ 0x4 /*prg_eram:*/ 0x3881FC /*prg_length:*/ 0x4 ETK_CFG 0xf 0xf0 0xff 0x3 0xff 0xee 0xff 0x1 /* EMU_RAM start_addr length CS offset >>>>> (multiple) */ /* EMU_DATA start_addr length CS offset >>>>> (multiple) */ /* EMU_CODE start_addr length CS offset >>>>> (multiple) */ /* RESERVED start_addr length CS offset >>>>> (multiple) */ RESERVED_DISTAB_MEMORY /*start_addr:*/ 0x8FBD0A 0x2F8 EXTERN -1 -1 -1 -1 -1 /end TP_BLOB
 /begin SOURCE "Synchro" 103 1 QP_BLOB 1 0x3B 0x8FBD0A 0x388040 0x388036 0 0 0 /end SOURCE
 /begin SOURCE "10ms" 4 1 QP_BLOB 2 0x4B 0x8FBD82 0x3880B6 0x388038 10 0 0 /end SOURCE
 /begin SOURCE "100ms" 5 1 QP_BLOB 3 0x4B 0x8FBE1A 0x38814C 0x38803A 100 0 0 /end SOURCE
/end IF_DATA
/* --- AgI-Objekt für McMess/VS2x (ASAP V1.3), Stand 2.1 11.10.99; AML: ETAS-Og/Vector-Schnorr, 23.9.99 --Be-- */
/begin IF_DATA ASAP1B_MCMESS
 /begin SOURCE "Handshake" 103 1 QP_BLOB HANDSHAKE 20 /end SOURCE
 /begin SOURCE "Block Zuendsynchr" 103 1 QP_BLOB ANGLE 6 /end SOURCE
 /begin TP_BLOB /* Version des TP_BLOB:*/ 0x102 KOMKEN 13 /* Kommunikationskennung 1..255 */ MCTGT 0x1 /* Targetadresse im Steuergerät mit Massetastung */ MCINI MASSE /* Reizungstyp */ WFSIDLE0 12 /* Wartezeit bevor Tester mit Reizung/Vorspann beginnt (quant. 10ms) */ WFSIDLE1 8 /* Retriggerzeit von WFSIDLE0 (10ms-Quantisierung) */ WFS5B 10 /* Wartezeit nach 5-Baud-Vorspann, bevor Tester mit der Protokoll-Einleitung beginnt (quant. 100ms) */
  /begin VS_DEF /* Verstellparameterzuordnung */ "VSW:vszw" "VSFG:vsfrk" "VSWV:vsvw" "VSNS:vsns" "VSWZ1:vszwkr_0_A" "VSWZ2:vszwkr_1_A" "VSWZ3:vszwkr_2_A" "VSWZ4:vszwkr_3_A" "VSWZ5:vszwkr_4_A" "VSWZ6:vszwkr_5_A" "VSWZ7:vszwkr_6_A" "VSWZ8:vszwkr_7_A" "VSKF:vske" "VSMFA:vsdmr" "VSMFL:vsfpses" "VSLDS:vsrlmx" "VSLUC:vsldtv" /end VS_DEF
  /begin PSEUDO_ADR /* Pseudoadressen */ /end PSEUDO_ADR
  BYTE_ORDER MSB_LAST /end TP_BLOB
/end IF_DATA
/begin CHARACTERISTIC ABKKATTAB "" CURVE 0x8EAFA8 KlAUbSstUwWUb 0.9961 fak_ub_b1 0.00 0.9961
 /begin AXIS_DESCR STD_AXIS tabst_w t1sxs_uw_q1 6 0.00 65535.00 FORMAT "%8.2" DEPOSIT ABSOLUTE /end AXIS_DESCR
/end CHARACTERISTIC
/begin CHARACTERISTIC ABOINI "" VALUE 0x8E2339 KwUb 255.0 dez 0.00 255.0 FORMAT "%5.1" /end CHARACTERISTIC
/begin CHARACTERISTIC ABOLRAR "" VALUE 0x8E233A KwUb 255.0 dez 0.00 255.0 FORMAT "%5.1" /end CHARACTERISTIC
/begin CHARACTERISTIC ABOMX "" VALUE 0x8E233B KwUb 255.0 dez 0.00 255.0 FORMAT "%5.1" /end CHARACTERISTIC
/begin CHARACTERISTIC ANZEKPVLMX "" VALUE 0x8E3FD8 KwUb 255.0 dez 0.00 255.0 FORMAT "%5.1" /end CHARACTERISTIC
/begin CHARACTERISTIC ANZSYNAB "" VALUE 0x8FD2AF KwUb 255.0 dez 0.00 255.0 FORMAT "%5.1" /end CHARACTERISTIC
/begin CHARACTERISTIC ATMTAKR "" CURVE 0x8E7E1A KlAUbSstUbWSb 1275. temp_q5 -640.0 635.0 FORMAT "%5.1"
 /begin AXIS_DESCR STD_AXIS tans temp_ub_q0p75_o48 5 -48.00 143.3 FORMAT "%5.1" DEPOSIT ABSOLUTE /end AXIS_DESCR
/end CHARACTERISTIC
/begin CHARACTERISTIC ATMTANS "" CURVE 0x8E7E26 KlAUbSstUbWSb 1275. temp_q5 -640.0 635.0 FORMAT "%5.1"
 /begin AXIS_DESCR STD_AXIS tatu temp_ub_q0p75_o48 3 -48.00 143.3 FORMAT "%5.1" DEPOSIT ABSOLUTE /end AXIS_DESCR
/end CHARACTERISTIC
/begin CHARACTERISTIC BTRKHTMS "" CURVE 0x8E243A KlAUbSstUbWUb 0.9961 fak_ub_b1 0.00 0.9961
 /begin AXIS_DESCR STD_AXIS tmst temp_ub_q0p75_o48 8 -48.00 143.3 FORMAT "%5.1" DEPOSIT ABSOLUTE /end AXIS_DESCR
/end CHARACTERISTIC
/begin CHARACTERISTIC CDPCV "" VALUE 0x8E233C KwUb 255.0 dez 0.00 255.0 FORMAT "%5.1" /end CHARACTERISTIC
/begin CHARACTERISTIC CLSDKH "" VALUE 0x8FD2AC KwUb 255.0 dez 0.00 255.0 FORMAT "%5.1" /end CHARACTERISTIC
/begin CHARACTERISTIC CMVKAT "" VALUE 0x8E244B KwUb 2720. qptemp_q10p667 0.00 2720. FORMAT "%5.0" /end CHARACTERISTIC
/begin CHARACTERISTIC CWALE "" VALUE 0x8FCE0C KwUb 255.0 dez 0.00 255.0 FORMAT "%5.1" /end CHARACTERISTIC
/begin CHARACTERISTIC CWARMD "" VALUE 0x8FEB4E KwUw 65535.00 dez 0.00 65535.00 FORMAT "%8.2" /end CHARACTERISTIC
/begin CHARACTERISTIC CWBBGANG "" VALUE 0x8E0D8C KwUb 255.0 dez 0.00 255.0 FORMAT "%5.1" /end CHARACTERISTIC
/begin CHARACTERISTIC CWBBKD "" VALUE 0x8FCE95 KwUb 255.0 dez 0.00 255.0 FORMAT "%5.1" /end CHARACTERISTIC
/begin CHARACTERISTIC CWDKNOLU "" VALUE 0x8E0E95 KwUb 255.0 dez 0.00 255.0 FORMAT "%5.1" /end CHARACTERISTIC
/begin CHARACTERISTIC CWDLRIKL "" VALUE 0x8FCEC2 KwUb 255.0 dez 0.00 255.0 FORMAT "%5.1" /end CHARACTERISTIC
/begin CHARACTERISTIC CWESWEZ "" VALUE 0x8E0EA0 KwUb 255.0 dez 0.00 255.0 FORMAT "%5.1" /end CHARACTERISTIC
/begin CHARACTERISTIC CWEVAB "" VALUE 0x8E1A6A KwUb 255.0 dez 0.00 255.0 FORMAT "%5.1" /end CHARACTERISTIC
/begin CHARACTERISTIC CWGAGKG "" VALUE 0x8E4DA1 KwUb 255.0 dez 0.00 255.0 FORMAT "%5.1" /end CHARACTERISTIC
/begin CHARACTERISTIC CWKDASG "" VALUE 0x8FCE96 KwUb 255.0 dez 0.00 255.0 FORMAT "%5.1" /end CHARACTERISTIC
/begin CHARACTERISTIC CWKHZ "" VALUE 0x8E244C KwUb 255.0 dez 0.00 255.0 FORMAT "%5.1" /end CHARACTERISTIC
/begin CHARACTERISTIC CWKHZ2 "" VALUE 0x8E244D KwUb 255.0 dez 0.00 255.0 FORMAT "%5.1" /end CHARACTERISTIC
/begin CHARACTERISTIC CWNWEGTR "" VALUE 0x8FD178 KwUb 255.0 dez 0.00 255.0 FORMAT "%5.1" /end CHARACTERISTIC
/begin CHARACTERISTIC CWNWGE "" VALUE 0x8E3A06 KwUb 255.0 dez 0.00 255.0 FORMAT "%5.1" /end CHARACTERISTIC
/begin CHARACTERISTIC CWNWSA "" VALUE 0x8EED08 KwUw 65535.00 dez 0.00 65535.00 FORMAT "%8.2" /end CHARACTERISTIC
/begin CHARACTERISTIC CWNWSE "" VALUE 0x8EED0A KwUw 65535.00 dez 0.00 65535.00 FORMAT "%8.2" /end CHARACTERISTIC
/begin CHARACTERISTIC CWNWSG "" VALUE 0x8EED0C KwUw 65535.00 dez 0.00 65535.00 FORMAT "%8.2" /end CHARACTERISTIC
/begin CHARACTERISTIC CWSAWE "" VALUE 0x8FD179 KwUb 255.0 dez 0.00 255.0 FORMAT "%5.1" /end CHARACTERISTIC
/begin CHARACTERISTIC CW_AZUE "" VALUE 0x8FCD22 KwUb 255.0 DEZ 0.00 255.0 FORMAT "%5.1" /end CHARACTERISTIC
/begin CHARACTERISTIC DANTGESWNV "" VALUE 0x8FDCE8 KwSw 1599.976 relDK_q0p02441 -800.0000 799.9756 FORMAT "%8.4" /end CHARACTERISTIC
/begin CHARACTERISTIC DANTGESWV "" VALUE 0x8FDCEA KwSw 1599.976 relDK_q0p02441 -800.0000 799.9756 FORMAT "%8.4" /end CHARACTERISTIC
/begin CHARACTERISTIC DANTSCHWNV "" VALUE 0x8FDCEC KwSw 1599.976 relDK_q0p02441 -800.0000 799.9756 FORMAT "%8.4" /end CHARACTERISTIC
/begin CHARACTERISTIC DANTSCHWV "" VALUE 0x8FDCEE KwSw 1599.976 relDK_q0p02441 -800.0000 799.9756 FORMAT "%8.4" /end CHARACTERISTIC
/begin CHARACTERISTIC DKLAGERT "" VALUE 0x8FCEC3 KwUb 5.100 t20msxs_ub_b5p1 0.00 5.100 FORMAT "%5.3" /end CHARACTERISTIC
/begin CHARACTERISTIC DLRDWDKSS1 "" VALUE 0x8FDCF0 KwSw 99.99847 relDK_q0p00152 -50.00000 49.99847 FORMAT "%8.5" /end CHARACTERISTIC
/begin CHARACTERISTIC DLRDWDKSS2 "" VALUE 0x8FDCF2 KwSw 99.99847 relDK_q0p00152 -50.00000 49.99847 FORMAT "%8.5" /end CHARACTERISTIC
/begin CHARACTERISTIC DLRHAFTMN "" VALUE 0x8E82A8 KwSw 100.0000 rel_q0p1957 -100.0000 0.00 FORMAT "%8.4" /end CHARACTERISTIC
/begin CHARACTERISTIC DLRHAFTST "" VALUE 0x8E82AA KwSw 99.99847 relDK_q0p00152 -50.00000 49.99847 FORMAT "%8.5" /end CHARACTERISTIC
/begin CHARACTERISTIC DLRIAMAXA "" VALUE 0x8FDCF4 KwUw 100.0000 rel_q0p1957 0.00 100.0000 FORMAT "%8.4" /end CHARACTERISTIC
/begin CHARACTERISTIC DLRIKLPAR "" VALUE 0x8FCEC4 KwUb 15.94 relDK_q0p0625 0.00 15.94 FORMAT "%5.2" /end CHARACTERISTIC
/begin CHARACTERISTIC DLRININI "" VALUE 0x8FDCF6 KwUw 100.0000 rel_q0p1957 0.00 100.0000 FORMAT "%8.4" /end CHARACTERISTIC
/begin CHARACTERISTIC DLRKDONLP0 "" VALUE 0x8FCEC5 KwUb 1020. relDK_q4 0.00 1020. FORMAT "%5.0" /end CHARACTERISTIC
/begin CHARACTERISTIC DLRKDUNLP0 "" VALUE 0x8FCEC6 KwUb 1020. relDK_q4 0.00 1020. FORMAT "%5.0" /end CHARACTERISTIC
/begin CHARACTERISTIC DLRKDUNLP1 "" VALUE 0x8FCEC7 KwUb 1020. relDK_q4 0.00 1020. FORMAT "%5.0" /end CHARACTERISTIC
/begin CHARACTERISTIC DLRKDUNLP2 "" VALUE 0x8FCEC8 KwUb 1020. relDK_q4 0.00 1020. FORMAT "%5.0" /end CHARACTERISTIC
/begin CHARACTERISTIC DLRKDUNLP3 "" VALUE 0x8FCEC9 KwUb 1020. relDK_q4 0.00 1020. FORMAT "%5.0" /end CHARACTERISTIC
/begin CHARACTERISTIC DLRKIONLP0 "" VAL_BLK 0x8FCECA KwbUb 15.94 relDK_q0p0625 0.00 15.94 FORMAT "%5.2" NUMBER 32 /end CHARACTERISTIC
/begin CHARACTERISTIC DLRKIUNLP0 "" VAL_BLK 0x8FCEEA KwbUb 15.94 relDK_q0p0625 0.00 15.94 FORMAT "%5.2" NUMBER 32 /end CHARACTERISTIC
/begin CHARACTERISTIC DLRKIUNLP1 "" VAL_BLK 0x8FCF0A KwbUb 15.94 relDK_q0p0625 0.00 15.94 FORMAT "%5.2" NUMBER 32 /end CHARACTERISTIC
/begin CHARACTERISTIC DLRKIUNLP2 "" VAL_BLK 0x8FCF2A KwbUb 15.94 relDK_q0p0625 0.00 15.94 FORMAT "%5.2" NUMBER 32 /end CHARACTERISTIC
/begin CHARACTERISTIC DLRKIUNLP3 "" VAL_BLK 0x8FCF4A KwbUb 15.94 relDK_q0p0625 0.00 15.94 FORMAT "%5.2" NUMBER 32 /end CHARACTERISTIC
/begin CHARACTERISTIC DLRKPONLP0 "" VALUE 0x8FCF6A KwUb 255.0 relDK_q1 0.00 255.0 FORMAT "%5.1" /end CHARACTERISTIC
/begin CHARACTERISTIC DLRKPUNLP0 "" VALUE 0x8FCF6B KwUb 255.0 relDK_q1 0.00 255.0 FORMAT "%5.1" /end CHARACTERISTIC
/begin CHARACTERISTIC DLRKPUNLP1 "" VALUE 0x8FCF6C KwUb 255.0 relDK_q1 0.00 255.0 FORMAT "%5.1" /end CHARACTERISTIC
/begin CHARACTERISTIC DLRKPUNLP2 "" VALUE 0x8FCF6D KwUb 255.0 relDK_q1 0.00 255.0 FORMAT "%5.1" /end CHARACTERISTIC
/begin CHARACTERISTIC DLRKPUNLP3 "" VALUE 0x8FCF6E KwUb 255.0 relDK_q1 0.00 255.0 FORMAT "%5.1" /end CHARACTERISTIC
/begin CHARACTERISTIC DLRKREIS "" VALUE 0x8E0E96 KwUb 1.992 fak_ub_b2 0.00 1.992 FORMAT "%5.3" /end CHARACTERISTIC
/begin CHARACTERISTIC DLRKREISST "" VALUE 0x8E0E97 KwUb 1.992 fak_ub_b2 0.00 1.992 FORMAT "%5.3" /end CHARACTERISTIC
/begin CHARACTERISTIC DLRNLPD "" VALUE 0x8FDCF8 KwUw 100.0000 relDK_uw_b100 0.00 100.0000 FORMAT "%8.4" /end CHARACTERISTIC
/begin CHARACTERISTIC DLRPID0T "" VALUE 0x8FDCFA KwUw 655.3500 t10msxs_uw_b655p35 0.00 655.3500 FORMAT "%8.4" /end CHARACTERISTIC
/begin CHARACTERISTIC DLRPID1T "" VALUE 0x8FDCFC KwUw 655.3500 t10msxs_uw_b655p35 0.00 655.3500 FORMAT "%8.4" /end CHARACTERISTIC
/begin CHARACTERISTIC DLRPID2T "" VALUE 0x8FDCFE KwUw 655.3500 t10msxs_uw_b655p35 0.00 655.3500 FORMAT "%8.4" /end CHARACTERISTIC
/begin CHARACTERISTIC DLRPIDMAX "" VALUE 0x8FDD00 KwUw 99.99847 rel_uw_b100 0.00 99.99847 FORMAT "%8.5" /end CHARACTERISTIC
/begin CHARACTERISTIC DLRPIDMIN "" VALUE 0x8FDD02 KwUw 99.99847 rel_uw_b100 0.00 99.99847 FORMAT "%8.5" /end CHARACTERISTIC
/begin CHARACTERISTIC DLRUBSOLL "" VALUE 0x8E0E98 KwUb 17.95 spg_ubatt 0.00 17.95 FORMAT "%5.2" /end CHARACTERISTIC
/begin CHARACTERISTIC DLRUMABAND "" VALUE 0x8FDD04 KwUw 4.882813 relDK_q0p02441 0.00 4.882813 FORMAT "%8.6" /end CHARACTERISTIC
/begin CHARACTERISTIC DLRUMAIINI "" VALUE 0x8FDD06 KwSw 12824.85 rel_q0p1957 -6412.524 6412.329 FORMAT "%8.3" /end CHARACTERISTIC
/begin CHARACTERISTIC DMARMX "" CURVE 0x8ECA74 KlAUbSstUbWUw 99.99847 rel_uw_b100 0.00 99.99847 FORMAT "%8.5"
 /begin AXIS_DESCR STD_AXIS tmot temp_ub_q0p75_o48 6 -48.00 143.3 FORMAT "%5.1" DEPOSIT ABSOLUTE /end AXIS_DESCR
/end CHARACTERISTIC
/begin CHARACTERISTIC DNFILO "" VALUE 0x8FEB50 KwSw 8191.750 nmot_sw_q0p25 0.00 8191.750 FORMAT "%8.3" /end CHARACTERISTIC
/begin CHARACTERISTIC DNLLSNW "" VALUE 0x8E3A07 KwUb 2550. nmot_ub_q10 0.00 2550. FORMAT "%5.0" /end CHARACTERISTIC
/begin CHARACTERISTIC DNMAXH "" VALUE 0x8FE6BE KwUw 16383.75 nmot_uw_q0p25 0.00 16383.75 FORMAT "%8.2" /end CHARACTERISTIC
/begin CHARACTERISTIC DNSAH "" VALUE 0x8FD17A KwUb 5080. nmot_ub_q40 0.00 5080. FORMAT "%5.0" /end CHARACTERISTIC
/begin CHARACTERISTIC DNSAL "" VALUE 0x8FD17B KwUb 5080. nmot_ub_q40 0.00 5080. FORMAT "%5.0" /end CHARACTERISTIC
/begin CHARACTERISTIC DNSALH "" VALUE 0x8FD17C KwUb 5080. nmot_ub_q40 0.00 5080. FORMAT "%5.0" /end CHARACTERISTIC
/begin CHARACTERISTIC DNSATIP "" VALUE 0x8FD17D KwUb 10200. nmot_ub_q40 0.00 10200. FORMAT "%5.0" /end CHARACTERISTIC
/begin CHARACTERISTIC DNSKAZ "" VALUE 0x8FE6C0 KwUw 16383.75 nmot_uw_q0p25 0.00 16383.75 FORMAT "%8.2" /end CHARACTERISTIC
/begin CHARACTERISTIC DNSLL "" VALUE 0x8FD17E KwUb 10200. nmot_ub_q40 0.00 10200. FORMAT "%5.0" /end CHARACTERISTIC
/begin CHARACTERISTIC DNSLLK "" VALUE 0x8FD17F KwUb 10200. nmot_ub_q40 0.00 10200. FORMAT "%5.0" /end CHARACTERISTIC
/begin CHARACTERISTIC DNVSA "" VALUE 0x8FD180 KwUb 10200. nmot_ub_q40 0.00 10200. FORMAT "%5.0" /end CHARACTERISTIC
/begin CHARACTERISTIC DNWEK "" VALUE 0x8FD181 KwUb 10200. nmot_ub_q40 0.00 10200. FORMAT "%5.0" /end CHARACTERISTIC
/begin CHARACTERISTIC DNWEOFF "" VALUE 0x8FD182 KwUb 10200. nmot_ub_q40 0.00 10200. FORMAT "%5.0" /end CHARACTERISTIC
/begin CHARACTERISTIC DTIABS "" VALUE 0x8FDD1C KwUw 209.5104 tinjection_sy 0.2016000 209.7120 FORMAT "%8.4" /end CHARACTERISTIC
/begin CHARACTERISTIC DTIREL "" VALUE 0x8FCF75 KwUb 98.44 rel_ub_b99p6 1.172 99.61 FORMAT "%5.2" /end CHARACTERISTIC
/begin CHARACTERISTIC DTKATMN "" VALUE 0x8E244E KwUb 1275. temp_ub_q5_o50 -50.00 1225. FORMAT "%5.0" /end CHARACTERISTIC
/begin CHARACTERISTIC DTKH "" VALUE 0x8E244F KwUb 191.3 temp_ub_b191p25 0.00 191.3 FORMAT "%5.1" /end CHARACTERISTIC
/begin CHARACTERISTIC DTMABKH "" VALUE 0x8E2450 KwUb 191.3 temp_ub_b191p25 0.00 191.3 FORMAT "%5.1" /end CHARACTERISTIC
/begin CHARACTERISTIC DTUMTAT "" VALUE 0x8E091A KwUb 191.3 temp_ub_b191p25 0.00 191.3 FORMAT "%5.1" /end CHARACTERISTIC
/begin CHARACTERISTIC DUPW12KD "" VALUE 0x8FDC7C KwUw 319.9951 spg_uw_q0p00488 0.00 319.9951 FORMAT "%8.4" /end CHARACTERISTIC
/begin CHARACTERISTIC DUPWGLKD "" VALUE 0x8FDC7E KwUw 319.9951 spg_uw_q0p00488 0.00 319.9951 FORMAT "%8.4" /end CHARACTERISTIC
/begin CHARACTERISTIC DUPWKDLB "" VALUE 0x8FDC80 KwUw 319.9951 spg_uw_q0p00488 0.00 319.9951 FORMAT "%8.4" /end CHARACTERISTIC
/begin CHARACTERISTIC DUPWKDO "" VALUE 0x8FDC82 KwUw 319.9951 spg_uw_q0p00488 0.00 319.9951 FORMAT "%8.4" /end CHARACTERISTIC
/begin CHARACTERISTIC DUPWKDU "" VALUE 0x8FDC84 KwUw 319.9951 spg_uw_q0p00488 0.00 319.9951 FORMAT "%8.4" /end CHARACTERISTIC
/begin CHARACTERISTIC DVEEST "" VALUE 0x8FCF6F KwUb 2.550 t10msxs_ub_b2p55 0.00 2.550 FORMAT "%5.3" /end CHARACTERISTIC
/begin CHARACTERISTIC DVFZAR "" VALUE 0x8FD1B4 KwUb 318.8 vfzg_ub_q1p25 0.00 318.8 FORMAT "%5.1" /end CHARACTERISTIC
/begin CHARACTERISTIC DVSA "" VALUE 0x8FD183 KwUb 318.8 vfzg_ub_q1p25 0.00 318.8 FORMAT "%5.1" /end CHARACTERISTIC
/begin CHARACTERISTIC DWDKSBAMX "" CURVE 0x8E82AC KlAUwSstUwWUw 100.0000 relDK_uw_b100 0.00 100.0000 FORMAT "%8.4"
 /begin AXIS_DESCR STD_AXIS gwdk_kge relDK_q0p00152 5 0.00 99.99847 FORMAT "%8.5" DEPOSIT ABSOLUTE /end AXIS_DESCR
/end CHARACTERISTIC
/begin CHARACTERISTIC DWDKSIKLS "" VALUE 0x8FDD08 KwSw 1599.976 relDK_q0p02441 -800.0000 799.9756 FORMAT "%8.4" /end CHARACTERISTIC
/begin CHARACTERISTIC ENSAKHG "" VALUE 0x8FD184 KwUb 255.0 dez 0.00 255.0 FORMAT "%5.1" /end CHARACTERISTIC
/begin CHARACTERISTIC FATMAHX "" CURVE 0x8E81B6 KlAUbSstUwWUw 0.9999847 fak_uw_b1 0.00 0.9999847 FORMAT "%9.7"
 /begin AXIS_DESCR STD_AXIS msabikr_w m_uw_b6553p5 8 0.00 6553.500 FORMAT "%8.3" DEPOSIT ABSOLUTE /end AXIS_DESCR
/end CHARACTERISTIC
/begin CHARACTERISTIC FATMAHX2 "" CURVE 0x8E81D8 KlAUbSstUwWUw 0.9999847 fak_uw_b1 0.00 0.9999847 FORMAT "%9.7"
 /begin AXIS_DESCR STD_AXIS msabikr2_w m_uw_b6553p5 8 0.00 6553.500 FORMAT "%8.3" DEPOSIT ABSOLUTE /end AXIS_DESCR
/end CHARACTERISTIC
/begin CHARACTERISTIC FATMRML "" CURVE 0x8E091B GklWUb 0.9961 fak_ub_b1 0.00 0.9961
 /begin AXIS_DESCR COM_AXIS ml_w m_uw_b6553p5 7 0.00 6553.500 FORMAT "%8.3" AXIS_PTS_REF SML07TMUW /end AXIS_DESCR
/end CHARACTERISTIC
/begin CHARACTERISTIC FATMRML2 "" CURVE 0x8E0922 GklWUb 0.9961 fak_ub_b1 0.00 0.9961
 /begin AXIS_DESCR COM_AXIS ml_w m_uw_b6553p5 7 0.00 6553.500 FORMAT "%8.3" AXIS_PTS_REF SML07TMUW /end AXIS_DESCR
/end CHARACTERISTIC
/begin CHARACTERISTIC FATMTWHX "" VALUE 0x8E0D74 KwUb 0.9961 fak_q0p0039 0.00 0.9961 /end CHARACTERISTIC
/begin CHARACTERISTIC FATMVHX "" CURVE 0x8E81FA KlAUbSstUwWUw 113.7760 fak_q0p00174_JsK 0.00 113.7760 FORMAT "%8.4"
 /begin AXIS_DESCR STD_AXIS vfzg_w vfzg_uw_b512 7 0.00 511.9922 FORMAT "%8.4" DEPOSIT ABSOLUTE /end AXIS_DESCR
/end CHARACTERISTIC
/begin CHARACTERISTIC FATMVHX2 "" CURVE 0x8E8218 KlAUbSstUwWUw 113.7760 fak_q0p00174_JsK 0.00 113.7760 FORMAT "%8.4"
 /begin AXIS_DESCR STD_AXIS vfzg_w vfzg_uw_b512 7 0.00 511.9922 FORMAT "%8.4" DEPOSIT ABSOLUTE /end AXIS_DESCR
/end CHARACTERISTIC
/begin CHARACTERISTIC FATRKRML "" CURVE 0x8E0929 GklWUb 0.9961 fak_ub_b1 0.00 0.9961
 /begin AXIS_DESCR COM_AXIS ml_w m_uw_b6553p5 7 0.00 6553.500 FORMAT "%8.3" AXIS_PTS_REF SML07TMUW /end AXIS_DESCR
/end CHARACTERISTIC
/begin CHARACTERISTIC FATRKRML2 "" CURVE 0x8E0930 GklWUb 0.9961 fak_ub_b1 0.00 0.9961
 /begin AXIS_DESCR COM_AXIS ml_w m_uw_b6553p5 7 0.00 6553.500 FORMAT "%8.3" AXIS_PTS_REF SML07TMUW /end AXIS_DESCR
/end CHARACTERISTIC
/begin CHARACTERISTIC FHOKH "" VALUE 0x8EAFBC KwUw 3.999939 fak_uw_b4 0.00 3.999939 FORMAT "%8.6" /end CHARACTERISTIC
/begin CHARACTERISTIC FKFDARTM "" CURVE 0x8E2F49 KlAUbSstUbWUb 1.992 fak_q0p0078 0.00 1.992 FORMAT "%5.3"
 /begin AXIS_DESCR STD_AXIS tmot temp_ub_q0p75_o48 6 -48.00 143.3 FORMAT "%5.1" DEPOSIT ABSOLUTE /end AXIS_DESCR
/end CHARACTERISTIC
/begin CHARACTERISTIC FKHABMN "" VALUE 0x8E2451 KwUb 0.9961 fak_ub_b1 0.00 0.9961 /end CHARACTERISTIC
/begin CHARACTERISTIC FKHLA "" CURVE 0x8EAFBE KlAUwSstUwWUw 0.9999847 fak_uw_b1 0.00 0.9999847 FORMAT "%9.7"
 /begin AXIS_DESCR STD_AXIS imlpr_w fak_uw_b1 8 0.00 0.9999847 FORMAT "%9.7" DEPOSIT ABSOLUTE /end AXIS_DESCR
/end CHARACTERISTIC
/begin CHARACTERISTIC FKHMD "" CURVE 0x8EAFE0 KlAUwSstUwWUw 0.9999847 fak_uw_b1 0.00 0.9999847 FORMAT "%9.7"
 /begin AXIS_DESCR STD_AXIS imlpr_w fak_uw_b1 8 0.00 0.9999847 FORMAT "%9.7" DEPOSIT ABSOLUTE /end AXIS_DESCR
/end CHARACTERISTIC
/begin CHARACTERISTIC FKHMDLL "" CURVE 0x8EB002 KlAUwSstUwWUw 0.9999847 fak_uw_b1 0.00 0.9999847 FORMAT "%9.7"
 /begin AXIS_DESCR STD_AXIS imlpr_w fak_uw_b1 8 0.00 0.9999847 FORMAT "%9.7" DEPOSIT ABSOLUTE /end AXIS_DESCR
/end CHARACTERISTIC
/begin CHARACTERISTIC FKVRNR "" VALUE 0x8ECA88 KwUw 159.9976 fak_uw_b160 0.00 159.9976 FORMAT "%8.4" /end CHARACTERISTIC
/begin CHARACTERISTIC FLRAWG "" CURVE 0x8E2F56 FklWUb 15.94 fak_ub_b16 0.00 15.94 FORMAT "%5.2"
 /begin AXIS_DESCR FIX_AXIS gangi dez 8 0.00 7.000 FORMAT "%5.3" FIX_AXIS_PAR 0 0 8 /end AXIS_DESCR
/end CHARACTERISTIC
/begin CHARACTERISTIC FLRCVT "" CURVE 0x8E2F5E GklWUb 15.94 fak_ub_b16 0.00 15.94 FORMAT "%5.2"
 /begin AXIS_DESCR COM_AXIS uefktget uefktget_ub_b25p4 7 0.00 25.50 FORMAT "%5.2" AXIS_PTS_REF SUV07MDUB /end AXIS_DESCR
/end CHARACTERISTIC
/begin CHARACTERISTIC FLRFDAR "" VALUE 0x8E2F65 KwUb 3.984 fak_ub_b4 0.00 3.984 FORMAT "%5.3" /end CHARACTERISTIC
/begin CHARACTERISTIC FLRFLRAR "" VALUE 0x8E2F66 KwUb 3.984 fak_ub_b4 0.00 3.984 FORMAT "%5.3" /end CHARACTERISTIC
/begin CHARACTERISTIC FLRHG "" CURVE 0x8E2F67 FklWUb 15.94 fak_ub_b16 0.00 15.94 FORMAT "%5.2"
 /begin AXIS_DESCR FIX_AXIS gangi dez 8 0.00 7.000 FORMAT "%5.3" FIX_AXIS_PAR 0 0 8 /end AXIS_DESCR
/end CHARACTERISTIC
/begin CHARACTERISTIC FLRKIFZ "" VALUE 0x8E2F6F KwUb 3.984 fak_ub_b4 0.00 3.984 FORMAT "%5.3" /end CHARACTERISTIC
/begin CHARACTERISTIC FMDKHNS "" VALUE 0x8EB024 KwUw 0.9999847 fak_uw_b1 0.00 0.9999847 FORMAT "%9.7" /end CHARACTERISTIC
/begin CHARACTERISTIC FRARAWGS "" CURVE 0x8E2F70 FklWUb 3.113 fak_ub_b3p125 0.00 3.113 FORMAT "%5.3"
 /begin AXIS_DESCR FIX_AXIS gangi dez 8 0.00 7.000 FORMAT "%5.3" FIX_AXIS_PAR 0 0 8 /end AXIS_DESCR
/end CHARACTERISTIC
/begin CHARACTERISTIC FRARCVT "" CURVE 0x8E2F78 GklWUb 3.113 fak_ub_b3p125 0.00 3.113 FORMAT "%5.3"
 /begin AXIS_DESCR COM_AXIS uefktget uefktget_ub_b25p4 7 0.00 25.50 FORMAT "%5.2" AXIS_PTS_REF SUV07MDUB /end AXIS_DESCR
/end CHARACTERISTIC
/begin CHARACTERISTIC FRARCVTS "" CURVE 0x8E2F7F GklWUb 3.113 fak_ub_b3p125 0.00 3.113 FORMAT "%5.3"
 /begin AXIS_DESCR COM_AXIS uefktget uefktget_ub_b25p4 7 0.00 25.50 FORMAT "%5.2" AXIS_PTS_REF SUV07MDUB /end AXIS_DESCR
/end CHARACTERISTIC
/begin CHARACTERISTIC FRARHGS "" CURVE 0x8E2F86 FklWUb 3.113 fak_ub_b3p125 0.00 3.113 FORMAT "%5.3"
 /begin AXIS_DESCR FIX_AXIS gangi dez 8 0.00 7.000 FORMAT "%5.3" FIX_AXIS_PAR 0 0 8 /end AXIS_DESCR
/end CHARACTERISTIC
/begin CHARACTERISTIC FTDGANG "" VALUE 0x8E0D8D KwUb 10.00 dez 0.00 10.00 FORMAT "%5.2" /end CHARACTERISTIC
/begin CHARACTERISTIC FTMLAKH "" CURVE 0x8E2452 KlAUbSstUbWUb 0.9961 fak_ub_b1 0.00 0.9961
 /begin AXIS_DESCR STD_AXIS tmot temp_ub_q0p75_o48 4 -48.00 143.3 FORMAT "%5.1" DEPOSIT ABSOLUTE /end AXIS_DESCR
/end CHARACTERISTIC
/begin CHARACTERISTIC FTMOTKHX "" VALUE 0x8E0D75 KwUb 2.361 fak_q0p00926_JsKK 0.00 2.361 FORMAT "%5.3" /end CHARACTERISTIC
/begin CHARACTERISTIC FTMOTKHX2 "" VALUE 0x8E0D76 KwUb 2.361 fak_q0p00926_JsKK 0.00 2.361 FORMAT "%5.3" /end CHARACTERISTIC
/begin CHARACTERISTIC FWEAB "" VALUE 0x8FCF76 KwUb 0.9961 fak_ub_b1 0.00 0.9961 /end CHARACTERISTIC
/begin CHARACTERISTIC FWEAUF "" VALUE 0x8FCF77 KwUb 0.9961 fak_ub_b1 0.00 0.9961 /end CHARACTERISTIC
/begin CHARACTERISTIC FWEMXT "" CURVE 0x8E0EA1 KlAUbSstUbWUb 0.9922 fak_ub_b2 1.000 1.992 FORMAT "%5.3"
 /begin AXIS_DESCR STD_AXIS tmot temp_ub_q0p75_o48 8 -48.00 143.3 FORMAT "%5.1" DEPOSIT ABSOLUTE /end AXIS_DESCR
/end CHARACTERISTIC
/begin CHARACTERISTIC FWMABGW "" VALUE 0x8E0937 KwUb 0.9961 fak_ub_b1 0.00 0.9961 /end CHARACTERISTIC
/begin CHARACTERISTIC FWMABGW2 "" VALUE 0x8E0938 KwUb 0.9961 fak_ub_b1 0.00 0.9961 /end CHARACTERISTIC
/begin CHARACTERISTIC FWMKATW "" VALUE 0x8E0939 KwUb 0.9961 fak_ub_b1 0.00 0.9961 /end CHARACTERISTIC
/begin CHARACTERISTIC FWMKATW2 "" VALUE 0x8E093A KwUb 0.9961 fak_ub_b1 0.00 0.9961 /end CHARACTERISTIC
/begin CHARACTERISTIC GANGISAV "" VALUE 0x8E290C KwUb 7.000 dez 0.00 7.000 FORMAT "%5.3" /end CHARACTERISTIC
/begin CHARACTERISTIC IGESGA "" CURVE 0x8E0D8E FklWUb 25.50 fak_q0p1 0.00 25.50 FORMAT "%5.2"
 /begin AXIS_DESCR FIX_AXIS gangi dez 8 0.00 7.000 FORMAT "%5.3" FIX_AXIS_PAR 0 0 8 /end AXIS_DESCR
/end CHARACTERISTIC
/begin CHARACTERISTIC IGNDELAY "" VALUE 0x8FCD23 KwUb 255.0 DEZ 0.00 255.0 FORMAT "%5.1" /end CHARACTERISTIC
/begin CHARACTERISTIC IMLATWS "" VALUE 0x8EB026 KwUw 23.30133 m_uw_b23p3 0.00 23.30133 FORMAT "%8.5" /end CHARACTERISTIC
/begin CHARACTERISTIC IMLKHMXTMS "" CURVE 0x8EB028 KlAUbSstUbWUw 0.9999847 fak_uw_b1 0.00 0.9999847 FORMAT "%9.7"
 /begin AXIS_DESCR STD_AXIS tmst temp_ub_q0p75_o48 4 -48.00 143.3 FORMAT "%5.1" DEPOSIT ABSOLUTE /end AXIS_DESCR
/end CHARACTERISTIC
/begin CHARACTERISTIC IMLKHTMS "" CURVE 0x8EB190 KlAUbSstUbWUb 0.9961 fak_ub_b1 0.00 0.9961
 /begin AXIS_DESCR STD_AXIS tmst temp_ub_q0p75_o48 8 -48.00 143.3 FORMAT "%5.1" DEPOSIT ABSOLUTE /end AXIS_DESCR
/end CHARACTERISTIC
/begin CHARACTERISTIC IMLKS "" VALUE 0x8E233D KwUb 23.21 m_ub_b23p3 0.00 23.21 FORMAT "%5.2" /end CHARACTERISTIC
/begin CHARACTERISTIC IMTUMTAT "" VALUE 0x8E093B KwUb 23.21 m_ub_b23p3 0.00 23.21 FORMAT "%5.2" /end CHARACTERISTIC
/begin CHARACTERISTIC KATMCPHX "" VALUE 0x8E8236 KwUw 14563.11 fak_q0p2222_JK 0.2222222 14563.33 FORMAT "%8.2" /end CHARACTERISTIC
/begin CHARACTERISTIC KATMCPHX2 "" VALUE 0x8E8238 KwUw 14563.11 fak_q0p2222_JK 0.2222222 14563.33 FORMAT "%8.2" /end CHARACTERISTIC
/begin CHARACTERISTIC KATMEXML "" CURVE 0x8E093C GklWSb 1275. temp_q5 -640.0 635.0 FORMAT "%5.1"
 /begin AXIS_DESCR COM_AXIS ml_w m_uw_b6553p5 7 0.00 6553.500 FORMAT "%8.3" AXIS_PTS_REF SML07TMUW /end AXIS_DESCR
/end CHARACTERISTIC
/begin CHARACTERISTIC KATMEXML2 "" CURVE 0x8E0943 GklWSb 1275. temp_q5 -640.0 635.0 FORMAT "%5.1"
 /begin AXIS_DESCR COM_AXIS ml_w m_uw_b6553p5 7 0.00 6553.500 FORMAT "%8.3" AXIS_PTS_REF SML07TMUW /end AXIS_DESCR
/end CHARACTERISTIC
/begin CHARACTERISTIC KATMIEXML "" CURVE 0x8E094A GklWSb 1275. temp_q5 -640.0 635.0 FORMAT "%5.1"
 /begin AXIS_DESCR COM_AXIS ml_w m_uw_b6553p5 7 0.00 6553.500 FORMAT "%8.3" AXIS_PTS_REF SML07TMUW /end AXIS_DESCR
/end CHARACTERISTIC
/begin CHARACTERISTIC KATMIEXML2 "" CURVE 0x8E0951 GklWSb 1275. temp_q5 -640.0 635.0 FORMAT "%5.1"
 /begin AXIS_DESCR COM_AXIS ml_w m_uw_b6553p5 7 0.00 6553.500 FORMAT "%8.3" AXIS_PTS_REF SML07TMUW /end AXIS_DESCR
/end CHARACTERISTIC
/begin CHARACTERISTIC KDLRIDDVE "" VALUE 0x8E0E99 KwUb 255.0 dez 0.00 255.0 FORMAT "%5.1" /end CHARACTERISTIC
/begin CHARACTERISTIC KFABK "" MAP 0x8E4DA2 KfAxUbAyUbSstxUbSstyUbWUb 2.000 dez 0.00 2.000 FORMAT "%5.3"
 /begin AXIS_DESCR STD_AXIS nmot nmot_ub_q40 8 0.00 10200. FORMAT "%5.0" DEPOSIT ABSOLUTE /end AXIS_DESCR
 /begin AXIS_DESCR STD_AXIS rl rel_ub_q0p75 8 0.00 191.3 FORMAT "%5.1" DEPOSIT ABSOLUTE /end AXIS_DESCR
/end CHARACTERISTIC
/begin CHARACTERISTIC KFATLAK "" MAP 0x8E0958 GkfWSb 1275. temp_q5 -640.0 635.0 FORMAT "%5.1"
 /begin AXIS_DESCR COM_AXIS ml_w m_uw_b6553p5 6 0.00 6553.500 FORMAT "%8.3" AXIS_PTS_REF SMT06TMUW /end AXIS_DESCR
 /begin AXIS_DESCR COM_AXIS lamsbg_w fak_uw_b16 6 0.00 15.99976 FORMAT "%8.5" AXIS_PTS_REF SLX06TMUW /end AXIS_DESCR
/end CHARACTERISTIC
/begin CHARACTERISTIC KFATLAK2 "" MAP 0x8E097C GkfWSb 1275. temp_q5 -640.0 635.0 FORMAT "%5.1"
 /begin AXIS_DESCR COM_AXIS ml_w m_uw_b6553p5 6 0.00 6553.500 FORMAT "%8.3" AXIS_PTS_REF SMT06TMUW /end AXIS_DESCR
 /begin AXIS_DESCR COM_AXIS lamsbg2_w fak_uw_b16 6 0.00 15.99976 FORMAT "%8.5" AXIS_PTS_REF SLY06TMUW /end AXIS_DESCR
/end CHARACTERISTIC
/begin CHARACTERISTIC KFATMABKA "" MAP 0x8E09A0 GkfWUb 0.9961 fak_ub_b1 0.00 0.9961
 /begin AXIS_DESCR COM_AXIS tabstatm_w t1sxs_uw_q1 6 0.00 65535.00 FORMAT "%8.2" AXIS_PTS_REF STS06TMUW /end AXIS_DESCR
 /begin AXIS_DESCR COM_AXIS tatu temp_ub_q0p75_o48 5 -48.00 143.3 FORMAT "%5.1" AXIS_PTS_REF STU05TMUB /end AXIS_DESCR
/end CHARACTERISTIC
/begin CHARACTERISTIC KFATMABKA2 "" MAP 0x8E09BE GkfWUb 0.9961 fak_ub_b1 0.00 0.9961
 /begin AXIS_DESCR COM_AXIS tabstatm_w t1sxs_uw_q1 6 0.00 65535.00 FORMAT "%8.2" AXIS_PTS_REF STS06TMUW /end AXIS_DESCR
 /begin AXIS_DESCR COM_AXIS tatu temp_ub_q0p75_o48 5 -48.00 143.3 FORMAT "%5.1" AXIS_PTS_REF STU05TMUB /end AXIS_DESCR
/end CHARACTERISTIC
/begin CHARACTERISTIC KFATMABKK "" MAP 0x8E09DC GkfWUb 0.9961 fak_ub_b1 0.00 0.9961
 /begin AXIS_DESCR COM_AXIS tabstatm_w t1sxs_uw_q1 6 0.00 65535.00 FORMAT "%8.2" AXIS_PTS_REF STS06TMUW /end AXIS_DESCR
 /begin AXIS_DESCR COM_AXIS tatu temp_ub_q0p75_o48 5 -48.00 143.3 FORMAT "%5.1" AXIS_PTS_REF STU05TMUB /end AXIS_DESCR
/end CHARACTERISTIC
/begin CHARACTERISTIC KFATMABKK2 "" MAP 0x8E09FA GkfWUb 0.9961 fak_ub_b1 0.00 0.9961
 /begin AXIS_DESCR COM_AXIS tabstatm_w t1sxs_uw_q1 6 0.00 65535.00 FORMAT "%8.2" AXIS_PTS_REF STS06TMUW /end AXIS_DESCR
 /begin AXIS_DESCR COM_AXIS tatu temp_ub_q0p75_o48 5 -48.00 143.3 FORMAT "%5.1" AXIS_PTS_REF STU05TMUB /end AXIS_DESCR
/end CHARACTERISTIC
/begin CHARACTERISTIC KFATMKR "" MAP 0x8E0A18 KfAxUbAyUbSstxUbSstyUbWUb 1275. temp_ub_q5_o50 -50.00 1225. FORMAT "%5.0"
 /begin AXIS_DESCR STD_AXIS nmot nmot_ub_q40 8 0.00 10200. FORMAT "%5.0" DEPOSIT ABSOLUTE /end AXIS_DESCR
 /begin AXIS_DESCR STD_AXIS rl rel_ub_q0p75 8 0.00 191.3 FORMAT "%5.1" DEPOSIT ABSOLUTE /end AXIS_DESCR
/end CHARACTERISTIC
/begin CHARACTERISTIC KFATMKR2 "" MAP 0x8E0A6A KfAxUbAyUbSstxUbSstyUbWUb 1275. temp_ub_q5_o50 -50.00 1225. FORMAT "%5.0"
 /begin AXIS_DESCR STD_AXIS nmot nmot_ub_q40 8 0.00 10200. FORMAT "%5.0" DEPOSIT ABSOLUTE /end AXIS_DESCR
 /begin AXIS_DESCR STD_AXIS rl rel_ub_q0p75 8 0.00 191.3 FORMAT "%5.1" DEPOSIT ABSOLUTE /end AXIS_DESCR
/end CHARACTERISTIC
/begin CHARACTERISTIC KFATMLA "" MAP 0x8E0ABC GkfWSb 1275. temp_q5 -640.0 635.0 FORMAT "%5.1"
 /begin AXIS_DESCR COM_AXIS ml_w m_uw_b6553p5 6 0.00 6553.500 FORMAT "%8.3" AXIS_PTS_REF SML06TMUW /end AXIS_DESCR
 /begin AXIS_DESCR COM_AXIS lamsbg_w fak_uw_b16 6 0.00 15.99976 FORMAT "%8.5" AXIS_PTS_REF SLX06TMUW /end AXIS_DESCR
/end CHARACTERISTIC
/begin CHARACTERISTIC KFATMLA2 "" MAP 0x8E0AE0 GkfWSb 1275. temp_q5 -640.0 635.0 FORMAT "%5.1"
 /begin AXIS_DESCR COM_AXIS ml_w m_uw_b6553p5 6 0.00 6553.500 FORMAT "%8.3" AXIS_PTS_REF SML06TMUW /end AXIS_DESCR
 /begin AXIS_DESCR COM_AXIS lamsbg2_w fak_uw_b16 6 0.00 15.99976 FORMAT "%8.5" AXIS_PTS_REF SLY06TMUW /end AXIS_DESCR
/end CHARACTERISTIC
/begin CHARACTERISTIC KFATMZW "" MAP 0x8E0B04 GkfWSb 1275. temp_q5 -640.0 635.0 FORMAT "%5.1"
 /begin AXIS_DESCR COM_AXIS ml_w m_uw_b6553p5 6 0.00 6553.500 FORMAT "%8.3" AXIS_PTS_REF SML06TMUW /end AXIS_DESCR
 /begin AXIS_DESCR COM_AXIS etazwimt rel_ub_b127p5 6 0.00 127.5 FORMAT "%5.1" AXIS_PTS_REF SEZ06TMUB /end AXIS_DESCR
/end CHARACTERISTIC
/begin CHARACTERISTIC KFATMZW2 "" MAP 0x8E0B28 GkfWSb 1275. temp_q5 -640.0 635.0 FORMAT "%5.1"
 /begin AXIS_DESCR COM_AXIS ml_w m_uw_b6553p5 6 0.00 6553.500 FORMAT "%8.3" AXIS_PTS_REF SML06TMUW /end AXIS_DESCR
 /begin AXIS_DESCR COM_AXIS etazwimt rel_ub_b127p5 6 0.00 127.5 FORMAT "%5.1" AXIS_PTS_REF SEZ06TMUB /end AXIS_DESCR
/end CHARACTERISTIC
/begin CHARACTERISTIC KFATZWK "" MAP 0x8E0B4C GkfWSb 1275. temp_q5 -640.0 635.0 FORMAT "%5.1"
 /begin AXIS_DESCR COM_AXIS ml_w m_uw_b6553p5 6 0.00 6553.500 FORMAT "%8.3" AXIS_PTS_REF SMT06TMUW /end AXIS_DESCR
 /begin AXIS_DESCR COM_AXIS etazwimt rel_ub_b127p5 6 0.00 127.5 FORMAT "%5.1" AXIS_PTS_REF SEZ06TMUB /end AXIS_DESCR
/end CHARACTERISTIC
/begin CHARACTERISTIC KFATZWK2 "" MAP 0x8E0B70 GkfWSb 1275. temp_q5 -640.0 635.0 FORMAT "%5.1"
 /begin AXIS_DESCR COM_AXIS ml_w m_uw_b6553p5 6 0.00 6553.500 FORMAT "%8.3" AXIS_PTS_REF SMT06TMUW /end AXIS_DESCR
 /begin AXIS_DESCR COM_AXIS etazwimt rel_ub_b127p5 6 0.00 127.5 FORMAT "%5.1" AXIS_PTS_REF SEZ06TMUB /end AXIS_DESCR
/end CHARACTERISTIC
/begin CHARACTERISTIC KFDMDADP "" MAP 0x8ECA8A GkfWUw 99.99847 rel_uw_b100 0.00 99.99847 FORMAT "%8.5"
 /begin AXIS_DESCR COM_AXIS gangi dez 6 0.00 255.0 FORMAT "%5.1" AXIS_PTS_REF SGA06MDUB /end AXIS_DESCR
 /begin AXIS_DESCR COM_AXIS mkar_w rel_sw_b100 8 -100.0000 99.99695 FORMAT "%8.4" AXIS_PTS_REF SMK08MDSW /end AXIS_DESCR
/end CHARACTERISTIC
/begin CHARACTERISTIC KFDMDARO "" MAP 0x8ECAEA GkfWUw 99.99847 rel_uw_b100 0.00 99.99847 FORMAT "%8.5"
 /begin AXIS_DESCR COM_AXIS gangi dez 6 0.00 255.0 FORMAT "%5.1" AXIS_PTS_REF SGA06MDUB /end AXIS_DESCR
 /begin AXIS_DESCR COM_AXIS mkar_w rel_sw_b100 8 -100.0000 99.99695 FORMAT "%8.4" AXIS_PTS_REF SMK08MDSW /end AXIS_DESCR
/end CHARACTERISTIC
/begin CHARACTERISTIC KFDMDAROS "" MAP 0x8ECB4A GkfWUw 99.99847 rel_uw_b100 0.00 99.99847 FORMAT "%8.5"
 /begin AXIS_DESCR COM_AXIS gangi dez 6 0.00 255.0 FORMAT "%5.1" AXIS_PTS_REF SGA06MDUB /end AXIS_DESCR
 /begin AXIS_DESCR COM_AXIS mkar_w rel_sw_b100 8 -100.0000 99.99695 FORMAT "%8.4" AXIS_PTS_REF SMK08MDSW /end AXIS_DESCR
/end CHARACTERISTIC
/begin CHARACTERISTIC KFFGDMAR "" MAP 0x8E2F8E KfAxUbAyUbSstxUbSstyUbWUb 1.992 fak_ub_b2 0.00 1.992 FORMAT "%5.3"
 /begin AXIS_DESCR STD_AXIS rl rel_ub_q0p75 6 0.00 191.3 FORMAT "%5.1" DEPOSIT ABSOLUTE /end AXIS_DESCR
 /begin AXIS_DESCR STD_AXIS nmot nmot_ub_q40 6 0.00 10200. FORMAT "%5.0" DEPOSIT ABSOLUTE /end AXIS_DESCR
/end CHARACTERISTIC
/begin CHARACTERISTIC KFFRARAW "" MAP 0x8E2FC0 KfAxUbAyUbSstxUbSstyUbWUb 3.113 fak_ub_b3p125 0.00 3.113 FORMAT "%5.3"
 /begin AXIS_DESCR STD_AXIS nmot nmot_ub_q40 6 0.00 10200. FORMAT "%5.0" DEPOSIT ABSOLUTE /end AXIS_DESCR
 /begin AXIS_DESCR STD_AXIS gangi dez 7 0.00 255.0 FORMAT "%5.1" DEPOSIT ABSOLUTE /end AXIS_DESCR
/end CHARACTERISTIC
/begin CHARACTERISTIC KFFRARHG "" MAP 0x8E2FF9 KfAxUbAyUbSstxUbSstyUbWUb 3.113 fak_ub_b3p125 0.00 3.113 FORMAT "%5.3"
 /begin AXIS_DESCR STD_AXIS nmot nmot_ub_q40 6 0.00 10200. FORMAT "%5.0" DEPOSIT ABSOLUTE /end AXIS_DESCR
 /begin AXIS_DESCR STD_AXIS gangi dez 7 0.00 255.0 FORMAT "%5.1" DEPOSIT ABSOLUTE /end AXIS_DESCR
/end CHARACTERISTIC
/begin CHARACTERISTIC KFNFSKHM "" MAP 0x8EB036 KfAxUbAyUbSstxUbSstyUwWUb 2550. nmot_ub_q10 0.00 2550. FORMAT "%5.0"
 /begin AXIS_DESCR STD_AXIS tmot temp_ub_q0p75_o48 8 -48.00 143.3 FORMAT "%5.1" DEPOSIT ABSOLUTE /end AXIS_DESCR
 /begin AXIS_DESCR STD_AXIS frhokor_w fak_uw_b4 4 0.00 3.999939 FORMAT "%8.6" DEPOSIT ABSOLUTE /end AXIS_DESCR
/end CHARACTERISTIC
/begin CHARACTERISTIC KFNLLKHM "" MAP 0x8EB068 KfAxUbAyUbSstxUbSstyUwWUb 2550. nmot_ub_q10 0.00 2550. FORMAT "%5.0"
 /begin AXIS_DESCR STD_AXIS tmot temp_ub_q0p75_o48 8 -48.00 143.3 FORMAT "%5.1" DEPOSIT ABSOLUTE /end AXIS_DESCR
 /begin AXIS_DESCR STD_AXIS frhokor_w fak_uw_b4 4 0.00 3.999939 FORMAT "%8.6" DEPOSIT ABSOLUTE /end AXIS_DESCR
/end CHARACTERISTIC
/begin CHARACTERISTIC KFNSKHLL "" MAP 0x8E245B KfAxUbAyUbSstxUbSstyUbWUb 1.992 fak_ub_b2 0.00 1.992 FORMAT "%5.3" /begin AXIS_DESCR STD_AXIS imlpr fak_ub_b1 5 0.00 0.9961 DEPOSIT ABSOLUTE /end AXIS_DESCR
 /begin AXIS_DESCR STD_AXIS fho fak_ub_b4 4 0.00 3.984 FORMAT "%5.3" DEPOSIT ABSOLUTE /end AXIS_DESCR
/end CHARACTERISTIC
/begin CHARACTERISTIC KFNWEGM "" MAP 0x8E290D GkfWUb 10200. nmot_ub_q40 0.00 10200. FORMAT "%5.0"
 /begin AXIS_DESCR COM_AXIS tmot temp_ub_q0p75_o48 5 -48.00 143.3 FORMAT "%5.1" AXIS_PTS_REF STM05SAUB /end AXIS_DESCR
 /begin AXIS_DESCR COM_AXIS gangi dez 8 0.00 255.0 FORMAT "%5.1" AXIS_PTS_REF SGA08MDUB /end AXIS_DESCR
/end CHARACTERISTIC
/begin CHARACTERISTIC KFTATM "" MAP 0x8E0B94 KfAxUbAyUbSstxUbSstyUbWUb 1275. temp_ub_q5_o50 -50.00 1225. FORMAT "%5.0"
 /begin AXIS_DESCR STD_AXIS nmot nmot_ub_q40 8 0.00 10200. FORMAT "%5.0" DEPOSIT ABSOLUTE /end AXIS_DESCR
 /begin AXIS_DESCR STD_AXIS rl rel_ub_q0p75 8 0.00 191.3 FORMAT "%5.1" DEPOSIT ABSOLUTE /end AXIS_DESCR
/end CHARACTERISTIC
/begin CHARACTERISTIC KFTATM2 "" MAP 0x8E0BE6 KfAxUbAyUbSstxUbSstyUbWUb 1275. temp_ub_q5_o50 -50.00 1225. FORMAT "%5.0"
 /begin AXIS_DESCR STD_AXIS nmot nmot_ub_q40 8 0.00 10200. FORMAT "%5.0" DEPOSIT ABSOLUTE /end AXIS_DESCR
 /begin AXIS_DESCR STD_AXIS rl rel_ub_q0p75 8 0.00 191.3 FORMAT "%5.1" DEPOSIT ABSOLUTE /end AXIS_DESCR
/end CHARACTERISTIC
/begin CHARACTERISTIC KFTEVP "" MAP 0x8E38A0 KfAxUbAyUbSstxUbSstyUbWUb 127.5 t500usxms_ub_q0p5 0.00 127.5 FORMAT "%5.1"
 /begin AXIS_DESCR STD_AXIS nmot nmot_ub_q40 5 0.00 10200. FORMAT "%5.0" DEPOSIT ABSOLUTE /end AXIS_DESCR
 /begin AXIS_DESCR STD_AXIS tateroh rel_ub_b99p6 9 0.00 99.61 FORMAT "%5.2" DEPOSIT ABSOLUTE /end AXIS_DESCR
/end CHARACTERISTIC
/begin CHARACTERISTIC KFTVSA "" MAP 0x8E2935 GkfWUb 2.550 t10msxs_ub_b2p55 0.00 2.550 FORMAT "%5.3"
 /begin AXIS_DESCR COM_AXIS tmot temp_ub_q0p75_o48 5 -48.00 143.3 FORMAT "%5.1" AXIS_PTS_REF STM05SAUB /end AXIS_DESCR
 /begin AXIS_DESCR COM_AXIS nmot nmot_ub_q40 8 0.00 10200. FORMAT "%5.0" AXIS_PTS_REF SNM08SAUB /end AXIS_DESCR
/end CHARACTERISTIC
/begin CHARACTERISTIC KFTVSAGI "" MAP 0x8E295D GkfWUb 2.550 t10msxs_ub_b2p55 0.00 2.550 FORMAT "%5.3"
 /begin AXIS_DESCR COM_AXIS tmot temp_ub_q0p75_o48 5 -48.00 143.3 FORMAT "%5.1" AXIS_PTS_REF STM05SAUB /end AXIS_DESCR
 /begin AXIS_DESCR COM_AXIS nmot nmot_ub_q40 8 0.00 10200. FORMAT "%5.0" AXIS_PTS_REF SNM08SAUB /end AXIS_DESCR
/end CHARACTERISTIC
/begin CHARACTERISTIC KFTVSAGNG "" MAP 0x8EBAD2 KfAxUwAyUwSstxUwSstyUwWUw 655.3500 t10msxs_uw_b655p35 0.00 655.3500 FORMAT "%8.4"
 /begin AXIS_DESCR STD_AXIS nmot nmot_ub_q40 3 0.00 10200. FORMAT "%5.0" DEPOSIT ABSOLUTE /end AXIS_DESCR
 /begin AXIS_DESCR STD_AXIS gangi dez 8 0.00 255.0 FORMAT "%5.1" DEPOSIT ABSOLUTE /end AXIS_DESCR
/end CHARACTERISTIC
/begin CHARACTERISTIC KFTVSAKAT "" MAP 0x8E2985 GkfWUb 10200.0 t40ms_ub_b10200 0.00 10200.0 FORMAT "%7.1"
 /begin AXIS_DESCR COM_AXIS nmot nmot_ub_q40 8 0.00 10200. FORMAT "%5.0" AXIS_PTS_REF SNM08SAUB /end AXIS_DESCR
 /begin AXIS_DESCR COM_AXIS tkatm temp_ub_q5_o50 4 -50.00 1225. FORMAT "%5.0" AXIS_PTS_REF STK04SAUB /end AXIS_DESCR
/end CHARACTERISTIC
/begin CHARACTERISTIC KFTVTEV "" MAP 0x8E38DD KfAxUbAyUbSstxUbSstyUbWUb 127.5 t500usxms_ub_q0p5 0.00 127.5 FORMAT "%5.1"
 /begin AXIS_DESCR STD_AXIS ub spg_ubatt_sy 6 0.00 17.93 FORMAT "%5.2" DEPOSIT ABSOLUTE /end AXIS_DESCR
 /begin AXIS_DESCR STD_AXIS tans temp_ub_q0p75_o48 3 -48.00 143.3 FORMAT "%5.1" DEPOSIT ABSOLUTE /end AXIS_DESCR
/end CHARACTERISTIC
/begin CHARACTERISTIC KFWMABG "" MAP 0x8E7E2E GkfWUw 29825.71 q_q0p4551 0.00 29825.71 FORMAT "%8.2"
 /begin AXIS_DESCR COM_AXIS tabgmst temp_ub_q5_o50 7 -50.00 1225. FORMAT "%5.0" AXIS_PTS_REF ST107TMUB /end AXIS_DESCR
 /begin AXIS_DESCR COM_AXIS tmst temp_ub_q0p75_o48 5 -48.00 143.3 FORMAT "%5.1" AXIS_PTS_REF STM05TMUB /end AXIS_DESCR
/end CHARACTERISTIC
/begin CHARACTERISTIC KFWMABG2 "" MAP 0x8E7E74 GkfWUw 29825.71 q_q0p4551 0.00 29825.71 FORMAT "%8.2"
 /begin AXIS_DESCR COM_AXIS tabgmst2 temp_ub_q5_o50 7 -50.00 1225. FORMAT "%5.0" AXIS_PTS_REF ST207TMUB /end AXIS_DESCR
 /begin AXIS_DESCR COM_AXIS tmst temp_ub_q0p75_o48 5 -48.00 143.3 FORMAT "%5.1" AXIS_PTS_REF STM05TMUB /end AXIS_DESCR
/end CHARACTERISTIC
/begin CHARACTERISTIC KFWMKAT "" MAP 0x8E7EBA GkfWUw 29825.71 q_q0p4551 0.00 29825.71 FORMAT "%8.2"
 /begin AXIS_DESCR COM_AXIS tkatmst temp_ub_q5_o50 7 -50.00 1225. FORMAT "%5.0" AXIS_PTS_REF ST307TMUB /end AXIS_DESCR
 /begin AXIS_DESCR COM_AXIS tmst temp_ub_q0p75_o48 5 -48.00 143.3 FORMAT "%5.1" AXIS_PTS_REF STM05TMUB /end AXIS_DESCR
/end CHARACTERISTIC
/begin CHARACTERISTIC KFWMKAT2 "" MAP 0x8E7F00 GkfWUw 29825.71 q_q0p4551 0.00 29825.71 FORMAT "%8.2"
 /begin AXIS_DESCR COM_AXIS tkatmst2 temp_ub_q5_o50 7 -50.00 1225. FORMAT "%5.0" AXIS_PTS_REF ST407TMUB /end AXIS_DESCR
 /begin AXIS_DESCR COM_AXIS tmst temp_ub_q0p75_o48 5 -48.00 143.3 FORMAT "%5.1" AXIS_PTS_REF STM05TMUB /end AXIS_DESCR
/end CHARACTERISTIC
/begin CHARACTERISTIC KFWNWWKA "" MAP 0x8EB09A KfAxUbAyUbSstxUwSstyUbWUb 1.992 fak_ub_b2 0.00 1.992 FORMAT "%5.3"
 /begin AXIS_DESCR STD_AXIS imlpr_w fak_uw_b1 8 0.00 0.9999847 FORMAT "%9.7" DEPOSIT ABSOLUTE /end AXIS_DESCR
 /begin AXIS_DESCR STD_AXIS tmst temp_ub_q0p75_o48 8 -48.00 143.3 FORMAT "%5.1" DEPOSIT ABSOLUTE /end AXIS_DESCR
/end CHARACTERISTIC
/begin CHARACTERISTIC KFWNWWKE "" MAP 0x8EB0F4 KfAxUbAyUbSstxUwSstyUbWUb 1.992 fak_ub_b2 0.00 1.992 FORMAT "%5.3"
 /begin AXIS_DESCR STD_AXIS imlpr_w fak_uw_b1 8 0.00 0.9999847 FORMAT "%9.7" DEPOSIT ABSOLUTE /end AXIS_DESCR
 /begin AXIS_DESCR STD_AXIS tmst temp_ub_q0p75_o48 8 -48.00 143.3 FORMAT "%5.1" DEPOSIT ABSOLUTE /end AXIS_DESCR
/end CHARACTERISTIC
/begin CHARACTERISTIC KIFZCVT "" CURVE 0x8ECBAA GklWUw 4863.926 fak_uw_b4864 0.00 4863.926 FORMAT "%8.3"
 /begin AXIS_DESCR COM_AXIS uefktget uefktget_ub_b25p4 7 0.00 25.50 FORMAT "%5.2" AXIS_PTS_REF SUV07MDUB /end AXIS_DESCR
/end CHARACTERISTIC
/begin CHARACTERISTIC KIFZGAWG "" CURVE 0x8ECBB8 FklWUw 4863.926 fak_uw_b4864 0.00 4863.926 FORMAT "%8.3"
 /begin AXIS_DESCR FIX_AXIS gangi dez 8 0.00 7.000 FORMAT "%5.3" FIX_AXIS_PAR 0 0 8 /end AXIS_DESCR
/end CHARACTERISTIC
/begin CHARACTERISTIC KIFZGHG "" CURVE 0x8ECBC8 FklWUw 4863.926 fak_uw_b4864 0.00 4863.926 FORMAT "%8.3"
 /begin AXIS_DESCR FIX_AXIS gangi dez 8 0.00 7.000 FORMAT "%5.3" FIX_AXIS_PAR 0 0 8 /end AXIS_DESCR
/end CHARACTERISTIC
/begin CHARACTERISTIC KLATMILAE "" CURVE 0x8E0C38 GklWUb 1.992 fak_ub_b2 0.00 1.992 FORMAT "%5.3"
 /begin AXIS_DESCR COM_AXIS lamsbg_w fak_uw_b16 6 0.00 15.99976 FORMAT "%8.5" AXIS_PTS_REF SLX06TMUW /end AXIS_DESCR
/end CHARACTERISTIC
/begin CHARACTERISTIC KLATMILAE2 "" CURVE 0x8E0C3E GklWUb 1.992 fak_ub_b2 0.00 1.992 FORMAT "%5.3"
 /begin AXIS_DESCR COM_AXIS lamsbg2_w fak_uw_b16 6 0.00 15.99976 FORMAT "%8.5" AXIS_PTS_REF SLY06TMUW /end AXIS_DESCR
/end CHARACTERISTIC
/begin CHARACTERISTIC KLATMIZWE "" CURVE 0x8E0C44 GklWUb 1.992 fak_ub_b2 0.00 1.992 FORMAT "%5.3"
 /begin AXIS_DESCR COM_AXIS etazwimt rel_ub_b127p5 6 0.00 127.5 FORMAT "%5.1" AXIS_PTS_REF SEZ06TMUB /end AXIS_DESCR
/end CHARACTERISTIC
/begin CHARACTERISTIC KLATMIZWE2 "" CURVE 0x8E0C4A GklWUb 1.992 fak_ub_b2 0.00 1.992 FORMAT "%5.3"
 /begin AXIS_DESCR COM_AXIS etazwimt rel_ub_b127p5 6 0.00 127.5 FORMAT "%5.1" AXIS_PTS_REF SEZ06TMUB /end AXIS_DESCR
/end CHARACTERISTIC
/begin CHARACTERISTIC KLATMLAE "" CURVE 0x8E0C50 GklWUb 1.992 fak_ub_b2 0.00 1.992 FORMAT "%5.3"
 /begin AXIS_DESCR COM_AXIS lamsbg_w fak_uw_b16 6 0.00 15.99976 FORMAT "%8.5" AXIS_PTS_REF SLX06TMUW /end AXIS_DESCR
/end CHARACTERISTIC
/begin CHARACTERISTIC KLATMLAE2 "" CURVE 0x8E0C56 GklWUb 1.992 fak_ub_b2 0.00 1.992 FORMAT "%5.3"
 /begin AXIS_DESCR COM_AXIS lamsbg2_w fak_uw_b16 6 0.00 15.99976 FORMAT "%8.5" AXIS_PTS_REF SLY06TMUW /end AXIS_DESCR
/end CHARACTERISTIC
/begin CHARACTERISTIC KLATMZWE "" CURVE 0x8E0C5C GklWUb 1.992 fak_ub_b2 0.00 1.992 FORMAT "%5.3"
 /begin AXIS_DESCR COM_AXIS etazwimt rel_ub_b127p5 6 0.00 127.5 FORMAT "%5.1" AXIS_PTS_REF SEZ06TMUB /end AXIS_DESCR
/end CHARACTERISTIC
/begin CHARACTERISTIC KLATMZWE2 "" CURVE 0x8E0C62 GklWUb 1.992 fak_ub_b2 0.00 1.992 FORMAT "%5.3"
 /begin AXIS_DESCR COM_AXIS etazwimt rel_ub_b127p5 6 0.00 127.5 FORMAT "%5.1" AXIS_PTS_REF SEZ06TMUB /end AXIS_DESCR
/end CHARACTERISTIC
/begin CHARACTERISTIC KLNDNWMN "" CURVE 0x8E3A75 KlAUbSstUbWUb 10200. nmot_ub_q40 0.00 10200. FORMAT "%5.0"
 /begin AXIS_DESCR STD_AXIS tmot temp_ub_q0p75_o48 6 -48.00 143.3 FORMAT "%5.1" DEPOSIT ABSOLUTE /end AXIS_DESCR
/end CHARACTERISTIC
/begin CHARACTERISTIC KOE_A0 "" VALUE 0x8FEB52 KwSw 0.1249981 fak_sw_b0p0625 -0.06250000 0.06249809 FORMAT "%10.8" /end CHARACTERISTIC
/begin CHARACTERISTIC KOE_A1 "" VALUE 0x8FEB54 KwSw 0.1249981 fak_sw_b0p0625 -0.06250000 0.06249809 FORMAT "%10.8" /end CHARACTERISTIC
/begin CHARACTERISTIC KOE_A2 "" VALUE 0x8FEB56 KwSw 0.1249981 fak_sw_b0p0625 -0.06250000 0.06249809 FORMAT "%10.8" /end CHARACTERISTIC
/begin CHARACTERISTIC KOE_B1 "" VALUE 0x8FEB58 KwSw 3.999939 fak_sw_b2 -2.000000 1.999939 FORMAT "%8.6" /end CHARACTERISTIC
/begin CHARACTERISTIC KOE_B2 "" VALUE 0x8FEB5A KwSw 3.999939 fak_sw_b2 -2.000000 1.999939 FORMAT "%8.6" /end CHARACTERISTIC
/begin CHARACTERISTIC KTNDMRKH "" VALUE 0x8EB14E KwUw 0.9999847 fak_uw_b1 0.00 0.9999847 FORMAT "%9.7" /end CHARACTERISTIC
/begin CHARACTERISTIC MLKHMX "" VALUE 0x8E247A KwUb 1020. m_ub_b1020 0.00 1020. FORMAT "%5.0" /end CHARACTERISTIC
/begin CHARACTERISTIC MLSUS "" CURVE 0x8EB150 KlAUbSstUbWUw 23.30133 m_uw_b23p3 0.00 23.30133 FORMAT "%8.5"
 /begin AXIS_DESCR STD_AXIS tmst temp_ub_q0p75_o48 12 -48.00 143.3 FORMAT "%5.1" DEPOSIT ABSOLUTE /end AXIS_DESCR
/end CHARACTERISTIC
/begin CHARACTERISTIC MSNPCV "" CURVE 0x8E233E KlAUbSstUbWUb 25.50 m_q0p1 0.00 25.50 FORMAT "%5.2"
 /begin AXIS_DESCR STD_AXIS dpspu p_ub_q10 14 0.00 2550. FORMAT "%5.0" DEPOSIT ABSOLUTE /end AXIS_DESCR
/end CHARACTERISTIC
/begin CHARACTERISTIC MTABGKH "" VALUE 0x8EB176 KwUw 1062.820 temp_q0p0234_o273 200.0063 1262.827 FORMAT "%8.3" /end CHARACTERISTIC
/begin CHARACTERISTIC NARASTGU "" CURVE 0x8E3032 FklWUb 10200. nmot_ub_q40 0.00 10200. FORMAT "%5.0"
 /begin AXIS_DESCR FIX_AXIS gangi dez 8 0.00 7.000 FORMAT "%5.3" FIX_AXIS_PAR 0 0 8 /end AXIS_DESCR
/end CHARACTERISTIC
/begin CHARACTERISTIC NARLLGA "" CURVE 0x8E303A FklWUb 10200. nmot_ub_q40 0.00 10200. FORMAT "%5.0"
 /begin AXIS_DESCR FIX_AXIS gangi dez 8 0.00 7.000 FORMAT "%5.3" FIX_AXIS_PAR 0 0 8 /end AXIS_DESCR
/end CHARACTERISTIC
/begin CHARACTERISTIC NARLLMXG "" CURVE 0x8E3042 FklWUb 10200. nmot_ub_q40 0.00 10200. FORMAT "%5.0"
 /begin AXIS_DESCR FIX_AXIS gangi dez 8 0.00 7.000 FORMAT "%5.3" FIX_AXIS_PAR 0 0 8 /end AXIS_DESCR
/end CHARACTERISTIC
/begin CHARACTERISTIC NARMXG "" CURVE 0x8E304A FklWUb 10200. nmot_ub_q40 0.00 10200. FORMAT "%5.0"
 /begin AXIS_DESCR FIX_AXIS gangi dez 8 0.00 7.000 FORMAT "%5.3" FIX_AXIS_PAR 0 0 8 /end AXIS_DESCR
/end CHARACTERISTIC
/begin CHARACTERISTIC NDFILOG "" CURVE 0x8ECC2A FklWUw 16383.75 nmot_uw_q0p25 0.00 16383.75 FORMAT "%8.2"
 /begin AXIS_DESCR FIX_AXIS gangi dez 8 0.00 7.000 FORMAT "%5.3" FIX_AXIS_PAR 0 0 8 /end AXIS_DESCR
/end CHARACTERISTIC
/begin CHARACTERISTIC NDIFFOG "" CURVE 0x8ECBD8 FklWSw 16383.75 nmot_sw_q0p25 -8192.000 8191.750 FORMAT "%8.3"
 /begin AXIS_DESCR FIX_AXIS gangi dez 8 0.00 7.000 FORMAT "%5.3" FIX_AXIS_PAR 0 0 8 /end AXIS_DESCR
/end CHARACTERISTIC
/begin CHARACTERISTIC NDLSO "" VALUE 0x8FD2AD KwUb 2550. nmot_ub_q10 0.00 2550. FORMAT "%5.0" /end CHARACTERISTIC
/begin CHARACTERISTIC NDLSU "" VALUE 0x8FD2AE KwUb 2550. nmot_ub_q10 0.00 2550. FORMAT "%5.0" /end CHARACTERISTIC
/begin CHARACTERISTIC NDNWMN "" VALUE 0x8E3A82 KwUb 10200. nmot_ub_q40 0.00 10200. FORMAT "%5.0" /end CHARACTERISTIC
/begin CHARACTERISTIC NDNWMNFA "" VALUE 0x8E3A83 KwUb 10200. nmot_ub_q40 0.00 10200. FORMAT "%5.0" /end CHARACTERISTIC
/begin CHARACTERISTIC NDNWMX "" VALUE 0x8E3A84 KwUb 10200. nmot_ub_q40 0.00 10200. FORMAT "%5.0" /end CHARACTERISTIC
/begin CHARACTERISTIC NGANGMIN "" VALUE 0x8E827C KwUw 16383.75 nmot_uw_q0p25 0.00 16383.75 FORMAT "%8.2" /end CHARACTERISTIC
/begin CHARACTERISTIC NGDNSA "" VALUE 0x8FEB3C KwSw 10239.84 nmotg_sw_q0p15625 -5120.000 5119.844 FORMAT "%8.3" /end CHARACTERISTIC
/begin CHARACTERISTIC NGDNSAL "" VALUE 0x8FEB3E KwSw 10239.84 nmotg_sw_q0p15625 -5120.000 5119.844 FORMAT "%8.3" /end CHARACTERISTIC
/begin CHARACTERISTIC NGDNWEGTR "" VALUE 0x8FEB40 KwSw 10239.84 nmotg_sw_q0p15625 -5120.000 5119.844 FORMAT "%8.3" /end CHARACTERISTIC
/begin CHARACTERISTIC NLLAD "" VALUE 0x8E247B KwUb 2550. nmot_ub_q10 0.00 2550. FORMAT "%5.0" /end CHARACTERISTIC
/begin CHARACTERISTIC NLLKT "" VALUE 0x8E247C KwUb 2550. nmot_ub_q10 0.00 2550. FORMAT "%5.0" /end CHARACTERISTIC
/begin CHARACTERISTIC NMNWSTMN "" VALUE 0x8E3A08 KwUb 10200. nmot_ub_q40 0.00 10200. FORMAT "%5.0" /end CHARACTERISTIC
/begin CHARACTERISTIC NMXDAE "" CURVE 0x8E1DDA KlAUbSstUbWUb 8160. nmot_ub_q32 0.00 8160. FORMAT "%5.0"
 /begin AXIS_DESCR STD_AXIS wped relPED_ub_b100 6 0.00 100.0 FORMAT "%5.1" DEPOSIT ABSOLUTE /end AXIS_DESCR
/end CHARACTERISTIC
/begin CHARACTERISTIC NMXMDSKA "" VALUE 0x8FE6C2 KwUw 16383.75 nmot_uw_q0p25 0.00 16383.75 FORMAT "%8.2" /end CHARACTERISTIC
/begin CHARACTERISTIC NNWMX "" VALUE 0x8E3A09 KwUb 10200. nmot_ub_q40 0.00 10200. FORMAT "%5.0" /end CHARACTERISTIC
/begin CHARACTERISTIC NNWTMN "" CURVE 0x8EED0E KlAUbSstUwWUb 10200. nmot_ub_q40 0.00 10200. FORMAT "%5.0"
 /begin AXIS_DESCR STD_AXIS toelk_w temp_q0p0234_o273 4 -273.1500 1262.827 FORMAT "%8.3" DEPOSIT ABSOLUTE /end AXIS_DESCR
/end CHARACTERISTIC
/begin CHARACTERISTIC NSAFAN "" VALUE 0x8FD185 KwUb 10200. nmot_ub_q40 0.00 10200. FORMAT "%5.0" /end CHARACTERISTIC
/begin CHARACTERISTIC NTUMTAT "" VALUE 0x8E0C68 KwUb 10200. nmot_ub_q40 0.00 10200. FORMAT "%5.0" /end CHARACTERISTIC
/begin CHARACTERISTIC NVG "" CURVE 0x8ECBE8 FklWUw 511.9922 qnv_uw_b512 0.00 511.9922 FORMAT "%8.4"
 /begin AXIS_DESCR FIX_AXIS gangi dez 8 0.00 7.000 FORMAT "%5.3" FIX_AXIS_PAR 0 0 8 /end AXIS_DESCR
/end CHARACTERISTIC
/begin CHARACTERISTIC NVMNG "" CURVE 0x8ECBF8 FklWUw 511.9922 qnv_uw_b512 0.00 511.9922 FORMAT "%8.4"
 /begin AXIS_DESCR FIX_AXIS gangi dez 8 0.00 7.000 FORMAT "%5.3" FIX_AXIS_PAR 0 0 8 /end AXIS_DESCR
/end CHARACTERISTIC
/begin CHARACTERISTIC NVMXG "" CURVE 0x8ECC08 FklWUw 511.9922 qnv_uw_b512 0.00 511.9922 FORMAT "%8.4"
 /begin AXIS_DESCR FIX_AXIS gangi dez 8 0.00 7.000 FORMAT "%5.3" FIX_AXIS_PAR 0 0 8 /end AXIS_DESCR
/end CHARACTERISTIC
/begin CHARACTERISTIC NVQUOT1O "" VALUE 0x8E827E KwUw 511.9922 qnv_uw_b512 0.00 511.9922 FORMAT "%8.4" /end CHARACTERISTIC
/begin CHARACTERISTIC NVQUOT1U "" VALUE 0x8E8280 KwUw 511.9922 qnv_uw_b512 0.00 511.9922 FORMAT "%8.4" /end CHARACTERISTIC
/begin CHARACTERISTIC NVQUOT2O "" VALUE 0x8E8282 KwUw 511.9922 qnv_uw_b512 0.00 511.9922 FORMAT "%8.4" /end CHARACTERISTIC
/begin CHARACTERISTIC NVQUOT2U "" VALUE 0x8E8284 KwUw 511.9922 qnv_uw_b512 0.00 511.9922 FORMAT "%8.4" /end CHARACTERISTIC
/begin CHARACTERISTIC NVQUOT3O "" VALUE 0x8E8286 KwUw 511.9922 qnv_uw_b512 0.00 511.9922 FORMAT "%8.4" /end CHARACTERISTIC
/begin CHARACTERISTIC NVQUOT3U "" VALUE 0x8E8288 KwUw 511.9922 qnv_uw_b512 0.00 511.9922 FORMAT "%8.4" /end CHARACTERISTIC
/begin CHARACTERISTIC NVQUOT4O "" VALUE 0x8E828A KwUw 511.9922 qnv_uw_b512 0.00 511.9922 FORMAT "%8.4" /end CHARACTERISTIC
/begin CHARACTERISTIC NVQUOT4U "" VALUE 0x8E828C KwUw 511.9922 qnv_uw_b512 0.00 511.9922 FORMAT "%8.4" /end CHARACTERISTIC
/begin CHARACTERISTIC NVQUOT5O "" VALUE 0x8E828E KwUw 511.9922 qnv_uw_b512 0.00 511.9922 FORMAT "%8.4" /end CHARACTERISTIC
/begin CHARACTERISTIC NVQUOT5U "" VALUE 0x8E8290 KwUw 511.9922 qnv_uw_b512 0.00 511.9922 FORMAT "%8.4" /end CHARACTERISTIC
/begin CHARACTERISTIC NVQUOT6O "" VALUE 0x8E8292 KwUw 511.9922 qnv_uw_b512 0.00 511.9922 FORMAT "%8.4" /end CHARACTERISTIC
/begin CHARACTERISTIC NVQUOT6U "" VALUE 0x8E8294 KwUw 511.9922 qnv_uw_b512 0.00 511.9922 FORMAT "%8.4" /end CHARACTERISTIC
/begin CHARACTERISTIC NWEGTRM "" CURVE 0x8E29A5 GklWUb 10200. nmot_ub_q40 0.00 10200. FORMAT "%5.0"
 /begin AXIS_DESCR COM_AXIS tmot temp_ub_q0p75_o48 5 -48.00 143.3 FORMAT "%5.1" AXIS_PTS_REF STM05SAUB /end AXIS_DESCR
/end CHARACTERISTIC
/begin CHARACTERISTIC NWENG "" CURVE 0x8EBB4E KlAUbSstSbWUb 10200. nmot_ub_q40 0.00 10200. FORMAT "%5.0"
 /begin AXIS_DESCR STD_AXIS ngfil nmotg_sb_q100 5 -12800. 12700. FORMAT "%5.0" DEPOSIT ABSOLUTE /end AXIS_DESCR
/end CHARACTERISTIC
/begin CHARACTERISTIC NWENGFS "" CURVE 0x8EBB5A KlAUbSstSbWUb 10200. nmot_ub_q40 0.00 10200. FORMAT "%5.0"
 /begin AXIS_DESCR STD_AXIS ngfil nmotg_sb_q100 5 -12800. 12700. FORMAT "%5.0" DEPOSIT ABSOLUTE /end AXIS_DESCR
/end CHARACTERISTIC
/begin CHARACTERISTIC NWKHFHO "" CURVE 0x8EB178 KlAUbSstUbWUb 1.992 fak_q0p0078 0.00 1.992 FORMAT "%5.3"
 /begin AXIS_DESCR STD_AXIS fho fak_ub_b4 4 0.00 3.984 FORMAT "%5.3" DEPOSIT ABSOLUTE /end AXIS_DESCR
/end CHARACTERISTIC
/begin CHARACTERISTIC PEKP "" VALUE 0x8E3FD9 KwUb 25.50 vs_q0p1 0.00 25.50 FORMAT "%5.2" /end CHARACTERISTIC
/begin CHARACTERISTIC RALEZMAX "" VALUE 0x8FCE0D KwUb 127.0 dez 0.00 127.0 FORMAT "%5.1" /end CHARACTERISTIC
/begin CHARACTERISTIC REDABM "" MAP 0x8FCFDA FkfNoShNoOffWUb 255.0 dez 0.00 255.0 FORMAT "%5.1"
 /begin AXIS_DESCR FIX_AXIS evrbgn_one dez 6 0.00 5.000 FORMAT "%5.3" FIX_AXIS_PAR 0 0 6 /end AXIS_DESCR
 /begin AXIS_DESCR FIX_AXIS redsol_one dez 6 0.00 5.000 FORMAT "%5.3" FIX_AXIS_PAR 0 0 6 /end AXIS_DESCR
/end CHARACTERISTIC
/begin AXIS_PTS SEZ06TMUB "" 0x8E0094 etazwimt SstAUbSstUb 127.5 rel_ub_b127p5 6 0.00 127.5 FORMAT "%5.1" DEPOSIT ABSOLUTE /end AXIS_PTS
/begin CHARACTERISTIC SFZARMD "" VALUE 0x8FEB5C KwUw 65535.00 dez 0.00 65535.00 FORMAT "%8.2" /end CHARACTERISTIC
/begin AXIS_PTS SGA06MDUB "" 0x8E5974 gangi SstAUbSstUb 255.0 dez 6 0.00 255.0 FORMAT "%5.1" DEPOSIT ABSOLUTE /end AXIS_PTS
/begin AXIS_PTS SGA08MDUB "" 0x8E01C9 gangi SstAUbSstUb 255.0 dez 8 0.00 255.0 FORMAT "%5.1" DEPOSIT ABSOLUTE /end AXIS_PTS
/begin AXIS_PTS SLX06TMUW "" 0x8E598A lamsbg_w SstAUwSstUw 15.99976 fak_uw_b16 6 0.00 15.99976 FORMAT "%8.5" DEPOSIT ABSOLUTE /end AXIS_PTS
/begin AXIS_PTS SLY06TMUW "" 0x8E5998 lamsbg2_w SstAUwSstUw 15.99976 fak_uw_b16 6 0.00 15.99976 FORMAT "%8.5" DEPOSIT ABSOLUTE /end AXIS_PTS
/begin AXIS_PTS SMK08MDSW "" 0x8ECC18 mkar_w SstASwSstSw 199.9969 rel_sw_b100 8 -100.0000 99.99695 FORMAT "%8.4" DEPOSIT ABSOLUTE /end AXIS_PTS
/begin AXIS_PTS SML06TMUW "" 0x8E59CA ml_w SstAUwSstUw 6553.500 m_uw_b6553p5 6 0.00 6553.500 FORMAT "%8.3" DEPOSIT ABSOLUTE /end AXIS_PTS
/begin AXIS_PTS SML07TMUW "" 0x8E59D8 ml_w SstAUwSstUw 6553.500 m_uw_b6553p5 7 0.00 6553.500 FORMAT "%8.3" DEPOSIT ABSOLUTE /end AXIS_PTS
/begin AXIS_PTS SMT06TMUW "" 0x8E59E8 ml_w SstAUwSstUw 6553.500 m_uw_b6553p5 6 0.00 6553.500 FORMAT "%8.3" DEPOSIT ABSOLUTE /end AXIS_PTS
/begin AXIS_PTS SNM08SAUB "" 0x8EBB1C nmot SstAUwSstUw 10200. nmot_ub_q40 8 0.00 10200. FORMAT "%5.0" DEPOSIT ABSOLUTE /end AXIS_PTS
/begin AXIS_PTS ST107TMUB "" 0x8E0145 tabgmst SstAUbSstUb 1275. temp_ub_q5_o50 7 -50.00 1225. FORMAT "%5.0" DEPOSIT ABSOLUTE /end AXIS_PTS
/begin AXIS_PTS ST207TMUB "" 0x8E014D tabgmst2 SstAUbSstUb 1275. temp_ub_q5_o50 7 -50.00 1225. FORMAT "%5.0" DEPOSIT ABSOLUTE /end AXIS_PTS
/begin AXIS_PTS ST307TMUB "" 0x8E0155 tkatmst SstAUbSstUb 1275. temp_ub_q5_o50 7 -50.00 1225. FORMAT "%5.0" DEPOSIT ABSOLUTE /end AXIS_PTS
/begin AXIS_PTS ST407TMUB "" 0x8E015D tkatmst2 SstAUbSstUb 1275. temp_ub_q5_o50 7 -50.00 1225. FORMAT "%5.0" DEPOSIT ABSOLUTE /end AXIS_PTS
/begin AXIS_PTS STK04SAUB "" 0x8E016C tkatm SstAUbSstUb 1275. temp_ub_q5_o50 4 -50.00 1225. FORMAT "%5.0" DEPOSIT ABSOLUTE /end AXIS_PTS
/begin AXIS_PTS STM05SAUB "" 0x8E0176 tmot SstAUbSstUb 191.3 temp_ub_q0p75_o48 5 -48.00 143.3 FORMAT "%5.1" DEPOSIT ABSOLUTE /end AXIS_PTS
/begin AXIS_PTS STM05TMUB "" 0x8E017C tmst SstAUbSstUb 191.3 temp_ub_q0p75_o48 5 -48.00 143.3 FORMAT "%5.1" DEPOSIT ABSOLUTE /end AXIS_PTS
/begin AXIS_PTS STS06TMUW "" 0x8E7F46 tabstatm_w SstAUwSstUw 65535.00 t1sxs_uw_q1 6 0.00 65535.00 FORMAT "%8.2" DEPOSIT ABSOLUTE /end AXIS_PTS
/begin AXIS_PTS STU05TMUB "" 0x8E0C69 tatu SstAUbSstUb 191.3 temp_ub_q0p75_o48 5 -48.00 143.3 FORMAT "%5.1" DEPOSIT ABSOLUTE /end AXIS_PTS
/begin AXIS_PTS SUV07MDUB "" 0x8E01BC uefktget SstAUbSstUb 25.50 uefktget_ub_b25p4 7 0.00 25.50 FORMAT "%5.2" DEPOSIT ABSOLUTE /end AXIS_PTS
/begin CHARACTERISTIC TABGMEX "" VALUE 0x8E0C6F KwUb 1275. temp_ub_q5_o50 -50.00 1225. FORMAT "%5.0" /end CHARACTERISTIC
/begin CHARACTERISTIC TABSTKH "" VALUE 0x8EB182 KwUw 65535.00 t1sxs_uw_b65535 0.00 65535.00 FORMAT "%8.2" /end CHARACTERISTIC
/begin CHARACTERISTIC TAHRLSUMX "" VALUE 0x8FED1A KwUw 199.9969 rel_uw_b200 0.00 199.9969 FORMAT "%8.4" /end CHARACTERISTIC
/begin CHARACTERISTIC TANW "" VALUE 0x8E3A0A KwUb 191.3 temp_ub_q0p75_o48 -48.00 143.3 FORMAT "%5.1" /end CHARACTERISTIC
/begin CHARACTERISTIC TAPVLTM "" CURVE 0x8F110C KlAUbSstUbWUw 65535.00 t1sxs_uw_q1 0.00 65535.00 FORMAT "%8.2"
 /begin AXIS_DESCR STD_AXIS tmotab temp_ub_q0p75_o48 4 -48.00 143.3 FORMAT "%5.1" DEPOSIT ABSOLUTE /end AXIS_DESCR
/end CHARACTERISTIC
/begin CHARACTERISTIC TAREIN "" VALUE 0x8FD1B5 KwUb 2.550 t10msxs_ub_b2p55 0.00 2.550 FORMAT "%5.3" /end CHARACTERISTIC
/begin CHARACTERISTIC TASTBFA "" VALUE 0x8E0C70 KwUb 1275. temp_ub_q5_o50 -50.00 1225. FORMAT "%5.0" /end CHARACTERISTIC
/begin CHARACTERISTIC TATEGMX "" VALUE 0x8EEBF6 KwUw 99.99847 rel_uw_b100 0.00 99.99847 FORMAT "%8.5" /end CHARACTERISTIC
/begin CHARACTERISTIC TATEGRDO "" VALUE 0x8E38FA KwUb 99.61 rel_ub_b99p6 0.00 99.61 FORMAT "%5.2" /end CHARACTERISTIC
/begin CHARACTERISTIC TATEGRDU "" VALUE 0x8E38FB KwUb 99.61 rel_ub_b99p6 0.00 99.61 FORMAT "%5.2" /end CHARACTERISTIC
/begin CHARACTERISTIC TATEMSN "" CURVE 0x8EEBF8 KlAUwSstUwWUw 99.99847 rel_uw_b100 0.00 99.99847 FORMAT "%8.5"
 /begin AXIS_DESCR STD_AXIS msntev_w m_uw_b25p6 10 0.00 25.59961 FORMAT "%8.5" DEPOSIT ABSOLUTE /end AXIS_DESCR
/end CHARACTERISTIC
/begin CHARACTERISTIC TATMKH "" VALUE 0x8E0C71 KwUb 1275. temp_q5 0.00 1275. FORMAT "%5.0" /end CHARACTERISTIC
/begin CHARACTERISTIC TATMKH2 "" VALUE 0x8E0C72 KwUb 1275. temp_q5 0.00 1275. FORMAT "%5.0" /end CHARACTERISTIC
/begin CHARACTERISTIC TATMKRSA "" VALUE 0x8E0C73 KwUb 1275. temp_ub_q5_o50 -50.00 1225. FORMAT "%5.0" /end CHARACTERISTIC
/begin CHARACTERISTIC TATMKW "" VALUE 0x8E0C74 KwUb 1275. temp_q5 0.00 1275. FORMAT "%5.0" /end CHARACTERISTIC
/begin CHARACTERISTIC TATMSA "" VALUE 0x8E0C75 KwUb 1275. temp_ub_q5_o50 -50.00 1225. FORMAT "%5.0" /end CHARACTERISTIC
/begin CHARACTERISTIC TATMSAE "" VALUE 0x8E0C76 KwUb 1275. temp_ub_q5_o50 -50.00 1225. FORMAT "%5.0" /end CHARACTERISTIC
/begin CHARACTERISTIC TATMSAE2 "" VALUE 0x8E0C77 KwUb 1275. temp_ub_q5_o50 -50.00 1225. FORMAT "%5.0" /end CHARACTERISTIC
/begin CHARACTERISTIC TATMSTI "" VALUE 0x8E0C78 KwUb 1275. temp_ub_q5_o50 -50.00 1225. FORMAT "%5.0" /end CHARACTERISTIC
/begin CHARACTERISTIC TATMTMOT "" VALUE 0x8E0C79 KwUb 191.3 temp_ub_q0p75_o48 -48.00 143.3 FORMAT "%5.1" /end CHARACTERISTIC
/begin CHARACTERISTIC TATMTP "" VALUE 0x8E0C7A KwUb 1275. temp_ub_q5_o50 -50.00 1225. FORMAT "%5.0" /end CHARACTERISTIC
/begin CHARACTERISTIC TATMTRKH "" VALUE 0x8E0C7B KwUb 1275. temp_q5 0.00 1275. FORMAT "%5.0" /end CHARACTERISTIC
/begin CHARACTERISTIC TATMTRKH2 "" VALUE 0x8E0C7C KwUb 1275. temp_q5 0.00 1275. FORMAT "%5.0" /end CHARACTERISTIC
/begin CHARACTERISTIC TATMWMK "" VALUE 0x8E0C7D KwSb 1275. temp_q5 -640.0 635.0 FORMAT "%5.1" /end CHARACTERISTIC
/begin CHARACTERISTIC TAVHKSAO "" VALUE 0x8EBB2E KwUw 1535.977 temp_q0p0234_o273 -273.1500 1262.827 FORMAT "%8.3" /end CHARACTERISTIC
/begin CHARACTERISTIC TAVVKSAO "" VALUE 0x8EBB30 KwUw 1535.977 temp_q0p0234_o273 -273.1500 1262.827 FORMAT "%8.3" /end CHARACTERISTIC
/begin CHARACTERISTIC TDBKVSTEND "" VALUE 0x8E3FF5 KwUb 2.550 t10msxs_ub_b2p55 0.00 2.550 FORMAT "%5.3" /end CHARACTERISTIC
/begin CHARACTERISTIC TDDEDBKVP "" VALUE 0x8EFFFA KwUw 1310.700 t20msxs_uw_q0p02 0.00 1310.700 FORMAT "%8.3" /end CHARACTERISTIC
/begin CHARACTERISTIC TDKLAGDE "" VALUE 0x8FCF70 KwUb 5.100 t20msxs_ub_b5p1 0.00 5.100 FORMAT "%5.3" /end CHARACTERISTIC
/begin CHARACTERISTIC TDLRHAFTMX "" VALUE 0x8E0E9A KwUb 12.75 t50msxs_q0p05 0.00 12.75 FORMAT "%5.2" /end CHARACTERISTIC
/begin CHARACTERISTIC TDLRPIDC "" VALUE 0x8FDD0A KwUw 655.3500 t10msxs_uw_b655p35 0.00 655.3500 FORMAT "%8.4" /end CHARACTERISTIC
/begin CHARACTERISTIC TDTABGMK "" VALUE 0x8E247D KwUb 254.996 zk1sxs_ub_b255 1.00392 256.000 FORMAT "%7.3" /end CHARACTERISTIC
/begin CHARACTERISTIC THYNWMN "" VALUE 0x8EED1C KwUw 1535.977 temp_q0p0234 0.00 1535.977 FORMAT "%8.3" /end CHARACTERISTIC
/begin CHARACTERISTIC TIKATMOE "" VALUE 0x8E0C7E KwSb 1275. temp_q5 -640.0 635.0 FORMAT "%5.1" /end CHARACTERISTIC
/begin CHARACTERISTIC TKATMN "" VALUE 0x8E247E KwUb 1275. temp_ub_q5_o50 -50.00 1225. FORMAT "%5.0" /end CHARACTERISTIC
/begin CHARACTERISTIC TKATMOE "" VALUE 0x8E0C7F KwSb 1275. temp_q5 -640.0 635.0 FORMAT "%5.1" /end CHARACTERISTIC
/begin CHARACTERISTIC TKATSA "" VALUE 0x8E29AA KwUb 1275. temp_ub_q5_o50 -50.00 1225. FORMAT "%5.0" /end CHARACTERISTIC
/begin CHARACTERISTIC TKATW "" VALUE 0x8E247F KwUb 1275. temp_ub_q5_o50 -50.00 1225. FORMAT "%5.0" /end CHARACTERISTIC
/begin CHARACTERISTIC TKD "" VALUE 0x8FCE97 KwUb 2.550 t10msxs_ub_b2p55 0.00 2.550 FORMAT "%5.3" /end CHARACTERISTIC
/begin CHARACTERISTIC TKHABB "" VALUE 0x8E2480 KwUb 25.50 t100msxs_ub_b25p5 0.00 25.50 FORMAT "%5.2" /end CHARACTERISTIC
/begin CHARACTERISTIC TKHFSAB "" VALUE 0x8EB184 KwUw 6553.500 t100msxs_uw_b6553p5 0.00 6553.500 FORMAT "%8.3" /end CHARACTERISTIC
/begin CHARACTERISTIC TKHLL "" VALUE 0x8EB186 KwUw 6553.500 t100msxs_uw_b6553p5 0.00 6553.500 FORMAT "%8.3" /end CHARACTERISTIC
/begin CHARACTERISTIC TKHLLAB "" VALUE 0x8E2481 KwUb 25.50 t100msxs_ub_b25p5 0.00 25.50 FORMAT "%5.2" /end CHARACTERISTIC
/begin CHARACTERISTIC TKHLLMX "" VALUE 0x8EB188 KwUw 655.3500 t10msxs_uw_b655p35 0.00 655.3500 FORMAT "%8.4" /end CHARACTERISTIC
/begin CHARACTERISTIC TKHMX "" VALUE 0x8EB18A KwUw 655.3500 t10msxs_uw_b655p35 0.00 655.3500 FORMAT "%8.4" /end CHARACTERISTIC
/begin CHARACTERISTIC TKHNAB "" VALUE 0x8EB18C KwUw 6553.500 t100msxs_uw_b6553p5 0.00 6553.500 FORMAT "%8.3" /end CHARACTERISTIC
/begin CHARACTERISTIC TKIHKSAO "" VALUE 0x8EBB32 KwUw 1535.977 temp_q0p0234_o273 -273.1500 1262.827 FORMAT "%8.3" /end CHARACTERISTIC
/begin CHARACTERISTIC TKSTBFA "" VALUE 0x8E0C80 KwUb 1275. temp_ub_q5_o50 -50.00 1225. FORMAT "%5.0" /end CHARACTERISTIC
/begin CHARACTERISTIC TLKD "" VALUE 0x8FDC86 KwUw 655.3500 t10msxs_uw_b655p35 0.00 655.3500 FORMAT "%8.4" /end CHARACTERISTIC
/begin CHARACTERISTIC TMAR "" VALUE 0x8FD1B6 KwUb 191.3 temp_ub_q0p75_o48 -48.00 143.3 FORMAT "%5.1" /end CHARACTERISTIC
/begin CHARACTERISTIC TMDNWMN "" VALUE 0x8E3A85 KwUb 191.3 temp_ub_q0p75_o48 -48.00 143.3 FORMAT "%5.1" /end CHARACTERISTIC
/begin CHARACTERISTIC TMDNWMX "" VALUE 0x8E3A86 KwUb 191.3 temp_ub_q0p75_o48 -48.00 143.3 FORMAT "%5.1" /end CHARACTERISTIC
/begin CHARACTERISTIC TMESP "" VALUE 0x8FCF78 KwUb 191.3 temp_ub_q0p75_o48 -48.00 143.3 FORMAT "%5.1" /end CHARACTERISTIC
/begin CHARACTERISTIC TMLAST "" VALUE 0x8FD1B7 KwUb 2.550 t10msxs_ub_b2p55 0.00 2.550 FORMAT "%5.3" /end CHARACTERISTIC
/begin CHARACTERISTIC TMNWKH "" VALUE 0x8E3A0B KwUb 191.3 temp_ub_q0p75_o48 -48.00 143.3 FORMAT "%5.1" /end CHARACTERISTIC
/begin CHARACTERISTIC TMNWMN "" VALUE 0x8E3A0C KwUb 191.3 temp_ub_q0p75_o48 -48.00 143.3 FORMAT "%5.1" /end CHARACTERISTIC
/begin CHARACTERISTIC TMNWMX "" VALUE 0x8E3A0D KwUb 191.3 temp_ub_q0p75_o48 -48.00 143.3 FORMAT "%5.1" /end CHARACTERISTIC
/begin CHARACTERISTIC TMNWST "" VALUE 0x8E3A0E KwUb 191.3 temp_ub_q0p75_o48 -48.00 143.3 FORMAT "%5.1" /end CHARACTERISTIC
/begin CHARACTERISTIC TMSKS "" VALUE 0x8E235B KwUb 191.3 temp_ub_q0p75_o48 -48.00 143.3 FORMAT "%5.1" /end CHARACTERISTIC
/begin CHARACTERISTIC TMSLOF "" VALUE 0x8E2482 KwUb 191.3 temp_ub_q0p75_o48 -48.00 143.3 FORMAT "%5.1" /end CHARACTERISTIC
/begin CHARACTERISTIC TMSTABO "" CURVE 0x8E235C KlAUbSstUbWUb 255.0 dez 0.00 255.0 FORMAT "%5.1"
 /begin AXIS_DESCR STD_AXIS tmst temp_ub_q0p75_o48 4 -48.00 143.3 FORMAT "%5.1" DEPOSIT ABSOLUTE /end AXIS_DESCR
/end CHARACTERISTIC
/begin CHARACTERISTIC TMTKS "" VALUE 0x8E2365 KwUb 191.3 temp_ub_q0p75_o48 -48.00 143.3 FORMAT "%5.1" /end CHARACTERISTIC
/begin CHARACTERISTIC TMZUB2MX "" VALUE 0x8FCD24 KwUb 191.3 temp_ub_q0p75_o48 -48.00 143.3 FORMAT "%5.1" /end CHARACTERISTIC
/begin CHARACTERISTIC TNLATM "" VALUE 0x8E7F54 KwUw 65535.00 t1sxs_uw_q1 0.00 65535.00 FORMAT "%8.2" /end CHARACTERISTIC
/begin CHARACTERISTIC TNLATMTM "" VALUE 0x8E0C81 KwUb 191.3 temp_ub_q0p75_o48 -48.00 143.3 FORMAT "%5.1" /end CHARACTERISTIC
/begin CHARACTERISTIC TNLATMTU "" VALUE 0x8E0C82 KwUb 191.3 temp_ub_q0p75_o48 -48.00 143.3 FORMAT "%5.1" /end CHARACTERISTIC
/begin CHARACTERISTIC TNLEKPVL "" VALUE 0x8F111A KwUw 6553.500 t100msxs_uw_b6553p6 0.00 6553.500 FORMAT "%8.3" /end CHARACTERISTIC
/begin CHARACTERISTIC TNLZOFF "" VALUE 0x8FD046 KwUb 2.550 t10msxs_ub_b2p55 0.00 2.550 FORMAT "%5.3" /end CHARACTERISTIC
/begin CHARACTERISTIC TNSAFAN "" VALUE 0x8E29AB KwUb 51.00 t200msxs_ub_b51 0.00 51.00 FORMAT "%5.2" /end CHARACTERISTIC
/begin CHARACTERISTIC TNSDMRKH "" VALUE 0x8EB18E KwUw 655.3500 t10msxs_uw_b655p35 0.00 655.3500 FORMAT "%8.4" /end CHARACTERISTIC
/begin CHARACTERISTIC TNWDSTEND "" VALUE 0x8EF25E KwUw 655.3500 t10msxs_uw_b655p35 0.00 655.3500 FORMAT "%8.4" /end CHARACTERISTIC
/begin CHARACTERISTIC TOELDNWMN "" VALUE 0x8EF260 KwUw 1535.977 temp_q0p0234_o273 -273.1500 1262.827 FORMAT "%8.3" /end CHARACTERISTIC
/begin CHARACTERISTIC TOELDNWMX "" VALUE 0x8EF262 KwUw 1535.977 temp_q0p0234_o273 -273.1500 1262.827 FORMAT "%8.3" /end CHARACTERISTIC
/begin CHARACTERISTIC TOELNWEMN "" VALUE 0x8EED1E KwUw 1535.977 temp_q0p0234_o273 -273.1500 1262.827 FORMAT "%8.3" /end CHARACTERISTIC
/begin CHARACTERISTIC TOELNWEMX "" VALUE 0x8EED20 KwUw 1535.977 temp_q0p0234_o273 -273.1500 1262.827 FORMAT "%8.3" /end CHARACTERISTIC
/begin CHARACTERISTIC TOELNWMN "" VALUE 0x8EED22 KwUw 1535.977 temp_q0p0234_o273 -273.1500 1262.827 FORMAT "%8.3" /end CHARACTERISTIC
/begin CHARACTERISTIC TOELNWMX "" VALUE 0x8EED24 KwUw 1535.977 temp_q0p0234_o273 -273.1500 1262.827 FORMAT "%8.3" /end CHARACTERISTIC
/begin CHARACTERISTIC TPHRLSU "" VALUE 0x8EE7B2 KwUw 1.048560 t100msxs_q16Em6 0.00 1.048560 FORMAT "%8.6" /end CHARACTERISTIC
/begin CHARACTERISTIC TPWRSV "" VALUE 0x8FDD0C KwUw 655.3500 t10msxs_uw_b655p35 0.00 655.3500 FORMAT "%8.4" /end CHARACTERISTIC
/begin CHARACTERISTIC TRD "" VALUE 0x8FCE0E KwUb 100.0 t1msxms_q1 0.00 100.0 FORMAT "%5.1" /end CHARACTERISTIC
/begin CHARACTERISTIC TSPAK "" VALUE 0x8E4DF4 KwUb 25.50 t100msxs_ub_b25p5 0.00 25.50 FORMAT "%5.2" /end CHARACTERISTIC
/begin CHARACTERISTIC TSPAKST "" VALUE 0x8E4DF5 KwUb 25.50 t100msxs_ub_b25p5 0.00 25.50 FORMAT "%5.2" /end CHARACTERISTIC
/begin CHARACTERISTIC TUMTAIT "" VALUE 0x8E0C83 KwUb 191.3 temp_ub_q0p75_o48 -48.00 143.3 FORMAT "%5.1" /end CHARACTERISTIC
/begin CHARACTERISTIC TVARS "" VALUE 0x8FD1B8 KwUb 2.550 t10msxs_ub_b2p55 0.00 2.550 FORMAT "%5.3" /end CHARACTERISTIC
/begin CHARACTERISTIC TVARSA "" VALUE 0x8FD1B9 KwUb 2.550 t10msxs_ub_b2p55 0.00 2.550 FORMAT "%5.3" /end CHARACTERISTIC
/begin CHARACTERISTIC TVARSS "" VALUE 0x8FD1BA KwUb 2.550 t10msxs_ub_b2p55 0.00 2.550 FORMAT "%5.3" /end CHARACTERISTIC
/begin CHARACTERISTIC TVKUPAR "" VALUE 0x8FD1BB KwUb 5.100 t20msxs_ub_b5p1 0.00 5.100 FORMAT "%5.3" /end CHARACTERISTIC
/begin CHARACTERISTIC TVKUPGW "" VALUE 0x8FD1BC KwUb 2.550 t10msxs_ub_b2p55 0.00 2.550 FORMAT "%5.3" /end CHARACTERISTIC
/begin CHARACTERISTIC TVKUPHS "" CURVE 0x8E3052 FklWUb 2.550 t10msxs_ub_b2p55 0.00 2.550 FORMAT "%5.3"
 /begin AXIS_DESCR FIX_AXIS gangi dez 8 0.00 7.000 FORMAT "%5.3" FIX_AXIS_PAR 0 0 8 /end AXIS_DESCR
/end CHARACTERISTIC
/begin CHARACTERISTIC TVKUPRS "" CURVE 0x8E305A FklWUb 2.550 t10msxs_ub_b2p55 0.00 2.550 FORMAT "%5.3"
 /begin AXIS_DESCR FIX_AXIS gangi dez 8 0.00 7.000 FORMAT "%5.3" FIX_AXIS_PAR 0 0 8 /end AXIS_DESCR
/end CHARACTERISTIC
/begin CHARACTERISTIC TVNWGE "" VALUE 0x8E3A0F KwUb 12.75 t50msxs_ub_b12p75 0.00 12.75 FORMAT "%5.2" /end CHARACTERISTIC
/begin CHARACTERISTIC TVNWSTNMTM "" CURVE 0x8EED26 KlAUwSstUwWUw 3276.750 t50msxs_uw_b3276p75 0.00 3276.750 FORMAT "%8.3"
 /begin AXIS_DESCR STD_AXIS tmot temp_ub_q0p75_o48 4 -48.00 143.3 FORMAT "%5.1" DEPOSIT ABSOLUTE /end AXIS_DESCR
/end CHARACTERISTIC
/begin CHARACTERISTIC TVNWSTTM "" CURVE 0x8EED38 KlAUbSstUbWUw 655.3500 t10msxs_uw_b655p35 0.00 655.3500 FORMAT "%8.4"
 /begin AXIS_DESCR STD_AXIS tmot temp_ub_q0p75_o48 4 -48.00 143.3 FORMAT "%5.1" DEPOSIT ABSOLUTE /end AXIS_DESCR
/end CHARACTERISTIC
/begin CHARACTERISTIC TVREABO "" VALUE 0x8E2366 KwUb 25.50 t100msxs_ub_b25p5 0.00 25.50 FORMAT "%5.2" /end CHARACTERISTIC
/begin CHARACTERISTIC TVSABFA "" VALUE 0x8FEB42 KwUw 655.3500 t10msxs_uw_b655p35 0.00 655.3500 FORMAT "%8.4" /end CHARACTERISTIC
/begin CHARACTERISTIC TVSABTE "" VALUE 0x8FEB44 KwUw 655.3500 t10msxs_uw_b655p35 0.00 655.3500 FORMAT "%8.4" /end CHARACTERISTIC
/begin CHARACTERISTIC TVSATM "" CURVE 0x8EBB34 KlAUwSstUwWUw 655.3500 t10msxs_uw_b655p35 0.00 655.3500 FORMAT "%8.4"
 /begin AXIS_DESCR STD_AXIS tmst temp_ub_q0p75_o48 6 -48.00 143.3 FORMAT "%5.1" DEPOSIT ABSOLUTE /end AXIS_DESCR
/end CHARACTERISTIC
/begin CHARACTERISTIC TVTEVPS "" CURVE 0x8E38FC KlAUbSstUbWUb 127.5 t500usxms_ub_q0p5 0.00 127.5 FORMAT "%5.1"
 /begin AXIS_DESCR STD_AXIS pspu fak_ub_b2 5 0.00 1.992 FORMAT "%5.3" DEPOSIT ABSOLUTE /end AXIS_DESCR
/end CHARACTERISTIC
/begin CHARACTERISTIC TWDKNL "" VALUE 0x8E0E9B KwUb 25.50 t100msxs_ub_b25p5 0.00 25.50 FORMAT "%5.2" /end CHARACTERISTIC
/begin CHARACTERISTIC TZMIN "" VALUE 0x8E3FDA KwUb 2.550 t10msxs_ub_b2p55 0.00 2.550 FORMAT "%5.3" /end CHARACTERISTIC
/begin CHARACTERISTIC TZSPINI "" VALUE 0x8FD1BD KwUb 2.550 t10msxs_ub_b2p55 0.00 2.550 FORMAT "%5.3" /end CHARACTERISTIC
/begin CHARACTERISTIC TZZMX "" VALUE 0x8E3FDB KwUb 2.550 t10msxs_ub_b2p55 0.00 2.550 FORMAT "%5.3" /end CHARACTERISTIC
/begin CHARACTERISTIC UBALSUMX "" VALUE 0x8FD275 KwUb 25.50 spg_q0p1 0.00 25.50 FORMAT "%5.2" /end CHARACTERISTIC
/begin CHARACTERISTIC UBSQBKVMN "" VALUE 0x8E3FF6 KwUb 25.50 spg_q0p1 0.00 25.50 FORMAT "%5.2" /end CHARACTERISTIC
/begin CHARACTERISTIC UBSQBKVMX "" VALUE 0x8E3FF7 KwUb 25.50 spg_q0p1 0.00 25.50 FORMAT "%5.2" /end CHARACTERISTIC
/begin CHARACTERISTIC UBSTS "" VALUE 0x8E3FDC KwUb 25.50 spg_q0p1 0.00 25.50 FORMAT "%5.2" /end CHARACTERISTIC
/begin CHARACTERISTIC UDKNLPTOL "" VALUE 0x8FDD0E KwUw 79.99878 spg_uw_q0p001222 0.00 79.99878 FORMAT "%8.5" /end CHARACTERISTIC
/begin CHARACTERISTIC UPWGKDMN "" VALUE 0x8FDC88 KwUw 319.9951 spg_uw_q0p00488 0.00 319.9951 FORMAT "%8.4" /end CHARACTERISTIC
/begin CHARACTERISTIC UPWGKDMX "" VALUE 0x8FDC8A KwUw 319.9951 spg_uw_q0p00488 0.00 319.9951 FORMAT "%8.4" /end CHARACTERISTIC
/begin CHARACTERISTIC UPWGKDO "" VALUE 0x8E82A2 KwUw 319.9951 spg_uw_q0p00488 0.00 319.9951 FORMAT "%8.4" /end CHARACTERISTIC
/begin CHARACTERISTIC UPWGKDU "" VALUE 0x8E82A4 KwUw 319.9951 spg_uw_q0p00488 0.00 319.9951 FORMAT "%8.4" /end CHARACTERISTIC
/begin CHARACTERISTIC UPWKDDF "" VALUE 0x8FDC8C KwUw 319.9951 spg_uw_q0p00488 0.00 319.9951 FORMAT "%8.4" /end CHARACTERISTIC
/begin CHARACTERISTIC USVKKS "" VALUE 0x8EAE34 KwUw 319.9951 spg_q0p00488 0.00 319.9951 FORMAT "%8.4" /end CHARACTERISTIC
/begin CHARACTERISTIC VARAU "" VALUE 0x8FD1BE KwUb 317.5 fak_ub_b318p75 0.00 317.5 FORMAT "%5.1" /end CHARACTERISTIC
/begin CHARACTERISTIC VKSTEBF "" VALUE 0x8F111C KwUw 6553.500 vol_q0p1 0.00 6553.500 FORMAT "%8.3" /end CHARACTERISTIC
/begin CHARACTERISTIC VKSTPVLAB "" CURVE 0x8F111E KlAUwSstUwWUw 6553.500 vol_q0p1 0.00 6553.500 FORMAT "%8.3"
 /begin AXIS_DESCR STD_AXIS tabst_w t1sxs_uw_q1 4 0.00 65535.00 FORMAT "%8.2" DEPOSIT ABSOLUTE /end AXIS_DESCR
/end CHARACTERISTIC
/begin CHARACTERISTIC VKSTPVLNL "" VALUE 0x8F1130 KwUw 6553.500 vol_q0p1 0.00 6553.500 FORMAT "%8.3" /end CHARACTERISTIC
/begin CHARACTERISTIC VLLABKL "" VALUE 0x8FEFBA KwUb 318.8 vfzg_ub_q1p25 0.00 318.8 FORMAT "%5.1" /end CHARACTERISTIC
/begin CHARACTERISTIC VOABKL "" VALUE 0x8FEFBB KwUb 318.8 vfzg_ub_q1p25 0.00 318.8 FORMAT "%5.1" /end CHARACTERISTIC
/begin CHARACTERISTIC VSAA "" VALUE 0x8FD186 KwUb 318.8 vfzg_ub_q1p25 0.00 318.8 FORMAT "%5.1" /end CHARACTERISTIC
/begin CHARACTERISTIC VTUMTAT "" VALUE 0x8E0C84 KwUb 318.8 vfzg_ub_q1p25 0.00 318.8 FORMAT "%5.1" /end CHARACTERISTIC
/begin CHARACTERISTIC VUABKL "" VALUE 0x8FEFBC KwUb 318.8 vfzg_ub_q1p25 0.00 318.8 FORMAT "%5.1" /end CHARACTERISTIC
/begin CHARACTERISTIC VWE "" VALUE 0x8FD187 KwUb 318.8 vfzg_ub_q1p25 0.00 318.8 FORMAT "%5.1" /end CHARACTERISTIC
/begin CHARACTERISTIC WDKBEWS "" VALUE 0x8FDD10 KwSw 1599.976 relDK_q0p02441 -800.0000 799.9756 FORMAT "%8.4" /end CHARACTERISTIC
/begin CHARACTERISTIC WDKNLPTOL "" VALUE 0x8FDD12 KwUw 100.0000 relDK_uw_b100 0.00 100.0000 FORMAT "%8.4" /end CHARACTERISTIC
/begin CHARACTERISTIC WDKREIB "" VALUE 0x8FCF71 KwUb 0.9961 fak_ub_b1 0.00 0.9961 /end CHARACTERISTIC
/begin CHARACTERISTIC WDKSAPNOL "" VALUE 0x8FDD14 KwUw 99.99847 relDK_q0p00152 0.00 99.99847 FORMAT "%8.5" /end CHARACTERISTIC
/begin CHARACTERISTIC WDKSTFEIN "" VALUE 0x8FDD16 KwSw 1599.976 relDK_q0p02441 -800.0000 799.9756 FORMAT "%8.4" /end CHARACTERISTIC
/begin CHARACTERISTIC WDKSTGROB "" VALUE 0x8FDD18 KwSw 1599.976 relDK_q0p02441 -800.0000 799.9756 FORMAT "%8.4" /end CHARACTERISTIC
/begin CHARACTERISTIC WEESTSM "" CURVE 0x8E0EB2 KlAUbSstUbWUb 717.2 kw_q2p8125 0.00 717.2 FORMAT "%5.1"
 /begin AXIS_DESCR STD_AXIS tmot temp_ub_q0p75_o48 6 -48.00 143.3 FORMAT "%5.1" DEPOSIT ABSOLUTE /end AXIS_DESCR
/end CHARACTERISTIC
/begin CHARACTERISTIC WESSTO "" VALUE 0x8FCF79 KwUb 717.2 kw_q2p8125 0.00 717.2 FORMAT "%5.1" /end CHARACTERISTIC
/begin CHARACTERISTIC WMABGKH "" VALUE 0x8E0C85 KwUb 1.000 fak_ub_b2 0.00 1.000 FORMAT "%5.3" /end CHARACTERISTIC
/begin CHARACTERISTIC WMABGKH2 "" VALUE 0x8E0C86 KwUb 1.000 fak_ub_b2 0.00 1.000 FORMAT "%5.3" /end CHARACTERISTIC
/begin CHARACTERISTIC WMKATKH "" VALUE 0x8E0C87 KwUb 1.000 fak_ub_b2 0.00 1.000 FORMAT "%5.3" /end CHARACTERISTIC
/begin CHARACTERISTIC WMKATKH2 "" VALUE 0x8E0C88 KwUb 1.000 fak_ub_b2 0.00 1.000 FORMAT "%5.3" /end CHARACTERISTIC
/begin CHARACTERISTIC WPEDU "" VALUE 0x8FEB5E KwUw 100.0000 relPED_uw_b100 0.00 100.0000 FORMAT "%8.4" /end CHARACTERISTIC
/begin CHARACTERISTIC WPKDMN "" VALUE 0x8FDC8E KwUw 100.0000 relPED_uw_b100 0.00 100.0000 FORMAT "%8.4" /end CHARACTERISTIC
/begin CHARACTERISTIC ZATAKRML "" CURVE 0x8E7F56 GklWUw 13106.999997 zk200msxs_uw_b13107 0.20000305180 13107.200000 FORMAT "%12.6"
 /begin AXIS_DESCR COM_AXIS ml_w m_uw_b6553p5 7 0.00 6553.500 FORMAT "%8.3" AXIS_PTS_REF SML07TMUW /end AXIS_DESCR
/end CHARACTERISTIC
/begin CHARACTERISTIC ZATAKRML2 "" CURVE 0x8E7F64 GklWUw 13106.999997 zk200msxs_uw_b13107 0.20000305180 13107.200000 FORMAT "%12.6"
 /begin AXIS_DESCR COM_AXIS ml_w m_uw_b6553p5 7 0.00 6553.500 FORMAT "%8.3" AXIS_PTS_REF SML07TMUW /end AXIS_DESCR
/end CHARACTERISTIC
/begin CHARACTERISTIC ZATMAML "" CURVE 0x8E7F72 GklWUw 13106.999997 zk200msxs_uw_b13107 0.20000305180 13107.200000 FORMAT "%12.6"
 /begin AXIS_DESCR COM_AXIS ml_w m_uw_b6553p5 7 0.00 6553.500 FORMAT "%8.3" AXIS_PTS_REF SML07TMUW /end AXIS_DESCR
/end CHARACTERISTIC
/begin CHARACTERISTIC ZATMAML2 "" CURVE 0x8E7F80 GklWUw 13106.999997 zk200msxs_uw_b13107 0.20000305180 13107.200000 FORMAT "%12.6"
 /begin AXIS_DESCR COM_AXIS ml_w m_uw_b6553p5 7 0.00 6553.500 FORMAT "%8.3" AXIS_PTS_REF SML07TMUW /end AXIS_DESCR
/end CHARACTERISTIC
/begin CHARACTERISTIC ZATMIKML "" CURVE 0x8E7F8E GklWUw 13106.999997 zk200msxs_uw_b13107 0.20000305180 13107.200000 FORMAT "%12.6"
 /begin AXIS_DESCR COM_AXIS ml_w m_uw_b6553p5 7 0.00 6553.500 FORMAT "%8.3" AXIS_PTS_REF SML07TMUW /end AXIS_DESCR
/end CHARACTERISTIC
/begin CHARACTERISTIC ZATMIKML2 "" CURVE 0x8E7F9C GklWUw 13106.999997 zk200msxs_uw_b13107 0.20000305180 13107.200000 FORMAT "%12.6"
 /begin AXIS_DESCR COM_AXIS ml_w m_uw_b6553p5 7 0.00 6553.500 FORMAT "%8.3" AXIS_PTS_REF SML07TMUW /end AXIS_DESCR
/end CHARACTERISTIC
/begin CHARACTERISTIC ZATMKML "" CURVE 0x8E7FAA GklWUw 13106.999997 zk200msxs_uw_b13107 0.20000305180 13107.200000 FORMAT "%12.6"
 /begin AXIS_DESCR COM_AXIS ml_w m_uw_b6553p5 7 0.00 6553.500 FORMAT "%8.3" AXIS_PTS_REF SML07TMUW /end AXIS_DESCR
/end CHARACTERISTIC
/begin CHARACTERISTIC ZATMKML2 "" CURVE 0x8E7FB8 GklWUw 13106.999997 zk200msxs_uw_b13107 0.20000305180 13107.200000 FORMAT "%12.6"
 /begin AXIS_DESCR COM_AXIS ml_w m_uw_b6553p5 7 0.00 6553.500 FORMAT "%8.3" AXIS_PTS_REF SML07TMUW /end AXIS_DESCR
/end CHARACTERISTIC
/begin CHARACTERISTIC ZATMRML "" CURVE 0x8E7FC6 GklWUw 13106.999997 zk200msxs_uw_b13107 0.20000305180 13107.200000 FORMAT "%12.6"
 /begin AXIS_DESCR COM_AXIS ml_w m_uw_b6553p5 7 0.00 6553.500 FORMAT "%8.3" AXIS_PTS_REF SML07TMUW /end AXIS_DESCR
/end CHARACTERISTIC
/begin CHARACTERISTIC ZATMRML2 "" CURVE 0x8E7FD4 GklWUw 13106.999997 zk200msxs_uw_b13107 0.20000305180 13107.200000 FORMAT "%12.6"
 /begin AXIS_DESCR COM_AXIS ml_w m_uw_b6553p5 7 0.00 6553.500 FORMAT "%8.3" AXIS_PTS_REF SML07TMUW /end AXIS_DESCR
/end CHARACTERISTIC
/begin CHARACTERISTIC ZATRKRML "" CURVE 0x8E7FE2 GklWUw 13106.999997 zk200msxs_uw_b13107 0.20000305180 13107.200000 FORMAT "%12.6"
 /begin AXIS_DESCR COM_AXIS ml_w m_uw_b6553p5 7 0.00 6553.500 FORMAT "%8.3" AXIS_PTS_REF SML07TMUW /end AXIS_DESCR
/end CHARACTERISTIC
/begin CHARACTERISTIC ZATRKRML2 "" CURVE 0x8E7FF0 GklWUw 13106.999997 zk200msxs_uw_b13107 0.20000305180 13107.200000 FORMAT "%12.6"
 /begin AXIS_DESCR COM_AXIS ml_w m_uw_b6553p5 7 0.00 6553.500 FORMAT "%8.3" AXIS_PTS_REF SML07TMUW /end AXIS_DESCR
/end CHARACTERISTIC
/begin CHARACTERISTIC ZKHABB "" VALUE 0x8E2483 KwUb 25.4996 zk100msxs_ub_b25p5 0.100392 25.6000 FORMAT "%7.4" /end CHARACTERISTIC
/begin CHARACTERISTIC ZKLAMKH "" VALUE 0x8FE8D6 KwUw 655.34999985 zk10msxs_uw_b655 0.010000152590 655.36000000 FORMAT "%12.8" /end CHARACTERISTIC
/begin CHARACTERISTIC ZKUBDLR "" VALUE 0x8E0E9C KwUb 0.4980 fak_ub_b0p5 0.00 0.4980 /end CHARACTERISTIC
/begin CHARACTERISTIC ZKWDKSPT1 "" VALUE 0x8FCF72 KwUb 0.6973 fak_q0p00273 0.00 0.6973 /end CHARACTERISTIC
/begin CHARACTERISTIC ZWFUBAMN "" VALUE 0x8FCD25 KwUb 90.00 zw_TR2OT_teeth_sy -30.00 60.00 FORMAT "%5.2" /end CHARACTERISTIC
/begin MEASUREMENT abmf "" UBYTE dez 1 100 0.00 255.0 FORMAT "%5.1" ECU_ADDRESS 0xF08D4 /end MEASUREMENT
/begin MEASUREMENT abo "" UBYTE dez 1 100 0.00 255.0 FORMAT "%5.1" ECU_ADDRESS 0x38401B /end MEASUREMENT
/begin MEASUREMENT aebkvph_w "" UWORD dez 1 100 0.00 65535.00 FORMAT "%8.2" ECU_ADDRESS 0xF2D24 /end MEASUREMENT
/begin MEASUREMENT aebkvpl_w "" UWORD dez 1 100 0.00 65535.00 FORMAT "%8.2" ECU_ADDRESS 0xF2D26 /end MEASUREMENT
/begin MEASUREMENT aebkvp_l "" ULONG DEZL 1 100 0.00 4294967295.00 FORMAT "%13.2" ECU_ADDRESS 0x383164 /end MEASUREMENT
/begin MEASUREMENT aekp8bits "" UBYTE dez 1 100 0.00 255.0 FORMAT "%5.1" ECU_ADDRESS 0xF41AD /end MEASUREMENT
/begin MEASUREMENT aleNvBits "" UBYTE dez 1 100 0.00 255.0 FORMAT "%5.1" ECU_ADDRESS 0x38203E /end MEASUREMENT
/begin MEASUREMENT anzeab "" UBYTE dez 1 100 0.00 255.0 FORMAT "%5.1" ECU_ADDRESS 0xF08D5 /end MEASUREMENT
/begin MEASUREMENT anzekpvl "" UBYTE dez 1 100 0.00 255.0 FORMAT "%5.1" ECU_ADDRESS 0x38402C /end MEASUREMENT
/begin MEASUREMENT anzti "" UBYTE dez 1 100 0.00 255.0 FORMAT "%5.1" ECU_ADDRESS 0xE10C /end MEASUREMENT
/begin MEASUREMENT anztib "" UBYTE dez 1 100 0.00 255.0 FORMAT "%5.1" ECU_ADDRESS 0xE10D /end MEASUREMENT
/begin MEASUREMENT anztib_w "" UWORD dez 1 100 0.00 65535.00 FORMAT "%8.2" ECU_ADDRESS 0xE12E /end MEASUREMENT
/begin MEASUREMENT anzti_w "" UWORD dez 1 100 0.00 65535.00 FORMAT "%8.2" ECU_ADDRESS 0xE130 /end MEASUREMENT
/begin MEASUREMENT atmAusBitsNov "" UBYTE dez 1 100 0.00 255.0 FORMAT "%5.1" ECU_ADDRESS 0x382042 /end MEASUREMENT
/begin MEASUREMENT atmLokBits "" UBYTE dez 1 100 0.00 255.0 FORMAT "%5.1" ECU_ADDRESS 0xF0724 /end MEASUREMENT
/begin MEASUREMENT azFadeStatBits "" UBYTE dez 1 100 0.00 255.0 FORMAT "%5.1" ECU_ADDRESS 0xE00E /end MEASUREMENT
/begin MEASUREMENT azfdoff "" UBYTE dez 1 100 0.00 255.0 FORMAT "%5.1" ECU_ADDRESS 0xE00F /end MEASUREMENT
/begin MEASUREMENT azoffmsk_w "" UWORD dez 1 100 0.00 65535.00 FORMAT "%8.2" ECU_ADDRESS 0xE032 /end MEASUREMENT
/begin MEASUREMENT BBKDbits "" UBYTE dez 1 100 0.00 255.0 FORMAT "%5.1" ECU_ADDRESS 0xF0831 /end MEASUREMENT
/begin MEASUREMENT BBKHZausbits "" UBYTE dez 1 100 0.00 255.0 FORMAT "%5.1" ECU_ADDRESS 0xF0A46 /end MEASUREMENT
/begin MEASUREMENT BBKHZlokBits "" UBYTE dez 1 100 0.00 255.0 FORMAT "%5.1" ECU_ADDRESS 0xF0A47 /end MEASUREMENT
/begin MEASUREMENT BBKHZlokBits1 "" UBYTE dez 1 100 0.00 255.0 FORMAT "%5.1" ECU_ADDRESS 0xF0A48 /end MEASUREMENT
/begin MEASUREMENT bblkderf "" UBYTE dez 1 100 0.00 255.0 FORMAT "%5.1" ECU_ADDRESS 0x38205D /end MEASUREMENT
/begin MEASUREMENT B_abkl "" UWORD B_TRUE 1 100 0.00 1.00000000000 BIT_MASK 0x200 FORMAT "%13.11" ECU_ADDRESS 0xFDD0 /end MEASUREMENT
/begin MEASUREMENT B_abor "" UWORD B_TRUE 1 100 0.00 1.00000000000 BIT_MASK 0x8000 FORMAT "%13.11" ECU_ADDRESS 0xFD82 /end MEASUREMENT
/begin MEASUREMENT B_ale "" UBYTE B_TRUE 1 100 0.00 1.00000000000 BIT_MASK 0x1 FORMAT "%13.11" ECU_ADDRESS 0x38203E /end MEASUREMENT
/begin MEASUREMENT B_apnoluv "" UWORD B_TRUE 1 100 0.00 1.00000000000 BIT_MASK 0x2 FORMAT "%13.11" ECU_ADDRESS 0xFD5E /end MEASUREMENT
/begin MEASUREMENT B_appnolu "" UWORD B_TRUE 1 100 0.00 1.00000000000 BIT_MASK 0x4 FORMAT "%13.11" ECU_ADDRESS 0xFD5E /end MEASUREMENT
/begin MEASUREMENT B_ar "" UWORD B_TRUE 1 100 0.00 1.00000000000 BIT_MASK 0x20 FORMAT "%13.11" ECU_ADDRESS 0xFDA2 /end MEASUREMENT
/begin MEASUREMENT B_argf "" UWORD B_TRUE 1 100 0.00 1.00000000000 BIT_MASK 0x40 FORMAT "%13.11" ECU_ADDRESS 0xFDA2 /end MEASUREMENT
/begin MEASUREMENT B_AsicComDisable "" UWORD B_TRUE 1 100 0.00 1.00000000000 BIT_MASK 0x20 FORMAT "%13.11" ECU_ADDRESS 0xFDB8 /end MEASUREMENT
/begin MEASUREMENT B_atmst "" UBYTE B_TRUE 1 100 0.00 1.00000000000 BIT_MASK 0x2 FORMAT "%13.11" ECU_ADDRESS 0xF0724 /end MEASUREMENT
/begin MEASUREMENT B_atmst2 "" UBYTE B_TRUE 1 100 0.00 1.00000000000 BIT_MASK 0x4 FORMAT "%13.11" ECU_ADDRESS 0xF0724 /end MEASUREMENT
/begin MEASUREMENT B_atmtpa "" UWORD B_TRUE 1 100 0.00 1.00000000000 BIT_MASK 0x10 FORMAT "%13.11" ECU_ADDRESS 0xFD4A /end MEASUREMENT
/begin MEASUREMENT B_atmtpa2 "" UWORD B_TRUE 1 100 0.00 1.00000000000 BIT_MASK 0x20 FORMAT "%13.11" ECU_ADDRESS 0xFD4A /end MEASUREMENT
/begin MEASUREMENT B_atmtpf "" UBYTE B_TRUE 1 100 0.00 1.00000000000 BIT_MASK 0x4 FORMAT "%13.11" ECU_ADDRESS 0x382042 /end MEASUREMENT
/begin MEASUREMENT B_atmtpf2 "" UBYTE B_TRUE 1 100 0.00 1.00000000000 BIT_MASK 0x8 FORMAT "%13.11" ECU_ADDRESS 0x382042 /end MEASUREMENT
/begin MEASUREMENT B_atmtpk "" UWORD B_TRUE 1 100 0.00 1.00000000000 BIT_MASK 0x40 FORMAT "%13.11" ECU_ADDRESS 0xFD4A /end MEASUREMENT
/begin MEASUREMENT B_atmtpk2 "" UWORD B_TRUE 1 100 0.00 1.00000000000 BIT_MASK 0x80 FORMAT "%13.11" ECU_ADDRESS 0xFD4A /end MEASUREMENT
/begin MEASUREMENT B_atmtpl "" UBYTE B_TRUE 1 100 0.00 1.00000000000 BIT_MASK 0x1 FORMAT "%13.11" ECU_ADDRESS 0x382042 /end MEASUREMENT
/begin MEASUREMENT B_atmtpl2 "" UBYTE B_TRUE 1 100 0.00 1.00000000000 BIT_MASK 0x2 FORMAT "%13.11" ECU_ADDRESS 0x382042 /end MEASUREMENT
/begin MEASUREMENT B_azoffzag "" UWORD B_TRUE 1 100 0.00 1.00000000000 BIT_MASK 0x2 FORMAT "%13.11" ECU_ADDRESS 0xFD10 /end MEASUREMENT
/begin MEASUREMENT B_bkvp "" UWORD B_TRUE 1 100 0.00 1.00000000000 BIT_MASK 0x40 FORMAT "%13.11" ECU_ADDRESS 0xFDD0 /end MEASUREMENT
/begin MEASUREMENT B_buf "" UWORD B_TRUE 1 100 0.00 1.00000000000 BIT_MASK 0x1 FORMAT "%13.11" ECU_ADDRESS 0xFDC4 /end MEASUREMENT
/begin MEASUREMENT B_cwesakt "" UWORD B_TRUE 1 100 0.00 1.00000000000 BIT_MASK 0x800 FORMAT "%13.11" ECU_ADDRESS 0xFD62 /end MEASUREMENT
/begin MEASUREMENT B_dcdisfr "" UWORD B_TRUE 1 100 0.00 1.00000000000 BIT_MASK 0x8 FORMAT "%13.11" ECU_ADDRESS 0xFD5E /end MEASUREMENT
/begin MEASUREMENT B_dkbew "" UWORD B_TRUE 1 100 0.00 1.00000000000 BIT_MASK 0x10 FORMAT "%13.11" ECU_ADDRESS 0xFD5E /end MEASUREMENT
/begin MEASUREMENT B_dlrbe "" UWORD B_TRUE 1 100 0.00 1.00000000000 BIT_MASK 0x20 FORMAT "%13.11" ECU_ADDRESS 0xFD5E /end MEASUREMENT
/begin MEASUREMENT B_dlrikla "" UWORD B_TRUE 1 100 0.00 1.00000000000 BIT_MASK 0x40 FORMAT "%13.11" ECU_ADDRESS 0xFD5E /end MEASUREMENT
/begin MEASUREMENT B_dlriklst "" UWORD B_TRUE 1 100 0.00 1.00000000000 BIT_MASK 0x80 FORMAT "%13.11" ECU_ADDRESS 0xFD5E /end MEASUREMENT
/begin MEASUREMENT B_dlrparc "" UWORD B_TRUE 1 100 0.00 1.00000000000 BIT_MASK 0x100 FORMAT "%13.11" ECU_ADDRESS 0xFD5E /end MEASUREMENT
/begin MEASUREMENT B_dlrpide "" UWORD B_TRUE 1 100 0.00 1.00000000000 BIT_MASK 0x200 FORMAT "%13.11" ECU_ADDRESS 0xFD5E /end MEASUREMENT
/begin MEASUREMENT B_dlrspid "" UWORD B_TRUE 1 100 0.00 1.00000000000 BIT_MASK 0x400 FORMAT "%13.11" ECU_ADDRESS 0xFD5E /end MEASUREMENT
/begin MEASUREMENT B_dlrumzu "" UWORD B_TRUE 1 100 0.00 1.00000000000 BIT_MASK 0x800 FORMAT "%13.11" ECU_ADDRESS 0xFD5E /end MEASUREMENT
/begin MEASUREMENT B_dls "" UWORD B_TRUE 1 100 0.00 1.00000000000 BIT_MASK 0x2 FORMAT "%13.11" ECU_ADDRESS 0xFDC4 /end MEASUREMENT
/begin MEASUREMENT B_dmdstop "" UWORD B_TRUE 1 100 0.00 1.00000000000 BIT_MASK 0x2 FORMAT "%13.11" ECU_ADDRESS 0xFD70 /end MEASUREMENT
/begin MEASUREMENT B_dnn "" UWORD B_TRUE 1 100 0.00 1.00000000000 BIT_MASK 0x4 FORMAT "%13.11" ECU_ADDRESS 0xFDC4 /end MEASUREMENT
/begin MEASUREMENT B_dnsll "" UWORD B_TRUE 1 100 0.00 1.00000000000 BIT_MASK 0x80 FORMAT "%13.11" ECU_ADDRESS 0xFD9E /end MEASUREMENT
/begin MEASUREMENT B_dnwfozea "" UBYTE B_TRUE 1 100 0.00 1.00000000000 BIT_MASK 0x1 FORMAT "%13.11" ECU_ADDRESS 0xF0BD2 /end MEASUREMENT
/begin MEASUREMENT B_dnwfozee "" UBYTE B_TRUE 1 100 0.00 1.00000000000 BIT_MASK 0x2 FORMAT "%13.11" ECU_ADDRESS 0xF0BD2 /end MEASUREMENT
/begin MEASUREMENT B_dnwrpa "" UBYTE B_TRUE 1 100 0.00 1.00000000000 BIT_MASK 0x1 FORMAT "%13.11" ECU_ADDRESS 0xF418F /end MEASUREMENT
/begin MEASUREMENT B_dnwrpe "" UBYTE B_TRUE 1 100 0.00 1.00000000000 BIT_MASK 0x4 FORMAT "%13.11" ECU_ADDRESS 0xF418F /end MEASUREMENT
/begin MEASUREMENT B_dnws "" UBYTE B_TRUE 1 100 0.00 1.00000000000 BIT_MASK 0x1 FORMAT "%13.11" ECU_ADDRESS 0xF418E /end MEASUREMENT
/begin MEASUREMENT B_dnwsa "" UBYTE B_TRUE 1 100 0.00 1.00000000000 BIT_MASK 0x2 FORMAT "%13.11" ECU_ADDRESS 0xF418E /end MEASUREMENT
/begin MEASUREMENT B_dnwse "" UBYTE B_TRUE 1 100 0.00 1.00000000000 BIT_MASK 0x8 FORMAT "%13.11" ECU_ADDRESS 0xF418E /end MEASUREMENT
/begin MEASUREMENT B_dnwsfa "" UBYTE B_TRUE 1 100 0.00 1.00000000000 BIT_MASK 0x1 FORMAT "%13.11" ECU_ADDRESS 0xF418D /end MEASUREMENT
/begin MEASUREMENT B_dopzue_i "" UWORD B_TRUE 1 100 0.00 1.00000000000 BIT_MASK 0x4 FORMAT "%13.11" ECU_ADDRESS 0xFD10 /end MEASUREMENT
/begin MEASUREMENT B_dveese "" UWORD B_TRUE 1 100 0.00 1.00000000000 BIT_MASK 0x1000 FORMAT "%13.11" ECU_ADDRESS 0xFD5E /end MEASUREMENT
/begin MEASUREMENT B_dveesh "" UWORD B_TRUE 1 100 0.00 1.00000000000 BIT_MASK 0x2000 FORMAT "%13.11" ECU_ADDRESS 0xFD5E /end MEASUREMENT
/begin MEASUREMENT B_dvete "" UWORD B_TRUE 1 100 0.00 1.00000000000 BIT_MASK 0x4000 FORMAT "%13.11" ECU_ADDRESS 0xFD5E /end MEASUREMENT
/begin MEASUREMENT B_dzai "" UWORD B_TRUE 1 100 0.00 1.00000000000 BIT_MASK 0x8 FORMAT "%13.11" ECU_ADDRESS 0xFD10 /end MEASUREMENT
/begin MEASUREMENT B_ekp "" UWORD B_TRUE 1 100 0.00 1.00000000000 BIT_MASK 0x80 FORMAT "%13.11" ECU_ADDRESS 0xFDCC /end MEASUREMENT
/begin MEASUREMENT B_ekpd "" UWORD B_TRUE 1 100 0.00 1.00000000000 BIT_MASK 0x100 FORMAT "%13.11" ECU_ADDRESS 0xFDCC /end MEASUREMENT
/begin MEASUREMENT B_ekps "" UWORD B_TRUE 1 100 0.00 1.00000000000 BIT_MASK 0x200 FORMAT "%13.11" ECU_ADDRESS 0xFDCC /end MEASUREMENT
/begin MEASUREMENT B_ekpvl "" UBYTE B_TRUE 1 100 0.00 1.00000000000 BIT_MASK 0x1 FORMAT "%13.11" ECU_ADDRESS 0xF41AD /end MEASUREMENT
/begin MEASUREMENT B_ekpvla "" UBYTE B_TRUE 1 100 0.00 1.00000000000 BIT_MASK 0x2 FORMAT "%13.11" ECU_ADDRESS 0xF41AD /end MEASUREMENT
/begin MEASUREMENT B_ekpvlz "" UBYTE B_TRUE 1 100 0.00 1.00000000000 BIT_MASK 0x4 FORMAT "%13.11" ECU_ADDRESS 0xF41AD /end MEASUREMENT
/begin MEASUREMENT B_enabale "" UWORD B_TRUE 1 100 0.00 1.00000000000 BIT_MASK 0x4000 FORMAT "%13.11" ECU_ADDRESS 0xFD40 /end MEASUREMENT
/begin MEASUREMENT B_encifi "" UWORD B_TRUE 1 100 0.00 1.00000000000 BIT_MASK 0x1000 FORMAT "%13.11" ECU_ADDRESS 0xFD62 /end MEASUREMENT
/begin MEASUREMENT B_esabrev "" UBYTE B_TRUE 1 100 0.00 1.00000000000 BIT_MASK 0x1 FORMAT "%13.11" ECU_ADDRESS 0xF0C37 /end MEASUREMENT
/begin MEASUREMENT B_evabu "" UWORD B_TRUE 1 100 0.00 1.00000000000 BIT_MASK 0x8 FORMAT "%13.11" ECU_ADDRESS 0xFD78 /end MEASUREMENT
/begin MEASUREMENT B_evasel "" UWORD B_TRUE 1 100 0.00 1.00000000000 BIT_MASK 0x4 FORMAT "%13.11" ECU_ADDRESS 0xFD78 /end MEASUREMENT
/begin MEASUREMENT B_fbkvpa "" UWORD B_TRUE 1 100 0.00 1.00000000000 BIT_MASK 0x80 FORMAT "%13.11" ECU_ADDRESS 0xFDD0 /end MEASUREMENT
/begin MEASUREMENT B_ffsn2_i "" UWORD B_TRUE 1 100 0.00 1.00000000000 BIT_MASK 0x10 FORMAT "%13.11" ECU_ADDRESS 0xFD10 /end MEASUREMENT
/begin MEASUREMENT B_ff_i "" UWORD B_TRUE 1 100 0.00 1.00000000000 BIT_MASK 0x20 FORMAT "%13.11" ECU_ADDRESS 0xFD10 /end MEASUREMENT
/begin MEASUREMENT B_fophsnl "" UWORD B_TRUE 1 100 0.00 1.00000000000 BIT_MASK 0x4 FORMAT "%13.11" ECU_ADDRESS 0xFD70 /end MEASUREMENT
/begin MEASUREMENT B_frdph "" UWORD B_TRUE 1 100 0.00 1.00000000000 BIT_MASK 0x8 FORMAT "%13.11" ECU_ADDRESS 0xFD70 /end MEASUREMENT
/begin MEASUREMENT B_fs "" UBYTE B_TRUE 1 100 0.00 1.00000000000 BIT_MASK 0x1 FORMAT "%13.11" ECU_ADDRESS 0xF080B /end MEASUREMENT
/begin MEASUREMENT B_genws "" UBYTE B_TRUE 1 100 0.00 1.00000000000 BIT_MASK 0x4 FORMAT "%13.11" ECU_ADDRESS 0xF0BD2 /end MEASUREMENT
/begin MEASUREMENT B_gfen "" UWORD B_TRUE 1 100 0.00 1.00000000000 BIT_MASK 0x80 FORMAT "%13.11" ECU_ADDRESS 0xFDA2 /end MEASUREMENT
/begin MEASUREMENT B_gwhs "" UBYTE B_TRUE 1 100 0.00 1.00000000000 BIT_MASK 0x2 FORMAT "%13.11" ECU_ADDRESS 0xF080B /end MEASUREMENT
/begin MEASUREMENT B_hpnmot "" UWORD B_TRUE 1 100 0.00 1.00000000000 BIT_MASK 0x100 FORMAT "%13.11" ECU_ADDRESS 0xFDA2 /end MEASUREMENT
/begin MEASUREMENT B_hrlsaus "" UWORD B_TRUE 1 100 0.00 1.00000000000 BIT_MASK 0x10 FORMAT "%13.11" ECU_ADDRESS 0xFDB8 /end MEASUREMENT
/begin MEASUREMENT B_iklrest "" UWORD B_TRUE 1 100 0.00 1.00000000000 BIT_MASK 0x8000 FORMAT "%13.11" ECU_ADDRESS 0xFD5E /end MEASUREMENT
/begin MEASUREMENT B_iklstar "" UWORD B_TRUE 1 100 0.00 1.00000000000 BIT_MASK 0x1 FORMAT "%13.11" ECU_ADDRESS 0xFD60 /end MEASUREMENT
/begin MEASUREMENT B_iniar "" UWORD B_TRUE 1 100 0.00 1.00000000000 BIT_MASK 0x200 FORMAT "%13.11" ECU_ADDRESS 0xFDA2 /end MEASUREMENT
/begin MEASUREMENT B_iniar1 "" UWORD B_TRUE 1 100 0.00 1.00000000000 BIT_MASK 0x400 FORMAT "%13.11" ECU_ADDRESS 0xFDA2 /end MEASUREMENT
/begin MEASUREMENT B_iniarv "" UWORD B_TRUE 1 100 0.00 1.00000000000 BIT_MASK 0x800 FORMAT "%13.11" ECU_ADDRESS 0xFDA2 /end MEASUREMENT
/begin MEASUREMENT B_kd "" UBYTE B_TRUE 1 100 0.00 1.00000000000 BIT_MASK 0x1 FORMAT "%13.11" ECU_ADDRESS 0xF0831 /end MEASUREMENT
/begin MEASUREMENT B_kdpos "" UBYTE B_TRUE 1 100 0.00 1.00000000000 BIT_MASK 0x40 FORMAT "%13.11" ECU_ADDRESS 0xF0831 /end MEASUREMENT
/begin MEASUREMENT B_kh "" UWORD B_TRUE 1 100 0.00 1.00000000000 BIT_MASK 0x800 FORMAT "%13.11" ECU_ADDRESS 0xFD8C /end MEASUREMENT
/begin MEASUREMENT B_kha "" UWORD B_TRUE 1 100 0.00 1.00000000000 BIT_MASK 0x1000 FORMAT "%13.11" ECU_ADDRESS 0xFD8C /end MEASUREMENT
/begin MEASUREMENT B_khab "" UWORD B_TRUE 1 100 0.00 1.00000000000 BIT_MASK 0x2000 FORMAT "%13.11" ECU_ADDRESS 0xFD8C /end MEASUREMENT
/begin MEASUREMENT B_khan "" UBYTE B_TRUE 1 100 0.00 1.00000000000 BIT_MASK 0x2 FORMAT "%13.11" ECU_ADDRESS 0xF0A46 /end MEASUREMENT
/begin MEASUREMENT B_khares "" UBYTE B_TRUE 1 100 0.00 1.00000000000 BIT_MASK 0x40 FORMAT "%13.11" ECU_ADDRESS 0xF0A47 /end MEASUREMENT
/begin MEASUREMENT B_khaset "" UBYTE B_TRUE 1 100 0.00 1.00000000000 BIT_MASK 0x20 FORMAT "%13.11" ECU_ADDRESS 0xF0A47 /end MEASUREMENT
/begin MEASUREMENT B_kherr "" UBYTE B_TRUE 1 100 0.00 1.00000000000 BIT_MASK 0x1 FORMAT "%13.11" ECU_ADDRESS 0xF0A48 /end MEASUREMENT
/begin MEASUREMENT B_khll "" UBYTE B_TRUE 1 100 0.00 1.00000000000 BIT_MASK 0x4 FORMAT "%13.11" ECU_ADDRESS 0xF0A47 /end MEASUREMENT
/begin MEASUREMENT B_khlle "" UBYTE B_TRUE 1 100 0.00 1.00000000000 BIT_MASK 0x1 FORMAT "%13.11" ECU_ADDRESS 0xF0A47 /end MEASUREMENT
/begin MEASUREMENT B_khllmx "" UBYTE B_TRUE 1 100 0.00 1.00000000000 BIT_MASK 0x2 FORMAT "%13.11" ECU_ADDRESS 0xF0A47 /end MEASUREMENT
/begin MEASUREMENT B_khn "" UWORD B_TRUE 1 100 0.00 1.00000000000 BIT_MASK 0x4000 FORMAT "%13.11" ECU_ADDRESS 0xFD8C /end MEASUREMENT
/begin MEASUREMENT B_khno "" UWORD B_TRUE 1 100 0.00 1.00000000000 BIT_MASK 0x8000 FORMAT "%13.11" ECU_ADDRESS 0xFD8C /end MEASUREMENT
/begin MEASUREMENT B_khnwt "" UBYTE B_TRUE 1 100 0.00 1.00000000000 BIT_MASK 0x1 FORMAT "%13.11" ECU_ADDRESS 0xF0BD6 /end MEASUREMENT
/begin MEASUREMENT B_khnwta "" UBYTE B_TRUE 1 100 0.00 1.00000000000 BIT_MASK 0x2 FORMAT "%13.11" ECU_ADDRESS 0xF0BD6 /end MEASUREMENT
/begin MEASUREMENT B_khnwte "" UBYTE B_TRUE 1 100 0.00 1.00000000000 BIT_MASK 0x4 FORMAT "%13.11" ECU_ADDRESS 0xF0BD6 /end MEASUREMENT
/begin MEASUREMENT B_khoab "" UBYTE B_TRUE 1 100 0.00 1.00000000000 BIT_MASK 0x1 FORMAT "%13.11" ECU_ADDRESS 0xF0A46 /end MEASUREMENT
/begin MEASUREMENT B_khres "" UBYTE B_TRUE 1 100 0.00 1.00000000000 BIT_MASK 0x10 FORMAT "%13.11" ECU_ADDRESS 0xF0A47 /end MEASUREMENT
/begin MEASUREMENT B_khset "" UBYTE B_TRUE 1 100 0.00 1.00000000000 BIT_MASK 0x8 FORMAT "%13.11" ECU_ADDRESS 0xF0A47 /end MEASUREMENT
/begin MEASUREMENT B_khstc "" UBYTE B_TRUE 1 100 0.00 1.00000000000 BIT_MASK 0x2 FORMAT "%13.11" ECU_ADDRESS 0xF0A48 /end MEASUREMENT
/begin MEASUREMENT B_kupgw "" UWORD B_TRUE 1 100 0.00 1.00000000000 BIT_MASK 0x1000 FORMAT "%13.11" ECU_ADDRESS 0xFDA2 /end MEASUREMENT
/begin MEASUREMENT B_kw "" UWORD B_TRUE 1 100 0.00 1.00000000000 BIT_MASK 0x1 FORMAT "%13.11" ECU_ADDRESS 0xFD8E /end MEASUREMENT
/begin MEASUREMENT B_lkderf "" UBYTE B_TRUE 1 100 0.00 1.00000000000 BIT_MASK 0x1 FORMAT "%13.11" ECU_ADDRESS 0x38205D /end MEASUREMENT
/begin MEASUREMENT B_lkdfrg "" UBYTE B_TRUE 1 100 0.00 1.00000000000 BIT_MASK 0x80 FORMAT "%13.11" ECU_ADDRESS 0xF0831 /end MEASUREMENT
/begin MEASUREMENT B_mlsu "" UBYTE B_TRUE 1 100 0.00 1.00000000000 BIT_MASK 0x80 FORMAT "%13.11" ECU_ADDRESS 0xF0A47 /end MEASUREMENT
/begin MEASUREMENT B_nlphea "" UWORD B_TRUE 1 100 0.00 1.00000000000 BIT_MASK 0x10 FORMAT "%13.11" ECU_ADDRESS 0xFD70 /end MEASUREMENT
/begin MEASUREMENT B_nlpheai "" UWORD B_TRUE 1 100 0.00 1.00000000000 BIT_MASK 0x20 FORMAT "%13.11" ECU_ADDRESS 0xFD70 /end MEASUREMENT
/begin MEASUREMENT B_nlpne "" UWORD B_TRUE 1 100 0.00 1.00000000000 BIT_MASK 0x2 FORMAT "%13.11" ECU_ADDRESS 0xFD60 /end MEASUREMENT
/begin MEASUREMENT B_nlzoff "" UWORD B_TRUE 1 100 0.00 1.00000000000 BIT_MASK 0x10 FORMAT "%13.11" ECU_ADDRESS 0xFD78 /end MEASUREMENT
/begin MEASUREMENT B_nmotnwdf "" UBYTE B_TRUE 1 100 0.00 1.00000000000 BIT_MASK 0x2 FORMAT "%13.11" ECU_ADDRESS 0xF418D /end MEASUREMENT
/begin MEASUREMENT B_nnwmx "" UBYTE B_TRUE 1 100 0.00 1.00000000000 BIT_MASK 0x8 FORMAT "%13.11" ECU_ADDRESS 0xF0BD2 /end MEASUREMENT
/begin MEASUREMENT B_nsafan "" UBYTE B_TRUE 1 100 0.00 1.00000000000 BIT_MASK 0x4 FORMAT "%13.11" ECU_ADDRESS 0xF0ADE /end MEASUREMENT
/begin MEASUREMENT B_nwdfonws "" UBYTE B_TRUE 1 100 0.00 1.00000000000 BIT_MASK 0x10 FORMAT "%13.11" ECU_ADDRESS 0xF0BD5 /end MEASUREMENT
/begin MEASUREMENT B_nwemg "" UWORD B_TRUE 1 100 0.00 1.00000000000 BIT_MASK 0x100 FORMAT "%13.11" ECU_ADDRESS 0xFD9E /end MEASUREMENT
/begin MEASUREMENT B_nwkwaosw "" UBYTE B_TRUE 1 100 0.00 1.00000000000 BIT_MASK 0x10 FORMAT "%13.11" ECU_ADDRESS 0xF0BD2 /end MEASUREMENT
/begin MEASUREMENT B_nwmd "" UBYTE B_TRUE 1 100 0.00 1.00000000000 BIT_MASK 0x8 FORMAT "%13.11" ECU_ADDRESS 0xF0BD6 /end MEASUREMENT
/begin MEASUREMENT B_nwnmot "" UBYTE B_TRUE 1 100 0.00 1.00000000000 BIT_MASK 0x10 FORMAT "%13.11" ECU_ADDRESS 0xF0BD6 /end MEASUREMENT
/begin MEASUREMENT B_nws "" UWORD B_TRUE 1 100 0.00 1.00000000000 BIT_MASK 0x2000 FORMAT "%13.11" ECU_ADDRESS 0xFDBE /end MEASUREMENT
/begin MEASUREMENT B_nwsapkfa "" UBYTE B_TRUE 1 100 0.00 1.00000000000 BIT_MASK 0x20 FORMAT "%13.11" ECU_ADDRESS 0xF0BD2 /end MEASUREMENT
/begin MEASUREMENT B_nwsapkfe "" UBYTE B_TRUE 1 100 0.00 1.00000000000 BIT_MASK 0x40 FORMAT "%13.11" ECU_ADDRESS 0xF0BD2 /end MEASUREMENT
/begin MEASUREMENT B_nwsappa "" UBYTE B_TRUE 1 100 0.00 1.00000000000 BIT_MASK 0x80 FORMAT "%13.11" ECU_ADDRESS 0xF0BD2 /end MEASUREMENT
/begin MEASUREMENT B_nwsappe "" UBYTE B_TRUE 1 100 0.00 1.00000000000 BIT_MASK 0x1 FORMAT "%13.11" ECU_ADDRESS 0xF0BD3 /end MEASUREMENT
/begin MEASUREMENT B_nwsguda "" UBYTE B_TRUE 1 100 0.00 1.00000000000 BIT_MASK 0x2 FORMAT "%13.11" ECU_ADDRESS 0xF0BD3 /end MEASUREMENT
/begin MEASUREMENT B_nwsgude "" UBYTE B_TRUE 1 100 0.00 1.00000000000 BIT_MASK 0x4 FORMAT "%13.11" ECU_ADDRESS 0xF0BD3 /end MEASUREMENT
/begin MEASUREMENT B_nwsinva "" UBYTE B_TRUE 1 100 0.00 1.00000000000 BIT_MASK 0x8 FORMAT "%13.11" ECU_ADDRESS 0xF0BD3 /end MEASUREMENT
/begin MEASUREMENT B_nwsinve "" UBYTE B_TRUE 1 100 0.00 1.00000000000 BIT_MASK 0x10 FORMAT "%13.11" ECU_ADDRESS 0xF0BD3 /end MEASUREMENT
/begin MEASUREMENT B_nwskflla "" UBYTE B_TRUE 1 100 0.00 1.00000000000 BIT_MASK 0x20 FORMAT "%13.11" ECU_ADDRESS 0xF0BD3 /end MEASUREMENT
/begin MEASUREMENT B_nwskflle "" UBYTE B_TRUE 1 100 0.00 1.00000000000 BIT_MASK 0x40 FORMAT "%13.11" ECU_ADDRESS 0xF0BD3 /end MEASUREMENT
/begin MEASUREMENT B_nwskha "" UBYTE B_TRUE 1 100 0.00 1.00000000000 BIT_MASK 0x80 FORMAT "%13.11" ECU_ADDRESS 0xF0BD3 /end MEASUREMENT
/begin MEASUREMENT B_nwskhe "" UBYTE B_TRUE 1 100 0.00 1.00000000000 BIT_MASK 0x1 FORMAT "%13.11" ECU_ADDRESS 0xF0BD4 /end MEASUREMENT
/begin MEASUREMENT B_nwsoada "" UBYTE B_TRUE 1 100 0.00 1.00000000000 BIT_MASK 0x20 FORMAT "%13.11" ECU_ADDRESS 0xF0BD6 /end MEASUREMENT
/begin MEASUREMENT B_nwsoedk "" UBYTE B_TRUE 1 100 0.00 1.00000000000 BIT_MASK 0x40 FORMAT "%13.11" ECU_ADDRESS 0xF0BD6 /end MEASUREMENT
/begin MEASUREMENT B_nwsrl "" UBYTE B_TRUE 1 100 0.00 1.00000000000 BIT_MASK 0x80 FORMAT "%13.11" ECU_ADDRESS 0xF0BD6 /end MEASUREMENT
/begin MEASUREMENT B_nwssprga "" UBYTE B_TRUE 1 100 0.00 1.00000000000 BIT_MASK 0x2 FORMAT "%13.11" ECU_ADDRESS 0xF0BD4 /end MEASUREMENT
/begin MEASUREMENT B_nwssprge "" UBYTE B_TRUE 1 100 0.00 1.00000000000 BIT_MASK 0x4 FORMAT "%13.11" ECU_ADDRESS 0xF0BD4 /end MEASUREMENT
/begin MEASUREMENT B_nwsst "" UBYTE B_TRUE 1 100 0.00 1.00000000000 BIT_MASK 0x8 FORMAT "%13.11" ECU_ADDRESS 0xF0BD4 /end MEASUREMENT
/begin MEASUREMENT B_nwssta "" UBYTE B_TRUE 1 100 0.00 1.00000000000 BIT_MASK 0x10 FORMAT "%13.11" ECU_ADDRESS 0xF0BD4 /end MEASUREMENT
/begin MEASUREMENT B_nwsste "" UBYTE B_TRUE 1 100 0.00 1.00000000000 BIT_MASK 0x20 FORMAT "%13.11" ECU_ADDRESS 0xF0BD4 /end MEASUREMENT
/begin MEASUREMENT B_nwsstend "" UBYTE B_TRUE 1 100 0.00 1.00000000000 BIT_MASK 0x1 FORMAT "%13.11" ECU_ADDRESS 0xF0BD7 /end MEASUREMENT
/begin MEASUREMENT B_nwstvakt "" UBYTE B_TRUE 1 100 0.00 1.00000000000 BIT_MASK 0x2 FORMAT "%13.11" ECU_ADDRESS 0xF0BD7 /end MEASUREMENT
/begin MEASUREMENT B_nwta "" UBYTE B_TRUE 1 100 0.00 1.00000000000 BIT_MASK 0x4 FORMAT "%13.11" ECU_ADDRESS 0xF0BD7 /end MEASUREMENT
/begin MEASUREMENT B_nwte "" UBYTE B_TRUE 1 100 0.00 1.00000000000 BIT_MASK 0x8 FORMAT "%13.11" ECU_ADDRESS 0xF0BD7 /end MEASUREMENT
/begin MEASUREMENT B_nwurledk "" UBYTE B_TRUE 1 100 0.00 1.00000000000 BIT_MASK 0x40 FORMAT "%13.11" ECU_ADDRESS 0xF0BD4 /end MEASUREMENT
/begin MEASUREMENT B_nwvfa "" UBYTE B_TRUE 1 100 0.00 1.00000000000 BIT_MASK 0x80 FORMAT "%13.11" ECU_ADDRESS 0xF0BD4 /end MEASUREMENT
/begin MEASUREMENT B_nwvfe "" UBYTE B_TRUE 1 100 0.00 1.00000000000 BIT_MASK 0x1 FORMAT "%13.11" ECU_ADDRESS 0xF0BD5 /end MEASUREMENT
/begin MEASUREMENT B_nwvfg "" UBYTE B_TRUE 1 100 0.00 1.00000000000 BIT_MASK 0x2 FORMAT "%13.11" ECU_ADDRESS 0xF0BD5 /end MEASUREMENT
/begin MEASUREMENT B_ph2okay "" UBYTE B_TRUE 1 100 0.00 1.00000000000 BIT_MASK 0x8 FORMAT "%13.11" ECU_ADDRESS 0xF0C37 /end MEASUREMENT
/begin MEASUREMENT B_phedge "" UBYTE B_TRUE 1 100 0.00 1.00000000000 BIT_MASK 0x2 FORMAT "%13.11" ECU_ADDRESS 0xF0C37 /end MEASUREMENT
/begin MEASUREMENT B_phedge2 "" UBYTE B_TRUE 1 100 0.00 1.00000000000 BIT_MASK 0x10 FORMAT "%13.11" ECU_ADDRESS 0xF0C37 /end MEASUREMENT
/begin MEASUREMENT B_phesab "" UWORD B_TRUE 1 100 0.00 1.00000000000 BIT_MASK 0x8 FORMAT "%13.11" ECU_ADDRESS 0xFDC4 /end MEASUREMENT
/begin MEASUREMENT B_phin "" UBYTE B_TRUE 1 100 0.00 1.00000000000 BIT_MASK 0x4 FORMAT "%13.11" ECU_ADDRESS 0xF0C37 /end MEASUREMENT
/begin MEASUREMENT B_phin2 "" UBYTE B_TRUE 1 100 0.00 1.00000000000 BIT_MASK 0x20 FORMAT "%13.11" ECU_ADDRESS 0xF0C37 /end MEASUREMENT
/begin MEASUREMENT B_phzueab "" UWORD B_TRUE 1 100 0.00 1.00000000000 BIT_MASK 0x10 FORMAT "%13.11" ECU_ADDRESS 0xFDC4 /end MEASUREMENT
/begin MEASUREMENT B_pvlab "" UBYTE B_TRUE 1 100 0.00 1.00000000000 BIT_MASK 0x8 FORMAT "%13.11" ECU_ADDRESS 0xF41AD /end MEASUREMENT
/begin MEASUREMENT B_pvlnl "" UBYTE B_TRUE 1 100 0.00 1.00000000000 BIT_MASK 0x10 FORMAT "%13.11" ECU_ADDRESS 0xF41AD /end MEASUREMENT
/begin MEASUREMENT B_pwrsv "" UWORD B_TRUE 1 100 0.00 1.00000000000 BIT_MASK 0x4 FORMAT "%13.11" ECU_ADDRESS 0xFD60 /end MEASUREMENT
/begin MEASUREMENT B_ralectr "" UWORD B_TRUE 1 100 0.00 1.00000000000 BIT_MASK 0x8000 FORMAT "%13.11" ECU_ADDRESS 0xFD40 /end MEASUREMENT
/begin MEASUREMENT B_raleok "" UWORD B_TRUE 1 100 0.00 1.00000000000 BIT_MASK 0x1 FORMAT "%13.11" ECU_ADDRESS 0xFD42 /end MEASUREMENT
/begin MEASUREMENT B_sab "" UWORD B_TRUE 1 100 0.00 1.00000000000 BIT_MASK 0x200 FORMAT "%13.11" ECU_ADDRESS 0xFD9E /end MEASUREMENT
/begin MEASUREMENT B_sabfg "" UWORD B_TRUE 1 100 0.00 1.00000000000 BIT_MASK 0x400 FORMAT "%13.11" ECU_ADDRESS 0xFD9E /end MEASUREMENT
/begin MEASUREMENT B_sabt "" UWORD B_TRUE 1 100 0.00 1.00000000000 BIT_MASK 0x800 FORMAT "%13.11" ECU_ADDRESS 0xFD9E /end MEASUREMENT
/begin MEASUREMENT B_sabte "" UWORD B_TRUE 1 100 0.00 1.00000000000 BIT_MASK 0x1000 FORMAT "%13.11" ECU_ADDRESS 0xFD9E /end MEASUREMENT
/begin MEASUREMENT B_sabv "" UWORD B_TRUE 1 100 0.00 1.00000000000 BIT_MASK 0x2000 FORMAT "%13.11" ECU_ADDRESS 0xFD9E /end MEASUREMENT
/begin MEASUREMENT B_saen "" UWORD B_TRUE 1 100 0.00 1.00000000000 BIT_MASK 0x4000 FORMAT "%13.11" ECU_ADDRESS 0xFD9E /end MEASUREMENT
/begin MEASUREMENT B_slsn2 "" UWORD B_TRUE 1 100 0.00 1.00000000000 BIT_MASK 0x40 FORMAT "%13.11" ECU_ADDRESS 0xFD10 /end MEASUREMENT
/begin MEASUREMENT B_spontan0 "" UWORD B_TRUE 1 100 0.00 1.00000000000 BIT_MASK 0x2000 FORMAT "%13.11" ECU_ADDRESS 0xFD62 /end MEASUREMENT
/begin MEASUREMENT B_spontan1 "" UWORD B_TRUE 1 100 0.00 1.00000000000 BIT_MASK 0x4000 FORMAT "%13.11" ECU_ADDRESS 0xFD62 /end MEASUREMENT
/begin MEASUREMENT B_spontan2 "" UWORD B_TRUE 1 100 0.00 1.00000000000 BIT_MASK 0x8000 FORMAT "%13.11" ECU_ADDRESS 0xFD62 /end MEASUREMENT
/begin MEASUREMENT B_spontan3 "" UWORD B_TRUE 1 100 0.00 1.00000000000 BIT_MASK 0x1 FORMAT "%13.11" ECU_ADDRESS 0xFD64 /end MEASUREMENT
/begin MEASUREMENT B_spontan4 "" UWORD B_TRUE 1 100 0.00 1.00000000000 BIT_MASK 0x2 FORMAT "%13.11" ECU_ADDRESS 0xFD64 /end MEASUREMENT
/begin MEASUREMENT B_spontan5 "" UWORD B_TRUE 1 100 0.00 1.00000000000 BIT_MASK 0x4 FORMAT "%13.11" ECU_ADDRESS 0xFD64 /end MEASUREMENT
/begin MEASUREMENT B_stndnl "" UBYTE B_TRUE 1 100 0.00 1.00000000000 BIT_MASK 0x1 FORMAT "%13.11" ECU_ADDRESS 0xF0724 /end MEASUREMENT
/begin MEASUREMENT B_sw0 "" UWORD B_TRUE 1 100 0.00 1.00000000000 BIT_MASK 0x80 FORMAT "%13.11" ECU_ADDRESS 0xFD10 /end MEASUREMENT
/begin MEASUREMENT B_sw1 "" UWORD B_TRUE 1 100 0.00 1.00000000000 BIT_MASK 0x100 FORMAT "%13.11" ECU_ADDRESS 0xFD10 /end MEASUREMENT
/begin MEASUREMENT B_synti "" UWORD B_TRUE 1 100 0.00 1.00000000000 BIT_MASK 0x8 FORMAT "%13.11" ECU_ADDRESS 0xFD64 /end MEASUREMENT
/begin MEASUREMENT B_tatmsa "" UBYTE B_TRUE 1 100 0.00 1.00000000000 BIT_MASK 0x8 FORMAT "%13.11" ECU_ADDRESS 0xF0ADE /end MEASUREMENT
/begin MEASUREMENT B_tevtstp "" UWORD B_TRUE 1 100 0.00 1.00000000000 BIT_MASK 0x200 FORMAT "%13.11" ECU_ADDRESS 0xFDBA /end MEASUREMENT
/begin MEASUREMENT B_ti_cha0 "" UWORD B_TRUE 1 100 0.00 1.00000000000 BIT_MASK 0x10 FORMAT "%13.11" ECU_ADDRESS 0xFD64 /end MEASUREMENT
/begin MEASUREMENT B_ti_cha1 "" UWORD B_TRUE 1 100 0.00 1.00000000000 BIT_MASK 0x20 FORMAT "%13.11" ECU_ADDRESS 0xFD64 /end MEASUREMENT
/begin MEASUREMENT B_ti_cha2 "" UWORD B_TRUE 1 100 0.00 1.00000000000 BIT_MASK 0x40 FORMAT "%13.11" ECU_ADDRESS 0xFD64 /end MEASUREMENT
/begin MEASUREMENT B_ti_cha3 "" UWORD B_TRUE 1 100 0.00 1.00000000000 BIT_MASK 0x80 FORMAT "%13.11" ECU_ADDRESS 0xFD64 /end MEASUREMENT
/begin MEASUREMENT B_ti_cha4 "" UWORD B_TRUE 1 100 0.00 1.00000000000 BIT_MASK 0x100 FORMAT "%13.11" ECU_ADDRESS 0xFD64 /end MEASUREMENT
/begin MEASUREMENT B_ti_cha5 "" UWORD B_TRUE 1 100 0.00 1.00000000000 BIT_MASK 0x200 FORMAT "%13.11" ECU_ADDRESS 0xFD64 /end MEASUREMENT
/begin MEASUREMENT B_ti_out0 "" UWORD B_TRUE 1 100 0.00 1.00000000000 BIT_MASK 0x400 FORMAT "%13.11" ECU_ADDRESS 0xFD64 /end MEASUREMENT
/begin MEASUREMENT B_ti_out1 "" UWORD B_TRUE 1 100 0.00 1.00000000000 BIT_MASK 0x800 FORMAT "%13.11" ECU_ADDRESS 0xFD64 /end MEASUREMENT
/begin MEASUREMENT B_ti_out2 "" UWORD B_TRUE 1 100 0.00 1.00000000000 BIT_MASK 0x1000 FORMAT "%13.11" ECU_ADDRESS 0xFD64 /end MEASUREMENT
/begin MEASUREMENT B_ti_out3 "" UWORD B_TRUE 1 100 0.00 1.00000000000 BIT_MASK 0x2000 FORMAT "%13.11" ECU_ADDRESS 0xFD64 /end MEASUREMENT
/begin MEASUREMENT B_ti_out4 "" UWORD B_TRUE 1 100 0.00 1.00000000000 BIT_MASK 0x4000 FORMAT "%13.11" ECU_ADDRESS 0xFD64 /end MEASUREMENT
/begin MEASUREMENT B_ti_out5 "" UWORD B_TRUE 1 100 0.00 1.00000000000 BIT_MASK 0x8000 FORMAT "%13.11" ECU_ADDRESS 0xFD64 /end MEASUREMENT
/begin MEASUREMENT B_ti_wai0 "" UWORD B_TRUE 1 100 0.00 1.00000000000 BIT_MASK 0x1 FORMAT "%13.11" ECU_ADDRESS 0xFD66 /end MEASUREMENT
/begin MEASUREMENT B_ti_wai1 "" UWORD B_TRUE 1 100 0.00 1.00000000000 BIT_MASK 0x2 FORMAT "%13.11" ECU_ADDRESS 0xFD66 /end MEASUREMENT
/begin MEASUREMENT B_ti_wai2 "" UWORD B_TRUE 1 100 0.00 1.00000000000 BIT_MASK 0x4 FORMAT "%13.11" ECU_ADDRESS 0xFD66 /end MEASUREMENT
/begin MEASUREMENT B_ti_wai3 "" UWORD B_TRUE 1 100 0.00 1.00000000000 BIT_MASK 0x8 FORMAT "%13.11" ECU_ADDRESS 0xFD66 /end MEASUREMENT
/begin MEASUREMENT B_ti_wai4 "" UWORD B_TRUE 1 100 0.00 1.00000000000 BIT_MASK 0x10 FORMAT "%13.11" ECU_ADDRESS 0xFD66 /end MEASUREMENT
/begin MEASUREMENT B_ti_wai5 "" UWORD B_TRUE 1 100 0.00 1.00000000000 BIT_MASK 0x20 FORMAT "%13.11" ECU_ADDRESS 0xFD66 /end MEASUREMENT
/begin MEASUREMENT B_tmotnwdf "" UBYTE B_TRUE 1 100 0.00 1.00000000000 BIT_MASK 0x4 FORMAT "%13.11" ECU_ADDRESS 0xF418D /end MEASUREMENT
/begin MEASUREMENT B_tolnwdf "" UBYTE B_TRUE 1 100 0.00 1.00000000000 BIT_MASK 0x8 FORMAT "%13.11" ECU_ADDRESS 0xF418D /end MEASUREMENT
/begin MEASUREMENT B_tooth "" UWORD B_TRUE 1 100 0.00 1.00000000000 BIT_MASK 0x400 FORMAT "%13.11" ECU_ADDRESS 0xFDCC /end MEASUREMENT
/begin MEASUREMENT B_tpnmot "" UWORD B_TRUE 1 100 0.00 1.00000000000 BIT_MASK 0x2000 FORMAT "%13.11" ECU_ADDRESS 0xFDA2 /end MEASUREMENT
/begin MEASUREMENT B_trkh "" UWORD B_TRUE 1 100 0.00 1.00000000000 BIT_MASK 0x2 FORMAT "%13.11" ECU_ADDRESS 0xFD8E /end MEASUREMENT
/begin MEASUREMENT B_tvars "" UWORD B_TRUE 1 100 0.00 1.00000000000 BIT_MASK 0x4000 FORMAT "%13.11" ECU_ADDRESS 0xFDA2 /end MEASUREMENT
/begin MEASUREMENT B_tvarsa "" UWORD B_TRUE 1 100 0.00 1.00000000000 BIT_MASK 0x8000 FORMAT "%13.11" ECU_ADDRESS 0xFDA2 /end MEASUREMENT
/begin MEASUREMENT B_tvarss "" UWORD B_TRUE 1 100 0.00 1.00000000000 BIT_MASK 0x1 FORMAT "%13.11" ECU_ADDRESS 0xFDA4 /end MEASUREMENT
/begin MEASUREMENT B_ubdve "" UWORD B_TRUE 1 100 0.00 1.00000000000 BIT_MASK 0x8 FORMAT "%13.11" ECU_ADDRESS 0xFD60 /end MEASUREMENT
/begin MEASUREMENT B_ubpvg "" UWORD B_TRUE 1 100 0.00 1.00000000000 BIT_MASK 0x10 FORMAT "%13.11" ECU_ADDRESS 0xFD60 /end MEASUREMENT
/begin MEASUREMENT B_ub_ok "" UWORD B_TRUE 1 100 0.00 1.00000000000 BIT_MASK 0x20 FORMAT "%13.11" ECU_ADDRESS 0xFD60 /end MEASUREMENT
/begin MEASUREMENT B_umsync "" UWORD B_TRUE 1 100 0.00 1.00000000000 BIT_MASK 0x40 FORMAT "%13.11" ECU_ADDRESS 0xFD66 /end MEASUREMENT
/begin MEASUREMENT B_wdksauf "" UWORD B_TRUE 1 100 0.00 1.00000000000 BIT_MASK 0x40 FORMAT "%13.11" ECU_ADDRESS 0xFD60 /end MEASUREMENT
/begin MEASUREMENT B_wdksive "" UWORD B_TRUE 1 100 0.00 1.00000000000 BIT_MASK 0x80 FORMAT "%13.11" ECU_ADDRESS 0xFD60 /end MEASUREMENT
/begin MEASUREMENT B_wksch "" UWORD B_TRUE 1 100 0.00 1.00000000000 BIT_MASK 0x2 FORMAT "%13.11" ECU_ADDRESS 0xFDA4 /end MEASUREMENT
/begin MEASUREMENT B_wnwsmxfa "" UBYTE B_TRUE 1 100 0.00 1.00000000000 BIT_MASK 0x4 FORMAT "%13.11" ECU_ADDRESS 0xF0BD5 /end MEASUREMENT
/begin MEASUREMENT B_wnwsmxfe "" UBYTE B_TRUE 1 100 0.00 1.00000000000 BIT_MASK 0x8 FORMAT "%13.11" ECU_ADDRESS 0xF0BD5 /end MEASUREMENT
/begin MEASUREMENT B_z1 "" UWORD B_TRUE 1 100 0.00 1.00000000000 BIT_MASK 0x200 FORMAT "%13.11" ECU_ADDRESS 0xFD10 /end MEASUREMENT
/begin MEASUREMENT B_z1not "" UWORD B_TRUE 1 100 0.00 1.00000000000 BIT_MASK 0x400 FORMAT "%13.11" ECU_ADDRESS 0xFD10 /end MEASUREMENT
/begin MEASUREMENT B_z1_i "" UWORD B_TRUE 1 100 0.00 1.00000000000 BIT_MASK 0x800 FORMAT "%13.11" ECU_ADDRESS 0xFD10 /end MEASUREMENT
/begin MEASUREMENT B_zesync "" UWORD B_TRUE 1 100 0.00 1.00000000000 BIT_MASK 0x1000 FORMAT "%13.11" ECU_ADDRESS 0xFD10 /end MEASUREMENT
/begin MEASUREMENT B_zesync_d "" UWORD B_TRUE 1 100 0.00 1.00000000000 BIT_MASK 0x2000 FORMAT "%13.11" ECU_ADDRESS 0xFD10 /end MEASUREMENT
/begin MEASUREMENT B_zws0 "" UWORD B_TRUE 1 100 0.00 1.00000000000 BIT_MASK 0x4000 FORMAT "%13.11" ECU_ADDRESS 0xFD10 /end MEASUREMENT
/begin MEASUREMENT cc_cha_0 "" UWORD dez 1 100 0.00 65535.00 FORMAT "%8.2" ECU_ADDRESS 0xE132 /end MEASUREMENT
/begin MEASUREMENT cc_cha_1 "" UWORD dez 1 100 0.00 65535.00 FORMAT "%8.2" ECU_ADDRESS 0xE134 /end MEASUREMENT
/begin MEASUREMENT cc_cha_2 "" UWORD dez 1 100 0.00 65535.00 FORMAT "%8.2" ECU_ADDRESS 0xE136 /end MEASUREMENT
/begin MEASUREMENT cc_cha_3 "" UWORD dez 1 100 0.00 65535.00 FORMAT "%8.2" ECU_ADDRESS 0xE138 /end MEASUREMENT
/begin MEASUREMENT cc_cha_4 "" UWORD dez 1 100 0.00 65535.00 FORMAT "%8.2" ECU_ADDRESS 0xE13A /end MEASUREMENT
/begin MEASUREMENT cc_cha_5 "" UWORD dez 1 100 0.00 65535.00 FORMAT "%8.2" ECU_ADDRESS 0xE13C /end MEASUREMENT
/begin MEASUREMENT countrev "" UBYTE dez 1 100 0.00 255.0 FORMAT "%5.1" ECU_ADDRESS 0xF0C38 /end MEASUREMENT
/begin MEASUREMENT dekpub "" UBYTE spg_q0p1 1 100 0.00 25.50 FORMAT "%5.2" ECU_ADDRESS 0xF0C7D /end MEASUREMENT
/begin MEASUREMENT deltaseg_w "" UWORD dez 1 100 0.00 65535.00 FORMAT "%8.2" ECU_ADDRESS 0xF1B50 /end MEASUREMENT
/begin MEASUREMENT dkattumg_w "" UWORD temp_q0p0234 1 100 0.00 1535.977 FORMAT "%8.3" ECU_ADDRESS 0xF46E6 /end MEASUREMENT
/begin MEASUREMENT dklagerc "" UBYTE t20msxs_ub_b5p1 1 100 0.00 5.100 FORMAT "%5.3" ECU_ADDRESS 0xF0850 /end MEASUREMENT
/begin MEASUREMENT dlrd "" UBYTE relDK_q4 1 100 0.00 1020. FORMAT "%5.0" ECU_ADDRESS 0xE0E2 /end MEASUREMENT
/begin MEASUREMENT dlrhaftak "" SWORD rel_q0p1957 1 100 -6412.524 6412.329 FORMAT "%8.3" ECU_ADDRESS 0xF4592 /end MEASUREMENT
/begin MEASUREMENT dlri "" UBYTE relDK_q0p0625 1 100 0.00 15.94 FORMAT "%5.2" ECU_ADDRESS 0xE0E3 /end MEASUREMENT
/begin MEASUREMENT dlriamax "" UWORD rel_q0p1957 1 100 0.00 12824.85 FORMAT "%8.2" ECU_ADDRESS 0xE0E8 /end MEASUREMENT
/begin MEASUREMENT dlriant_w "" SWORD rel_sw_q0p1953 1 100 -6400.000 6399.805 FORMAT "%8.3" ECU_ADDRESS 0xF1B3A /end MEASUREMENT
/begin MEASUREMENT dlrihaftc "" UBYTE t50msxs_q0p05 1 100 0.00 12.75 FORMAT "%5.2" ECU_ADDRESS 0xF40AF /end MEASUREMENT
/begin MEASUREMENT dlriklst_w "" SWORD rel_q0p1957 1 100 -6412.524 6412.329 FORMAT "%8.3" ECU_ADDRESS 0xF1B3C /end MEASUREMENT
/begin MEASUREMENT dlrikl_w "" SWORD rel_q0p1957 1 100 -6412.524 6412.329 FORMAT "%8.3" ECU_ADDRESS 0xE0EA /end MEASUREMENT
/begin MEASUREMENT dlrini_w "" UWORD rel_q0p1957 1 100 0.00 12824.85 FORMAT "%8.2" ECU_ADDRESS 0xF1B3E /end MEASUREMENT
/begin MEASUREMENT dlrkomp "" UBYTE fak_ub_b2 1 100 0.00 1.992 FORMAT "%5.3" ECU_ADDRESS 0xE0E4 /end MEASUREMENT
/begin MEASUREMENT dlrndif_w "" SWORD relDK_q0p02441 1 100 -800.0000 799.9756 FORMAT "%8.4" ECU_ADDRESS 0xE0EC /end MEASUREMENT
/begin MEASUREMENT dlrp "" UBYTE relDK_q1 1 100 0.00 255.0 FORMAT "%5.1" ECU_ADDRESS 0xE0E5 /end MEASUREMENT
/begin MEASUREMENT dlrpidc "" UWORD t10msxs_uw_b655p35 1 100 0.00 655.3500 FORMAT "%8.4" ECU_ADDRESS 0xF1B40 /end MEASUREMENT
/begin MEASUREMENT dlrspid_w "" UWORD rel_uw_b100 1 100 0.00 99.99847 FORMAT "%8.5" ECU_ADDRESS 0xE0EE /end MEASUREMENT
/begin MEASUREMENT dlrubrsq "" UBYTE spg_q0p1 1 100 0.00 25.50 FORMAT "%5.2" ECU_ADDRESS 0xF40B0 /end MEASUREMENT
/begin MEASUREMENT dmar_w "" SWORD rel_sw_b100 1 100 -100.0000 99.99695 FORMAT "%8.4" ECU_ADDRESS 0xF248A /end MEASUREMENT
/begin MEASUREMENT dmdevab "" UBYTE dez 1 100 0.00 255.0 FORMAT "%5.1" ECU_ADDRESS 0xF08D6 /end MEASUREMENT
/begin MEASUREMENT dncvt_w "" SWORD nmot_sw_q0p25 1 100 -8192.000 8191.750 FORMAT "%8.3" ECU_ADDRESS 0xF248C /end MEASUREMENT
/begin MEASUREMENT dnsa "" UBYTE nmot_ub_q40 1 100 0.00 10200. FORMAT "%5.0" ECU_ADDRESS 0xF0ADF /end MEASUREMENT
/begin MEASUREMENT dpspu "" UBYTE p_ub_q10 1 100 0.00 2550. FORMAT "%5.0" ECU_ADDRESS 0xF4103 /end MEASUREMENT
/begin MEASUREMENT dpwrsvc "" UWORD t10msxs_uw_b655p35 1 100 0.00 655.3500 FORMAT "%8.4" ECU_ADDRESS 0xF1B42 /end MEASUREMENT
/begin MEASUREMENT dqatmhx2_w "" SWORD qg_q5p333 1 100 -174762.7 174757.3 FORMAT "%8.1" ECU_ADDRESS 0xF4516 /end MEASUREMENT
/begin MEASUREMENT dqatmhx_w "" SWORD qg_q5p333 1 100 -174762.7 174757.3 FORMAT "%8.1" ECU_ADDRESS 0xF4518 /end MEASUREMENT
/begin MEASUREMENT dtatwhx2_w "" SWORD temp_q0p0468_K 1 100 -1536.000 1535.953 FORMAT "%8.3" ECU_ADDRESS 0xF451A /end MEASUREMENT
/begin MEASUREMENT dtatwhx_w "" SWORD temp_q0p0468_K 1 100 -1536.000 1535.953 FORMAT "%8.3" ECU_ADDRESS 0xF451C /end MEASUREMENT
/begin MEASUREMENT dtivkst_w "" UWORD temp_q0p0234 1 100 0.00 1535.977 FORMAT "%8.3" ECU_ADDRESS 0xF46E8 /end MEASUREMENT
/begin MEASUREMENT dveesc "" UBYTE t10msxs_ub_b2p55 1 100 0.00 2.550 FORMAT "%5.3" ECU_ADDRESS 0xF0851 /end MEASUREMENT
/begin MEASUREMENT dwdkdlr_w "" SWORD relDK_q0p02441 1 100 -800.0000 799.9756 FORMAT "%8.4" ECU_ADDRESS 0xE0F0 /end MEASUREMENT
/begin MEASUREMENT dzaCtr "" UBYTE dez 1 100 0.00 255.0 FORMAT "%5.1" ECU_ADDRESS 0xE010 /end MEASUREMENT
/begin MEASUREMENT eevx "" UBYTE dez 1 100 0.00 255.0 FORMAT "%5.1" ECU_ADDRESS 0xF40E1 /end MEASUREMENT
/begin MEASUREMENT esst_smk08mdsw "" UWORD dez 1 100 0.00 65535.00 FORMAT "%8.2" ECU_ADDRESS 0xF476E /end MEASUREMENT
/begin MEASUREMENT esst_snm08saub "" UWORD dez 1 100 0.00 65535.00 FORMAT "%8.2" ECU_ADDRESS 0xF2374 /end MEASUREMENT
/begin MEASUREMENT esst_sts06tmuw "" UWORD dez 1 100 0.00 65535.00 FORMAT "%8.2" ECU_ADDRESS 0xF4426 /end MEASUREMENT
/begin MEASUREMENT esst_stu05tmub "" UWORD dez 1 100 0.00 65535.00 FORMAT "%8.2" ECU_ADDRESS 0xF4428 /end MEASUREMENT
/begin MEASUREMENT etazwimt "" UBYTE rel_ub_b127p5 1 100 0.00 127.5 FORMAT "%5.1" ECU_ADDRESS 0xF405B /end MEASUREMENT
/begin MEASUREMENT evrbgn_one "" UBYTE dez 1 100 0.00 255.0 FORMAT "%5.1" ECU_ADDRESS 0xF08D7 /end MEASUREMENT
/begin MEASUREMENT evz_aus "" UBYTE dez 1 100 0.00 255.0 FORMAT "%5.1" ECU_ADDRESS 0xF08D8 /end MEASUREMENT
/begin MEASUREMENT evz_austot "" UBYTE dez 1 100 0.00 255.0 FORMAT "%5.1" ECU_ADDRESS 0xF08FC /end MEASUREMENT
/begin MEASUREMENT fbmxzahn "" UBYTE dez 1 100 0.00 255.0 FORMAT "%5.1" ECU_ADDRESS 0xE011 /end MEASUREMENT
/begin MEASUREMENT fdar "" UBYTE fak_ub_b3p125 1 100 0.00 3.113 FORMAT "%5.3" ECU_ADDRESS 0xF0B1A /end MEASUREMENT
/begin MEASUREMENT fdars "" UBYTE fak_ub_b3p125 1 100 0.00 3.113 FORMAT "%5.3" ECU_ADDRESS 0xF0B1B /end MEASUREMENT
/begin MEASUREMENT fdpatdmd "" UBYTE dez 1 100 0.00 255.0 FORMAT "%5.1" ECU_ADDRESS 0xF05C8 /end MEASUREMENT
/begin MEASUREMENT fevab "" UBYTE dez 1 100 0.00 255.0 FORMAT "%5.1" ECU_ADDRESS 0xF40E2 /end MEASUREMENT
/begin MEASUREMENT fevabe "" UBYTE dez 1 100 0.00 255.0 FORMAT "%5.1" ECU_ADDRESS 0xF40E3 /end MEASUREMENT
/begin MEASUREMENT fhost_w "" UWORD fak_uw_b4 1 100 0.00 3.999939 FORMAT "%8.6" ECU_ADDRESS 0xF46EA /end MEASUREMENT
/begin MEASUREMENT fkhab "" UBYTE fak_ub_b1 1 100 0.00 0.9961 ECU_ADDRESS 0xF0A49 /end MEASUREMENT
/begin MEASUREMENT fkhnab "" UBYTE fak_ub_b1 1 100 0.00 0.9961 ECU_ADDRESS 0xF0A4A /end MEASUREMENT
/begin MEASUREMENT flakh "" UBYTE fak_ub_b1 1 100 0.00 0.9961 ECU_ADDRESS 0xF0A4B /end MEASUREMENT
/begin MEASUREMENT flamkh "" UBYTE fak_ub_b1 1 100 0.00 0.9961 ECU_ADDRESS 0xF0A4C /end MEASUREMENT
/begin MEASUREMENT flrar "" UBYTE fak_ub_b16 1 100 0.00 15.94 FORMAT "%5.2" ECU_ADDRESS 0xF0B1C /end MEASUREMENT
/begin MEASUREMENT fmdkh "" UBYTE fak_ub_b1 1 100 0.00 0.9961 ECU_ADDRESS 0xF0A4D /end MEASUREMENT
/begin MEASUREMENT fmdkhtns_w "" UWORD fak_uw_b1 1 100 0.00 0.9999847 FORMAT "%9.7" ECU_ADDRESS 0xF229C /end MEASUREMENT
/begin MEASUREMENT fnwkha "" UBYTE fak_ub_b2 1 100 0.00 1.992 FORMAT "%5.3" ECU_ADDRESS 0xF411C /end MEASUREMENT
/begin MEASUREMENT fnwkhe "" UBYTE fak_ub_b2 1 100 0.00 1.992 FORMAT "%5.3" ECU_ADDRESS 0xF411D /end MEASUREMENT
/begin MEASUREMENT frhokor_w "" UWORD fak_uw_b4 1 100 0.00 3.999939 FORMAT "%8.6" ECU_ADDRESS 0xF46EC /end MEASUREMENT
/begin MEASUREMENT ftkhx2_w "" SWORD fak_q0p00347_JsK 1 100 -113.7778 113.7743 FORMAT "%8.4" ECU_ADDRESS 0xF451E /end MEASUREMENT
/begin MEASUREMENT ftkhx_w "" SWORD fak_q0p00347_JsK 1 100 -113.7778 113.7743 FORMAT "%8.4" ECU_ADDRESS 0xF4520 /end MEASUREMENT
/begin MEASUREMENT fubaanz_i "" UBYTE dez 1 100 0.00 255.0 FORMAT "%5.1" ECU_ADDRESS 0xE012 /end MEASUREMENT
/begin MEASUREMENT fubkor_w "" UWORD fak_uw_b2 1 100 0.00 1.999969 FORMAT "%8.6" ECU_ADDRESS 0xF29D2 /end MEASUREMENT
/begin MEASUREMENT fweg "" UBYTE fak_ub_b2 1 100 0.00 1.992 FORMAT "%5.3" ECU_ADDRESS 0xE10E /end MEASUREMENT
/begin MEASUREMENT fwez0 "" UBYTE fak_ub_b2 1 100 0.00 1.992 FORMAT "%5.3" ECU_ADDRESS 0xE10F /end MEASUREMENT
/begin MEASUREMENT fwez1 "" UBYTE fak_ub_b2 1 100 0.00 1.992 FORMAT "%5.3" ECU_ADDRESS 0xE110 /end MEASUREMENT
/begin MEASUREMENT fwez2 "" UBYTE fak_ub_b2 1 100 0.00 1.992 FORMAT "%5.3" ECU_ADDRESS 0xE111 /end MEASUREMENT
/begin MEASUREMENT fwez3 "" UBYTE fak_ub_b2 1 100 0.00 1.992 FORMAT "%5.3" ECU_ADDRESS 0xE112 /end MEASUREMENT
/begin MEASUREMENT fwez4 "" UBYTE fak_ub_b2 1 100 0.00 1.992 FORMAT "%5.3" ECU_ADDRESS 0xE113 /end MEASUREMENT
/begin MEASUREMENT fwez5 "" UBYTE fak_ub_b2 1 100 0.00 1.992 FORMAT "%5.3" ECU_ADDRESS 0xE114 /end MEASUREMENT
/begin MEASUREMENT gangi "" UBYTE dez 1 100 0.00 255.0 FORMAT "%5.1" ECU_ADDRESS 0xF080C /end MEASUREMENT
/begin MEASUREMENT gangist "" UBYTE dez 1 100 0.00 255.0 FORMAT "%5.1" ECU_ADDRESS 0xF40A9 /end MEASUREMENT
/begin MEASUREMENT gwdkdlr_w "" SWORD relDK_q0p00152 1 100 -50.00000 49.99847 FORMAT "%8.5" ECU_ADDRESS 0xE0F2 /end MEASUREMENT
/begin MEASUREMENT gwdk_kge "" UWORD relDK_q0p00152 1 100 0.00 99.99847 FORMAT "%8.5" ECU_ADDRESS 0xF1B44 /end MEASUREMENT
/begin MEASUREMENT ignDelayCtr "" UBYTE dez 1 100 0.00 255.0 FORMAT "%5.1" ECU_ADDRESS 0xE013 /end MEASUREMENT
/begin MEASUREMENT imlatm "" UBYTE m_ub_b23p3 1 100 0.00 23.21 FORMAT "%5.2" ECU_ADDRESS 0xF405C /end MEASUREMENT
/begin MEASUREMENT imlatmst_w "" UWORD m_uw_b23p3 1 100 0.00 23.30133 FORMAT "%8.5" ECU_ADDRESS 0xF46EE /end MEASUREMENT
/begin MEASUREMENT imlatmw_w "" UWORD m_uw_b23p3 1 100 0.00 23.30133 FORMAT "%8.5" ECU_ADDRESS 0xF46F0 /end MEASUREMENT
/begin MEASUREMENT imlatm_w "" UWORD m_uw_b23p3 1 100 0.00 23.30133 FORMAT "%8.5" ECU_ADDRESS 0xF442A /end MEASUREMENT
/begin MEASUREMENT imlbbo "" UBYTE m_ub_b23p3 1 100 0.00 23.21 FORMAT "%5.2" ECU_ADDRESS 0x38401C /end MEASUREMENT
/begin MEASUREMENT imlpr "" UBYTE fak_ub_b1 1 100 0.00 0.9961 ECU_ADDRESS 0xF0A4E /end MEASUREMENT
/begin MEASUREMENT imlpr_w "" UWORD fak_uw_b1 1 100 0.00 0.9999847 FORMAT "%9.7" ECU_ADDRESS 0xF229E /end MEASUREMENT
/begin MEASUREMENT iwmatm2_w "" UWORD q_q0p4551 1 100 0.00 29825.71 FORMAT "%8.2" ECU_ADDRESS 0xF442C /end MEASUREMENT
/begin MEASUREMENT iwmatm_w "" UWORD q_q0p4551 1 100 0.00 29825.71 FORMAT "%8.2" ECU_ADDRESS 0xF442E /end MEASUREMENT
/begin MEASUREMENT kifz_w "" UWORD fak_uw_b4864 1 100 0.00 4863.926 FORMAT "%8.3" ECU_ADDRESS 0xF248E /end MEASUREMENT
/begin MEASUREMENT mdbes_w "" SWORD rel_sw_b100 1 100 -100.0000 99.99695 FORMAT "%8.4" ECU_ADDRESS 0xF2490 /end MEASUREMENT
/begin MEASUREMENT minzahn "" UBYTE dez 1 100 0.00 255.0 FORMAT "%5.1" ECU_ADDRESS 0xE014 /end MEASUREMENT
/begin MEASUREMENT mkar_w "" SWORD rel_sw_b100 1 100 -100.0000 99.99695 FORMAT "%8.4" ECU_ADDRESS 0xF2492 /end MEASUREMENT
/begin MEASUREMENT mlast_w "" SWORD rel_sw_b100 1 100 -100.0000 99.99695 FORMAT "%8.4" ECU_ADDRESS 0xF2494 /end MEASUREMENT
/begin MEASUREMENT mlsuini_w "" UWORD m_uw_b23p3 1 100 0.00 23.30133 FORMAT "%8.5" ECU_ADDRESS 0xF46F2 /end MEASUREMENT
/begin MEASUREMENT mlsu_w "" UWORD m_uw_b23p3 1 100 0.00 23.30133 FORMAT "%8.5" ECU_ADDRESS 0xF46F4 /end MEASUREMENT
/begin MEASUREMENT msntev_w "" UWORD m_uw_b25p6 1 100 0.00 25.59961 FORMAT "%8.5" ECU_ADDRESS 0xF2A9C /end MEASUREMENT
/begin MEASUREMENT mspcv "" UBYTE m_q0p1 1 100 0.00 25.50 FORMAT "%5.2" ECU_ADDRESS 0xF4104 /end MEASUREMENT
/begin MEASUREMENT na_abs_c "" UBYTE dez 1 100 0.00 255.0 FORMAT "%5.1" ECU_ADDRESS 0xE115 /end MEASUREMENT
/begin MEASUREMENT na_rel_c "" UBYTE dez 1 100 0.00 255.0 FORMAT "%5.1" ECU_ADDRESS 0xE116 /end MEASUREMENT
/begin MEASUREMENT ndar_w "" SWORD nmot_sw_q0p25 1 100 -8192.000 8191.750 FORMAT "%8.3" ECU_ADDRESS 0xF2496 /end MEASUREMENT
/begin MEASUREMENT ndcdis_w "" UWORD nmot_uw_q0p25 1 100 0.00 16383.75 FORMAT "%8.2" ECU_ADDRESS 0xF1FD8 /end MEASUREMENT
/begin MEASUREMENT ndfil_w "" SWORD nmot_sw_q0p25 1 100 -8192.000 8191.750 FORMAT "%8.3" ECU_ADDRESS 0xF2498 /end MEASUREMENT
/begin MEASUREMENT ndiffog_w "" SWORD nmot_sw_q0p25 1 100 -8192.000 8191.750 FORMAT "%8.3" ECU_ADDRESS 0xF249A /end MEASUREMENT
/begin MEASUREMENT ndiff_w "" SWORD nmot_sw_q0p25 1 100 -8192.000 8191.750 FORMAT "%8.3" ECU_ADDRESS 0xF249C /end MEASUREMENT
/begin MEASUREMENT ndnwtmn "" UBYTE nmot_ub_q40 1 100 0.00 10200. FORMAT "%5.0" ECU_ADDRESS 0xF4190 /end MEASUREMENT
/begin MEASUREMENT nfskh "" UBYTE nmot_ub_q10 1 100 0.00 2550. FORMAT "%5.0" ECU_ADDRESS 0xF0A4F /end MEASUREMENT
/begin MEASUREMENT nllkh "" UBYTE nmot_ub_q10 1 100 0.00 2550. FORMAT "%5.0" ECU_ADDRESS 0xF0A50 /end MEASUREMENT
/begin MEASUREMENT nmodiv_w "" UWORD nmot_uw_q0p25 1 100 0.00 16383.75 FORMAT "%8.2" ECU_ADDRESS 0xF249E /end MEASUREMENT
/begin MEASUREMENT nmod_w "" UWORD nmot_uw_q0p25 1 100 0.00 16383.75 FORMAT "%8.2" ECU_ADDRESS 0xF24A0 /end MEASUREMENT
/begin MEASUREMENT nnwtoelmn "" UBYTE nmot_ub_q40 1 100 0.00 10200. FORMAT "%5.0" ECU_ADDRESS 0xF4187 /end MEASUREMENT
/begin MEASUREMENT nsa "" UBYTE nmot_ub_q40 1 100 0.00 10200. FORMAT "%5.0" ECU_ADDRESS 0xF0AE0 /end MEASUREMENT
/begin MEASUREMENT nvquot_w "" UWORD qnv_uw_b512 1 100 0.00 511.9922 FORMAT "%8.4" ECU_ADDRESS 0xF1AB8 /end MEASUREMENT
/begin MEASUREMENT nwe "" UBYTE nmot_ub_q40 1 100 0.00 10200. FORMAT "%5.0" ECU_ADDRESS 0xF0AE1 /end MEASUREMENT
/begin MEASUREMENT nwecvt "" UBYTE nmot_ub_q40 1 100 0.00 10200. FORMAT "%5.0" ECU_ADDRESS 0xF414B /end MEASUREMENT
/begin MEASUREMENT nwema "" UBYTE nmot_ub_q40 1 100 0.00 10200. FORMAT "%5.0" ECU_ADDRESS 0xF0AE2 /end MEASUREMENT
/begin MEASUREMENT nwemn "" UBYTE nmot_ub_q40 1 100 0.00 10200. FORMAT "%5.0" ECU_ADDRESS 0xF0AE3 /end MEASUREMENT
/begin MEASUREMENT nwenga "" UBYTE nmot_ub_q40 1 100 0.00 10200. FORMAT "%5.0" ECU_ADDRESS 0xF0AE4 /end MEASUREMENT
/begin MEASUREMENT ovlCtr "" UBYTE dez 1 100 0.00 255.0 FORMAT "%5.1" ECU_ADDRESS 0xE015 /end MEASUREMENT
/begin MEASUREMENT pd_we_zy "" UWORD dez 1 100 0.00 65535.00 FORMAT "%8.2" ECU_ADDRESS 0xE13E /end MEASUREMENT
/begin MEASUREMENT quatmhx2_w "" SWORD qg_q5p333 1 100 -174762.7 174757.3 FORMAT "%8.1" ECU_ADDRESS 0xF4522 /end MEASUREMENT
/begin MEASUREMENT quatmhx_w "" SWORD qg_q5p333 1 100 -174762.7 174757.3 FORMAT "%8.1" ECU_ADDRESS 0xF4524 /end MEASUREMENT
/begin MEASUREMENT qwatmhx2_w "" SWORD qg_q5p333 1 100 -174762.7 174757.3 FORMAT "%8.1" ECU_ADDRESS 0xF4526 /end MEASUREMENT
/begin MEASUREMENT qwatmhx_w "" SWORD qg_q5p333 1 100 -174762.7 174757.3 FORMAT "%8.1" ECU_ADDRESS 0xF4528 /end MEASUREMENT
/begin MEASUREMENT redsolr "" UBYTE dez 1 100 0.00 255.0 FORMAT "%5.1" ECU_ADDRESS 0xF08D9 /end MEASUREMENT
/begin MEASUREMENT redsol_one "" UBYTE dez 1 100 0.00 255.0 FORMAT "%5.1" ECU_ADDRESS 0xF08DA /end MEASUREMENT
/begin MEASUREMENT restw_b1 "" UBYTE dez 1 100 0.00 255.0 FORMAT "%5.1" ECU_ADDRESS 0xE117 /end MEASUREMENT
/begin MEASUREMENT restw_b2 "" UBYTE dez 1 100 0.00 255.0 FORMAT "%5.1" ECU_ADDRESS 0xE118 /end MEASUREMENT
/begin MEASUREMENT rlnw_w "" UWORD rel_uw_q0p0234 1 100 0.00 1535.977 FORMAT "%8.3" ECU_ADDRESS 0xF4F3A /end MEASUREMENT
/begin MEASUREMENT segz "" UBYTE dez 1 100 0.00 255.0 FORMAT "%5.1" ARRAY_SIZE 6 ECU_ADDRESS 0xE119 /end MEASUREMENT
/begin MEASUREMENT slsninkr "" UBYTE dez 1 100 0.00 255.0 FORMAT "%5.1" ECU_ADDRESS 0xE016 /end MEASUREMENT
/begin MEASUREMENT slsninkr2 "" UBYTE dez 1 100 0.00 255.0 FORMAT "%5.1" ECU_ADDRESS 0xE017 /end MEASUREMENT
/begin MEASUREMENT slsninkr_r "" UBYTE dez 1 100 0.00 255.0 FORMAT "%5.1" ECU_ADDRESS 0xE018 /end MEASUREMENT
/begin MEASUREMENT slsnzahn "" UBYTE dez 1 100 0.00 255.0 FORMAT "%5.1" ECU_ADDRESS 0xE019 /end MEASUREMENT
/begin MEASUREMENT slsnzahn2 "" UBYTE dez 1 100 0.00 255.0 FORMAT "%5.1" ECU_ADDRESS 0xE01A /end MEASUREMENT
/begin MEASUREMENT slsnzahn_r "" UBYTE dez 1 100 0.00 255.0 FORMAT "%5.1" ECU_ADDRESS 0xE01B /end MEASUREMENT
/begin MEASUREMENT sn2zkact "" UWORD dez 1 100 0.00 65535.00 FORMAT "%8.2" ECU_ADDRESS 0xE034 /end MEASUREMENT
/begin MEASUREMENT sn2zkvek "" UWORD dez 1 100 0.00 65535.00 FORMAT "%8.2" ECU_ADDRESS 0xE036 /end MEASUREMENT
/begin MEASUREMENT snzkact "" UWORD dez 1 100 0.00 65535.00 FORMAT "%8.2" ECU_ADDRESS 0xE038 /end MEASUREMENT
/begin MEASUREMENT snzkvek "" UWORD dez 1 100 0.00 65535.00 FORMAT "%8.2" ECU_ADDRESS 0xE03A /end MEASUREMENT
/begin MEASUREMENT stateaevab "" UBYTE dez 1 100 0.00 255.0 FORMAT "%5.1" ECU_ADDRESS 0xF08DB /end MEASUREMENT
/begin MEASUREMENT swout "" UWORD zw_azue_sy 1 100 0.00 49151.25 FORMAT "%8.2" ECU_ADDRESS 0xE03C /end MEASUREMENT
/begin MEASUREMENT tabgkrm2_w "" UWORD temp_uw_q0p0195_o50 1 100 -50.00000 1229.980 FORMAT "%8.3" ECU_ADDRESS 0xF4430 /end MEASUREMENT
/begin MEASUREMENT tabgkrm_w "" UWORD temp_uw_q0p0195_o50 1 100 -50.00000 1229.980 FORMAT "%8.3" ECU_ADDRESS 0xF4432 /end MEASUREMENT
/begin MEASUREMENT tabgm "" UBYTE temp_ub_q5_o50 1 100 -50.00 1225. FORMAT "%5.0" ECU_ADDRESS 0xF405D /end MEASUREMENT
/begin MEASUREMENT tabgm2 "" UBYTE temp_ub_q5_o50 1 100 -50.00 1225. FORMAT "%5.0" ECU_ADDRESS 0xF405E /end MEASUREMENT
/begin MEASUREMENT tabgm2_w "" UWORD temp_uw_q0p0195_o50 1 100 -50.00000 1229.980 FORMAT "%8.3" ECU_ADDRESS 0xF4434 /end MEASUREMENT
/begin MEASUREMENT tabgmab "" UBYTE temp_ub_q5_o50 1 100 -50.00 1225. FORMAT "%5.0" ECU_ADDRESS 0x382043 /end MEASUREMENT
/begin MEASUREMENT tabgmab2 "" UBYTE temp_ub_q5_o50 1 100 -50.00 1225. FORMAT "%5.0" ECU_ADDRESS 0x382044 /end MEASUREMENT
/begin MEASUREMENT tabgmst "" UBYTE temp_ub_q5_o50 1 100 -50.00 1225. FORMAT "%5.0" ECU_ADDRESS 0xF405F /end MEASUREMENT
/begin MEASUREMENT tabgmst2 "" UBYTE temp_ub_q5_o50 1 100 -50.00 1225. FORMAT "%5.0" ECU_ADDRESS 0xF4060 /end MEASUREMENT
/begin MEASUREMENT tabgm_w "" UWORD temp_uw_q0p0195_o50 1 100 -50.00000 1229.980 FORMAT "%8.3" ECU_ADDRESS 0xF4436 /end MEASUREMENT
/begin MEASUREMENT tabstatm_w "" UWORD t1sxs_uw_q1 1 100 0.00 65535.00 FORMAT "%8.2" ECU_ADDRESS 0xF4438 /end MEASUREMENT
/begin MEASUREMENT tabstmx_w "" UWORD t1sxs_uw_q1 1 100 0.00 65535.00 FORMAT "%8.2" ECU_ADDRESS 0x382ED2 /end MEASUREMENT
/begin MEASUREMENT tahrlsu2_w "" UWORD rel_uw_b200 1 100 0.00 199.9969 FORMAT "%8.4" ECU_ADDRESS 0xF29D4 /end MEASUREMENT
/begin MEASUREMENT tahrlsu_w "" UWORD rel_uw_b200 1 100 0.00 199.9969 FORMAT "%8.4" ECU_ADDRESS 0xF29D6 /end MEASUREMENT
/begin MEASUREMENT takrkf "" UBYTE temp_ub_q5_o50 1 100 -50.00 1225. FORMAT "%5.0" ECU_ADDRESS 0xF4061 /end MEASUREMENT
/begin MEASUREMENT takrkf2 "" UBYTE temp_ub_q5_o50 1 100 -50.00 1225. FORMAT "%5.0" ECU_ADDRESS 0xF4062 /end MEASUREMENT
/begin MEASUREMENT takrstc "" UBYTE temp_ub_q5_o50 1 100 -50.00 1225. FORMAT "%5.0" ECU_ADDRESS 0xF4063 /end MEASUREMENT
/begin MEASUREMENT takrstc2 "" UBYTE temp_ub_q5_o50 1 100 -50.00 1225. FORMAT "%5.0" ECU_ADDRESS 0xF4064 /end MEASUREMENT
/begin MEASUREMENT talsum2_w "" UWORD temp_q0p0234_o273 1 100 -273.1500 1262.827 FORMAT "%8.3" ECU_ADDRESS 0xF452A /end MEASUREMENT
/begin MEASUREMENT talsum_w "" UWORD temp_q0p0234_o273 1 100 -273.1500 1262.827 FORMAT "%8.3" ECU_ADDRESS 0xF452C /end MEASUREMENT
/begin MEASUREMENT tanskhst "" UBYTE temp_ub_q0p75_o48 1 100 -48.00 143.3 FORMAT "%5.1" ECU_ADDRESS 0xF411E /end MEASUREMENT
/begin MEASUREMENT tatakrml "" UBYTE temp_ub_q5_o50 1 100 -50.00 1225. FORMAT "%5.0" ECU_ADDRESS 0xF4065 /end MEASUREMENT
/begin MEASUREMENT tatakrml2 "" UBYTE temp_ub_q5_o50 1 100 -50.00 1225. FORMAT "%5.0" ECU_ADDRESS 0xF4066 /end MEASUREMENT
/begin MEASUREMENT tateist "" UBYTE rel_ub_b99p6 1 100 0.00 99.61 FORMAT "%5.2" ECU_ADDRESS 0xF0BB6 /end MEASUREMENT
/begin MEASUREMENT tateist_w "" UWORD rel_uw_b100 1 100 0.00 99.99847 FORMAT "%8.5" ECU_ADDRESS 0xF2A9E /end MEASUREMENT
/begin MEASUREMENT tateout "" UBYTE rel_ub_b99p6 1 100 0.00 99.61 FORMAT "%5.2" ECU_ADDRESS 0xF0BB7 /end MEASUREMENT
/begin MEASUREMENT tateout_w "" UWORD rel_uw_b100 1 100 0.00 99.99847 FORMAT "%8.5" ECU_ADDRESS 0xF2AA0 /end MEASUREMENT
/begin MEASUREMENT tateroh "" UBYTE rel_ub_b99p6 1 100 0.00 99.61 FORMAT "%5.2" ECU_ADDRESS 0xF0BB8 /end MEASUREMENT
/begin MEASUREMENT tateroh_w "" UWORD rel_uw_b100 1 100 0.00 99.99847 FORMAT "%8.5" ECU_ADDRESS 0xF2AA2 /end MEASUREMENT
/begin MEASUREMENT tatesoll "" UBYTE rel_ub_b99p6 1 100 0.00 99.61 FORMAT "%5.2" ECU_ADDRESS 0xF0BB9 /end MEASUREMENT
/begin MEASUREMENT tatesoll_w "" UWORD rel_uw_b100 1 100 0.00 99.99847 FORMAT "%8.5" ECU_ADDRESS 0xF2AA4 /end MEASUREMENT
/begin MEASUREMENT tatmaml "" UBYTE temp_ub_q5_o50 1 100 -50.00 1225. FORMAT "%5.0" ECU_ADDRESS 0xF4067 /end MEASUREMENT
/begin MEASUREMENT tatmaml2 "" UBYTE temp_ub_q5_o50 1 100 -50.00 1225. FORMAT "%5.0" ECU_ADDRESS 0xF4068 /end MEASUREMENT
/begin MEASUREMENT tatmkf "" UBYTE temp_ub_q5_o50 1 100 -50.00 1225. FORMAT "%5.0" ECU_ADDRESS 0xF4069 /end MEASUREMENT
/begin MEASUREMENT tatmkf2 "" UBYTE temp_ub_q5_o50 1 100 -50.00 1225. FORMAT "%5.0" ECU_ADDRESS 0xF406A /end MEASUREMENT
/begin MEASUREMENT tatmrml "" UBYTE temp_ub_q5_o50 1 100 -50.00 1225. FORMAT "%5.0" ECU_ADDRESS 0xF406B /end MEASUREMENT
/begin MEASUREMENT tatmrml2 "" UBYTE temp_ub_q5_o50 1 100 -50.00 1225. FORMAT "%5.0" ECU_ADDRESS 0xF406C /end MEASUREMENT
/begin MEASUREMENT tatmsta "" UBYTE temp_ub_q5_o50 1 100 -50.00 1225. FORMAT "%5.0" ECU_ADDRESS 0xF406D /end MEASUREMENT
/begin MEASUREMENT tatmsta2 "" UBYTE temp_ub_q5_o50 1 100 -50.00 1225. FORMAT "%5.0" ECU_ADDRESS 0xF406E /end MEASUREMENT
/begin MEASUREMENT tatrkrml "" UBYTE temp_ub_q5_o50 1 100 -50.00 1225. FORMAT "%5.0" ECU_ADDRESS 0xF406F /end MEASUREMENT
/begin MEASUREMENT tatrkrml2 "" UBYTE temp_ub_q5_o50 1 100 -50.00 1225. FORMAT "%5.0" ECU_ADDRESS 0xF4070 /end MEASUREMENT
/begin MEASUREMENT tatu "" UBYTE temp_ub_q0p75_o48 1 100 -48.00 143.3 FORMAT "%5.1" ECU_ADDRESS 0xF4071 /end MEASUREMENT
/begin MEASUREMENT tbdbkvp_l "" ULONG t20msxs_uw_q0p02 1 100 0.00 85899345.9000 FORMAT "%13.4" ECU_ADDRESS 0x383168 /end MEASUREMENT
/begin MEASUREMENT tbdbkvp_w "" UWORD t20msxs_q40p96 1 100 0.00 2684314. FORMAT "%8.0" ECU_ADDRESS 0xF2D28 /end MEASUREMENT
/begin MEASUREMENT tevper "" UBYTE t500usxms_ub_q0p5 1 100 0.00 127.5 FORMAT "%5.1" ECU_ADDRESS 0xF4177 /end MEASUREMENT
/begin MEASUREMENT texkor "" UBYTE fak_ub_b2 1 100 0.00 1.992 FORMAT "%5.3" ECU_ADDRESS 0xF4072 /end MEASUREMENT
/begin MEASUREMENT texkor2 "" UBYTE fak_ub_b2 1 100 0.00 1.992 FORMAT "%5.3" ECU_ADDRESS 0xF4073 /end MEASUREMENT
/begin MEASUREMENT texml "" SBYTE temp_q5 1 100 -640.0 635.0 FORMAT "%5.1" ECU_ADDRESS 0xF4074 /end MEASUREMENT
/begin MEASUREMENT texml2 "" SBYTE temp_q5 1 100 -640.0 635.0 FORMAT "%5.1" ECU_ADDRESS 0xF4075 /end MEASUREMENT
/begin MEASUREMENT texoikm2_w "" SWORD temp_q0p0195 1 100 -640.0000 639.9805 FORMAT "%8.4" ECU_ADDRESS 0xF443A /end MEASUREMENT
/begin MEASUREMENT texoikm_w "" SWORD temp_q0p0195 1 100 -640.0000 639.9805 FORMAT "%8.4" ECU_ADDRESS 0xF443C /end MEASUREMENT
/begin MEASUREMENT texom2_w "" SWORD temp_q0p0195 1 100 -640.0000 639.9805 FORMAT "%8.4" ECU_ADDRESS 0xF443E /end MEASUREMENT
/begin MEASUREMENT texom_w "" SWORD temp_q0p0195 1 100 -640.0000 639.9805 FORMAT "%8.4" ECU_ADDRESS 0xF4440 /end MEASUREMENT
/begin MEASUREMENT thxlsum2_w "" UWORD temp_q0p0234_o273 1 100 -273.1500 1262.827 FORMAT "%8.3" ECU_ADDRESS 0xF452E /end MEASUREMENT
/begin MEASUREMENT thxlsum_w "" UWORD temp_q0p0234_o273 1 100 -273.1500 1262.827 FORMAT "%8.3" ECU_ADDRESS 0xF4530 /end MEASUREMENT
/begin MEASUREMENT tiexkor "" UBYTE fak_ub_b2 1 100 0.00 1.992 FORMAT "%5.3" ECU_ADDRESS 0xF4076 /end MEASUREMENT
/begin MEASUREMENT tiexkor2 "" UBYTE fak_ub_b2 1 100 0.00 1.992 FORMAT "%5.3" ECU_ADDRESS 0xF4077 /end MEASUREMENT
/begin MEASUREMENT tiexml "" SBYTE temp_q5 1 100 -640.0 635.0 FORMAT "%5.1" ECU_ADDRESS 0xF4078 /end MEASUREMENT
/begin MEASUREMENT tiexml2 "" SBYTE temp_q5 1 100 -640.0 635.0 FORMAT "%5.1" ECU_ADDRESS 0xF4079 /end MEASUREMENT
/begin MEASUREMENT tikatm "" UBYTE temp_ub_q5_o50 1 100 -50.00 1225. FORMAT "%5.0" ECU_ADDRESS 0xF407A /end MEASUREMENT
/begin MEASUREMENT tikatm2 "" UBYTE temp_ub_q5_o50 1 100 -50.00 1225. FORMAT "%5.0" ECU_ADDRESS 0xF407B /end MEASUREMENT
/begin MEASUREMENT tikatm2_w "" UWORD temp_uw_q0p0195_o50 1 100 -50.00000 1229.980 FORMAT "%8.3" ECU_ADDRESS 0xF4442 /end MEASUREMENT
/begin MEASUREMENT tikatmnl "" UBYTE temp_ub_q5_o50 1 100 -50.00 1225. FORMAT "%5.0" ECU_ADDRESS 0x384020 /end MEASUREMENT
/begin MEASUREMENT tikatm_w "" UWORD temp_uw_q0p0195_o50 1 100 -50.00000 1229.980 FORMAT "%8.3" ECU_ADDRESS 0xF4444 /end MEASUREMENT
/begin MEASUREMENT tinkr "" UWORD dez 1 100 0.00 65535.00 FORMAT "%8.2" ECU_ADDRESS 0xE03E /end MEASUREMENT
/begin MEASUREMENT tivkst_w "" UWORD temp_q0p0234_o273 1 100 -273.1500 1262.827 FORMAT "%8.3" ECU_ADDRESS 0xF46F6 /end MEASUREMENT
/begin MEASUREMENT ti_ev0 "" UWORD tinjection_sy 1 100 0.00 209.7120 FORMAT "%8.4" ECU_ADDRESS 0xE140 /end MEASUREMENT
/begin MEASUREMENT ti_ev1 "" UWORD tinjection_sy 1 100 0.00 209.7120 FORMAT "%8.4" ECU_ADDRESS 0xE142 /end MEASUREMENT
/begin MEASUREMENT ti_ev2 "" UWORD tinjection_sy 1 100 0.00 209.7120 FORMAT "%8.4" ECU_ADDRESS 0xE144 /end MEASUREMENT
/begin MEASUREMENT ti_ev3 "" UWORD tinjection_sy 1 100 0.00 209.7120 FORMAT "%8.4" ECU_ADDRESS 0xE146 /end MEASUREMENT
/begin MEASUREMENT ti_ev4 "" UWORD tinjection_sy 1 100 0.00 209.7120 FORMAT "%8.4" ECU_ADDRESS 0xE148 /end MEASUREMENT
/begin MEASUREMENT ti_ev5 "" UWORD tinjection_sy 1 100 0.00 209.7120 FORMAT "%8.4" ECU_ADDRESS 0xE14A /end MEASUREMENT
/begin MEASUREMENT ti_sto_0 "" UWORD tinjection_sy 1 100 0.00 209.7120 FORMAT "%8.4" ECU_ADDRESS 0xE14C /end MEASUREMENT
/begin MEASUREMENT ti_sto_1 "" UWORD tinjection_sy 1 100 0.00 209.7120 FORMAT "%8.4" ECU_ADDRESS 0xE14E /end MEASUREMENT
/begin MEASUREMENT ti_sto_2 "" UWORD tinjection_sy 1 100 0.00 209.7120 FORMAT "%8.4" ECU_ADDRESS 0xE150 /end MEASUREMENT
/begin MEASUREMENT ti_sto_3 "" UWORD tinjection_sy 1 100 0.00 209.7120 FORMAT "%8.4" ECU_ADDRESS 0xE152 /end MEASUREMENT
/begin MEASUREMENT ti_sto_4 "" UWORD tinjection_sy 1 100 0.00 209.7120 FORMAT "%8.4" ECU_ADDRESS 0xE154 /end MEASUREMENT
/begin MEASUREMENT ti_sto_5 "" UWORD tinjection_sy 1 100 0.00 209.7120 FORMAT "%8.4" ECU_ADDRESS 0xE156 /end MEASUREMENT
/begin MEASUREMENT tkatm "" UBYTE temp_ub_q5_o50 1 100 -50.00 1225. FORMAT "%5.0" ECU_ADDRESS 0xF407C /end MEASUREMENT
/begin MEASUREMENT tkatm2 "" UBYTE temp_ub_q5_o50 1 100 -50.00 1225. FORMAT "%5.0" ECU_ADDRESS 0xF407D /end MEASUREMENT
/begin MEASUREMENT tkatm2_w "" UWORD temp_uw_q0p0195_o50 1 100 -50.00000 1229.980 FORMAT "%8.3" ECU_ADDRESS 0xF4446 /end MEASUREMENT
/begin MEASUREMENT tkatmab "" UBYTE temp_ub_q5_o50 1 100 -50.00 1225. FORMAT "%5.0" ECU_ADDRESS 0x382045 /end MEASUREMENT
/begin MEASUREMENT tkatmab2 "" UBYTE temp_ub_q5_o50 1 100 -50.00 1225. FORMAT "%5.0" ECU_ADDRESS 0x382046 /end MEASUREMENT
/begin MEASUREMENT tkatmst "" UBYTE temp_ub_q5_o50 1 100 -50.00 1225. FORMAT "%5.0" ECU_ADDRESS 0xF407E /end MEASUREMENT
/begin MEASUREMENT tkatmst2 "" UBYTE temp_ub_q5_o50 1 100 -50.00 1225. FORMAT "%5.0" ECU_ADDRESS 0xF407F /end MEASUREMENT
/begin MEASUREMENT tkatm_w "" UWORD temp_uw_q0p0195_o50 1 100 -50.00000 1229.980 FORMAT "%8.3" ECU_ADDRESS 0xF4448 /end MEASUREMENT
/begin MEASUREMENT tkhnab_ctr "" UWORD t100msxs_uw_b6553p5 1 100 0.00 6553.500 FORMAT "%8.3" ECU_ADDRESS 0xF22A0 /end MEASUREMENT
/begin MEASUREMENT tooth_rale "" UBYTE dez 1 100 0.00 255.0 FORMAT "%5.1" ECU_ADDRESS 0xF06FF /end MEASUREMENT
/begin MEASUREMENT tphrlsu_w "" UWORD t100msxs_q16Em6 1 100 0.00 1.048560 FORMAT "%8.6" ECU_ADDRESS 0xF4F00 /end MEASUREMENT
/begin MEASUREMENT tr_zahnabs "" UWORD dez 1 100 0.00 65535.00 FORMAT "%8.2" ECU_ADDRESS 0xE040 /end MEASUREMENT
/begin MEASUREMENT tumgnl "" UBYTE temp_ub_q0p75_o48 1 100 -48.00 143.3 FORMAT "%5.1" ECU_ADDRESS 0x384021 /end MEASUREMENT
/begin MEASUREMENT tvnwsttm_w "" UWORD t10msxs_uw_b655p35 1 100 0.00 655.3500 FORMAT "%8.4" ECU_ADDRESS 0xF4F3C /end MEASUREMENT
/begin MEASUREMENT tvrnr "" UBYTE dez 1 100 0.00 255.0 FORMAT "%5.1" ECU_ADDRESS 0xF08DC /end MEASUREMENT
/begin MEASUREMENT tvsaa_w "" UWORD t10msxs_uw_b655p35 1 100 0.00 655.3500 FORMAT "%8.4" ECU_ADDRESS 0xF2376 /end MEASUREMENT
/begin MEASUREMENT tvsab_w "" UWORD t10msxs_uw_b655p35 1 100 0.00 655.3500 FORMAT "%8.4" ECU_ADDRESS 0xF2378 /end MEASUREMENT
/begin MEASUREMENT tvsag_w "" UWORD t10msxs_uw_b655p35 1 100 0.00 655.3500 FORMAT "%8.4" ECU_ADDRESS 0xF237A /end MEASUREMENT
/begin MEASUREMENT tvsakat_w "" UWORD t10msxs_uw_b655p35 1 100 0.00 655.3500 FORMAT "%8.4" ECU_ADDRESS 0xF237C /end MEASUREMENT
/begin MEASUREMENT tvsans_w "" UWORD t10msxs_uw_b655p35 1 100 0.00 655.3500 FORMAT "%8.4" ECU_ADDRESS 0xF4742 /end MEASUREMENT
/begin MEASUREMENT tvtevptu "" UBYTE t500usxms_ub_q0p5 1 100 0.00 127.5 FORMAT "%5.1" ECU_ADDRESS 0xF4178 /end MEASUREMENT
/begin MEASUREMENT twatmhx2_w "" SWORD tempg_q0p0234 1 100 -768.0000 767.9766 FORMAT "%8.4" ECU_ADDRESS 0xF4532 /end MEASUREMENT
/begin MEASUREMENT twatmhx_w "" SWORD tempg_q0p0234 1 100 -768.0000 767.9766 FORMAT "%8.4" ECU_ADDRESS 0xF4534 /end MEASUREMENT
/begin MEASUREMENT twdknlc "" UBYTE t100msxs_ub_b25p5 1 100 0.00 25.50 FORMAT "%5.2" ECU_ADDRESS 0xF40B1 /end MEASUREMENT
/begin MEASUREMENT tznd "" UWORD tsegment_sy 1 100 0.00 52.42800 FORMAT "%8.5" ECU_ADDRESS 0xE042 /end MEASUREMENT
/begin MEASUREMENT tznd2 "" UWORD tsegment_sy 1 100 0.00 52.42800 FORMAT "%8.5" ECU_ADDRESS 0xE044 /end MEASUREMENT
/begin MEASUREMENT ubdedis "" UBYTE spg_q0p1 1 100 0.00 25.50 FORMAT "%5.2" ECU_ADDRESS 0xF0852 /end MEASUREMENT
/begin MEASUREMENT ubdeen "" UBYTE spg_q0p1 1 100 0.00 25.50 FORMAT "%5.2" ECU_ADDRESS 0xF0853 /end MEASUREMENT
/begin MEASUREMENT uevges "" UBYTE fak_q0p1 1 100 0.00 25.50 FORMAT "%5.2" ECU_ADDRESS 0xF080D /end MEASUREMENT
/begin MEASUREMENT upwkdo_w "" UWORD spg_uw_q0p00488 1 100 0.00 319.9951 FORMAT "%8.4" ECU_ADDRESS 0xF1AE2 /end MEASUREMENT
/begin MEASUREMENT upwkdt_w "" UWORD spg_uw_q0p00488 1 100 0.00 319.9951 FORMAT "%8.4" ECU_ADDRESS 0xF1AE4 /end MEASUREMENT
/begin MEASUREMENT upwkdu_w "" UWORD spg_uw_q0p00488 1 100 0.00 319.9951 FORMAT "%8.4" ECU_ADDRESS 0xF1AE6 /end MEASUREMENT
/begin MEASUREMENT upwkd_w "" UWORD spg_uw_q0p00488 1 100 0.00 319.9951 FORMAT "%8.4" ECU_ADDRESS 0x382ED8 /end MEASUREMENT
/begin MEASUREMENT vkst_w "" UWORD vol_q0p1 1 100 0.00 6553.500 FORMAT "%8.3" ECU_ADDRESS 0xF4FAE /end MEASUREMENT
/begin MEASUREMENT wdkdlra_w "" UWORD relDK_q0p02441 1 100 0.00 1599.976 FORMAT "%8.3" ECU_ADDRESS 0xF1B46 /end MEASUREMENT
/begin MEASUREMENT wdkdlr_w "" UWORD relDK_q0p02441 1 100 0.00 1599.976 FORMAT "%8.3" ECU_ADDRESS 0xE0F4 /end MEASUREMENT
/begin MEASUREMENT wdksfi_w "" SWORD relDK_q0p02441 1 100 -800.0000 799.9756 FORMAT "%8.4" ECU_ADDRESS 0xF1B48 /end MEASUREMENT
/begin MEASUREMENT weestsb "" UBYTE kw_q2p8125 1 100 0.00 717.2 FORMAT "%5.1" ECU_ADDRESS 0xF0858 /end MEASUREMENT
/begin MEASUREMENT weests_r "" UBYTE kw_q2p8125 1 100 0.00 717.2 FORMAT "%5.1" ECU_ADDRESS 0xE11F /end MEASUREMENT
/begin MEASUREMENT wikatst_w "" UWORD q_q64 1 100 0.00 4194240. FORMAT "%8.0" ECU_ADDRESS 0xF46F8 /end MEASUREMENT
/begin MEASUREMENT winkl_b1 "" UWORD dez 1 100 0.00 65535.00 FORMAT "%8.2" ECU_ADDRESS 0xE158 /end MEASUREMENT
/begin MEASUREMENT winkl_b2 "" UWORD dez 1 100 0.00 65535.00 FORMAT "%8.2" ECU_ADDRESS 0xE15A /end MEASUREMENT
/begin MEASUREMENT wistr_w "" UWORD fak_uw_b1 1 100 0.00 0.9999847 FORMAT "%9.7" ECU_ADDRESS 0xF46FA /end MEASUREMENT
/begin MEASUREMENT wkw0rale_w "" UWORD kw_tooth_sy 1 100 0.00 393210.0 FORMAT "%8.1" ECU_ADDRESS 0xF175A /end MEASUREMENT
/begin MEASUREMENT wkwas_kor "" UBYTE kw_tooth_sy 1 100 0.00 1530. FORMAT "%5.0" ECU_ADDRESS 0xF0700 /end MEASUREMENT
/begin MEASUREMENT wkwrale_w "" UWORD kw_tooth_sy 1 100 0.00 393210.0 FORMAT "%8.1" ECU_ADDRESS 0xF175C /end MEASUREMENT
/begin MEASUREMENT wkwstop "" UBYTE kw_tooth_sy 1 100 0.00 1530. FORMAT "%5.0" ECU_ADDRESS 0x38203F /end MEASUREMENT
/begin MEASUREMENT wouta "" UBYTE zw_azue_sy 1 100 0.00 191.3 FORMAT "%5.1" ARRAY_SIZE 4 ECU_ADDRESS 0xE01C /end MEASUREMENT
/begin MEASUREMENT woutst "" UBYTE zw_azue_sy 1 100 0.00 191.3 FORMAT "%5.1" ARRAY_SIZE 4 ECU_ADDRESS 0xE020 /end MEASUREMENT
/begin MEASUREMENT zkvek "" UBYTE dez 1 100 0.00 255.0 FORMAT "%5.1" ECU_ADDRESS 0xE024 /end MEASUREMENT
/begin MEASUREMENT zlkd "" UBYTE dez 1 100 0.00 255.0 FORMAT "%5.1" ECU_ADDRESS 0xF0832 /end MEASUREMENT
/begin MEASUREMENT zn2zksucc "" UWORD dez 1 100 0.00 65535.00 FORMAT "%8.2" ECU_ADDRESS 0xE046 /end MEASUREMENT
/begin MEASUREMENT zn2zkvek "" UWORD dez 1 100 0.00 65535.00 FORMAT "%8.2" ECU_ADDRESS 0xE048 /end MEASUREMENT
/begin MEASUREMENT zndact "" UBYTE dez 1 100 0.00 255.0 FORMAT "%5.1" ECU_ADDRESS 0xE025 /end MEASUREMENT
/begin MEASUREMENT zndsucc "" UBYTE dez 1 100 0.00 255.0 FORMAT "%5.1" ECU_ADDRESS 0xE026 /end MEASUREMENT
/begin MEASUREMENT znzksucc "" UWORD dez 1 100 0.00 65535.00 FORMAT "%8.2" ECU_ADDRESS 0xE04A /end MEASUREMENT
/begin MEASUREMENT znzkvek "" UWORD dez 1 100 0.00 65535.00 FORMAT "%8.2" ECU_ADDRESS 0xE04C /end MEASUREMENT
/begin MEASUREMENT zouttmx "" UWORD tsegment_sy 1 100 0.00 52.42800 FORMAT "%8.5" ECU_ADDRESS 0xE04E /end MEASUREMENT
/begin MEASUREMENT zrphsyn "" UBYTE dez 1 100 0.00 255.0 FORMAT "%5.1" ECU_ADDRESS 0xF0C39 /end MEASUREMENT
/begin MEASUREMENT zrphsyn2 "" UBYTE dez 1 100 0.00 255.0 FORMAT "%5.1" ECU_ADDRESS 0xF0C3A /end MEASUREMENT
/begin MEASUREMENT zueninkr "" UBYTE dez 1 100 0.00 255.0 FORMAT "%5.1" ECU_ADDRESS 0xE027 /end MEASUREMENT
/begin MEASUREMENT zueninkr2 "" UBYTE dez 1 100 0.00 255.0 FORMAT "%5.1" ECU_ADDRESS 0xE028 /end MEASUREMENT
/begin MEASUREMENT zueninkr_r "" UBYTE dez 1 100 0.00 255.0 FORMAT "%5.1" ECU_ADDRESS 0xE029 /end MEASUREMENT
/begin MEASUREMENT zuentmx "" UWORD tsegment_sy 1 100 0.00 52.42800 FORMAT "%8.5" ECU_ADDRESS 0xE050 /end MEASUREMENT
/begin MEASUREMENT zuenzahn "" UBYTE dez 1 100 0.00 255.0 FORMAT "%5.1" ECU_ADDRESS 0xE02A /end MEASUREMENT
/begin MEASUREMENT zuenzahn2 "" UBYTE dez 1 100 0.00 255.0 FORMAT "%5.1" ECU_ADDRESS 0xE02B /end MEASUREMENT
/begin MEASUREMENT zuenzahn_r "" UBYTE dez 1 100 0.00 255.0 FORMAT "%5.1" ECU_ADDRESS 0xE02C /end MEASUREMENT
/begin MEASUREMENT zuen_beg "" UBYTE dez 1 100 0.00 255.0 FORMAT "%5.1" ECU_ADDRESS 0xE120 /end MEASUREMENT
/begin MEASUREMENT zwmatm "" UBYTE dez 1 100 0.00 255.0 FORMAT "%5.1" ECU_ADDRESS 0x382047 /end MEASUREMENT
/begin MEASUREMENT zwmatm2 "" UBYTE dez 1 100 0.00 255.0 FORMAT "%5.1" ECU_ADDRESS 0x382048 /end MEASUREMENT
/begin MEASUREMENT zwmatmf "" UBYTE dez 1 100 0.00 255.0 FORMAT "%5.1" ECU_ADDRESS 0x382049 /end MEASUREMENT
/begin MEASUREMENT zwmatmf2 "" UBYTE dez 1 100 0.00 255.0 FORMAT "%5.1" ECU_ADDRESS 0x38204A /end MEASUREMENT
/begin MEASUREMENT zwoutakt "" UBYTE zw_TR2OT_sy 1 100 -119.3 72.00 FORMAT "%5.1" ECU_ADDRESS 0xE02D /end MEASUREMENT
/begin MEASUREMENT zwoutar "" SBYTE zw_sb_q0p75 1 100 -96.00 95.25 FORMAT "%5.2" ARRAY_SIZE 4 ECU_ADDRESS 0xE02E /end MEASUREMENT
/begin MEASUREMENT zylvek_a "" UBYTE dez 1 100 0.00 255.0 FORMAT "%5.1" ECU_ADDRESS 0xE121 /end MEASUREMENT
/begin FUNCTION ABGKL "8.60" /begin DEF_CHARACTERISTIC CWGAGKG KFABK TSPAK TSPAKST VLLABKL VOABKL VUABKL /end DEF_CHARACTERISTIC /begin IN_MEASUREMENT B_ll B_stend gangi nmot rl vfzg /end IN_MEASUREMENT /begin OUT_MEASUREMENT B_abkl /end OUT_MEASUREMENT /end FUNCTION
/begin FUNCTION ABKVP "1.80" /begin DEF_CHARACTERISTIC TDBKVSTEND TDDEDBKVP UBSQBKVMN UBSQBKVMX /end DEF_CHARACTERISTIC /begin IN_MEASUREMENT B_bkvpa B_brems B_cdbkvp B_pwf tnst_w ubsq /end IN_MEASUREMENT /begin OUT_MEASUREMENT aebkvph_w aebkvpl_w B_bkvp tbdbkvp_w /end OUT_MEASUREMENT /begin LOC_MEASUREMENT aebkvp_l B_fbkvpa tbdbkvp_l /end LOC_MEASUREMENT /end FUNCTION
/begin FUNCTION ACIFI "18.10"
 /begin DEF_CHARACTERISTIC CWESWEZ DTIABS DTIREL FWEAB FWEAUF FWEMXT TMESP WEESTSM WESSTO /end DEF_CHARACTERISTIC
 /begin REF_CHARACTERISTIC NMIN /end REF_CHARACTERISTIC
 /begin IN_MEASUREMENT B_kl15 B_nsp B_sa evz_austot fnmes0 fnmes1 fnmes2 fnmes3 fnmes4 fnmes5 nmot_w synstate synstate_o ti_b1 ti_b2 ti_tvu_w tmot tn2 weer wessbm zylvirt zzbank zzvirt zzyl /end IN_MEASUREMENT
 /begin OUT_MEASUREMENT anzti anztib anztib_w anzti_w B_encifi B_spontan0 B_spontan1 B_spontan2 B_spontan3 B_spontan4 B_spontan5 B_synti B_ti_cha0 B_ti_cha1 B_ti_cha2 B_ti_cha3 B_ti_cha4 B_ti_cha5 B_ti_out0 B_ti_out1 B_ti_out2 B_ti_out3 B_ti_out4 B_ti_out5 B_ti_wai0 B_ti_wai1 B_ti_wai2 B_ti_wai3 B_ti_wai4 B_ti_wai5 B_umsync cc_cha_0 cc_cha_1 cc_cha_2 cc_cha_3 cc_cha_4 cc_cha_5 fweg fwez0 fwez1 fwez2 fwez3 fwez4 fwez5 ti_ev0 ti_ev1 ti_ev2 ti_ev3 ti_ev4 ti_ev5 ti_sto_0 ti_sto_1 ti_sto_2 ti_sto_3 ti_sto_4 ti_sto_5 weests_r winkl_b1 winkl_b2 zuen_beg /end OUT_MEASUREMENT
 /begin LOC_MEASUREMENT B_cwesakt deltaseg_w na_abs_c na_rel_c pd_we_zy restw_b1 restw_b2 segz weestsb zylvek_a /end LOC_MEASUREMENT
/end FUNCTION
/begin FUNCTION ADVE "3.60"
 /begin DEF_CHARACTERISTIC CWDKNOLU CWDLRIKL DANTGESWNV DANTGESWV DANTSCHWNV DANTSCHWV DKLAGERT DLRDWDKSS1 DLRDWDKSS2 DLRHAFTMN DLRHAFTST DLRIAMAXA DLRIKLPAR DLRININI DLRKDONLP0 DLRKDUNLP0 DLRKDUNLP1 DLRKDUNLP2 DLRKDUNLP3 DLRKIONLP0 DLRKIUNLP0 DLRKIUNLP1 DLRKIUNLP2 DLRKIUNLP3 DLRKPONLP0 DLRKPUNLP0 DLRKPUNLP1 DLRKPUNLP2 DLRKPUNLP3 DLRKREIS DLRKREISST DLRNLPD DLRPID0T DLRPID1T DLRPID2T DLRPIDMAX DLRPIDMIN DLRUBSOLL DLRUMABAND DLRUMAIINI DVEEST DWDKSBAMX DWDKSIKLS KDLRIDDVE TDKLAGDE TDLRHAFTMX TDLRPIDC TPWRSV TWDKNL UDKNLPTOL WDKBEWS WDKNLPTOL WDKREIB WDKSAPNOL WDKSTFEIN WDKSTGROB ZKUBDLR ZKWDKSPT1 /end DEF_CHARACTERISTIC
 /begin IN_MEASUREMENT B_dcdisr B_dkaden B_dknolu B_dknot B_dkp1e B_dkp2e B_dkpiu B_dlrien B_dveeson B_i_ska_um B_kl15 B_lrnrdy B_nldve B_nmin B_nmot B_pwf B_st B_wdk1v B_wdk2sel dynPeriod nmot ub ubrsq udknlp1 udknlp2 udkp1_w udkp2_w wdkada_w wdkba_w wdknlp_w wdks_w wped /end IN_MEASUREMENT
 /begin OUT_MEASUREMENT B_apnoluv B_appnolu B_dcdisfr B_dlrbe B_dlrparc B_dlrpide B_dlrspid B_dlrumzu B_dveese B_dveesh B_dvete B_nlpne B_pwrsv B_ubdve B_ubpvg B_ub_ok B_wdksive dklagerc dlrspid_w dpwrsvc /end OUT_MEASUREMENT
 /begin LOC_MEASUREMENT B_dkbew B_dlrikla B_dlriklst B_iklrest B_iklstar B_wdksauf dlrd dlrhaftak dlri dlriamax dlriant_w dlrihaftc dlriklst_w dlrikl_w dlrini_w dlrkomp dlrndif_w dlrp dlrpidc dlrubrsq dveesc dwdkdlr_w gwdkdlr_w gwdk_kge twdknlc ubdedis ubdeen wdkdlra_w wdkdlr_w wdksfi_w /end LOC_MEASUREMENT
/end FUNCTION
/begin FUNCTION AEKP "8.20"
 /begin DEF_CHARACTERISTIC ANZEKPVLMX PEKP TAPVLTM TNLEKPVL TZMIN TZZMX UBSTS VKSTEBF VKSTPVLAB VKSTPVLNL /end DEF_CHARACTERISTIC
 /begin IN_MEASUREMENT B_abstnlgp B_airbag B_bbdecj B_desee B_kstebf B_nachlend B_nmot B_stend B_uhrrmin B_uhrrsec tabst_w tmotab tnachl_w ubsq /end IN_MEASUREMENT
 /begin OUT_MEASUREMENT B_ekp /end OUT_MEASUREMENT
 /begin LOC_MEASUREMENT aekp8bits anzekpvl B_ekpd B_ekps B_ekpvl B_ekpvla B_ekpvlz B_pvlab B_pvlnl B_tooth dekpub vkst_w /end LOC_MEASUREMENT
/end FUNCTION
/begin FUNCTION AEVAB "6.90" /begin DEF_CHARACTERISTIC CWEVAB REDABM /end DEF_CHARACTERISTIC
 /begin IN_MEASUREMENT anzeausb B_dkuevab B_faevz B_phsnl devoff flgstinj_w flgtiab redsol zyleausb zzyl /end IN_MEASUREMENT
 /begin OUT_MEASUREMENT abmf B_dmdstop B_nlphea eevx evz_aus fevab stateaevab /end OUT_MEASUREMENT
 /begin LOC_MEASUREMENT anzeab B_fophsnl B_frdph B_nlpheai dmdevab evrbgn_one fevabe redsolr redsol_one tvrnr /end LOC_MEASUREMENT
/end FUNCTION
/begin FUNCTION AEVABU "3.50" /begin DEF_CHARACTERISTIC DNMAXH DNSKAZ NMXDAE NMXMDSKA TNLZOFF /end DEF_CHARACTERISTIC /begin IN_MEASUREMENT B_dknolu B_dkpu nmot wped /end IN_MEASUREMENT /begin OUT_MEASUREMENT B_evabu B_nlzoff ndcdis_w /end OUT_MEASUREMENT /end FUNCTION
/begin FUNCTION AEVABZK "1.30" /begin IN_MEASUREMENT B_dmdstop B_dveada B_evabu B_koevab evz_aus /end IN_MEASUREMENT /begin OUT_MEASUREMENT B_evasel evz_austot /end OUT_MEASUREMENT /end FUNCTION
/begin FUNCTION ALE "6.30" /begin DEF_CHARACTERISTIC CWALE RALEZMAX TRD /end DEF_CHARACTERISTIC
 /begin IN_MEASUREMENT B_luecke B_mluecke B_nlale B_nldg B_nmot B_phsnlinv B_startini B_stend B_zprel ttooth10ms wkwbzm0_w wkw_w /end IN_MEASUREMENT
 /begin OUT_MEASUREMENT aleNvBits B_ale wkwstop /end OUT_MEASUREMENT
 /begin LOC_MEASUREMENT B_enabale B_ralectr B_raleok tooth_rale wkw0rale_w wkwas_kor wkwrale_w /end LOC_MEASUREMENT
/end FUNCTION
/begin FUNCTION ALSU "2.40" /begin DEF_CHARACTERISTIC TAHRLSUMX TPHRLSU UBALSUMX /end DEF_CHARACTERISTIC /begin IN_MEASUREMENT B_nmot prhrlsu2_w prhrlsu_w ubrsq /end IN_MEASUREMENT /begin OUT_MEASUREMENT B_hrlsaus tahrlsu2_w tahrlsu_w tphrlsu_w /end OUT_MEASUREMENT /begin LOC_MEASUREMENT fubkor_w /end LOC_MEASUREMENT /end FUNCTION
/begin FUNCTION ARMD "10.150"
 /begin DEF_CHARACTERISTIC CWARMD DMARMX DNFILO DVFZAR FKFDARTM FKVRNR FLRAWG FLRCVT FLRFDAR FLRFLRAR FLRHG FLRKIFZ FRARAWGS FRARCVT FRARCVTS FRARHGS KFDMDADP KFDMDARO KFDMDAROS KFFGDMAR KFFRARAW KFFRARHG KIFZCVT KIFZGAWG KIFZGHG KOE_A0 KOE_A1 KOE_A2 KOE_B1 KOE_B2 NARASTGU NARLLGA NARLLMXG NARMXG NDFILOG NDIFFOG NVG NVMNG NVMXG SFZARMD SMK08MDSW TAREIN TMAR TMLAST TVARS TVARSA TVARSS TVKUPAR TVKUPGW TVKUPHS TVKUPRS TZSPINI VARAU WPEDU /end DEF_CHARACTERISTIC
 /begin REF_CHARACTERISTIC SGA06MDUB SUV07MDUB /end REF_CHARACTERISTIC
 /begin IN_MEASUREMENT B_autget B_brems B_cvt B_dashv B_fgr B_gsch B_gwhs B_kuppl B_ll B_lowra B_lsd B_sa B_stend B_wk B_wkauf esst_sga06mdub esst_suv07mdub fzabgs_w gangi mdverl_w mifa_w misolv_w mkfanb_w nmot nmot_w nvquot_w rl tmot uefktget vfzg vfzg_w wped_w /end IN_MEASUREMENT
 /begin OUT_MEASUREMENT B_ar B_hpnmot B_iniar B_iniarv B_kupgw B_tpnmot dmar_w esst_smk08mdsw fdar fdars flrar kifz_w mdbes_w mkar_w mlast_w ndar_w ndfil_w ndiffog_w ndiff_w nmod_w /end OUT_MEASUREMENT
 /begin LOC_MEASUREMENT B_argf B_gfen B_iniar1 B_tvars B_tvarsa B_tvarss B_wksch dncvt_w nmodiv_w /end LOC_MEASUREMENT
/end FUNCTION
/begin FUNCTION ASCOM "" /end FUNCTION
/begin FUNCTION ASIC0 "" /begin OUT_MEASUREMENT B_AsicComDisable /end OUT_MEASUREMENT /end FUNCTION
/begin FUNCTION ATEV "4.40" /begin DEF_CHARACTERISTIC KFTEVP KFTVTEV TATEGMX TATEGRDO TATEGRDU TATEMSN TVTEVPS /end DEF_CHARACTERISTIC
 /begin IN_MEASUREMENT B_dtes B_evloc B_tevtini msntevo_w msteo_w mstesoll_w nmot pspu tadtea tans ub /end IN_MEASUREMENT
 /begin OUT_MEASUREMENT B_tevtstp tateist tateist_w tateout tateout_w tatesoll tatesoll_w tevper /end OUT_MEASUREMENT
 /begin LOC_MEASUREMENT msntev_w tateroh tateroh_w tvtevptu /end LOC_MEASUREMENT
/end FUNCTION
/begin FUNCTION ATM "54.10"
 /begin DEF_CHARACTERISTIC ATMTAKR ATMTANS DTUMTAT FATMRML FATMRML2 FATRKRML FATRKRML2 FWMABGW FWMABGW2 FWMKATW FWMKATW2 IMTUMTAT KATMEXML KATMEXML2 KATMIEXML KATMIEXML2 KFATLAK KFATLAK2 KFATMABKA KFATMABKA2 KFATMABKK KFATMABKK2 KFATMKR KFATMKR2 KFATMLA KFATMLA2 KFATMZW KFATMZW2 KFATZWK KFATZWK2 KFTATM KFTATM2 KFWMABG KFWMABG2 KFWMKAT KFWMKAT2 KLATMILAE KLATMILAE2 KLATMIZWE KLATMIZWE2 KLATMLAE KLATMLAE2 KLATMZWE KLATMZWE2 NTUMTAT STS06TMUW STU05TMUB TABGMEX TASTBFA TATMKH TATMKH2 TATMKRSA TATMKW TATMSA TATMSAE TATMSAE2 TATMSTI TATMTMOT TATMTP TATMTRKH TATMTRKH2 TATMWMK TIKATMOE TKATMOE TKSTBFA TNLATM TNLATMTM TNLATMTU TUMTAIT VTUMTAT WMABGKH WMABGKH2 WMKATKH WMKATKH2 ZATAKRML ZATAKRML2 ZATMAML ZATMAML2 ZATMIKML ZATMIKML2 ZATMKML ZATMKML2 ZATMRML ZATMRML2 ZATRKRML ZATRKRML2 /end DEF_CHARACTERISTIC
 /begin REF_CHARACTERISTIC SEZ06TMUB SLX06TMUW SLY06TMUW SML06TMUW SML07TMUW SMT06TMUW ST107TMUB ST207TMUB ST307TMUB ST407TMUB STM05TMUB /end REF_CHARACTERISTIC
 /begin IN_MEASUREMENT B_abstgp B_faatm B_kh B_kw B_nachlend B_nlatm B_nmot B_pwf B_sa B_st B_stend B_tfu B_trkh B_uhrrmin B_uhrrsec esst_sez06tmub esst_slx06tmuw esst_sly06tmuw esst_sml06tmuw esst_sml07tmuw esst_smt06tmuw esst_st107tmub esst_st207tmub esst_st307tmub esst_st407tmub esst_stm05tmub etazwist lamsbg2_w lamsbg_w ml ml_w nmot rl tabst_w tans tmot tmst tumg vfzg /end IN_MEASUREMENT
 /begin OUT_MEASUREMENT atmAusBitsNov B_atmtpa B_atmtpa2 B_atmtpf B_atmtpf2 B_atmtpk B_atmtpk2 B_atmtpl B_atmtpl2 esst_sts06tmuw esst_stu05tmub etazwimt imlatm imlatm_w iwmatm2_w iwmatm_w tabgkrm2_w tabgkrm_w tabgm tabgm2 tabgm2_w tabgmab tabgmab2 tabgmst tabgmst2 tabgm_w tatu tikatm tikatm2 tikatm2_w tikatm_w tkatm tkatm2 tkatm2_w tkatmab tkatmab2 tkatmst tkatmst2 tkatm_w zwmatm zwmatm2 zwmatmf zwmatmf2 /end OUT_MEASUREMENT
 /begin LOC_MEASUREMENT atmLokBits B_atmst B_atmst2 B_stndnl tabstatm_w tabstmx_w takrkf takrkf2 takrstc takrstc2 tatakrml tatakrml2 tatmaml tatmaml2 tatmkf tatmkf2 tatmrml tatmrml2 tatmsta tatmsta2 tatrkrml tatrkrml2 texkor texkor2 texml texml2 texoikm2_w texoikm_w texom2_w texom_w tiexkor tiexkor2 tiexml tiexml2 /end LOC_MEASUREMENT
/end FUNCTION
/begin FUNCTION ATMHEX "1.10"
 /begin DEF_CHARACTERISTIC FATMAHX FATMAHX2 FATMTWHX FATMVHX FATMVHX2 FTMOTKHX FTMOTKHX2 KATMCPHX KATMCPHX2 /end DEF_CHARACTERISTIC
 /begin REF_CHARACTERISTIC KTMOTW /end REF_CHARACTERISTIC
 /begin IN_MEASUREMENT B_stend msabikr2_w msabikr_w msabiks2_w msabiks_w taikrm2_w taikrm_w tanvk2_w tanvk_w tmotk_w tumgk_w vfzg_w /end IN_MEASUREMENT
 /begin OUT_MEASUREMENT talsum2_w talsum_w thxlsum2_w thxlsum_w /end OUT_MEASUREMENT
 /begin LOC_MEASUREMENT dqatmhx2_w dqatmhx_w dtatwhx2_w dtatwhx_w ftkhx2_w ftkhx_w quatmhx2_w quatmhx_w qwatmhx2_w qwatmhx_w twatmhx2_w twatmhx_w /end LOC_MEASUREMENT
/end FUNCTION
/begin FUNCTION AZUE "5.80" /begin DEF_CHARACTERISTIC CW_AZUE IGNDELAY TMZUB2MX ZWFUBAMN /end DEF_CHARACTERISTIC
 /begin IN_MEASUREMENT B_airbag B_dls B_ff B_kl15 B_motstop B_nachl flgstign_w fubaanz nmot_w offz_w szfuba_w tmot wkwbzm0_w znachanz zwcalcar /end IN_MEASUREMENT
 /begin OUT_MEASUREMENT azoffmsk_w B_zesync fdpatdmd zndact zndsucc zwoutakt /end OUT_MEASUREMENT
 /begin LOC_MEASUREMENT azFadeStatBits azfdoff B_azoffzag B_dopzue_i B_dzai B_ffsn2_i B_ff_i B_slsn2 B_sw0 B_sw1 B_z1 B_z1not B_z1_i B_zesync_d B_zws0 dzaCtr fbmxzahn fubaanz_i ignDelayCtr minzahn ovlCtr slsninkr slsninkr2 slsninkr_r slsnzahn slsnzahn2 slsnzahn_r sn2zkact sn2zkvek snzkact snzkvek swout tinkr tr_zahnabs tznd tznd2 wouta woutst zkvek zn2zksucc zn2zkvek znzksucc znzkvek zouttmx zueninkr zueninkr2 zueninkr_r zuentmx zuenzahn zuenzahn2 zuenzahn_r zwoutar /end LOC_MEASUREMENT
/end FUNCTION
/begin FUNCTION BBBO "3.40"
 /begin DEF_CHARACTERISTIC ABOINI ABOLRAR ABOMX CDPCV IMLKS MSNPCV TMSKS TMSTABO TMTKS TVREABO USVKKS /end DEF_CHARACTERISTIC
 /begin IN_MEASUREMENT B_nmot B_pwf B_sa B_sbbvk B_sbbvk2 ftho_w ml_w ps_w pu_w tmot tmst usvkk2_w usvkk_w /end IN_MEASUREMENT
 /begin OUT_MEASUREMENT abo B_abor imlbbo /end OUT_MEASUREMENT
 /begin LOC_MEASUREMENT dpspu mspcv /end LOC_MEASUREMENT
/end FUNCTION
/begin FUNCTION BBDLS "1.10" /begin DEF_CHARACTERISTIC CLSDKH NDLSO NDLSU /end DEF_CHARACTERISTIC /begin IN_MEASUREMENT B_dknolu B_dkpu B_kh B_llr B_sa B_st nmotll nstat /end IN_MEASUREMENT /begin OUT_MEASUREMENT B_dls /end OUT_MEASUREMENT /begin LOC_MEASUREMENT B_buf B_dnn /end LOC_MEASUREMENT /end FUNCTION
/begin FUNCTION BBDNWS "1.100"
 /begin DEF_CHARACTERISTIC KLNDNWMN NDNWMN NDNWMNFA NDNWMX TMDNWMN TMDNWMX TNWDSTEND TOELDNWMN TOELDNWMX /end DEF_CHARACTERISTIC
 /begin IN_MEASUREMENT B_dnwfozea B_dnwfozee B_fanwsa B_fanwsaa B_fanwse B_fanwsea B_nwdfonws B_nwrposa B_nwrpose B_nwvfa B_nwvfe B_phada B_phade B_stend B_wnws0a B_wnws0e nmot tmot tnst_w toelk_w /end IN_MEASUREMENT
 /begin OUT_MEASUREMENT B_dnwrpa B_dnwrpe B_dnws B_dnwsa B_dnwse /end OUT_MEASUREMENT
 /begin LOC_MEASUREMENT B_dnwsfa B_nmotnwdf B_tmotnwdf B_tolnwdf ndnwtmn /end LOC_MEASUREMENT
/end FUNCTION
/begin FUNCTION BBGANG "14.100"
 /begin DEF_CHARACTERISTIC CWBBGANG FTDGANG IGESGA NGANGMIN NVQUOT1O NVQUOT1U NVQUOT2O NVQUOT2U NVQUOT3O NVQUOT3U NVQUOT4O NVQUOT4U NVQUOT5O NVQUOT5U NVQUOT6O NVQUOT6U /end DEF_CHARACTERISTIC
 /begin IN_MEASUREMENT B_asm B_autget B_cvt B_gang0 B_gang7 B_tippg B_vnull gangauti nmot_w S_fs uefktget vfzg_w /end IN_MEASUREMENT
 /begin OUT_MEASUREMENT B_fs B_gwhs gangi gangist nvquot_w uevges /end OUT_MEASUREMENT
/end FUNCTION
/begin FUNCTION BBKD "1.40"
 /begin DEF_CHARACTERISTIC CWBBKD CWKDASG DUPW12KD DUPWGLKD DUPWKDLB DUPWKDO DUPWKDU TKD TLKD UPWGKDMN UPWGKDMX UPWGKDO UPWGKDU UPWKDDF WPKDMN /end DEF_CHARACTERISTIC
 /begin IN_MEASUREMENT B_autget B_fakd B_pwf B_pwgnotfr S_kd upwg1_w upwg2d_w upwgej_w wped_w /end IN_MEASUREMENT
 /begin OUT_MEASUREMENT BBKDbits bblkderf B_kd upwkdu_w upwkd_w zlkd /end OUT_MEASUREMENT
 /begin LOC_MEASUREMENT B_kdpos B_lkderf B_lkdfrg upwkdo_w upwkdt_w /end LOC_MEASUREMENT
/end FUNCTION
/begin FUNCTION BBKHZ "18.290"
 /begin DEF_CHARACTERISTIC ABKKATTAB BTRKHTMS CMVKAT CWKHZ CWKHZ2 DTKATMN DTKH DTMABKH FHOKH FKHABMN FKHLA FKHMD FKHMDLL FMDKHNS FTMLAKH IMLATWS IMLKHMXTMS IMLKHTMS KFNFSKHM KFNLLKHM KFNSKHLL KFWNWWKA KFWNWWKE KTNDMRKH MLKHMX MLSUS MTABGKH NLLAD NLLKT NWKHFHO TABSTKH TDTABGMK TKATMN TKATW TKHABB TKHFSAB TKHLL TKHLLAB TKHLLMX TKHMX TKHNAB TMSLOF TNSDMRKH ZKHABB ZKLAMKH /end DEF_CHARACTERISTIC
 /begin IN_MEASUREMENT B_bkvleer B_dsl4 B_dsla B_fa B_fasla B_fs B_hag B_katfz B_ll B_lmsslof B_msloff B_nachl B_nachlstp B_nmot B_slkhof B_slpoff B_sls B_slsfz B_st B_stend B_wst fho fho_w frhol_w imlatm_w ml tabgm_w tabst_w tans tikatm tkatm tmot tmotab tmst tnst_w tumg /end IN_MEASUREMENT
 /begin OUT_MEASUREMENT BBKHZausbits B_kh B_kha B_khab B_khan B_khn B_khno B_khoab B_kw B_trkh fhost_w fkhab fkhnab flakh flamkh fmdkh fnwkha fnwkhe frhokor_w imlatmw_w imlpr imlpr_w nfskh nllkh tikatmnl tumgnl wistr_w /end OUT_MEASUREMENT
 /begin LOC_MEASUREMENT BBKHZlokBits BBKHZlokBits1 B_khares B_khaset B_kherr B_khll B_khlle B_khllmx B_khres B_khset B_khstc B_mlsu dkattumg_w dtivkst_w fmdkhtns_w imlatmst_w mlsuini_w mlsu_w tanskhst tivkst_w tkhnab_ctr wikatst_w /end LOC_MEASUREMENT
/end FUNCTION
/begin FUNCTION BBNWS "4.80"
 /begin DEF_CHARACTERISTIC CWNWGE CWNWSA CWNWSE CWNWSG DNLLSNW NMNWSTMN NNWMX NNWTMN TANW THYNWMN TMNWKH TMNWMN TMNWMX TMNWST TOELNWEMN TOELNWEMX TOELNWMN TOELNWMX TVNWGE TVNWSTNMTM TVNWSTTM /end DEF_CHARACTERISTIC
 /begin REF_CHARACTERISTIC CWMDAPP /end REF_CHARACTERISTIC
 /begin IN_MEASUREMENT B_dknolu B_dkpu B_fanwsa B_fanwse B_gsch B_nldg B_nmin B_nwkv B_phada B_phade B_pwofnwa B_pwofnwe fnwkha fnwkhe nmot nsol rlshk_w rlsol_w rl_w tans tmot tnst_w toelk_w /end IN_MEASUREMENT
 /begin OUT_MEASUREMENT B_dnwfozea B_dnwfozee B_genws B_nnwmx B_nwdfonws B_nwkwaosw B_nws B_nwsapkfa B_nwsapkfe B_nwsappa B_nwsappe B_nwsguda B_nwsgude B_nwsinva B_nwsinve B_nwskflla B_nwskflle B_nwskha B_nwskhe B_nwssprga B_nwssprge B_nwsst B_nwssta B_nwsste B_nwurledk B_nwvfa B_nwvfe B_nwvfg B_wnwsmxfa B_wnwsmxfe rlnw_w /end OUT_MEASUREMENT
 /begin LOC_MEASUREMENT B_khnwt B_khnwta B_khnwte B_nwmd B_nwnmot B_nwsoada B_nwsoedk B_nwsrl B_nwsstend B_nwstvakt B_nwta B_nwte nnwtoelmn tvnwsttm_w /end LOC_MEASUREMENT
/end FUNCTION
/begin FUNCTION BBPHSYN "1.11" /begin DEF_CHARACTERISTIC ANZSYNAB /end DEF_CHARACTERISTIC /begin IN_MEASUREMENT B_pha2act B_phsok B_phsok2 B_st B_synph zrph zrph2 zzyl /end IN_MEASUREMENT /begin OUT_MEASUREMENT B_phesab B_phzueab /end OUT_MEASUREMENT
 /begin LOC_MEASUREMENT B_esabrev B_ph2okay B_phedge B_phedge2 B_phin B_phin2 countrev zrphsyn zrphsyn2 /end LOC_MEASUREMENT
/end FUNCTION
/begin FUNCTION BBSAWE "18.290"
 /begin DEF_CHARACTERISTIC CWNWEGTR CWSAWE DNSAH DNSAL DNSALH DNSATIP DNSLL DNSLLK DNVSA DNWEK DNWEOFF DVSA ENSAKHG GANGISAV KFNWEGM KFTVSA KFTVSAGI KFTVSAGNG KFTVSAKAT NGDNSA NGDNSAL NGDNWEGTR NSAFAN NWEGTRM NWENG NWENGFS SNM08SAUB TAVHKSAO TAVVKSAO TKATSA TKIHKSAO TNSAFAN TVSABFA TVSABTE TVSATM VSAA VWE /end DEF_CHARACTERISTIC
 /begin REF_CHARACTERISTIC SGA08MDUB STK04SAUB STM05SAUB /end REF_CHARACTERISTIC
 /begin IN_MEASUREMENT B_cvt B_dash B_dsls B_fa B_fan B_fs B_kh B_koe B_kuppl B_ll B_sacvt B_savfgr B_savmd B_savmsr B_stend B_te B_tippg B_vllr esst_sga08mdub esst_stk04saub esst_stm05saub gangi ngfil nmot nmot_w nstat tavhkm_w tavvkm_w tkatm tkihkm_w tmot tmst tnst_w vfzg /end IN_MEASUREMENT
 /begin OUT_MEASUREMENT B_sab B_sabfg B_sabte esst_snm08saub tvsab_w tvsans_w /end OUT_MEASUREMENT
 /begin LOC_MEASUREMENT B_dnsll B_nsafan B_nwemg B_sabt B_sabv B_saen B_tatmsa dnsa nsa nwe nwecvt nwema nwemn nwenga tvsaa_w tvsag_w tvsakat_w /end LOC_MEASUREMENT
/end FUNCTION
/begin COMPU_METHOD B_TRUE "" TAB_VERB "%6.3" "" COMPU_TAB_REF B_TRUE /end COMPU_METHOD
/begin COMPU_VTAB B_TRUE "" TAB_VERB 2 0 "----" 1 "TRUE" /end COMPU_VTAB
/begin COMPU_METHOD DEZ "" RAT_FUNC "%6.2" "" COEFFS 0 1 0 0 0 1 /end COMPU_METHOD
/begin COMPU_METHOD dez "" RAT_FUNC "%6.2" "" COEFFS 0 1 0 0 0 1 /end COMPU_METHOD
/begin COMPU_METHOD DEZL "" RAT_FUNC "%6.2" "" COEFFS 0 1 0 0 0 1 /end COMPU_METHOD
/begin COMPU_METHOD fak_q0p00174_JsK "" RAT_FUNC "%6.4" "J/sK" COEFFS 0 576 0 0 0 1 /end COMPU_METHOD
/begin COMPU_METHOD fak_q0p00273 "" RAT_FUNC "%6.4" "-" COEFFS 0 256 0 0 0 0.7 /end COMPU_METHOD
/begin COMPU_METHOD fak_q0p00347_JsK "" RAT_FUNC "%6.4" "J/sK" COEFFS 0 288 0 0 0 1 /end COMPU_METHOD
/begin COMPU_METHOD fak_q0p0039 "" RAT_FUNC "%6.4" "-" COEFFS 0 256 0 0 0 1 /end COMPU_METHOD
/begin COMPU_METHOD fak_q0p0078 "" RAT_FUNC "%6.4" "-" COEFFS 0 128 0 0 0 1 /end COMPU_METHOD
/begin COMPU_METHOD fak_q0p00926_JsKK "" RAT_FUNC "%6.4" "J/sK^2" COEFFS 0 108 0 0 0 1 /end COMPU_METHOD
/begin COMPU_METHOD fak_q0p1 "" RAT_FUNC "%6.3" "-" COEFFS 0 1 0 0 0 0.1 /end COMPU_METHOD
/begin COMPU_METHOD fak_q0p2222_JK "" RAT_FUNC "%6.3" "J/K" COEFFS 0 9 0 0 0 2 /end COMPU_METHOD
/begin COMPU_METHOD fak_sw_b0p0625 "" RAT_FUNC "%8.7" "-" COEFFS 0 65536 0 0 0 0.125 /end COMPU_METHOD
/begin COMPU_METHOD fak_sw_b2 "" RAT_FUNC "%7.6" "-" COEFFS 0 65536 0 0 0 4 /end COMPU_METHOD
/begin COMPU_METHOD fak_ub_b0p5 "" RAT_FUNC "%6.4" "-" COEFFS 0 256 0 0 0 0.5 /end COMPU_METHOD
/begin COMPU_METHOD fak_ub_b1 "" RAT_FUNC "%6.4" "-" COEFFS 0 256 0 0 0 1 /end COMPU_METHOD
/begin COMPU_METHOD fak_ub_b16 "" RAT_FUNC "%6.4" "-" COEFFS 0 256 0 0 0 16 /end COMPU_METHOD
/begin COMPU_METHOD fak_ub_b2 "" RAT_FUNC "%6.4" "-" COEFFS 0 256 0 0 0 2 /end COMPU_METHOD
/begin COMPU_METHOD fak_ub_b318p75 "" RAT_FUNC "%6.2" "-" COEFFS 0 256 0 0 0 318.75 /end COMPU_METHOD
/begin COMPU_METHOD fak_ub_b3p125 "" RAT_FUNC "%6.4" "%/1/min" COEFFS 0 2048 0 0 0 25 /end COMPU_METHOD
/begin COMPU_METHOD fak_ub_b4 "" RAT_FUNC "%6.4" "-" COEFFS 0 256 0 0 0 4 /end COMPU_METHOD
/begin COMPU_METHOD fak_uw_b1 "" RAT_FUNC "%7.6" "-" COEFFS 0 65536 0 0 0 1 /end COMPU_METHOD
/begin COMPU_METHOD fak_uw_b16 "" RAT_FUNC "%6.5" "-" COEFFS 0 65536 0 0 0 16 /end COMPU_METHOD
/begin COMPU_METHOD fak_uw_b160 "" RAT_FUNC "%6.4" "-" COEFFS 0 65536 0 0 0 160 /end COMPU_METHOD
/begin COMPU_METHOD fak_uw_b2 "" RAT_FUNC "%7.6" "-" COEFFS 0 65536 0 0 0 2 /end COMPU_METHOD
/begin COMPU_METHOD fak_uw_b4 "" RAT_FUNC "%7.6" "-" COEFFS 0 65536 0 0 0 4 /end COMPU_METHOD
/begin COMPU_METHOD fak_uw_b4864 "" RAT_FUNC "%6.4" "-" COEFFS 0 65536 0 0 0 4864 /end COMPU_METHOD
/begin COMPU_METHOD kw_q2p8125 "" RAT_FUNC "%6.2" "°KW" COEFFS 0 1 0 0 0 2.8125 /end COMPU_METHOD
/begin COMPU_METHOD kw_tooth_sy "" RAT_FUNC "%6.2" "°KW" COEFFS 0 0.166666666666667 0 0 0 1 /end COMPU_METHOD
/begin COMPU_METHOD m_q0p1 "" RAT_FUNC "%6.3" "kg/h" COEFFS 0 10 0 0 0 1 /end COMPU_METHOD
/begin COMPU_METHOD m_ub_b1020 "" RAT_FUNC "%6.2" "kg/h" COEFFS 0 1 0 0 0 4 /end COMPU_METHOD
/begin COMPU_METHOD m_ub_b23p3 "" RAT_FUNC "%6.3" "kg" COEFFS 0 2812.5 0 0 0 256 /end COMPU_METHOD
/begin COMPU_METHOD m_uw_b23p3 "" RAT_FUNC "%6.5" "kg" COEFFS 0 2812.5 0 0 0 1 /end COMPU_METHOD
/begin COMPU_METHOD m_uw_b25p6 "" RAT_FUNC "%6.5" "kg/h" COEFFS 0 65536 0 0 0 25.6 /end COMPU_METHOD
/begin COMPU_METHOD m_uw_b6553p5 "" RAT_FUNC "%6.3" "kg/h" COEFFS 0 1 0 0 0 0.1 /end COMPU_METHOD
/begin COMPU_METHOD nmotg_sb_q100 "" RAT_FUNC "%6.0" "1/min/s" COEFFS 0 1 0 0 0 100 /end COMPU_METHOD
/begin COMPU_METHOD nmotg_sw_q0p15625 "" RAT_FUNC "%6.3" "1/min/s" COEFFS 0 1 0 0 0 0.15625 /end COMPU_METHOD
/begin COMPU_METHOD nmot_sw_q0p25 "" RAT_FUNC "%6.3" "1/min" COEFFS 0 1 0 0 0 0.25 /end COMPU_METHOD
/begin COMPU_METHOD nmot_ub_q10 "" RAT_FUNC "%6.1" "1/min" COEFFS 0 1 0 0 0 10 /end COMPU_METHOD
/begin COMPU_METHOD nmot_ub_q32 "" RAT_FUNC "%6.1" "U/min" COEFFS 0 1 0 0 0 32 /end COMPU_METHOD
/begin COMPU_METHOD nmot_ub_q40 "" RAT_FUNC "%6.1" "1/min" COEFFS 0 1 0 0 0 40 /end COMPU_METHOD
/begin COMPU_METHOD nmot_uw_q0p25 "" RAT_FUNC "%6.3" "1/min" COEFFS 0 1 0 0 0 0.25 /end COMPU_METHOD
/begin COMPU_METHOD p_ub_q10 "" RAT_FUNC "%6.1" "hPa" COEFFS 0 1 0 0 0 10 /end COMPU_METHOD
/begin COMPU_METHOD qg_q5p333 "" RAT_FUNC "%6.2" "J/s" COEFFS 0 3 0 0 0 16 /end COMPU_METHOD
/begin COMPU_METHOD qnv_uw_b512 "" RAT_FUNC "%6.4" "(1/min) / (km/h)" COEFFS 0 65536 0 0 0 512 /end COMPU_METHOD
/begin COMPU_METHOD qptemp_q10p667 "" RAT_FUNC "%6.1" "J/K" COEFFS 0 3 0 0 0 32 /end COMPU_METHOD
/begin COMPU_METHOD q_q0p4551 "" RAT_FUNC "%6.3" "kJ" COEFFS 0 36000 0 0 0 16384 /end COMPU_METHOD
/begin COMPU_METHOD q_q64 "" RAT_FUNC "%6.1" "J" COEFFS 0 1 0 0 0 64 /end COMPU_METHOD
/begin COMPU_METHOD relDK_q0p00152 "" RAT_FUNC "%6.4" "%DK" COEFFS 0 65536 0 0 0 100 /end COMPU_METHOD
/begin COMPU_METHOD relDK_q0p02441 "" RAT_FUNC "%6.4" "%DK" COEFFS 0 65536 0 0 0 1600 /end COMPU_METHOD
/begin COMPU_METHOD relDK_q0p0625 "" RAT_FUNC "%6.4" "%PWM/%DK" COEFFS 0 16 0 0 0 1 /end COMPU_METHOD
/begin COMPU_METHOD relDK_q1 "" RAT_FUNC "%6.2" "%PWM/%DK" COEFFS 0 1 0 0 0 1 /end COMPU_METHOD
/begin COMPU_METHOD relDK_q4 "" RAT_FUNC "%6.2" "%" COEFFS 0 1 0 0 0 4 /end COMPU_METHOD
/begin COMPU_METHOD relDK_uw_b100 "" RAT_FUNC "%6.4" "%DK" COEFFS 0 65535 0 0 0 100 /end COMPU_METHOD
/begin COMPU_METHOD relPED_ub_b100 "" RAT_FUNC "%6.3" "%PED" COEFFS 0 255 0 0 0 100 /end COMPU_METHOD
/begin COMPU_METHOD relPED_uw_b100 "" RAT_FUNC "%6.4" "%PED" COEFFS 0 65535 0 0 0 100 /end COMPU_METHOD
/begin COMPU_METHOD rel_q0p1957 "" RAT_FUNC "%6.3" "%" COEFFS 0 511 0 0 0 100 /end COMPU_METHOD
/begin COMPU_METHOD rel_sw_b100 "" RAT_FUNC "%6.4" "%" COEFFS 0 32768 0 0 0 100 /end COMPU_METHOD
/begin COMPU_METHOD rel_sw_q0p1953 "" RAT_FUNC "%6.3" "%" COEFFS 0 65536 0 0 0 12800 /end COMPU_METHOD
/begin COMPU_METHOD rel_ub_b127p5 "" RAT_FUNC "%6.3" "%" COEFFS 0 2 0 0 0 1 /end COMPU_METHOD
/begin COMPU_METHOD rel_ub_b99p6 "" RAT_FUNC "%6.3" "%" COEFFS 0 256 0 0 0 100 /end COMPU_METHOD
/begin COMPU_METHOD rel_ub_q0p75 "" RAT_FUNC "%6.3" "%" COEFFS 0 1 0 0 0 0.75 /end COMPU_METHOD
/begin COMPU_METHOD rel_uw_b100 "" RAT_FUNC "%6.4" "%" COEFFS 0 65536 0 0 0 100 /end COMPU_METHOD
/begin COMPU_METHOD rel_uw_b200 "" RAT_FUNC "%6.4" "%" COEFFS 0 65536 0 0 0 200 /end COMPU_METHOD
/begin COMPU_METHOD rel_uw_q0p0234 "" RAT_FUNC "%6.4" "%" COEFFS 0 32 0 0 0 0.75 /end COMPU_METHOD
/begin COMPU_METHOD spg_q0p00488 "" RAT_FUNC "%6.4" "V" COEFFS 0 1024 0 0 0 5 /end COMPU_METHOD
/begin COMPU_METHOD spg_q0p1 "" RAT_FUNC "%6.3" "V" COEFFS 0 1 0 0 0 0.1 /end COMPU_METHOD
/begin COMPU_METHOD spg_ubatt "" RAT_FUNC "%6.4" "V" COEFFS 0 1 0 0 0 0.0704 /end COMPU_METHOD
/begin COMPU_METHOD spg_ubatt_sy "" RAT_FUNC "%6.4" "V" COEFFS 0 14.2222222222222 0 0 0 1 /end COMPU_METHOD
/begin COMPU_METHOD spg_uw_q0p001222 "" RAT_FUNC "%6.4" "V" COEFFS 0 65536 0 0 0 80 /end COMPU_METHOD
/begin COMPU_METHOD spg_uw_q0p00488 "" RAT_FUNC "%6.4" "V" COEFFS 0 1024 0 0 0 5 /end COMPU_METHOD
/begin COMPU_METHOD t100msxs_q16Em6 "" RAT_FUNC "%7.6" "s" COEFFS 0 1 0 0 0 1.6e-005 /end COMPU_METHOD
/begin COMPU_METHOD t100msxs_ub_b25p5 "" RAT_FUNC "%6.3" "s" COEFFS 0 1 0 0 0 0.1 /end COMPU_METHOD
/begin COMPU_METHOD t100msxs_uw_b6553p5 "" RAT_FUNC "%6.3" "s" COEFFS 0 1 0 0 0 0.1 /end COMPU_METHOD
/begin COMPU_METHOD t100msxs_uw_b6553p6 "" RAT_FUNC "%6.3" "s" COEFFS 0 10 0 0 0 1 /end COMPU_METHOD
/begin COMPU_METHOD t10msxs_ub_b2p55 "" RAT_FUNC "%6.4" "s" COEFFS 0 1 0 0 0 0.01 /end COMPU_METHOD
/begin COMPU_METHOD t10msxs_uw_b655p35 "" RAT_FUNC "%6.4" "s" COEFFS 0 1 0 0 0 0.01 /end COMPU_METHOD
/begin COMPU_METHOD t1msxms_q1 "" RAT_FUNC "%6.2" "ms" COEFFS 0 1 0 0 0 1 /end COMPU_METHOD
/begin COMPU_METHOD t1sxs_uw_b65535 "" RAT_FUNC "%6.2" "s" COEFFS 0 1 0 0 0 1 /end COMPU_METHOD
/begin COMPU_METHOD t1sxs_uw_q1 "" RAT_FUNC "%6.2" "s" COEFFS 0 1 0 0 0 1 /end COMPU_METHOD
/begin COMPU_METHOD t200msxs_ub_b51 "" RAT_FUNC "%6.3" "s" COEFFS 0 1 0 0 0 0.2 /end COMPU_METHOD
/begin COMPU_METHOD t20msxs_q40p96 "" RAT_FUNC "%6.1" "s" COEFFS 0 1 0 0 0 40.96 /end COMPU_METHOD
/begin COMPU_METHOD t20msxs_ub_b5p1 "" RAT_FUNC "%6.4" "s" COEFFS 0 1 0 0 0 0.02 /end COMPU_METHOD
/begin COMPU_METHOD t20msxs_uw_q0p02 "" RAT_FUNC "%6.4" "s" COEFFS 0 1 0 0 0 0.02 /end COMPU_METHOD
/begin COMPU_METHOD t40ms_ub_b10200 "" RAT_FUNC "%7.2" "ms" COEFFS 0 1 0 0 0 40 /end COMPU_METHOD
/begin COMPU_METHOD t500usxms_ub_q0p5 "" RAT_FUNC "%6.3" "ms" COEFFS 0 1 0 0 0 0.5 /end COMPU_METHOD
/begin COMPU_METHOD t50msxs_q0p05 "" RAT_FUNC "%6.4" "s" COEFFS 0 1 0 0 0 0.05 /end COMPU_METHOD
/begin COMPU_METHOD t50msxs_ub_b12p75 "" RAT_FUNC "%6.4" "s" COEFFS 0 1 0 0 0 0.05 /end COMPU_METHOD
/begin COMPU_METHOD t50msxs_uw_b3276p75 "" RAT_FUNC "%6.4" "s" COEFFS 0 1 0 0 0 0.05 /end COMPU_METHOD
/begin COMPU_METHOD tempg_q0p0234 "" RAT_FUNC "%6.4" "Grad C/s" COEFFS 0 256 0 0 0 6 /end COMPU_METHOD
/begin COMPU_METHOD temp_q0p0195 "" RAT_FUNC "%6.4" "Grad C" COEFFS 0 256 0 0 0 5 /end COMPU_METHOD
/begin COMPU_METHOD temp_q0p0234 "" RAT_FUNC "%6.4" "K" COEFFS 0 256 0 0 0 6 /end COMPU_METHOD
/begin COMPU_METHOD temp_q0p0234_o273 "" RAT_FUNC "%6.1" "Grad C" COEFFS 0 1 273.15 0 0 0.0234375 /end COMPU_METHOD
/begin COMPU_METHOD temp_q0p0468_K "" RAT_FUNC "%6.4" "Grad K" COEFFS 0 256 0 0 0 12 /end COMPU_METHOD
/begin COMPU_METHOD temp_q5 "" RAT_FUNC "%6.2" "Grad C" COEFFS 0 1 0 0 0 5 /end COMPU_METHOD
/begin COMPU_METHOD temp_ub_b191p25 "" RAT_FUNC "%6.3" "Grad C" COEFFS 0 1 0 0 0 0.75 /end COMPU_METHOD
/begin COMPU_METHOD temp_ub_q0p75_o48 "" RAT_FUNC "%6.2" "Grad C" COEFFS 0 1 48 0 0 0.75 /end COMPU_METHOD
/begin COMPU_METHOD temp_ub_q5_o50 "" RAT_FUNC "%6.2" "Grad C" COEFFS 0 1 50 0 0 5 /end COMPU_METHOD
/begin COMPU_METHOD temp_uw_q0p0195_o50 "" RAT_FUNC "%6.2" "Grad C" COEFFS 0 256 12800 0 0 5 /end COMPU_METHOD
/begin COMPU_METHOD tinjection_sy "" RAT_FUNC "%6.4" "ms" COEFFS 0 312.5 0 0 0 1 /end COMPU_METHOD
/begin COMPU_METHOD tsegment_sy "" RAT_FUNC "%6.5" "ms" COEFFS 0 1250 0 0 0 1 /end COMPU_METHOD
/begin COMPU_METHOD uefktget_ub_b25p4 "" RAT_FUNC "%6.3" "" COEFFS 0 10 0 0 0 1 /end COMPU_METHOD
/begin COMPU_METHOD vfzg_ub_q1p25 "" RAT_FUNC "%6.2" "km/h" COEFFS 0 1 0 0 0 1.25 /end COMPU_METHOD
/begin COMPU_METHOD vfzg_uw_b512 "" RAT_FUNC "%6.4" "km/h" COEFFS 0 65536 0 0 0 512 /end COMPU_METHOD
/begin COMPU_METHOD vol_q0p1 "" RAT_FUNC "%6.3" "ml" COEFFS 0 1 0 0 0 0.1 /end COMPU_METHOD
/begin COMPU_METHOD vs_q0p1 "" RAT_FUNC "%6.3" "ml/dT" COEFFS 0 1 0 0 0 0.1 /end COMPU_METHOD
/begin COMPU_METHOD zk100msxs_ub_b25p5 "" RAT_FUNC "%6.3" "s" COEFFS 0 0 256 0 10 0 /end COMPU_METHOD
/begin COMPU_METHOD zk10msxs_uw_b655 "" RAT_FUNC "%6.2" "s" COEFFS 0 0 65536 0 100 0 /end COMPU_METHOD
/begin COMPU_METHOD zk1sxs_ub_b255 "" RAT_FUNC "%6.2" "s" COEFFS 0 0 256 0 1 0 /end COMPU_METHOD
/begin COMPU_METHOD zk200msxs_uw_b13107 "" RAT_FUNC "%12.3" "s" COEFFS 0 0 13107.2 0 1 0 /end COMPU_METHOD
/begin COMPU_METHOD zw_azue_sy "" RAT_FUNC "%6.3" "Grad KW" COEFFS 0 1.33333333333333 0 0 0 1 /end COMPU_METHOD
/begin COMPU_METHOD zw_sb_q0p75 "" RAT_FUNC "%6.3" "Grad KW" COEFFS 0 255 0 0 0 191.25 /end COMPU_METHOD
/begin COMPU_METHOD zw_TR2OT_sy "" RAT_FUNC "%6.2" "Grad KW" COEFFS 0 -1.33333333333333 96 0 0 1 /end COMPU_METHOD
/begin COMPU_METHOD zw_TR2OT_teeth_sy "" RAT_FUNC "%6.3" "Grad KW" COEFFS 0 -0.166666666666667 12 0 0 1 /end COMPU_METHOD
/begin RECORD_LAYOUT FkfNoShNoOffWUb FNC_VALUES 1 UBYTE COLUMN_DIR DIRECT /end RECORD_LAYOUT
/begin RECORD_LAYOUT FklWSw FNC_VALUES 1 SWORD COLUMN_DIR DIRECT /end RECORD_LAYOUT
/begin RECORD_LAYOUT FklWUb FNC_VALUES 1 UBYTE COLUMN_DIR DIRECT /end RECORD_LAYOUT
/begin RECORD_LAYOUT FklWUw FNC_VALUES 1 UWORD COLUMN_DIR DIRECT /end RECORD_LAYOUT
/begin RECORD_LAYOUT GkfWSb FNC_VALUES 1 SBYTE COLUMN_DIR DIRECT /end RECORD_LAYOUT
/begin RECORD_LAYOUT GkfWUb FNC_VALUES 1 UBYTE COLUMN_DIR DIRECT /end RECORD_LAYOUT
/begin RECORD_LAYOUT GkfWUw FNC_VALUES 1 UWORD COLUMN_DIR DIRECT /end RECORD_LAYOUT
/begin RECORD_LAYOUT GklWSb FNC_VALUES 1 SBYTE COLUMN_DIR DIRECT /end RECORD_LAYOUT
/begin RECORD_LAYOUT GklWUb FNC_VALUES 1 UBYTE COLUMN_DIR DIRECT /end RECORD_LAYOUT
/begin RECORD_LAYOUT GklWUw FNC_VALUES 1 UWORD COLUMN_DIR DIRECT /end RECORD_LAYOUT
/begin RECORD_LAYOUT KfAxUbAyUbSstxUbSstyUbWUb NO_AXIS_PTS_X 1 UBYTE NO_AXIS_PTS_Y 2 UBYTE AXIS_PTS_X 3 UBYTE INDEX_INCR DIRECT AXIS_PTS_Y 4 UBYTE INDEX_INCR DIRECT FNC_VALUES 5 UBYTE COLUMN_DIR DIRECT /end RECORD_LAYOUT
/begin RECORD_LAYOUT KfAxUbAyUbSstxUbSstyUwWUb NO_AXIS_PTS_X 1 UBYTE NO_AXIS_PTS_Y 2 UBYTE AXIS_PTS_X 3 UBYTE INDEX_INCR DIRECT AXIS_PTS_Y 4 UWORD INDEX_INCR DIRECT FNC_VALUES 5 UBYTE COLUMN_DIR DIRECT /end RECORD_LAYOUT
/begin RECORD_LAYOUT KfAxUbAyUbSstxUwSstyUbWUb NO_AXIS_PTS_X 1 UBYTE NO_AXIS_PTS_Y 2 UBYTE AXIS_PTS_X 3 UWORD INDEX_INCR DIRECT AXIS_PTS_Y 4 UBYTE INDEX_INCR DIRECT FNC_VALUES 5 UBYTE COLUMN_DIR DIRECT /end RECORD_LAYOUT
/begin RECORD_LAYOUT KfAxUwAyUwSstxUwSstyUwWUw NO_AXIS_PTS_X 1 UWORD NO_AXIS_PTS_Y 2 UWORD AXIS_PTS_X 3 UWORD INDEX_INCR DIRECT AXIS_PTS_Y 4 UWORD INDEX_INCR DIRECT FNC_VALUES 5 UWORD COLUMN_DIR DIRECT /end RECORD_LAYOUT
/begin RECORD_LAYOUT KlAUbSstSbWUb NO_AXIS_PTS_X 1 UBYTE AXIS_PTS_X 2 SBYTE INDEX_INCR DIRECT FNC_VALUES 3 UBYTE COLUMN_DIR DIRECT /end RECORD_LAYOUT
/begin RECORD_LAYOUT KlAUbSstUbWSb NO_AXIS_PTS_X 1 UBYTE AXIS_PTS_X 2 UBYTE INDEX_INCR DIRECT FNC_VALUES 3 SBYTE COLUMN_DIR DIRECT /end RECORD_LAYOUT
/begin RECORD_LAYOUT KlAUbSstUbWUb NO_AXIS_PTS_X 1 UBYTE AXIS_PTS_X 2 UBYTE INDEX_INCR DIRECT FNC_VALUES 3 UBYTE COLUMN_DIR DIRECT /end RECORD_LAYOUT
/begin RECORD_LAYOUT KlAUbSstUbWUw NO_AXIS_PTS_X 1 UBYTE AXIS_PTS_X 2 UBYTE INDEX_INCR DIRECT FNC_VALUES 3 UWORD COLUMN_DIR DIRECT /end RECORD_LAYOUT
/begin RECORD_LAYOUT KlAUbSstUwWUb NO_AXIS_PTS_X 1 UBYTE AXIS_PTS_X 2 UWORD INDEX_INCR DIRECT FNC_VALUES 3 UBYTE COLUMN_DIR DIRECT /end RECORD_LAYOUT
/begin RECORD_LAYOUT KlAUbSstUwWUw NO_AXIS_PTS_X 1 UWORD AXIS_PTS_X 2 UWORD INDEX_INCR DIRECT FNC_VALUES 3 UWORD COLUMN_DIR DIRECT /end RECORD_LAYOUT
/begin RECORD_LAYOUT KlAUwSstUwWUw NO_AXIS_PTS_X 1 UWORD AXIS_PTS_X 2 UWORD INDEX_INCR DIRECT FNC_VALUES 3 UWORD COLUMN_DIR DIRECT /end RECORD_LAYOUT
/begin RECORD_LAYOUT KwbUb FNC_VALUES 1 UBYTE COLUMN_DIR DIRECT /end RECORD_LAYOUT
/begin RECORD_LAYOUT KwSb FNC_VALUES 1 SBYTE COLUMN_DIR DIRECT /end RECORD_LAYOUT
/begin RECORD_LAYOUT KwSw FNC_VALUES 1 SWORD COLUMN_DIR DIRECT /end RECORD_LAYOUT
/begin RECORD_LAYOUT KwUb FNC_VALUES 1 UBYTE COLUMN_DIR DIRECT /end RECORD_LAYOUT
/begin RECORD_LAYOUT KwUw FNC_VALUES 1 UWORD COLUMN_DIR DIRECT /end RECORD_LAYOUT
/begin RECORD_LAYOUT SstASwSstSw NO_AXIS_PTS_X 1 SWORD AXIS_PTS_X 2 SWORD INDEX_INCR DIRECT /end RECORD_LAYOUT
/begin RECORD_LAYOUT SstAUbSstUb NO_AXIS_PTS_X 1 UBYTE AXIS_PTS_X 2 UBYTE INDEX_INCR DIRECT /end RECORD_LAYOUT
/begin RECORD_LAYOUT SstAUwSstUw NO_AXIS_PTS_X 1 UWORD AXIS_PTS_X 2 UWORD INDEX_INCR DIRECT /end RECORD_LAYOUT
/end MODULE
/end PROJECT
