ASAP2_VERSION 1 3
/begin PROJECT X505R_24d1_0 "4019.XX"
/begin HEADER "" VERSION "X505R_24d1_0" PROJECT_NO X505R_24d1_0 /end HEADER
/begin MODULE DIM ""
/begin MOD_COMMON "" BYTE_ORDER MSB_LAST ALIGNMENT_BYTE 1 ALIGNMENT_WORD 2 ALIGNMENT_LONG 2 /end MOD_COMMON
/begin CHARACTERISTIC AGRRMAX "maximal mögliche AGR-Rate" VALUE 0x811510 KwUb 99.61 rel_ub_b99p6 0.00 99.61 FORMAT "%5.2" /end CHARACTERISTIC
/begin CHARACTERISTIC ANZEAUS "Anzahl der auszublendenden Einspritzungen" VALUE 0x8109CC KwUb 3.000 dez 4.000 7.000 FORMAT "%5.3" /end CHARACTERISTIC
/begin CHARACTERISTIC CLRS "Codewort für Betriebsmodi LRS" VALUE 0x811C1E KwUb 255.0 dez 0.00 255.0 FORMAT "%5.1" /end CHARACTERISTIC
/begin CHARACTERISTIC CLRSHK "Codewort für Freigabe LRSHK und Auswahl Initialisierung" VALUE 0x81A018 KwUb 255.0 dez 0.00 255.0 FORMAT "%5.1" /end CHARACTERISTIC
/begin CHARACTERISTIC CLRSHKA "Codewort II für Freigabe LRSHK und Auswahl Initialisierung" VALUE 0x81A019 KwUb 255.0 dez 0.00 255.0 FORMAT "%5.1" /end CHARACTERISTIC
/begin CHARACTERISTIC CLRSKA "Code-Wort Funktionsart Kat-Ausräumen" VALUE 0x81A01D KwUb 255.0 dez 0.00 255.0 FORMAT "%5.1" /end CHARACTERISTIC
/begin CHARACTERISTIC CLRZWTMS "Codewort Zwangseinschaltung LR gemäß CARB-Forderung" VALUE 0x81A003 KwUb 255.0 dez 0.00 255.0 FORMAT "%5.1" /end CHARACTERISTIC
/begin CHARACTERISTIC CNFMDVER "Codewort zur Konfiguration von MDVER" VALUE 0x819E73 KwUb 255.0 dez 0.00 255.0 FORMAT "%5.1" /end CHARACTERISTIC
/begin CHARACTERISTIC CNFMDWAN "Codewort für die Einberechnung von MDWAN in der LLR" VALUE 0x8113A2 KwUb 255.0 dez 0.00 255.0 FORMAT "%5.1" /end CHARACTERISTIC
/begin CHARACTERISTIC CNFSL "Codewort für Einberechnung der Servolenkung in der LLR" VALUE 0x811490 KwUb 255.0 dez 0.00 255.0 FORMAT "%5.1" /end CHARACTERISTIC
/begin CHARACTERISTIC CREDSTU "Codewort für Reduzierstufe ein/aus" VALUE 0x8116DA KwUb 255.0 dez 0.00 255.0 FORMAT "%5.1" /end CHARACTERISTIC
/begin CHARACTERISTIC CWDMFAB "Codewort Sw-Schalter für Änderungsbegrenzung" VALUE 0x8114F0 KwUb 255.0 DEZ 0.00 255.0 FORMAT "%5.1" /end CHARACTERISTIC
/begin CHARACTERISTIC CWLRMS "Codewort Magerschutz" VALUE 0x819FF5 KwUb 255.0 dez 0.00 255.0 FORMAT "%5.1" /end CHARACTERISTIC
/begin CHARACTERISTIC CWMDBAS "Codewort Einrechnung der ZW-Korrektur für AGR-Betrieb" VALUE 0x811511 KwUb 255.0 dez 0.00 255.0 FORMAT "%5.1" /end CHARACTERISTIC
/begin CHARACTERISTIC CWMDBGRG "Codewort MDBGRG" VALUE 0x819F29 KwUb 255.0 dez 0.00 255.0 FORMAT "%5.1" /end CHARACTERISTIC
/begin CHARACTERISTIC CWMDFAW "Codewort für %MDFAW" VALUE 0x8114F1 KwUb 255.0 DEZ 0.00 255.0 FORMAT "%5.1" /end CHARACTERISTIC
/begin CHARACTERISTIC CWMDKOG "Codewort MDKOG: Zündwinkelspätverstellung bei Unterdruckbegrenzung" VALUE 0x811509 KwUb 255.0 dez 0.00 255.0 FORMAT "%5.1" /end CHARACTERISTIC
/begin CHARACTERISTIC CWMDKOL "Codeword MDKOL: Momentenbegrenzung" VALUE 0x81150F KwUb 255.0 dez 0.00 255.0 FORMAT "%5.1" /end CHARACTERISTIC
/begin CHARACTERISTIC CWMDRLKO "Codewort: Klimakompressormoment abh. von rl, nmot" VALUE 0x811491 KwUb 255.0 dez 0.00 255.0 FORMAT "%5.1" /end CHARACTERISTIC
/begin CHARACTERISTIC CWNLPH "Freigabe der jeweiligen Phasengebernotlauffunktion" VALUE 0x8109CD KwUb 255.0 dez 0.00 255.0 FORMAT "%5.1" /end CHARACTERISTIC
/begin CHARACTERISTIC CWRLAPPL "Codewort Vorgabe rlsol_w während Applikationsphase" VALUE 0x810D4E KwUb 255.0 dez 0.00 255.0 FORMAT "%5.1" /end CHARACTERISTIC
/begin CHARACTERISTIC CWTEZW "Codewort Zündwinkeleingriff bei TEV-Prüfung" VALUE 0x81150A KwUb 255.0 dez 0.00 255.0 FORMAT "%5.1" /end CHARACTERISTIC
/begin CHARACTERISTIC CWTUM "Codewort: Umgebungstemperatur für Klimakompressor" VALUE 0x819CD8 KwUb 255.0 dez 0.00 255.0 FORMAT "%5.1" /end CHARACTERISTIC
/begin CHARACTERISTIC CWZWVMX "Codewort Zündwinkeleingriff bei VMAX-Begrenzung" VALUE 0x81150B KwUb 255.0 dez 0.00 255.0 FORMAT "%5.1" /end CHARACTERISTIC
/begin CHARACTERISTIC DELRL "Delta relative Luftfüllung für Freigabe ZW-Eingriff" VALUE 0x81150C KwUb 5.977 rel_uw_q0p0234 0.00 5.977 FORMAT "%5.3" /end CHARACTERISTIC
/begin CHARACTERISTIC DLAHINI "Initwert Integrator dlahi der stetigen LRHK" VALUE 0x816D3A KwSw 1.999969 fak_sw_b1 -1.000000 0.9999695 FORMAT "%8.6" /end CHARACTERISTIC
/begin CHARACTERISTIC DLAMXSA "max Regeldifferenz, für die nach SA die LRS gesperrt bleibt" VALUE 0x816D00 KwUw 15.99976 fak_uw_b16 0.00 15.99976 FORMAT "%8.5" /end CHARACTERISTIC
/begin CHARACTERISTIC DMADFK "Maximal adaptierbares Delta-Verlustmoment pro Adaptionsphase Fahrst.+Kompr." VALUE 0x819C98 KwUb 24.90 rel_ub_b24p9 0.00 24.90 FORMAT "%5.2" /end CHARACTERISTIC
/begin CHARACTERISTIC DMADFS "Maximal adaptierbares Delta-Verlustmoment pro Adaptionsphase mit Fahrstufe ein" VALUE 0x819C99 KwUb 24.90 rel_ub_b24p9 0.00 24.90 FORMAT "%5.2" /end CHARACTERISTIC
/begin CHARACTERISTIC DMADKO "Maximal adaptierbares Delta-Verlustmoment pro Adaptionsphase Kompr.ein" VALUE 0x819C9A KwUb 24.90 rel_ub_b24p9 0.00 24.90 FORMAT "%5.2" /end CHARACTERISTIC
/begin CHARACTERISTIC DMADLL "Maximal adaptierbares Delta-Verlustmoment pro Adaptionsphase ohne Last" VALUE 0x819C9B KwUb 24.90 rel_ub_b24p9 0.00 24.90 FORMAT "%5.2" /end CHARACTERISTIC
/begin CHARACTERISTIC DMADMNFK "Minimal adaptierbares Delta-Verlustmoment Fahrstufe eingelegt + Kompressor ein" VALUE 0x819C9C KwUb 24.90 rel_ub_bn24p9 -24.90 0.00 FORMAT "%5.2" /end CHARACTERISTIC
/begin CHARACTERISTIC DMADMNFS "Minimal adaptierbares Delta-Verlustmoment Fahrstufe eingelegt" VALUE 0x819C9D KwUb 24.90 rel_ub_bn24p9 -24.90 0.00 FORMAT "%5.2" /end CHARACTERISTIC
/begin CHARACTERISTIC DMADMNKO "Minimal adaptierbares Delta-Verlustmoment Klimakompressor ein" VALUE 0x819C9E KwUb 24.90 rel_ub_bn24p9 -24.90 0.00 FORMAT "%5.2" /end CHARACTERISTIC
/begin CHARACTERISTIC DMADMNLL "Minimal adaptierbares Delta-Verlustmoment ohne Last" VALUE 0x819C9F KwUb 24.90 rel_ub_bn24p9 -24.90 0.00 FORMAT "%5.2" /end CHARACTERISTIC
/begin CHARACTERISTIC DMADMXFK "Maximal adaptierbares Delta-Verlustmoment Farstufe + Klimakompressor ein" VALUE 0x819CA0 KwUb 24.90 rel_ub_b24p9 0.00 24.90 FORMAT "%5.2" /end CHARACTERISTIC
/begin CHARACTERISTIC DMADMXFS "Maximal adaptierbares Delta-Verlustmoment Farstufe ein" VALUE 0x819CA1 KwUb 24.90 rel_ub_b24p9 0.00 24.90 FORMAT "%5.2" /end CHARACTERISTIC
/begin CHARACTERISTIC DMADMXKO "Maximal adaptierbares Delta-Verlustmoment Klimakompressor ein" VALUE 0x819CA2 KwUb 24.90 rel_ub_b24p9 0.00 24.90 FORMAT "%5.2" /end CHARACTERISTIC
/begin CHARACTERISTIC DMADMXLL "Maximal adaptierbares Delta-Verlustmoment ohne Last" VALUE 0x819CA3 KwUb 24.90 rel_ub_b24p9 0.00 24.90 FORMAT "%5.2" /end CHARACTERISTIC
/begin CHARACTERISTIC DMAUFN "Delta-Moment Aufregelung nach Drehmomenteingriff" CURVE 0x829808 KlAUwSstUwWUw 99.99847 rel_uw_b100 0.00 99.99847 FORMAT "%8.5"
 /begin AXIS_DESCR STD_AXIS nmot_w nmot_uw_q0p25 8 0.00 16383.75 FORMAT "%8.2" DEPOSIT ABSOLUTE /end AXIS_DESCR
/end CHARACTERISTIC
/begin CHARACTERISTIC DMDDLWS "Lenkhilfelastmoment abhängig von der Lenkwinkelgeschwindigkeit" CURVE 0x81F9BA KlASwSstSwWSw 99.99847 rel_uw_b100 -50.00000 49.99847 FORMAT "%8.5"
 /begin AXIS_DESCR STD_AXIS dlwsu_w dlw_sw_q0p04375 6 -1434.044 1434.000 FORMAT "%8.3" DEPOSIT ABSOLUTE /end AXIS_DESCR
/end CHARACTERISTIC
/begin CHARACTERISTIC DMDGENAB "Änderung: Faktor Generatormoment" VALUE 0x811492 KwSb 1.000 fak_sb_b1 -1.000 0.00 FORMAT "%5.3" /end CHARACTERISTIC
/begin CHARACTERISTIC DMDLWS "Lenkhilfelastmoment" CURVE 0x81F9D4 KlAUbSstSbWUb 49.73 rel_ub_b49p725 0.00 49.73 FORMAT "%5.2"
 /begin AXIS_DESCR STD_AXIS lws lw_sb_q11p2 6 -1445. 1434. FORMAT "%5.0" DEPOSIT ABSOLUTE /end AXIS_DESCR
/end CHARACTERISTIC
/begin CHARACTERISTIC DMDNSM "Delta Moment zur Nachstartkompensation" CURVE 0x819E74 KlAUbSstUbWUb 99.61 rel_ub_b99p6 0.00 99.61 FORMAT "%5.2"
 /begin AXIS_DESCR STD_AXIS tmot temp_ub_q0p75_o48 8 -48.00 143.3 FORMAT "%5.1" DEPOSIT ABSOLUTE /end AXIS_DESCR
/end CHARACTERISTIC
/begin CHARACTERISTIC DMDPUG "delta Moment Dashpotende" CURVE 0x8161B8 KlAUwSstSwWUw 99.99847 rel_uw_b100 0.00 99.99847 FORMAT "%8.5"
 /begin AXIS_DESCR STD_AXIS mkfanb_w rel_sw_b100 8 -100.0000 99.99695 FORMAT "%8.4" DEPOSIT ABSOLUTE /end AXIS_DESCR
/end CHARACTERISTIC
/begin CHARACTERISTIC DMDWHYS "Hysterese für Bildung D-Anteil-Wandlermoment" VALUE 0x8113A3 KwUb 99.61 rel_ub_b99p6 0.00 99.61 FORMAT "%5.2" /end CHARACTERISTIC
/begin CHARACTERISTIC DMDWM "D-Anteil Wandlermoment bei Einlegen der Fahrstufe" CURVE 0x819CA6 GklWUb 99.61 rel_ub_b99p6 0.00 99.61 FORMAT "%5.2"
 /begin AXIS_DESCR COM_AXIS tmot temp_ub_q0p75_o48 8 -48.00 143.3 AXIS_PTS_REF STM08MDUB /end AXIS_DESCR
/end CHARACTERISTIC
/begin CHARACTERISTIC DMIFLSD "Delta-Moment für Initialisierung Filter Lastschlagdämpfung" VALUE 0x8161DA KwUw 99.99847 rel_uw_b100 0.00 99.99847 FORMAT "%8.5" /end CHARACTERISTIC
/begin CHARACTERISTIC DMIZWMN "Offset auf indiziertes Motormoment bei spätestem Zündwinkel und ASR-Eingriff" VALUE 0x8116DB KwUb 99.61 rel_ub_b99p6 0.00 99.61 FORMAT "%5.2" /end CHARACTERISTIC
/begin CHARACTERISTIC DMLSDUG "Delta Moment Ende Lastschlagdämpfung" CURVE 0x8161DC KlAUwSstSwWUw 99.99847 rel_uw_b100 0.00 99.99847 FORMAT "%8.5"
 /begin AXIS_DESCR STD_AXIS mkfanb_w rel_sw_b100 8 -100.0000 99.99695 FORMAT "%8.4" DEPOSIT ABSOLUTE /end AXIS_DESCR
/end CHARACTERISTIC
/begin CHARACTERISTIC DMRAA "allgemeine Momentenreserve Kurztrip" VALUE 0x81FBCC KwUw 99.99847 rel_uw_b100 0.00 99.99847 FORMAT "%8.5" /end CHARACTERISTIC
/begin CHARACTERISTIC DMRFAWEN "Schwelle mrfa-Gradient für Deaktivierung PT1-Filter beim Wiedereinsetzen" CURVE 0x826CC0 KlAUwSstUwWUw 199.9969 rel_uw_b200 0.00 199.9969 FORMAT "%8.4"
 /begin AXIS_DESCR STD_AXIS nmot_w nmot_uw_q0p25 4 0.00 16383.75 FORMAT "%8.2" DEPOSIT ABSOLUTE /end AXIS_DESCR
/end CHARACTERISTIC
/begin CHARACTERISTIC DMRTMKI "Inkrement für Regelfaktor Momentenbegrenzung über Motortemperatur" VALUE 0x819F2A KwUb 1.992 fak_ub_b2 0.00 1.992 FORMAT "%5.3" /end CHARACTERISTIC
/begin CHARACTERISTIC DMVERLMN "minimale Verlustmomentschwelle" VALUE 0x8169B2 KwUw 99.99847 rel_uw_b100 0.00 99.99847 FORMAT "%8.5" /end CHARACTERISTIC
/begin CHARACTERISTIC DRLMINDP "Offset auf rlmin für Abschaltung Dashpot" VALUE 0x8161FE KwSw 1535.977 rel_sw_q0p0234 -768.0000 767.9766 FORMAT "%8.4" /end CHARACTERISTIC
/begin CHARACTERISTIC DTMIBG "Delta temperatur für Hysterese Breite" VALUE 0x819F2B KwUb 191.3 temp_ub_q0p75_o48 -48.00 143.3 FORMAT "%5.1" /end CHARACTERISTIC
/begin CHARACTERISTIC DTMR "Hysterese für Einschaltschwelle" VALUE 0x811CE9 KwUb 191.3 temp_ub_b191p25 0.00 191.3 FORMAT "%5.1" /end CHARACTERISTIC
/begin CHARACTERISTIC DTMTMRW "Temperaturdiff.-Schwelle für die Prüfung, ob Zwangseinschaltung LR nötig (CARB)" VALUE 0x81A004 KwSb 191.3 temp_sb_q0p75 -96.00 95.25 FORMAT "%5.2" /end CHARACTERISTIC
/begin CHARACTERISTIC DYNMXNL "Schwellwert für Dynamikbewertung -> hohe Dynamik" VALUE 0x813FE4 KwUw 40000.00 t5usxus_q5 0.00 40000.00 FORMAT "%8.2" /end CHARACTERISTIC
/begin CHARACTERISTIC DZWETA "Deltazündwinkel aus Wirkungsgrad" CURVE 0x811F74 FklWSb 191.3 zw_sb_q0p75 -96.00 95.25 FORMAT "%5.2"
 /begin AXIS_DESCR FIX_AXIS etazws rel_ub_b127p5 201 0.00 100.0 FORMAT "%5.1" FIX_AXIS_PAR 0 0 201 /end AXIS_DESCR
/end CHARACTERISTIC
/begin CHARACTERISTIC DZWOLA "Lambda-Abhängigkeit des optimalen Zündwinkels bezogen auf Lambda 1" CURVE 0x816818 KlAUbSstUbWSb 191.3 zw_sb_q0p75 -96.00 95.25 FORMAT "%5.2"
 /begin AXIS_DESCR STD_AXIS lambas fak_ub_b2 10 0.00 1.992 FORMAT "%5.3" DEPOSIT ABSOLUTE /end AXIS_DESCR
/end CHARACTERISTIC
/begin CHARACTERISTIC DZWOM "temperaturabhängiger Offset des optimalen ZW" CURVE 0x81682E KlAUbSstUbWSb 191.3 zw_sb_q0p75 -96.00 95.25 FORMAT "%5.2"
 /begin AXIS_DESCR STD_AXIS tmot temp_ub_q0p75_o48 5 -48.00 143.3 FORMAT "%5.1" DEPOSIT ABSOLUTE /end AXIS_DESCR
/end CHARACTERISTIC
/begin CHARACTERISTIC ETADZW "ZW-Wirkungsgrad in Abhängigkeit von delta ZW" CURVE 0x811512 FklWUb 127.5 rel_ub_b127p5 0.00 127.5 FORMAT "%5.1"
 /begin AXIS_DESCR FIX_AXIS dzw_kge zw_sb_q0p75 65 0.00 48.00 FORMAT "%5.2" FIX_AXIS_PAR 0 0 65 /end AXIS_DESCR
/end CHARACTERISTIC
/begin CHARACTERISTIC ETALAM "Lambda-Wirkungsgrad" CURVE 0x811553 KlAUbSstUbWUb 127.5 rel_ub_b127p5 0.00 127.5 FORMAT "%5.1"
 /begin AXIS_DESCR STD_AXIS lambas fak_ub_b2 10 0.00 1.992 FORMAT "%5.3" DEPOSIT ABSOLUTE /end AXIS_DESCR
/end CHARACTERISTIC
/begin CHARACTERISTIC FABMDWA "Faktor zur Absteuerung des Wandlermoments abhängig von nturb/nsol" CURVE 0x8113A4 KlAUbSstUbWUb 0.9961 fak_ub_b1 0.00 0.9961
 /begin AXIS_DESCR STD_AXIS qntns fak_ub_b8 6 0.00 7.969 FORMAT "%5.3" DEPOSIT ABSOLUTE /end AXIS_DESCR
/end CHARACTERISTIC
/begin CHARACTERISTIC FDMDWAN "Wichtungsfaktor für Einrechnung D-Anteil in Wandlermoment" VALUE 0x8113B1 KwUb 0.9961 fak_ub_b1 0.00 0.9961 /end CHARACTERISTIC
/begin CHARACTERISTIC FGMIFAL "Gewichtungsfaktor für Überhöhung über KFWMIFAL" CURVE 0x8114F2 FklWUb 1.992 fak_ub_b2 0.00 1.992 FORMAT "%5.3"
 /begin AXIS_DESCR FIX_AXIS gangi dez 8 0.00 7.000 FORMAT "%5.3" FIX_AXIS_PAR 0 0 8 /end AXIS_DESCR
/end CHARACTERISTIC
/begin CHARACTERISTIC FGZLSD "Gewichtungsfaktor für Reduktion über KFZLSD" CURVE 0x8114FA FklWUb 1.992 fak_ub_b2 0.00 1.992 FORMAT "%5.3"
 /begin AXIS_DESCR FIX_AXIS gangi dez 8 0.00 7.000 FORMAT "%5.3" FIX_AXIS_PAR 0 0 8 /end AXIS_DESCR
/end CHARACTERISTIC
/begin CHARACTERISTIC FIRNLIGN "Mindestwert für Winkelfehler nach der ersten Zündung" VALUE 0x8109E0 KwUb 255.0 kw_q1 0.00 255.0 FORMAT "%5.1" /end CHARACTERISTIC
/begin CHARACTERISTIC FKFPEDV "Faktor für Interpolation zwischen den beiden Pedalkennfeldern" CURVE 0x819DF1 KlAUbSstUbWUb 1.000 fak_ub_b2 0.00 1.000 FORMAT "%5.3"
 /begin AXIS_DESCR STD_AXIS vfzg vfzg_ub_q1p25 2 0.00 318.8 FORMAT "%5.1" DEPOSIT ABSOLUTE /end AXIS_DESCR
/end CHARACTERISTIC
/begin CHARACTERISTIC FKZDPTM "Korrekturfaktor Zeitkonstante Dashpot" CURVE 0x819DF6 KlAUbSstUbWUb 1.49804 rfak_q0p5 0.501961 2.00000 FORMAT "%7.5"
 /begin AXIS_DESCR STD_AXIS tmot temp_ub_q0p75_o48 6 -48.00 143.3 FORMAT "%5.1" DEPOSIT ABSOLUTE /end AXIS_DESCR
/end CHARACTERISTIC
/begin CHARACTERISTIC FLMLKAMA "Faktor zur Bewertung Schwellwert integr. Fettfl. f. Abbruch Kat-Ausr. Pre/Main" VALUE 0x811EED KwUb 7.969 fak_ub_b8 0.00 7.969 FORMAT "%5.3" /end CHARACTERISTIC
/begin CHARACTERISTIC FLRMIFAL "Faktor für Fahrerwunschmoment Füllungspfad im Low Range" VALUE 0x811502 KwUb 3.984 fak_ub_b4 0.00 3.984 FORMAT "%5.3" /end CHARACTERISTIC
/begin CHARACTERISTIC FLRZDASH "Faktor für Dashpot-Zeitkonstante im Low Range" VALUE 0x811503 KwUb 3.49804 rfak_q0p5 0.501961 4.00000 FORMAT "%7.5" /end CHARACTERISTIC
/begin CHARACTERISTIC FLRZLSD "Faktor für LSD-Zeitkonstante im Low Range" VALUE 0x819E03 KwUb 3.984 fak_ub_b4 0.00 3.984 FORMAT "%5.3" /end CHARACTERISTIC
/begin CHARACTERISTIC FMDGEN "Faktor Generatormoment vor Eigenerwärmung" VALUE 0x811493 KwUb 6.969 fak_ub_b8 1.000 7.969 FORMAT "%5.3" /end CHARACTERISTIC
/begin CHARACTERISTIC FMDGENTA "Generatormoment Temperaturanteil" CURVE 0x811494 KlAUbSstUbWUb 1.992 rel_ub_b2p0 0.00 1.992 FORMAT "%5.3"
 /begin AXIS_DESCR STD_AXIS tans temp_ub_q0p75_o48 6 -48.00 143.3 FORMAT "%5.1" DEPOSIT ABSOLUTE /end AXIS_DESCR
/end CHARACTERISTIC
/begin CHARACTERISTIC FMDWAT "Faktor zur Berechnung des Wandlermoments abh. von der Öltemperatur des Wandlers" CURVE 0x819CAE GklWUb 0.000119850000 fak_ub_q4p7Em7 0.00 0.000119850000 FORMAT "%14.12"
 /begin AXIS_DESCR COM_AXIS tmot temp_ub_q0p75_o48 8 -48.00 143.3 AXIS_PTS_REF STM08MDUB /end AXIS_DESCR
/end CHARACTERISTIC
/begin CHARACTERISTIC FMIVL "Faktor Korrektur maximales Moment bei VL" VALUE 0x819E68 KwUb 1.992 fak_ub_b2 0.00 1.992 FORMAT "%5.3" /end CHARACTERISTIC
/begin CHARACTERISTIC FNLMI0 "Bewertungsfaktor von tsegph(k) für gleitenden Mittelwert" VALUE 0x8109E1 KwUb 7.969 fak_ub_b8 0.00 7.969 FORMAT "%5.3" /end CHARACTERISTIC
/begin CHARACTERISTIC FNLMI1 "Bewertungsfaktor von tsegph(k-1) für gleitenden Mittelwert" VALUE 0x8109E2 KwUb 7.969 fak_ub_b8 0.00 7.969 FORMAT "%5.3" /end CHARACTERISTIC
/begin CHARACTERISTIC FNLMI2 "Bewertungsfaktor von tsegph(k-2) für gleitenden Mittelwert" VALUE 0x8109E3 KwUb 7.969 fak_ub_b8 0.00 7.969 FORMAT "%5.3" /end CHARACTERISTIC
/begin CHARACTERISTIC FNRAD "Faktor zwischen Raddrehzahl und Geschwindigkeit f(Radumfang)" VALUE 0x8113B2 KwUb 15.94 fak_ub_b16 0.00 15.94 FORMAT "%5.2" /end CHARACTERISTIC
/begin CHARACTERISTIC FNSTABNV "Faktor zur Drehzahlstabilisierung durch Drehmoment" CURVE 0x81F9A0 KlAUwSstUwWUw 7.999878 fak_uw_b8 0.00 7.999878 FORMAT "%8.6"
 /begin AXIS_DESCR STD_AXIS nver_w fak_uw_b8 6 0.00 7.999878 FORMAT "%8.6" DEPOSIT ABSOLUTE /end AXIS_DESCR
/end CHARACTERISTIC
/begin CHARACTERISTIC FRLMNHO "Korrekturfaktor rlmin über Höhe" CURVE 0x810D4F KlAUbSstUbWUb 1.992 fak_ub_b2 0.00 1.992 FORMAT "%5.3"
 /begin AXIS_DESCR STD_AXIS fho fak_ub_b4 5 0.00 3.984 FORMAT "%5.3" DEPOSIT ABSOLUTE /end AXIS_DESCR
/end CHARACTERISTIC
/begin CHARACTERISTIC FRMAX "obere Regelbereichsgrenze" VALUE 0x816B74 KwUw 1.999969 fak_uw_b2 0.00 1.999969 FORMAT "%8.6" /end CHARACTERISTIC
/begin CHARACTERISTIC FRMINKH "Magerbegrenzung Lambdaregelung bei KH mit SL" VALUE 0x816B76 KwUw 1.999969 fak_uw_b2 0.00 1.999969 FORMAT "%8.6" /end CHARACTERISTIC
/begin CHARACTERISTIC FVDMDWAN "Verstärkungsfaktor zur Bildung D-Ateil-Wandlermomnet" VALUE 0x8113B3 KwUb 7.969 fak_ub_b8 0.00 7.969 FORMAT "%5.3" /end CHARACTERISTIC
/begin CHARACTERISTIC FWDMVAD "Faktor zur Wichtung von dmvad_w in %MDMIN" CURVE 0x816062 KlAUwSstUwWUw 0.9999847 fak_uw_b1 0.00 0.9999847 FORMAT "%9.7"
 /begin AXIS_DESCR STD_AXIS nver_w fak_uw_b8 8 0.00 7.999878 FORMAT "%8.6" DEPOSIT ABSOLUTE /end AXIS_DESCR
/end CHARACTERISTIC
/begin CHARACTERISTIC FWPEDRLS "Faktor zur direkten rlsol-Vorgabe aus wped (Applikation)" VALUE 0x81516A KwUw 3.999939 fak_uw_b4 0.00 3.999939 FORMAT "%8.6" /end CHARACTERISTIC
/begin CHARACTERISTIC FZAB2 "Verstärkungsfaktor für Zwangsamplitude auf Bank 2 gegenüber Bank 1" VALUE 0x811C1F KwSb 15.94 fak_q0p0625 -8.000 7.938 FORMAT "%5.3" /end CHARACTERISTIC
/begin CHARACTERISTIC FZDA1SCH "Korrekturfaktor Dashpot-Zeitkonstante im Schichtbetrieb" VALUE 0x811504 KwUb 3.00000 rfak_q0p5 1.00000 4.00000 FORMAT "%7.5" /end CHARACTERISTIC
/begin CHARACTERISTIC FZDA2SCH "Korrekturfaktor Dashpot-Zeitkonstante bei kl. Kupplungsmoment im Schichtbetr." VALUE 0x811505 KwUb 3.00000 rfak_q0p5 1.00000 4.00000 FORMAT "%7.5" /end CHARACTERISTIC
/begin CHARACTERISTIC ILMLKAXTK "Schwelle Fettfläche Kat-Ausräumen nach SA, Funktion der Kat-Temperatur" CURVE 0x827F0C KlAUwSstUwWUw 4660.267 m_uw_b4660 0.00 4660.267 FORMAT "%8.3"
 /begin AXIS_DESCR STD_AXIS tkatm_w temp_uw_q0p0195_o50 5 -50.00000 1229.980 FORMAT "%8.3" DEPOSIT ABSOLUTE /end AXIS_DESCR
/end CHARACTERISTIC
/begin CHARACTERISTIC IMLEVABS "Schwelle Luftmassenintegral vor Freigabe Lambdaregelung nach Zylinderausblendung" VALUE 0x816D02 KwUw 4660.267 m_uw_b4660 0.00 4660.267 FORMAT "%8.3" /end CHARACTERISTIC
/begin CHARACTERISTIC IMLSALR "Schwellwert integr. Luftmasse f. Einschaltverzögerung LR nach SA" VALUE 0x816D04 KwUw 4660.267 m_uw_b4660 0.00 4660.267 FORMAT "%8.3" /end CHARACTERISTIC
/begin CHARACTERISTIC KDLASHKI_0_A "Kennlinie über dlashkm, Bewertungsfaktor für I-Anteil in der LRHK" CURVE 0x816D3C GklWSw 1.999969 fak_sw_b1 -1.000000 0.9999695 FORMAT "%8.6"
 /begin AXIS_DESCR COM_AXIS dlashkm_w fak_sw_b1 8 -1.000000 0.9999695 AXIS_PTS_REF SM108LHSW /end AXIS_DESCR
/end CHARACTERISTIC
/begin CHARACTERISTIC KDLASHKI_1_A "Kennlinie über dlashkm, Bewertungsfaktor für I-Anteil in der LRHK" CURVE 0x816D4C GklWSw 1.999969 fak_sw_b1 -1.000000 0.9999695 FORMAT "%8.6"
 /begin AXIS_DESCR COM_AXIS dlashkm_w fak_sw_b1 8 -1.000000 0.9999695 AXIS_PTS_REF SM108LHSW /end AXIS_DESCR
/end CHARACTERISTIC
/begin CHARACTERISTIC KDLASHKP_0_A "Kennlinie über dlashkm_w, Bewertungsfaktor für P-Anteil in der LRHK" CURVE 0x816D5C GklWSw 1.999969 fak_sw_b1 -1.000000 0.9999695 FORMAT "%8.6"
 /begin AXIS_DESCR COM_AXIS dlashkm_w fak_sw_b1 8 -1.000000 0.9999695 AXIS_PTS_REF SM108LHSW /end AXIS_DESCR
/end CHARACTERISTIC
/begin CHARACTERISTIC KDLASHKP_1_A "Kennlinie über dlashkm_w, Bewertungsfaktor für P-Anteil in der LRHK" CURVE 0x816D6C GklWSw 1.999969 fak_sw_b1 -1.000000 0.9999695 FORMAT "%8.6"
 /begin AXIS_DESCR COM_AXIS dlashkm_w fak_sw_b1 8 -1.000000 0.9999695 AXIS_PTS_REF SM108LHSW /end AXIS_DESCR
/end CHARACTERISTIC
/begin CHARACTERISTIC KFDLASO_0_A "Kennfeld Lambdasollwert-Korrektur für stetigen Lambdaregler" MAP 0x811C20 GkfWSb 0.06226 fak_sb_b0p03125 -0.03125 0.03101 FORMAT "%7.5"
 /begin AXIS_DESCR COM_AXIS nmot nmot_ub_q40 10 0.00 10200. AXIS_PTS_REF SNM10LSUB /end AXIS_DESCR
 /begin AXIS_DESCR COM_AXIS rl rel_ub_q0p75 10 0.00 191.3 AXIS_PTS_REF SRL10LSUB /end AXIS_DESCR
/end CHARACTERISTIC
/begin CHARACTERISTIC KFDLASO_1_A "Kennfeld Lambdasollwert-Korrektur für stetigen Lambdaregler" MAP 0x811C84 GkfWSb 0.06226 fak_sb_b0p03125 -0.03125 0.03101 FORMAT "%7.5"
 /begin AXIS_DESCR COM_AXIS nmot nmot_ub_q40 10 0.00 10200. AXIS_PTS_REF SNM10LSUB /end AXIS_DESCR
 /begin AXIS_DESCR COM_AXIS rl rel_ub_q0p75 10 0.00 191.3 AXIS_PTS_REF SRL10LSUB /end AXIS_DESCR
/end CHARACTERISTIC
/begin CHARACTERISTIC KFDLSD_0_A "Dämpfung PT2-Filter Lastschlagdämpfung" MAP 0x826CD2 GkfWUw 1.999969 fak_uw_b2 0.00 1.999969 FORMAT "%8.6" /begin AXIS_DESCR COM_AXIS gangi dez 8 0.00 255.0 AXIS_PTS_REF SGA08MDUB /end AXIS_DESCR
 /begin AXIS_DESCR COM_AXIS nmot_w nmot_uw_q0p25 6 0.00 16383.75 AXIS_PTS_REF SNM06MDUW /end AXIS_DESCR
/end CHARACTERISTIC
/begin CHARACTERISTIC KFDLSD_1_A "Dämpfung PT2-Filter Lastschlagdämpfung" MAP 0x826D32 GkfWUw 1.999969 fak_uw_b2 0.00 1.999969 FORMAT "%8.6" /begin AXIS_DESCR COM_AXIS gangi dez 8 0.00 255.0 AXIS_PTS_REF SGA08MDUB /end AXIS_DESCR
 /begin AXIS_DESCR COM_AXIS nmot_w nmot_uw_q0p25 6 0.00 16383.75 AXIS_PTS_REF SNM06MDUW /end AXIS_DESCR
/end CHARACTERISTIC
/begin CHARACTERISTIC KFDLSD_2_A "Dämpfung PT2-Filter Lastschlagdämpfung" MAP 0x826D92 GkfWUw 1.999969 fak_uw_b2 0.00 1.999969 FORMAT "%8.6" /begin AXIS_DESCR COM_AXIS gangi dez 8 0.00 255.0 AXIS_PTS_REF SGA08MDUB /end AXIS_DESCR
 /begin AXIS_DESCR COM_AXIS nmot_w nmot_uw_q0p25 6 0.00 16383.75 AXIS_PTS_REF SNM06MDUW /end AXIS_DESCR
/end CHARACTERISTIC
/begin CHARACTERISTIC KFDLSD_3_A "Dämpfung PT2-Filter Lastschlagdämpfung" MAP 0x826DF2 GkfWUw 1.999969 fak_uw_b2 0.00 1.999969 FORMAT "%8.6" /begin AXIS_DESCR COM_AXIS gangi dez 8 0.00 255.0 AXIS_PTS_REF SGA08MDUB /end AXIS_DESCR
 /begin AXIS_DESCR COM_AXIS nmot_w nmot_uw_q0p25 6 0.00 16383.75 AXIS_PTS_REF SNM06MDUW /end AXIS_DESCR
/end CHARACTERISTIC
/begin CHARACTERISTIC KFDMDKOE "Anfangswert Momentenfilter bei Klimakompressor Einschalten" MAP 0x819CD9 GkfWSb 99.60 rel_sb_q0p39 -50.00 49.61 FORMAT "%5.2"
 /begin AXIS_DESCR COM_AXIS nmot nmot_ub_q40 6 0.00 10200. AXIS_PTS_REF SNM06KOUB /end AXIS_DESCR
 /begin AXIS_DESCR COM_AXIS tlok temp_ub_q0p75_o48 6 -48.00 143.3 AXIS_PTS_REF STA06LLUB /end AXIS_DESCR
/end CHARACTERISTIC
/begin CHARACTERISTIC KFDMDPO "Delta Moment Dashpotauslösung" MAP 0x816200 KfAxUbAyUbSstxSwSstyUbWUw 99.99847 rel_uw_b100 0.00 99.99847 FORMAT "%8.5"
 /begin AXIS_DESCR STD_AXIS mkfanb_w rel_sw_b100 6 -100.0000 99.99695 FORMAT "%8.4" DEPOSIT ABSOLUTE /end AXIS_DESCR
 /begin AXIS_DESCR STD_AXIS gangi dez 8 0.00 255.0 FORMAT "%5.1" DEPOSIT ABSOLUTE /end AXIS_DESCR
/end CHARACTERISTIC
/begin CHARACTERISTIC KFDMINS "Zulässiges Deltamoment bei Nachstartaufweitung" MAP 0x8116E0 GkfWUb 99.61 rel_ub_b99p6 0.00 99.61 FORMAT "%5.2"
 /begin AXIS_DESCR COM_AXIS tmot temp_ub_q0p75_o48 8 -48.00 143.3 AXIS_PTS_REF STM08OPUB /end AXIS_DESCR
 /begin AXIS_DESCR COM_AXIS nmot nmot_ub_q40 8 0.00 10200. AXIS_PTS_REF SNM08OPUB /end AXIS_DESCR
/end CHARACTERISTIC
/begin CHARACTERISTIC KFDMLSDO_0_A "Delta Moment Auslösung Lastschlagdämpfung" MAP 0x826E52 KfAxUwAyUwSstxSwSstyUwWUw 99.99847 rel_uw_b100 0.00 99.99847 FORMAT "%8.5"
 /begin AXIS_DESCR STD_AXIS mkfanb_w rel_sw_b100 8 -100.0000 99.99695 FORMAT "%8.4" DEPOSIT ABSOLUTE /end AXIS_DESCR
 /begin AXIS_DESCR STD_AXIS nmot_w nmot_uw_q0p25 6 0.00 16383.75 FORMAT "%8.2" DEPOSIT ABSOLUTE /end AXIS_DESCR
/end CHARACTERISTIC
/begin CHARACTERISTIC KFDMLSDO_1_A "Delta Moment Auslösung Lastschlagdämpfung" MAP 0x826ED2 KfAxUwAyUwSstxSwSstyUwWUw 99.99847 rel_uw_b100 0.00 99.99847 FORMAT "%8.5"
 /begin AXIS_DESCR STD_AXIS mkfanb_w rel_sw_b100 8 -100.0000 99.99695 FORMAT "%8.4" DEPOSIT ABSOLUTE /end AXIS_DESCR
 /begin AXIS_DESCR STD_AXIS nmot_w nmot_uw_q0p25 6 0.00 16383.75 FORMAT "%8.2" DEPOSIT ABSOLUTE /end AXIS_DESCR
/end CHARACTERISTIC
/begin CHARACTERISTIC KFDMLSDO_2_A "Delta Moment Auslösung Lastschlagdämpfung" MAP 0x826F52 KfAxUwAyUwSstxSwSstyUwWUw 99.99847 rel_uw_b100 0.00 99.99847 FORMAT "%8.5"
 /begin AXIS_DESCR STD_AXIS mkfanb_w rel_sw_b100 8 -100.0000 99.99695 FORMAT "%8.4" DEPOSIT ABSOLUTE /end AXIS_DESCR
 /begin AXIS_DESCR STD_AXIS nmot_w nmot_uw_q0p25 6 0.00 16383.75 FORMAT "%8.2" DEPOSIT ABSOLUTE /end AXIS_DESCR
/end CHARACTERISTIC
/begin CHARACTERISTIC KFDMLSDO_3_A "Delta Moment Auslösung Lastschlagdämpfung" MAP 0x826FD2 KfAxUwAyUwSstxSwSstyUwWUw 99.99847 rel_uw_b100 0.00 99.99847 FORMAT "%8.5"
 /begin AXIS_DESCR STD_AXIS mkfanb_w rel_sw_b100 8 -100.0000 99.99695 FORMAT "%8.4" DEPOSIT ABSOLUTE /end AXIS_DESCR
 /begin AXIS_DESCR STD_AXIS nmot_w nmot_uw_q0p25 6 0.00 16383.75 FORMAT "%8.2" DEPOSIT ABSOLUTE /end AXIS_DESCR
/end CHARACTERISTIC
/begin CHARACTERISTIC KFDMLSDS "Delta Moment Auslösung Lastschlagdämpfung nach Schaltvorgang" MAP 0x827052 GkfWUw 99.99847 rel_uw_b100 0.00 99.99847 FORMAT "%8.5" /begin AXIS_DESCR COM_AXIS gangi dez 8 0.00 255.0 AXIS_PTS_REF SGA08MDUB /end AXIS_DESCR
 /begin AXIS_DESCR COM_AXIS nmot_w nmot_uw_q0p25 6 0.00 16383.75 AXIS_PTS_REF SNM06MDUW /end AXIS_DESCR
/end CHARACTERISTIC
/begin CHARACTERISTIC KFDZWOAGR "Offset des optimalen ZW bei AGR-Betrieb" MAP 0x81FA00 KfAxUwAyUwSstxUwSstyUwWUw 49151.25 zw_uw_q0p75 0.00 49151.25 FORMAT "%8.2"
 /begin AXIS_DESCR STD_AXIS nmot_w nmot_uw_q0p25 16 0.00 16383.75 FORMAT "%8.2" DEPOSIT ABSOLUTE /end AXIS_DESCR
 /begin AXIS_DESCR STD_AXIS rl_w rel_uw_q0p0234 11 0.00 1535.977 FORMAT "%8.3" DEPOSIT ABSOLUTE /end AXIS_DESCR
/end CHARACTERISTIC
/begin CHARACTERISTIC KFFRMIN "untere Regelbereichsgrenze" MAP 0x816B78 KfAxUbAyUbSstxUbSstyUwWUw 1.999969 fak_uw_b2 0.00 1.999969 FORMAT "%8.6"
 /begin AXIS_DESCR STD_AXIS tmot temp_ub_q0p75_o48 5 -48.00 143.3 FORMAT "%5.1" DEPOSIT ABSOLUTE /end AXIS_DESCR
 /begin AXIS_DESCR STD_AXIS tnst_w t10msxs_uw_b655p35 4 0.00 655.3500 FORMAT "%8.4" DEPOSIT ABSOLUTE /end AXIS_DESCR
/end CHARACTERISTIC
/begin CHARACTERISTIC KFFRTMKI "Faktor fur Moment Begrenzung abhängig auf Drehzahl und gang" MAP 0x819F2C KfAxUbAyUbSstxUbSstyUbWUb 1.992 fak_ub_b2 0.00 1.992 FORMAT "%5.3"
 /begin AXIS_DESCR STD_AXIS nmot nmot_ub_q40 6 0.00 10200. FORMAT "%5.0" DEPOSIT ABSOLUTE /end AXIS_DESCR
 /begin AXIS_DESCR STD_AXIS gangi dez 8 0.00 255.0 FORMAT "%5.1" DEPOSIT ABSOLUTE /end AXIS_DESCR
/end CHARACTERISTIC
/begin CHARACTERISTIC KFLRSG1 "Kennfeld Reglerparameter g1 stetiger Lambdaregler" MAP 0x828002 GkfWSw 63.99902 fak_sw_b32 -32.00000 31.99902 FORMAT "%8.5"
 /begin AXIS_DESCR COM_AXIS nmot_w nmot_uw_q0p25 7 0.00 16383.75 AXIS_PTS_REF SNM07LSUW /end AXIS_DESCR
 /begin AXIS_DESCR COM_AXIS rl_w rel_uw_q0p0234 8 0.00 1535.977 AXIS_PTS_REF SRL08LSUW /end AXIS_DESCR
/end CHARACTERISTIC
/begin CHARACTERISTIC KFLRSG2 "Kennfeld Reglerparameter g2 stetiger Lambdaregler" MAP 0x828072 GkfWUw 63.99902 fak_uw_b64 0.00 63.99902 FORMAT "%8.5"
 /begin AXIS_DESCR COM_AXIS nmot_w nmot_uw_q0p25 7 0.00 16383.75 AXIS_PTS_REF SNM07LSUW /end AXIS_DESCR
 /begin AXIS_DESCR COM_AXIS rl_w rel_uw_q0p0234 8 0.00 1535.977 AXIS_PTS_REF SRL08LSUW /end AXIS_DESCR
/end CHARACTERISTIC
/begin CHARACTERISTIC KFLRSG4 "Kennfeld Reglerparameter g4 stetiger Lambdaregler" MAP 0x8280E2 GkfWSw 3.999939 fak_sw_b2 -2.000000 1.999939 FORMAT "%8.6"
 /begin AXIS_DESCR COM_AXIS nmot_w nmot_uw_q0p25 7 0.00 16383.75 AXIS_PTS_REF SNM07LSUW /end AXIS_DESCR
 /begin AXIS_DESCR COM_AXIS rl_w rel_uw_q0p0234 8 0.00 1535.977 AXIS_PTS_REF SRL08LSUW /end AXIS_DESCR
/end CHARACTERISTIC
/begin CHARACTERISTIC KFLRSP1 "Kennfeld Reglerparameter p1 stetiger Lambdaregler" MAP 0x828152 GkfWUw 127.9980 fak_uw_b128 0.00 127.9980 FORMAT "%8.4"
 /begin AXIS_DESCR COM_AXIS nmot_w nmot_uw_q0p25 7 0.00 16383.75 AXIS_PTS_REF SNM07LSUW /end AXIS_DESCR
 /begin AXIS_DESCR COM_AXIS rl_w rel_uw_q0p0234 8 0.00 1535.977 AXIS_PTS_REF SRL08LSUW /end AXIS_DESCR
/end CHARACTERISTIC
/begin CHARACTERISTIC KFLRSP2 "Kennfeld Reglerparameter p2 stetiger Lambdaregler" MAP 0x8281C2 GkfWUw 127.9980 fak_uw_b128 0.00 127.9980 FORMAT "%8.4"
 /begin AXIS_DESCR COM_AXIS nmot_w nmot_uw_q0p25 7 0.00 16383.75 AXIS_PTS_REF SNM07LSUW /end AXIS_DESCR
 /begin AXIS_DESCR COM_AXIS rl_w rel_uw_q0p0234 8 0.00 1535.977 AXIS_PTS_REF SRL08LSUW /end AXIS_DESCR
/end CHARACTERISTIC
/begin CHARACTERISTIC KFLRSP3 "Kennfeld Reglerparameter p3 stetiger Lambdaregler" MAP 0x828232 GkfWUw 127.9980 fak_uw_b128 0.00 127.9980 FORMAT "%8.4"
 /begin AXIS_DESCR COM_AXIS nmot_w nmot_uw_q0p25 7 0.00 16383.75 AXIS_PTS_REF SNM07LSUW /end AXIS_DESCR
 /begin AXIS_DESCR COM_AXIS rl_w rel_uw_q0p0234 8 0.00 1535.977 AXIS_PTS_REF SRL08LSUW /end AXIS_DESCR
/end CHARACTERISTIC
/begin CHARACTERISTIC KFLRSP4 "Kennfeld Reglerparameter p4 stetiger Lambdaregler" MAP 0x8282A2 GkfWSw 127.9980 fak_sw_b64 -64.00000 63.99805 FORMAT "%8.5"
 /begin AXIS_DESCR COM_AXIS nmot_w nmot_uw_q0p25 7 0.00 16383.75 AXIS_PTS_REF SNM07LSUW /end AXIS_DESCR
 /begin AXIS_DESCR COM_AXIS rl_w rel_uw_q0p0234 8 0.00 1535.977 AXIS_PTS_REF SRL08LSUW /end AXIS_DESCR
/end CHARACTERISTIC
/begin CHARACTERISTIC KFLRST "Kennfeld Streckentotzeit" MAP 0x816BB0 KfAxUwAyUwSstxUwSstyUwWUw 327.67000000 tz10msxs_uw_b327p68 0.010000000000 327.68000000 FORMAT "%12.8"
 /begin AXIS_DESCR STD_AXIS nmot_w nmot_uw_q0p25 7 0.00 16383.75 FORMAT "%8.2" DEPOSIT ABSOLUTE /end AXIS_DESCR
 /begin AXIS_DESCR STD_AXIS rl_w rel_uw_q0p0234 8 0.00 1535.977 FORMAT "%8.3" DEPOSIT ABSOLUTE /end AXIS_DESCR
/end CHARACTERISTIC
/begin CHARACTERISTIC KFLRSZ "Kennfeld Streckenzeitkonstante der LRS, 16-Bit" MAP 0x816C42 KfAxUwAyUwSstxUwSstyUwWUw 655.34999985 zk10msxs_uw_b655 0.010000152590 655.36000000 FORMAT "%12.8"
 /begin AXIS_DESCR STD_AXIS nmot_w nmot_uw_q0p25 7 0.00 16383.75 FORMAT "%8.2" DEPOSIT ABSOLUTE /end AXIS_DESCR
 /begin AXIS_DESCR STD_AXIS rl_w rel_uw_q0p0234 8 0.00 1535.977 FORMAT "%8.3" DEPOSIT ABSOLUTE /end AXIS_DESCR
/end CHARACTERISTIC
/begin CHARACTERISTIC KFMDBGRG "Kennfeld mit dem Wert der Momentenbegrenzung" MAP 0x827CAE KfAxUwAyUwSstxUwSstyUwWUw 99.99847 rel_uw_b100 0.00 99.99847 FORMAT "%8.5"
 /begin AXIS_DESCR STD_AXIS nmot nmot_ub_q40 4 0.00 2621400. FORMAT "%8.0" DEPOSIT ABSOLUTE /end AXIS_DESCR
 /begin AXIS_DESCR STD_AXIS gangi dez 7 0.00 65535.00 FORMAT "%8.2" DEPOSIT ABSOLUTE /end AXIS_DESCR
/end CHARACTERISTIC
/begin CHARACTERISTIC KFMDGEN "Drehmomentenaufnahme Generator" MAP 0x8114A1 KfAxUbAyUbSstxUbSstyUbWUb 49.73 rel_ub_b49p725 0.00 49.73 FORMAT "%5.2"
 /begin AXIS_DESCR STD_AXIS nmot nmot_ub_q40 5 0.00 10200. FORMAT "%5.0" DEPOSIT ABSOLUTE /end AXIS_DESCR
 /begin AXIS_DESCR STD_AXIS kldfpwm rel_ub_b99p6 6 0.00 99.61 FORMAT "%5.2" DEPOSIT ABSOLUTE /end AXIS_DESCR
/end CHARACTERISTIC
/begin CHARACTERISTIC KFMDKO "Drehmomentaufnahme Klimakompressor" MAP 0x819CFD GkfWUb 49.73 rel_ub_b49p725 0.00 49.73 FORMAT "%5.2"
 /begin AXIS_DESCR COM_AXIS nmot nmot_ub_q40 6 0.00 10200. AXIS_PTS_REF SNM06KOUB /end AXIS_DESCR
 /begin AXIS_DESCR COM_AXIS tlok temp_ub_q0p75_o48 6 -48.00 143.3 AXIS_PTS_REF STA06LLUB /end AXIS_DESCR
/end CHARACTERISTIC
/begin CHARACTERISTIC KFMDRKO "Kennfeld: Klimakompressormoment abh. von rl, nmot" MAP 0x819D21 GkfWUb 49.73 rel_ub_b49p725 0.00 49.73 FORMAT "%5.2"
 /begin AXIS_DESCR COM_AXIS nmot nmot_ub_q40 6 0.00 10200. AXIS_PTS_REF SNM06KOUB /end AXIS_DESCR
 /begin AXIS_DESCR COM_AXIS rl rel_ub_q0p75 6 0.00 191.3 AXIS_PTS_REF SRL06KOUB /end AXIS_DESCR
/end CHARACTERISTIC
/begin CHARACTERISTIC KFMDRKOE "Kennfeld: Klimakompressormoment dyn. Anteil abh. von rl, nmot" MAP 0x819D45 GkfWSb 99.60 rel_sb_q0p39 -50.00 49.61 FORMAT "%5.2"
 /begin AXIS_DESCR COM_AXIS nmot nmot_ub_q40 6 0.00 10200. AXIS_PTS_REF SNM06KOUB /end AXIS_DESCR
 /begin AXIS_DESCR COM_AXIS rl rel_ub_q0p75 6 0.00 191.3 AXIS_PTS_REF SRL06KOUB /end AXIS_DESCR
/end CHARACTERISTIC
/begin CHARACTERISTIC KFMDS "Schleppmoment Drehzahl- und Lastabhängigkeit" MAP 0x827AE4 GkfWUw 99.99847 rel_uw_b100 0.00 99.99847 FORMAT "%8.5"
 /begin AXIS_DESCR COM_AXIS nmot_w nmot_uw_q0p25 16 0.00 16383.75 AXIS_PTS_REF SNM16OPUW /end AXIS_DESCR
 /begin AXIS_DESCR COM_AXIS rl_w rel_uw_q0p0234 11 0.00 1535.977 AXIS_PTS_REF SRL11OPUW /end AXIS_DESCR
/end CHARACTERISTIC
/begin CHARACTERISTIC KFMDWMX "Max. Begrenzung für Drehmomentaufnahme des Wandlers" MAP 0x8113B4 KfAxUbAyUbSstxUbSstyUbWUb 99.61 rel_ub_b99p6 0.00 99.61 FORMAT "%5.2"
 /begin AXIS_DESCR STD_AXIS vfzg vfzg_ub_q1p25 6 0.00 318.8 FORMAT "%5.1" DEPOSIT ABSOLUTE /end AXIS_DESCR
 /begin AXIS_DESCR STD_AXIS tmot temp_ub_q0p75_o48 8 -48.00 143.3 FORMAT "%5.1" DEPOSIT ABSOLUTE /end AXIS_DESCR
/end CHARACTERISTIC
/begin CHARACTERISTIC KFMIFABG_0_A "Delta-Moment für Gradientenbegrenzung" MAP 0x8270B2 KfAxUwAyUwSstxSwSstyUwWUw 99.99847 rel_uw_b100 0.00 99.99847 FORMAT "%8.5"
 /begin AXIS_DESCR STD_AXIS mkfa_w rel_sw_b50 8 -50.00000 49.99847 FORMAT "%8.5" DEPOSIT ABSOLUTE /end AXIS_DESCR
 /begin AXIS_DESCR STD_AXIS nmot_w nmot_uw_q0p25 8 0.00 16383.75 FORMAT "%8.2" DEPOSIT ABSOLUTE /end AXIS_DESCR
/end CHARACTERISTIC
/begin CHARACTERISTIC KFMIFABG_1_A "Delta-Moment für Gradientenbegrenzung" MAP 0x827156 KfAxUwAyUwSstxSwSstyUwWUw 99.99847 rel_uw_b100 0.00 99.99847 FORMAT "%8.5"
 /begin AXIS_DESCR STD_AXIS mkfa_w rel_sw_b50 8 -50.00000 49.99847 FORMAT "%8.5" DEPOSIT ABSOLUTE /end AXIS_DESCR
 /begin AXIS_DESCR STD_AXIS nmot_w nmot_uw_q0p25 8 0.00 16383.75 FORMAT "%8.2" DEPOSIT ABSOLUTE /end AXIS_DESCR
/end CHARACTERISTIC
/begin CHARACTERISTIC KFMIFABG_2_A "Delta-Moment für Gradientenbegrenzung" MAP 0x8271FA KfAxUwAyUwSstxSwSstyUwWUw 99.99847 rel_uw_b100 0.00 99.99847 FORMAT "%8.5"
 /begin AXIS_DESCR STD_AXIS mkfa_w rel_sw_b50 8 -50.00000 49.99847 FORMAT "%8.5" DEPOSIT ABSOLUTE /end AXIS_DESCR
 /begin AXIS_DESCR STD_AXIS nmot_w nmot_uw_q0p25 8 0.00 16383.75 FORMAT "%8.2" DEPOSIT ABSOLUTE /end AXIS_DESCR
/end CHARACTERISTIC
/begin CHARACTERISTIC KFMIFABG_3_A "Delta-Moment für Gradientenbegrenzung" MAP 0x82729E KfAxUwAyUwSstxSwSstyUwWUw 99.99847 rel_uw_b100 0.00 99.99847 FORMAT "%8.5"
 /begin AXIS_DESCR STD_AXIS mkfa_w rel_sw_b50 8 -50.00000 49.99847 FORMAT "%8.5" DEPOSIT ABSOLUTE /end AXIS_DESCR
 /begin AXIS_DESCR STD_AXIS nmot_w nmot_uw_q0p25 8 0.00 16383.75 FORMAT "%8.2" DEPOSIT ABSOLUTE /end AXIS_DESCR
/end CHARACTERISTIC
/begin CHARACTERISTIC KFMIFALS_0_A "Indiziertes Fahrerwunschmoment für Füllungspfad bei Lastschlagdämpfung" MAP 0x827342 KfAxUbAyUbSstxUbSstyUwWUw 99.99847 rel_uw_b100 0.00 99.99847 FORMAT "%8.5"
 /begin AXIS_DESCR STD_AXIS gangi dez 8 0.00 255.0 FORMAT "%5.1" DEPOSIT ABSOLUTE /end AXIS_DESCR
 /begin AXIS_DESCR STD_AXIS mifa_w rel_uw_b100 8 0.00 99.99847 FORMAT "%8.5" DEPOSIT ABSOLUTE /end AXIS_DESCR
/end CHARACTERISTIC
/begin CHARACTERISTIC KFMIFALS_1_A "Indiziertes Fahrerwunschmoment für Füllungspfad bei Lastschlagdämpfung" MAP 0x8273DC KfAxUbAyUbSstxUbSstyUwWUw 99.99847 rel_uw_b100 0.00 99.99847 FORMAT "%8.5"
 /begin AXIS_DESCR STD_AXIS gangi dez 8 0.00 255.0 FORMAT "%5.1" DEPOSIT ABSOLUTE /end AXIS_DESCR
 /begin AXIS_DESCR STD_AXIS mifa_w rel_uw_b100 8 0.00 99.99847 FORMAT "%8.5" DEPOSIT ABSOLUTE /end AXIS_DESCR
/end CHARACTERISTIC
/begin CHARACTERISTIC KFMIFALS_2_A "Indiziertes Fahrerwunschmoment für Füllungspfad bei Lastschlagdämpfung" MAP 0x827476 KfAxUbAyUbSstxUbSstyUwWUw 99.99847 rel_uw_b100 0.00 99.99847 FORMAT "%8.5"
 /begin AXIS_DESCR STD_AXIS gangi dez 8 0.00 255.0 FORMAT "%5.1" DEPOSIT ABSOLUTE /end AXIS_DESCR
 /begin AXIS_DESCR STD_AXIS mifa_w rel_uw_b100 8 0.00 99.99847 FORMAT "%8.5" DEPOSIT ABSOLUTE /end AXIS_DESCR
/end CHARACTERISTIC
/begin CHARACTERISTIC KFMIFALS_3_A "Indiziertes Fahrerwunschmoment für Füllungspfad bei Lastschlagdämpfung" MAP 0x827510 KfAxUbAyUbSstxUbSstyUwWUw 99.99847 rel_uw_b100 0.00 99.99847 FORMAT "%8.5"
 /begin AXIS_DESCR STD_AXIS gangi dez 8 0.00 255.0 FORMAT "%5.1" DEPOSIT ABSOLUTE /end AXIS_DESCR
 /begin AXIS_DESCR STD_AXIS mifa_w rel_uw_b100 8 0.00 99.99847 FORMAT "%8.5" DEPOSIT ABSOLUTE /end AXIS_DESCR
/end CHARACTERISTIC
/begin CHARACTERISTIC KFMILSD "Startwert indiziertes Moment für Lastschlagdämpfung" MAP 0x8275AA KfAxUwAyUwSstxUwSstyUwWUw 99.99847 rel_uw_b100 0.00 99.99847 FORMAT "%8.5"
 /begin AXIS_DESCR STD_AXIS mivbeb_w rel_uw_b100 6 0.00 99.99847 FORMAT "%8.5" DEPOSIT ABSOLUTE /end AXIS_DESCR
 /begin AXIS_DESCR STD_AXIS nmot_w nmot_uw_q0p25 8 0.00 16383.75 FORMAT "%8.2" DEPOSIT ABSOLUTE /end AXIS_DESCR
/end CHARACTERISTIC
/begin CHARACTERISTIC KFMIMN "Minimales Schubmoment" MAP 0x816084 KfAxUbAyUbSstxUbSstyUwWUw 99.99847 rel_uw_b100 0.00 99.99847 FORMAT "%8.5"
 /begin AXIS_DESCR STD_AXIS gangi dez 8 0.00 255.0 FORMAT "%5.1" DEPOSIT ABSOLUTE /end AXIS_DESCR
 /begin AXIS_DESCR STD_AXIS nmot_w nmot_uw_q0p25 8 0.00 16383.75 FORMAT "%8.2" DEPOSIT ABSOLUTE /end AXIS_DESCR
/end CHARACTERISTIC
/begin CHARACTERISTIC KFMIOP "Kennfeld optimales Motormoment" MAP 0x81683A GkfWUw 99.99847 rel_uw_b100 0.00 99.99847 FORMAT "%8.5"
 /begin AXIS_DESCR COM_AXIS nmot_w nmot_uw_q0p25 16 0.00 16383.75 AXIS_PTS_REF SNM16OPUW /end AXIS_DESCR
 /begin AXIS_DESCR COM_AXIS rl_w rel_uw_q0p0234 11 0.00 1535.977 AXIS_PTS_REF SRL11OPUW /end AXIS_DESCR
/end CHARACTERISTIC
/begin CHARACTERISTIC KFMIRL "Kennfeld für Berechnung Sollfüllung" MAP 0x81516C KfAxUwAyUwSstxUwSstyUwWUw 1535.977 rel_uw_q0p0234 0.00 1535.977 FORMAT "%8.3"
 /begin AXIS_DESCR STD_AXIS nmot_w nmot_uw_q0p25 16 0.00 16383.75 FORMAT "%8.2" DEPOSIT ABSOLUTE /end AXIS_DESCR
 /begin AXIS_DESCR STD_AXIS misopl1_w rel_uw_b100 16 0.00 99.99847 FORMAT "%8.5" DEPOSIT ABSOLUTE /end AXIS_DESCR
/end CHARACTERISTIC
/begin CHARACTERISTIC KFMIZUFIL "Zulässiges indiziertes Moment zur Momentenbegrenzung vor Filter" MAP 0x811720 GkfWUb 99.61 rel_ub_b99p6 0.00 99.61 FORMAT "%5.2"
 /begin AXIS_DESCR COM_AXIS wped relPED_ub_b100 8 0.00 100.0 AXIS_PTS_REF SWP08OPUB /end AXIS_DESCR
 /begin AXIS_DESCR COM_AXIS nmot nmot_ub_q40 8 0.00 10200. AXIS_PTS_REF SNM08OPUB /end AXIS_DESCR
/end CHARACTERISTIC
/begin CHARACTERISTIC KFMIZUOF "Zulässiges indiziertes Moment zur Momentenbegrenzung" MAP 0x811760 GkfWUb 99.61 rel_ub_b99p6 0.00 99.61 FORMAT "%5.2"
 /begin AXIS_DESCR COM_AXIS mizuvfil rel_ub_b99p6 8 0.00 99.61 AXIS_PTS_REF SMO08OPUB /end AXIS_DESCR
 /begin AXIS_DESCR COM_AXIS nmot nmot_ub_q40 8 0.00 10200. AXIS_PTS_REF SNM08OPUB /end AXIS_DESCR
/end CHARACTERISTIC
/begin CHARACTERISTIC KFPED "Relatives Fahrerwunschmoment aus Fahrpedal" MAP 0x816276 GkfWUw 199.9969 rel_uw_b200 0.00 199.9969 FORMAT "%8.4"
 /begin AXIS_DESCR COM_AXIS wped_w relPED_uw_b100 16 0.00 100.0000 AXIS_PTS_REF SWP16MDUW /end AXIS_DESCR
 /begin AXIS_DESCR COM_AXIS nmot_w nmot_uw_q0p25 12 0.00 16383.75 AXIS_PTS_REF SNM12MDUW /end AXIS_DESCR
/end CHARACTERISTIC
/begin CHARACTERISTIC KFPEDL "Relatives Fahrerwunschmoment aus Fahrpedal für kleine Geschwindigkeiten" MAP 0x8163F6 GkfWUw 199.9969 rel_uw_b200 0.00 199.9969 FORMAT "%8.4"
 /begin AXIS_DESCR COM_AXIS wped_w relPED_uw_b100 16 0.00 100.0000 AXIS_PTS_REF SWP16MDUW /end AXIS_DESCR
 /begin AXIS_DESCR COM_AXIS nmot_w nmot_uw_q0p25 12 0.00 16383.75 AXIS_PTS_REF SNM12MDUW /end AXIS_DESCR
/end CHARACTERISTIC
/begin CHARACTERISTIC KFPEDR "Relatives Fahrerwunschmoment aus Fahrpedal für Rückwärtsgang" MAP 0x816576 GkfWUw 199.9969 rel_uw_b200 0.00 199.9969 FORMAT "%8.4"
 /begin AXIS_DESCR COM_AXIS wped_w relPED_uw_b100 16 0.00 100.0000 AXIS_PTS_REF SWP16MDUW /end AXIS_DESCR
 /begin AXIS_DESCR COM_AXIS nmot_w nmot_uw_q0p25 12 0.00 16383.75 AXIS_PTS_REF SNM12MDUW /end AXIS_DESCR
/end CHARACTERISTIC
/begin CHARACTERISTIC KFRLMN "minimale Füllung im befeuerten Betrieb" MAP 0x818B18 GkfWUb 191.3 rel_ub_q0p75 0.00 191.3 FORMAT "%5.1"
 /begin AXIS_DESCR COM_AXIS nmot nmot_ub_q40 12 0.00 10200. AXIS_PTS_REF SNM12FEUB /end AXIS_DESCR
 /begin AXIS_DESCR COM_AXIS tmot temp_ub_q0p75_o48 4 -48.00 143.3 AXIS_PTS_REF STM04FEUB /end AXIS_DESCR
/end CHARACTERISTIC
/begin CHARACTERISTIC KFRLMNSA "minimales rl bei Schubabschalten" MAP 0x818B48 GkfWUb 191.3 rel_ub_q0p75 0.00 191.3 FORMAT "%5.1"
 /begin AXIS_DESCR COM_AXIS nmot nmot_ub_q40 12 0.00 10200. AXIS_PTS_REF SNM12FEUB /end AXIS_DESCR
 /begin AXIS_DESCR COM_AXIS tmot temp_ub_q0p75_o48 4 -48.00 143.3 AXIS_PTS_REF STM04FEUB /end AXIS_DESCR
/end CHARACTERISTIC
/begin CHARACTERISTIC KFUSHK_0_A "Sondenspannungssollwert für Regelung hinter Kat. (statt KFUSRHK für Variantenk.)" MAP 0x811D0C KfAxUbAyUbSstxUbSstyUbWUb 1.330 spg_ub_q0p0052_o0p2 -0.2000 1.130 FORMAT "%5.3"
 /begin AXIS_DESCR STD_AXIS nmot nmot_ub_q40 10 0.00 10200. FORMAT "%5.0" DEPOSIT ABSOLUTE /end AXIS_DESCR
 /begin AXIS_DESCR STD_AXIS rl rel_ub_q0p75 10 0.00 191.3 FORMAT "%5.1" DEPOSIT ABSOLUTE /end AXIS_DESCR
/end CHARACTERISTIC
/begin CHARACTERISTIC KFUSHK_1_A "Sondenspannungssollwert für Regelung hinter Kat. (statt KFUSRHK für Variantenk.)" MAP 0x811D86 KfAxUbAyUbSstxUbSstyUbWUb 1.330 spg_ub_q0p0052_o0p2 -0.2000 1.130 FORMAT "%5.3"
 /begin AXIS_DESCR STD_AXIS nmot nmot_ub_q40 10 0.00 10200. FORMAT "%5.0" DEPOSIT ABSOLUTE /end AXIS_DESCR
 /begin AXIS_DESCR STD_AXIS rl rel_ub_q0p75 10 0.00 191.3 FORMAT "%5.1" DEPOSIT ABSOLUTE /end AXIS_DESCR
/end CHARACTERISTIC
/begin CHARACTERISTIC KFUSHKA "Sondenspannungssollwert für Regelung hinter Kat. während Kurztest" MAP 0x811E00 KfAxUbAyUbSstxUbSstyUbWUb 1.330 spg_ub_q0p0052_o0p2 -0.2000 1.130 FORMAT "%5.3"
 /begin AXIS_DESCR STD_AXIS nmot nmot_ub_q40 10 0.00 10200. FORMAT "%5.0" DEPOSIT ABSOLUTE /end AXIS_DESCR
 /begin AXIS_DESCR STD_AXIS rl rel_ub_q0p75 10 0.00 191.3 FORMAT "%5.1" DEPOSIT ABSOLUTE /end AXIS_DESCR
/end CHARACTERISTIC
/begin CHARACTERISTIC KFWMIFAL "Überhöhungsfaktor für Füllungspfad bei Lastschlagdämpfung" MAP 0x819E04 KfAxUbAyUbSstxUbSstyUbWUb 0.9922 fak_ub_b2 1.000 1.992 FORMAT "%5.3"
 /begin AXIS_DESCR STD_AXIS wped relPED_ub_b100 4 0.00 100.0 FORMAT "%5.1" DEPOSIT ABSOLUTE /end AXIS_DESCR
 /begin AXIS_DESCR STD_AXIS nmot nmot_ub_q40 4 0.00 10200. FORMAT "%5.0" DEPOSIT ABSOLUTE /end AXIS_DESCR
/end CHARACTERISTIC
/begin CHARACTERISTIC KFWZLSD "Reduktionsfaktor für Zeitkonstante Lastschlagdämpfung" MAP 0x819E1E KfAxUbAyUbSstxUbSstyUbWUb 0.9961 fak_ub_b1 0.00 0.9961
 /begin AXIS_DESCR STD_AXIS wped relPED_ub_b100 4 0.00 100.0 FORMAT "%5.1" DEPOSIT ABSOLUTE /end AXIS_DESCR
 /begin AXIS_DESCR STD_AXIS nmot nmot_ub_q40 4 0.00 10200. FORMAT "%5.0" DEPOSIT ABSOLUTE /end AXIS_DESCR
/end CHARACTERISTIC
/begin CHARACTERISTIC KFZDASH_0_A "Zeitkonstante PT1-Filter Dashpot" MAP 0x82762A GkfWUw 81.880000000 zk10msxs_uw_b655 0.040000000000 81.920000000 FORMAT "%12.9" /begin AXIS_DESCR COM_AXIS gangi dez 8 0.00 255.0 AXIS_PTS_REF SGA08MDUB /end AXIS_DESCR
 /begin AXIS_DESCR COM_AXIS nmot_w nmot_uw_q0p25 6 0.00 16383.75 AXIS_PTS_REF SNM06MDUW /end AXIS_DESCR
/end CHARACTERISTIC
/begin CHARACTERISTIC KFZDASH_1_A "Zeitkonstante PT1-Filter Dashpot" MAP 0x82768A GkfWUw 81.880000000 zk10msxs_uw_b655 0.040000000000 81.920000000 FORMAT "%12.9" /begin AXIS_DESCR COM_AXIS gangi dez 8 0.00 255.0 AXIS_PTS_REF SGA08MDUB /end AXIS_DESCR
 /begin AXIS_DESCR COM_AXIS nmot_w nmot_uw_q0p25 6 0.00 16383.75 AXIS_PTS_REF SNM06MDUW /end AXIS_DESCR
/end CHARACTERISTIC
/begin CHARACTERISTIC KFZDASH_2_A "Zeitkonstante PT1-Filter Dashpot" MAP 0x8276EA GkfWUw 81.880000000 zk10msxs_uw_b655 0.040000000000 81.920000000 FORMAT "%12.9" /begin AXIS_DESCR COM_AXIS gangi dez 8 0.00 255.0 AXIS_PTS_REF SGA08MDUB /end AXIS_DESCR
 /begin AXIS_DESCR COM_AXIS nmot_w nmot_uw_q0p25 6 0.00 16383.75 AXIS_PTS_REF SNM06MDUW /end AXIS_DESCR
/end CHARACTERISTIC
/begin CHARACTERISTIC KFZDASH_3_A "Zeitkonstante PT1-Filter Dashpot" MAP 0x82774A GkfWUw 81.880000000 zk10msxs_uw_b655 0.040000000000 81.920000000 FORMAT "%12.9" /begin AXIS_DESCR COM_AXIS gangi dez 8 0.00 255.0 AXIS_PTS_REF SGA08MDUB /end AXIS_DESCR
 /begin AXIS_DESCR COM_AXIS nmot_w nmot_uw_q0p25 6 0.00 16383.75 AXIS_PTS_REF SNM06MDUW /end AXIS_DESCR
/end CHARACTERISTIC
/begin CHARACTERISTIC KFZDASH2_0_A "Zeitkonstante PT1-Filter Dashpot bei kleinem Kupplungsmoment" MAP 0x8277AA GkfWUw 81.880000000 zk10msxs_uw_b655 0.040000000000 81.920000000 FORMAT "%12.9" /begin AXIS_DESCR COM_AXIS gangi dez 8 0.00 255.0 AXIS_PTS_REF SGA08MDUB /end AXIS_DESCR
 /begin AXIS_DESCR COM_AXIS nmot_w nmot_uw_q0p25 6 0.00 16383.75 AXIS_PTS_REF SNM06MDUW /end AXIS_DESCR
/end CHARACTERISTIC
/begin CHARACTERISTIC KFZDASH2_1_A "Zeitkonstante PT1-Filter Dashpot bei kleinem Kupplungsmoment" MAP 0x82780A GkfWUw 81.880000000 zk10msxs_uw_b655 0.040000000000 81.920000000 FORMAT "%12.9" /begin AXIS_DESCR COM_AXIS gangi dez 8 0.00 255.0 AXIS_PTS_REF SGA08MDUB /end AXIS_DESCR
 /begin AXIS_DESCR COM_AXIS nmot_w nmot_uw_q0p25 6 0.00 16383.75 AXIS_PTS_REF SNM06MDUW /end AXIS_DESCR
/end CHARACTERISTIC
/begin CHARACTERISTIC KFZDASH2_2_A "Zeitkonstante PT1-Filter Dashpot bei kleinem Kupplungsmoment" MAP 0x82786A GkfWUw 81.880000000 zk10msxs_uw_b655 0.040000000000 81.920000000 FORMAT "%12.9" /begin AXIS_DESCR COM_AXIS gangi dez 8 0.00 255.0 AXIS_PTS_REF SGA08MDUB /end AXIS_DESCR
 /begin AXIS_DESCR COM_AXIS nmot_w nmot_uw_q0p25 6 0.00 16383.75 AXIS_PTS_REF SNM06MDUW /end AXIS_DESCR
/end CHARACTERISTIC
/begin CHARACTERISTIC KFZDASH2_3_A "Zeitkonstante PT1-Filter Dashpot bei kleinem Kupplungsmoment" MAP 0x8278CA GkfWUw 81.880000000 zk10msxs_uw_b655 0.040000000000 81.920000000 FORMAT "%12.9" /begin AXIS_DESCR COM_AXIS gangi dez 8 0.00 255.0 AXIS_PTS_REF SGA08MDUB /end AXIS_DESCR
 /begin AXIS_DESCR COM_AXIS nmot_w nmot_uw_q0p25 6 0.00 16383.75 AXIS_PTS_REF SNM06MDUW /end AXIS_DESCR
/end CHARACTERISTIC
/begin CHARACTERISTIC KFZLSD_0_A "Zeitkonstante PT2-Filter Lastschlagdämpfung" MAP 0x82792A GkfWUw 655.34999985 zk10msxs_uw_b655 0.010000152590 655.36000000 FORMAT "%12.8" /begin AXIS_DESCR COM_AXIS gangi dez 8 0.00 255.0 AXIS_PTS_REF SGA08MDUB /end AXIS_DESCR
 /begin AXIS_DESCR COM_AXIS nmot_w nmot_uw_q0p25 6 0.00 16383.75 AXIS_PTS_REF SNM06MDUW /end AXIS_DESCR
/end CHARACTERISTIC
/begin CHARACTERISTIC KFZLSD_1_A "Zeitkonstante PT2-Filter Lastschlagdämpfung" MAP 0x82798A GkfWUw 655.34999985 zk10msxs_uw_b655 0.010000152590 655.36000000 FORMAT "%12.8" /begin AXIS_DESCR COM_AXIS gangi dez 8 0.00 255.0 AXIS_PTS_REF SGA08MDUB /end AXIS_DESCR
 /begin AXIS_DESCR COM_AXIS nmot_w nmot_uw_q0p25 6 0.00 16383.75 AXIS_PTS_REF SNM06MDUW /end AXIS_DESCR
/end CHARACTERISTIC
/begin CHARACTERISTIC KFZLSD_2_A "Zeitkonstante PT2-Filter Lastschlagdämpfung" MAP 0x8279EA GkfWUw 655.34999985 zk10msxs_uw_b655 0.010000152590 655.36000000 FORMAT "%12.8" /begin AXIS_DESCR COM_AXIS gangi dez 8 0.00 255.0 AXIS_PTS_REF SGA08MDUB /end AXIS_DESCR
 /begin AXIS_DESCR COM_AXIS nmot_w nmot_uw_q0p25 6 0.00 16383.75 AXIS_PTS_REF SNM06MDUW /end AXIS_DESCR
/end CHARACTERISTIC
/begin CHARACTERISTIC KFZLSD_3_A "Zeitkonstante PT2-Filter Lastschlagdämpfung" MAP 0x827A4A GkfWUw 655.34999985 zk10msxs_uw_b655 0.010000152590 655.36000000 FORMAT "%12.8" /begin AXIS_DESCR COM_AXIS gangi dez 8 0.00 255.0 AXIS_PTS_REF SGA08MDUB /end AXIS_DESCR
 /begin AXIS_DESCR COM_AXIS nmot_w nmot_uw_q0p25 6 0.00 16383.75 AXIS_PTS_REF SNM06MDUW /end AXIS_DESCR
/end CHARACTERISTIC
/begin CHARACTERISTIC KFZWOP "optimaler Zündwinkel" MAP 0x811568 GkfWSb 191.3 zw_sb_q0p75 -96.00 95.25 FORMAT "%5.2"
 /begin AXIS_DESCR COM_AXIS nmot_w nmot_uw_q0p25 16 0.00 16383.75 AXIS_PTS_REF SNM16OPUW /end AXIS_DESCR
 /begin AXIS_DESCR COM_AXIS rl_w rel_uw_q0p0234 11 0.00 1535.977 AXIS_PTS_REF SRL11OPUW /end AXIS_DESCR
/end CHARACTERISTIC
/begin CHARACTERISTIC KFZWOP2 "optimaler Zündwinkel Variante 2" MAP 0x811618 GkfWSb 191.3 zw_sb_q0p75 -96.00 95.25 FORMAT "%5.2"
 /begin AXIS_DESCR COM_AXIS nmot_w nmot_uw_q0p25 16 0.00 16383.75 AXIS_PTS_REF SNM16OPUW /end AXIS_DESCR
 /begin AXIS_DESCR COM_AXIS rl_w rel_uw_q0p0234 11 0.00 1535.977 AXIS_PTS_REF SRL11OPUW /end AXIS_DESCR
/end CHARACTERISTIC
/begin CHARACTERISTIC KILRHML_0_A "I-Anteil fuer stetige LRHK" CURVE 0x811E7A GklWUb 0.04980 freq_ub_b0p05 0.00 0.04980 FORMAT "%7.5"
 /begin AXIS_DESCR COM_AXIS ml m_ub_b1020 8 0.00 1020. AXIS_PTS_REF SML08LHUB_0_A /end AXIS_DESCR
/end CHARACTERISTIC
/begin CHARACTERISTIC KILRHML_1_A "I-Anteil fuer stetige LRHK" CURVE 0x811E82 GklWUb 0.04980 freq_ub_b0p05 0.00 0.04980 FORMAT "%7.5"
 /begin AXIS_DESCR COM_AXIS ml m_ub_b1020 8 0.00 1020. AXIS_PTS_REF SML08LHUB_1_A /end AXIS_DESCR
/end CHARACTERISTIC
/begin CHARACTERISTIC KLDMKH "Zulässiges Deltamoment beim Katheizen in Momentenüberwachung" CURVE 0x8117A0 GklWUb 99.61 rel_ub_b99p6 0.00 99.61 FORMAT "%5.2"
 /begin AXIS_DESCR COM_AXIS nmot nmot_ub_q40 8 0.00 10200. AXIS_PTS_REF SNM08OPUB /end AXIS_DESCR
/end CHARACTERISTIC
/begin CHARACTERISTIC KLDMMX "Maximal zulässige Momentenreserven" CURVE 0x8117A8 KlAUbSstUbWUb 99.61 rel_ub_b99p6 0.00 99.61 FORMAT "%5.2"
 /begin AXIS_DESCR STD_AXIS nmot nmot_ub_q40 8 0.00 10200. FORMAT "%5.0" DEPOSIT ABSOLUTE /end AXIS_DESCR
/end CHARACTERISTIC
/begin CHARACTERISTIC KLDTPH "Festwertkennlinie eines Gewichtungsfaktors für die Dynamikbewertung" CURVE 0x8109E4 FklWUb 0.9961 fak_q0p0039 0.00 0.9961
 /begin AXIS_DESCR FIX_AXIS dtsegph_w t5usxus_q5 16 -40960.00 40955.00 FORMAT "%8.2" FIX_AXIS_PAR -8192 10 16 /end AXIS_DESCR
/end CHARACTERISTIC
/begin CHARACTERISTIC KLDTPHST "Festwertkennlinie eines Gewichtungsfaktors für Motorstart" CURVE 0x8109F4 FklWUb 0.9961 fak_q0p0039 0.00 0.9961
 /begin AXIS_DESCR FIX_AXIS dtsegph_w t5usxus_q5 16 -40960.00 40955.00 FORMAT "%8.2" FIX_AXIS_PAR -8192 10 16 /end AXIS_DESCR
/end CHARACTERISTIC
/begin CHARACTERISTIC KLDYNCOR "Wert für Dynamikkorrektur nach der ersten Zündung" CURVE 0x813FE6 KlAUbSstUbWUw 2621400. t40usxus_q40 0.00 2621400. FORMAT "%8.0"
 /begin AXIS_DESCR STD_AXIS tmot temp_ub_q0p75_o48 4 -48.00 143.3 FORMAT "%5.1" DEPOSIT ABSOLUTE /end AXIS_DESCR
/end CHARACTERISTIC
/begin CHARACTERISTIC KLFRTMKI "Kennlinie Regelfaktor aus Motortemperatur" CURVE 0x819F6C KlAUbSstUbWUb 1.992 fak_ub_b2 0.00 1.992 FORMAT "%5.3"
 /begin AXIS_DESCR STD_AXIS tmotmdb temp_ub_q0p75_o48 4 -48.00 143.3 FORMAT "%5.1" DEPOSIT ABSOLUTE /end AXIS_DESCR
/end CHARACTERISTIC
/begin CHARACTERISTIC KLNLPHN "Korrektur des Sensor-Phasengangs" CURVE 0x810A04 FklWSb 15.94 kw_q0p0625 -8.000 7.938 FORMAT "%5.3"
 /begin AXIS_DESCR FIX_AXIS nmot nmot_ub_q40 16 0.00 5080. FORMAT "%5.0" FIX_AXIS_PAR 0 3 16 /end AXIS_DESCR
/end CHARACTERISTIC
/begin CHARACTERISTIC KLNSTABMX "Größtmöglicher Stabilisierungsfaktor in Momentenüberwachung" CURVE 0x8117B9 GklWUb 7.969 fak_ub_b8 0.00 7.969 FORMAT "%5.3"
 /begin AXIS_DESCR COM_AXIS nmot nmot_ub_q40 8 0.00 10200. AXIS_PTS_REF SNM08OPUB /end AXIS_DESCR
/end CHARACTERISTIC
/begin CHARACTERISTIC KLOELD "Kennlinie eines Gewichtungsfaktors für Öldruck im Start" CURVE 0x81BB12 KlAUwSstUwWUw 2047.969 fak_ub_b8 0.00 2047.969 FORMAT "%8.3"
 /begin AXIS_DESCR STD_AXIS tabst_w t1sxs_uw_q1 6 0.00 65535.00 FORMAT "%8.2" DEPOSIT ABSOLUTE /end AXIS_DESCR
/end CHARACTERISTIC
/begin CHARACTERISTIC KLOELT "Kennlinie eines Gewichtungsfaktors für Öltemperatur im Start" CURVE 0x8184B3 KlAUbSstUbWUb 7.969 fak_ub_b8 0.00 7.969 FORMAT "%5.3"
 /begin AXIS_DESCR STD_AXIS tmot temp_ub_q0p75_o48 5 -48.00 143.3 FORMAT "%5.1" DEPOSIT ABSOLUTE /end AXIS_DESCR
/end CHARACTERISTIC
/begin CHARACTERISTIC KLVERBMX "Maximales Verbrauchermoment in Momentenüberwachung der Ebene 1" CURVE 0x8117C1 GklWUb 99.61 rel_ub_b99p6 0.00 99.61 FORMAT "%5.2"
 /begin AXIS_DESCR COM_AXIS nmot nmot_ub_q40 8 0.00 10200. AXIS_PTS_REF SNM08OPUB /end AXIS_DESCR
/end CHARACTERISTIC
/begin CHARACTERISTIC KLWNWI "Festwertkennlinie eines Gewichtungsfaktors für den Winkelfehler" CURVE 0x810A14 FklWUb 0.9961 fak_q0p0039 0.00 0.9961
 /begin AXIS_DESCR FIX_AXIS wnwix_w kw_sw_b128 16 -127.9961 128.0000 FORMAT "%8.4" FIX_AXIS_PAR -32767 12 16 /end AXIS_DESCR
/end CHARACTERISTIC
/begin CHARACTERISTIC KNLSYN "Sicherheitsfaktor für Notlauf-Synchronisationsbedingung" VALUE 0x810A24 KwUb 7.969 fak_ub_b8 0.00 7.969 FORMAT "%5.3" /end CHARACTERISTIC
/begin CHARACTERISTIC KPLRHML_0_A "P-Anteil fuer stetige LRHK" CURVE 0x811E8A GklWUb 3.984 fak_ub_b4 0.00 3.984 FORMAT "%5.3"
 /begin AXIS_DESCR COM_AXIS ml m_ub_b1020 8 0.00 1020. AXIS_PTS_REF SML08LHUB_0_A /end AXIS_DESCR
/end CHARACTERISTIC
/begin CHARACTERISTIC KPLRHML_1_A "P-Anteil fuer stetige LRHK" CURVE 0x811E92 GklWUb 3.984 fak_ub_b4 0.00 3.984 FORMAT "%5.3"
 /begin AXIS_DESCR COM_AXIS ml m_ub_b1020 8 0.00 1020. AXIS_PTS_REF SML08LHUB_1_A /end AXIS_DESCR
/end CHARACTERISTIC
/begin CHARACTERISTIC LADIFFTHR "Schwelle für Lambda-Differenz für LRS Reset bei Magerschutz" VALUE 0x816CD4 KwSw 1.999969 fak_sw_b1 -1.000000 0.9999695 FORMAT "%8.6" /end CHARACTERISTIC
/begin CHARACTERISTIC LALIUSH "Lambdalinearisierung, Sonde hinter Katalysator" CURVE 0x816D7C KlAUwSstUwWUw 15.99976 fak_uw_b16 0.00 15.99976 FORMAT "%8.5"
 /begin AXIS_DESCR STD_AXIS ushk_w spg_uw_q0p00488_o1 10 -1.000000 318.9951 FORMAT "%8.4" DEPOSIT ABSOLUTE /end AXIS_DESCR
/end CHARACTERISTIC
/begin CHARACTERISTIC LALIUSMN "minimales, ueber LALIUS (%GGLSU) messbares Lambda" VALUE 0x816CD6 KwUw 15.99976 fak_uw_b16 0.00 15.99976 FORMAT "%8.5" /end CHARACTERISTIC
/begin CHARACTERISTIC LALIUSRH "Lambdalinearisierung, Sonde hinter Katalysator, Sollwert" CURVE 0x816DA6 KlAUbSstUbWUw 15.99976 fak_uw_b16 0.00 15.99976 FORMAT "%8.5"
 /begin AXIS_DESCR STD_AXIS usrhk spg_ub_q0p0052_o0p2 10 -0.2000 1.130 FORMAT "%5.3" DEPOSIT ABSOLUTE /end AXIS_DESCR
/end CHARACTERISTIC
/begin CHARACTERISTIC LAMKAML "Lambdasollwert für Katalysator-Ausräumen (luftmassenabhängig)" CURVE 0x81A01E KlAUbSstUbWUb 0.4980 fak_ub_b1p25_o0p75 0.7500 1.248 FORMAT "%5.3"
 /begin AXIS_DESCR STD_AXIS ml m_ub_b1020 5 0.00 1020. FORMAT "%5.0" DEPOSIT ABSOLUTE /end AXIS_DESCR
/end CHARACTERISTIC
/begin CHARACTERISTIC LAMSKAMX "Lambda-Ist vor Kat für Erkennung Magerbedingung Kat-Ausräumen" VALUE 0x816E1C KwUw 15.99976 fak_uw_b16 0.00 15.99976 FORMAT "%8.5" /end CHARACTERISTIC
/begin CHARACTERISTIC LAMSONMN "Lambda-Schwelle Min. für Auslösung Sperre I-Anteil" VALUE 0x81FBD6 KwUw 15.99976 fak_uw_b16 0.00 15.99976 FORMAT "%8.5" /end CHARACTERISTIC
/begin CHARACTERISTIC LAMSONMX "Lambda-Schwelle Max. für Auslösung Sperre I-Anteil" VALUE 0x81FBD8 KwUw 15.99976 fak_uw_b16 0.00 15.99976 FORMAT "%8.5" /end CHARACTERISTIC
/begin CHARACTERISTIC LASHKAB "Startwert für dynamische Sollwertanhebung (lamsolh) in der LRHK" VALUE 0x816DC6 KwSw 0.9999695 fak_sw_b1 0.00 0.9999695 FORMAT "%9.7" /end CHARACTERISTIC
/begin CHARACTERISTIC LRHIMN "minimale Integratorgrenze der stetigen LRHK" VALUE 0x816DC8 KwSw 1.999969 fak_sw_b1 -1.000000 0.9999695 FORMAT "%8.6" /end CHARACTERISTIC
/begin CHARACTERISTIC LRHIMX "maximale Integratorgrenze der stetigen LRHK" VALUE 0x816DCA KwSw 1.999969 fak_sw_b1 -1.000000 0.9999695 FORMAT "%8.6" /end CHARACTERISTIC
/begin CHARACTERISTIC LRSGKTM "Korrekturkennlinie der Reglerparameter bei tiefen Motortemperaturen" CURVE 0x819FF6 KlAUbSstUbWUb 1.992 fak_ub_b2 0.00 1.992 FORMAT "%5.3"
 /begin AXIS_DESCR STD_AXIS tmot temp_ub_q0p75_o48 6 -48.00 143.3 FORMAT "%5.1" DEPOSIT ABSOLUTE /end AXIS_DESCR
/end CHARACTERISTIC
/begin CHARACTERISTIC LRSTPZA "Periodendauer der LRS-Zwangsamplitude" VALUE 0x816CD8 KwUw 655.3500 t10msxs_uw_b655p35 0.00 655.3500 FORMAT "%8.4" /end CHARACTERISTIC
/begin CHARACTERISTIC LRSZAWML "Kennlinie Amplitude der LRS-Zwangsamplitude" CURVE 0x816CDA KlAUwSstUwWUb 0.249023438 fak_ub_b0p25 0.00 0.249023438 FORMAT "%11.9"
 /begin AXIS_DESCR STD_AXIS ml_w m_uw_b6553p5 6 0.00 6553.500 FORMAT "%8.3" DEPOSIT ABSOLUTE /end AXIS_DESCR
/end CHARACTERISTIC
/begin CHARACTERISTIC LWSER "Lenkilfelastmoment bei fehlerhaftem Lenkwinkelsensor" VALUE 0x8114CC KwUb 49.73 rel_ub_b49p725 0.00 49.73 FORMAT "%5.2" /end CHARACTERISTIC
/begin CHARACTERISTIC MDATNM "Drehmomentaufnahme AT-Getriebe in Fahrstufe N/P" CURVE 0x81F980 GklWSw 99.99695 rel_sw_b100 0.00 99.99695 FORMAT "%8.5"
 /begin AXIS_DESCR COM_AXIS tmot temp_ub_q0p75_o48 8 -48.00 143.3 AXIS_PTS_REF STM08MDUB /end AXIS_DESCR
/end CHARACTERISTIC
/begin CHARACTERISTIC MDATRM "Drehmomentanteil (Pumpenanteil) AT-Getriebe in Fahrstufe R" CURVE 0x81F990 GklWSw 99.99695 rel_sw_b100 0.00 99.99695 FORMAT "%8.5"
 /begin AXIS_DESCR COM_AXIS tmot temp_ub_q0p75_o48 8 -48.00 143.3 AXIS_PTS_REF STM08MDUB /end AXIS_DESCR
/end CHARACTERISTIC
/begin CHARACTERISTIC MDGAT "Kennlinie Momenten begrenzung bei zu hoher Abgastemperatur" CURVE 0x827D00 KlAUwSstUwWUw 99.99847 rel_uw_b100 0.00 99.99847 FORMAT "%8.5"
 /begin AXIS_DESCR STD_AXIS nmot nmot_ub_q40 6 0.00 2621400. FORMAT "%8.0" DEPOSIT ABSOLUTE /end AXIS_DESCR
/end CHARACTERISTIC
/begin CHARACTERISTIC MDHYEZ "Momenten-Hysterese bei Entscheidung der Zylinderausblendung" VALUE 0x8116DC KwUb 99.61 rel_ub_b99p6 0.00 99.61 FORMAT "%5.2" /end CHARACTERISTIC
/begin CHARACTERISTIC MDSH "Höhenabhängiger Anteil des Schleppmomentes" CURVE 0x827C44 KlAUbSstUbWSb 49.90 rel_q0p1957 -25.05 24.85 FORMAT "%5.2"
 /begin AXIS_DESCR STD_AXIS fho fak_ub_b4 6 0.00 3.984 FORMAT "%5.3" DEPOSIT ABSOLUTE /end AXIS_DESCR
/end CHARACTERISTIC
/begin CHARACTERISTIC MDSL "Momentenanforderung der Servolenkung" VALUE 0x8114CD KwUb 49.73 rel_ub_b49p725 0.00 49.73 FORMAT "%5.2" /end CHARACTERISTIC
/begin CHARACTERISTIC MDSLP "Moment zur Kompensation der Sekundärluftpumpe (stat.)" VALUE 0x8114CE KwUb 49.73 rel_ub_b49p725 0.00 49.73 FORMAT "%5.2" /end CHARACTERISTIC
/begin CHARACTERISTIC MDSLPE "Moment zur Kompensation der Sekundärluftpumpe (Einschalten)" VALUE 0x8114CF KwUb 49.73 rel_ub_b49p725 0.00 49.73 FORMAT "%5.2" /end CHARACTERISTIC
/begin CHARACTERISTIC MDSM "Schleppmoment Temperaturanteil" CURVE 0x827C52 GklWUw 99.99847 rel_uw_b100 0.00 99.99847 FORMAT "%8.5"
 /begin AXIS_DESCR COM_AXIS tmot temp_ub_q0p75_o48 10 -48.00 143.3 AXIS_PTS_REF STM10__UB /end AXIS_DESCR
/end CHARACTERISTIC
/begin CHARACTERISTIC MDWANER "Ersatzwert fur mdwan_w bei Fehler" VALUE 0x8113F4 KwUb 99.61 rel_ub_b99p6 0.00 99.61 FORMAT "%5.2" /end CHARACTERISTIC
/begin CHARACTERISTIC MIFABGMX "Maximalwert mifa_w für Momentenänderungsbegrenzung" VALUE 0x8166F6 KwUw 99.99847 rel_uw_b100 0.00 99.99847 FORMAT "%8.5" /end CHARACTERISTIC
/begin CHARACTERISTIC MIFALMF "Indiziertes Fahrerwunschmoment für Füllungspfad bei aktiver Gradientenbegrenzung" CURVE 0x8166F8 KlAUwSstUwWUw 99.99847 rel_uw_b100 0.00 99.99847 FORMAT "%8.5"
 /begin AXIS_DESCR STD_AXIS mifa_w rel_uw_b100 8 0.00 99.99847 FORMAT "%8.5" DEPOSIT ABSOLUTE /end AXIS_DESCR
/end CHARACTERISTIC
/begin CHARACTERISTIC MKBRMXWP "Maximal zulässiges Kupplungsmoment bei betätigter Bremse" CURVE 0x827D1A KlAUwSstUwWUw 99.99847 rel_uw_b100 0.00 99.99847 FORMAT "%8.5"
 /begin AXIS_DESCR STD_AXIS wped_w relPED_uw_b100 8 0.00 100.0000 FORMAT "%8.4" DEPOSIT ABSOLUTE /end AXIS_DESCR
/end CHARACTERISTIC
/begin CHARACTERISTIC MKFADPN_0_A "Kupplungsmoment für Umschaltung Dashpot-Filterzeit" CURVE 0x819E38 GklWSb 99.60 rel_sb_q0p39 -50.00 49.61 FORMAT "%5.2"
 /begin AXIS_DESCR COM_AXIS nmot_w nmot_uw_q0p25 6 0.00 16383.75 AXIS_PTS_REF SNM06MDUW /end AXIS_DESCR
/end CHARACTERISTIC
/begin CHARACTERISTIC MKFADPN_1_A "Kupplungsmoment für Umschaltung Dashpot-Filterzeit" CURVE 0x819E3E GklWSb 99.60 rel_sb_q0p39 -50.00 49.61 FORMAT "%5.2"
 /begin AXIS_DESCR COM_AXIS nmot_w nmot_uw_q0p25 6 0.00 16383.75 AXIS_PTS_REF SNM06MDUW /end AXIS_DESCR
/end CHARACTERISTIC
/begin CHARACTERISTIC MKFADPN_2_A "Kupplungsmoment für Umschaltung Dashpot-Filterzeit" CURVE 0x819E44 GklWSb 99.60 rel_sb_q0p39 -50.00 49.61 FORMAT "%5.2"
 /begin AXIS_DESCR COM_AXIS nmot_w nmot_uw_q0p25 6 0.00 16383.75 AXIS_PTS_REF SNM06MDUW /end AXIS_DESCR
/end CHARACTERISTIC
/begin CHARACTERISTIC MKFADPN_3_A "Kupplungsmoment für Umschaltung Dashpot-Filterzeit" CURVE 0x819E4A GklWSb 99.60 rel_sb_q0p39 -50.00 49.61 FORMAT "%5.2"
 /begin AXIS_DESCR COM_AXIS nmot_w nmot_uw_q0p25 6 0.00 16383.75 AXIS_PTS_REF SNM06MDUW /end AXIS_DESCR
/end CHARACTERISTIC
/begin CHARACTERISTIC MKFADPN1_0_A "Kupplungsmoment für Umschaltung Dashpot-Filterzeit bei Klimakompressor" CURVE 0x819E50 GklWSb 99.60 rel_sb_q0p39 -50.00 49.61 FORMAT "%5.2"
 /begin AXIS_DESCR COM_AXIS nmot_w nmot_uw_q0p25 6 0.00 16383.75 AXIS_PTS_REF SNM06MDUW /end AXIS_DESCR
/end CHARACTERISTIC
/begin CHARACTERISTIC MKFADPN1_1_A "Kupplungsmoment für Umschaltung Dashpot-Filterzeit bei Klimakompressor" CURVE 0x819E56 GklWSb 99.60 rel_sb_q0p39 -50.00 49.61 FORMAT "%5.2"
 /begin AXIS_DESCR COM_AXIS nmot_w nmot_uw_q0p25 6 0.00 16383.75 AXIS_PTS_REF SNM06MDUW /end AXIS_DESCR
/end CHARACTERISTIC
/begin CHARACTERISTIC MKFADPN1_2_A "Kupplungsmoment für Umschaltung Dashpot-Filterzeit bei Klimakompressor" CURVE 0x819E5C GklWSb 99.60 rel_sb_q0p39 -50.00 49.61 FORMAT "%5.2"
 /begin AXIS_DESCR COM_AXIS nmot_w nmot_uw_q0p25 6 0.00 16383.75 AXIS_PTS_REF SNM06MDUW /end AXIS_DESCR
/end CHARACTERISTIC
/begin CHARACTERISTIC MKFADPN1_3_A "Kupplungsmoment für Umschaltung Dashpot-Filterzeit bei Klimakompressor" CURVE 0x819E62 GklWSb 99.60 rel_sb_q0p39 -50.00 49.61 FORMAT "%5.2"
 /begin AXIS_DESCR COM_AXIS nmot_w nmot_uw_q0p25 6 0.00 16383.75 AXIS_PTS_REF SNM06MDUW /end AXIS_DESCR
/end CHARACTERISTIC
/begin CHARACTERISTIC MKLLS "Momentaufnahme Klimakompressorlüfter" CURVE 0x819D69 KlAUbSstUbWUb 99.61 rel_ub_b100 0.00 99.61 FORMAT "%5.2"
 /begin AXIS_DESCR STD_AXIS mkllsc rel_q0p39 6 0.00 99.61 FORMAT "%5.2" DEPOSIT ABSOLUTE /end AXIS_DESCR
/end CHARACTERISTIC
/begin CHARACTERISTIC MKMIFABG "Kupplungsmoment für Aktivierung der Momentenänderungsbegrenzung" VALUE 0x81671A KwSw 199.9969 rel_sw_b100 -100.0000 99.99695 FORMAT "%8.4" /end CHARACTERISTIC
/begin CHARACTERISTIC MLNKAX "Luftmassenschwelle für Einschaltbereitschaft LRSHK I-Anteil" VALUE 0x816DCC KwUw 7281.667 m_uw_b7281 0.00 7281.667 FORMAT "%8.3" /end CHARACTERISTIC
/begin CHARACTERISTIC MRFALLO "Obere Leerlaufschwelle des relativen Fahrerwunschmoments" VALUE 0x81671C KwUw 199.9969 rel_uw_b200 0.00 199.9969 FORMAT "%8.4" /end CHARACTERISTIC
/begin CHARACTERISTIC MRFALLU "Untere Leerlaufschwelle des relativen Fahrerwunschmoments" VALUE 0x81671E KwUw 199.9969 rel_uw_b200 0.00 199.9969 FORMAT "%8.4" /end CHARACTERISTIC
/begin CHARACTERISTIC MRFAVLN "Vollasterkennungsschwelle des relativen Fahrerwunsches" CURVE 0x827AAA KlAUwSstUwWUw 199.9969 rel_uw_b200 0.00 199.9969 FORMAT "%8.4"
 /begin AXIS_DESCR STD_AXIS nmot_w nmot_uw_q0p25 14 0.00 16383.75 FORMAT "%8.2" DEPOSIT ABSOLUTE /end AXIS_DESCR
/end CHARACTERISTIC
/begin CHARACTERISTIC MXNLFEHL "Maximale Anzahl von Fehlern der Synchronisationsüberwachung bei hoher Dynamik" VALUE 0x810A25 KwUb 8.000 dez 0.00 8.000 FORMAT "%5.3" /end CHARACTERISTIC
/begin CHARACTERISTIC NASNOTKL "Kennlinie für Drehzahlschwelle für Abwürgeschutz" CURVE 0x819E69 KlAUbSstUbWUb 10200. nmot_ub_q40 0.00 10200. FORMAT "%5.0"
 /begin AXIS_DESCR STD_AXIS tmot temp_ub_q0p75_o48 4 -48.00 143.3 FORMAT "%5.1" DEPOSIT ABSOLUTE /end AXIS_DESCR
/end CHARACTERISTIC
/begin CHARACTERISTIC NGFSAWE "Schwelle Drehzahlgradient für Sperrung Filter SA/WE" VALUE 0x816720 KwSw 25599.94 nmotg_sw_q0p39 -12800.16 12799.77 FORMAT "%8.2" /end CHARACTERISTIC
/begin CHARACTERISTIC NLRHO_0_A "obere Drehzahlgrenze für Regelung hinter Kat" VALUE 0x816E06 KwUb 10200. nmot_ub_q40 0.00 10200. FORMAT "%5.0" /end CHARACTERISTIC
/begin CHARACTERISTIC NLRHO_1_A "obere Drehzahlgrenze für Regelung hinter Kat" VALUE 0x816E07 KwUb 10200. nmot_ub_q40 0.00 10200. FORMAT "%5.0" /end CHARACTERISTIC
/begin CHARACTERISTIC NLRHU_0_A "untere Drehzahlgrenze für Regelung hinter Kat" VALUE 0x816E08 KwUb 10200. nmot_ub_q40 0.00 10200. FORMAT "%5.0" /end CHARACTERISTIC
/begin CHARACTERISTIC NLRHU_1_A "untere Drehzahlgrenze für Regelung hinter Kat" VALUE 0x816E09 KwUb 10200. nmot_ub_q40 0.00 10200. FORMAT "%5.0" /end CHARACTERISTIC
/begin CHARACTERISTIC NLRKA "Drehzahlschwelle für Unterdrücken gesteuertes Kat-Ausräumen" VALUE 0x811EEE KwUb 10200. nmot_ub_q40 0.00 10200. FORMAT "%5.0" /end CHARACTERISTIC
/begin CHARACTERISTIC NLRSHB "Drehzahlschwelle, Abschalten LR bei Schub, in Verbindung mit LL und TLLRSHB" VALUE 0x811CEA KwUb 10200. nmot_ub_q40 0.00 10200. FORMAT "%5.0" /end CHARACTERISTIC
/begin CHARACTERISTIC NPHERKMN "minimale Motordrehzahl für Phasensuche" VALUE 0x8109CE KwUb 10200. nmot_ub_q40 0.00 10200. FORMAT "%5.0" /end CHARACTERISTIC
/begin CHARACTERISTIC NPHERKMX "maximale Motordrehzahl für Phasensuche" VALUE 0x8109CF KwUb 10200. nmot_ub_q40 0.00 10200. FORMAT "%5.0" /end CHARACTERISTIC
/begin CHARACTERISTIC NPHINVMN "minimale Motordrehzahl für Initialisierung" VALUE 0x8109D0 KwUb 10200. nmot_ub_q40 0.00 10200. FORMAT "%5.0" /end CHARACTERISTIC
/begin CHARACTERISTIC NPHINVMX "maximale Motordrehzahl für Initialisierung" VALUE 0x8109D1 KwUb 10200. nmot_ub_q40 0.00 10200. FORMAT "%5.0" /end CHARACTERISTIC
/begin CHARACTERISTIC NSTART "Motordrehzahlschwelle für Unterdrehzahl-Ausstieg bei Nachstartaufweitung" VALUE 0x8117C9 KwUb 10200. nmot_ub_q40 0.00 10200. FORMAT "%5.0" /end CHARACTERISTIC
/begin CHARACTERISTIC NSTEND "Motordrehzahlschwelle für Start Ende bei Nachstartaufweitung" VALUE 0x8117CA KwUb 10200. nmot_ub_q40 0.00 10200. FORMAT "%5.0" /end CHARACTERISTIC
/begin CHARACTERISTIC PLRHAV_0_A "Wichtungsfaktor des P-Anteils in der LRHK über KAT-Alterung" CURVE 0x811E9A KlAUbSstUbWUb 0.9961 fak_ub_b1 0.00 0.9961 /begin AXIS_DESCR STD_AXIS avkatf fak_ub_b1 8 0.00 0.9961 DEPOSIT ABSOLUTE /end AXIS_DESCR /end CHARACTERISTIC
/begin CHARACTERISTIC PLRHAV_1_A "Wichtungsfaktor des P-Anteils in der LRHK über KAT-Alterung" CURVE 0x811EAB KlAUbSstUbWUb 0.9961 fak_ub_b1 0.00 0.9961 /begin AXIS_DESCR STD_AXIS avkatf fak_ub_b1 8 0.00 0.9961 DEPOSIT ABSOLUTE /end AXIS_DESCR /end CHARACTERISTIC
/begin CHARACTERISTIC REDHYOC "Hysterese der Reduzierstufe bei größerer Soll-Reduzierstufe als Ist-Wert" VALUE 0x8116DD KwSb 5.100 rel_sb_q0p02 -2.560 2.540 FORMAT "%5.3" /end CHARACTERISTIC
/begin CHARACTERISTIC REDHYUC "Hysterese der Reduzierstufe bei kleinerer Soll-Reduzierstufe als Ist-Wert" VALUE 0x8116DE KwSb 5.100 rel_sb_q0p02 -2.560 2.540 FORMAT "%5.3" /end CHARACTERISTIC
/begin CHARACTERISTIC REDMXSA "maximale Reduzierstufe bei sequentieller Schubabschaltung" VALUE 0x8116DF KwUb 255.0 dez 0.00 255.0 FORMAT "%5.1" /end CHARACTERISTIC
/begin CHARACTERISTIC REDZEM "Schwelle zwischen Zündeingriff und Einspritzausblendung" CURVE 0x819F0E KlAUbSstUbWUb 255.0 dez 0.00 255.0 FORMAT "%5.1"
 /begin AXIS_DESCR STD_AXIS tmot temp_ub_q0p75_o48 5 -48.00 143.3 FORMAT "%5.1" DEPOSIT ABSOLUTE /end AXIS_DESCR
/end CHARACTERISTIC
/begin CHARACTERISTIC RLLRHON_0_A "Kennlinie über nmot, obere rL Regelgrenze für Regler hinter KAT" CURVE 0x811EBC GklWUb 191.3 rel_ub_q0p75 0.00 191.3 FORMAT "%5.1"
 /begin AXIS_DESCR COM_AXIS nmot nmot_ub_q40 8 0.00 10200. AXIS_PTS_REF SNM08LHUB /end AXIS_DESCR
/end CHARACTERISTIC
/begin CHARACTERISTIC RLLRHON_1_A "Kennlinie über nmot, obere rL Regelgrenze für Regler hinter KAT" CURVE 0x811EC4 GklWUb 191.3 rel_ub_q0p75 0.00 191.3 FORMAT "%5.1"
 /begin AXIS_DESCR COM_AXIS nmot nmot_ub_q40 8 0.00 10200. AXIS_PTS_REF SNM08LHUB /end AXIS_DESCR
/end CHARACTERISTIC
/begin CHARACTERISTIC RLLRHUAN_0_A "Kennlinie über nmot, untere rL Regelgrenze für Regler hinter KAT während Kurztes" CURVE 0x811ECC GklWUb 191.3 rel_ub_q0p75 0.00 191.3 FORMAT "%5.1"
 /begin AXIS_DESCR COM_AXIS nmot nmot_ub_q40 8 0.00 10200. AXIS_PTS_REF SNM08LHUB /end AXIS_DESCR
/end CHARACTERISTIC
/begin CHARACTERISTIC RLLRHUAN_1_A "Kennlinie über nmot, untere rL Regelgrenze für Regler hinter KAT während Kurztes" CURVE 0x811ED4 GklWUb 191.3 rel_ub_q0p75 0.00 191.3 FORMAT "%5.1"
 /begin AXIS_DESCR COM_AXIS nmot nmot_ub_q40 8 0.00 10200. AXIS_PTS_REF SNM08LHUB /end AXIS_DESCR
/end CHARACTERISTIC
/begin CHARACTERISTIC RLLRHUN_0_A "Kennlinie über nmot, untere rL Regelgrenze für Regler hinter KAT" CURVE 0x811EDC GklWUb 191.3 rel_ub_q0p75 0.00 191.3 FORMAT "%5.1"
 /begin AXIS_DESCR COM_AXIS nmot nmot_ub_q40 8 0.00 10200. AXIS_PTS_REF SNM08LHUB /end AXIS_DESCR
/end CHARACTERISTIC
/begin CHARACTERISTIC RLLRHUN_1_A "Kennlinie über nmot, untere rL Regelgrenze für Regler hinter KAT" CURVE 0x811EE4 GklWUb 191.3 rel_ub_q0p75 0.00 191.3 FORMAT "%5.1"
 /begin AXIS_DESCR COM_AXIS nmot nmot_ub_q40 8 0.00 10200. AXIS_PTS_REF SNM08LHUB /end AXIS_DESCR
/end CHARACTERISTIC
/begin CHARACTERISTIC RLLRSHB "relative Lastschwelle, Abschalten LR bei SLS, in Verbindung mit LL und NLRSHB" VALUE 0x811CEB KwUb 191.3 rel_ub_q0p75 0.00 191.3 FORMAT "%5.1" /end CHARACTERISTIC
/begin CHARACTERISTIC RLLRUN "Kennlinie über nmot, untere rL Regelgrenze für Regler vor KAT" CURVE 0x811CEC KlAUbSstUbWUb 191.3 rel_ub_q0p75 0.00 191.3 FORMAT "%5.1"
 /begin AXIS_DESCR STD_AXIS nmot nmot_ub_q40 8 0.00 10200. FORMAT "%5.0" DEPOSIT ABSOLUTE /end AXIS_DESCR
/end CHARACTERISTIC
/begin CHARACTERISTIC RLPHERKMN "minimale Last für Phasensuche" VALUE 0x8109D2 KwUb 191.3 rel_ub_q0p75 0.00 191.3 FORMAT "%5.1" /end CHARACTERISTIC
/begin CHARACTERISTIC RLPHERKMX "maximale Last für Phasensuche" VALUE 0x8109D3 KwUb 191.3 rel_ub_q0p75 0.00 191.3 FORMAT "%5.1" /end CHARACTERISTIC
/begin CHARACTERISTIC RLSLSMN "min. rl für Freigabe Regelung während Sekundärluft" CURVE 0x811CFD KlAUbSstUbWUb 191.3 rel_ub_q0p75 0.00 191.3 FORMAT "%5.1"
 /begin AXIS_DESCR STD_AXIS nmot nmot_ub_q40 4 0.00 10200. FORMAT "%5.0" DEPOSIT ABSOLUTE /end AXIS_DESCR
/end CHARACTERISTIC
/begin CHARACTERISTIC RLSOLAP "Sollfüllung für Applikationszwecke" VALUE 0x8153B0 KwUw 1535.977 rel_uw_q0p0234 0.00 1535.977 FORMAT "%8.3" /end CHARACTERISTIC
/begin AXIS_PTS SGA08MDUB "Stützstellenverteilung Ist Gang 8 Sst." 0x810060 gangi SstAUbSstUb 255.0 dez 8 0.00 255.0 FORMAT "%5.1" DEPOSIT ABSOLUTE /end AXIS_PTS
/begin AXIS_PTS SM108LHSW "dlashk_w abhängige Stützstellen (Anzahl 8)" 0x81A80A dlashkm_w SstASwSstSw 1.999969 fak_sw_b1 8 -1.000000 0.9999695 FORMAT "%8.6" DEPOSIT ABSOLUTE /end AXIS_PTS
/begin AXIS_PTS SML08LHUB_0_A "ml abhängige Stützstellen (Anzahl 8)" 0x8181F1 ml SstAUbSstUb 1020. m_ub_b1020 8 0.00 1020. FORMAT "%5.0" DEPOSIT ABSOLUTE /end AXIS_PTS
/begin AXIS_PTS SML08LHUB_1_A "ml abhängige Stützstellen (Anzahl 8)" 0x8181FA ml SstAUbSstUb 1020. m_ub_b1020 8 0.00 1020. FORMAT "%5.0" DEPOSIT ABSOLUTE /end AXIS_PTS
/begin AXIS_PTS SMO08OPUB "Stützstellenverteilung für zulässiges Moment mizuvfil" 0x8117CB mizuvfil SstAUbSstUb 99.61 rel_ub_b99p6 8 0.00 99.61 FORMAT "%5.2" DEPOSIT ABSOLUTE /end AXIS_PTS
/begin AXIS_PTS SNM06KOUB "Verteilung für Klimakompressorkennlinien" 0x819D76 nmot SstAUbSstUb 10200. nmot_ub_q40 6 0.00 10200. FORMAT "%5.0" DEPOSIT ABSOLUTE /end AXIS_PTS
/begin AXIS_PTS SNM06MDUW "Rover" 0x81A848 nmot_w SstAUwSstUw 16383.75 nmot_uw_q0p25 6 0.00 16383.75 FORMAT "%8.2" DEPOSIT ABSOLUTE /end AXIS_PTS
/begin AXIS_PTS SNM07LSUW "Stützstellenverteilung Reglerparameter LRS" 0x81306E nmot_w SstAUwSstUw 16383.75 nmot_uw_q0p25 7 0.00 16383.75 FORMAT "%8.2" DEPOSIT ABSOLUTE /end AXIS_PTS
/begin AXIS_PTS SNM08LHUB "nmot abhängige Stützstellen (Anzahl 8)" 0x81822D nmot SstAUbSstUb 10200. nmot_ub_q40 8 0.00 10200. FORMAT "%5.0" DEPOSIT ABSOLUTE /end AXIS_PTS
/begin AXIS_PTS SNM08OPUB "Stützstellenverteilung für Motordrehzahl nmot" 0x81008E nmot SstAUbSstUb 10200. nmot_ub_q40 8 0.00 10200. FORMAT "%5.0" DEPOSIT ABSOLUTE /end AXIS_PTS
/begin AXIS_PTS SNM10LSUB "Stützstellenverteilung Kat-Vorsteuerwert LRS" 0x810097 nmot SstAUbSstUb 10200. nmot_ub_q40 10 0.00 10200. FORMAT "%5.0" DEPOSIT ABSOLUTE /end AXIS_PTS
/begin AXIS_PTS SNM12FEUB "Stützstellen für WDKSMX, WDKUGDN" 0x8100AF nmot SstAUbSstUb 10200. nmot_ub_q40 12 0.00 10200. FORMAT "%5.0" DEPOSIT ABSOLUTE /end AXIS_PTS
/begin AXIS_PTS SNM12MDUW "Stützstellenverteilung nmot_w" 0x816722 nmot_w SstAUwSstUw 16383.75 nmot_uw_q0p25 12 0.00 16383.75 FORMAT "%8.2" DEPOSIT ABSOLUTE /end AXIS_PTS
/begin AXIS_PTS SNM16OPUW "Stützstellenverteilung Drehzahl" 0x8130EE nmot_w SstAUwSstUw 16383.75 nmot_uw_q0p25 16 0.00 16383.75 FORMAT "%8.2" DEPOSIT ABSOLUTE /end AXIS_PTS
/begin AXIS_PTS SRL06KOUB "Stützstellenverteilung Kompressormoment" 0x819D7D rl SstAUbSstUb 191.3 rel_ub_q0p75 6 0.00 191.3 FORMAT "%5.1" DEPOSIT ABSOLUTE /end AXIS_PTS
/begin AXIS_PTS SRL08LSUW "Stützstellenverteilung Reglerparameter" 0x81313E rl_w SstAUwSstUw 1535.977 rel_uw_q0p0234 8 0.00 1535.977 FORMAT "%8.3" DEPOSIT ABSOLUTE /end AXIS_PTS
/begin AXIS_PTS SRL10LSUB "Stützstellenverteilung Kat-Vorsteuerwert LRS" 0x8100EC rl SstAUbSstUb 191.3 rel_ub_q0p75 10 0.00 191.3 FORMAT "%5.1" DEPOSIT ABSOLUTE /end AXIS_PTS
/begin AXIS_PTS SRL11OPUW "Stützstellenverteilung relative Luftfüllung" 0x81699A rl_w SstAUwSstUw 1535.977 rel_uw_q0p0234 11 0.00 1535.977 FORMAT "%8.3" DEPOSIT ABSOLUTE /end AXIS_PTS
/begin AXIS_PTS STA06LLUB "Temperatur: Ansaugluft bzw. PWM-Signal von AC/Kompressor" 0x819D84 tlok SstAUbSstUb 191.3 temp_ub_q0p75_o48 6 -48.00 143.3 FORMAT "%5.1" DEPOSIT ABSOLUTE /end AXIS_PTS
/begin AXIS_PTS STM04FEUB "Stützstellenverteilung Motortemperatur" 0x81011A tmot SstAUbSstUb 191.3 temp_ub_q0p75_o48 4 -48.00 143.3 FORMAT "%5.1" DEPOSIT ABSOLUTE /end AXIS_PTS
/begin AXIS_PTS STM08MDUB "Stützstellenverteilung: tmot für Drehmomentwandler" 0x8182DC tmot SstAUbSstUb 191.3 temp_ub_q0p75_o48 8 -48.00 143.3 FORMAT "%5.1" DEPOSIT ABSOLUTE /end AXIS_PTS
/begin AXIS_PTS STM08OPUB "" 0x81012D tmot SstAUbSstUb 191.3 temp_ub_q0p75_o48 8 -48.00 143.3 FORMAT "%5.1" DEPOSIT ABSOLUTE /end AXIS_PTS
/begin AXIS_PTS STM10__UB "" 0x8182EF tmot SstAUbSstUb 191.3 temp_ub_q0p75_o48 10 -48.00 143.3 FORMAT "%5.1" DEPOSIT ABSOLUTE /end AXIS_PTS
/begin AXIS_PTS SWP08OPUB "Stützstellenverteilung für Pedalstellung wped" 0x810159 wped SstAUbSstUb 100.0 relPED_ub_b100 8 0.00 100.0 FORMAT "%5.1" DEPOSIT ABSOLUTE /end AXIS_PTS
/begin AXIS_PTS SWP16MDUW "Stützstellenverteilung wped_w" 0x81673C wped_w SstAUwSstUw 100.0000 relPED_uw_b100 16 0.00 100.0000 FORMAT "%8.4" DEPOSIT ABSOLUTE /end AXIS_PTS
/begin CHARACTERISTIC TAGAT "Zeitkonstante Abregelung Momenten begrenzung" VALUE 0x819F75 KwUb 25.4996 zk100msxs_ub_b25p5 0.100392 25.6000 FORMAT "%7.4" /end CHARACTERISTIC
/begin CHARACTERISTIC TANSMN "Ansauglufttemperaturschwelle zur Nachstartaufweitung" VALUE 0x8117D4 KwUb 191.3 temp_ub_q0p75_o48 -48.00 143.3 FORMAT "%5.1" /end CHARACTERISTIC
/begin CHARACTERISTIC TARAU "Ansauglufttemperaturschwelle für Einschalten der Lambda - Regelung" VALUE 0x811D06 KwUb 191.3 temp_ub_q0p75_o48 -48.00 143.3 FORMAT "%5.1" /end CHARACTERISTIC
/begin CHARACTERISTIC TASHS "Schwelle Ansauglufttemp. für Auslösung TLRHS - Sperrzeit LR bei Heißstart" VALUE 0x811D07 KwUb 191.3 temp_ub_q0p75_o48 -48.00 143.3 FORMAT "%5.1" /end CHARACTERISTIC
/begin CHARACTERISTIC TAUIDEC "Zeitkonstante Absteuern Integralanteil bei Grenzwertregelung LRS" VALUE 0x816CEE KwUw 655.34999985 zk10msxs_uw_b655 0.010000152590 655.36000000 FORMAT "%12.8" /end CHARACTERISTIC
/begin CHARACTERISTIC TBLRH "Sperrzeit für Regelung hinter Kat nach Freigabe durch Regelung vor Kat" VALUE 0x811EEC KwUb 25.50 t100msxs_ub_b25p5 0.00 25.50 FORMAT "%5.2" /end CHARACTERISTIC
/begin CHARACTERISTIC TDMFBSA "Zeitkonstante PT1-Filter beim Schubabschalten" VALUE 0x81675E KwUw 655.34999985 zk10msxs_uw_b655 0.010000152590 655.36000000 FORMAT "%12.8" /end CHARACTERISTIC
/begin CHARACTERISTIC TDMFBWE "Zeitkonstante PT1-Filter beim weichen Wiedereinsetzen" VALUE 0x816760 KwUw 655.34999985 zk10msxs_uw_b655 0.010000152590 655.36000000 FORMAT "%12.8" /end CHARACTERISTIC
/begin CHARACTERISTIC TDMFNSG "Filterzeitkonstante bei Solldrehzahlanhebung CVT" VALUE 0x816762 KwUw 655.34999985 zk10msxs_uw_b655 0.010000152590 655.36000000 FORMAT "%12.8" /end CHARACTERISTIC
/begin CHARACTERISTIC TDMFWEMI "Filterzeitkonstante beim harten Wiedereinsetzen" CURVE 0x816764 KlAUwSstUwWUw 655.34999908 zk10msxs_uw_b655 0.010000915611 655.36000000 FORMAT "%12.8"
 /begin AXIS_DESCR STD_AXIS mivbeb_w rel_uw_b100 8 0.00 99.99847 FORMAT "%8.5" DEPOSIT ABSOLUTE /end AXIS_DESCR
/end CHARACTERISTIC
/begin CHARACTERISTIC TDMKO "Entprellzeit nach Momentenreserve: Klimakompressor" VALUE 0x8114D0 KwUb 5.100 t20msxs_ub_b5p1 0.00 5.100 FORMAT "%5.3" /end CHARACTERISTIC
/begin CHARACTERISTIC TDMLSDS "Zeit nach Kupplungsbetätigung mit veränderter LSD-Auslösung" VALUE 0x811506 KwUb 5.100 t20msxs_ub_b5p1 0.00 5.100 FORMAT "%5.3" /end CHARACTERISTIC
/begin CHARACTERISTIC TFMIZU "Filterzeitkonstante zur Filterung des zulässigen Moments" VALUE 0x8169CC KwUw 655.34999985 zk10msxs_uw_b655 0.010000152590 655.36000000 FORMAT "%12.8" /end CHARACTERISTIC
/begin CHARACTERISTIC THDMB "Heilungs-Entprellzeit des Fehleintrags für dauerhafte Momentbegrenzung" VALUE 0x819E72 KwUb 255.0 t1sxs_ub_b255 0.00 255.0 FORMAT "%5.1" /end CHARACTERISTIC
/begin CHARACTERISTIC TKATMLRH_0_A "Einschaltschwelle Kat-Modelltemperatur  für Lambdaregelung hinter Kat" VALUE 0x816E1A KwUb 1275. temp_ub_q5_o50 -50.00 1225. FORMAT "%5.0" /end CHARACTERISTIC
/begin CHARACTERISTIC TKATMLRH_1_A "Einschaltschwelle Kat-Modelltemperatur  für Lambdaregelung hinter Kat" VALUE 0x816E1B KwUb 1275. temp_ub_q5_o50 -50.00 1225. FORMAT "%5.0" /end CHARACTERISTIC
/begin CHARACTERISTIC TKATSZA "Kat-Temperaturschwelle für Freigabe der Zwangsamplitude" VALUE 0x816CF0 KwUw 1279.980 temp_uw_q0p0195_o50 -50.00000 1229.980 FORMAT "%8.3" /end CHARACTERISTIC
/begin CHARACTERISTIC TLRBAM "Sperrzeit für Einschalten LR nach BA" CURVE 0x816D06 KlAUbSstUbWUw 655.3500 t10msxs_uw_b655p35 0.00 655.3500 FORMAT "%8.4"
 /begin AXIS_DESCR STD_AXIS tmot temp_ub_q0p75_o48 8 -48.00 143.3 FORMAT "%5.1" DEPOSIT ABSOLUTE /end AXIS_DESCR
/end CHARACTERISTIC
/begin CHARACTERISTIC TLRHFRXMOF "Turnoff Delay für Bedingung B_frmin OR B_frmax (Sperre P-Anteil)" VALUE 0x81A01A KwUb 25.50 t_q0p1 0.00 25.50 FORMAT "%5.2" /end CHARACTERISTIC
/begin CHARACTERISTIC TLRHFRXMON "Turnon Delay für Bedingung B_frmin OR B_frmax (Sperre P-Anteil)" VALUE 0x81A01B KwUb 25.50 t_q0p1 0.00 25.50 FORMAT "%5.2" /end CHARACTERISTIC
/begin CHARACTERISTIC TLRHS "Sperrzeit LR bei Heißstart, ausgelöst über Schwellen TASHS und TMSHS" VALUE 0x81A005 KwUb 25.50 t100msxs_ub_b25p5 0.00 25.50 FORMAT "%5.2" /end CHARACTERISTIC
/begin CHARACTERISTIC TLRSZWSA "Zeitdauer für LRS-Zwangseinschaltung nach Schubabschneiden" VALUE 0x827EEC KwUw 6553.500 t100msxs_uw_b6553p5 0.00 6553.500 FORMAT "%8.3" /end CHARACTERISTIC
/begin CHARACTERISTIC TLRTMS "Sperrzeit LR nach Start, abhängig von der Motortemperatur bei Start" CURVE 0x827EEE KlAUbSstUbWUw 6553.500 t100msxs_uw_b6553p5 0.00 6553.500 FORMAT "%8.3"
 /begin AXIS_DESCR STD_AXIS tmst temp_ub_q0p75_o48 5 -48.00 143.3 FORMAT "%5.1" DEPOSIT ABSOLUTE /end AXIS_DESCR
/end CHARACTERISTIC
/begin CHARACTERISTIC TLRVAM "Sperrzeit für Einschalten LR nach VA" CURVE 0x816D20 KlAUbSstUbWUw 655.3500 t10msxs_uw_b655p35 0.00 655.3500 FORMAT "%8.4"
 /begin AXIS_DESCR STD_AXIS tmot temp_ub_q0p75_o48 8 -48.00 143.3 FORMAT "%5.1" DEPOSIT ABSOLUTE /end AXIS_DESCR
/end CHARACTERISTIC
/begin CHARACTERISTIC TLRZWTMS "Zeit für Zwangseinschaltung LR (CARB-Forderung) nach Start" CURVE 0x827EFE KlAUbSstUbWUw 6553.500 t100msxs_uw_b6553p5 0.00 6553.500 FORMAT "%8.3"
 /begin AXIS_DESCR STD_AXIS tmst temp_ub_q0p75_o48 4 -48.00 143.3 FORMAT "%5.1" DEPOSIT ABSOLUTE /end AXIS_DESCR
/end CHARACTERISTIC
/begin CHARACTERISTIC TMDMAD "Motortemperaturschwelle für Freigabe der Adaption des Verlustmoments" VALUE 0x819CA4 KwUb 191.3 temp_ub_q0p75_o48 -48.00 143.3 FORMAT "%5.1" /end CHARACTERISTIC
/begin CHARACTERISTIC TMLLAMN "Entprellzeit für Erkennung  Bedingung lamsons_w > 1" VALUE 0x81A01C KwUb 25.50 t_q0p1 0.00 25.50 FORMAT "%5.2" /end CHARACTERISTIC
/begin CHARACTERISTIC TMLRZAMN "Minimale Motortemperatur für Zusatzamplitude" VALUE 0x811CE8 KwUb 191.3 temp_ub_q0p75_o48 -48.00 143.3 FORMAT "%5.1" /end CHARACTERISTIC
/begin CHARACTERISTIC TMMIBGR "tmot-Schwelle für Freigabe Momentenbegrenzung" VALUE 0x819F76 KwUb 191.3 temp_ub_q0p75_o48 -48.00 143.3 FORMAT "%5.1" /end CHARACTERISTIC
/begin CHARACTERISTIC TMNSMN "Motortemperaturschwelle für die Nachstartaufweitung" VALUE 0x8117D5 KwUb 191.3 temp_ub_q0p75_o48 -48.00 143.3 FORMAT "%5.1" /end CHARACTERISTIC
/begin CHARACTERISTIC TMRA1 "Ausschaltbedingung (S_LL = 0)" VALUE 0x811D08 KwUb 191.3 temp_ub_q0p75_o48 -48.00 143.3 FORMAT "%5.1" /end CHARACTERISTIC
/begin CHARACTERISTIC TMRA2 "Ausschaltbedingung (S_LL = 1)" VALUE 0x811D09 KwUb 191.3 temp_ub_q0p75_o48 -48.00 143.3 FORMAT "%5.1" /end CHARACTERISTIC
/begin CHARACTERISTIC TMRAK "Ausschaltschwelle der Lambda - Regelung bei niedriger Starttemperatur" VALUE 0x811D0A KwUb 191.3 temp_ub_q0p75_o48 -48.00 143.3 FORMAT "%5.1" /end CHARACTERISTIC
/begin CHARACTERISTIC TMSHS "Schwelle Motortemp. für Auslösung TLRHS - Sperrzeit LR bei Heißstart" VALUE 0x811D0B KwUb 191.3 temp_ub_q0p75_o48 -48.00 143.3 FORMAT "%5.1" /end CHARACTERISTIC
/begin CHARACTERISTIC TMVER "Entprellzeit zur Erkennung einer dauerhaften Momentenbegrenzung" VALUE 0x81F9FE KwUw 65535.00 t1sxs_uw_b65535 0.00 65535.00 FORMAT "%8.2" /end CHARACTERISTIC
/begin CHARACTERISTIC TMXMIBG "Maximal Motor Temperatur für Moment Begrenzung" VALUE 0x819F77 KwUb 191.3 temp_ub_q0p75_o48 -48.00 143.3 FORMAT "%5.1" /end CHARACTERISTIC
/begin CHARACTERISTIC TNGAT "Zeitkonstante Eingriff Momenten begrenzung Abgastemperatur" VALUE 0x819F78 KwUb 25.4996 zk100msxs_ub_b25p5 0.100392 25.6000 FORMAT "%7.4" /end CHARACTERISTIC
/begin CHARACTERISTIC TNLPHWAIT "Zeit für Zahnaufweitung bei B_rphsp" VALUE 0x81BB2C KwUw 30000.00 t5usxus_q5 0.00 30000.00 FORMAT "%8.2" /end CHARACTERISTIC
/begin CHARACTERISTIC TNLSGMN "Minimale Zeit für SG-Nachlauf" VALUE 0x81FBCE KwUw 6553.300 t100msxs_uw_b6553p6 0.2000000 6553.500 FORMAT "%8.3" /end CHARACTERISTIC
/begin CHARACTERISTIC TNLSGMX "Maximale Zeit für SG-Nachlauf" VALUE 0x81FBD0 KwUw 6553.500 t100msxs_uw_b6553p6 0.00 6553.500 FORMAT "%8.3" /end CHARACTERISTIC
/begin CHARACTERISTIC TNLSYNMN "Maximalwert der Phasenperiodendauer für Synchronisationsfreigabe" VALUE 0x813FF4 KwUw 2615400. t40usxus_q40 6000.000 2621400. FORMAT "%8.0" /end CHARACTERISTIC
/begin CHARACTERISTIC TNLSYNMX "Minimalwert der Phasenperiodendauer für Synchronisationsfreigabe" VALUE 0x813FF6 KwUw 400000.0 t40usxus_q40 0.00 400000.0 FORMAT "%8.1" /end CHARACTERISTIC
/begin CHARACTERISTIC TNSC "Nachstartüberwachungszeit" VALUE 0x8169CE KwUw 1310.700 t20msxs_uw_q0p02 0.00 1310.700 FORMAT "%8.3" /end CHARACTERISTIC
/begin CHARACTERISTIC TNSOF "Entprellzeit zur Abschaltung der Nachstartaufweitung" VALUE 0x8117D6 KwUb 5.100 t20msxs_ub_b5p1 0.00 5.100 FORMAT "%5.3" /end CHARACTERISTIC
/begin CHARACTERISTIC TPHERKMN "minimale Motortemperatur für Phasensuche" VALUE 0x8109D4 KwUb 191.3 temp_ub_q0p75_o48 -48.00 143.3 FORMAT "%5.1" /end CHARACTERISTIC
/begin CHARACTERISTIC TPHSABSP "Sperrzeit für die Phasensuche, wenn der geeignete Betriebsbereich verl. wurde" VALUE 0x8109D5 KwUb 255.0 t1sxs_ub_b255 0.00 255.0 FORMAT "%5.1" /end CHARACTERISTIC
/begin CHARACTERISTIC TPHSSP "Sperrzeit für Phasensuche nach erfolgloser Suche" VALUE 0x8109D6 KwUb 255.0 t1sxs_ub_b255 0.00 255.0 FORMAT "%5.1" /end CHARACTERISTIC
/begin CHARACTERISTIC TRAU "Überwachungszeit für untere Lastschwelle der Lambdaregelung" VALUE 0x81A006 KwUb 25.50 t100msxs_ub_b25p5 0.00 25.50 FORMAT "%5.2" /end CHARACTERISTIC
/begin CHARACTERISTIC TSAKAMN "Mindestdauer SA für Funktion Katalysator-Ausräumen" VALUE 0x811EEF KwUb 5.100 t20msxs_ub_b5p1 0.00 5.100 FORMAT "%5.3" /end CHARACTERISTIC
/begin CHARACTERISTIC TVBRMX "Verzögerungszeit für Aktivierung der Brettfunktion" VALUE 0x819F79 KwUb 25.50 t_q0p1 0.00 25.50 FORMAT "%5.2" /end CHARACTERISTIC
/begin CHARACTERISTIC TVFSAM "Temperaturabhängige Verzögerungszeit für Fahrstufe AUS" CURVE 0x819CB6 GklWUb 5.100 t20msxs_ub_b5p1 0.00 5.100 FORMAT "%5.3"
 /begin AXIS_DESCR COM_AXIS tmot temp_ub_q0p75_o48 8 -48.00 143.3 AXIS_PTS_REF STM08MDUB /end AXIS_DESCR
/end CHARACTERISTIC
/begin CHARACTERISTIC TVFSAWE "Verzögerungszeit für Rücksetzen von B_fil" VALUE 0x816786 KwUw 655.3500 t10msxs_uw_b655p35 0.00 655.3500 FORMAT "%8.4" /end CHARACTERISTIC
/begin CHARACTERISTIC TVFSEM "Temperaturabhängige Verzögerungszeit für Fahrstufe EIN" CURVE 0x819CBE GklWUb 5.100 t20msxs_ub_b5p1 0.00 5.100 FORMAT "%5.3"
 /begin AXIS_DESCR COM_AXIS tmot temp_ub_q0p75_o48 8 -48.00 143.3 AXIS_PTS_REF STM08MDUB /end AXIS_DESCR
/end CHARACTERISTIC
/begin CHARACTERISTIC TVFSRAM "motortemperaturabhängige Verzögerungszeit für Fahrstufe aus (R)" CURVE 0x819CC6 GklWUb 5.100 t20msxs_ub_b5p1 0.00 5.100 FORMAT "%5.3"
 /begin AXIS_DESCR COM_AXIS tmot temp_ub_q0p75_o48 8 -48.00 143.3 AXIS_PTS_REF STM08MDUB /end AXIS_DESCR
/end CHARACTERISTIC
/begin CHARACTERISTIC TVFSREM "motortemperaturabhängige Verzögerungszeit für Fahrstufe ein (R)" CURVE 0x819CCE GklWUb 5.100 t20msxs_ub_b5p1 0.00 5.100 FORMAT "%5.3"
 /begin AXIS_DESCR COM_AXIS tmot temp_ub_q0p75_o48 8 -48.00 143.3 AXIS_PTS_REF STM08MDUB /end AXIS_DESCR
/end CHARACTERISTIC
/begin CHARACTERISTIC TVFUE "Verzögerungszeit für den Aufbau der Füllung" VALUE 0x8113F5 KwUb 5.100 t20msxs_ub_b5p1 0.00 5.100 FORMAT "%5.3" /end CHARACTERISTIC
/begin CHARACTERISTIC TVGAT "Verzögerung Momenten begrenzung Abgastemperatur" VALUE 0x819F7A KwUb 25.50 t100msxs_ub_b25p5 0.00 25.50 FORMAT "%5.2" /end CHARACTERISTIC
/begin CHARACTERISTIC TVLDSZW "Einschaltdauer Zündwinkelfreigabe bei Nachladeeffekt" VALUE 0x81150D KwUb 2.550 t10msxs_ub_b2p55 0.00 2.550 FORMAT "%5.3" /end CHARACTERISTIC
/begin CHARACTERISTIC TVMIBEG "Entprellzeit für Zündwinkelfreigabe bei Momentenbegrenzung" VALUE 0x81150E KwUb 2.550 t10msxs_ub_b2p55 0.00 2.550 FORMAT "%5.3" /end CHARACTERISTIC
/begin CHARACTERISTIC TVSLR "Dauer LRS-Ausschaltung über Ventilhubsteuerung" CURVE 0x81A007 KlAUbSstUbWUb 2.550 t10msxs_ub_b2p55 0.00 2.550 FORMAT "%5.3"
 /begin AXIS_DESCR STD_AXIS nmot nmot_ub_q40 8 0.00 10200. FORMAT "%5.0" DEPOSIT ABSOLUTE /end AXIS_DESCR
/end CHARACTERISTIC
/begin CHARACTERISTIC TWDMAD "Wartezeit bis Freigabe der Adaption des Verlustmoments" VALUE 0x819CA5 KwUb 51.00 t200msxs_ub_b51 0.00 51.00 FORMAT "%5.2" /end CHARACTERISTIC
/begin CHARACTERISTIC UBNLMN "Minimale Batterie-Sollspannung" VALUE 0x819F7D KwUb 17.95 spg_ubatt 0.00 17.95 FORMAT "%5.2" /end CHARACTERISTIC
/begin CHARACTERISTIC UEVERG_0_A "Übersetzungsverhältnis abh. vom eingelegten Gang" CURVE 0x8113F6 FklWUb 15.94 fak_ub_b16 0.00 15.94 FORMAT "%5.2"
 /begin AXIS_DESCR FIX_AXIS gangi dez 8 0.00 7.000 FORMAT "%5.3" FIX_AXIS_PAR 0 0 8 /end AXIS_DESCR
/end CHARACTERISTIC
/begin CHARACTERISTIC UEVERG_1_A "Übersetzungsverhältnis abh. vom eingelegten Gang" CURVE 0x8113FE FklWUb 15.94 fak_ub_b16 0.00 15.94 FORMAT "%5.2"
 /begin AXIS_DESCR FIX_AXIS gangi dez 8 0.00 7.000 FORMAT "%5.3" FIX_AXIS_PAR 0 0 8 /end AXIS_DESCR
/end CHARACTERISTIC
/begin CHARACTERISTIC UEVERG_2_A "Übersetzungsverhältnis abh. vom eingelegten Gang" CURVE 0x811406 FklWUb 15.94 fak_ub_b16 0.00 15.94 FORMAT "%5.2"
 /begin AXIS_DESCR FIX_AXIS gangi dez 8 0.00 7.000 FORMAT "%5.3" FIX_AXIS_PAR 0 0 8 /end AXIS_DESCR
/end CHARACTERISTIC
/begin CHARACTERISTIC UEVERG_3_A "Übersetzungsverhältnis abh. vom eingelegten Gang" CURVE 0x81140E FklWUb 15.94 fak_ub_b16 0.00 15.94 FORMAT "%5.2"
 /begin AXIS_DESCR FIX_AXIS gangi dez 8 0.00 7.000 FORMAT "%5.3" FIX_AXIS_PAR 0 0 8 /end AXIS_DESCR
/end CHARACTERISTIC
/begin CHARACTERISTIC USHKAMX "Sondenspannung hinter Kat für Abbruch Kat-Ausräumen" VALUE 0x811EF0 KwUb 1.330 spg_ub_q0p0052_o0p2 -0.2000 1.130 FORMAT "%5.3" /end CHARACTERISTIC
/begin CHARACTERISTIC VDASH "Mindestgeschwindigkeit für Dashpot" VALUE 0x811507 KwUb 318.8 vfzg_ub_q1p25 0.00 318.8 FORMAT "%5.1" /end CHARACTERISTIC
/begin CHARACTERISTIC VLSD "Mindestgeschwindigkeit für Lastschlagdämpfung" VALUE 0x811508 KwUb 318.8 vfzg_ub_q1p25 0.00 318.8 FORMAT "%5.1" /end CHARACTERISTIC
/begin CHARACTERISTIC VMIBGR "v-Schwelle für Freigabe Momentenbegrenzung" VALUE 0x819F7B KwUb 318.8 vfzg_ub_q1p25 0.00 318.8 FORMAT "%5.1" /end CHARACTERISTIC
/begin CHARACTERISTIC VMKBRMX "Geschwindigkeitsschwelle für Kupplungsmomentbegrenzung bei betätigter Bremse" VALUE 0x819F7C KwUb 318.8 vfzg_ub_q1p25 0.00 318.8 FORMAT "%5.1" /end CHARACTERISTIC
/begin CHARACTERISTIC WIMAX "ObererSchranke interne Reglerzustände stetige Lambdaregelung" VALUE 0x816CF2 KwSw 7.999878 fak_sw_b4 -4.000000 3.999878 FORMAT "%8.6" /end CHARACTERISTIC
/begin CHARACTERISTIC WIMIN "Untere Schranke interne Reglerzustaende stetige Lambdaregelung" VALUE 0x816CF4 KwSw 7.999878 fak_sw_b4 -4.000000 3.999878 FORMAT "%8.6" /end CHARACTERISTIC
/begin CHARACTERISTIC XIMAX "ObererSchranke interne Reglerzustände stetige Lambdaregelung" VALUE 0x816CF6 KwSw 1.999969 fak_sw_b1 -1.000000 0.9999695 FORMAT "%8.6" /end CHARACTERISTIC
/begin CHARACTERISTIC XIMIN "Untere [Bhranke interne Reglerzustaende stetige Lambdaregelung" VALUE 0x816CF8 KwSw 1.999969 fak_sw_b1 -1.000000 0.9999695 FORMAT "%8.6" /end CHARACTERISTIC
/begin CHARACTERISTIC Y2MAX "Obere Schranke Integralanteil LRS" VALUE 0x816CFA KwSw 1.999969 fak_sw_b1 -1.000000 0.9999695 FORMAT "%8.6" /end CHARACTERISTIC
/begin CHARACTERISTIC ZFMDVERL "Zeitkonstante für Filterung Verlustmoment" VALUE 0x8116C8 KwUb 2.53000 zk20msxs_ub_b5p1 0.0200000 2.55000 FORMAT "%7.5" /end CHARACTERISTIC
/begin CHARACTERISTIC ZKDMADFK "Zeitkonstante für Adaption des Verlustmoments Fahrstufe und Kompressor ein" VALUE 0x81F978 KwUw 816.00000000 zk200msxs_uw_b13107 3.2000000000 819.20000000 FORMAT "%12.8" /end CHARACTERISTIC
/begin CHARACTERISTIC ZKDMADFS "Zeitkonstante für Adaption des Verlustmoments Fahrstufe ein" VALUE 0x81F97A KwUw 816.00000000 zk200msxs_uw_b13107 3.2000000000 819.20000000 FORMAT "%12.8" /end CHARACTERISTIC
/begin CHARACTERISTIC ZKDMADKO "Zeitkonstante für Adaption des Verlustmoments Klimakompressor ein" VALUE 0x81F97C KwUw 816.00000000 zk200msxs_uw_b13107 3.2000000000 819.20000000 FORMAT "%12.8" /end CHARACTERISTIC
/begin CHARACTERISTIC ZKDMADLL "Zeitkonstante für Adaption des Verlustmoments ohne Last" VALUE 0x81F97E KwUw 816.00000000 zk200msxs_uw_b13107 3.2000000000 819.20000000 FORMAT "%12.8" /end CHARACTERISTIC
/begin CHARACTERISTIC ZKDMDW "Zeitkonstante für Abregelung D-Anteil Wandlermoment" VALUE 0x811416 KwUb 5.08000 zk20msxs_ub_b5p1 0.0200000 5.10000 FORMAT "%7.5" /end CHARACTERISTIC
/begin CHARACTERISTIC ZKDRLSOL "Zeitkonstante für drlsol-Integrator" VALUE 0x8153B2 KwUw 655.34999985 zk10msxs_uw_b655 0.010000152590 655.36000000 FORMAT "%12.8" /end CHARACTERISTIC
/begin CHARACTERISTIC ZKMDKO "Zeitkonstante Klimakompressor-Lastabregelung" VALUE 0x8114D1 KwUb 5.08000 zk20msxs_ub_b5p1 0.0200000 5.10000 FORMAT "%7.5" /end CHARACTERISTIC
/begin CHARACTERISTIC ZKMDSLP "Zeitkonstante zur Abregelung des Einschaltmomentes der Sek-Luftpumpe" VALUE 0x8114D2 KwUb 5.08000 zk20msxs_ub_b5p1 0.0200000 5.10000 FORMAT "%7.5" /end CHARACTERISTIC
/begin CHARACTERISTIC ZKMDWAB "Zeitkonstante für Abregelung der  Drehmomentaufnahme des Wandlers" VALUE 0x811417 KwUb 5.08000 zk20msxs_ub_b5p1 0.0200000 5.10000 FORMAT "%7.5" /end CHARACTERISTIC
/begin CHARACTERISTIC ZKMDWAUF "Zeitkonstante für Aufregelung der  Drehmomentaufnahme des Wandlers" VALUE 0x811418 KwUb 5.08000 zk20msxs_ub_b5p1 0.0200000 5.10000 FORMAT "%7.5" /end CHARACTERISTIC
/begin CHARACTERISTIC ZKMDWF "Zeitkonstante für Filterung Wandlermoment zur Bildung D-Anteil" VALUE 0x811419 KwUb 5.08000 zk20msxs_ub_b5p1 0.0200000 5.10000 FORMAT "%7.5" /end CHARACTERISTIC
/begin CHARACTERISTIC ZKUEVERG "Filterzeitkonstante: Turbinendrehzahl bei Gangwechsel" VALUE 0x81141A KwUb 5.08000 zk20msxs_ub_b5p1 0.0200000 5.10000 FORMAT "%7.5" /end CHARACTERISTIC
/begin CHARACTERISTIC ZLASHKAB "Zeitkonstante für Abregelung der dyn. Sollwertanhebung (dlasohkab) rin der LRHK" VALUE 0x816DCE KwUw 655.34999985 zk10msxs_uw_b655 0.010000152590 655.36000000 FORMAT "%12.8" /end CHARACTERISTIC
/begin CHARACTERISTIC ZLASOHML "Zeitkonstante für PT1-Filter des Pseudo-Lambda hinter Kat" CURVE 0x816DD0 KlAUwSstUwWUw 655.34999985 zk10msxs_uw_b655 0.010000152590 655.36000000 FORMAT "%12.8"
 /begin AXIS_DESCR STD_AXIS ml_w m_uw_b6553p5 8 0.00 6553.500 FORMAT "%8.3" DEPOSIT ABSOLUTE /end AXIS_DESCR
/end CHARACTERISTIC
/begin CHARACTERISTIC ZMDNSM "Zeitkonstante zur Abrgelung des Nachstart-Momentenoffset" CURVE 0x827C66 KlAUbSstUbWUw 3276.7499992 zk50msxs_uw_b3276p8 0.050000762951 3276.8000000 FORMAT "%12.7"
 /begin AXIS_DESCR STD_AXIS tmot temp_ub_q0p75_o48 8 -48.00 143.3 FORMAT "%5.1" DEPOSIT ABSOLUTE /end AXIS_DESCR
/end CHARACTERISTIC
/begin CHARACTERISTIC ZYLEAUS "auszublendender Zylinder" VALUE 0x8109D7 KwUb 255.0 dez 0.00 255.0 FORMAT "%5.1" /end CHARACTERISTIC
/begin MEASUREMENT anzeausb "Anzahl der auszublendenen Einspritzungen; begrenzt zwischen 4 und 7" UBYTE dez 1 100 0 255 FORMAT "%5.1" ECU_ADDRESS 0x380974 /end MEASUREMENT
/begin MEASUREMENT B_2ph "Bedingung, daß zweite Phasenflankeninformation vorliegt" UWORD B_TRUE 1 100 0 1 BIT_MASK 0x100 FORMAT "%13.11" ECU_ADDRESS 0xFD30 /end MEASUREMENT
/begin MEASUREMENT B_3ph "Bedingung, daß dritte Phasenflankeninformation vorliegt" UWORD B_TRUE 1 100 0 1 BIT_MASK 0x200 FORMAT "%13.11" ECU_ADDRESS 0xFD30 /end MEASUREMENT
/begin MEASUREMENT B_adwfk "Bedingung Adaptionswert Fahrstufe und Kompressor ein verwenden" UBYTE B_TRUE 1 100 0 1 BIT_MASK 0x10 FORMAT "%13.11" ECU_ADDRESS 0x380B0B /end MEASUREMENT
/begin MEASUREMENT B_adwfs "Bedingung Adaptionswert Fahrstufe ein verwenden" UBYTE B_TRUE 1 100 0 1 BIT_MASK 0x20 FORMAT "%13.11" ECU_ADDRESS 0x380B0B /end MEASUREMENT
/begin MEASUREMENT B_adwko "Bedingung Adaptionswert Klimakompressor ein verwenden" UBYTE B_TRUE 1 100 0 1 BIT_MASK 0x40 FORMAT "%13.11" ECU_ADDRESS 0x380B0B /end MEASUREMENT
/begin MEASUREMENT B_asr "Bedingung für ASR aktiv" UWORD B_TRUE 1 100 0 1 BIT_MASK 0x400 FORMAT "%13.11" ECU_ADDRESS 0xFD8C /end MEASUREMENT
/begin MEASUREMENT B_blrka "Bedingung gesteuertes Katalysator-Ausräumen angefordert" UWORD B_TRUE 1 100 0 1 BIT_MASK 0x400 FORMAT "%13.11" ECU_ADDRESS 0xFD9A /end MEASUREMENT
/begin MEASUREMENT B_brvfp "Bedingung Bremse betätigt vor Fahrpedal" UBYTE B_TRUE 1 100 0 1 BIT_MASK 0x1 FORMAT "%13.11" ECU_ADDRESS 0x380B3A /end MEASUREMENT
/begin MEASUREMENT B_dash "Bedingung: Dashpot-Änderungsbegrenzung aktiv" UWORD B_TRUE 1 100 0 1 BIT_MASK 0x8 FORMAT "%13.11" ECU_ADDRESS 0xFD8A /end MEASUREMENT
/begin MEASUREMENT B_dashv "Bedingung Dashpot verzögert" UWORD B_TRUE 1 100 0 1 BIT_MASK 0x10 FORMAT "%13.11" ECU_ADDRESS 0xFD8A /end MEASUREMENT
/begin MEASUREMENT B_delaysyn "Flag für eine Verzögerung um 1 Lücke zur Neusynchronisierung" UWORD B_TRUE 1 100 0 1 BIT_MASK 0x1 FORMAT "%13.11" ECU_ADDRESS 0xFD2C /end MEASUREMENT
/begin MEASUREMENT B_dlahini "Bedingung Intiliasierung Integralanteil LRSHK" UBYTE B_TRUE 1 100 0 1 BIT_MASK 0x4 FORMAT "%13.11" ECU_ADDRESS 0x380B84 /end MEASUREMENT
/begin MEASUREMENT B_dmrwan "Bedingung Aufbau Momentenreserve für Wandlermoment" UWORD B_TRUE 1 100 0 1 BIT_MASK 0x8000 FORMAT "%13.11" ECU_ADDRESS 0xFD84 /end MEASUREMENT
/begin MEASUREMENT B_dmverlin "Bedingung dmverl = 0" UWORD B_TRUE 1 100 0 1 BIT_MASK 0x40 FORMAT "%13.11" ECU_ADDRESS 0xFD8E /end MEASUREMENT
/begin MEASUREMENT B_dopzue "Bedingung doppelte Zündausgabe" UWORD B_TRUE 1 100 0 1 BIT_MASK 0x2 FORMAT "%13.11" ECU_ADDRESS 0xFD2C /end MEASUREMENT
/begin MEASUREMENT B_dp "Bedingung: Dashpotwert größer Fahrerwunsch (=1)" UWORD B_TRUE 1 100 0 1 BIT_MASK 0x80 FORMAT "%13.11" ECU_ADDRESS 0xFD8A /end MEASUREMENT
/begin MEASUREMENT B_edp "Bedingung Erlaubnis Dashpot" UWORD B_TRUE 1 100 0 1 BIT_MASK 0x100 FORMAT "%13.11" ECU_ADDRESS 0xFD8A /end MEASUREMENT
/begin MEASUREMENT B_elsd "Bedingung Erlaubnis Lastschlagdämpfung" UWORD B_TRUE 1 100 0 1 BIT_MASK 0x200 FORMAT "%13.11" ECU_ADDRESS 0xFD8A /end MEASUREMENT
/begin MEASUREMENT B_ensynnl "Freigabe der Synchronisation für Notlauf-Drehzahlgeber" UWORD B_TRUE 1 100 0 1 BIT_MASK 0x400 FORMAT "%13.11" ECU_ADDRESS 0xFD30 /end MEASUREMENT
/begin MEASUREMENT B_eobdlr "OBDII-Summenfehler. sperrt die LR" UWORD B_TRUE 1 100 0 1 BIT_MASK 0x100 FORMAT "%13.11" ECU_ADDRESS 0xFD98 /end MEASUREMENT
/begin MEASUREMENT B_fgr "Bedingung FGR (Tempomat) aktiv" UWORD B_TRUE 1 100 0 1 BIT_MASK 0x400 FORMAT "%13.11" ECU_ADDRESS 0xFD8A /end MEASUREMENT
/begin MEASUREMENT B_fil "Bedingung PT1-Filter für SAWE aktiv" UWORD B_TRUE 1 100 0 1 BIT_MASK 0x800 FORMAT "%13.11" ECU_ADDRESS 0xFD8A /end MEASUREMENT
/begin MEASUREMENT B_flrsres "Bedingung Regler-Resetierung in Abhängigkeit von B_lrsresf" UWORD B_TRUE 1 100 0 1 BIT_MASK 0x4000 FORMAT "%13.11" ECU_ADDRESS 0xFD96 /end MEASUREMENT
/begin MEASUREMENT B_frini "Bedingung Regelfaktor fr initialisieren" UWORD B_TRUE 1 100 0 1 BIT_MASK 0x100 FORMAT "%13.11" ECU_ADDRESS 0xFD9A /end MEASUREMENT
/begin MEASUREMENT B_frini2 "Bedingung Regelfaktor fr initialisieren, Bank 2" UWORD B_TRUE 1 100 0 1 BIT_MASK 0x200 FORMAT "%13.11" ECU_ADDRESS 0xFD9A /end MEASUREMENT
/begin MEASUREMENT B_frmax "Lambda-Regelung setzt Bit sobald FR am Anschlag FRMAX" UWORD B_TRUE 1 100 0 1 BIT_MASK 0x8000 FORMAT "%13.11" ECU_ADDRESS 0xFD96 /end MEASUREMENT
/begin MEASUREMENT B_frmin "Lambda-Regelung setzt Bit sobald FR am Anschlag FRMIN" UWORD B_TRUE 1 100 0 1 BIT_MASK 0x1 FORMAT "%13.11" ECU_ADDRESS 0xFD98 /end MEASUREMENT
/begin MEASUREMENT B_fsu "Bedingung Fahrstufe, Umschaltung" UWORD B_TRUE 1 100 0 1 BIT_MASK 0x1 FORMAT "%13.11" ECU_ADDRESS 0xFD86 /end MEASUREMENT
/begin MEASUREMENT B_gapnldg "Information über die Position der Lücke" UWORD B_TRUE 1 100 0 1 BIT_MASK 0x800 FORMAT "%13.11" ECU_ADDRESS 0xFD30 /end MEASUREMENT
/begin MEASUREMENT B_idecay "Bedingung Grenzwertreg. auf fettes Soll-Lambda mit Absteuern Integralanteil LRS" UWORD B_TRUE 1 100 0 1 BIT_MASK 0x2 FORMAT "%13.11" ECU_ADDRESS 0xFD98 /end MEASUREMENT
/begin MEASUREMENT B_iflsd "Bedingung Initialisierung Filter Lastschlagdämpfung" UWORD B_TRUE 1 100 0 1 BIT_MASK 0x1000 FORMAT "%13.11" ECU_ADDRESS 0xFD8A /end MEASUREMENT
/begin MEASUREMENT B_kllknl "Synchronisationsbedingung für zphflsyn=3 erfüllt" UWORD B_TRUE 1 100 0 1 BIT_MASK 0x1000 FORMAT "%13.11" ECU_ADDRESS 0xFD30 /end MEASUREMENT
/begin MEASUREMENT B_lelshbb "Fehler LS hinter Haupt Kat, der Betriebsbereitschaft zurücksetzt (lokal)" UBYTE B_TRUE 1 100 0 1 BIT_MASK 0x2 FORMAT "%13.11" ECU_ADDRESS 0x380B80 /end MEASUREMENT
/begin MEASUREMENT B_lelsubb "Fehler LSU, der Betriebsbereitschaft zurücksetzt (lokal)" UBYTE B_TRUE 1 100 0 1 BIT_MASK 0x4 FORMAT "%13.11" ECU_ADDRESS 0x380B80 /end MEASUREMENT
/begin MEASUREMENT B_lkklnl "Synchronisationsbedingung für zphflsyn=1 erfüllt" UWORD B_TRUE 1 100 0 1 BIT_MASK 0x2000 FORMAT "%13.11" ECU_ADDRESS 0xFD30 /end MEASUREMENT
/begin MEASUREMENT B_ll "Bedingung Leerlauf" UWORD B_TRUE 1 100 0 1 BIT_MASK 0x4000 FORMAT "%13.11" ECU_ADDRESS 0xFD8A /end MEASUREMENT
/begin MEASUREMENT B_lr "LREB: Bedingung Lambdaregelung (vor Kat); (Bank 1)" UWORD B_TRUE 1 100 0 1 BIT_MASK 0x200 FORMAT "%13.11" ECU_ADDRESS 0xFD98 /end MEASUREMENT
/begin MEASUREMENT B_lr2s "CARB FREEZE FRAME, Bank1 bit 1, LR: Regelbetrieb mit zwei Sonden" UBYTE B_TRUE 1 100 0 1 BIT_MASK 0x2 FORMAT "%13.11" ECU_ADDRESS 0x380B7F /end MEASUREMENT
/begin MEASUREMENT B_lrhbb "Bankunabhänginge Betriebsbereich abhängige Bedingung Freigabe I-Anteil" UBYTE B_TRUE 1 100 0 1 BIT_MASK 0x20 FORMAT "%13.11" ECU_ADDRESS 0x380B84 /end MEASUREMENT
/begin MEASUREMENT B_lrhk "Bedingung Lambdaregelung hinter Kat" UBYTE B_TRUE 1 100 0 1 BIT_MASK 0x4 FORMAT "%13.11" ECU_ADDRESS 0x380B83 /end MEASUREMENT
/begin MEASUREMENT B_lrhkb "Bedingung Lambdaregelung h. Kat, bankspez. Parameter Bank 1" UBYTE B_TRUE 1 100 0 1 BIT_MASK 0x8 FORMAT "%13.11" ECU_ADDRESS 0x380B84 /end MEASUREMENT
/begin MEASUREMENT B_lrhkg "bankunabhängige Bedingung Lambdaregelung hinter Kat" UBYTE B_TRUE 1 100 0 1 BIT_MASK 0x10 FORMAT "%13.11" ECU_ADDRESS 0x380B84 /end MEASUREMENT
/begin MEASUREMENT B_lrhkp "LRHK: Freigabebedingung P-Anteil Lambdaregelung hinter Kat" UBYTE B_TRUE 1 100 0 1 BIT_MASK 0x1 FORMAT "%13.11" ECU_ADDRESS 0x380B83 /end MEASUREMENT
/begin MEASUREMENT B_lrka "Bedingung Katalysator-Ausräumen" UWORD B_TRUE 1 100 0 1 BIT_MASK 0x800 FORMAT "%13.11" ECU_ADDRESS 0xFD9A /end MEASUREMENT
/begin MEASUREMENT B_lrkae "Bedingung gesteuertes Katalysator-Ausräumen möglich" UWORD B_TRUE 1 100 0 1 BIT_MASK 0x1000 FORMAT "%13.11" ECU_ADDRESS 0xFD9A /end MEASUREMENT
/begin MEASUREMENT B_lrmsbrc "Bit Bereitschaft zum Reset bei Magerschutz" UBYTE B_TRUE 1 100 0 1 BIT_MASK 0x1 FORMAT "%13.11" ECU_ADDRESS 0x380B7D /end MEASUREMENT
/begin MEASUREMENT B_lrmsbs "Bedingung Abmagerungsverbot für stetige Regelung, Bank 1" UWORD B_TRUE 1 100 0 1 BIT_MASK 0x400 FORMAT "%13.11" ECU_ADDRESS 0xFD98 /end MEASUREMENT
/begin MEASUREMENT B_lrnda "LR Bank1 aktiv bei Bedingungen : B_lrpspa & B_lrkasn & !E_obdlr" UWORD B_TRUE 1 100 0 1 BIT_MASK 0x800 FORMAT "%13.11" ECU_ADDRESS 0xFD98 /end MEASUREMENT
/begin MEASUREMENT B_lrrl "LREB: Von Last abhängige Bedingung Lambdaregelung (vor Kat)" UWORD B_TRUE 1 100 0 1 BIT_MASK 0x1000 FORMAT "%13.11" ECU_ADDRESS 0xFD98 /end MEASUREMENT
/begin MEASUREMENT B_lrs "LRSEB: Bedingung Lambdaregelung intern (vor Kat), Bank 1" UWORD B_TRUE 1 100 0 1 BIT_MASK 0x2000 FORMAT "%13.11" ECU_ADDRESS 0xFD98 /end MEASUREMENT
/begin MEASUREMENT B_lrsrems "Bedingung fr-reset bei Abmagerungsverbot für Bank 1" UWORD B_TRUE 1 100 0 1 BIT_MASK 0x4 FORMAT "%13.11" ECU_ADDRESS 0xFD98 /end MEASUREMENT
/begin MEASUREMENT B_lrsresf "Bedingung Fr-Reset bei lamsons<LALIUSMN" UWORD B_TRUE 1 100 0 1 BIT_MASK 0x4000 FORMAT "%13.11" ECU_ADDRESS 0xFD98 /end MEASUREMENT
/begin MEASUREMENT B_lrssa "LRSEB: Einschaltbed. für Lambdareg. nach Schub bei langsamer Sonde" UWORD B_TRUE 1 100 0 1 BIT_MASK 0x8000 FORMAT "%13.11" ECU_ADDRESS 0xFD98 /end MEASUREMENT
/begin MEASUREMENT B_lrssp "Lamda-Regelung setzt Bit, wenn Zusatzamplitude Vorzeichenwechsel" UWORD B_TRUE 1 100 0 1 BIT_MASK 0x8 FORMAT "%13.11" ECU_ADDRESS 0xFD98 /end MEASUREMENT
/begin MEASUREMENT B_lrvk "CARB FREEZE FRAME, Bank1 Bit 4, LR: Regelung nur mit einer Sonde (vor KAT)" UBYTE B_TRUE 1 100 0 1 BIT_MASK 0x10 FORMAT "%13.11" ECU_ADDRESS 0x380B7F /end MEASUREMENT
/begin MEASUREMENT B_ls "Bedingung: Lastschlagbegrenzung kleiner Fahrerwunsch (=1)" UWORD B_TRUE 1 100 0 1 BIT_MASK 0x2 FORMAT "%13.11" ECU_ADDRESS 0xFD8C /end MEASUREMENT
/begin MEASUREMENT B_lsd "Bedingung: Pos. Lastschlagdämpfung aktiv" UWORD B_TRUE 1 100 0 1 BIT_MASK 0x4 FORMAT "%13.11" ECU_ADDRESS 0xFD8C /end MEASUREMENT
/begin MEASUREMENT B_madfk "Bedingung Momentenadaption Fahrstufe und Klimakompressor ein" UBYTE B_TRUE 1 100 0 1 BIT_MASK 0x1 FORMAT "%13.11" ECU_ADDRESS 0x380B0B /end MEASUREMENT
/begin MEASUREMENT B_madfs "Bedingung Momentenadaption Fahrstufe ein" UBYTE B_TRUE 1 100 0 1 BIT_MASK 0x2 FORMAT "%13.11" ECU_ADDRESS 0x380B0B /end MEASUREMENT
/begin MEASUREMENT B_madko "Bedingung Momentenadaption Klimakompressor ein" UBYTE B_TRUE 1 100 0 1 BIT_MASK 0x4 FORMAT "%13.11" ECU_ADDRESS 0x380B0B /end MEASUREMENT
/begin MEASUREMENT B_madll "Bedingung Momentenadaption ohne Last" UBYTE B_TRUE 1 100 0 1 BIT_MASK 0x8 FORMAT "%13.11" ECU_ADDRESS 0x380B0B /end MEASUREMENT
/begin MEASUREMENT B_mdee "Bedingung Momentenreduzierung über Einspritzausblendung erlaubt" UWORD B_TRUE 1 100 0 1 BIT_MASK 0x800 FORMAT "%13.11" ECU_ADDRESS 0xFD8E /end MEASUREMENT
/begin MEASUREMENT B_mdein "Bedingung Momenteneingriff aktiv" UWORD B_TRUE 1 100 0 1 BIT_MASK 0x800 FORMAT "%13.11" ECU_ADDRESS 0xFD8C /end MEASUREMENT
/begin MEASUREMENT B_mdmin "Bedingung minimal erreichbares indiziertes Moment erreicht" UWORD B_TRUE 1 100 0 1 BIT_MASK 0x80 FORMAT "%13.11" ECU_ADDRESS 0xFD58 /end MEASUREMENT
/begin MEASUREMENT B_mdmxzu "Bedingung maximales Moment zulässig" UBYTE B_TRUE 1 100 0 1 BIT_MASK 0x10 FORMAT "%13.11" ECU_ADDRESS 0x380B36 /end MEASUREMENT
/begin MEASUREMENT B_mdnstab "Bedingung Drehzahlstabilisierung aktiv" UWORD B_TRUE 1 100 0 1 BIT_MASK 0x4 FORMAT "%13.11" ECU_ADDRESS 0xFD86 /end MEASUREMENT
/begin MEASUREMENT B_mdredhyein "" UWORD B_TRUE 1 100 0 1 BIT_MASK 0x1000 FORMAT "%13.11" ECU_ADDRESS 0xFD8E /end MEASUREMENT
/begin MEASUREMENT B_mgbgakt "Bedingung Momentengradientenbegrenzung aktiv" UWORD B_TRUE 1 100 0 1 BIT_MASK 0x10 FORMAT "%13.11" ECU_ADDRESS 0xFD8C /end MEASUREMENT
/begin MEASUREMENT B_mibeg "Bedingung Momentenbegrenzung ist aktiv" UWORD B_TRUE 1 100 0 1 BIT_MASK 0x1000 FORMAT "%13.11" ECU_ADDRESS 0xFD8C /end MEASUREMENT
/begin MEASUREMENT B_mibegl "Bedingung Momentenbegrenzung Füllungspfad aktiv" UWORD B_TRUE 1 100 0 1 BIT_MASK 0x10 FORMAT "%13.11" ECU_ADDRESS 0xFD8E /end MEASUREMENT
/begin MEASUREMENT B_mifabg "Bedingung Begrenzung mifa" UWORD B_TRUE 1 100 0 1 BIT_MASK 0x20 FORMAT "%13.11" ECU_ADDRESS 0xFD8C /end MEASUREMENT
/begin MEASUREMENT B_mkbrmx "Bedingung Kupplungsmomentbegrenzung bei betätigter Bremse aktiv" UBYTE B_TRUE 1 100 0 1 BIT_MASK 0x2 FORMAT "%13.11" ECU_ADDRESS 0x380B3A /end MEASUREMENT
/begin MEASUREMENT B_mlevab "Bit Lambdaregelung bei/nach Zylinderausblendung" UWORD B_TRUE 1 100 0 1 BIT_MASK 0x1 FORMAT "%13.11" ECU_ADDRESS 0xFD9A /end MEASUREMENT
/begin MEASUREMENT B_mlnka "Bedingung Luftmassenschwelle nach Kat-Ausräumen überschritten; (Bank 1)" UBYTE B_TRUE 1 100 0 1 BIT_MASK 0x2 FORMAT "%13.11" ECU_ADDRESS 0x380B84 /end MEASUREMENT
/begin MEASUREMENT B_mlrsa "LRSEB: Ausschaltbed. für Lambdareg. auf bei und nach Schub über Luftmassenschw." UWORD B_TRUE 1 100 0 1 BIT_MASK 0x2 FORMAT "%13.11" ECU_ADDRESS 0xFD9A /end MEASUREMENT
/begin MEASUREMENT B_mrakt "Bedingung: Momentenreserve aktiv" UWORD B_TRUE 1 100 0 1 BIT_MASK 0x20 FORMAT "%13.11" ECU_ADDRESS 0xFD8E /end MEASUREMENT
/begin MEASUREMENT B_mrpfa "Bedingung Nullsetzen von mrped_w wegen allgemeiner Drehzahlanhebung" UBYTE B_TRUE 1 100 0 1 BIT_MASK 0x1 FORMAT "%13.11" ECU_ADDRESS 0x380B20 /end MEASUREMENT
/begin MEASUREMENT B_msr "Bedingung für Momentenschlupfregelung" UWORD B_TRUE 1 100 0 1 BIT_MASK 0x2000 FORMAT "%13.11" ECU_ADDRESS 0xFD8C /end MEASUREMENT
/begin MEASUREMENT B_mzns "Nachstartaufweitung des zul. Moments aktiv" UBYTE B_TRUE 1 100 0 1 BIT_MASK 0x2 FORMAT "%13.11" ECU_ADDRESS 0x380B36 /end MEASUREMENT
/begin MEASUREMENT B_nachl "Steuerung SG-Nachlauf" UWORD B_TRUE 1 100 0 1 BIT_MASK 0x8000 FORMAT "%13.11" ECU_ADDRESS 0x383AA6 /end MEASUREMENT
/begin MEASUREMENT B_nachlend "Bedingung SG-Nachlauf regulär beendet" UWORD B_TRUE 1 100 0 1 BIT_MASK 0x4000 FORMAT "%13.11" ECU_ADDRESS 0x383AA6 /end MEASUREMENT
/begin MEASUREMENT B_nachlram "Steuerung SG-Nachlauf mit Systemcheck" UWORD B_TRUE 1 100 0 1 BIT_MASK 0x8000 FORMAT "%13.11" ECU_ADDRESS 0xFD8E /end MEASUREMENT
/begin MEASUREMENT B_nachlstp "Bedingung SG-Nachlauf beendet" UWORD B_TRUE 1 100 0 1 BIT_MASK 0x2000 FORMAT "%13.11" ECU_ADDRESS 0x383AA6 /end MEASUREMENT
/begin MEASUREMENT B_nekati "lokales Flag für  Sperre  I-Anteil durch DKAT-Fehler gemäß CLRSHKEB" UBYTE B_TRUE 1 100 0 1 BIT_MASK 0x1 FORMAT "%13.11" ECU_ADDRESS 0x380B84 /end MEASUREMENT
/begin MEASUREMENT B_nlacls "Anforderung Steuergerätenachlauf von AC-Lüftersteuerung" UWORD B_TRUE 1 100 0 1 BIT_MASK 0x2 FORMAT "%13.11" ECU_ADDRESS 0x383AA6 /end MEASUREMENT
/begin MEASUREMENT B_nlale "Anforderung Steuergerätenachlauf von Funktion ALE" UWORD B_TRUE 1 100 0 1 BIT_MASK 0x1 FORMAT "%13.11" ECU_ADDRESS 0x383AA6 /end MEASUREMENT
/begin MEASUREMENT B_nlatm "Anforderung Steuergerätenachlauf für Abgastemp.Modell Sondenschutz" UWORD B_TRUE 1 100 0 1 BIT_MASK 0x800 FORMAT "%13.11" ECU_ADDRESS 0x383AA6 /end MEASUREMENT
/begin MEASUREMENT B_nlcan "Bedingung für SG-Nachlauf von CAN" UWORD B_TRUE 1 100 0 1 BIT_MASK 0x200 FORMAT "%13.11" ECU_ADDRESS 0x383AA6 /end MEASUREMENT
/begin MEASUREMENT B_nldtafx "Bedingung Anforderung Steuergerätenachlauf für TANS-Diagnose / Stuck-Sign.-Check" UWORD B_TRUE 1 100 0 1 BIT_MASK 0x8 FORMAT "%13.11" ECU_ADDRESS 0x383AA4 /end MEASUREMENT
/begin MEASUREMENT B_nldte "Anforderung Steuergerätenachlauf Diagnose Tankentlüftung" UWORD B_TRUE 1 100 0 1 BIT_MASK 0x100 FORMAT "%13.11" ECU_ADDRESS 0x383AA6 /end MEASUREMENT
/begin MEASUREMENT B_nldval "Anforderung Steuergeräte Nachlauf wegen DVAL (Validierung)" UWORD B_TRUE 1 100 0 1 BIT_MASK 0x1 FORMAT "%13.11" ECU_ADDRESS 0x383AA4 /end MEASUREMENT
/begin MEASUREMENT B_nldve "Anforderung Steuergerätenachlauf von DVE" UWORD B_TRUE 1 100 0 1 BIT_MASK 0x1000 FORMAT "%13.11" ECU_ADDRESS 0x383AA6 /end MEASUREMENT
/begin MEASUREMENT B_nlEEPR "Bedingung Nachlauf EEPROM schreiben" UWORD B_TRUE 1 100 0 1 BIT_MASK 0x20 FORMAT "%13.11" ECU_ADDRESS 0x383AA6 /end MEASUREMENT
/begin MEASUREMENT B_nletm "Bedingung Nachlauf tmot-Fehler" UWORD B_TRUE 1 100 0 1 BIT_MASK 0x4 FORMAT "%13.11" ECU_ADDRESS 0x383AA4 /end MEASUREMENT
/begin MEASUREMENT B_nlmls "Anforderung Steuergerätenachlauf von Motor-Lüftersteuerung" UWORD B_TRUE 1 100 0 1 BIT_MASK 0x8 FORMAT "%13.11" ECU_ADDRESS 0x383AA6 /end MEASUREMENT
/begin MEASUREMENT B_nlobd "Anforderung Steuergerätenachlauf von OBD" UWORD B_TRUE 1 100 0 1 BIT_MASK 0x10 FORMAT "%13.11" ECU_ADDRESS 0x383AA6 /end MEASUREMENT
/begin MEASUREMENT B_nlph "Bedingung kein Phasensignal von den Phasengebern" UWORD B_TRUE 1 100 0 1 BIT_MASK 0x4 FORMAT "%13.11" ECU_ADDRESS 0xFD2C /end MEASUREMENT
/begin MEASUREMENT B_nlsgls "Anforderung Steuergerätenachlauf von Steuergeräte-Lüftersteuerung" UWORD B_TRUE 1 100 0 1 BIT_MASK 0x40 FORMAT "%13.11" ECU_ADDRESS 0x383AA6 /end MEASUREMENT
/begin MEASUREMENT B_nlsiko "Bedingung Nachlauf EGAS-Überwachung" UWORD B_TRUE 1 100 0 1 BIT_MASK 0x80 FORMAT "%13.11" ECU_ADDRESS 0x383AA6 /end MEASUREMENT
/begin MEASUREMENT B_nlubr "Bedingung Anforderung Steuergerätenachlauf für UBR-Diagnose" UWORD B_TRUE 1 100 0 1 BIT_MASK 0x2 FORMAT "%13.11" ECU_ADDRESS 0x383AA4 /end MEASUREMENT
/begin MEASUREMENT B_nlwfs "SG-Bedingung SG-Nachlauf durch Wegfahrsperrensteuergerät" UWORD B_TRUE 1 100 0 1 BIT_MASK 0x400 FORMAT "%13.11" ECU_ADDRESS 0x383AA6 /end MEASUREMENT
/begin MEASUREMENT B_nlwst "Anforderung Steuergerätenachlauf für Wiederholstarterkennung" UWORD B_TRUE 1 100 0 1 BIT_MASK 0x4 FORMAT "%13.11" ECU_ADDRESS 0x383AA6 /end MEASUREMENT
/begin MEASUREMENT B_noknldg "Drehzahl ist in zulässigem Fenster für Synchronisation im Notlauf" UWORD B_TRUE 1 100 0 1 BIT_MASK 0x4000 FORMAT "%13.11" ECU_ADDRESS 0xFD30 /end MEASUREMENT
/begin MEASUREMENT B_nolrb "CARB FREEZE FRAME, Bank1 Bit 2, LR: Steuerbetrieb durch Betriebsbedingungen" UBYTE B_TRUE 1 100 0 1 BIT_MASK 0x4 FORMAT "%13.11" ECU_ADDRESS 0x380B7F /end MEASUREMENT
/begin MEASUREMENT B_nolre "CARB FREEZE FRAME, Bank1 Bit 3, LR: Steuerung nach Systemfehler" UBYTE B_TRUE 1 100 0 1 BIT_MASK 0x8 FORMAT "%13.11" ECU_ADDRESS 0x380B7F /end MEASUREMENT
/begin MEASUREMENT B_nolrw "CARB FREEZE FRAME, Bank1 Bit 0, LR: Steuerbetrieb, Startbed. noch nicht erfüllt" UBYTE B_TRUE 1 100 0 1 BIT_MASK 0x1 FORMAT "%13.11" ECU_ADDRESS 0x380B7F /end MEASUREMENT
/begin MEASUREMENT B_nosynph "Flag für falsche Zylinderzuordnung bei Synchronisierlücke" UWORD B_TRUE 1 100 0 1 BIT_MASK 0x8 FORMAT "%13.11" ECU_ADDRESS 0xFD2C /end MEASUREMENT
/begin MEASUREMENT B_nozwe "Bedingung kein Zündwinkeleingriff der Drehmomentstruktur" UWORD B_TRUE 1 100 0 1 BIT_MASK 0x10 FORMAT "%13.11" ECU_ADDRESS 0xFDA4 /end MEASUREMENT
/begin MEASUREMENT B_nsakt "Nachstart aktiv für Nachstartaufweitung" UBYTE B_TRUE 1 100 0 1 BIT_MASK 0x4 FORMAT "%13.11" ECU_ADDRESS 0x380B36 /end MEASUREMENT
/begin MEASUREMENT B_nsend "Nachstartüberwachungszeit abgelaufen" UBYTE B_TRUE 1 100 0 1 BIT_MASK 0x8 FORMAT "%13.11" ECU_ADDRESS 0x380B36 /end MEASUREMENT
/begin MEASUREMENT B_optpherk "Bedingung geeigneter Motorbetriebszustand für Phasenerkennung" UWORD B_TRUE 1 100 0 1 BIT_MASK 0x10 FORMAT "%13.11" ECU_ADDRESS 0xFD2C /end MEASUREMENT
/begin MEASUREMENT B_phfalse "SW generierte Phasenpegelinformation ist unplausibel" UWORD B_TRUE 1 100 0 1 BIT_MASK 0x8000 FORMAT "%13.11" ECU_ADDRESS 0xFD30 /end MEASUREMENT
/begin MEASUREMENT B_phnegtiv "Bedingung gibt an, ob der Interrupt von einer negativen Flanke ausgelöst wurde" UWORD B_TRUE 1 100 0 1 BIT_MASK 0x1 FORMAT "%13.11" ECU_ADDRESS 0xFD32 /end MEASUREMENT
/begin MEASUREMENT B_phnldg "Phasenlage aus Notlauf DG" UWORD B_TRUE 1 100 0 1 BIT_MASK 0x2 FORMAT "%13.11" ECU_ADDRESS 0xFD32 /end MEASUREMENT
/begin MEASUREMENT B_phsnl "Bedingung Phasensuche während PG-Notlauf" UWORD B_TRUE 1 100 0 1 BIT_MASK 0x20 FORMAT "%13.11" ECU_ADDRESS 0xFD2C /end MEASUREMENT
/begin MEASUREMENT B_phsnlab "Bedingung Phasensuche während PG-Notlauf abgeschlossen" UWORD B_TRUE 1 100 0 1 BIT_MASK 0x40 FORMAT "%13.11" ECU_ADDRESS 0xFD2C /end MEASUREMENT
/begin MEASUREMENT B_phsnlinv "Bedingung Phaselage invertieren" UWORD B_TRUE 1 100 0 1 BIT_MASK 0x80 FORMAT "%13.11" ECU_ADDRESS 0xFD2C /end MEASUREMENT
/begin MEASUREMENT B_phsnlok "Bedingung Phasensuche während PG-Notlauf erfolgreich" UWORD B_TRUE 1 100 0 1 BIT_MASK 0x100 FORMAT "%13.11" ECU_ADDRESS 0xFD2C /end MEASUREMENT
/begin MEASUREMENT B_pspaus "Bedingung LR inaktiv bei projektspez. AUS-Bedingungen" UWORD B_TRUE 1 100 0 1 BIT_MASK 0x4 FORMAT "%13.11" ECU_ADDRESS 0xFD9A /end MEASUREMENT
/begin MEASUREMENT B_pspwl "Bedingung LR inaktiv bei projektspez. Warmlauf-Bedingungen" UWORD B_TRUE 1 100 0 1 BIT_MASK 0x8 FORMAT "%13.11" ECU_ADDRESS 0xFD9A /end MEASUREMENT
/begin MEASUREMENT B_resetsyn "Rücksetzbedingung für die Notlaufsynchronisation" UWORD B_TRUE 1 100 0 1 BIT_MASK 0x4 FORMAT "%13.11" ECU_ADDRESS 0xFD32 /end MEASUREMENT
/begin MEASUREMENT B_rgang "Bedingung Rückwärtsgang eingelegt" UWORD B_TRUE 1 100 0 1 BIT_MASK 0x2 FORMAT "%13.11" ECU_ADDRESS 0xFD86 /end MEASUREMENT
/begin MEASUREMENT B_rphsp "Bedingung für Zahnsignale zu schnell ausgegeben" UWORD B_TRUE 1 100 0 1 BIT_MASK 0x8 FORMAT "%13.11" ECU_ADDRESS 0xFD32 /end MEASUREMENT
/begin MEASUREMENT B_sa "Bedingung Schubabschalten" UWORD B_TRUE 1 100 0 1 BIT_MASK 0x2000 FORMAT "%13.11" ECU_ADDRESS 0xFD8E /end MEASUREMENT
/begin MEASUREMENT B_slspaus "Sekundärluft-spezifisches Sperrbit für Lambdaregelung" UWORD B_TRUE 1 100 0 1 BIT_MASK 0x10 FORMAT "%13.11" ECU_ADDRESS 0xFD9A /end MEASUREMENT
/begin MEASUREMENT B_stimnlph "Aussetzer stimuliert durch NLPH" UWORD B_TRUE 1 100 0 1 BIT_MASK 0x200 FORMAT "%13.11" ECU_ADDRESS 0xFD2C /end MEASUREMENT
/begin MEASUREMENT B_synnldg "Bedingung: Motorposition im Notlauf DG aus PG-Signal erkannt" UWORD B_TRUE 1 100 0 1 BIT_MASK 0x10 FORMAT "%13.11" ECU_ADDRESS 0xFD32 /end MEASUREMENT
/begin MEASUREMENT B_synoknl "Synchronisation für den Notlauf ist erlaubt" UWORD B_TRUE 1 100 0 1 BIT_MASK 0x20 FORMAT "%13.11" ECU_ADDRESS 0xFD32 /end MEASUREMENT
/begin MEASUREMENT B_tarau "LREB: Bedingung Start bei niedrigen Ansauglufttemperaturen" UWORD B_TRUE 1 100 0 1 BIT_MASK 0x20 FORMAT "%13.11" ECU_ADDRESS 0xFD9A /end MEASUREMENT
/begin MEASUREMENT B_tdmlsds "Bedingung Zeit nach Kupplungsbetätigung mit veränderter LSD-Auslösung" UWORD B_TRUE 1 100 0 1 BIT_MASK 0x100 FORMAT "%13.11" ECU_ADDRESS 0xFD8C /end MEASUREMENT
/begin MEASUREMENT B_tmlr "LREB: Von Motortemp. abhängige Bedingungen Lambdaregelung (vor Kat)" UWORD B_TRUE 1 100 0 1 BIT_MASK 0x40 FORMAT "%13.11" ECU_ADDRESS 0xFD9A /end MEASUREMENT
/begin MEASUREMENT B_update "B_update = false    kein Update der Zustandsgroessen in der LRS" UWORD B_TRUE 1 100 0 1 BIT_MASK 0x10 FORMAT "%13.11" ECU_ADDRESS 0xFD98 /end MEASUREMENT
/begin MEASUREMENT B_vl "Bedingung Vollast" UWORD B_TRUE 1 100 0 1 BIT_MASK 0x200 FORMAT "%13.11" ECU_ADDRESS 0xFD8C /end MEASUREMENT
/begin MEASUREMENT B_vsspaus "Ventilverstellung-spezifisches Sperrbit für Lambdaregelung" UWORD B_TRUE 1 100 0 1 BIT_MASK 0x80 FORMAT "%13.11" ECU_ADDRESS 0xFD9A /end MEASUREMENT
/begin MEASUREMENT B_wnwioutx "Bedingung für unplausiblen Winkelfehler" UWORD B_TRUE 1 100 0 1 BIT_MASK 0x40 FORMAT "%13.11" ECU_ADDRESS 0xFD32 /end MEASUREMENT
/begin MEASUREMENT B_y2max "Integralanteil der LRS hat obere Schranke erreicht" UWORD B_TRUE 1 100 0 1 BIT_MASK 0x20 FORMAT "%13.11" ECU_ADDRESS 0xFD98 /end MEASUREMENT
/begin MEASUREMENT B_y2min "Integralanteil der LRS hat untere Schranke erreicht" UWORD B_TRUE 1 100 0 1 BIT_MASK 0x40 FORMAT "%13.11" ECU_ADDRESS 0xFD98 /end MEASUREMENT
/begin MEASUREMENT B_za "Bedingung Zwangsamplitude" UWORD B_TRUE 1 100 0 1 BIT_MASK 0x80 FORMAT "%13.11" ECU_ADDRESS 0xFD98 /end MEASUREMENT
/begin MEASUREMENT B_zwget "Zündwinkeleingriff durch Getriebeeingriff" UWORD B_TRUE 1 100 0 1 BIT_MASK 0x4000 FORMAT "%13.11" ECU_ADDRESS 0xFD8C /end MEASUREMENT
/begin MEASUREMENT B_zwnget "Zündwinkeleingriff nicht durch Getriebeeingriff" UWORD B_TRUE 1 100 0 1 BIT_MASK 0x8000 FORMAT "%13.11" ECU_ADDRESS 0xFD8C /end MEASUREMENT
/begin MEASUREMENT B_zwvs "Bedingung für schnellen äußeren ZW-Eingriff der Momentenschnittstelle" UWORD B_TRUE 1 100 0 1 BIT_MASK 0x1 FORMAT "%13.11" ECU_ADDRESS 0xFD8E /end MEASUREMENT
/begin MEASUREMENT B_zwvz "Bedingung für Zündwinkeleingriff der Momentenschnittstelle" UWORD B_TRUE 1 100 0 1 BIT_MASK 0x2 FORMAT "%13.11" ECU_ADDRESS 0xFD8E /end MEASUREMENT
/begin MEASUREMENT B_zwvzm "" UWORD B_TRUE 1 100 0 1 BIT_MASK 0x20 FORMAT "%13.11" ECU_ADDRESS 0xFDA4 /end MEASUREMENT
/begin MEASUREMENT B_zwvzvb "Bedingung für Zündwinkeleingriff der Momentenschnittstelle vor Begrenzung" UWORD B_TRUE 1 100 0 1 BIT_MASK 0x4 FORMAT "%13.11" ECU_ADDRESS 0xFD8E /end MEASUREMENT
/begin MEASUREMENT cmibeg_w "Zähler aktiver Begrenzungen des inneren Moments" UWORD dez 1 100 0 65535 FORMAT "%8.2" ECU_ADDRESS 0x383AA2 /end MEASUREMENT
/begin MEASUREMENT dfrmin_w "Untergrenze von dfr_w bei Abmagerungsverbot (B_lrms=true)" SWORD fak_sw_b1 1 100 -1 0.999969 FORMAT "%8.6" ECU_ADDRESS 0x382922 /end MEASUREMENT
/begin MEASUREMENT dfrmn_w "Untergrenze von dfr_w" SWORD fak_sw_b1 1 100 -1 0.999969 FORMAT "%8.6" ECU_ADDRESS 0x382924 /end MEASUREMENT
/begin MEASUREMENT dfrpr_w "Delta Lambdaregler (Faktor); vorläufiger Wert vor Abfrage auf Magerschutz" SWORD fak_sw_b1 1 100 -1 0.999969 FORMAT "%8.6" ECU_ADDRESS 0x382926 /end MEASUREMENT
/begin MEASUREMENT dfrzaff_w "Zusatzamplitude gefiltert auf fr-Ebene" SWORD fak_sw_b1 1 100 -1 0.999969 FORMAT "%8.6" ECU_ADDRESS 0x382928 /end MEASUREMENT
/begin MEASUREMENT dfrzaf_w "LRS-Zwangsamplitude, gefiltert" SWORD fak_sw_b1 1 100 -1 0.999969 FORMAT "%8.6" ECU_ADDRESS 0x38292A /end MEASUREMENT
/begin MEASUREMENT dfrzapr_w "Gesteuerte Rechteckschwingung für Zwangsamplitude" SWORD fak_sw_b1 1 100 -1 0.999969 FORMAT "%8.6" ECU_ADDRESS 0x38292C /end MEASUREMENT
/begin MEASUREMENT dfrza_w "LRS-Zwangsamplitude" SWORD fak_sw_b1 1 100 -1 0.999969 FORMAT "%8.6" ECU_ADDRESS 0x38292E /end MEASUREMENT
/begin MEASUREMENT dfr_w "Delta Lambdaregler (Faktor )" SWORD fak_sw_b1 1 100 -1 0.999969 FORMAT "%8.6" ECU_ADDRESS 0x382930 /end MEASUREMENT
/begin MEASUREMENT dlahini_w "Intialisierungswert für Integralanteil LRSHK" SWORD fak_sw_b1 1 100 -1 0.999969 FORMAT "%8.6" ECU_ADDRESS 0x38535C /end MEASUREMENT
/begin MEASUREMENT dlahi_w "I-Anteil der stetigen LRHK" SWORD fak_sw_b1 1 100 -1 0.999969 FORMAT "%8.6" ECU_ADDRESS 0x385368 /end MEASUREMENT
/begin MEASUREMENT dlahkab_w "Dynamische Überhöhung des Pseudo Lambda-Sollwertes hinter Kat" SWORD fak_sw_b1 1 100 -1 0.999969 FORMAT "%8.6" ECU_ADDRESS 0x3829D2 /end MEASUREMENT
/begin MEASUREMENT dlahp_w "P-Anteil der stetigen LRHK" SWORD fak_sw_b1 1 100 -1 0.999969 FORMAT "%8.6" ECU_ADDRESS 0x38535E /end MEASUREMENT
/begin MEASUREMENT dlashki_w "Delta-Lambda gewichtet für I-Anteil LRSHK" SWORD fak_sw_b1 1 100 -1 0.999969 FORMAT "%8.6" ECU_ADDRESS 0x385360 /end MEASUREMENT
/begin MEASUREMENT dlashkm_w "Delta-Lambda aus Lambdaregelung hinter Kat (Ist-Wert fr-synchron gemittelt)" SWORD fak_sw_b1 1 100 -1 0.999969 FORMAT "%8.6" ECU_ADDRESS 0x385362 /end MEASUREMENT
/begin MEASUREMENT dlashkp_w "Delta-Lambda gewichtet für P-Anteil LRSHK5.30" SWORD fak_sw_b1 1 100 -1 0.999969 FORMAT "%8.6" ECU_ADDRESS 0x385364 /end MEASUREMENT
/begin MEASUREMENT dlaso "Korrekturwert Lambda-Sollwert für stetigen Lambdaregler, 8 Bit" SBYTE fak_sb_b0p03125 1 100 -0.03125 0.0310059 FORMAT "%7.5" ECU_ADDRESS 0x380B7B /end MEASUREMENT
/begin MEASUREMENT dlsd_w "Dämpfung PT2-Filter in Lastschlagdämpfung" UWORD fak_uw_b2 1 100 0 1.99997 FORMAT "%8.6" ECU_ADDRESS 0x382616 /end MEASUREMENT
/begin MEASUREMENT dlwsl_w "berechnete Lenkwinkelgeschwindigkeit" SWORD dlw_sw_q0p04375 1 100 -1434.04 1434 FORMAT "%8.3" ECU_ADDRESS 0x384C50 /end MEASUREMENT
/begin MEASUREMENT dlwsu_w "Lenkwinkelgeschwindigkeit" SWORD dlw_sw_q0p04375 1 100 -1434.04 1434 FORMAT "%8.3" ECU_ADDRESS 0x384C52 /end MEASUREMENT
/begin MEASUREMENT dmaufr_w "Delta Aufregelmoment" UWORD rel_uw_b100 1 100 0 99.9985 FORMAT "%8.5" ECU_ADDRESS 0x382C0E /end MEASUREMENT
/begin MEASUREMENT dmbebl_w "Delta-Moment für Auslösung Lastschlagdämpfung" UWORD rel_uw_b100 1 100 0 99.9985 FORMAT "%8.5" ECU_ADDRESS 0x382618 /end MEASUREMENT
/begin MEASUREMENT dmdpo_w "delta Moment Dashpot-Ausloesung" UWORD rel_uw_b100 1 100 0 99.9985 FORMAT "%8.5" ECU_ADDRESS 0x38261A /end MEASUREMENT
/begin MEASUREMENT dmdpu_w "delta Moment Dashpot-Ende" UWORD rel_uw_b100 1 100 0 99.9985 FORMAT "%8.5" ECU_ADDRESS 0x38261C /end MEASUREMENT
/begin MEASUREMENT dmdwan_w "" UWORD rel_uw_b200 1 100 0 199.997 FORMAT "%8.4" ECU_ADDRESS 0x382566 /end MEASUREMENT
/begin MEASUREMENT dmgbeg_w "Delta-Moment für Gradientenbegrenzung" UWORD rel_uw_b100 1 100 0 99.9985 FORMAT "%8.5" ECU_ADDRESS 0x38261E /end MEASUREMENT
/begin MEASUREMENT dmlms_w "Abstand des Sollmoments vom zulässigen Moment für Füllungspfad" SWORD rel_sw_b100 1 100 -100 99.9969 FORMAT "%8.4" ECU_ADDRESS 0x38268A /end MEASUREMENT
/begin MEASUREMENT dmlsdo_w "Delta Moment Auslösung Lastschlagdämpfung" UWORD rel_uw_b100 1 100 0 99.9985 FORMAT "%8.5" ECU_ADDRESS 0x382620 /end MEASUREMENT
/begin MEASUREMENT dmlsdu_w "Delta Moment Ende Lastschlagdämpfung" UWORD rel_uw_b100 1 100 0 99.9985 FORMAT "%8.5" ECU_ADDRESS 0x382622 /end MEASUREMENT
/begin MEASUREMENT dmrac "Reservemoment für AC-Kompressor" UBYTE rel_ub_b99p6 1 100 0 99.6094 FORMAT "%5.2" ECU_ADDRESS 0x380B10 /end MEASUREMENT
/begin MEASUREMENT dmrfawe_w "Schwelle mrfa-Gradient für Deaktivierung PT1-Filter beim Wiedereinsetzen" UWORD rel_uw_b200 1 100 0 199.997 FORMAT "%8.4" ECU_ADDRESS 0x382624 /end MEASUREMENT
/begin MEASUREMENT dmrkt_w "Momentenreserve im Kurztrip" UWORD rel_uw_b100 1 100 0 99.9985 FORMAT "%8.5" ECU_ADDRESS 0x384C92 /end MEASUREMENT
/begin MEASUREMENT dmrlf "Momentreserve für Lüfter" UBYTE rel_ub_b99p6 1 100 0 99.6094 FORMAT "%5.2" ECU_ADDRESS 0x3848E5 /end MEASUREMENT
/begin MEASUREMENT dmrmx_w "Delta-Moment Füllung durch Momentenreserve" UWORD rel_uw_b100 1 100 0 99.9985 FORMAT "%8.5" ECU_ADDRESS 0x38268C /end MEASUREMENT
/begin MEASUREMENT dmrwan "Momentreserve für Drehmomentaufnahme des Wandlers" UBYTE rel_ub_b99p6 1 100 0 99.6094 FORMAT "%5.2" ECU_ADDRESS 0x380B0C /end MEASUREMENT
/begin MEASUREMENT dmvadfk_w "Delta-Motordrehmoment aus Verlustmoment-Adaption (B_fs=1 & B_ko=1)" SWORD rel_sw_b100 1 100 -100 99.9969 FORMAT "%8.4" ECU_ADDRESS 0x38404E /end MEASUREMENT
/begin MEASUREMENT dmvadfs_w "Delta-Motordrehmoment aus Verlustmoment-Adaption (B_fs=1)" SWORD rel_sw_b100 1 100 -100 99.9969 FORMAT "%8.4" ECU_ADDRESS 0x384050 /end MEASUREMENT
/begin MEASUREMENT dmvadko_w "Delta-Motordrehmoment aus Verlustmoment-Adaption (B_ko=1)" SWORD rel_sw_b100 1 100 -100 99.9969 FORMAT "%8.4" ECU_ADDRESS 0x384052 /end MEASUREMENT
/begin MEASUREMENT dmvadll_w "Delta-Motordrehmoment aus Verlustmoment-Adaption (B_ll=1)" SWORD rel_sw_b100 1 100 -100 99.9969 FORMAT "%8.4" ECU_ADDRESS 0x384054 /end MEASUREMENT
/begin MEASUREMENT dmvad_w "Delta-Motordrehmoment aus Verlustmoment-Adaption" SWORD rel_sw_b100 1 100 -100 99.9969 FORMAT "%8.4" ECU_ADDRESS 0x384C3A /end MEASUREMENT
/begin MEASUREMENT dmvamnfk_w "Minimalbegrenzung der Verlustmomentadaption (B_fs=1 & B_ko=1)" SWORD rel_sw_b100 1 100 -100 99.9969 FORMAT "%8.4" ECU_ADDRESS 0x384C3C /end MEASUREMENT
/begin MEASUREMENT dmvamnfs_w "Minimalbegrenzung der Verlustmomentadaption (B_fs=1)" SWORD rel_sw_b100 1 100 -100 99.9969 FORMAT "%8.4" ECU_ADDRESS 0x384C3E /end MEASUREMENT
/begin MEASUREMENT dmvamnko_w "Minimalbegrenzung der Verlustmomentadaption (B_ko=1)" SWORD rel_sw_b100 1 100 -100 99.9969 FORMAT "%8.4" ECU_ADDRESS 0x384C40 /end MEASUREMENT
/begin MEASUREMENT dmvamnll_w "Minimalbegrenzung der Verlustmomentadaption (B_ll=1)" SWORD rel_sw_b100 1 100 -100 99.9969 FORMAT "%8.4" ECU_ADDRESS 0x384C42 /end MEASUREMENT
/begin MEASUREMENT dmvamxfk_w "0aximalbegrenzung der Verlustmomentadaption (B_fs=1 & B_ko=1)" SWORD rel_sw_b100 1 100 -100 99.9969 FORMAT "%8.4" ECU_ADDRESS 0x384C44 /end MEASUREMENT
/begin MEASUREMENT dmvamxfs_w "Maximalbegrenzung der Verlustmomentadaption (B_fs=1)" SWORD rel_sw_b100 1 100 -100 99.9969 FORMAT "%8.4" ECU_ADDRESS 0x384C46 /end MEASUREMENT
/begin MEASUREMENT dmvamxko_w "Maximalbegrenzung der Verlustmomentadaption (B_ko=1)" SWORD rel_sw_b100 1 100 -100 99.9969 FORMAT "%8.4" ECU_ADDRESS 0x384C48 /end MEASUREMENT
/begin MEASUREMENT dmvamxll_w "Maximalbegrenzung der Verlustmomentadaption (B_ll=1)" SWORD rel_sw_b100 1 100 -100 99.9969 FORMAT "%8.4" ECU_ADDRESS 0x384C4A /end MEASUREMENT
/begin MEASUREMENT dmverl_w "Verlustmoment nach DT1-Filter" SWORD rel_sw_b100 1 100 -100 99.9969 FORMAT "%8.4" ECU_ADDRESS 0x3826A6 /end MEASUREMENT
/begin MEASUREMENT dmzms_w "Abstand des indizierten Sollmoments vom zulässigen Sollmoment" SWORD rel_sw_b100 1 100 -100 99.9969 FORMAT "%8.4" ECU_ADDRESS 0x382674 /end MEASUREMENT
/begin MEASUREMENT dnturb_w "Turbinendrehzahldifferenz des Wandlers" SWORD nmot_q0p125 1 100 -4096 4095.88 FORMAT "%8.3" ECU_ADDRESS 0x382568 /end MEASUREMENT
/begin MEASUREMENT drlsolf_w "gefilterte Änderung Sollfüllung" SWORD rel_sw_q0p0234 1 100 -768 767.977 FORMAT "%8.4" ECU_ADDRESS 0x381FCA /end MEASUREMENT
/begin MEASUREMENT drlsol_w "Änderung Sollfüllung" SWORD rel_sw_q0p0234 1 100 -768 767.977 FORMAT "%8.4" ECU_ADDRESS 0x381FCC /end MEASUREMENT
/begin MEASUREMENT dtsegph_w "Faktor zur Bewertung der Motordynamik" SWORD t5usxus_q5 1 100 -163840 163835 FORMAT "%8.1" ECU_ADDRESS 0x381AA0 /end MEASUREMENT
/begin MEASUREMENT dzwb "Differenz BasisZW optimaler Zündwinkel" SBYTE zw_sb_q0p75 1 100 -96 95.25 FORMAT "%5.2" ECU_ADDRESS 0x380B24 /end MEASUREMENT
/begin MEASUREMENT dzwi "Delta Zündwinkel zwischen zwopt und zwout" SBYTE zw_sb_q0p75 1 100 -96 95.25 FORMAT "%5.2" ECU_ADDRESS 0x380B2F /end MEASUREMENT
/begin MEASUREMENT dzwoag "abgasrückführratenabh. Zündwinkelkorrektur des optimalen ZW" SBYTE zw_sb_q0p75 1 100 -96 95.25 FORMAT "%5.2" ECU_ADDRESS 0x380B25 /end MEASUREMENT
/begin MEASUREMENT dzwol "lambdaabh. Zündwinkelkorrektur des optimalen ZW" SBYTE zw_sb_q0p75 1 100 -96 95.25 FORMAT "%5.2" ECU_ADDRESS 0x380B26 /end MEASUREMENT
/begin MEASUREMENT dzwotm "temperaturabhängige Zündwinkelkorrektur des optimalen ZW" SBYTE zw_sb_q0p75 1 100 -96 95.25 FORMAT "%5.2" ECU_ADDRESS 0x380B27 /end MEASUREMENT
/begin MEASUREMENT dzws "Delta Zündwinekl zwischen zwopt und zwsol" SBYTE zw_sb_q0p75 1 100 -96 95.25 FORMAT "%5.2" ECU_ADDRESS 0x380BCE /end MEASUREMENT
/begin MEASUREMENT dzw_kge "Eingang Delta-Zündwinkel für mehrfach verwendete Kenngrößen" SBYTE zw_sb_q0p75 1 100 -96 95.25 FORMAT "%5.2" ECU_ADDRESS 0x380B28 /end MEASUREMENT
/begin MEASUREMENT esst_smo08opub "" UWORD dez 1 100 0 65535 FORMAT "%8.2" ECU_ADDRESS 0x3826E6 /end MEASUREMENT
/begin MEASUREMENT esst_snm06koub "" UWORD dez 1 100 0 65535 FORMAT "%8.2" ECU_ADDRESS 0x384C54 /end MEASUREMENT
/begin MEASUREMENT esst_snm12mduw "" UWORD dez 1 100 0 65535 FORMAT "%8.2" ECU_ADDRESS 0x382626 /end MEASUREMENT
/begin MEASUREMENT esst_srl06koub "" UWORD dez 1 100 0 65535 FORMAT "%8.2" ECU_ADDRESS 0x384C56 /end MEASUREMENT
/begin MEASUREMENT esst_srl11opuw "" UWORD dez 1 100 0 65535 FORMAT "%8.2" ECU_ADDRESS 0x382696 /end MEASUREMENT
/begin MEASUREMENT esst_sta06llub "" UWORD dez 1 100 0 65535 FORMAT "%8.2" ECU_ADDRESS 0x384C58 /end MEASUREMENT
/begin MEASUREMENT esst_swp16mduw "" UWORD dez 1 100 0 65535 FORMAT "%8.2" ECU_ADDRESS 0x382628 /end MEASUREMENT
/begin MEASUREMENT etalab "Lambda-Wirkungsgrad ohne Eingriff bezogen auf optimales Moment bei Lambda=1" UBYTE rel_ub_b127p5 1 100 0 127.5 FORMAT "%5.1" ECU_ADDRESS 0x380B29 /end MEASUREMENT
/begin MEASUREMENT etatrmn "minimaler Wert in der Wirkungsgradtrommel" UBYTE rel_ub_b127p5 1 100 0 127.5 FORMAT "%5.1" ECU_ADDRESS 0x380B2A /end MEASUREMENT
/begin MEASUREMENT etazaist "Ist-Zylinderausblendungswirkungsgrad" UBYTE rel_ub_b127p5 1 100 0 127.5 FORMAT "%5.1" ECU_ADDRESS 0x380B30 /end MEASUREMENT
/begin MEASUREMENT etazwb "Zündwinkelwirkungsgrad des Basiszündwinkels" UBYTE rel_ub_b127p5 1 100 0 127.5 FORMAT "%5.1" ECU_ADDRESS 0x380B2B /end MEASUREMENT
/begin MEASUREMENT etazwbm "gemittelter Zündwinkelwirkungsgrad des Basiszündwinkels" UBYTE rel_ub_b127p5 1 100 0 127.5 FORMAT "%5.1" ECU_ADDRESS 0x380B2C /end MEASUREMENT
/begin MEASUREMENT etazwist "Ist-Zündwinkelwirkungsgrad" UBYTE rel_ub_b127p5 1 100 0 127.5 FORMAT "%5.1" ECU_ADDRESS 0x380B31 /end MEASUREMENT
/begin MEASUREMENT etazws "Sollzündwinkelwirkungsgrad" UBYTE rel_ub_b127p5 1 100 0 127.5 FORMAT "%5.1" ECU_ADDRESS 0x380BCF /end MEASUREMENT
/begin MEASUREMENT fkfped "Faktor für Interpolation zwischen den beiden Pedalkennfeldern" UBYTE fak_ub_b2 1 100 0 1.99219 FORMAT "%5.3" ECU_ADDRESS 0x380B1F /end MEASUREMENT
/begin MEASUREMENT flglrs "CARB FREEZE FRAME Byte, Bank 1, für LR" UBYTE dez 1 100 0 255 FORMAT "%5.1" ECU_ADDRESS 0x380B7F /end MEASUREMENT
/begin MEASUREMENT fnstabzu_w "Zulässiger Faktor zur Drehzahlstabilisierung" UWORD fak_uw_b8 1 100 0 7.99988 FORMAT "%8.6" ECU_ADDRESS 0x3826E8 /end MEASUREMENT
/begin MEASUREMENT fnstab_w "Faktor zur Stabilisierung mittels Drehzahlquotient" UWORD fak_uw_b8 1 100 0 7.99988 FORMAT "%8.6" ECU_ADDRESS 0x384C4C /end MEASUREMENT
/begin MEASUREMENT frini2_w "Initialisierungswert für Regelfaktor Lambdaregelung, Bank 2" UWORD fak_uw_b2 1 100 0 1.99997 FORMAT "%8.6" ECU_ADDRESS 0x3829F2 /end MEASUREMENT
/begin MEASUREMENT frini_w "Initialisierungswert für Regelfaktor Lambdaregelung" UWORD fak_uw_b2 1 100 0 1.99997 FORMAT "%8.6" ECU_ADDRESS 0x3829F4 /end MEASUREMENT
/begin MEASUREMENT frmn_w "Lambda-Regler-Ausgang Minimalwert" UWORD fak_uw_b2 1 100 0 1.99997 FORMAT "%8.6" ECU_ADDRESS 0x382932 /end MEASUREMENT
/begin MEASUREMENT frmx_w "LR mit Integratorstop : Max. Begrenzung Integrator fr,; FRMAX / angehoben d.DSLS" UWORD fak_uw_b2 1 100 0 1.99997 FORMAT "%8.6" ECU_ADDRESS 0x382934 /end MEASUREMENT
/begin MEASUREMENT frm_w "schneller Mittelwert des Lambdaregelfaktors (Word)" UWORD fak_uw_b2 1 100 0 1.99997 FORMAT "%8.6" ECU_ADDRESS 0x382936 /end MEASUREMENT
/begin MEASUREMENT froza_w "Lambda-Regler-Ausgang ohne Zwangsanregung" UWORD fak_uw_b2 1 100 0 1.99997 FORMAT "%8.6" ECU_ADDRESS 0x382938 /end MEASUREMENT
/begin MEASUREMENT frtmki "Regelfaktor für Momentenbegrenzung aus Motortemperatur" UBYTE fak_ub_b2 1 100 0 1.99219 FORMAT "%5.3" ECU_ADDRESS 0x3848F1 /end MEASUREMENT
/begin MEASUREMENT fr_w "Lambda-Regler-Ausgang (Word)" UWORD fak_uw_b2 1 100 0 1.99997 FORMAT "%8.6" ECU_ADDRESS 0x38293A /end MEASUREMENT
/begin MEASUREMENT fwmifal "Überhöhungsfaktor Füllungspfad bei Lastschlagdämpfung" UBYTE fak_ub_b4 1 100 0 3.98438 FORMAT "%5.3" ECU_ADDRESS 0x3848EB /end MEASUREMENT
/begin MEASUREMENT fwzlsd "Reduktionsfaktor Zeitkonstante Lastschlagdämpfung" UBYTE fak_ub_b4 1 100 0 3.98438 FORMAT "%5.3" ECU_ADDRESS 0x3848EC /end MEASUREMENT
/begin MEASUREMENT fzdash "Faktor Zeitkonstante Dashpot" UBYTE rfak_q0p5 1 100 0.501961 128 FORMAT "%5.1" ECU_ADDRESS 0x3848ED /end MEASUREMENT
/begin MEASUREMENT g1korr "Korrekturfaktor für Reglerparameter G1" UBYTE fak_ub_b2 1 100 0 1.99219 FORMAT "%5.3" ECU_ADDRESS 0x380B7C /end MEASUREMENT
/begin MEASUREMENT ilmlkav_w "Gewichteter Integrator Fettfläche nach Ende Ausräumen Vorkat" UWORD m_uw_b4660 1 100 0 4660.27 FORMAT "%8.3" ECU_ADDRESS 0x3829F6 /end MEASUREMENT
/begin MEASUREMENT ilmlkax_w "Fettflächenschwelle gesteuertes Kat-Ausräumen f(tkatm), Bank 1" UWORD m_uw_b4660 1 100 0 4660.27 FORMAT "%8.3" ECU_ADDRESS 0x3829F8 /end MEASUREMENT
/begin MEASUREMENT ilmlka_w "Integrator Fettfläche für Katalysator-Ausräumen" UWORD m_uw_b4660 1 100 0 4660.27 FORMAT "%8.3" ECU_ADDRESS 0x3829FA /end MEASUREMENT
/begin MEASUREMENT imlevab_w "Luftmasse nach Zylinderausblendung für stetige Lambdaregelung" UWORD m_uw_b4660 1 100 0 4660.27 FORMAT "%8.3" ECU_ADDRESS 0x3829B4 /end MEASUREMENT
/begin MEASUREMENT imlrsa_w "Luftmasse nach SA für stetige Lambdaregelung" UWORD m_uw_b4660 1 100 0 4660.27 FORMAT "%8.3" ECU_ADDRESS 0x3829B6 /end MEASUREMENT
/begin MEASUREMENT kfmds_w "Schleppmoment Drehzahl- und Lastabhängigkeit                     |" UWORD rel_uw_b100 1 100 0 99.9985 FORMAT "%8.5" ECU_ADDRESS 0x384C66 /end MEASUREMENT
/begin MEASUREMENT ladiff_w "Regelabweichung Lambda" SWORD fak_sw_b1 1 100 -1 0.999969 FORMAT "%8.6" ECU_ADDRESS 0x38293C /end MEASUREMENT
/begin MEASUREMENT lahkmz "Zustandsbyte des Automaten: fr-synchrone Mittelung Pseodo-Lambda hinter Kat" UBYTE dez 1 100 0 255 FORMAT "%5.1" ECU_ADDRESS 0x380B82 /end MEASUREMENT
/begin MEASUREMENT lamhf_w "Pseudolinearisietes Lambda hinter Kat, PT1-gefiltert, Word" UWORD fak_uw_b16 1 100 0 15.9998 FORMAT "%8.5" ECU_ADDRESS 0x3829D4 /end MEASUREMENT
/begin MEASUREMENT lamhm_w "fr-synchron gemittelter Pseudo Lambda-Istwert gem. mit Nernst-Sonde h.Kat, Word" UWORD fak_uw_b16 1 100 0 15.9998 FORMAT "%8.5" ECU_ADDRESS 0x3829D6 /end MEASUREMENT
/begin MEASUREMENT lamka_w "Lambdasollwert Katausräumen" UWORD fak_uw_b16 1 100 0 15.9998 FORMAT "%8.5" ECU_ADDRESS 0x38536A /end MEASUREMENT
/begin MEASUREMENT lamsbgt_w "Lambdasoll bezogen auf Brennraum, totzeitverschoben" UWORD fak_uw_b16 1 100 0 15.9998 FORMAT "%8.5" ECU_ADDRESS 0x38293E /end MEASUREMENT
/begin MEASUREMENT lamsbpr_w "Lambda-Soll-Wert vor Begrenzung nach unten" UWORD fak_uw_b16 1 100 0 15.9998 FORMAT "%8.5" ECU_ADDRESS 0x382940 /end MEASUREMENT
/begin MEASUREMENT lamsolh_w "Pseudo Lambda-Sollwert hinter Kat" UWORD fak_uw_b16 1 100 0 15.9998 FORMAT "%8.5" ECU_ADDRESS 0x3829D8 /end MEASUREMENT
/begin MEASUREMENT lamsonh_w "Pseudo Lambda-Istwert gemessen mit Nernst-Sonde hinter Kat (word)" UWORD fak_uw_b16 1 100 0 15.9998 FORMAT "%8.5" ECU_ADDRESS 0x3829DA /end MEASUREMENT
/begin MEASUREMENT lamzak_w "Lambdasondenistwert, korrigiert um Zusatzamplitude" UWORD fak_uw_b16 1 100 0 15.9998 FORMAT "%8.5" ECU_ADDRESS 0x382942 /end MEASUREMENT
/begin MEASUREMENT lamzapr_w "Lambda-Ist-Wert bereinigt um Zwangsamplitude vor Begrenzung nach unten" UWORD fak_uw_b16 1 100 0 15.9998 FORMAT "%8.5" ECU_ADDRESS 0x382944 /end MEASUREMENT
/begin MEASUREMENT lrkaz "Zustandsbyte des Automaten Kat-Ausräumen" UBYTE dez 1 100 0 255 FORMAT "%5.1" ECU_ADDRESS 0x380B85 /end MEASUREMENT
/begin MEASUREMENT lrsg1_w "Interner Reglerkoeffizient stetige Lambdaregelung" SWORD fak_sw_b32 1 100 -32 31.999 FORMAT "%8.5" ECU_ADDRESS 0x382946 /end MEASUREMENT
/begin MEASUREMENT lrsg2_w "Interner Reglerkoeffizient stetige Lambdaregelung" UWORD fak_uw_b64 1 100 0 63.999 FORMAT "%8.5" ECU_ADDRESS 0x382948 /end MEASUREMENT
/begin MEASUREMENT lrsg4_w "Interner Reglerkoeffizient stetige Lambdaregelung" SWORD fak_sw_b2 1 100 -2 1.99994 FORMAT "%8.6" ECU_ADDRESS 0x38294A /end MEASUREMENT
/begin MEASUREMENT lrsp1_w "Interner Reglerkoeffizient stetige Lambdaregelung" UWORD fak_uw_b128 1 100 0 127.998 FORMAT "%8.4" ECU_ADDRESS 0x38294C /end MEASUREMENT
/begin MEASUREMENT lrsp2_w "Interner Reglerkoeffizient stetige Lambdaregelung" UWORD fak_uw_b128 1 100 0 127.998 FORMAT "%8.4" ECU_ADDRESS 0x38294E /end MEASUREMENT
/begin MEASUREMENT lrsp3_w "Interner Reglerkoeffizient stetige Lambdaregelung" UWORD fak_uw_b128 1 100 0 127.998 FORMAT "%8.4" ECU_ADDRESS 0x382950 /end MEASUREMENT
/begin MEASUREMENT lrsp4_w "Interner Reglerkoeffizient stetige Lambdaregelung" SWORD fak_sw_b64 1 100 -64 63.998 FORMAT "%8.5" ECU_ADDRESS 0x382952 /end MEASUREMENT
/begin MEASUREMENT lrsw1_w "Interner Reglerzustand stetige Lambdaregelung" SWORD fak_sw_b4 1 100 -4 3.99988 FORMAT "%8.6" ECU_ADDRESS 0x382954 /end MEASUREMENT
/begin MEASUREMENT lrsw2_w "Interner Reglerzustand stetige Lambdaregelung" SWORD fak_sw_b4 1 100 -4 3.99988 FORMAT "%8.6" ECU_ADDRESS 0x382956 /end MEASUREMENT
/begin MEASUREMENT lrsxk1_w "Interner Reglerzustand stetige Lambdaregelung" SWORD fak_sw_b1 1 100 -1 0.999969 FORMAT "%8.6" ECU_ADDRESS 0x382958 /end MEASUREMENT
/begin MEASUREMENT lrsxk3_w "Interner Reglerzustand stetige Lambdaregelung" SWORD fak_sw_b1 1 100 -1 0.999969 FORMAT "%8.6" ECU_ADDRESS 0x38295A /end MEASUREMENT
/begin MEASUREMENT lrsxk4_w "Interner Reglerzustand stetige Lambdaregelung" SWORD fak_sw_b1 1 100 -1 0.999969 FORMAT "%8.6" ECU_ADDRESS 0x38295C /end MEASUREMENT
/begin MEASUREMENT lrsy2_w "Interner Reglerzustand stetige Lambdaregelung" SWORD fak_sw_b1 1 100 -1 0.999969 FORMAT "%8.6" ECU_ADDRESS 0x38295E /end MEASUREMENT
/begin MEASUREMENT lrsy4_w "Interner Reglerzustand stetige Lambdaregelung" SWORD fak_sw_b8 1 100 -8 7.99976 FORMAT "%8.6" ECU_ADDRESS 0x382960 /end MEASUREMENT
/begin MEASUREMENT lrsza "Amplitude erzwungener Lambdamodulation" UBYTE fak_ub_b0p25 1 100 0 0.249023 FORMAT "%11.9" ECU_ADDRESS 0x3848F3 /end MEASUREMENT
/begin MEASUREMENT lws "Lenkwinkel" SBYTE lw_sb_q11p2 1 100 -1445.29 1434 FORMAT "%5.0" ECU_ADDRESS 0x380B11 /end MEASUREMENT
/begin MEASUREMENT mdatxm_w "Drehmomentaufnahme des Wandlers bei B_fs = false" UWORD rel_uw_b200 1 100 0 199.997 FORMAT "%8.4" ECU_ADDRESS 0x38256A /end MEASUREMENT
/begin MEASUREMENT MDBGRGlokbits "" UBYTE dez 1 100 0 255 FORMAT "%5.1" ECU_ADDRESS 0x380B3A /end MEASUREMENT
/begin MEASUREMENT mddlws_w "Lastmoment abhängig vom Lenkwinkelgradient" SWORD rel_uw_b100 1 100 -50 49.9985 FORMAT "%8.5" ECU_ADDRESS 0x384C5A /end MEASUREMENT
/begin MEASUREMENT MDFAWlokbits "" UBYTE dez 1 100 0 255 FORMAT "%5.1" ECU_ADDRESS 0x380B20 /end MEASUREMENT
/begin MEASUREMENT mdfaw_bits "Flagbyte für %MDFAW" UBYTE dez 1 100 0 255 FORMAT "%5.1" ECU_ADDRESS 0x380B21 /end MEASUREMENT
/begin MEASUREMENT mdgen "Momentenaufnahme Generator" UBYTE rel_ub_b99p6 1 100 0 99.6094 FORMAT "%5.2" ECU_ADDRESS 0x380B12 /end MEASUREMENT
/begin MEASUREMENT mdindg_w "indiziertes Motormoment Hochdruckphase wenn alle Zylinder befeuert" UWORD rel_uw_b100 1 100 0 99.9985 FORMAT "%8.5" ECU_ADDRESS 0x3826BA /end MEASUREMENT
/begin MEASUREMENT mdko "Momentenaufnahme Klimakompressor" UBYTE rel_ub_b99p6 1 100 0 99.6094 FORMAT "%5.2" ECU_ADDRESS 0x380B13 /end MEASUREMENT
/begin MEASUREMENT mdkoini "Kompressormoment beim Einschalten" UBYTE rel_ub_b99p6 1 100 0 99.6094 FORMAT "%5.2" ECU_ADDRESS 0x3848E6 /end MEASUREMENT
/begin MEASUREMENT mdlfs "Momentenaufnahme des Motorlüfters" UBYTE rel_ub_b99p6 1 100 0 99.6094 FORMAT "%5.2" ECU_ADDRESS 0x3848E7 /end MEASUREMENT
/begin MEASUREMENT mdlws_w "Lastmoment abhängig vom Lenkwinkel" UWORD rel_uw_b100 1 100 0 99.9985 FORMAT "%8.5" ECU_ADDRESS 0x384C5C /end MEASUREMENT
/begin MEASUREMENT mdns_w "Nachstartmoment" UWORD rel_uw_b100 1 100 0 99.9985 FORMAT "%8.5" ECU_ADDRESS 0x3826A8 /end MEASUREMENT
/begin MEASUREMENT mdslpf "Momentenaufnahme der Sekundärluftpumpe" UBYTE rel_ub_b99p6 1 100 0 99.6094 FORMAT "%5.2" ECU_ADDRESS 0x380B14 /end MEASUREMENT
/begin MEASUREMENT mdsm_w "Schleppmoment Temperatur-Anteil" UWORD rel_uw_b100 1 100 0 99.9985 FORMAT "%8.5" ECU_ADDRESS 0x384C68 /end MEASUREMENT
/begin MEASUREMENT mdswl "Verbrauchermoment: Servolenkung" UBYTE rel_ub_b99p6 1 100 0 99.6094 FORMAT "%5.2" ECU_ADDRESS 0x380B15 /end MEASUREMENT
/begin MEASUREMENT mds_w "Motorschleppmoment" UWORD rel_uw_b100 1 100 0 99.9985 FORMAT "%8.5" ECU_ADDRESS 0x3826AA /end MEASUREMENT
/begin MEASUREMENT MDVERADlokbits "" UBYTE dez 1 100 0 255 FORMAT "%5.1" ECU_ADDRESS 0x380B0B /end MEASUREMENT
/begin MEASUREMENT mdverb "Momentenbedarf der Nebenaggregate" UBYTE rel_ub_b99p6 1 100 0 99.6094 FORMAT "%5.2" ECU_ADDRESS 0x380B16 /end MEASUREMENT
/begin MEASUREMENT mdverbad_w "Momentenbedarf der Nebenaggregate und der Verlustmomentadaption" SWORD rel_sw_b100 1 100 -100 99.9969 FORMAT "%8.4" ECU_ADDRESS 0x3826EA /end MEASUREMENT
/begin MEASUREMENT mdverbmx_w "Maximales Motor-Verlustmoment" SWORD rel_sw_b100 1 100 -100 99.9969 FORMAT "%8.4" ECU_ADDRESS 0x3826EC /end MEASUREMENT
/begin MEASUREMENT mdverbzu_w "Zulässiger Momentenbedarf der Nebenaggregate" SWORD rel_sw_b100 1 100 -100 99.9969 FORMAT "%8.4" ECU_ADDRESS 0x3826EE /end MEASUREMENT
/begin MEASUREMENT mdverf_w "Gefiltertes Verlustmoment" UWORD rel_uw_b100 1 100 0 99.9985 FORMAT "%8.5" ECU_ADDRESS 0x3826AC /end MEASUREMENT
/begin MEASUREMENT mdverl_w "Motor-Verlustmoment" UWORD rel_uw_b100 1 100 0 99.9985 FORMAT "%8.5" ECU_ADDRESS 0x3826AE /end MEASUREMENT
/begin MEASUREMENT mdvervf_w "ungefiltertes Verlustmoment" SWORD rel_sw_b100 1 100 -100 99.9969 FORMAT "%8.4" ECU_ADDRESS 0x3826B0 /end MEASUREMENT
/begin MEASUREMENT mdwanvf_w "Drehmomentaufnahme des Wandlers vor Filterung" UWORD rel_uw_b200 1 100 0 199.997 FORMAT "%8.4" ECU_ADDRESS 0x38256C /end MEASUREMENT
/begin MEASUREMENT mdwan_w "Drehmomentaufnahme des Wandlers" UWORD rel_uw_b200 1 100 0 199.997 FORMAT "%8.4" ECU_ADDRESS 0x38256E /end MEASUREMENT
/begin MEASUREMENT MDZULbits "" UBYTE dez 1 100 0 255 FORMAT "%5.1" ECU_ADDRESS 0x380B36 /end MEASUREMENT
/begin MEASUREMENT miatbgr_w "Momentenbegrenzung bei zu hoher Abgastemperatur" UWORD rel_uw_b100 1 100 0 99.9985 FORMAT "%8.5" ECU_ADDRESS 0x384C84 /end MEASUREMENT
/begin MEASUREMENT miautget_w "Motormoment ohne Getriebeeingriff" UWORD rel_uw_b100 1 100 0 99.9985 FORMAT "%8.5" ECU_ADDRESS 0x382708 /end MEASUREMENT
/begin MEASUREMENT miautgs_w "Motorsollmoment ohne Getriebeeingriff" UWORD rel_uw_b100 1 100 0 99.9985 FORMAT "%8.5" ECU_ADDRESS 0x38270A /end MEASUREMENT
/begin MEASUREMENT mibas_w "indiziertes Basis-Moment" UWORD rel_uw_b100 1 100 0 99.9985 FORMAT "%8.5" ECU_ADDRESS 0x382698 /end MEASUREMENT
/begin MEASUREMENT mibdp_w "indiziertes Soll-Motormoment Dashpot" UWORD rel_uw_b100 1 100 0 99.9985 FORMAT "%8.5" ECU_ADDRESS 0x38262A /end MEASUREMENT
/begin MEASUREMENT mibeg_w "Begrenzungsmoment" UWORD rel_uw_b100 1 100 0 99.9985 FORMAT "%8.5" ECU_ADDRESS 0x382676 /end MEASUREMENT
/begin MEASUREMENT mibgrg_w "gangabhängige Momentenbegrenzung" UWORD rel_uw_b100 1 100 0 99.9985 FORMAT "%8.5" ECU_ADDRESS 0x384C86 /end MEASUREMENT
/begin MEASUREMENT mibgrl_w "indiziertes soll-Moment für Momentbegrenzung Luftpfad" UWORD rel_uw_b100 1 100 0 99.9985 FORMAT "%8.5" ECU_ADDRESS 0x384C88 /end MEASUREMENT
/begin MEASUREMENT mibgr_w "indiziertes soll-Moment für gangabhängige Kupplungsmomentbegrenzung" UWORD rel_uw_b100 1 100 0 99.9985 FORMAT "%8.5" ECU_ADDRESS 0x384C8A /end MEASUREMENT
/begin MEASUREMENT miblsd_w "Begrenztes indiziertes Moment aus Lastschlagdämpfung" UWORD rel_uw_b100 1 100 0 99.9985 FORMAT "%8.5" ECU_ADDRESS 0x38262C /end MEASUREMENT
/begin MEASUREMENT mibrmx_w "Maximal zulässiges Moment bei betätigter Bremse" UWORD rel_uw_b100 1 100 0 99.9985 FORMAT "%8.5" ECU_ADDRESS 0x384C8C /end MEASUREMENT
/begin MEASUREMENT miekpbgr_w "Momentenbegrenzung durch Ausfall EKP" UWORD rel_uw_b100 1 100 0 99.9985 FORMAT "%8.5" ECU_ADDRESS 0x384C8E /end MEASUREMENT
/begin MEASUREMENT miextv_w "von extern gefordertes Moment vor Abwürgeschutz" UWORD rel_uw_b100 1 100 0 99.9985 FORMAT "%8.5" ECU_ADDRESS 0x382678 /end MEASUREMENT
/begin MEASUREMENT miext_w "von außen (ASR, GS, usw.) angefordertes indiziertes Motormoment" UWORD rel_uw_b100 1 100 0 99.9985 FORMAT "%8.5" ECU_ADDRESS 0x38267A /end MEASUREMENT
/begin MEASUREMENT mifa "indiziertes Motormoment Fahrerwunsch" UBYTE rel_ub_b99p6 1 100 0 99.6094 FORMAT "%5.2" ECU_ADDRESS 0x380B22 /end MEASUREMENT
/begin MEASUREMENT mifabg_w "Gradientenbegrenztes Fahrerwunschmoment" UWORD rel_uw_b100 1 100 0 99.9985 FORMAT "%8.5" ECU_ADDRESS 0x38262E /end MEASUREMENT
/begin MEASUREMENT mifab_w "Begrenztes indiziertes Fahrerwunschmoment" UWORD rel_uw_b100 1 100 0 99.9985 FORMAT "%8.5" ECU_ADDRESS 0x38267C /end MEASUREMENT
/begin MEASUREMENT mifafu_w "Fahrermomentenwunsch für Füllung" UWORD rel_uw_b100 1 100 0 99.9985 FORMAT "%8.5" ECU_ADDRESS 0x38268E /end MEASUREMENT
/begin MEASUREMENT mifal_w "Indiziertes Fahrerwunschmoment für Momentenkoordination Füllung" UWORD rel_uw_b100 1 100 0 99.9985 FORMAT "%8.5" ECU_ADDRESS 0x382630 /end MEASUREMENT
/begin MEASUREMENT mifa_w "indiziertes Motormoment Fahrerwunsch" UWORD rel_uw_b100 1 100 0 99.9985 FORMAT "%8.5" ECU_ADDRESS 0x382632 /end MEASUREMENT
/begin MEASUREMENT migef_w "Gefiltertes indiziertes Fahrerwunschmoment" UWORD rel_uw_b100 1 100 0 99.9985 FORMAT "%8.5" ECU_ADDRESS 0x382634 /end MEASUREMENT
/begin MEASUREMENT miistoar_w "Istmoment ohne Antiruckel-Anteil" UWORD rel_uw_b100 1 100 0 99.9985 FORMAT "%8.5" ECU_ADDRESS 0x38270C /end MEASUREMENT
/begin MEASUREMENT miist_w "indiziertes Motormoment Hochdruckphase Istwert" UWORD rel_uw_b100 1 100 0 99.9985 FORMAT "%8.5" ECU_ADDRESS 0x3826BC /end MEASUREMENT
/begin MEASUREMENT mill_w "Indiziertes Motormoment im Leerlauf" UWORD rel_uw_b100 1 100 0 99.9985 FORMAT "%8.5" ECU_ADDRESS 0x38259E /end MEASUREMENT
/begin MEASUREMENT milres_w "Momentenanforderung für Luftpfad mit allen Reserven" UWORD rel_uw_b100 1 100 0 99.9985 FORMAT "%8.5" ECU_ADDRESS 0x382690 /end MEASUREMENT
/begin MEASUREMENT milsolv_w "Sollmoment für Füllungspfad vor Momentenbegrenzung" UWORD rel_uw_b100 1 100 0 99.9985 FORMAT "%8.5" ECU_ADDRESS 0x382692 /end MEASUREMENT
/begin MEASUREMENT milsol_w "Fahrermomentenwunsch für Füllung" UWORD rel_uw_b100 1 100 0 99.9985 FORMAT "%8.5" ECU_ADDRESS 0x382694 /end MEASUREMENT
/begin MEASUREMENT mimax_w "maximal erreichbares indiziertes Moment" UWORD rel_uw_b100 1 100 0 99.9985 FORMAT "%8.5" ECU_ADDRESS 0x384C62 /end MEASUREMENT
/begin MEASUREMENT mimins_w "minimales Schubmoment" UWORD rel_uw_b100 1 100 0 99.9985 FORMAT "%8.5" ECU_ADDRESS 0x3825A0 /end MEASUREMENT
/begin MEASUREMENT mimin_w "Minimales Motor-Moment" UWORD rel_uw_b100 1 100 0 99.9985 FORMAT "%8.5" ECU_ADDRESS 0x3825A2 /end MEASUREMENT
/begin MEASUREMENT mimxl1_w "Maximales optimales Moment bei Lambda = 1" UWORD rel_uw_b100 1 100 0 99.9985 FORMAT "%8.5" ECU_ADDRESS 0x384C64 /end MEASUREMENT
/begin MEASUREMENT minbeg_w "Indiziertes Fahrerwunschmoment nach Änderungsbegrenzung" UWORD rel_uw_b100 1 100 0 99.9985 FORMAT "%8.5" ECU_ADDRESS 0x382636 /end MEASUREMENT
/begin MEASUREMENT mioptl1_w "optimales indiziertes Motormoment bei Lambda = 1" UWORD rel_uw_b100 1 100 0 99.9985 FORMAT "%8.5" ECU_ADDRESS 0x38269A /end MEASUREMENT
/begin MEASUREMENT miopt_w "optimales indiziertes Moment" UWORD rel_uw_b100 1 100 0 99.9985 FORMAT "%8.5" ECU_ADDRESS 0x38269C /end MEASUREMENT
/begin MEASUREMENT misolv_w "Indiziertes resultierendes Sollmoment vor Momentenbegrenzung" UWORD rel_uw_b100 1 100 0 99.9985 FORMAT "%8.5" ECU_ADDRESS 0x38267E /end MEASUREMENT
/begin MEASUREMENT misol_w "Indiziertes resultierendes Sollmoment" UWORD rel_uw_b100 1 100 0 99.9985 FORMAT "%8.5" ECU_ADDRESS 0xF9F2 /end MEASUREMENT
/begin MEASUREMENT misopl1_w "Solluftmoment, rückgerechnet auf Lambda=1 und zwopt" UWORD rel_uw_b100 1 100 0 99.9985 FORMAT "%8.5" ECU_ADDRESS 0x381FCE /end MEASUREMENT
/begin MEASUREMENT miszullb_w "Maximal zulässiges indiziertes Moment für Luftpfad (begrenzt)" UWORD rel_uw_b100 1 100 0 99.9985 FORMAT "%8.5" ECU_ADDRESS 0x3826F0 /end MEASUREMENT
/begin MEASUREMENT miszull_w "Maximal zulässiges indiziertes Moment für Luftpfad" UWORD rel_uw_b100 1 100 0 99.9985 FORMAT "%8.5" ECU_ADDRESS 0x3826F2 /end MEASUREMENT
/begin MEASUREMENT miszul_w "Maximal zulässiges indiziertes Moment" UWORD rel_uw_b100 1 100 0 99.9985 FORMAT "%8.5" ECU_ADDRESS 0x3826F4 /end MEASUREMENT
/begin MEASUREMENT mitmbgr_w "Momentenbegrenzung durch erhöhte Motortemperatur" UWORD rel_uw_b100 1 100 0 99.9985 FORMAT "%8.5" ECU_ADDRESS 0x384C90 /end MEASUREMENT
/begin MEASUREMENT mivbeb_w "Indiziertes Moment vor Änderungsbegrenzung, nach oben auf mimax_w begrenzt" UWORD rel_uw_b100 1 100 0 99.9985 FORMAT "%8.5" ECU_ADDRESS 0x382638 /end MEASUREMENT
/begin MEASUREMENT mivbegv_w "Indiziertes Fahrerwunschmoment vor Maximalbegrenzung" UWORD rel_uw_b100 1 100 0 99.9985 FORMAT "%8.5" ECU_ADDRESS 0x38263A /end MEASUREMENT
/begin MEASUREMENT mivbeg_w "inidziertes Fahrerwunschmoment vor Änderungsbegrenzung" UWORD rel_uw_b100 1 100 0 99.9985 FORMAT "%8.5" ECU_ADDRESS 0x38263C /end MEASUREMENT
/begin MEASUREMENT mizsolv_w "Indiziertes resultierendes Sollmoment für ZW-Eingriff vor Momentenbegrenzung" UWORD rel_uw_b100 1 100 0 99.9985 FORMAT "%8.5" ECU_ADDRESS 0x382680 /end MEASUREMENT
/begin MEASUREMENT mizsol_w "Indiziertes resultierendes Sollmoment für ZW-Eingriff" UWORD rel_uw_b100 1 100 0 99.9985 FORMAT "%8.5" ECU_ADDRESS 0x382682 /end MEASUREMENT
/begin MEASUREMENT mizufil_w "Zulässiges indiziertes Moment nach Filter" UWORD rel_uw_b100 1 100 0 99.9985 FORMAT "%8.5" ECU_ADDRESS 0x3826F6 /end MEASUREMENT
/begin MEASUREMENT mizuofil "Zulässiges indiziertes Moment ohne Filter" UBYTE rel_ub_b99p6 1 100 0 99.6094 FORMAT "%5.2" ECU_ADDRESS 0x380B37 /end MEASUREMENT
/begin MEASUREMENT mizuvfil "Zulässiges indiziertes Moment vor Filter" UBYTE rel_ub_b99p6 1 100 0 99.6094 FORMAT "%5.2" ECU_ADDRESS 0x380B38 /end MEASUREMENT
/begin MEASUREMENT mizwmn_w "indiziertes Motormoment beim spätesten Zündwinkel" UWORD rel_uw_b100 1 100 0 99.9985 FORMAT "%8.5" ECU_ADDRESS 0x3826E2 /end MEASUREMENT
/begin MEASUREMENT mkfadpn_w "Kupplungsmoment für Umschaltung Dashpot-Filterzeit" SWORD rel_sw_b100 1 100 -100 99.9969 FORMAT "%8.4" ECU_ADDRESS 0x38263E /end MEASUREMENT
/begin MEASUREMENT mkfanb_w "Kupplungsmoment aus begrenztem Fahrerwunsch" SWORD rel_sw_b100 1 100 -100 99.9969 FORMAT "%8.4" ECU_ADDRESS 0x382640 /end MEASUREMENT
/begin MEASUREMENT mkfa_w "Fahrerwunschmoment (Kupplung) nach Änderungsbegrenzung" SWORD rel_sw_b50 1 100 -50 49.9985 FORMAT "%8.5" ECU_ADDRESS 0x382642 /end MEASUREMENT
/begin MEASUREMENT mlnka_w "Luftmasse nach Kat-Ausräumen" UWORD m_uw_b7281 1 100 0 7281.67 FORMAT "%8.3" ECU_ADDRESS 0x385366 /end MEASUREMENT
/begin MEASUREMENT mrfamx_w "Relatives Fahrerwunschmoment Maximalwert" UWORD rel_uw_b200 1 100 0 199.997 FORMAT "%8.4" ECU_ADDRESS 0x384C60 /end MEASUREMENT
/begin MEASUREMENT mrfa_w "Relatives Fahrerwunschmoment aus FGR und Pedal" UWORD rel_uw_b200 1 100 0 199.997 FORMAT "%8.4" ECU_ADDRESS 0x382644 /end MEASUREMENT
/begin MEASUREMENT mrpedl_w "Relatives Fahrerwunschmoment aus Fahrpedal für kleine Geschwindigkeiten" UWORD rel_uw_b200 1 100 0 199.997 FORMAT "%8.4" ECU_ADDRESS 0x382646 /end MEASUREMENT
/begin MEASUREMENT mrpeds_w "Relatives Fahrerwunschmoment aus Fahrpedal für größere Geschwindigkeiten" UWORD rel_uw_b200 1 100 0 199.997 FORMAT "%8.4" ECU_ADDRESS 0x382648 /end MEASUREMENT
/begin MEASUREMENT mrped_w "relatives Fahrerwunschmoment aus Fahrpedal" UWORD rel_uw_b200 1 100 0 199.997 FORMAT "%8.4" ECU_ADDRESS 0x38264A /end MEASUREMENT
/begin MEASUREMENT mtsegph_w "Gleitender Mittelwert der Phasenperiodendauer" UWORD t40usxus_q40 1 100 0 2.6214e+006 FORMAT "%8.0" ECU_ADDRESS 0x381AA2 /end MEASUREMENT
/begin MEASUREMENT nasnottm "Drehzahlschwelle wegen Abwürgeschutz als Funktion von tmot" UBYTE nmot_ub_q40 1 100 0 10200 FORMAT "%5.0" ECU_ADDRESS 0x380B23 /end MEASUREMENT
/begin MEASUREMENT nsynnldg "Neusynchronisationsmonitor für NLDG" UBYTE dez 1 100 0 255 FORMAT "%5.1" ECU_ADDRESS 0x380984 /end MEASUREMENT
/begin MEASUREMENT nsynnlph "Neusynchronisationsmonitor für NLPH" UBYTE dez 1 100 0 255 FORMAT "%5.1" ECU_ADDRESS 0x380975 /end MEASUREMENT
/begin MEASUREMENT nturbv_w "Vorraussichtliche Turbinendrehzahl des Wandlers" UWORD nmot_q0p125 1 100 0 8191.88 FORMAT "%8.3" ECU_ADDRESS 0x382570 /end MEASUREMENT
/begin MEASUREMENT nturb_w "Turbinendrehzahl des Wandlers" UWORD nmot_q0p125 1 100 0 8191.88 FORMAT "%8.3" ECU_ADDRESS 0x382572 /end MEASUREMENT
/begin MEASUREMENT nver_w "Drehzahlverhältnis" UWORD fak_uw_b8 1 100 0 7.99988 FORMAT "%8.6" ECU_ADDRESS 0x384C4E /end MEASUREMENT
/begin MEASUREMENT percnt_w "Zähler 10-ms-Schritte für fr-synchrone lamsolh-Mittelung" UWORD dez 1 100 0 65535 FORMAT "%8.2" ECU_ADDRESS 0x3829DC /end MEASUREMENT
/begin MEASUREMENT phLosCtr_w "Zähler Neusynchronisation durch falsche Synchronisation an BM (word)" UWORD dez 1 100 0 65535 FORMAT "%8.2" ECU_ADDRESS 0x383A44 /end MEASUREMENT
/begin MEASUREMENT qntns "Quotient aus Turbinendrehzahl des Wandlers und Solldrehzahl der LLR" UBYTE fak_ub_b8 1 100 0 7.96875 FORMAT "%5.3" ECU_ADDRESS 0x380B0D /end MEASUREMENT
/begin MEASUREMENT redhyst "Reduzierstufenhysterese" SBYTE rel_sb_q0p02 1 100 -2.56 2.54 FORMAT "%5.3" ECU_ADDRESS 0x380B32 /end MEASUREMENT
/begin MEASUREMENT redneu "neu berechnete Reduzierstufe" UBYTE dez 1 100 0 255 FORMAT "%5.1" ECU_ADDRESS 0x380B33 /end MEASUREMENT
/begin MEASUREMENT redsol "Berechnete Soll-Reduzierstufe" UBYTE dez 1 100 0 255 FORMAT "%5.1" ECU_ADDRESS 0x380B34 /end MEASUREMENT
/begin MEASUREMENT redze "Schwelle in Reduzierstufe zwischen Zünd- und Einspritzeingriff" UBYTE dez 1 100 0 255 FORMAT "%5.1" ECU_ADDRESS 0x380B35 /end MEASUREMENT
/begin MEASUREMENT redzst_w "Reduzierstufe ohne Hysterese und Rundung" UWORD rel_uw_q0p001 1 100 0 65.535 FORMAT "%8.5" ECU_ADDRESS 0x3826E4 /end MEASUREMENT
/begin MEASUREMENT rlmindp_w "Minimale relative Füllung für Dashpot-Abschaltung" UWORD rel_uw_q0p0234 1 100 0 1535.98 FORMAT "%8.3" ECU_ADDRESS 0x38264C /end MEASUREMENT
/begin MEASUREMENT rlmin_w "minimal zulässiges rl" UWORD rel_uw_q0p0234 1 100 0 1535.98 FORMAT "%8.3" ECU_ADDRESS 0x381FD0 /end MEASUREMENT
/begin MEASUREMENT rlsol_w "Soll-Füllung" UWORD rel_uw_q0p0234 1 100 0 1535.98 FORMAT "%8.3" ECU_ADDRESS 0x381FD2 /end MEASUREMENT
/begin MEASUREMENT swOffD2Bits "" UWORD dez 1 100 0 65535 FORMAT "%8.2" ECU_ADDRESS 0x383AA4 /end MEASUREMENT
/begin MEASUREMENT swOffDlBits "" UWORD dez 1 100 0 65535 FORMAT "%8.2" ECU_ADDRESS 0x383AA6 /end MEASUREMENT
/begin MEASUREMENT tansst "Ansaugluft-Temperatur bei Start" UBYTE temp_ub_q0p75_o48 1 100 -48 143.25 FORMAT "%5.1" ECU_ADDRESS 0x380B81 /end MEASUREMENT
/begin MEASUREMENT tlok "Außentemperatur als Lastinformation für Klimakompressor" UBYTE temp_ub_q0p75_o48 1 100 -48 143.25 FORMAT "%5.1" ECU_ADDRESS 0x3848E8 /end MEASUREMENT
/begin MEASUREMENT tlrbamo_w "Ausgang der Kennlinie TLRBAM" UWORD t10msxs_uw_b655p35 1 100 0 655.35 FORMAT "%8.4" ECU_ADDRESS 0x385358 /end MEASUREMENT
/begin MEASUREMENT tlrs_w "Totzeit der Lambdaregelstrecke" UWORD tz10msxs_uw_b327p68 1 100 0.00500008 327.68 FORMAT "%8.4" ECU_ADDRESS 0x382962 /end MEASUREMENT
/begin MEASUREMENT tlrvamo_w "Ausgang der Kennlinie TLRVAM" UWORD t10msxs_uw_b655p35 1 100 0 655.35 FORMAT "%8.4" ECU_ADDRESS 0x38535A /end MEASUREMENT
/begin MEASUREMENT tmotmdb "Motor-Temperatur für Momentenbegrenzung" UBYTE temp_ub_q0p75_o48 1 100 -48 143.25 FORMAT "%5.1" ECU_ADDRESS 0x3848F2 /end MEASUREMENT
/begin MEASUREMENT tnachl_w "SG-Nachlaufzeit" UWORD t100msxs_uw_b6553p6 1 100 0 6553.5 FORMAT "%8.3" ECU_ADDRESS 0x383AA8 /end MEASUREMENT
/begin MEASUREMENT tnbmphs0_w "Zahnperiodendauer eines NBM-Signals durch linearen Algorithmus" UWORD t5usxus_q5 1 100 0 327675 FORMAT "%8.1" ECU_ADDRESS 0x381AA4 /end MEASUREMENT
/begin MEASUREMENT tnscCtr_w "" UWORD t20msxs_uw_q0p02 1 100 0 1310.7 FORMAT "%8.3" ECU_ADDRESS 0x3826F8 /end MEASUREMENT
/begin MEASUREMENT tnsofCtr "" UBYTE t20msxs_ub_b5p1 1 100 0 5.1 FORMAT "%5.3" ECU_ADDRESS 0x380B39 /end MEASUREMENT
/begin MEASUREMENT tPh1_w "Segmentzeit des letzten Phasensegments" UWORD t40usxus_q40 1 100 0 2.6214e+006 FORMAT "%8.0" ECU_ADDRESS 0x381AA6 /end MEASUREMENT
/begin MEASUREMENT tsaka "Timer Schubdauer für Katalysator-Ausräumen" UBYTE t20msxs_ub_b5p1 1 100 0 5.1 FORMAT "%5.3" ECU_ADDRESS 0x380B86 /end MEASUREMENT
/begin MEASUREMENT tsegph_w "Periodendauer eines Phasensegments" UWORD t40usxus_q40 1 100 0 2.6214e+006 FORMAT "%8.0" ECU_ADDRESS 0x381AA8 /end MEASUREMENT
/begin MEASUREMENT usrhk "aktuelle Regelschwelle Lambdasignal h.K." UBYTE spg_ub_q0p0052_o0p2 1 100 -0.2 1.13 FORMAT "%5.3" ECU_ADDRESS 0x3848F4 /end MEASUREMENT
/begin MEASUREMENT wdmdkoe "Momentenaufnahme Klimakompressor beim Einschalten" SBYTE rel_sb_q0p39 1 100 -49.9968 49.6062 FORMAT "%5.2" ECU_ADDRESS 0x3848E9 /end MEASUREMENT
/begin MEASUREMENT wkfmdko "Momentenaufnahme Klimakompressor vor Filter" UBYTE rel_ub_b99p6 1 100 0 99.6094 FORMAT "%5.2" ECU_ADDRESS 0x3848EA /end MEASUREMENT
/begin MEASUREMENT wnwix_w "Winkelfehler der berechneten Winkelbasis an der negativen Phasenflanke" SWORD kw_sw_b128 1 100 -128 127.996 FORMAT "%8.4" ECU_ADDRESS 0x381AAA /end MEASUREMENT
/begin MEASUREMENT wnwkwasx_w "Berechnete Winkelbasis zum Zeitpunkt der negativen Phasenflanke" UWORD kw_q0p0156 1 100 0 1023.98 FORMAT "%8.3" ECU_ADDRESS 0x381AAC /end MEASUREMENT
/begin MEASUREMENT wnwspasx_w "Adaptierter Wert der aktuellen Phasenflanke" UWORD kw_q0p0156 1 100 0 1023.98 FORMAT "%8.3" ECU_ADDRESS 0x381AAE /end MEASUREMENT
/begin MEASUREMENT zdash1_w "Zeitkonstante PT1-Filter Dashpot" UWORD zk10msxs_uw_b655 1 100 0.0100002 655.36 FORMAT "%12.8" ECU_ADDRESS 0x38264E /end MEASUREMENT
/begin MEASUREMENT zdash2_w "Zeitkonstante PT1-Filter Dashpot bei kleinem Kupplungsmoment" UWORD zk10msxs_uw_b655 1 100 0.0100002 655.36 FORMAT "%12.8" ECU_ADDRESS 0x382650 /end MEASUREMENT
/begin MEASUREMENT zdash_w "Zeitkonstante Dashpot" UWORD zk10msxs_uw_b655 1 100 0.0100002 655.36 FORMAT "%12.8" ECU_ADDRESS 0x382652 /end MEASUREMENT
/begin MEASUREMENT zlrs "Verzögerungszeitkonstante der Lambdaregelstrecke" UBYTE zk10msxs_ub_b2p55 1 100 0.01 2.55 FORMAT "%5.3" ECU_ADDRESS 0x380B7E /end MEASUREMENT
/begin MEASUREMENT zlrs_w "Verzögerungszeitkonstante der Lambdaregelstrecke, 16 bit" UWORD zk10msxs_uw_b655 1 100 0.0100002 655.36 FORMAT "%12.8" ECU_ADDRESS 0x382964 /end MEASUREMENT
/begin MEASUREMENT zlsdv_w "Zeitkonstante PT2-Filter Lastschlagdämpfung vor Reduktion" UWORD zk10msxs_uw_b655 1 100 0.0100002 655.36 FORMAT "%12.8" ECU_ADDRESS 0x382654 /end MEASUREMENT
/begin MEASUREMENT zlsd_w "Zeitkonstante PT2-Filter Lastschlagdämpfung" UWORD zk10msxs_uw_b655 1 100 0.0100002 655.36 FORMAT "%12.8" ECU_ADDRESS 0x382656 /end MEASUREMENT
/begin MEASUREMENT znlphausf "Zähler für erkannte Aussetzer an falscher Position" UBYTE dez 1 100 0 255 FORMAT "%5.1" ECU_ADDRESS 0x380976 /end MEASUREMENT
/begin MEASUREMENT znlphausr "Zähler für erkannte Aussetzer an richtiger Position" UBYTE dez 1 100 0 255 FORMAT "%5.1" ECU_ADDRESS 0x380977 /end MEASUREMENT
/begin MEASUREMENT znlphstim "Zähler für Stimuli-Bits von Aussetzertrommel" UBYTE dez 1 100 0 255 FORMAT "%5.1" ECU_ADDRESS 0x380978 /end MEASUREMENT
/begin MEASUREMENT zphflsyn "Phasenflankenzähler bei Erkennen der Motorposition im Notlauf DG" UBYTE dez 1 100 0 255 FORMAT "%5.1" ECU_ADDRESS 0x380985 /end MEASUREMENT
/begin MEASUREMENT zphflx "Zähler äquidistanter Phasenflanken von %WANWKW" UBYTE dez 1 100 0 255 FORMAT "%5.1" ECU_ADDRESS 0x380986 /end MEASUREMENT
/begin MEASUREMENT zueoffnl "Zündwinkeloffset von Notlauf-Drehzahlgeber" SBYTE zw_sb_q0p75 1 100 -96 95.25 FORMAT "%5.2" ECU_ADDRESS 0x380987 /end MEASUREMENT
/begin MEASUREMENT zwopt "optimaler Zündwinkel" SBYTE zw_sb_q0p75 1 100 -96 95.25 FORMAT "%5.2" ECU_ADDRESS 0x380B2D /end MEASUREMENT
/begin MEASUREMENT zwoptl1 "optimaler Zündwinkel bei Lambda=1" SBYTE zw_sb_q0p75 1 100 -96 95.25 FORMAT "%5.2" ECU_ADDRESS 0x380B2E /end MEASUREMENT
/begin MEASUREMENT zwsol "Soll-Zündwinkel aus Momenteneingriff" SBYTE zw_sb_q0p75 1 100 -96 95.25 FORMAT "%5.2" ECU_ADDRESS 0x380BD0 /end MEASUREMENT
/begin MEASUREMENT zyleausb "auszublendender Zylinder; binäre Darstellung" UBYTE dez 1 100 0 255 FORMAT "%5.1" ECU_ADDRESS 0x380979 /end MEASUREMENT
/begin FUNCTION LRS "15.120    Stetige Lambdaregelung"
 /begin DEF_CHARACTERISTIC CLRS CWLRMS FRMAX FRMINKH FZAB2 KFDLASO_0_A KFDLASO_1_A KFFRMIN KFLRSG1 KFLRSG2 KFLRSG4 KFLRSP1 KFLRSP2 KFLRSP3 KFLRSP4 KFLRST KFLRSZ LADIFFTHR LALIUSMN LRSGKTM LRSTPZA LRSZAWML TAUIDEC TKATSZA TMLRZAMN WIMAX WIMIN XIMAX XIMIN Y2MAX /end DEF_CHARACTERISTIC
 /begin REF_CHARACTERISTIC SNM07LSUW SNM10LSUB SRL08LSUW SRL10LSUB /end REF_CHARACTERISTIC
 /begin IN_MEASUREMENT azlrdkt B_dktlp B_frini B_gaeing B_kh B_lrka B_lrmsbs B_lrs B_lrsresf B_nswo1 B_sls dlahi_w dlahp_w esst_snm07lsuw esst_snm10lsub esst_srl08lsuw esst_srl10lsub flamsl_w frini_w lamsbg_w lamsoni_w lamsons_w ml_w nmot nmot_w rl rl_w tkatm_w tmot tnst_w tzlrdkt_w /end IN_MEASUREMENT
 /begin OUT_MEASUREMENT B_frmax B_frmin B_lrsrems B_lrssp B_za dfrzaf_w dfrza_w frmn_w frmx_w frm_w fr_w ladiff_w lamsbgt_w lamzak_w tlrs_w zlrs zlrs_w /end OUT_MEASUREMENT
 /begin LOC_MEASUREMENT B_flrsres B_idecay B_lrmsbrc B_update B_y2max B_y2min dfrmin_w dfrmn_w dfrpr_w dfrzaff_w dfrzapr_w dfr_w dlaso froza_w g1korr lamsbpr_w lamzapr_w lrsg1_w lrsg2_w lrsg4_w lrsp1_w lrsp2_w lrsp3_w lrsp4_w lrsw1_w lrsw2_w lrsxk1_w lrsxk3_w lrsxk4_w lrsy2_w lrsy4_w lrsza /end LOC_MEASUREMENT
 /begin SUB_FUNCTION /end SUB_FUNCTION
/end FUNCTION
/begin FUNCTION LRSEB "10.200    Einschaltbedingungen stetige Lambdaregelung"
 /begin DEF_CHARACTERISTIC CLRZWTMS DLAMXSA DTMR DTMTMRW IMLEVABS IMLSALR NLRSHB RLLRSHB RLLRUN RLSLSMN TARAU TASHS TLRBAM TLRHS TLRSZWSA TLRTMS TLRVAM TLRZWTMS TMRA1 TMRA2 TMRAK TMSHS TRAU TVSLR /end DEF_CHARACTERISTIC
 /begin REF_CHARACTERISTIC CLRS LALIUSMN /end REF_CHARACTERISTIC
 /begin IN_MEASUREMENT B_bag B_bevab B_craus B_dsla B_dslsk B_eev B_ehlsu B_elsu B_esls B_falr B_ll B_mdarv B_mdkat B_nwse B_sa B_sbbhk B_sbblsu B_slsoff B_st B_stend B_temin B_vag B_vlsuftb lamsoni_w lamsons_w ml_w nmot rl tans tmot tmotlin tmrw tmst /end IN_MEASUREMENT
 /begin OUT_MEASUREMENT B_eobdlr B_lr B_lr2s B_lrmsbs B_lrnda B_lrs B_lrsresf B_lrssa B_lrvk B_mlevab B_mlrsa B_nolrb B_nolre B_nolrw B_tmlr flglrs /end OUT_MEASUREMENT
 /begin LOC_MEASUREMENT B_lelshbb B_lelsubb B_lrrl B_pspaus B_pspwl B_slspaus B_tarau B_vsspaus imlevab_w imlrsa_w tansst tlrbamo_w tlrvamo_w /end LOC_MEASUREMENT
 /begin SUB_FUNCTION /end SUB_FUNCTION
/end FUNCTION
/begin FUNCTION LRSHK "15.10     Lambdaregelung (stetig) hinter Katalysator"
 /begin DEF_CHARACTERISTIC CLRSHK CLRSHKA DLAHINI KDLASHKI_0_A KDLASHKI_1_A KDLASHKP_0_A KDLASHKP_1_A KFUSHK_0_A KFUSHK_1_A KFUSHKA KILRHML_0_A KILRHML_1_A KPLRHML_0_A KPLRHML_1_A LALIUSH LALIUSRH LAMSONMN LAMSONMX LASHKAB LRHIMN LRHIMX MLNKAX NLRHO_0_A NLRHO_1_A NLRHU_0_A NLRHU_1_A PLRHAV_0_A PLRHAV_1_A RLLRHON_0_A RLLRHON_1_A RLLRHUAN_0_A RLLRHUAN_1_A RLLRHUN_0_A RLLRHUN_1_A TBLRH TKATMLRH_0_A TKATMLRH_1_A TLRHFRXMOF TLRHFRXMON TMLLAMN ZLASHKAB ZLASOHML /end DEF_CHARACTERISTIC
 /begin REF_CHARACTERISTIC CLRSHKEB SM108LHSW SML08LHUB_0_A SML08LHUB_1_A SNM08LHUB /end REF_CHARACTERISTIC
 /begin IN_MEASUREMENT avkatf B_edkvs B_fakat B_falsh B_frmax B_frmin B_lr B_lrka B_lrssp B_mdarv B_pwf B_sbbhk B_st B_tehb esst_sm108lhsw esst_sml08lhub esst_snm08lhub lamsons_w ml ml_w nmot rl tkatm ushk_w /end IN_MEASUREMENT
 /begin OUT_MEASUREMENT B_lrhk B_lrhkp dlahi_w dlahp_w lamsolh_w lamsonh_w usrhk /end OUT_MEASUREMENT
 /begin LOC_MEASUREMENT B_dlahini B_lrhbb B_lrhkb B_lrhkg B_mlnka B_nekati dlahini_w dlahkab_w dlashki_w dlashkm_w dlashkp_w lahkmz lamhf_w lamhm_w mlnka_w percnt_w /end LOC_MEASUREMENT
 /begin SUB_FUNCTION /end SUB_FUNCTION
/end FUNCTION
/begin FUNCTION LRSINI "1.10      Stetige Lambdaregelung, Koordination der Initialisierung" /begin DEF_CHARACTERISTIC /end DEF_CHARACTERISTIC /begin REF_CHARACTERISTIC /end REF_CHARACTERISTIC /begin IN_MEASUREMENT B_dtefrr frdter_w /end IN_MEASUREMENT /begin OUT_MEASUREMENT B_frini B_frini2 frini2_w frini_w /end OUT_MEASUREMENT /begin LOC_MEASUREMENT /end LOC_MEASUREMENT /begin SUB_FUNCTION /end SUB_FUNCTION /end FUNCTION
/begin FUNCTION LRSKA "4.60      Stetige Lambdaregelung Zusatzfunktion Katalysator-Ausräumen"
 /begin DEF_CHARACTERISTIC CLRSKA FLMLKAMA ILMLKAXTK LAMKAML LAMSKAMX NLRKA TSAKAMN USHKAMX /end DEF_CHARACTERISTIC
 /begin REF_CHARACTERISTIC /end REF_CHARACTERISTIC
 /begin IN_MEASUREMENT B_bevab B_sbbhk B_sbbvk lamsoni_w lamsons_w ml ml_w nmot tkatm_w ushk /end IN_MEASUREMENT
 /begin OUT_MEASUREMENT B_lrka lamka_w /end OUT_MEASUREMENT
 /begin LOC_MEASUREMENT B_blrka B_lrkae ilmlkav_w ilmlkax_w ilmlka_w lrkaz tsaka /end LOC_MEASUREMENT
 /begin SUB_FUNCTION /end SUB_FUNCTION
/end FUNCTION
/begin FUNCTION MCMESS_PROT "" /begin DEF_CHARACTERISTIC /end DEF_CHARACTERISTIC /begin REF_CHARACTERISTIC CWVSV /end REF_CHARACTERISTIC /begin IN_MEASUREMENT /end IN_MEASUREMENT /begin OUT_MEASUREMENT /end OUT_MEASUREMENT /begin LOC_MEASUREMENT /end LOC_MEASUREMENT /begin SUB_FUNCTION /end SUB_FUNCTION /end FUNCTION
/begin FUNCTION MDAUTG "2.60      Berechnung des Istmomentes für die Getriebesteuerung" /begin DEF_CHARACTERISTIC /end DEF_CHARACTERISTIC /begin REF_CHARACTERISTIC /end REF_CHARACTERISTIC
 /begin IN_MEASUREMENT B_dash B_fil B_kh B_kw B_ll B_lsd B_mibeg B_sab B_zwvz dmaufr_w dmllr_w miasrs_w mibas_w mibgr_w mifa_w mimsr_w minmx_w miszul_w mivbeb_w mivmx_w mizwmn_w /end IN_MEASUREMENT
 /begin OUT_MEASUREMENT miautget_w miautgs_w miistoar_w /end OUT_MEASUREMENT
 /begin LOC_MEASUREMENT /end LOC_MEASUREMENT
 /begin SUB_FUNCTION /end SUB_FUNCTION
/end FUNCTION
/begin FUNCTION MDBAS "8.30      Berechnung der Basisgrößen für Momentenschnittstelle"
 /begin DEF_CHARACTERISTIC AGRRMAX CWMDBAS DZWOLA DZWOM ETADZW ETALAM KFDZWOAGR KFMIOP KFZWOP KFZWOP2 SRL11OPUW /end DEF_CHARACTERISTIC
 /begin REF_CHARACTERISTIC SNM16OPUW /end REF_CHARACTERISTIC
 /begin IN_MEASUREMENT agrr dzwnwsu esst_snm16opuw fnwue lambas nmot nmot_w rl_w tmot zwbas /end IN_MEASUREMENT
 /begin OUT_MEASUREMENT dzwoag dzwol dzw_kge esst_srl11opuw etalab etatrmn etazwb etazwbm mibas_w miopt_w zwopt zwoptl1 /end OUT_MEASUREMENT
 /begin LOC_MEASUREMENT dzwb dzwotm mioptl1_w /end LOC_MEASUREMENT
 /begin SUB_FUNCTION /end SUB_FUNCTION
/end FUNCTION
/begin FUNCTION MDBGRG "4.120     Momentenbegrenzung nach oben"
 /begin DEF_CHARACTERISTIC CWMDBGRG DMRTMKI DTMIBG KFFRTMKI KFMDBGRG KLFRTMKI MDGAT MKBRMXWP TAGAT TMMIBGR TMXMIBG TNGAT TVBRMX TVGAT VMIBGR VMKBRMX /end DEF_CHARACTERISTIC
 /begin REF_CHARACTERISTIC /end REF_CHARACTERISTIC
 /begin IN_MEASUREMENT B_atrsp B_autget B_brems B_krdws gangi mdverl_w mibgrbr_w mibgrtm_w mifafu_w mifamx_w mimax_w mitibgr_w mkbgr_w mkfamx_w nmot tmki tmot vfzg wped_w /end IN_MEASUREMENT
 /begin OUT_MEASUREMENT mibgrl_w mibgr_w miekpbgr_w mitmbgr_w /end OUT_MEASUREMENT
 /begin LOC_MEASUREMENT B_brvfp B_mkbrmx frtmki MDBGRGlokbits miatbgr_w mibgrg_w mibrmx_w tmotmdb /end LOC_MEASUREMENT
 /begin SUB_FUNCTION /end SUB_FUNCTION
/end FUNCTION
/begin FUNCTION MDFAW "12.260    Fahrerwunschmoment"
 /begin DEF_CHARACTERISTIC CWDMFAB CWMDFAW DMDPUG DMIFLSD DMLSDUG DMRFAWEN DRLMINDP FGMIFAL FGZLSD FKFPEDV FKZDPTM FLRMIFAL FLRZDASH FLRZLSD FZDA1SCH FZDA2SCH KFDLSD_0_A KFDLSD_1_A KFDLSD_2_A KFDLSD_3_A KFDMDPO KFDMLSDO_0_A KFDMLSDO_1_A KFDMLSDO_2_A KFDMLSDO_3_A KFDMLSDS KFMIFABG_0_A KFMIFABG_1_A KFMIFABG_2_A KFMIFABG_3_A KFMIFALS_0_A KFMIFALS_1_A KFMIFALS_2_A KFMIFALS_3_A KFMILSD KFPED KFPEDL KFPEDR KFWMIFAL KFWZLSD KFZDASH_0_A KFZDASH_1_A KFZDASH_2_A KFZDASH_3_A KFZDASH2_0_A KFZDASH2_1_A KFZDASH2_2_A KFZDASH2_3_A KFZLSD_0_A KFZLSD_1_A KFZLSD_2_A KFZLSD_3_A MIFABGMX MIFALMF MKFADPN_0_A MKFADPN_1_A MKFADPN_2_A MKFADPN_3_A MKFADPN1_0_A MKFADPN1_1_A MKFADPN1_2_A MKFADPN1_3_A MKMIFABG MRFALLO MRFALLU MRFAVLN NGFSAWE SNM12MDUW SWP16MDUW TDMFBSA TDMFBWE TDMFNSG TDMFWEMI TDMLSDS TVFSAWE VDASH VLSD /end DEF_CHARACTERISTIC
 /begin REF_CHARACTERISTIC MDIMX SGA08MDUB SNM06MDUW /end REF_CHARACTERISTIC
 /begin IN_MEASUREMENT B_asr B_cvt B_faan B_gwhs B_ko B_kuppl B_kupplv B_llvfgr B_lowra B_mgbget B_nmax B_nmot B_nsget B_sa B_sab B_sabfg B_stend B_vmax B_vnull B_wkauf dmllri_w dmverl_w esst_sga08mdub esst_snm06mduw gangi mdgrad_w mdverl_w miasrs_w mibas_w mifamx_w miistoar_w mimax_w mimin_w mizwmn_w mrfgr_w ngfil_w nmot nmot_w rlmin_w rl_w tmot vfzg wped wped_w /end IN_MEASUREMENT
 /begin OUT_MEASUREMENT B_dash B_fgr B_fil B_ll B_lsd B_vl esst_snm12mduw esst_swp16mduw mifa mifal_w mifa_w mivbeb_w mkfanb_w mrfamx_w mrfa_w /end OUT_MEASUREMENT
 /begin LOC_MEASUREMENT B_dashv B_dp B_edp B_elsd B_iflsd B_ls B_mgbgakt B_mifabg B_mrpfa B_tdmlsds dlsd_w dmbebl_w dmdpo_w dmdpu_w dmgbeg_w dmlsdo_w dmlsdu_w dmrfawe_w fkfped fwmifal fwzlsd fzdash MDFAWlokbits mdfaw_bits mibdp_w miblsd_w mifabg_w migef_w minbeg_w mivbegv_w mivbeg_w mkfadpn_w mkfa_w mrpedl_w mrpeds_w mrped_w rlmindp_w zdash1_w zdash2_w zdash_w zlsdv_w zlsd_w /end LOC_MEASUREMENT
 /begin SUB_FUNCTION /end SUB_FUNCTION
/end FUNCTION
/begin FUNCTION MDFUE "8.50      Sollwertvorgabe für Luftmasse aus Sollmoment"
 /begin DEF_CHARACTERISTIC CWRLAPPL FRLMNHO FWPEDRLS KFMIRL KFRLMN KFRLMNSA RLSOLAP ZKDRLSOL /end DEF_CHARACTERISTIC
 /begin REF_CHARACTERISTIC SNM12FEUB STM04FEUB /end REF_CHARACTERISTIC
 /begin IN_MEASUREMENT B_sa esst_snm12feub esst_stm04feub etalab etazwbm fho milsol_w nmot nmot_w rlmax_w rltedte_w tmot wped_w /end IN_MEASUREMENT
 /begin OUT_MEASUREMENT B_mdmin drlsolf_w drlsol_w rlsol_w /end OUT_MEASUREMENT
 /begin LOC_MEASUREMENT misopl1_w rlmin_w /end LOC_MEASUREMENT
 /begin SUB_FUNCTION /end SUB_FUNCTION
/end FUNCTION
/begin FUNCTION MDIST "10.21     Motormomentenberechnung" /begin DEF_CHARACTERISTIC /end DEF_CHARACTERISTIC /begin REF_CHARACTERISTIC ETADZW /end REF_CHARACTERISTIC /begin IN_MEASUREMENT miopt_w redist zwist zwopt /end IN_MEASUREMENT /begin OUT_MEASUREMENT etazaist etazwist miist_w /end OUT_MEASUREMENT /begin LOC_MEASUREMENT dzwi mdindg_w /end LOC_MEASUREMENT /begin SUB_FUNCTION /end SUB_FUNCTION /end FUNCTION
/begin FUNCTION MDKOG "14.70     Drehmomentenkoordination für Gesamteingriffe"
 /begin DEF_CHARACTERISTIC CWMDKOG CWTEZW CWZWVMX DELRL NASNOTKL THDMB TMVER TVLDSZW TVMIBEG /end DEF_CHARACTERISTIC
 /begin REF_CHARACTERISTIC MDIMX /end REF_CHARACTERISTIC
 /begin IN_MEASUREMENT B_dash B_fil B_kh B_kupplv B_kw B_ldsua B_ll B_llrein B_lsd B_mdmin B_mgbget B_mibegl B_pwf B_sa B_stend dmar_w dmllr_w dmrkh dmrkt_w dmrllr_w etazwb miasrl_w miasrs_w mibas_w mibgr_w mifa_w migs_w milres_w mimax_w mimsr_w minmx_w miopt_w miszul_w mitebg_w mivmx_w nmot rlmin_w rlsol_w rl_w tmot wped_w /end IN_MEASUREMENT
 /begin OUT_MEASUREMENT B_asr B_mdein B_mibeg B_msr B_zwvs B_zwvz cmibeg_w dmzms_w mifab_w misolv_w misol_w mizsol_w nasnottm /end OUT_MEASUREMENT
 /begin LOC_MEASUREMENT B_zwget B_zwnget B_zwvzvb mibeg_w miextv_w miext_w mizsolv_w /end LOC_MEASUREMENT
 /begin SUB_FUNCTION /end SUB_FUNCTION
/end FUNCTION
/begin FUNCTION MDKOL "10.130    Momentenkoordination auf Füllungsebene" /begin DEF_CHARACTERISTIC CWMDKOL /end DEF_CHARACTERISTIC /begin REF_CHARACTERISTIC MDIMX /end REF_CHARACTERISTIC
 /begin IN_MEASUREMENT B_dashv B_llrein B_lsd B_mibeg B_mifabg dmllrl_w dmrkh dmrkt_w dmrllr_w etazwbm etazwmn miasrl_w mibgrl_w mifal_w mifa_w miges_w migsl_w mimsr_w minmx_w misgsl_w miszull_w mitebg_w mivmx_w nasnottm nmot vsdmr /end IN_MEASUREMENT
 /begin OUT_MEASUREMENT B_mrakt dmrmx_w mifafu_w milres_w milsol_w /end OUT_MEASUREMENT
 /begin LOC_MEASUREMENT B_mibegl dmlms_w milsolv_w /end LOC_MEASUREMENT
 /begin SUB_FUNCTION /end SUB_FUNCTION
/end FUNCTION
/begin FUNCTION MDMAX "2.10      Berechnung maximales indiziertes Motormoment" /begin DEF_CHARACTERISTIC FMIVL /end DEF_CHARACTERISTIC /begin REF_CHARACTERISTIC KFMIOP SRL11OPUW /end REF_CHARACTERISTIC /begin IN_MEASUREMENT esst_snm16opuw esst_srl11opuw rlmxs_w /end IN_MEASUREMENT /begin OUT_MEASUREMENT mimax_w /end OUT_MEASUREMENT /begin LOC_MEASUREMENT mimxl1_w /end LOC_MEASUREMENT /begin SUB_FUNCTION /end SUB_FUNCTION /end FUNCTION
/begin FUNCTION MDMIN "1.60      Minimales Motormoment Koordination" /begin DEF_CHARACTERISTIC FWDMVAD KFMIMN /end DEF_CHARACTERISTIC /begin REF_CHARACTERISTIC /end REF_CHARACTERISTIC /begin IN_MEASUREMENT B_sab dmvad_w fnstab_w gangi mdverf_w mistt nmot_w nver_w /end IN_MEASUREMENT /begin OUT_MEASUREMENT mill_w mimins_w mimin_w /end OUT_MEASUREMENT /begin LOC_MEASUREMENT /end LOC_MEASUREMENT /begin SUB_FUNCTION /end SUB_FUNCTION /end FUNCTION
/begin FUNCTION MDNSTAB "1.41      Drehmoment: Drehzahlstabilisierung" /begin DEF_CHARACTERISTIC FNSTABNV /end DEF_CHARACTERISTIC /begin REF_CHARACTERISTIC /end REF_CHARACTERISTIC /begin IN_MEASUREMENT nmot_w nstat /end IN_MEASUREMENT /begin OUT_MEASUREMENT fnstab_w nver_w /end OUT_MEASUREMENT /begin LOC_MEASUREMENT B_mdnstab /end LOC_MEASUREMENT /begin SUB_FUNCTION /end SUB_FUNCTION /end FUNCTION
/begin FUNCTION MDRED "4.50      Berechnung Reduzierstufe aus Momentenanforderung" /begin DEF_CHARACTERISTIC CREDSTU DMIZWMN MDHYEZ REDHYOC REDHYUC REDMXSA REDZEM /end DEF_CHARACTERISTIC /begin REF_CHARACTERISTIC /end REF_CHARACTERISTIC
 /begin IN_MEASUREMENT B_asr B_dknolu B_dkpu B_msr B_nmax B_sab B_stend B_zmsoff etazwmn mibas_w miopt_w misol_w redist tmot /end IN_MEASUREMENT
 /begin OUT_MEASUREMENT B_sa mizwmn_w redsol /end OUT_MEASUREMENT
 /begin LOC_MEASUREMENT B_mdee B_mdredhyein redhyst redneu redze redzst_w /end LOC_MEASUREMENT
 /begin SUB_FUNCTION /end SUB_FUNCTION
/end FUNCTION
/begin FUNCTION MDTRIP "1.30      Berechnung der Momentenreserve im Kurztrip" /begin DEF_CHARACTERISTIC DMRAA /end DEF_CHARACTERISTIC /begin REF_CHARACTERISTIC /end REF_CHARACTERISTIC
 /begin IN_MEASUREMENT B_faam dmrdagr_w dmrdkt_w dmrdsls_w dmrlash_w dmrlsh_w dmrlsv_w /end IN_MEASUREMENT
 /begin OUT_MEASUREMENT dmrkt_w /end OUT_MEASUREMENT
 /begin LOC_MEASUREMENT /end LOC_MEASUREMENT
 /begin SUB_FUNCTION /end SUB_FUNCTION
/end FUNCTION
/begin FUNCTION MDVER "5.90      Motor-Verlustmoment" /begin DEF_CHARACTERISTIC CNFMDVER DMDNSM DMVERLMN KFMDS MDSH MDSM ZFMDVERL ZMDNSM /end DEF_CHARACTERISTIC /begin REF_CHARACTERISTIC SNM16OPUW SRL11OPUW STM10__UB /end REF_CHARACTERISTIC
 /begin IN_MEASUREMENT B_llrein B_sa dmvad_w esst_snm16opuw esst_srl11opuw esst_stm10__ub fho mdverb mdwan_w nmotll nmot_w nsol rl_w tmot /end IN_MEASUREMENT
 /begin OUT_MEASUREMENT dmverl_w mdverf_w mdverl_w mdvervf_w /end OUT_MEASUREMENT
 /begin LOC_MEASUREMENT B_dmverlin kfmds_w mdns_w mdsm_w mds_w /end LOC_MEASUREMENT
 /begin SUB_FUNCTION /end SUB_FUNCTION
/end FUNCTION
/begin FUNCTION MDVERAD "12.30     Adaption Verlustmoment"
 /begin DEF_CHARACTERISTIC DMADFK DMADFS DMADKO DMADLL DMADMNFK DMADMNFS DMADMNKO DMADMNLL DMADMXFK DMADMXFS DMADMXKO DMADMXLL TMDMAD TWDMAD ZKDMADFK ZKDMADFS ZKDMADKO ZKDMADLL /end DEF_CHARACTERISTIC
 /begin REF_CHARACTERISTIC CDWVERAD /end REF_CHARACTERISTIC
 /begin IN_MEASUREMENT B_adrmdver B_cvtad B_dtes B_fs B_koe B_llr B_llrein B_nswo1 B_pwf B_vllr dmllri_w tmot /end IN_MEASUREMENT
 /begin OUT_MEASUREMENT dmvad_w /end OUT_MEASUREMENT
 /begin LOC_MEASUREMENT B_adwfk B_adwfs B_adwko B_madfk B_madfs B_madko B_madll dmvadfk_w dmvadfs_w dmvadko_w dmvadll_w dmvamnfk_w dmvamnfs_w dmvamnko_w dmvamnll_w dmvamxfk_w dmvamxfs_w dmvamxko_w dmvamxll_w MDVERADlokbits /end LOC_MEASUREMENT
 /begin SUB_FUNCTION /end SUB_FUNCTION
/end FUNCTION
/begin FUNCTION MDVERB "12.170    Momentenbedarf der Nebenaggregate (z.B. Klimaanlage, sonst. Verbraucher)"
 /begin DEF_CHARACTERISTIC CNFSL CWMDRLKO CWTUM DMDDLWS DMDGENAB DMDLWS FMDGEN FMDGENTA KFDMDKOE KFMDGEN KFMDKO KFMDRKO KFMDRKOE LWSER MDSL MDSLP MDSLPE MKLLS SNM06KOUB SRL06KOUB STA06LLUB TDMKO ZKMDKO ZKMDSLP /end DEF_CHARACTERISTIC
 /begin REF_CHARACTERISTIC MDNORM /end REF_CHARACTERISTIC
 /begin IN_MEASUREMENT B_acres B_koe B_llrein B_lwser B_sl B_slp B_tumcb kldfpwm lws_w mkllsc mkolsc nmot rl tans tumc tum_ein /end IN_MEASUREMENT
 /begin OUT_MEASUREMENT dmrac dmrlf esst_snm06koub esst_srl06koub esst_sta06llub mdgen mdko mdlfs mdslpf mdswl mdverb /end OUT_MEASUREMENT
 /begin LOC_MEASUREMENT dlwsl_w dlwsu_w lws mddlws_w mdkoini mdlws_w tlok wdmdkoe wkfmdko /end LOC_MEASUREMENT
 /begin SUB_FUNCTION /end SUB_FUNCTION
/end FUNCTION
/begin FUNCTION MDWAN "6.70      Drehmomentaufnahme des Wandlers"
 /begin DEF_CHARACTERISTIC CNFMDWAN DMDWHYS DMDWM FABMDWA FDMDWAN FMDWAT FNRAD FVDMDWAN KFMDWMX MDATNM MDATRM MDWANER TVFSAM TVFSEM TVFSRAM TVFSREM TVFUE UEVERG_0_A UEVERG_1_A UEVERG_2_A UEVERG_3_A ZKDMDW ZKMDWAB ZKMDWAUF ZKMDWF ZKUEVERG /end DEF_CHARACTERISTIC
 /begin REF_CHARACTERISTIC STM08MDUB /end REF_CHARACTERISTIC
 /begin IN_MEASUREMENT B_autget B_fs B_mdwaner esst_stm08mdub gangi mdwancan nstat nturbc_w tmot vfzg vfzg_w /end IN_MEASUREMENT
 /begin OUT_MEASUREMENT B_dmrwan dmdwan_w dmrwan mdwanvf_w mdwan_w /end OUT_MEASUREMENT
 /begin LOC_MEASUREMENT B_fsu B_rgang dnturb_w mdatxm_w nturbv_w nturb_w qntns /end LOC_MEASUREMENT
 /begin SUB_FUNCTION /end SUB_FUNCTION
/end FUNCTION
/begin FUNCTION MDZUL "6.31      Maximal zulässiges Moment"
 /begin DEF_CHARACTERISTIC KFDMINS KFMIZUFIL KFMIZUOF KLDMKH KLDMMX KLNSTABMX KLVERBMX NSTART NSTEND SMO08OPUB TANSMN TFMIZU TMNSMN TNSC TNSOF /end DEF_CHARACTERISTIC
 /begin REF_CHARACTERISTIC MDIMX SNM08OPUB STM08OPUB SWP08OPUB /end REF_CHARACTERISTIC
 /begin IN_MEASUREMENT B_fgr B_kh B_mrakt B_msr B_mzns_um B_sgs dmrmx_w esst_snm08opub esst_stm08opub esst_swp08opub etazwbm etazwmn fnstab_w mds_w mdverl_w nmot tans tmot wped /end IN_MEASUREMENT
 /begin OUT_MEASUREMENT miszull_w miszul_w /end OUT_MEASUREMENT
 /begin LOC_MEASUREMENT B_mdmxzu B_mzns B_nsakt B_nsend esst_smo08opub fnstabzu_w mdverbad_w mdverbmx_w mdverbzu_w MDZULbits miszullb_w mizufil_w mizuofil mizuvfil tnscCtr_w tnsofCtr /end LOC_MEASUREMENT
 /begin SUB_FUNCTION /end SUB_FUNCTION
/end FUNCTION
/begin FUNCTION MDZW "1.120     Berechnung Moment in Sollzündwinkel" /begin DEF_CHARACTERISTIC DMAUFN DZWETA /end DEF_CHARACTERISTIC /begin REF_CHARACTERISTIC /end REF_CHARACTERISTIC
 /begin IN_MEASUREMENT B_zwvs B_zwvz etazaist mibas_w miopt_w misol_w mizsol_w mizwmn_w nmot_w redist zwopt /end IN_MEASUREMENT
 /begin OUT_MEASUREMENT B_nozwe zwsol /end OUT_MEASUREMENT
 /begin LOC_MEASUREMENT B_zwvzm dmaufr_w dzws etazws /end LOC_MEASUREMENT
 /begin SUB_FUNCTION /end SUB_FUNCTION
/end FUNCTION
/begin FUNCTION MOTAUS "5.80      Motor-Abstellen" /begin DEF_CHARACTERISTIC TNLSGMN TNLSGMX UBNLMN /end DEF_CHARACTERISTIC /begin REF_CHARACTERISTIC /end REF_CHARACTERISTIC /begin IN_MEASUREMENT B_kl15 B_pwf B_stend ub /end IN_MEASUREMENT
 /begin OUT_MEASUREMENT B_nachl B_nachlend B_nachlram B_nachlstp B_nlacls B_nlale B_nlatm B_nlcan B_nldtafx B_nldte B_nldval B_nldve B_nlEEPR B_nletm B_nlmls B_nlobd B_nlsgls B_nlsiko B_nlubr B_nlwfs B_nlwst swOffD2Bits swOffDlBits tnachl_w /end OUT_MEASUREMENT
 /begin LOC_MEASUREMENT /end LOC_MEASUREMENT
 /begin SUB_FUNCTION /end SUB_FUNCTION
/end FUNCTION
/begin FUNCTION NLDG "2.50      Notlauf Drehzahlgeber"
 /begin DEF_CHARACTERISTIC DYNMXNL FIRNLIGN FNLMI0 FNLMI1 FNLMI2 KLDTPH KLDTPHST KLDYNCOR KLNLPHN KLOELD KLOELT KLWNWI KNLSYN MXNLFEHL TNLPHWAIT TNLSYNMN TNLSYNMX /end DEF_CHARACTERISTIC
 /begin REF_CHARACTERISTIC CWNWREF WNWUEMXT /end REF_CHARACTERISTIC
 /begin IN_MEASUREMENT B_nldg B_phad B_phsok B_st B_switchpg B_wnwiout nmot synstate tabst_w tmot wnwi_ad_w wnwkwas_w wnwspas_w zphfl /end IN_MEASUREMENT
 /begin OUT_MEASUREMENT B_phnldg B_synnldg nsynnldg zphflsyn zueoffnl /end OUT_MEASUREMENT
 /begin LOC_MEASUREMENT B_2ph B_3ph B_ensynnl B_gapnldg B_kllknl B_lkklnl B_noknldg B_phfalse B_phnegtiv B_resetsyn B_rphsp B_synoknl B_wnwioutx dtsegph_w mtsegph_w tnbmphs0_w tPh1_w tsegph_w wnwix_w wnwkwasx_w wnwspasx_w zphflx /end LOC_MEASUREMENT
 /begin SUB_FUNCTION /end SUB_FUNCTION
/end FUNCTION
/begin FUNCTION NLPH "5.20      Notlauf Phasengeber"
 /begin DEF_CHARACTERISTIC ANZEAUS CWNLPH NPHERKMN NPHERKMX NPHINVMN NPHINVMX RLPHERKMN RLPHERKMX TPHERKMN TPHSABSP TPHSSP ZYLEAUS /end DEF_CHARACTERISTIC
 /begin REF_CHARACTERISTIC /end REF_CHARACTERISTIC
 /begin IN_MEASUREMENT B_bm B_dluerk_m B_ll B_luaerk_m B_luerk_m B_lustop_m B_mdstim_m B_mdstop_m B_nldg B_nlphea B_phaact B_phsok B_synph nmot rl synstate tmot zzyl /end IN_MEASUREMENT
 /begin OUT_MEASUREMENT anzeausb B_dopzue B_nlph B_nosynph B_phsnl B_phsnlab B_phsnlinv B_phsnlok B_stimnlph nsynnlph phLosCtr_w znlphausf znlphausr znlphstim zyleausb /end OUT_MEASUREMENT
 /begin LOC_MEASUREMENT B_delaysyn B_optpherk /end LOC_MEASUREMENT
 /begin SUB_FUNCTION /end SUB_FUNCTION
/end FUNCTION
/begin COMPU_METHOD B_TRUE "boolsche Zustände, positive Logik" TAB_VERB "%6.3" "" COMPU_TAB_REF B_TRUE /end COMPU_METHOD
/begin COMPU_VTAB B_TRUE "boolsche Zustände, positive Logik" TAB_VERB 2 0 "----" 1 "TRUE" /end COMPU_VTAB
/begin COMPU_METHOD DEZ "1 : 1 Umrechnug (dez/hex)" RAT_FUNC "%6.2" "" COEFFS 0 1 0 0 0 1 /end COMPU_METHOD
/begin COMPU_METHOD dez "1 : 1 Umrechnug (dez/hex)" RAT_FUNC "%6.2" "" COEFFS 0 1 0 0 0 1 /end COMPU_METHOD
/begin COMPU_METHOD dlw_sw_q0p04375 "" RAT_FUNC "%6.4" "°/s" COEFFS 0 32767 0 0 0 1434 /end COMPU_METHOD
/begin COMPU_METHOD fak_q0p0039 "" RAT_FUNC "%6.4" "-" COEFFS 0 256 0 0 0 1 /end COMPU_METHOD
/begin COMPU_METHOD fak_q0p0625 "" RAT_FUNC "%6.4" "-" COEFFS 0 16 0 0 0 1 /end COMPU_METHOD
/begin COMPU_METHOD fak_sb_b0p03125 "" RAT_FUNC "%6.5" "-" COEFFS 0 256 0 0 0 0.0625 /end COMPU_METHOD
/begin COMPU_METHOD fak_sb_b1 "" RAT_FUNC "%6.4" "-" COEFFS 0 256 0 0 0 2 /end COMPU_METHOD
/begin COMPU_METHOD fak_sw_b1 "" RAT_FUNC "%7.6" "-" COEFFS 0 65536 0 0 0 2 /end COMPU_METHOD
/begin COMPU_METHOD fak_sw_b2 "" RAT_FUNC "%7.6" "-" COEFFS 0 65536 0 0 0 4 /end COMPU_METHOD
/begin COMPU_METHOD fak_sw_b32 "" RAT_FUNC "%6.5" "-" COEFFS 0 65536 0 0 0 64 /end COMPU_METHOD
/begin COMPU_METHOD fak_sw_b4 "" RAT_FUNC "%6.5" "-" COEFFS 0 65536 0 0 0 8 /end COMPU_METHOD
/begin COMPU_METHOD fak_sw_b64 "" RAT_FUNC "%6.4" "-" COEFFS 0 65536 0 0 0 128 /end COMPU_METHOD
/begin COMPU_METHOD fak_sw_b8 "" RAT_FUNC "%6.5" "-" COEFFS 0 65536 0 0 0 16 /end COMPU_METHOD
/begin COMPU_METHOD fak_ub_b0p25 "" RAT_FUNC "%10.7" "-" COEFFS 0 256 0 0 0 0.25 /end COMPU_METHOD
/begin COMPU_METHOD fak_ub_b1 "" RAT_FUNC "%6.4" "-" COEFFS 0 256 0 0 0 1 /end COMPU_METHOD
/begin COMPU_METHOD fak_ub_b16 "" RAT_FUNC "%6.4" "-" COEFFS 0 256 0 0 0 16 /end COMPU_METHOD
/begin COMPU_METHOD fak_ub_b1p25_o0p75 "" RAT_FUNC "%6.3" "-" COEFFS 0 1 -0.75 0 0 0.00195313 /end COMPU_METHOD
/begin COMPU_METHOD fak_ub_b2 "" RAT_FUNC "%6.4" "-" COEFFS 0 256 0 0 0 2 /end COMPU_METHOD
/begin COMPU_METHOD fak_ub_b4 "" RAT_FUNC "%6.4" "-" COEFFS 0 256 0 0 0 4 /end COMPU_METHOD
/begin COMPU_METHOD fak_ub_b8 "" RAT_FUNC "%6.4" "-" COEFFS 0 256 0 0 0 8 /end COMPU_METHOD
/begin COMPU_METHOD fak_ub_q4p7Em7 "" RAT_FUNC "%11.10" "-" COEFFS 0 1 0 0 0 4.7e-007 /end COMPU_METHOD
/begin COMPU_METHOD fak_uw_b1 "" RAT_FUNC "%7.6" "-" COEFFS 0 65536 0 0 0 1 /end COMPU_METHOD
/begin COMPU_METHOD fak_uw_b128 "" RAT_FUNC "%6.4" "-" COEFFS 0 65536 0 0 0 128 /end COMPU_METHOD
/begin COMPU_METHOD fak_uw_b16 "" RAT_FUNC "%6.5" "-" COEFFS 0 65536 0 0 0 16 /end COMPU_METHOD
/begin COMPU_METHOD fak_uw_b2 "" RAT_FUNC "%7.6" "-" COEFFS 0 65536 0 0 0 2 /end COMPU_METHOD
/begin COMPU_METHOD fak_uw_b4 "" RAT_FUNC "%7.6" "-" COEFFS 0 65536 0 0 0 4 /end COMPU_METHOD
/begin COMPU_METHOD fak_uw_b64 "" RAT_FUNC "%6.5" "-" COEFFS 0 65536 0 0 0 64 /end COMPU_METHOD
/begin COMPU_METHOD fak_uw_b8 "" RAT_FUNC "%6.5" "-" COEFFS 0 65536 0 0 0 8 /end COMPU_METHOD
/begin COMPU_METHOD freq_ub_b0p05 "" RAT_FUNC "%6.5" "1/s" COEFFS 0 256 0 0 0 0.05 /end COMPU_METHOD
/begin COMPU_METHOD kw_q0p0156 "" RAT_FUNC "%6.4" "°KW" COEFFS 0 64 0 0 0 1 /end COMPU_METHOD
/begin COMPU_METHOD kw_q0p0625 "" RAT_FUNC "%6.4" "°KW" COEFFS 0 16 0 0 0 1 /end COMPU_METHOD
/begin COMPU_METHOD kw_q1 "" RAT_FUNC "%6.2" "°KW" COEFFS 0 1 0 0 0 1 /end COMPU_METHOD
/begin COMPU_METHOD kw_sw_b128 "" RAT_FUNC "%6.4" "°KW" COEFFS 0 65536 0 0 0 256 /end COMPU_METHOD
/begin COMPU_METHOD lw_sb_q11p2 "" RAT_FUNC "%6.1" "°" COEFFS 0 127 0 0 0 1434 /end COMPU_METHOD
/begin COMPU_METHOD m_ub_b1020 "" RAT_FUNC "%6.2" "kg/h" COEFFS 0 1 0 0 0 4 /end COMPU_METHOD
/begin COMPU_METHOD m_uw_b4660 "" RAT_FUNC "%6.4" "g" COEFFS 0 3600 0 0 0 256 /end COMPU_METHOD
/begin COMPU_METHOD m_uw_b6553p5 "" RAT_FUNC "%6.3" "kg/h" COEFFS 0 1 0 0 0 0.1 /end COMPU_METHOD
/begin COMPU_METHOD m_uw_b7281 "" RAT_FUNC "%6.3" "g" COEFFS 0 9 0 0 0 1 /end COMPU_METHOD
/begin COMPU_METHOD nmotg_sw_q0p39 "" RAT_FUNC "%6.3" "U/min/s" COEFFS 0 1 0 0 0 0.39063 /end COMPU_METHOD
/begin COMPU_METHOD nmot_q0p125 "" RAT_FUNC "%6.3" "U/min" COEFFS 0 1 0 0 0 0.125 /end COMPU_METHOD
/begin COMPU_METHOD nmot_ub_q40 "" RAT_FUNC "%6.1" "Upm" COEFFS 0 1 0 0 0 40 /end COMPU_METHOD
/begin COMPU_METHOD nmot_uw_q0p25 "" RAT_FUNC "%6.3" "U/min" COEFFS 0 1 0 0 0 0.25 /end COMPU_METHOD
/begin COMPU_METHOD relPED_ub_b100 "" RAT_FUNC "%6.3" "% PED" COEFFS 0 255 0 0 0 100 /end COMPU_METHOD
/begin COMPU_METHOD relPED_uw_b100 "" RAT_FUNC "%6.4" "% PED" COEFFS 0 65535 0 0 0 100 /end COMPU_METHOD
/begin COMPU_METHOD rel_q0p1957 "" RAT_FUNC "%6.3" "%" COEFFS 0 511 0 0 0 100 /end COMPU_METHOD
/begin COMPU_METHOD rel_q0p39 "" RAT_FUNC "%6.3" "%" COEFFS 0 256 0 0 0 100 /end COMPU_METHOD
/begin COMPU_METHOD rel_sb_q0p02 "" RAT_FUNC "%6.4" "%" COEFFS 0 50 0 0 0 1 /end COMPU_METHOD
/begin COMPU_METHOD rel_sb_q0p39 "" RAT_FUNC "%6.3" "%" COEFFS 0 1 0 0 0 0.3906 /end COMPU_METHOD
/begin COMPU_METHOD rel_sw_b100 "" RAT_FUNC "%6.4" "%" COEFFS 0 32768 0 0 0 100 /end COMPU_METHOD
/begin COMPU_METHOD rel_sw_b50 "" RAT_FUNC "%6.4" "%" COEFFS 0 65536 0 0 0 100 /end COMPU_METHOD
/begin COMPU_METHOD rel_sw_q0p0234 "" RAT_FUNC "%6.4" "%/seg" COEFFS 0 32 0 0 0 0.75 /end COMPU_METHOD
/begin COMPU_METHOD rel_ub_b100 "" RAT_FUNC "%6.3" "%" COEFFS 0 256 0 0 0 100 /end COMPU_METHOD
/begin COMPU_METHOD rel_ub_b127p5 "" RAT_FUNC "%6.3" "%" COEFFS 0 2 0 0 0 1 /end COMPU_METHOD
/begin COMPU_METHOD rel_ub_b24p9 "" RAT_FUNC "%6.3" "%" COEFFS 0 255 0 0 0 24.9 /end COMPU_METHOD
/begin COMPU_METHOD rel_ub_b2p0 "" RAT_FUNC "%6.4" "%" COEFFS 0 256 0 0 0 2 /end COMPU_METHOD
/begin COMPU_METHOD rel_ub_b49p725 "" RAT_FUNC "%6.3" "%" COEFFS 0 255 0 0 0 49.725 /end COMPU_METHOD
/begin COMPU_METHOD rel_ub_b99p6 "" RAT_FUNC "%6.3" "%" COEFFS 0 256 0 0 0 100 /end COMPU_METHOD
/begin COMPU_METHOD rel_ub_bn24p9 "" RAT_FUNC "%6.5" "%" COEFFS 0 -255 0 0 0 24.9 /end COMPU_METHOD
/begin COMPU_METHOD rel_ub_q0p75 "" RAT_FUNC "%6.3" "%" COEFFS 0 1 0 0 0 0.75 /end COMPU_METHOD
/begin COMPU_METHOD rel_uw_b100 "" RAT_FUNC "%6.4" "%" COEFFS 0 65536 0 0 0 100 /end COMPU_METHOD
/begin COMPU_METHOD rel_uw_b200 "" RAT_FUNC "%6.4" "%" COEFFS 0 65536 0 0 0 200 /end COMPU_METHOD
/begin COMPU_METHOD rel_uw_q0p001 "" RAT_FUNC "%6.5" "%" COEFFS 0 1000 0 0 0 1 /end COMPU_METHOD
/begin COMPU_METHOD rel_uw_q0p0234 "" RAT_FUNC "%6.4" "%" COEFFS 0 32 0 0 0 0.75 /end COMPU_METHOD
/begin COMPU_METHOD rfak_q0p5 "" RAT_FUNC "%6.2" "-" COEFFS 0 0 128 0 1 0 /end COMPU_METHOD
/begin COMPU_METHOD spg_ubatt "" RAT_FUNC "%6.4" "V" COEFFS 0 1 0 0 0 0.0704 /end COMPU_METHOD
/begin COMPU_METHOD spg_ub_q0p0052_o0p2 "" RAT_FUNC "%6.3" "V" COEFFS 0 255 51 0 0 1.33 /end COMPU_METHOD
/begin COMPU_METHOD spg_uw_q0p00488_o1 "" RAT_FUNC "%6.3" "V" COEFFS 0 1024 1024 0 0 5 /end COMPU_METHOD
/begin COMPU_METHOD t100msxs_ub_b25p5 "" RAT_FUNC "%6.3" "s" COEFFS 0 1 0 0 0 0.1 /end COMPU_METHOD
/begin COMPU_METHOD t100msxs_uw_b6553p5 "" RAT_FUNC "%6.3" "s" COEFFS 0 1 0 0 0 0.1 /end COMPU_METHOD
/begin COMPU_METHOD t100msxs_uw_b6553p6 "" RAT_FUNC "%6.3" "s" COEFFS 0 10 0 0 0 1 /end COMPU_METHOD
/begin COMPU_METHOD t10msxs_ub_b2p55 "" RAT_FUNC "%6.4" "s" COEFFS 0 1 0 0 0 0.01 /end COMPU_METHOD
/begin COMPU_METHOD t10msxs_uw_b655p35 "" RAT_FUNC "%6.4" "s" COEFFS 0 1 0 0 0 0.01 /end COMPU_METHOD
/begin COMPU_METHOD t1sxs_ub_b255 "" RAT_FUNC "%6.2" "s" COEFFS 0 1 0 0 0 1 /end COMPU_METHOD
/begin COMPU_METHOD t1sxs_uw_b65535 "" RAT_FUNC "%6.2" "s" COEFFS 0 1 0 0 0 1 /end COMPU_METHOD
/begin COMPU_METHOD t1sxs_uw_q1 "" RAT_FUNC "%6.2" "s" COEFFS 0 1 0 0 0 1 /end COMPU_METHOD
/begin COMPU_METHOD t200msxs_ub_b51 "" RAT_FUNC "%6.3" "s" COEFFS 0 1 0 0 0 0.2 /end COMPU_METHOD
/begin COMPU_METHOD t20msxs_ub_b5p1 "" RAT_FUNC "%6.4" "s" COEFFS 0 1 0 0 0 0.02 /end COMPU_METHOD
/begin COMPU_METHOD t20msxs_uw_q0p02 "" RAT_FUNC "%6.4" "s" COEFFS 0 1 0 0 0 0.02 /end COMPU_METHOD
/begin COMPU_METHOD t40usxus_q40 "" RAT_FUNC "%6.1" "us" COEFFS 0 1 0 0 0 40 /end COMPU_METHOD
/begin COMPU_METHOD t5usxus_q5 "" RAT_FUNC "%6.2" "us" COEFFS 0 1 0 0 0 5 /end COMPU_METHOD
/begin COMPU_METHOD temp_sb_q0p75 "" RAT_FUNC "%6.3" "Grad C" COEFFS 0 1 0 0 0 0.75 /end COMPU_METHOD
/begin COMPU_METHOD temp_ub_b191p25 "" RAT_FUNC "%6.3" "Grad C" COEFFS 0 1 0 0 0 0.75 /end COMPU_METHOD
/begin COMPU_METHOD temp_ub_q0p75_o48 "" RAT_FUNC "%6.2" "Grad C" COEFFS 0 1 48 0 0 0.75 /end COMPU_METHOD
/begin COMPU_METHOD temp_ub_q5_o50 "" RAT_FUNC "%6.2" "Grad C" COEFFS 0 1 50 0 0 5 /end COMPU_METHOD
/begin COMPU_METHOD temp_uw_q0p0195_o50 "" RAT_FUNC "%6.2" "Grad C" COEFFS 0 256 12800 0 0 5 /end COMPU_METHOD
/begin COMPU_METHOD tz10msxs_uw_b327p68 "" RAT_FUNC "%6.2" "s" COEFFS 0 0 327.68 0 1 0 /end COMPU_METHOD
/begin COMPU_METHOD t_q0p1 "" RAT_FUNC "%6.3" "s" COEFFS 0 10 0 0 0 1 /end COMPU_METHOD
/begin COMPU_METHOD vfzg_ub_q1p25 "" RAT_FUNC "%6.2" "km/h" COEFFS 0 1 0 0 0 1.25 /end COMPU_METHOD
/begin COMPU_METHOD zk100msxs_ub_b25p5 "" RAT_FUNC "%6.3" "s" COEFFS 0 0 256 0 10 0 /end COMPU_METHOD
/begin COMPU_METHOD zk10msxs_ub_b2p55 "" RAT_FUNC "%6.4" "s" COEFFS 0 0 255 0 100 0 /end COMPU_METHOD
/begin COMPU_METHOD zk10msxs_uw_b655 "" RAT_FUNC "%12.5" "s" COEFFS 0 0 65536 0 100 0 /end COMPU_METHOD
/begin COMPU_METHOD zk200msxs_uw_b13107 "" RAT_FUNC "%12.3" "s" COEFFS 0 0 13107.2 0 1 0 /end COMPU_METHOD
/begin COMPU_METHOD zk20msxs_ub_b5p1 "" RAT_FUNC "%6.4" "s" COEFFS 0 0 5.1 0 1 0 /end COMPU_METHOD
/begin COMPU_METHOD zk50msxs_uw_b3276p8 "" RAT_FUNC "%12.4" "s" COEFFS 0 0 65536 0 20 0 /end COMPU_METHOD
/begin COMPU_METHOD zw_sb_q0p75 "" RAT_FUNC "%6.3" "grad KW" COEFFS 0 255 0 0 0 191.25 /end COMPU_METHOD
/begin COMPU_METHOD zw_uw_q0p75 "" RAT_FUNC "%6.3" "Grad KW" COEFFS 0 1 0 0 0 0.75 /end COMPU_METHOD
/begin RECORD_LAYOUT FklWSb FNC_VALUES 1 SBYTE COLUMN_DIR DIRECT /end RECORD_LAYOUT
/begin RECORD_LAYOUT FklWUb FNC_VALUES 1 UBYTE COLUMN_DIR DIRECT /end RECORD_LAYOUT
/begin RECORD_LAYOUT GkfWSb FNC_VALUES 1 SBYTE COLUMN_DIR DIRECT /end RECORD_LAYOUT
/begin RECORD_LAYOUT GkfWSw FNC_VALUES 1 SWORD COLUMN_DIR DIRECT /end RECORD_LAYOUT
/begin RECORD_LAYOUT GkfWUb FNC_VALUES 1 UBYTE COLUMN_DIR DIRECT /end RECORD_LAYOUT
/begin RECORD_LAYOUT GkfWUw FNC_VALUES 1 UWORD COLUMN_DIR DIRECT /end RECORD_LAYOUT
/begin RECORD_LAYOUT GklWSb FNC_VALUES 1 SBYTE COLUMN_DIR DIRECT /end RECORD_LAYOUT
/begin RECORD_LAYOUT GklWSw FNC_VALUES 1 SWORD COLUMN_DIR DIRECT /end RECORD_LAYOUT
/begin RECORD_LAYOUT GklWUb FNC_VALUES 1 UBYTE COLUMN_DIR DIRECT /end RECORD_LAYOUT
/begin RECORD_LAYOUT GklWUw FNC_VALUES 1 UWORD COLUMN_DIR DIRECT /end RECORD_LAYOUT
/begin RECORD_LAYOUT KfAxUbAyUbSstxSwSstyUbWUw NO_AXIS_PTS_X 1 UBYTE NO_AXIS_PTS_Y 2 UBYTE AXIS_PTS_X 3 SWORD INDEX_INCR DIRECT AXIS_PTS_Y 4 UBYTE INDEX_INCR DIRECT FNC_VALUES 5 UWORD COLUMN_DIR DIRECT /end RECORD_LAYOUT
/begin RECORD_LAYOUT KfAxUbAyUbSstxUbSstyUbWUb NO_AXIS_PTS_X 1 UBYTE NO_AXIS_PTS_Y 2 UBYTE AXIS_PTS_X 3 UBYTE INDEX_INCR DIRECT AXIS_PTS_Y 4 UBYTE INDEX_INCR DIRECT FNC_VALUES 5 UBYTE COLUMN_DIR DIRECT /end RECORD_LAYOUT
/begin RECORD_LAYOUT KfAxUbAyUbSstxUbSstyUwWUw NO_AXIS_PTS_X 1 UBYTE NO_AXIS_PTS_Y 2 UBYTE AXIS_PTS_X 3 UBYTE INDEX_INCR DIRECT AXIS_PTS_Y 4 UWORD INDEX_INCR DIRECT FNC_VALUES 5 UWORD COLUMN_DIR DIRECT /end RECORD_LAYOUT
/begin RECORD_LAYOUT KfAxUwAyUwSstxSwSstyUwWUw NO_AXIS_PTS_X 1 UWORD NO_AXIS_PTS_Y 2 UWORD AXIS_PTS_X 3 SWORD INDEX_INCR DIRECT AXIS_PTS_Y 4 UWORD INDEX_INCR DIRECT FNC_VALUES 5 UWORD COLUMN_DIR DIRECT /end RECORD_LAYOUT
/begin RECORD_LAYOUT KfAxUwAyUwSstxUwSstyUwWUw NO_AXIS_PTS_X 1 UWORD NO_AXIS_PTS_Y 2 UWORD AXIS_PTS_X 3 UWORD INDEX_INCR DIRECT AXIS_PTS_Y 4 UWORD INDEX_INCR DIRECT FNC_VALUES 5 UWORD COLUMN_DIR DIRECT /end RECORD_LAYOUT
/begin RECORD_LAYOUT KlASwSstSwWSw NO_AXIS_PTS_X 1 SWORD AXIS_PTS_X 2 SWORD INDEX_INCR DIRECT FNC_VALUES 3 SWORD COLUMN_DIR DIRECT /end RECORD_LAYOUT
/begin RECORD_LAYOUT KlAUbSstSbWUb NO_AXIS_PTS_X 1 UBYTE AXIS_PTS_X 2 SBYTE INDEX_INCR DIRECT FNC_VALUES 3 UBYTE COLUMN_DIR DIRECT /end RECORD_LAYOUT
/begin RECORD_LAYOUT KlAUbSstUbWSb NO_AXIS_PTS_X 1 UBYTE AXIS_PTS_X 2 UBYTE INDEX_INCR DIRECT FNC_VALUES 3 SBYTE COLUMN_DIR DIRECT /end RECORD_LAYOUT
/begin RECORD_LAYOUT KlAUbSstUbWUb NO_AXIS_PTS_X 1 UBYTE AXIS_PTS_X 2 UBYTE INDEX_INCR DIRECT FNC_VALUES 3 UBYTE COLUMN_DIR DIRECT /end RECORD_LAYOUT
/begin RECORD_LAYOUT KlAUbSstUbWUw NO_AXIS_PTS_X 1 UBYTE AXIS_PTS_X 2 UBYTE INDEX_INCR DIRECT FNC_VALUES 3 UWORD COLUMN_DIR DIRECT /end RECORD_LAYOUT
/begin RECORD_LAYOUT KlAUwSstSwWUw NO_AXIS_PTS_X 1 UWORD AXIS_PTS_X 2 SWORD INDEX_INCR DIRECT FNC_VALUES 3 UWORD COLUMN_DIR DIRECT /end RECORD_LAYOUT
/begin RECORD_LAYOUT KlAUwSstUwWUb NO_AXIS_PTS_X 1 UWORD AXIS_PTS_X 2 UWORD INDEX_INCR DIRECT FNC_VALUES 3 UBYTE COLUMN_DIR DIRECT /end RECORD_LAYOUT
/begin RECORD_LAYOUT KlAUwSstUwWUw NO_AXIS_PTS_X 1 UWORD AXIS_PTS_X 2 UWORD INDEX_INCR DIRECT FNC_VALUES 3 UWORD COLUMN_DIR DIRECT /end RECORD_LAYOUT
/begin RECORD_LAYOUT KwSb FNC_VALUES 1 SBYTE COLUMN_DIR DIRECT /end RECORD_LAYOUT
/begin RECORD_LAYOUT KwSw FNC_VALUES 1 SWORD COLUMN_DIR DIRECT /end RECORD_LAYOUT
/begin RECORD_LAYOUT KwUb FNC_VALUES 1 UBYTE COLUMN_DIR DIRECT /end RECORD_LAYOUT
/begin RECORD_LAYOUT KwUw FNC_VALUES 1 UWORD COLUMN_DIR DIRECT /end RECORD_LAYOUT
/begin RECORD_LAYOUT SstASwSstSw NO_AXIS_PTS_X 1 SWORD AXIS_PTS_X 2 SWORD INDEX_INCR DIRECT /end RECORD_LAYOUT
/begin RECORD_LAYOUT SstAUbSstUb NO_AXIS_PTS_X 1 UBYTE AXIS_PTS_X 2 UBYTE INDEX_INCR DIRECT /end RECORD_LAYOUT
/begin RECORD_LAYOUT SstAUwSstUw NO_AXIS_PTS_X 1 UWORD AXIS_PTS_X 2 UWORD INDEX_INCR DIRECT /end RECORD_LAYOUT
/end MODULE
/end PROJECT
