/begin PROJECT X505S24EX "4016.32"
/begin HEADER "" VERSION "X505S24EX" PROJECT_NO X505S24EX /end HEADER
/begin MODULE DIM ""
/begin MOD_COMMON "" BYTE_ORDER BIG_ENDIAN S_REC_LAYOUT DAMOS /end MOD_COMMON
/begin CHARACTERISTIC FEMPOS "Schwelle für oberen Anschlag des mult. Anteils des Füllungsabgleichs" VALUE 0x81D746 KwUw 3.999939 fak_uw_b4 0.00 3.999939 FUNCTION_LIST DEGFE IF_DATA DIM_X DIRECT 0x81D746 /end CHARACTERISTIC
/begin CHARACTERISTIC FEMPUS "Schwelle für unteren Anschlag des mult. Anteils des Füllungsabgleichs" VALUE 0x81D748 KwUw 3.999939 fak_uw_b4 0.00 3.999939 FUNCTION_LIST DEGFE IF_DATA DIM_X DIRECT 0x81D748 /end CHARACTERISTIC
/begin CHARACTERISTIC FETATEBN "Kennlinie für drehzahlabhängigen Sollwert des Motorwirkungsgrades" CURVE 0x81A56A KlAUbSstUbWUb 0.9961 fak_ub_b1 0.00 0.9961 FUNCTION_LIST TEB IF_DATA DIM_X DIRECT 0x81A56A /begin AXIS_DESCR STD_AXIS nmot nmot_ub_q40 5 0.00 10200. DEPOSIT ABSOLUT /end AXIS_DESCR /end CHARACTERISTIC
/begin CHARACTERISTIC FFLDZ "Folgefunkenladezeit" CURVE 0x82AFD8 KlAUbSstUbWUw 43.69000 tsegment_sy 0.00 43.69000 FUNCTION_LIST ZUESZ IF_DATA DIM_X DIRECT 0x82AFD8 /begin AXIS_DESCR STD_AXIS ub spg_ubatt 8 0.00 17.95 DEPOSIT ABSOLUT /end AXIS_DESCR /end CHARACTERISTIC
/begin CHARACTERISTIC FFTAAA "Dummy: Tabellenanfang" VAL_BLK 0x810DF2 KwbUb 255.0 dez 0.00 255.0 NUMBER 2 FUNCTION_LIST DFPM_DFPM IF_DATA DIM_X DIRECT 0x810DF2 /end CHARACTERISTIC
/begin CHARACTERISTIC FFTAATUN "Freeze Frame Tabelle: Tuningschutz" VAL_BLK 0x810DF4 KwbUb 255.0 dez 0.00 255.0 NUMBER 2 FUNCTION_LIST DFPM_TUNING IF_DATA DIM_X DIRECT 0x810DF4 /end CHARACTERISTIC
/begin CHARACTERISTIC FFTAGRE "Freeze Frame Tabelle: AGR-Ventil Endstufe" VAL_BLK 0x810DF6 KwbUb 255.0 dez 0.00 255.0 NUMBER 2 FUNCTION_LIST DFPM_DEKON IF_DATA DIM_X DIRECT 0x810DF6 /end CHARACTERISTIC
/begin CHARACTERISTIC FFTAGRF "Freeze Frame Tabelle: Überwachung AGR-Flow" VAL_BLK 0x810DF8 KwbUb 255.0 dez 0.00 255.0 NUMBER 2 FUNCTION_LIST DFPM_DUMMY_D IF_DATA DIM_X DIRECT 0x810DF8 /end CHARACTERISTIC
/begin CHARACTERISTIC FFTBKVP "" VAL_BLK 0x810DFA KwbUb 255.0 dez 0.00 255.0 NUMBER 2 FUNCTION_LIST DFPM_DBKVP IF_DATA DIM_X DIRECT 0x810DFA /end CHARACTERISTIC
/begin CHARACTERISTIC FFTBKVPE "" VAL_BLK 0x810DFC KwbUb 255.0 dez 0.00 255.0 NUMBER 2 FUNCTION_LIST DFPM_DEKON IF_DATA DIM_X DIRECT 0x810DFC /end CHARACTERISTIC
/begin CHARACTERISTIC FFTBM "Freeze Frame Tabelle: Bezugsmarkengeber" VAL_BLK 0x810DFE KwbUb 255.0 dez 0.00 255.0 NUMBER 2 FUNCTION_LIST DFPM_DDG IF_DATA DIM_X DIRECT 0x810DFE /end CHARACTERISTIC
/begin CHARACTERISTIC FFTBREMS "Freeze Frame Tabelle: Pedalwertgeber Bremse" VAL_BLK 0x810E00 KwbUb 255.0 dez 0.00 255.0 NUMBER 2 FUNCTION_LIST DFPM_GGEGAS IF_DATA DIM_X DIRECT 0x810E00 /end CHARACTERISTIC
/begin CHARACTERISTIC FFTBWF "Freeze Frame Tabelle: PWG Bewegung" VAL_BLK 0x810E02 KwbUb 255.0 dez 0.00 255.0 NUMBER 2 FUNCTION_LIST DFPM_GGPED IF_DATA DIM_X DIRECT 0x810E02 /end CHARACTERISTIC
/begin CHARACTERISTIC FFTCAIR "Freeze Frame Tabelle: Airbag-Botschaft" VAL_BLK 0x810E04 KwbUb 255.0 dez 0.00 255.0 NUMBER 2 FUNCTION_LIST DFPM_CAIR IF_DATA DIM_X DIRECT 0x810E04 /end CHARACTERISTIC
/begin CHARACTERISTIC FFTCAIRP "Freeze Frame Tabelle: unpl. Airbag-Botschaft" VAL_BLK 0x810E06 KwbUb 255.0 dez 0.00 255.0 NUMBER 2 FUNCTION_LIST DFPM_GGCS IF_DATA DIM_X DIRECT 0x810E06 /end CHARACTERISTIC
/begin CHARACTERISTIC FFTCAS "Freeze Frame Tabelle: CAN-Timeout ASC-Botschaft" VAL_BLK 0x810E08 KwbUb 255.0 dez 0.00 255.0 NUMBER 2 FUNCTION_LIST DFPM_CAS IF_DATA DIM_X DIRECT 0x810E08 /end CHARACTERISTIC
/begin CHARACTERISTIC FFTCAT "Freeze Frame Tabelle: CAN-Schnittstelle, Timeout ASR" VAL_BLK 0x810E0A KwbUb 255.0 dez 0.00 255.0 NUMBER 2 FUNCTION_LIST DFPM_CAT IF_DATA DIM_X DIRECT 0x810E0A /end CHARACTERISTIC
/begin CHARACTERISTIC FFTCGE "Freeze Frame Tabelle: CAN-Timeout EGS-Botschaft" VAL_BLK 0x810E0C KwbUb 255.0 dez 0.00 255.0 NUMBER 2 FUNCTION_LIST DFPM_CGE IF_DATA DIM_X DIRECT 0x810E0C /end CHARACTERISTIC
/begin CHARACTERISTIC FFTCGRA "Freeze Frame Tabelle: GRA-Botschaft (Empfang)" VAL_BLK 0x810E0E KwbUb 255.0 dez 0.00 255.0 NUMBER 2 FUNCTION_LIST DFPM_CGRA IF_DATA DIM_X DIRECT 0x810E0E /end CHARACTERISTIC
/begin CHARACTERISTIC FFTCIF "Freeze Frame Tabelle: CAN-Schnittstelle, interner Fehler" VAL_BLK 0x810E10 KwbUb 255.0 dez 0.00 255.0 NUMBER 2 FUNCTION_LIST DFPM_CIF IF_DATA DIM_X DIRECT 0x810E10 /end CHARACTERISTIC
/begin CHARACTERISTIC FFTCINS "Freeze Frame Tabelle: CAN-Timeout Instr.-Botschaft" VAL_BLK 0x810E12 KwbUb 255.0 dez 0.00 255.0 NUMBER 2 FUNCTION_LIST DFPM_CINS IF_DATA DIM_X DIRECT 0x810E12 /end CHARACTERISTIC
/begin CHARACTERISTIC FFTCKLA "" VAL_BLK 0x810E14 KwbUb 255.0 dez 0.00 255.0 NUMBER 2 FUNCTION_LIST DFPM_CKLA IF_DATA DIM_X DIRECT 0x810E14 /end CHARACTERISTIC
/begin CHARACTERISTIC FFTCLWS "Freeze Frame Tabelle: CAN-Schnittstelle, Timeout Botschaft Lenkwinkelsensor" VAL_BLK 0x810E16 KwbUb 255.0 dez 0.00 255.0 NUMBER 2 FUNCTION_LIST DFPM_CLWS IF_DATA DIM_X DIRECT 0x810E16 /end CHARACTERISTIC
/begin CHARACTERISTIC FFTDPL "Freeze Frame Tabelle: Dauerplus" VAL_BLK 0x810E20 KwbUb 255.0 dez 0.00 255.0 NUMBER 2 FUNCTION_LIST DFPM_DPL IF_DATA DIM_X DIRECT 0x810E20 /end CHARACTERISTIC
/begin CHARACTERISTIC FFTDSBKV "Freeze Frame Tabelle: BKV" VAL_BLK 0x810E22 KwbUb 255.0 dez 0.00 255.0 NUMBER 2 FUNCTION_LIST DFPM_DSBKV IF_DATA DIM_X DIRECT 0x810E22 /end CHARACTERISTIC
/begin CHARACTERISTIC FFTDSL "Freeze Frame Tabelle: Drucksensor Ladedruck" VAL_BLK 0x810E24 KwbUb 255.0 dez 0.00 255.0 NUMBER 2 FUNCTION_LIST DFPM_GGDSAS IF_DATA DIM_X DIRECT 0x810E24 /end CHARACTERISTIC
/begin CHARACTERISTIC FFTDSU "Freeze Frame Tabelle: Umgebungsdrucksensor" VAL_BLK 0x810E26 KwbUb 255.0 dez 0.00 255.0 NUMBER 2 FUNCTION_LIST DFPM_GGDSAS IF_DATA DIM_X DIRECT 0x810E26 /end CHARACTERISTIC
/begin CHARACTERISTIC FFTDSVLU "Freeze Frame Tabelle: Drucksensorsignalvergleich (DS-L DS-U)" VAL_BLK 0x810E28 KwbUb 255.0 dez 0.00 255.0 NUMBER 2 FUNCTION_LIST DFPM_GGDSAS IF_DATA DIM_X DIRECT 0x810E28 /end CHARACTERISTIC
/begin CHARACTERISTIC FFTDVEE "Freeze Frame Tabelle: DV-E Endstufe" VAL_BLK 0x810E2A KwbUb 255.0 dez 0.00 255.0 NUMBER 2 FUNCTION_LIST DFPM_DDVE IF_DATA DIM_X DIRECT 0x810E2A /end CHARACTERISTIC
/begin CHARACTERISTIC FFTDVEF "Freeze Frame Tabelle: DV-E Fehler bei Federprüfung" VAL_BLK 0x810E2C KwbUb 255.0 dez 0.00 255.0 NUMBER 2 FUNCTION_LIST DFPM_DDVE IF_DATA DIM_X DIRECT 0x810E2C /end CHARACTERISTIC
/begin CHARACTERISTIC FFTDVEFO "" VAL_BLK 0x810E2E KwbUb 255.0 dez 0.00 255.0 NUMBER 2 FUNCTION_LIST DFPM_DDVE IF_DATA DIM_X DIRECT 0x810E2E /end CHARACTERISTIC
/begin CHARACTERISTIC FFTDVEL "Freeze Frame Tabelle: DV-E Lageabweichung" VAL_BLK 0x810E30 KwbUb 255.0 dez 0.00 255.0 NUMBER 2 FUNCTION_LIST DFPM_DDVE IF_DATA DIM_X DIRECT 0x810E30 /end CHARACTERISTIC
/begin CHARACTERISTIC FFTDVEN "Freeze Frame Tabelle: DV-E Fehler bei Prüfung Notluftposition" VAL_BLK 0x810E32 KwbUb 255.0 dez 0.00 255.0 NUMBER 2 FUNCTION_LIST DFPM_DDVE IF_DATA DIM_X DIRECT 0x810E32 /end CHARACTERISTIC
/begin CHARACTERISTIC FFTDVER "Freeze Frame Tabelle: DV-E Regelbereich" VAL_BLK 0x810E34 KwbUb 255.0 dez 0.00 255.0 NUMBER 2 FUNCTION_LIST DFPM_DDVE IF_DATA DIM_X DIRECT 0x810E34 /end CHARACTERISTIC
/begin CHARACTERISTIC FFTDVET "" VAL_BLK 0x810E36 KwbUb 255.0 dez 0.00 255.0 NUMBER 2 FUNCTION_LIST DFPM_DDVE IF_DATA DIM_X DIRECT 0x810E36 /end CHARACTERISTIC
/begin CHARACTERISTIC FFTDVEU "Freeze Frame Tabelle: DV-E Fehler beim UMA-Lernen" VAL_BLK 0x810E38 KwbUb 255.0 dez 0.00 255.0 NUMBER 2 FUNCTION_LIST DFPM_DDVE IF_DATA DIM_X DIRECT 0x810E38 /end CHARACTERISTIC
/begin CHARACTERISTIC FFTDVEUB "" VAL_BLK 0x810E3A KwbUb 255.0 dez 0.00 255.0 NUMBER 2 FUNCTION_LIST DFPM_DDVE IF_DATA DIM_X DIRECT 0x810E3A /end CHARACTERISTIC
/begin CHARACTERISTIC FFTDVEUW "" VAL_BLK 0x810E3C KwbUb 255.0 dez 0.00 255.0 NUMBER 2 FUNCTION_LIST DFPM_DDVE IF_DATA DIM_X DIRECT 0x810E3C /end CHARACTERISTIC
/begin CHARACTERISTIC FFTDVEV "Freeze Frame Tabelle: DV-E Fehler bei Verstärkerabgleich" VAL_BLK 0x810E3E KwbUb 255.0 dez 0.00 255.0 NUMBER 2 FUNCTION_LIST DFPM_DDVE IF_DATA DIM_X DIRECT 0x810E3E /end CHARACTERISTIC
/begin CHARACTERISTIC FFTEGFE "Freeze Frame Tabelle: Lasterfassung" VAL_BLK 0x810E40 KwbUb 255.0 dez 0.00 255.0 NUMBER 2 FUNCTION_LIST DFPM_DEGFE IF_DATA DIM_X DIRECT 0x810E40 /end CHARACTERISTIC
/begin CHARACTERISTIC FFTENWS "Freeze Frame Tabelle: Nockenwellensteuerung Einlass Nockenwelle" VAL_BLK 0x810E42 KwbUb 255.0 dez 0.00 255.0 NUMBER 2 FUNCTION_LIST DFPM_DENWS IF_DATA DIM_X DIRECT 0x810E42 /end CHARACTERISTIC
/begin CHARACTERISTIC FFTENWSE "Freeze Frame Tabelle: Einlaßnockenwelle- Endstufe" VAL_BLK 0x810E44 KwbUb 255.0 dez 0.00 255.0 NUMBER 2 FUNCTION_LIST DFPM_DEKON IF_DATA DIM_X DIRECT 0x810E44 /end CHARACTERISTIC
/begin CHARACTERISTIC FFTETRE "Freeze Frame Tabelle: El. Thermostat-Endstufe" VAL_BLK 0x810E46 KwbUb 255.0 dez 0.00 255.0 NUMBER 2 FUNCTION_LIST DFPM_DEKON IF_DATA DIM_X DIRECT 0x810E46 /end CHARACTERISTIC
/begin CHARACTERISTIC FFTEV1 "Freeze Frame Tabelle: EV Endstufe 1" VAL_BLK 0x810E48 KwbUb 255.0 dez 0.00 255.0 NUMBER 2 FUNCTION_LIST DFPM_DEKON IF_DATA DIM_X DIRECT 0x810E48 /end CHARACTERISTIC
/begin CHARACTERISTIC FFTEV2 "Freeze Frame Tabelle: EV Endstufe 2" VAL_BLK 0x810E4A KwbUb 255.0 dez 0.00 255.0 NUMBER 2 FUNCTION_LIST DFPM_DEKON IF_DATA DIM_X DIRECT 0x810E4A /end CHARACTERISTIC
/begin CHARACTERISTIC FFTEV3 "Freeze Frame Tabelle: EV Endstufe 3" VAL_BLK 0x810E4C KwbUb 255.0 dez 0.00 255.0 NUMBER 2 FUNCTION_LIST DFPM_DEKON IF_DATA DIM_X DIRECT 0x810E4C /end CHARACTERISTIC
/begin CHARACTERISTIC FFTEV4 "Freeze Frame Tabelle: EV Endstufe 4" VAL_BLK 0x810E4E KwbUb 255.0 dez 0.00 255.0 NUMBER 2 FUNCTION_LIST DFPM_DEKON IF_DATA DIM_X DIRECT 0x810E4E /end CHARACTERISTIC
/begin CHARACTERISTIC FFTFP1P "Freeze Frame Tabelle: Poti 1, Fahrpedal" VAL_BLK 0x810E50 KwbUb 255.0 dez 0.00 255.0 NUMBER 2 FUNCTION_LIST DFPM_GGPED IF_DATA DIM_X DIRECT 0x810E50 /end CHARACTERISTIC
/begin CHARACTERISTIC FFTFP2P "Freeze Frame Tabelle: Poti 2, Fahrpedal" VAL_BLK 0x810E52 KwbUb 255.0 dez 0.00 255.0 NUMBER 2 FUNCTION_LIST DFPM_GGPED IF_DATA DIM_X DIRECT 0x810E52 /end CHARACTERISTIC
/begin CHARACTERISTIC FFTFPP "Freeze Frame Tabelle: Poti Fahrpedal" VAL_BLK 0x810E54 KwbUb 255.0 dez 0.00 255.0 NUMBER 2 FUNCTION_LIST DFPM_GGPED IF_DATA DIM_X DIRECT 0x810E54 /end CHARACTERISTIC
/begin CHARACTERISTIC FFTFRAO "Freeze Frame Tabelle: FRAO Gemischadaption" VAL_BLK 0x810E56 KwbUb 255.0 dez 0.00 255.0 NUMBER 2 FUNCTION_LIST DFPM_DKVS IF_DATA DIM_X DIRECT 0x810E56 /end CHARACTERISTIC
/begin CHARACTERISTIC FFTFRAU "Freeze Frame Tabelle: FRAU Gemischadaption" VAL_BLK 0x810E58 KwbUb 255.0 dez 0.00 255.0 NUMBER 2 FUNCTION_LIST DFPM_DKVS IF_DATA DIM_X DIRECT 0x810E58 /end CHARACTERISTIC
/begin CHARACTERISTIC FFTFRST "Freeze Frame Tabelle: LR-Abweichung" VAL_BLK 0x810E5A KwbUb 255.0 dez 0.00 255.0 NUMBER 2 FUNCTION_LIST DFPM_DKVS IF_DATA DIM_X DIRECT 0x810E5A /end CHARACTERISTIC
/begin CHARACTERISTIC FFTGECOD "Freeze Frame Tabelle: Getriebecodierung CAN" VAL_BLK 0x810E5C KwbUb 255.0 dez 0.00 255.0 NUMBER 2 FUNCTION_LIST DFPM_GECOD IF_DATA DIM_X DIRECT 0x810E5C /end CHARACTERISTIC
/begin CHARACTERISTIC FFTGRBH "Freeze Frame Tabelle: GRA- Bedienhebel" VAL_BLK 0x810E5E KwbUb 255.0 dez 0.00 255.0 NUMBER 2 FUNCTION_LIST DFPM_GGFGRH IF_DATA DIM_X DIRECT 0x810E5E /end CHARACTERISTIC
/begin CHARACTERISTIC FFTHLA "Freeze Frame Tabelle: Heizleistungsanforderung" VAL_BLK 0x810E60 KwbUb 255.0 dez 0.00 255.0 NUMBER 2 FUNCTION_LIST DFPM_GGHLA IF_DATA DIM_X DIRECT 0x810E60 /end CHARACTERISTIC
/begin CHARACTERISTIC FFTHRE "" VAL_BLK 0x810E62 KwbUb 255.0 dez 0.00 255.0 NUMBER 2 FUNCTION_LIST DFPM_HRE IF_DATA DIM_X DIRECT 0x810E62 /end CHARACTERISTIC
/begin CHARACTERISTIC FFTHSH "Tabelle Umweltbedingungen Heizung Lambdasonde hinter Kat" VAL_BLK 0x810E64 KwbUb 255.0 dez 0.00 255.0 NUMBER 2 FUNCTION_LIST DFPM_DHLSHK IF_DATA DIM_X DIRECT 0x810E64 /end CHARACTERISTIC
/begin CHARACTERISTIC FFTHSH2 "Tabelle Umweltbedingungen Heizung Lambdasonde hinter Kat Bank2" VAL_BLK 0x810E66 KwbUb 255.0 dez 0.00 255.0 NUMBER 2 FUNCTION_LIST DFPM_DHLSHK IF_DATA DIM_X DIRECT 0x810E66 /end CHARACTERISTIC
/begin CHARACTERISTIC FFTHSHE "Tabelle Umweltbedingungen Endstufe Heizung Lambdasonde hinter Kat" VAL_BLK 0x810E68 KwbUb 255.0 dez 0.00 255.0 NUMBER 2 FUNCTION_LIST DFPM_DEKON IF_DATA DIM_X DIRECT 0x810E68 /end CHARACTERISTIC
/begin CHARACTERISTIC FFTHSV "Tabelle Umweltbedingungen Heizung Lambdasonde vor Kat" VAL_BLK 0x810E6A KwbUb 255.0 dez 0.00 255.0 NUMBER 2 FUNCTION_LIST DFPM_DHLSU IF_DATA DIM_X DIRECT 0x810E6A /end CHARACTERISTIC
/begin CHARACTERISTIC FFTHSV2 "Tabelle Umweltbedingungen Heizung Lambdasonde vor Kat Bank2" VAL_BLK 0x810E6C KwbUb 255.0 dez 0.00 255.0 NUMBER 2 FUNCTION_LIST DFPM_DHLSU IF_DATA DIM_X DIRECT 0x810E6C /end CHARACTERISTIC
/begin CHARACTERISTIC FFTHSVSA "Tabelle Umweltbedingungen Heizung Lambdasonde vor Kat" VAL_BLK 0x810E6E KwbUb 255.0 dez 0.00 255.0 NUMBER 2 FUNCTION_LIST DFPM_DHLSU IF_DATA DIM_X DIRECT 0x810E6E /end CHARACTERISTIC
/begin CHARACTERISTIC FFTHSVSA2 "Tabelle Umweltbedingungen Heizung Lambdasonde vor Kat Bank2" VAL_BLK 0x810E70 KwbUb 255.0 dez 0.00 255.0 NUMBER 2 FUNCTION_LIST DFPM_DHLSU IF_DATA DIM_X DIRECT 0x810E70 /end CHARACTERISTIC
/begin CHARACTERISTIC FFTKAT "Freeze Frame Tabelle: Katalysator" VAL_BLK 0x810E72 KwbUb 255.0 dez 0.00 255.0 NUMBER 2 FUNCTION_LIST DFPM_DKATSP IF_DATA DIM_X DIRECT 0x810E72 /end CHARACTERISTIC
/begin CHARACTERISTIC FFTKPE "Freeze Frame Tabelle: EKP-Relais Endstufe" VAL_BLK 0x810E74 KwbUb 255.0 dez 0.00 255.0 NUMBER 2 FUNCTION_LIST DFPM_DEKON IF_DATA DIM_X DIRECT 0x810E74 /end CHARACTERISTIC
/begin CHARACTERISTIC FFTKRA01 "Freeze Frame Tabelle: Klopfregelanschlag Zylinder 1" VAL_BLK 0x810E76 KwbUb 255.0 dez 0.00 255.0 NUMBER 2 FUNCTION_LIST DFPM_DKRA IF_DATA DIM_X DIRECT 0x810E76 /end CHARACTERISTIC
/begin CHARACTERISTIC FFTKRA02 "Freeze Frame Tabelle: Klopfregelanschlag Zylinder 2" VAL_BLK 0x810E78 KwbUb 255.0 dez 0.00 255.0 NUMBER 2 FUNCTION_LIST DFPM_DKRA IF_DATA DIM_X DIRECT 0x810E78 /end CHARACTERISTIC
/begin CHARACTERISTIC FFTKRA03 "Freeze Frame Tabelle: Klopfregelanschlag Zylinder 3" VAL_BLK 0x810E7A KwbUb 255.0 dez 0.00 255.0 NUMBER 2 FUNCTION_LIST DFPM_DKRA IF_DATA DIM_X DIRECT 0x810E7A /end CHARACTERISTIC
/begin CHARACTERISTIC FFTKRA04 "Freeze Frame Tabelle: Klopfregelanschlag Zylinder 4" VAL_BLK 0x810E7C KwbUb 255.0 dez 0.00 255.0 NUMBER 2 FUNCTION_LIST DFPM_DKRA IF_DATA DIM_X DIRECT 0x810E7C /end CHARACTERISTIC
/begin CHARACTERISTIC FFTKRNT "Freeze frame Tabelle: Klopfregelung Nulltest" VAL_BLK 0x810E7E KwbUb 255.0 dez 0.00 255.0 NUMBER 2 FUNCTION_LIST DFPM_DKRNT IF_DATA DIM_X DIRECT 0x810E7E /end CHARACTERISTIC
/begin CHARACTERISTIC FFTKROF "Freeze Frame Tabelle: Klopfregelung Offset" VAL_BLK 0x810E80 KwbUb 255.0 dez 0.00 255.0 NUMBER 2 FUNCTION_LIST DFPM_DKRNT IF_DATA DIM_X DIRECT 0x810E80 /end CHARACTERISTIC
/begin CHARACTERISTIC FFTKRTP "Freeze Frame Tabelle: Klopfregelung Testimpuls" VAL_BLK 0x810E82 KwbUb 255.0 dez 0.00 255.0 NUMBER 2 FUNCTION_LIST DFPM_DKRTP IF_DATA DIM_X DIRECT 0x810E82 /end CHARACTERISTIC
/begin CHARACTERISTIC FFTKS1 "Freeze Frame Tabelle: Klopfsensor 1" VAL_BLK 0x810E84 KwbUb 255.0 dez 0.00 255.0 NUMBER 2 FUNCTION_LIST DFPM_DKRS IF_DATA DIM_X DIRECT 0x810E84 /end CHARACTERISTIC
/begin CHARACTERISTIC FFTKS2 "Freeze Frame Tabelle: Klopfsensor 2" VAL_BLK 0x810E86 KwbUb 255.0 dez 0.00 255.0 NUMBER 2 FUNCTION_LIST DFPM_DKRS IF_DATA DIM_X DIRECT 0x810E86 /end CHARACTERISTIC
/begin CHARACTERISTIC FFTKS3 "Freeze Frame Tabelle: Klopfsensor 3" VAL_BLK 0x810E88 KwbUb 255.0 dez 0.00 255.0 NUMBER 2 FUNCTION_LIST DFPM_DKRS IF_DATA DIM_X DIRECT 0x810E88 /end CHARACTERISTIC
/begin CHARACTERISTIC FFTKS4 "Freeze Frame Tabelle: Klopfsensor 4" VAL_BLK 0x810E8A KwbUb 255.0 dez 0.00 255.0 NUMBER 2 FUNCTION_LIST DFPM_DKRS IF_DATA DIM_X DIRECT 0x810E8A /end CHARACTERISTIC
/begin CHARACTERISTIC FFTKUPPL "Freeze Frame Tabelle: Pedalwertgeber Kupplung" VAL_BLK 0x810E8C KwbUb 255.0 dez 0.00 255.0 NUMBER 2 FUNCTION_LIST DFPM_DKUPPL IF_DATA DIM_X DIRECT 0x810E8C /end CHARACTERISTIC
/begin CHARACTERISTIC FFTLASH "Tabelle Umweltbedingungen Lambdasonde hinter Kat" VAL_BLK 0x810E8E KwbUb 255.0 dez 0.00 255.0 NUMBER 2 FUNCTION_LIST DFPM_DLSAHK IF_DATA DIM_X DIRECT 0x810E8E /end CHARACTERISTIC
/begin CHARACTERISTIC FFTLDE "Freeze Frame Tabelle: LDR Taktventil Endstufe" VAL_BLK 0x810E90 KwbUb 255.0 dez 0.00 255.0 NUMBER 2 FUNCTION_LIST DFPM_DEKON IF_DATA DIM_X DIRECT 0x810E90 /end CHARACTERISTIC
/begin CHARACTERISTIC FFTLDO "Freeze Frame Tabelle: LDR Überladefehler" VAL_BLK 0x810E92 KwbUb 255.0 dez 0.00 255.0 NUMBER 2 FUNCTION_LIST DFPM_DLDR IF_DATA DIM_X DIRECT 0x810E92 /end CHARACTERISTIC
/begin CHARACTERISTIC FFTLDPE "Freeze Frame Tabelle: LDP Endstufe" VAL_BLK 0x810E96 KwbUb 255.0 dez 0.00 255.0 NUMBER 2 FUNCTION_LIST DFPM_LDPE IF_DATA DIM_X DIRECT 0x810E96 /end CHARACTERISTIC
/begin CHARACTERISTIC FFTLDRA "Freeze Frame Tabelle: LDR Regelabweichungsfehler" VAL_BLK 0x810E98 KwbUb 255.0 dez 0.00 255.0 NUMBER 2 FUNCTION_LIST DFPM_DLDR IF_DATA DIM_X DIRECT 0x810E98 /end CHARACTERISTIC
/begin CHARACTERISTIC FFTLDUV "Freeze Frame Tabelle: Schubumluftventil-Endstufe" VAL_BLK 0x810E9A KwbUb 255.0 dez 0.00 255.0 NUMBER 2 FUNCTION_LIST DFPM_DLDUV IF_DATA DIM_X DIRECT 0x810E9A /end CHARACTERISTIC
/begin CHARACTERISTIC FFTLKVDK "Freeze Frame Tabelle: Leck vor Drosselklappe" VAL_BLK 0x810E9C KwbUb 255.0 dez 0.00 255.0 NUMBER 2 FUNCTION_LIST DFPM_DLDR IF_DATA DIM_X DIRECT 0x810E9C /end CHARACTERISTIC
/begin CHARACTERISTIC FFTLM "Freeze Frame Tabelle: Hauptfüllungssensor" VAL_BLK 0x810EA0 KwbUb 255.0 dez 0.00 255.0 NUMBER 2 FUNCTION_LIST DFPM_DSELHFS IF_DATA DIM_X DIRECT 0x810EA0 /end CHARACTERISTIC
/begin CHARACTERISTIC FFTLSH "Tabelle Umweltbedingungen Lambdasonde hinter Kat" VAL_BLK 0x810EA2 KwbUb 255.0 dez 0.00 255.0 NUMBER 2 FUNCTION_LIST DFPM_DLSH IF_DATA DIM_X DIRECT 0x810EA2 /end CHARACTERISTIC
/begin CHARACTERISTIC FFTLSV "Tabelle Umweltbedingungen: Lambdasonde vor Kat" VAL_BLK 0x810EA4 KwbUb 255.0 dez 0.00 255.0 NUMBER 2 FUNCTION_LIST DFPM_DLSU IF_DATA DIM_X DIRECT 0x810EA4 /end CHARACTERISTIC
/begin CHARACTERISTIC FFTLUE1 "" VAL_BLK 0x810EA6 KwbUb 255.0 DEZ 0.00 255.0 NUMBER 2 FUNCTION_LIST DFPM_dkmtr IF_DATA DIM_X DIRECT 0x810EA6 /end CHARACTERISTIC
/begin CHARACTERISTIC FFTLUES1E "Freeze Frame Tabelle: Endstufe Lüftersteuerung 1" VAL_BLK 0x810EA8 KwbUb 255.0 dez 0.00 255.0 NUMBER 2 FUNCTION_LIST DFPM_DEKON IF_DATA DIM_X DIRECT 0x810EA8 /end CHARACTERISTIC
/begin CHARACTERISTIC FFTMD "Freeze Frame Tabelle: Aussetzer, Summenfehler (multiple)" VAL_BLK 0x810EAA KwbUb 255.0 dez 0.00 255.0 NUMBER 2 FUNCTION_LIST DFPM_DMDMIL IF_DATA DIM_X DIRECT 0x810EAA /end CHARACTERISTIC
/begin CHARACTERISTIC FFTMD00 "Freeze Frame Tabelle: Aussetzer Zyl. 0" VAL_BLK 0x810EAC KwbUb 255.0 dez 0.00 255.0 NUMBER 2 FUNCTION_LIST DFPM_DMDMIL IF_DATA DIM_X DIRECT 0x810EAC /end CHARACTERISTIC
/begin CHARACTERISTIC FFTMD01 "Freeze Frame Tabelle: Aussetzer Zyl. 1" VAL_BLK 0x810EAE KwbUb 255.0 dez 0.00 255.0 NUMBER 2 FUNCTION_LIST DFPM_DMDMIL IF_DATA DIM_X DIRECT 0x810EAE /end CHARACTERISTIC
/begin CHARACTERISTIC FFTMD02 "Freeze Frame Tabelle: Aussetzer Zylinder 2" VAL_BLK 0x810EB0 KwbUb 255.0 dez 0.00 255.0 NUMBER 2 FUNCTION_LIST DFPM_DMDMIL IF_DATA DIM_X DIRECT 0x810EB0 /end CHARACTERISTIC
/begin CHARACTERISTIC FFTMD03 "Freeze Frame Tabelle: Aussetzer Zylinder 3" VAL_BLK 0x810EB2 KwbUb 255.0 dez 0.00 255.0 NUMBER 2 FUNCTION_LIST DFPM_DMDMIL IF_DATA DIM_X DIRECT 0x810EB2 /end CHARACTERISTIC
/begin CHARACTERISTIC FFTMDB "Freeze Frame Tabelle: Momentbegrenzung Sollmoment" VAL_BLK 0x810EB4 KwbUb 255.0 dez 0.00 255.0 NUMBER 2 FUNCTION_LIST DFPM_MDKOG IF_DATA DIM_X DIRECT 0x810EB4 /end CHARACTERISTIC
/begin CHARACTERISTIC FFTN "Freeze Frame Tabelle: Drehzahlgeber" VAL_BLK 0x810EB8 KwbUb 255.0 dez 0.00 255.0 NUMBER 2 FUNCTION_LIST DFPM_DDG IF_DATA DIM_X DIRECT 0x810EB8 /end CHARACTERISTIC
/begin CHARACTERISTIC FFTNWKW "Freeze Frame Tabelle: Zuordnung Nockenwelle zu Kurbelwelle" VAL_BLK 0x810EBA KwbUb 255.0 dez 0.00 255.0 NUMBER 2 FUNCTION_LIST DFPM_DNWKW IF_DATA DIM_X DIRECT 0x810EBA /end CHARACTERISTIC
/begin CHARACTERISTIC FFTNWSE "Freeze Frame Tabelle: Nockenwellensteuerungsventil Endstufe" VAL_BLK 0x810EBC KwbUb 255.0 dez 0.00 255.0 NUMBER 2 FUNCTION_LIST DFPM_DEKON IF_DATA DIM_X DIRECT 0x810EBC /end CHARACTERISTIC
/begin CHARACTERISTIC FFTNX "Freeze Frame Tabelle: ^NMAX- Überschreitung" VAL_BLK 0x810EBE KwbUb 255.0 dez 0.00 255.0 NUMBER 2 FUNCTION_LIST DFPM_DNMAX IF_DATA DIM_X DIRECT 0x810EBE /end CHARACTERISTIC
/begin CHARACTERISTIC FFTPH "Freeze Frame Tabelle: Phasensensor" VAL_BLK 0x810EC0 KwbUb 255.0 dez 0.00 255.0 NUMBER 2 FUNCTION_LIST DFPM_DPH IF_DATA DIM_X DIRECT 0x810EC0 /end CHARACTERISTIC
/begin CHARACTERISTIC FFTPWM "" VAL_BLK 0x810EC2 KwbUb 255.0 dez 0.00 255.0 NUMBER 2 FUNCTION_LIST DFPM_DSWEA IF_DATA DIM_X DIRECT 0x810EC2 /end CHARACTERISTIC
/begin CHARACTERISTIC FFTRKAT "Freeze Frame Tabelle: RKAT Gemischadaption" VAL_BLK 0x810EC4 KwbUb 255.0 dez 0.00 255.0 NUMBER 2 FUNCTION_LIST DFPM_DKVS IF_DATA DIM_X DIRECT 0x810EC4 /end CHARACTERISTIC
/begin CHARACTERISTIC FFTRKAZ "Freeze Frame Tabelle: RKAZ Gemischadaption" VAL_BLK 0x810EC6 KwbUb 255.0 dez 0.00 255.0 NUMBER 2 FUNCTION_LIST DFPM_DKVS IF_DATA DIM_X DIRECT 0x810EC6 /end CHARACTERISTIC
/begin CHARACTERISTIC FFTSCR "Freeze Frame Tabelle: CRAS-Signal" VAL_BLK 0x810EC8 KwbUb 255.0 dez 0.00 255.0 NUMBER 2 FUNCTION_LIST DFPM_GGCS IF_DATA DIM_X DIRECT 0x810EC8 /end CHARACTERISTIC
/begin CHARACTERISTIC FFTSGEEP "Freeze Frame Tabelle: SG defekt (EEPROM)" VAL_BLK 0x810ECA KwbUb 255.0 dez 0.00 255.0 NUMBER 2 FUNCTION_LIST DFPM_DSGEEP IF_DATA DIM_X DIRECT 0x810ECA /end CHARACTERISTIC
/begin CHARACTERISTIC FFTSGEEW "Freeze Frame Tabelle: SG defekt (EEPROM WFS- Bereich)" VAL_BLK 0x810ECC KwbUb 255.0 dez 0.00 255.0 NUMBER 2 FUNCTION_LIST DFPM_IMS IF_DATA DIM_X DIRECT 0x810ECC /end CHARACTERISTIC
/begin CHARACTERISTIC FFTSLPE "Freeze Frame Tabelle: Sekundärluftpumpe Endstufe" VAL_BLK 0x810ECE KwbUb 255.0 dez 0.00 255.0 NUMBER 2 FUNCTION_LIST DFPM_DEKON IF_DATA DIM_X DIRECT 0x810ECE /end CHARACTERISTIC
/begin CHARACTERISTIC FFTSLS "Freeze Frame Tabelle: Sekundärluftsystem" VAL_BLK 0x810ED0 KwbUb 255.0 dez 0.00 255.0 NUMBER 2 FUNCTION_LIST DFPM_DSLSLRS IF_DATA DIM_X DIRECT 0x810ED0 /end CHARACTERISTIC
/begin CHARACTERISTIC FFTSLV "Freeze Frame Tabelle: Dichtheit Sekundärluftventil" VAL_BLK 0x810ED2 KwbUb 255.0 dez 0.00 255.0 NUMBER 2 FUNCTION_LIST DFPM_DSLSLRS IF_DATA DIM_X DIRECT 0x810ED2 /end CHARACTERISTIC
/begin CHARACTERISTIC FFTSLVE "Freeze Frame Tabelle: Sekundärluftventil Endstufe" VAL_BLK 0x810ED4 KwbUb 255.0 dez 0.00 255.0 NUMBER 2 FUNCTION_LIST DFPM_DEKON IF_DATA DIM_X DIRECT 0x810ED4 /end CHARACTERISTIC
/begin CHARACTERISTIC FFTSWE "Freeze Frame Tabelle: Beschleunigungssensor Schlechtwegeerk." VAL_BLK 0x810ED6 KwbUb 255.0 dez 0.00 255.0 NUMBER 2 FUNCTION_LIST DFPM_DSWEA IF_DATA DIM_X DIRECT 0x810ED6 /end CHARACTERISTIC
/begin CHARACTERISTIC FFTTA "Freeze Frame Tabelle: Ansauglufttemperatur TANS (/Ladeluft-)" VAL_BLK 0x810ED8 KwbUb 255.0 dez 0.00 255.0 NUMBER 2 FUNCTION_LIST DFPM_GGTFA IF_DATA DIM_X DIRECT 0x810ED8 /end CHARACTERISTIC
/begin CHARACTERISTIC FFTTANKL "Freeze Frame Tabelle : tankl (Tank leer)" VAL_BLK 0x810EDA KwbUb 255.0 dez 0.00 255.0 NUMBER 2 FUNCTION_LIST DFPM_DTANKL IF_DATA DIM_X DIRECT 0x810EDA /end CHARACTERISTIC
/begin CHARACTERISTIC FFTTES "Freeze Frame Tabelle: Tankentlüftungsventil" VAL_BLK 0x810EDC KwbUb 255.0 dez 0.00 255.0 NUMBER 2 FUNCTION_LIST DFPM_DTEV IF_DATA DIM_X DIRECT 0x810EDC /end CHARACTERISTIC
/begin CHARACTERISTIC FFTTESF "Freeze Frame Tabelle: Tankdiagnose, Feinleck" VAL_BLK 0x810EDE KwbUb 255.0 dez 0.00 255.0 NUMBER 2 FUNCTION_LIST DFPM_DLDP IF_DATA DIM_X DIRECT 0x810EDE /end CHARACTERISTIC
/begin CHARACTERISTIC FFTTESG "Freeze Frame Tabelle: Tankdiagnose, Grobleck" VAL_BLK 0x810EE0 KwbUb 255.0 dez 0.00 255.0 NUMBER 2 FUNCTION_LIST DFPM_DLDP IF_DATA DIM_X DIRECT 0x810EE0 /end CHARACTERISTIC
/begin CHARACTERISTIC FFTTEVE "Freeze Frame Tabelle: Tankentlüftungsventil Endstufe" VAL_BLK 0x810EE2 KwbUb 255.0 dez 0.00 255.0 NUMBER 2 FUNCTION_LIST DFPM_DEKON IF_DATA DIM_X DIRECT 0x810EE2 /end CHARACTERISTIC
/begin CHARACTERISTIC FFTTEVE2 "Freeze Frame Tabelle: Tankentlüftungsventil" VAL_BLK 0x810EE4 KwbUb 255.0 dez 0.00 255.0 NUMBER 2 FUNCTION_LIST DFPM_DUMMY_D IF_DATA DIM_X DIRECT 0x810EE4 /end CHARACTERISTIC
/begin CHARACTERISTIC FFTTHM "Freeze Frame Tabelle: Thermostat-Diagnose THM" VAL_BLK 0x810EE6 KwbUb 255.0 dez 0.00 255.0 NUMBER 2 FUNCTION_LIST DFPM_DTHM IF_DATA DIM_X DIRECT 0x810EE6 /end CHARACTERISTIC
/begin CHARACTERISTIC FFTTKA "Freeze Frame Tabelle: Temperatur Kühlerausgang" VAL_BLK 0x810EE8 KwbUb 255.0 dez 0.00 255.0 NUMBER 2 FUNCTION_LIST DFPM_GGTKA IF_DATA DIM_X DIRECT 0x810EE8 /end CHARACTERISTIC
/begin CHARACTERISTIC FFTTM "Freeze Frame Tabelle: Motortemperatur TMOT" VAL_BLK 0x810EEA KwbUb 255.0 dez 0.00 255.0 NUMBER 2 FUNCTION_LIST DFPM_GGTFM IF_DATA DIM_X DIRECT 0x810EEA /end CHARACTERISTIC
/begin CHARACTERISTIC FFTTMKI "Freeze Frame Tabelle: Motortemperatur aus Kombiinstrument TMKI" VAL_BLK 0x810EEC KwbUb 255.0 dez 0.00 255.0 NUMBER 2 FUNCTION_LIST DFPM_GGGTS IF_DATA DIM_X DIRECT 0x810EEC /end CHARACTERISTIC
/begin CHARACTERISTIC FFTTOL "Freeze Frame Tabelle: (Motor-) Oeltemperatur TOL" VAL_BLK 0x810EEE KwbUb 255.0 dez 0.00 255.0 NUMBER 2 FUNCTION_LIST DFPM_BGTOL IF_DATA DIM_X DIRECT 0x810EEE /end CHARACTERISTIC
/begin CHARACTERISTIC FFTTUM "Freeze Frame Tabelle: Umgebungstemperatur TUM" VAL_BLK 0x810EF0 KwbUb 255.0 dez 0.00 255.0 NUMBER 2 FUNCTION_LIST DFPM_BGTUMG IF_DATA DIM_X DIRECT 0x810EF0 /end CHARACTERISTIC
/begin CHARACTERISTIC FFTUB "Freeze Frame Tabelle: Batteriespannung UB (Bordnetz)" VAL_BLK 0x810EF2 KwbUb 255.0 dez 0.00 255.0 NUMBER 2 FUNCTION_LIST DFPM_GGUB IF_DATA DIM_X DIRECT 0x810EF2 /end CHARACTERISTIC
/begin CHARACTERISTIC FFTUBR "Freeze Frame Tabelle: Bordnetzspannung über Hauptrelais UBR" VAL_BLK 0x810EF4 KwbUb 255.0 dez 0.00 255.0 NUMBER 2 FUNCTION_LIST DFPM_GGUBR IF_DATA DIM_X DIRECT 0x810EF4 /end CHARACTERISTIC
/begin CHARACTERISTIC FFTUFMV "Freeze Frame Tabelle: Funktionsüberwachung: Momentenvergleich" VAL_BLK 0x810EF6 KwbUb 255.0 dez 0.00 255.0 NUMBER 2 FUNCTION_LIST DFPM_DUF IF_DATA DIM_X DIRECT 0x810EF6 /end CHARACTERISTIC
/begin CHARACTERISTIC FFTUFSKA "Freeze Frame Tabelle: Funktionsüberwachung: Sicherheits-Kraftstoff-Abschaltung" VAL_BLK 0x810EF8 KwbUb 255.0 dez 0.00 255.0 NUMBER 2 FUNCTION_LIST DFPM_DUF IF_DATA DIM_X DIRECT 0x810EF8 /end CHARACTERISTIC
/begin CHARACTERISTIC FFTURRAM "Freeze Frame Tabelle: Rechnerüberwachung: RAM" VAL_BLK 0x810EFA KwbUb 255.0 dez 0.00 255.0 NUMBER 2 FUNCTION_LIST DFPM_DUR IF_DATA DIM_X DIRECT 0x810EFA /end CHARACTERISTIC
/begin CHARACTERISTIC FFTURROM "Freeze Frame Tabelle: Rechnerüberwachung: ROM" VAL_BLK 0x810EFC KwbUb 255.0 dez 0.00 255.0 NUMBER 2 FUNCTION_LIST DFPM_DUR IF_DATA DIM_X DIRECT 0x810EFC /end CHARACTERISTIC
/begin CHARACTERISTIC FFTURRST "Freeze Frame Tabelle: Rechnerüberwachung: Reset" VAL_BLK 0x810EFE KwbUb 255.0 dez 0.00 255.0 NUMBER 2 FUNCTION_LIST DFPM_DUR IF_DATA DIM_X DIRECT 0x810EFE /end CHARACTERISTIC
/begin CHARACTERISTIC FFTUVSE "Freeze Frame Tabelle:Endstufe Umluftventil Turbo" VAL_BLK 0x810F00 KwbUb 255.0 dez 0.00 255.0 NUMBER 2 FUNCTION_LIST DFPM_DEKON IF_DATA DIM_X DIRECT 0x810F00 /end CHARACTERISTIC
/begin CHARACTERISTIC FFTVFZ "Freeze Frame Tabelle: Geschwindigkeitssignal" VAL_BLK 0x810F02 KwbUb 255.0 dez 0.00 255.0 NUMBER 2 FUNCTION_LIST DFPM_DVFZ IF_DATA DIM_X DIRECT 0x810F02 /end CHARACTERISTIC
/begin CHARACTERISTIC FFTWFS "Freeze Frame Tabelle: Wegfahrsperre" VAL_BLK 0x810F04 KwbUb 255.0 dez 0.00 255.0 NUMBER 2 FUNCTION_LIST DFPM_IMS IF_DATA DIM_X DIRECT 0x810F04 /end CHARACTERISTIC
/begin CHARACTERISTIC FFTWFSRC "Freeze Frame Tabelle: Wegfahrsperre RC-Glied" VAL_BLK 0x810F06 KwbUb 255.0 dez 0.00 255.0 NUMBER 2 FUNCTION_LIST DFPM_IMS IF_DATA DIM_X DIRECT 0x810F06 /end CHARACTERISTIC
/begin CHARACTERISTIC FFTZET1 "" VAL_BLK 0x810F08 KwbUb 255.0 dez 0.00 255.0 NUMBER 2 FUNCTION_LIST DFPM_DEKON IF_DATA DIM_X DIRECT 0x810F08 /end CHARACTERISTIC
/begin CHARACTERISTIC FFTZET2 "" VAL_BLK 0x810F0A KwbUb 255.0 dez 0.00 255.0 NUMBER 2 FUNCTION_LIST DFPM_DEKON IF_DATA DIM_X DIRECT 0x810F0A /end CHARACTERISTIC
/begin CHARACTERISTIC FGDPSMPDVS "Faktor Gewichtung Steigung extrap. Saugrohrdruck / Saugrohrdruck aus DK" VALUE 0x811502 KwUb 0.9961 fak_ub_b1 0.00 0.9961 FUNCTION_LIST BGRLP IF_DATA DIM_X DIRECT 0x811502 /end CHARACTERISTIC
/begin CHARACTERISTIC FGMIFAL_0_A "Gewichtungsfaktor für Überhöhung über KFWMIFAL" CURVE 0x811F2E FklWUb 1.992 fak_ub_b2 0.00 1.992 FUNCTION_LIST MDFAW IF_DATA DIM_X INDIRECT 0x816A66 /begin AXIS_DESCR FIX_AXIS gangi dez 8 0.00 7.000 FIX_AXIS_PAR 0 0 8 /end AXIS_DESCR /end CHARACTERISTIC
/begin CHARACTERISTIC FGMIFAL_1_A "Gewichtungsfaktor für Überhöhung über KFWMIFAL" CURVE 0x811F36 FklWUb 1.992 fak_ub_b2 0.00 1.992 FUNCTION_LIST MDFAW IF_DATA DIM_X INDIRECT 0x816A68 /begin AXIS_DESCR FIX_AXIS gangi dez 8 0.00 7.000 FIX_AXIS_PAR 0 0 8 /end AXIS_DESCR /end CHARACTERISTIC
/begin CHARACTERISTIC FGMRIDV "Gewichtungsfaktor für Reglerinitialisierung bei Wiederaufnahme" CURVE 0x81CADC KlASwSstSwWSw 1.999939 fak_sw_b2 0.00 1.999939 FUNCTION_LIST FGRREGL IF_DATA DIM_X DIRECT 0x81CADC
 /begin AXIS_DESCR STD_AXIS dvzvi_w vfzg_sw_q0p00781 4 -256.0000 255.9922 DEPOSIT ABSOLUT /end AXIS_DESCR
/end CHARACTERISTIC
/begin CHARACTERISTIC FGZLSD_0_A "Gewichtungsfaktor für Reduktion über KFZLSD" CURVE 0x811F3E FklWUb 1.992 fak_ub_b2 0.00 1.992 FUNCTION_LIST MDFAW IF_DATA DIM_X INDIRECT 0x816A6A /begin AXIS_DESCR FIX_AXIS gangi dez 8 0.00 7.000 FIX_AXIS_PAR 0 0 8 /end AXIS_DESCR /end CHARACTERISTIC
/begin CHARACTERISTIC FGZLSD_1_A "Gewichtungsfaktor für Reduktion über KFZLSD" CURVE 0x811F46 FklWUb 1.992 fak_ub_b2 0.00 1.992 FUNCTION_LIST MDFAW IF_DATA DIM_X INDIRECT 0x816A6C /begin AXIS_DESCR FIX_AXIS gangi dez 8 0.00 7.000 FIX_AXIS_PAR 0 0 8 /end AXIS_DESCR /end CHARACTERISTIC
/begin CHARACTERISTIC FHDLLR "Höhenschwelle für Durchführung Diagnose Leerlaufsteller" VALUE 0x81A22A KwUb 3.984 fak_ub_b4 0.00 3.984 FUNCTION_LIST DLLR IF_DATA DIM_X DIRECT 0x81A22A /end CHARACTERISTIC
/begin CHARACTERISTIC FHODSL "minimaler Höhenfaktor für DSLS" VALUE 0x81B256 KwUw 3.999939 fak_uw_b4 0.00 3.999939 FUNCTION_LIST DSLSLRS IF_DATA DIM_X DIRECT 0x81B256 /end CHARACTERISTIC
/begin CHARACTERISTIC FHODTEA "untere Höhenschwelle für DTEV aktiv" VALUE 0x829D08 KwUw 0.5999756 fak_uw_b4 0.2000122 0.7999878 FUNCTION_LIST DTEV IF_DATA DIM_X DIRECT 0x829D08 /end CHARACTERISTIC
/begin CHARACTERISTIC FHOE "Ersatzwert für Höhe" VALUE 0x818894 KwUb 3.984 fak_ub_b4 0.00 3.984 FUNCTION_LIST GGDSAS IF_DATA DIM_X DIRECT 0x818894 /end CHARACTERISTIC
/begin CHARACTERISTIC FHOKOB "Höhenschwelle für Kompressorabschaltung bei Beschleunigung" VALUE 0x812D81 KwUb 3.984 fak_ub_b4 0.00 3.984 FUNCTION_LIST KOS IF_DATA DIM_X DIRECT 0x812D81 /end CHARACTERISTIC
/begin CHARACTERISTIC FIAMALU "Anhebungsfaktor für Filter Mehrfachaussetzererkennung" VALUE 0x810806 KwUb 3.984 fak_ub_b4 0.00 3.984 FUNCTION_LIST DMDLU IF_DATA DIM_X DIRECT 0x810806 /end CHARACTERISTIC
/begin CHARACTERISTIC FIKTD "Bewertungsfaktor des Kat-Ausräumintegrals bei Katdiagnose" VALUE 0x8186D8 KwUb 15.94 fak_ub_b16 0.00 15.94 FUNCTION_LIST DKATSP IF_DATA DIM_X DIRECT 0x8186D8 /end CHARACTERISTIC
/begin CHARACTERISTIC FIMALU_1_A "Filterfaktor Mehrfachaussetzererkennung" VALUE 0x810D28 KwUb 0.9961 fak_ub_b1 0.00 0.9961 FUNCTION_LIST DMDLU IF_DATA DIM_X DIRECT 0x810D28 /end CHARACTERISTIC
/begin CHARACTERISTIC FIMHU "Faktor Impuls hart" CURVE 0x811BCA FklWUb 1.992 fak_ub_b2 0.00 1.992 FUNCTION_LIST ESWE IF_DATA DIM_X DIRECT 0x811BCA /begin AXIS_DESCR FIX_AXIS anzwefim dez 16 0.00 15.00 FIX_AXIS_PAR 0 0 16 /end AXIS_DESCR /end CHARACTERISTIC
/begin CHARACTERISTIC FIMWU "Faktor Impuls weich" CURVE 0x811BDA FklWUb 1.992 fak_ub_b2 0.00 1.992 FUNCTION_LIST ESWE IF_DATA DIM_X DIRECT 0x811BDA /begin AXIS_DESCR FIX_AXIS anzwefim dez 16 0.00 15.00 FIX_AXIS_PAR 0 0 16 /end AXIS_DESCR /end CHARACTERISTIC
/begin CHARACTERISTIC FIRNLIGN "Mindestwert für Winkelfehler nach der ersten Zündung" VALUE 0x810FCA KwUb 255.0 kw_q1 0.00 255.0 FUNCTION_LIST NLDG IF_DATA DIM_X DIRECT 0x810FCA /end CHARACTERISTIC
/begin CHARACTERISTIC FKADPMN "miminaler Kraftstoffanteil über TEV für passive i.O. Prüfung." VALUE 0x81A721 KwSb 0.6953 fak_sb_b1 0.1016 0.7969 FUNCTION_LIST DTEV IF_DATA DIM_X DIRECT 0x81A721 /end CHARACTERISTIC
/begin CHARACTERISTIC FKATEB "Kennlinie Kraftstoffanteil Tankentlüftung abh. von te / TEMIN" CURVE 0x81A575 KlAUbSstUbWUb 0.9961 fak_ub_b1 0.00 0.9961 FUNCTION_LIST TEB IF_DATA DIM_X DIRECT 0x81A575 /begin AXIS_DESCR STD_AXIS qtetemin fak_ub_b4 5 0.00 3.984 DEPOSIT ABSOLUT /end AXIS_DESCR /end CHARACTERISTIC
/begin CHARACTERISTIC FKEFMC "Korrekturfaktor für Klopferkennungsschwelle bei Filtermittenfrequenzumschaltung" VALUE 0x811BFE KwUb 2.000 fak_ub_b16 0.00 2.000 FUNCTION_LIST KRKE IF_DATA DIM_X DIRECT 0x811BFE /end CHARACTERISTIC
/begin CHARACTERISTIC FKELDY "Korrekturfaktor für Klopferkennungsschwelle bei Lastdynamik" VALUE 0x811BFF KwUb 2.000 fak_ub_b16 0.00 2.000 FUNCTION_LIST KRKE IF_DATA DIM_X DIRECT 0x811BFF /end CHARACTERISTIC
/begin CHARACTERISTIC FKELDYA "Korrekturfaktor für Klopferkennungsschwelle bei Lastdynamikadaption" VALUE 0x811C41 KwUb 0.6250 fak_ub_b16 0.6250 1.250 FUNCTION_LIST KRDY IF_DATA DIM_X DIRECT 0x811C41 /end CHARACTERISTIC
/begin CHARACTERISTIC FKENDY "Korrekturfaktor für Klopferkennungsschwelle bei Drehzahldynamik" VALUE 0x811C00 KwUb 2.000 fak_ub_b16 0.00 2.000 FUNCTION_LIST KRKE IF_DATA DIM_X DIRECT 0x811C00 /end CHARACTERISTIC
/begin CHARACTERISTIC FKFPEDV "Faktor für Interpolation zwischen den beiden Pedalkennfeldern" CURVE 0x81A28F KlAUbSstUbWUb 1.000 fak_ub_b2 0.00 1.000 FUNCTION_LIST MDFAW IF_DATA DIM_X DIRECT 0x81A28F /begin AXIS_DESCR STD_AXIS vfzg vfzg_ub_q1p25 2 0.00 318.8 DEPOSIT ABSOLUT /end AXIS_DESCR /end CHARACTERISTIC
/begin CHARACTERISTIC FKHMD_0_A "Wichtungsfaktor Drehmomentreserve für Katheizen" CURVE 0x81EB16 KlAUwSstUwWUw 0.9999847 fak_uw_b1 0.00 0.9999847 FUNCTION_LIST BBKHZ IF_DATA DIM_X INDIRECT 0x815CB6
 /begin AXIS_DESCR STD_AXIS imlpr_w fak_uw_b1 8 0.00 0.9999847 DEPOSIT ABSOLUT /end AXIS_DESCR
/end CHARACTERISTIC
/begin CHARACTERISTIC FKHMD_1_A "Wichtungsfaktor Drehmomentreserve für Katheizen" CURVE 0x81EB38 KlAUwSstUwWUw 0.9999847 fak_uw_b1 0.00 0.9999847 FUNCTION_LIST BBKHZ IF_DATA DIM_X INDIRECT 0x815CBA
 /begin AXIS_DESCR STD_AXIS imlpr_w fak_uw_b1 8 0.00 0.9999847 DEPOSIT ABSOLUT /end AXIS_DESCR
/end CHARACTERISTIC
/begin CHARACTERISTIC FKKVS "Korrekturfaktor Kraftstoffversorgungssystem" MAP 0x81DD2C KfAxUbAyUbSstxUbSstyUwWUw 1.999969 fak_uw_b2 0.00 1.999969 FUNCTION_LIST RKTI IF_DATA DIM_X DIRECT 0x81DD2C /begin AXIS_DESCR STD_AXIS nmot nmot_ub_q40 16 0.00 10200. DEPOSIT ABSOLUT /end AXIS_DESCR
 /begin AXIS_DESCR STD_AXIS tevfakge_w tinjection_sy 16 0.00 174.7600 DEPOSIT ABSOLUT /end AXIS_DESCR
/end CHARACTERISTIC
/begin CHARACTERISTIC FKLDOBG "Korrekturfaktor für Delta rl im Overboostbetrieb" CURVE 0x819D51 FklWUb 0.9961 fak_ub_b1 0.00 0.9961 FUNCTION_LIST LDOB IF_DATA DIM_X DIRECT 0x819D51 /begin AXIS_DESCR FIX_AXIS gangi dez 8 0.00 7.000 FIX_AXIS_PAR 0 0 8 /end AXIS_DESCR /end CHARACTERISTIC
/begin CHARACTERISTIC FKMSDKMN "min.Korrekturfaktor schneller Massenstromabgleich" VALUE 0x81547E KwUw 3.999939 fak_uw_b4 0.00 3.999939 FUNCTION_LIST BGMSZS IF_DATA DIM_X DIRECT 0x81547E /end CHARACTERISTIC
/begin CHARACTERISTIC FKMSDKMX "max.Korrekturfaktor schneller Massenstromabgleich" VALUE 0x815480 KwUw 3.999939 fak_uw_b4 0.00 3.999939 FUNCTION_LIST BGMSZS IF_DATA DIM_X DIRECT 0x815480 /end CHARACTERISTIC
/begin CHARACTERISTIC FKPVDKMN "Minimaler Korrekturfaktor langsamer Massenstomabgleich" VALUE 0x81D4CE KwUw 3.999939 fak_uw_b4 0.00 3.999939 FUNCTION_LIST BGMSZS IF_DATA DIM_X DIRECT 0x81D4CE /end CHARACTERISTIC
/begin CHARACTERISTIC FKPVDKMX "Maximaler Korrekturfaktor langsamer Massenstomabgleich" VALUE 0x81D4D0 KwUw 3.999939 fak_uw_b4 0.00 3.999939 FUNCTION_LIST BGMSZS IF_DATA DIM_X DIRECT 0x81D4D0 /end CHARACTERISTIC
/begin CHARACTERISTIC FKRFTPFMC "Korrekturfaktor des Tiefpaßverhaltens bei Umschaltung der Filtermittenfrequenz" VALUE 0x811C01 KwUb 0.5000 fak_ub_b2 0.5000 1.000 FUNCTION_LIST KRKE IF_DATA DIM_X DIRECT 0x811C01 /end CHARACTERISTIC
/begin CHARACTERISTIC FKRXTOL "Faktor zur Korrektur von rlmax bei hoher Motoröltemperatur" CURVE 0x827982 KlAUbSstUbWUb 1.000 fak_ub_b2 0.00 1.000 FUNCTION_LIST LDRLMX IF_DATA DIM_X DIRECT 0x827982
 /begin AXIS_DESCR STD_AXIS toelldrlmx temp_ub_q1_o60 4 -60.00 195.0 DEPOSIT ABSOLUT /end AXIS_DESCR
/end CHARACTERISTIC
/begin CHARACTERISTIC FKSTT_0_A "Faktor Kaltstart" CURVE 0x815D36 KlAUbSstUbWUw 63.99902 fak_uw_b64 0.00 63.99902 FUNCTION_LIST ESSTT IF_DATA DIM_X INDIRECT 0x81598E
 /begin AXIS_DESCR STD_AXIS tmst temp_ub_q0p75_o48 12 -48.00 143.3 DEPOSIT ABSOLUT /end AXIS_DESCR
/end CHARACTERISTIC
/begin CHARACTERISTIC FKSTT_1_A "Faktor Kaltstart" CURVE 0x815D5C KlAUbSstUbWUw 63.99902 fak_uw_b64 0.00 63.99902 FUNCTION_LIST ESSTT IF_DATA DIM_X INDIRECT 0x815990
 /begin AXIS_DESCR STD_AXIS tmst temp_ub_q0p75_o48 12 -48.00 143.3 DEPOSIT ABSOLUT /end AXIS_DESCR
/end CHARACTERISTIC
/begin CHARACTERISTIC FKSTT_2_A "Faktor Kaltstart" CURVE 0x815D82 KlAUbSstUbWUw 63.99902 fak_uw_b64 0.00 63.99902 FUNCTION_LIST ESSTT IF_DATA DIM_X INDIRECT 0x815992
 /begin AXIS_DESCR STD_AXIS tmst temp_ub_q0p75_o48 12 -48.00 143.3 DEPOSIT ABSOLUT /end AXIS_DESCR
/end CHARACTERISTIC
/begin CHARACTERISTIC FKSTT_3_A "Faktor Kaltstart" CURVE 0x815DA8 KlAUbSstUbWUw 63.99902 fak_uw_b64 0.00 63.99902 FUNCTION_LIST ESSTT IF_DATA DIM_X INDIRECT 0x815994
 /begin AXIS_DESCR STD_AXIS tmst temp_ub_q0p75_o48 12 -48.00 143.3 DEPOSIT ABSOLUT /end AXIS_DESCR
/end CHARACTERISTIC
/begin CHARACTERISTIC FKTDAVK "Faktor avkatf-Umrechnung bei Katdiagnose" VALUE 0x8186D9 KwUb 0.9961 fak_ub_b1 0.00 0.9961 FUNCTION_LIST DKATSP IF_DATA DIM_X DIRECT 0x8186D9 /end CHARACTERISTIC
/begin CHARACTERISTIC FKTDFE "Faktor Fetteintrag bei Katdiagnose" VALUE 0x8186DA KwUb 7.969 fak_ub_b8 0.00 7.969 FUNCTION_LIST DKATSP IF_DATA DIM_X DIRECT 0x8186DA /end CHARACTERISTIC
/begin CHARACTERISTIC FKTDFET "Faktor Fetteintrag bei Katdiagnose, Testeranforderung" VALUE 0x8186DB KwUb 7.969 fak_ub_b8 0.00 7.969 FUNCTION_LIST DKATSP IF_DATA DIM_X DIRECT 0x8186DB /end CHARACTERISTIC
/begin CHARACTERISTIC FKTDGTV "Katdiagnose: Faktor für Temperaturgradientenabhängige Verzugszeit" VALUE 0x8186E4 KwUb 10.20 ttemp_q0p04 0.00 10.20 FUNCTION_LIST DKATSPEB IF_DATA DIM_X DIRECT 0x8186E4 /end CHARACTERISTIC
/begin CHARACTERISTIC FKUKAO "Obergrenze Korrekturfaktor in UK-Adaption" VALUE 0x811BEF KwUb 3.984 fak_ub_b4 0.00 3.984 FUNCTION_LIST ESUKAS IF_DATA DIM_X DIRECT 0x811BEF /end CHARACTERISTIC
/begin CHARACTERISTIC FKUKAU "Untergrenze Korrekturfaktor in UK-Adaption" VALUE 0x811BF0 KwUb 3.891 fak_ub_b4 0.09375 3.984 FUNCTION_LIST ESUKAS IF_DATA DIM_X DIRECT 0x811BF0 /end CHARACTERISTIC
/begin CHARACTERISTIC FKVA "Konstanter Umrechnungsfaktor für Verbrauchsanzeige" VALUE 0x81ABF9 KwUb 15.94 fak_ub_b16 0.00 15.94 FUNCTION_LIST KVA IF_DATA DIM_X DIRECT 0x81ABF9 /end CHARACTERISTIC
/begin CHARACTERISTIC FKVRNR "Umrechnungsfaktor Radgeschwindigkeit in Drehzahl" VALUE 0x82837E KwUw 159.9976 fak_uw_b160 0.00 159.9976 FUNCTION_LIST ARMD IF_DATA DIM_X DIRECT 0x82837E /end CHARACTERISTIC
/begin CHARACTERISTIC FKZDPTM "Korrekturfaktor Zeitkonstante Dashpot" CURVE 0x81A294 KlAUbSstUbWUb 1.49804 rfak_q0p5 0.501961 2.00000 FUNCTION_LIST MDFAW IF_DATA DIM_X DIRECT 0x81A294
 /begin AXIS_DESCR STD_AXIS tmot temp_ub_q0p75_o48 6 -48.00 143.3 DEPOSIT ABSOLUT /end AXIS_DESCR
/end CHARACTERISTIC
/begin CHARACTERISTIC FLAMSBATM "Faktor Lambdasoll bei Beschleunigungsanreicherung" CURVE 0x81E5E0 GklWUw 2.000000 fak_uw_b16 0.00 2.000000 FUNCTION_LIST ESUKAS IF_DATA DIM_X DIRECT 0x81E5E0
 /begin AXIS_DESCR COM_AXIS tmot temp_ub_q0p75_o48 9 -48.00 143.3 AXIS_PTS_REF STM09ESUB /end AXIS_DESCR
/end CHARACTERISTIC
/begin CHARACTERISTIC FLAMSVATM "Faktor Lambdasoll bei Verzögerungsabmagerung" CURVE 0x81E5F2 GklWUw 2.000000 fak_uw_b16 0.00 2.000000 FUNCTION_LIST ESUKAS IF_DATA DIM_X DIRECT 0x81E5F2
 /begin AXIS_DESCR COM_AXIS tmot temp_ub_q0p75_o48 9 -48.00 143.3 AXIS_PTS_REF STM09ESUB /end AXIS_DESCR
/end CHARACTERISTIC
/begin CHARACTERISTIC FLFO "Filterfaktor Lernfilter der fuel-on/-off Adaption" VALUE 0x813D34 KwSw 1.999969 fak_uw_b2 -1.000000 0.9999695 FUNCTION_LIST DMDFON IF_DATA DIM_X DIRECT 0x813D34 /end CHARACTERISTIC
/begin CHARACTERISTIC FLMLKAMA "Faktor zur Bewertung Schwellwert integr. Fettfl. f. Abbruch Kat-Ausr. Pre/Main" VALUE 0x81274E KwUb 7.969 fak_ub_b8 0.00 7.969 FUNCTION_LIST LRSKA IF_DATA DIM_X DIRECT 0x81274E /end CHARACTERISTIC
/begin CHARACTERISTIC FLRAWG "Verstärkung Lastregler bei AT, WK geschlossen" CURVE 0x81A23F FklWUb 15.94 fak_ub_b16 0.00 15.94 FUNCTION_LIST ARMD IF_DATA DIM_X DIRECT 0x81A23F /begin AXIS_DESCR FIX_AXIS gangi dez 8 0.00 7.000 FIX_AXIS_PAR 0 0 8 /end AXIS_DESCR /end CHARACTERISTIC
/begin CHARACTERISTIC FLRCVT "Verstärkungsfaktor Lastregler bei CVT" CURVE 0x81A247 GklWUb 15.94 fak_ub_b16 0.00 15.94 FUNCTION_LIST ARMD IF_DATA DIM_X DIRECT 0x81A247
 /begin AXIS_DESCR COM_AXIS uefktget uefktget_ub_b25p4 7 0.00 25.50 AXIS_PTS_REF SUV07MDUB /end AXIS_DESCR
/end CHARACTERISTIC
/begin CHARACTERISTIC FLRFDAR "Faktor für Verstärkung des AR-Eingriffs im Low Range" VALUE 0x81A24E KwUb 3.984 fak_ub_b4 0.00 3.984 FUNCTION_LIST ARMD IF_DATA DIM_X DIRECT 0x81A24E /end CHARACTERISTIC
/begin CHARACTERISTIC FLRFLRAR "Faktor für Verstärkung zur Nachbildung der externen Last im Low Range" VALUE 0x81A24F KwUb 3.984 fak_ub_b4 0.00 3.984 FUNCTION_LIST ARMD IF_DATA DIM_X DIRECT 0x81A24F /end CHARACTERISTIC
/begin CHARACTERISTIC FLRHG_0_A "Verstärkung Lastregler" CURVE 0x81A250 FklWUb 15.94 fak_ub_b16 0.00 15.94 FUNCTION_LIST ARMD IF_DATA DIM_X INDIRECT 0x8162C8 /begin AXIS_DESCR FIX_AXIS gangi dez 8 0.00 7.000 FIX_AXIS_PAR 0 0 8 /end AXIS_DESCR /end CHARACTERISTIC
/begin CHARACTERISTIC FLRHG_1_A "Verstärkung Lastregler" CURVE 0x81A258 FklWUb 15.94 fak_ub_b16 0.00 15.94 FUNCTION_LIST ARMD IF_DATA DIM_X INDIRECT 0x8162CC /begin AXIS_DESCR FIX_AXIS gangi dez 8 0.00 7.000 FIX_AXIS_PAR 0 0 8 /end AXIS_DESCR /end CHARACTERISTIC
/begin CHARACTERISTIC FLRKIFZ "Faktor für Verstärkung Fahrzeugmodell im Low Range" VALUE 0x81A260 KwUb 3.984 fak_ub_b4 0.00 3.984 FUNCTION_LIST ARMD IF_DATA DIM_X DIRECT 0x81A260 /end CHARACTERISTIC
/begin CHARACTERISTIC FLRMIFAL "Faktor für Fahrerwunschmoment Füllungspfad im Low Range" VALUE 0x811F4E KwUb 3.984 fak_ub_b4 0.00 3.984 FUNCTION_LIST MDFAW IF_DATA DIM_X DIRECT 0x811F4E /end CHARACTERISTIC
/begin CHARACTERISTIC FLRZDASH "Faktor für Dashpot-Zeitkonstante im Low Range" VALUE 0x811F4F KwUb 3.49804 rfak_q0p5 0.501961 4.00000 FUNCTION_LIST MDFAW IF_DATA DIM_X DIRECT 0x811F4F /end CHARACTERISTIC
/begin CHARACTERISTIC FLRZLSD "Faktor für LSD-Zeitkonstante im Low Range" VALUE 0x81A2A1 KwUb 3.984 fak_ub_b4 0.00 3.984 FUNCTION_LIST MDFAW IF_DATA DIM_X DIRECT 0x81A2A1 /end CHARACTERISTIC
/begin CHARACTERISTIC FLR_AOG "oberer Grenzwert Anpassung Lambdaregelung-TV-Verschiebung" VALUE 0x811C54 KwSb 2.550 t10msxs_sb_q0p01 -1.280 1.270 FUNCTION_LIST TKMWL KRACT IF_DATA DIM_X DIRECT 0x811C54 /end CHARACTERISTIC
/begin CHARACTERISTIC FLR_AUG "unterer Grenzwert Anpassung Lambdaregelung-TV-Verschiebung" VALUE 0x811C55 KwSb 2.550 t10msxs_sb_q0p01 -1.280 1.270 FUNCTION_LIST TKMWL KRACT IF_DATA DIM_X DIRECT 0x811C55 /end CHARACTERISTIC
/begin CHARACTERISTIC FLTEFUEL "Faktor Anteil TEV Strom, der direkt ins Saugrohr strömt" CURVE 0x81A818 KlAUbSstUbWUb 0.9961 fak_ub_b1 0.00 0.9961 FUNCTION_LIST BGTEV IF_DATA DIM_X DIRECT 0x81A818 /begin AXIS_DESCR STD_AXIS qltefil fak_ub_b1 4 0.00 0.9961 DEPOSIT ABSOLUT /end AXIS_DESCR /end CHARACTERISTIC
/begin CHARACTERISTIC FLUTN "Filterfaktor Laufunruhe-Filter" CURVE 0x810278 GklWUb 0.9961 fak_ub_b1 0.00 0.9961 FUNCTION_LIST DMDLUA IF_DATA DIM_X DIRECT 0x810278
 /begin AXIS_DESCR COM_AXIS nmot nmot_ub_q40 8 0.00 10200. AXIS_PTS_REF SNM08DMUB /end AXIS_DESCR
/end CHARACTERISTIC
/begin CHARACTERISTIC FLUV1 "Schalter der Modifikation 1 der Laufunruhe-Berechnung" VALUE 0x810807 KwUb 255.0 dez 0.00 255.0 FUNCTION_LIST DMDLU IF_DATA DIM_X DIRECT 0x810807 /end CHARACTERISTIC
/begin CHARACTERISTIC FLUV2 "Schalter der Modifikation 2 der Laufunruhe-Berechnung" VALUE 0x810808 KwUb 255.0 dez 0.00 255.0 FUNCTION_LIST DMDLU IF_DATA DIM_X DIRECT 0x810808 /end CHARACTERISTIC
/begin CHARACTERISTIC FMDGEN "Faktor Generatormoment vor Eigenerwärmung" VALUE 0x81A125 KwUb 6.969 fak_ub_b8 1.000 7.969 FUNCTION_LIST MDVERB IF_DATA DIM_X DIRECT 0x81A125 /end CHARACTERISTIC
/begin CHARACTERISTIC FMDGENTA "Generatormoment Temperaturanteil" CURVE 0x81A126 KlAUbSstUbWUb 1.992 rel_ub_b2p0 0.00 1.992 FUNCTION_LIST MDVERB IF_DATA DIM_X DIRECT 0x81A126
 /begin AXIS_DESCR STD_AXIS tans temp_ub_q0p75_o48 6 -48.00 143.3 DEPOSIT ABSOLUT /end AXIS_DESCR
/end CHARACTERISTIC
/begin CHARACTERISTIC FMDKHFH "Höhenkorrektur Drehmomentenreserve für Katheizen" CURVE 0x81EDDE KlAUwSstUwWUw 1.999969 fak_uw_b2 0.00 1.999969 FUNCTION_LIST KHMD IF_DATA DIM_X DIRECT 0x81EDDE /begin AXIS_DESCR STD_AXIS fho_w fak_uw_b4 4 0.00 3.999939 DEPOSIT ABSOLUT /end AXIS_DESCR /end CHARACTERISTIC
/begin CHARACTERISTIC FMDPUBKV "Abregelungsfaktor für Momentenreserve bei Katheizen und leeren BKV" CURVE 0x81EDF0 KlAUwSstUwWUb 0.9961 fak_ub_b1 0.00 0.9961 FUNCTION_LIST KHMD IF_DATA DIM_X DIRECT 0x81EDF0
 /begin AXIS_DESCR STD_AXIS pubkv_w p_uw_q0p039 6 0.00 2559.961 DEPOSIT ABSOLUT /end AXIS_DESCR
/end CHARACTERISTIC
/begin CHARACTERISTIC FMDWAT "Faktor zur Berechnung des Wandlermoments abh. von der Öltemperatur des Wandlers" CURVE 0x81A0D6 GklWUb 0.000119850000 fak_ub_q4p7Em7 0.00 0.000119850000 FUNCTION_LIST MDWAN IF_DATA DIM_X DIRECT 0x81A0D6
 /begin AXIS_DESCR COM_AXIS twnd temp_ub_q0p75_o48 8 -48.00 143.3 AXIS_PTS_REF STW08MDUB /end AXIS_DESCR
/end CHARACTERISTIC
/begin CHARACTERISTIC FMFKRB0 "Filtermittenfrequenz Bereich 0" VALUE 0x819898 KwUb 255.0 fmfkr_dez 0.00 255.0 FUNCTION_LIST GGKS IF_DATA DIM_X DIRECT 0x819898 /end CHARACTERISTIC
/begin CHARACTERISTIC FMFKRB1 "Filtermittenfrequenz Bereich 1" VALUE 0x819899 KwUb 255.0 fmfkr_dez 0.00 255.0 FUNCTION_LIST GGKS IF_DATA DIM_X DIRECT 0x819899 /end CHARACTERISTIC
/begin CHARACTERISTIC FMFKRB2 "Filtermittenfrequenz Bereich 2" VALUE 0x81989A KwUb 255.0 fmfkr_dez 0.00 255.0 FUNCTION_LIST GGKS IF_DATA DIM_X DIRECT 0x81989A /end CHARACTERISTIC
/begin CHARACTERISTIC FMFKRB3 "Filtermittenfrequenz Bereich 3" VALUE 0x81989B KwUb 255.0 fmfkr_dez 0.00 255.0 FUNCTION_LIST GGKS IF_DATA DIM_X DIRECT 0x81989B /end CHARACTERISTIC
/begin CHARACTERISTIC FMRFAZTE "Gewichtung der Drehzahl um jetzige Leistung zu berechnen" CURVE 0x8191CD KlAUbSstUbWUb 3.984 fak_ub_b4 0.00 3.984 FUNCTION_LIST BBTEGA IF_DATA DIM_X DIRECT 0x8191CD /begin AXIS_DESCR STD_AXIS nmot nmot_ub_q40 4 0.00 10200. DEPOSIT ABSOLUT /end AXIS_DESCR /end CHARACTERISTIC
/begin CHARACTERISTIC FMSL "Faktor Korrektur Sekundärluftmasse" VALUE 0x8182E8 KwUb 1.992 fak_ub_b2 0.00 1.992 FUNCTION_LIST SLS IF_DATA DIM_X DIRECT 0x8182E8 /end CHARACTERISTIC
/begin CHARACTERISTIC FMSLAMN "minimaler Adaptionsfaktor Sekundärluftmasse" VALUE 0x818368 KwUb 1.992 fak_ub_b2 0.00 1.992 FUNCTION_LIST DSLSLRS IF_DATA DIM_X DIRECT 0x818368 /end CHARACTERISTIC
/begin CHARACTERISTIC FMSLAMX "maximaler Adaptionsfaktor Sekundärluftmasse" VALUE 0x818369 KwUb 1.992 fak_ub_b2 0.00 1.992 FUNCTION_LIST DSLSLRS IF_DATA DIM_X DIRECT 0x818369 /end CHARACTERISTIC
/begin CHARACTERISTIC FMSLOFF "Schwelle Ausräumen der Sekundärluft beendet" VALUE 0x8182E9 KwUb 0.9961 fak_ub_b1 0.00 0.9961 FUNCTION_LIST SLS IF_DATA DIM_X DIRECT 0x8182E9 /end CHARACTERISTIC
/begin CHARACTERISTIC FMSRHOL "Dichtekorrektur der Sekundärluftmasse" CURVE 0x81B19E KlAUwSstUwWUw 1.999969 fak_uw_b2 0.00 1.999969 FUNCTION_LIST SLS IF_DATA DIM_X DIRECT 0x81B19E
 /begin AXIS_DESCR STD_AXIS frhokor_w fak_uw_b4 4 0.00 3.999939 DEPOSIT ABSOLUT /end AXIS_DESCR
/end CHARACTERISTIC
/begin CHARACTERISTIC FMSTMOT "tmot- Korrektur der Sekundärluftmasse" CURVE 0x8182EA KlAUbSstUbWUb 1.992 fak_ub_b2 0.00 1.992 FUNCTION_LIST SLS IF_DATA DIM_X DIRECT 0x8182EA
 /begin AXIS_DESCR STD_AXIS tmot temp_ub_q0p75_o48 8 -48.00 143.3 DEPOSIT ABSOLUT /end AXIS_DESCR
/end CHARACTERISTIC
/begin CHARACTERISTIC FNLMI0 "Bewertungsfaktor von tsegph(k) für gleitenden Mittelwert" VALUE 0x810FCB KwUb 7.969 fak_ub_b8 0.00 7.969 FUNCTION_LIST NLDG IF_DATA DIM_X DIRECT 0x810FCB /end CHARACTERISTIC
/begin CHARACTERISTIC FNLMI1 "Bewertungsfaktor von tsegph(k-1) für gleitenden Mittelwert" VALUE 0x810FCC KwUb 7.969 fak_ub_b8 0.00 7.969 FUNCTION_LIST NLDG IF_DATA DIM_X DIRECT 0x810FCC /end CHARACTERISTIC
/begin CHARACTERISTIC FNLMI2 "Bewertungsfaktor von tsegph(k-2) für gleitenden Mittelwert" VALUE 0x810FCD KwUb 7.969 fak_ub_b8 0.00 7.969 FUNCTION_LIST NLDG IF_DATA DIM_X DIRECT 0x810FCD /end CHARACTERISTIC
/begin CHARACTERISTIC FNLPRUEF "Faktor Wiederholprüfung Nachlaufzeitberechnung" VALUE 0x81AC19 KwUb 0.9961 fak_ub_b1 0.00 0.9961 FUNCTION_LIST KMTR IF_DATA DIM_X DIRECT 0x81AC19 /end CHARACTERISTIC
/begin CHARACTERISTIC FNRAD "Faktor zwischen Raddrehzahl und Geschwindigkeit f(Radumfang)" VALUE 0x811DC0 KwUb 15.94 fak_ub_b16 0.00 15.94 FUNCTION_LIST MDWAN IF_DATA DIM_X DIRECT 0x811DC0 /end CHARACTERISTIC
/begin CHARACTERISTIC FNSHO "Wichtung Nachstartanhebung" CURVE 0x818AF8 KlAUbSstUbWUb 1.992 fak_ub_b2 0.00 1.992 FUNCTION_LIST ESNSWL IF_DATA DIM_X DIRECT 0x818AF8 /begin AXIS_DESCR STD_AXIS fho fak_ub_b4 4 0.00 3.984 DEPOSIT ABSOLUT /end AXIS_DESCR /end CHARACTERISTIC
/begin CHARACTERISTIC FNSNF "Faktor für Solldrehzahlnachführung" VALUE 0x819F3C KwUb 0.9961 fak_ub_b1 0.00 0.9961 FUNCTION_LIST LLRNS IF_DATA DIM_X DIRECT 0x819F3C /end CHARACTERISTIC
/begin CHARACTERISTIC FNSSM_0_A "Nachstartanhebung" CURVE 0x818B01 GklWUb 3.984 fak_ub_b4 0.00 3.984 FUNCTION_LIST ESNSWL IF_DATA DIM_X INDIRECT 0x813F32
 /begin AXIS_DESCR COM_AXIS tmst temp_ub_q0p75_o48 12 -48.00 143.3 AXIS_PTS_REF STS12ESUB /end AXIS_DESCR
/end CHARACTERISTIC
/begin CHARACTERISTIC FNSSM_1_A "Nachstartanhebung" CURVE 0x818B0D GklWUb 3.984 fak_ub_b4 0.00 3.984 FUNCTION_LIST ESNSWL IF_DATA DIM_X INDIRECT 0x813F36
 /begin AXIS_DESCR COM_AXIS tmst temp_ub_q0p75_o48 12 -48.00 143.3 AXIS_PTS_REF STS12ESUB /end AXIS_DESCR
/end CHARACTERISTIC
/begin CHARACTERISTIC FNSSTKM "Faktor zur Wichtung der Solldrehzahl im Start bei Kat-Heizen" CURVE 0x819F3D KlAUbSstUbWUb 1.992 fak_ub_b2 0.00 1.992 FUNCTION_LIST LLRNS IF_DATA DIM_X DIRECT 0x819F3D
 /begin AXIS_DESCR STD_AXIS tmot temp_ub_q0p75_o48 6 -48.00 143.3 DEPOSIT ABSOLUT /end AXIS_DESCR
/end CHARACTERISTIC
/begin CHARACTERISTIC FNSSTM "Faktor zur Wichtung der Solldrehzahl im Start" CURVE 0x819F4A KlAUbSstUbWUb 1.992 fak_ub_b2 0.00 1.992 FUNCTION_LIST LLRNS IF_DATA DIM_X DIRECT 0x819F4A
 /begin AXIS_DESCR STD_AXIS tmot temp_ub_q0p75_o48 6 -48.00 143.3 DEPOSIT ABSOLUT /end AXIS_DESCR
/end CHARACTERISTIC
/begin CHARACTERISTIC FNS_AOG "oberer Grenzwert Anpassung Faktor Nachstart" VALUE 0x811C56 KwUb 1.992 fak_ub_b2 0.00 1.992 FUNCTION_LIST TKMWL KRACT IF_DATA DIM_X DIRECT 0x811C56 /end CHARACTERISTIC
/begin CHARACTERISTIC FNS_AUG "unterer Grenzwert Anpassung Faktor Nachstart" VALUE 0x811C57 KwUb 1.992 fak_ub_b2 0.00 1.992 FUNCTION_LIST TKMWL KRACT IF_DATA DIM_X DIRECT 0x811C57 /end CHARACTERISTIC
/begin CHARACTERISTIC FNWSKRE "Faktor Nockenwellen-Sollwinkelkorrektur durch klopfende Verbrennungen Einlaß" CURVE 0x81A8CC KlAUbSstUbWUb 1.000 fak_ub_b2 0.00 1.000 FUNCTION_LIST NWSOLLE IF_DATA DIM_X DIRECT 0x81A8CC /begin AXIS_DESCR STD_AXIS wkrma zw_ub_qn0p75 3 -191.3 0.00 DEPOSIT ABSOLUT /end AXIS_DESCR /end CHARACTERISTIC
/begin CHARACTERISTIC FPLMRM "Wichtungsfaktor für P-Anteil Luftmassenregler" CURVE 0x818974 KlAUbSstUbWUb 0.9961 fak_ub_b1 0.00 0.9961 FUNCTION_LIST FUEREG IF_DATA DIM_X DIRECT 0x818974
 /begin AXIS_DESCR STD_AXIS tmot temp_ub_q0p75_o48 6 -48.00 143.3 DEPOSIT ABSOLUT /end AXIS_DESCR
/end CHARACTERISTIC
/begin CHARACTERISTIC FPRAT "Ansauglufttemperaturschwelle für DV-E-Federprüfung" VALUE 0x81113F KwUb 191.3 temp_ub_q0p75_o48 -48.00 143.3 FUNCTION_LIST BGDVE IF_DATA DIM_X DIRECT 0x81113F /end CHARACTERISTIC
/begin CHARACTERISTIC FPRMT "Motortemperaturschwelle für DV-E-Federprüfung" VALUE 0x811140 KwUb 191.3 temp_ub_q0p75_o48 -48.00 143.3 FUNCTION_LIST BGDVE IF_DATA DIM_X DIRECT 0x811140 /end CHARACTERISTIC
/begin CHARACTERISTIC FPRNMAX "Motordrehzahlschwelle für DV-E-Federprüfung" VALUE 0x811141 KwUb 2550. nmot_ub_q10 0.00 2550. FUNCTION_LIST BGDVE IF_DATA DIM_X DIRECT 0x811141 /end CHARACTERISTIC
/begin CHARACTERISTIC FPRTIM1_T "DV-E-Federprüfung, Wartezeit in Prüfschritt 1" VALUE 0x811142 KwUb 2.540 t10msxs_ub_b2p55 0.01000 2.550 FUNCTION_LIST BGDVE IF_DATA DIM_X DIRECT 0x811142 /end CHARACTERISTIC
/begin CHARACTERISTIC FPRTIM2_T "DV-E-Federprüfung, Wartezeit in Prüfschritt 2" VALUE 0x811143 KwUb 2.540 t10msxs_ub_b2p55 0.01000 2.550 FUNCTION_LIST BGDVE IF_DATA DIM_X DIRECT 0x811143 /end CHARACTERISTIC
/begin CHARACTERISTIC FPRTIM3_T "DV-E-Federprüfung: Wartezeit in Prüfschritt 5" VALUE 0x811144 KwUb 2.540 t10msxs_ub_b2p55 0.01000 2.550 FUNCTION_LIST BGDVE IF_DATA DIM_X DIRECT 0x811144 /end CHARACTERISTIC
/begin CHARACTERISTIC FPRTIM4_T "DV-E-Federprüfung: Wartezeit in Prüfschritt 6" VALUE 0x811145 KwUb 2.540 t10msxs_ub_b2p55 0.01000 2.550 FUNCTION_LIST BGDVE IF_DATA DIM_X DIRECT 0x811145 /end CHARACTERISTIC
/begin CHARACTERISTIC FPUPT "Periodendauer für Fast Pulse Leckdiagnosepumpe" CURVE 0x81A7A2 KlAUbSstUbWUb 2.550 t10msxs_ub_b2p55 0.00 2.550 FUNCTION_LIST DLDP IF_DATA DIM_X DIRECT 0x81A7A2 /begin AXIS_DESCR STD_AXIS tfpg t1sxs_ub_b255 6 0.00 255.0 DEPOSIT ABSOLUT /end AXIS_DESCR /end CHARACTERISTIC
/begin CHARACTERISTIC FPVMXN2 "Faktor maximales Druckverhältnis mit Nebenlastsignal" CURVE 0x81D190 KlAUwSstUwWUw 3.999939 fak_uw_b4 0.00 3.999939 FUNCTION_LIST BGSRM IF_DATA DIM_X DIRECT 0x81D190
 /begin AXIS_DESCR STD_AXIS nmot_w nmot_uw_q0p25 6 0.00 16383.75 DEPOSIT ABSOLUT /end AXIS_DESCR
/end CHARACTERISTIC
/begin CHARACTERISTIC FPWDKAPP "Drosselklappenkennlinie abh. von Fahrpedal nur f. Applik." CURVE 0x815A94 KlAUwSstUwWUw 99.99847 rel_uw_b100 0.00 99.99847 FUNCTION_LIST FUEDK IF_DATA DIM_X DIRECT 0x815A94
 /begin AXIS_DESCR STD_AXIS wped_w relPED_uw_b100 16 0.00 100.0000 DEPOSIT ABSOLUT /end AXIS_DESCR
/end CHARACTERISTIC
/begin CHARACTERISTIC FQTEDL "Kennlinie Faktor für exponentielle Absteuerung Spülrate" CURVE 0x81A580 KlAUbSstUbWUb 1.992 fak_ub_b2 0.00 1.992 FUNCTION_LIST TEB IF_DATA DIM_X DIRECT 0x81A580 /begin AXIS_DESCR STD_AXIS dmlftef fak_ub_b0p5 5 0.00 0.4980 DEPOSIT ABSOLUT /end AXIS_DESCR /end CHARACTERISTIC
/begin CHARACTERISTIC FQTEFR "Kennlinie stetige Grenzwertregelung (fr)" CURVE 0x829C58 KlAUbSstUbWSb 15.88 fak_sb_b16 0.00 15.88 FUNCTION_LIST TEB IF_DATA DIM_X DIRECT 0x829C58 /begin AXIS_DESCR STD_AXIS frmxa fak_ub_b2 8 0.00 1.992 DEPOSIT ABSOLUT /end AXIS_DESCR /end CHARACTERISTIC
/begin CHARACTERISTIC FQTEPT "Kennlinie Tankunterdruckbegrenzung (pte)" CURVE 0x81A58B KlAUbSstSbWSb 15.88 fak_sb_b16 0.00 15.88 FUNCTION_LIST TEB IF_DATA DIM_X DIRECT 0x81A58B /begin AXIS_DESCR STD_AXIS pte p_sb_q0p25 6 -32.00 31.75 DEPOSIT ABSOLUT /end AXIS_DESCR /end CHARACTERISTIC
/begin CHARACTERISTIC FQTEVA "Progression bei Spülratenaufsteuerung" CURVE 0x81A598 KlAUbSstUbWUb 15.94 fak_ub_b16 0.00 15.94 FUNCTION_LIST TEB IF_DATA DIM_X DIRECT 0x81A598 /begin AXIS_DESCR STD_AXIS ftefva fak_ub_b0p5 6 0.00 0.4980 DEPOSIT ABSOLUT /end AXIS_DESCR /end CHARACTERISTIC
/begin CHARACTERISTIC FRAE "Delta-fra-Schwelle für Erkennung der eingeschwungenen Grundadaption" VALUE 0x81E4D2 KwUw 1.999969 fak_uw_b2 0.00 1.999969 FUNCTION_LIST DKVS IF_DATA DIM_X DIRECT 0x81E4D2 /end CHARACTERISTIC
/begin CHARACTERISTIC FRAODN "untere Diagnoseschwelle des Korrekturfaktors frao" VALUE 0x81E4D4 KwUw 1.999969 fak_uw_b2 0.00 1.999969 FUNCTION_LIST DKVS IF_DATA DIM_X DIRECT 0x81E4D4 /end CHARACTERISTIC
/begin CHARACTERISTIC FRAODX "obere Diagnoseschwelle des Korrekturfaktors frao" VALUE 0x81E4D6 KwUw 1.999969 fak_uw_b2 0.00 1.999969 FUNCTION_LIST DKVS IF_DATA DIM_X DIRECT 0x81E4D6 /end CHARACTERISTIC
/begin CHARACTERISTIC FRAOMN "untere Begrenzung des Korrekturfaktors frao" VALUE 0x81904E KwUb 1.992 fak_ub_b2 0.00 1.992 FUNCTION_LIST LRA IF_DATA DIM_X DIRECT 0x81904E /end CHARACTERISTIC
/begin CHARACTERISTIC FRAOMX "obere Begrenzung des Korrekturfaktors frao" VALUE 0x81904F KwUb 1.992 fak_ub_b2 0.00 1.992 FUNCTION_LIST LRA IF_DATA DIM_X DIRECT 0x81904F /end CHARACTERISTIC
/begin CHARACTERISTIC FRAORN "untere reduzierte Schwelle des Korrekturfaktors frao" VALUE 0x819050 KwUb 1.992 fak_ub_b2 0.00 1.992 FUNCTION_LIST LRA IF_DATA DIM_X DIRECT 0x819050 /end CHARACTERISTIC
/begin CHARACTERISTIC FRAORX "obere reduzierte Schwelle des Korrekturfaktors frao" VALUE 0x819051 KwUb 1.992 fak_ub_b2 0.00 1.992 FUNCTION_LIST LRA IF_DATA DIM_X DIRECT 0x819051 /end CHARACTERISTIC
/begin CHARACTERISTIC FRAOS "Schwelle für oberen Anschlag des mult. Anteils der Gemischadaption" VALUE 0x81D74A KwUw 3.999939 fak_uw_b4_no1 -1.000000 2.999939 FUNCTION_LIST DEGFE IF_DATA DIM_X DIRECT 0x81D74A /end CHARACTERISTIC
/begin CHARACTERISTIC FRARAWG "Verstärkungsfaktor bei AT, WK geschlossen" CURVE 0x81A261 FklWUb 3.113 fak_ub_b3p125 0.00 3.113 FUNCTION_LIST ARMD IF_DATA DIM_X DIRECT 0x81A261 /begin AXIS_DESCR FIX_AXIS gangi dez 8 0.00 7.000 FIX_AXIS_PAR 0 0 8 /end AXIS_DESCR /end CHARACTERISTIC
/begin CHARACTERISTIC FRARAWGS "Verstärkungsfaktor Antiruckel bei AT, WK geschlossen für Stationärpfad" CURVE 0x81A269 FklWUb 3.113 fak_ub_b3p125 0.00 3.113 FUNCTION_LIST ARMD IF_DATA DIM_X DIRECT 0x81A269 /begin AXIS_DESCR FIX_AXIS gangi dez 8 0.00 7.000 FIX_AXIS_PAR 0 0 8 /end AXIS_DESCR /end CHARACTERISTIC
/begin CHARACTERISTIC FRARCVT "Verstärkungsfaktor Antiruckel bei CVT" CURVE 0x81A271 GklWUb 3.113 fak_ub_b3p125 0.00 3.113 FUNCTION_LIST ARMD IF_DATA DIM_X DIRECT 0x81A271
 /begin AXIS_DESCR COM_AXIS uefktget uefktget_ub_b25p4 7 0.00 25.50 AXIS_PTS_REF SUV07MDUB /end AXIS_DESCR
/end CHARACTERISTIC
/begin CHARACTERISTIC FRARCVTS "Verstärkungsfaktor Antiruckel bei CVT für Stationärpfad" CURVE 0x81A278 GklWUb 3.113 fak_ub_b3p125 0.00 3.113 FUNCTION_LIST ARMD IF_DATA DIM_X DIRECT 0x81A278
 /begin AXIS_DESCR COM_AXIS uefktget uefktget_ub_b25p4 7 0.00 25.50 AXIS_PTS_REF SUV07MDUB /end AXIS_DESCR
/end CHARACTERISTIC
/begin CHARACTERISTIC FRARHG "Verstärkungsfaktor" CURVE 0x81A27F FklWUb 3.113 fak_ub_b3p125 0.00 3.113 FUNCTION_LIST ARMD IF_DATA DIM_X DIRECT 0x81A27F /begin AXIS_DESCR FIX_AXIS gangi dez 8 0.00 7.000 FIX_AXIS_PAR 0 0 8 /end AXIS_DESCR /end CHARACTERISTIC
/begin CHARACTERISTIC FRARHGS "Verstärkungsfaktor Antiruckel für Stationärpfad" CURVE 0x81A287 FklWUb 3.113 fak_ub_b3p125 0.00 3.113 FUNCTION_LIST ARMD IF_DATA DIM_X DIRECT 0x81A287 /begin AXIS_DESCR FIX_AXIS gangi dez 8 0.00 7.000 FIX_AXIS_PAR 0 0 8 /end AXIS_DESCR /end CHARACTERISTIC
/begin CHARACTERISTIC FRATMN "untere Begrenzung des Korrekturfaktors frat" VALUE 0x819052 KwUb 1.992 fak_ub_b2 0.00 1.992 FUNCTION_LIST LRA IF_DATA DIM_X DIRECT 0x819052 /end CHARACTERISTIC
/begin CHARACTERISTIC FRATMX "obere Begrenzung des Korrekturfaktors frat" VALUE 0x819053 KwUb 1.992 fak_ub_b2 0.00 1.992 FUNCTION_LIST LRA IF_DATA DIM_X DIRECT 0x819053 /end CHARACTERISTIC
/begin CHARACTERISTIC FRAUDN "untere Diagnoseschwelle des Korrekturfaktors frau" VALUE 0x81E4D8 KwUw 1.999969 fak_uw_b2 0.00 1.999969 FUNCTION_LIST DKVS IF_DATA DIM_X DIRECT 0x81E4D8 /end CHARACTERISTIC
/begin CHARACTERISTIC FRAUDX "obere Diagnoseschwelle des Korrekturfaktors frau" VALUE 0x81E4DA KwUw 1.999969 fak_uw_b2 0.00 1.999969 FUNCTION_LIST DKVS IF_DATA DIM_X DIRECT 0x81E4DA /end CHARACTERISTIC
/begin CHARACTERISTIC FRAUMN "untere Begrenzung des Korrekturfaktors frau" VALUE 0x819054 KwUb 1.992 fak_ub_b2 0.00 1.992 FUNCTION_LIST LRA IF_DATA DIM_X DIRECT 0x819054 /end CHARACTERISTIC
/begin CHARACTERISTIC FRAUMX "obere Begrenzung des Korrekturfaktors frau" VALUE 0x819055 KwUb 1.992 fak_ub_b2 0.00 1.992 FUNCTION_LIST LRA IF_DATA DIM_X DIRECT 0x819055 /end CHARACTERISTIC
/begin CHARACTERISTIC FRAURN "untere reduzierte Schwelle des Korrekturfaktors frau" VALUE 0x819056 KwUb 1.992 fak_ub_b2 0.00 1.992 FUNCTION_LIST LRA IF_DATA DIM_X DIRECT 0x819056 /end CHARACTERISTIC
/begin CHARACTERISTIC FRAURX "obere reduzierte Schwelle des Korrekturfaktors frau" VALUE 0x819057 KwUb 1.992 fak_ub_b2 0.00 1.992 FUNCTION_LIST LRA IF_DATA DIM_X DIRECT 0x819057 /end CHARACTERISTIC
/begin CHARACTERISTIC FRAUS "Schwelle für unteren Anschlag des mult. Anteils der Gemischadaption" VALUE 0x81D74C KwUw 3.999939 fak_uw_b4_no1 -1.000000 2.999939 FUNCTION_LIST DEGFE IF_DATA DIM_X DIRECT 0x81D74C /end CHARACTERISTIC
/begin CHARACTERISTIC FRHB "fr-Schwelle für mögliches Rücksetzten Flip-Flop ""Hohe Beladung""" VALUE 0x81A5A5 KwUb 1.992 fak_ub_b2 0.00 1.992 FUNCTION_LIST TEB IF_DATA DIM_X DIRECT 0x81A5A5 /end CHARACTERISTIC
/begin CHARACTERISTIC FRINOF "Faktor für Bewertung alter Ri-Wert ohne Filter" VALUE 0x811017 KwUb 15.94 fak_ub_b16 0.00 15.94 FUNCTION_LIST GGLSH IF_DATA DIM_X DIRECT 0x811017 /end CHARACTERISTIC
/begin CHARACTERISTIC FRKAP_0_A "Faktor relative Kraftstoffmasse für Applikation" VALUE 0x81DCD0 KwUb 1.992 fak_ub_b2 0.00 1.992 FUNCTION_LIST ESGRU IF_DATA DIM_X DIRECT 0x81DCD0 /end CHARACTERISTIC
/begin CHARACTERISTIC FRKAP_1_A "Faktor relative Kraftstoffmasse für Applikation" VALUE 0x81DCD1 KwUb 1.992 fak_ub_b2 0.00 1.992 FUNCTION_LIST ESGRU IF_DATA DIM_X DIRECT 0x81DCD1 /end CHARACTERISTIC
/begin CHARACTERISTIC FRK_AOG "oberer Grenzwert Anpassung Faktor Grundanpassung" VALUE 0x811C58 KwUb 0.4980 fak_ub_b1p25_o0p75 0.7500 1.248 FUNCTION_LIST TKMWL KRACT IF_DATA DIM_X DIRECT 0x811C58 /end CHARACTERISTIC
/begin CHARACTERISTIC FRK_AUG "unterer Grenzwert Anpassung Faktor Grundanpassung" VALUE 0x811C59 KwUb 0.4980 fak_ub_b1p25_o0p75 0.7500 1.248 FUNCTION_LIST TKMWL KRACT IF_DATA DIM_X DIRECT 0x811C59 /end CHARACTERISTIC
/begin CHARACTERISTIC FRLFSDP "Einspritzkorrektur bei RLFS" CURVE 0x81DF5E KlAUwSstSwWUw 1.999969 fak_uw_b2 0.00 1.999969 FUNCTION_LIST RKTI IF_DATA DIM_X DIRECT 0x81DF5E
 /begin AXIS_DESCR STD_AXIS dppk_w p_sw_q0p312 11 -10240.00 10239.69 DEPOSIT ABSOLUT /end AXIS_DESCR
/end CHARACTERISTIC
/begin CHARACTERISTIC FRLMNHO "Korrekturfaktor rlmin über Höhe" CURVE 0x81132C KlAUbSstUbWUb 1.992 fak_ub_b2 0.00 1.992 FUNCTION_LIST MDFUE IF_DATA DIM_X DIRECT 0x81132C /begin AXIS_DESCR STD_AXIS fho fak_ub_b4 5 0.00 3.984 DEPOSIT ABSOLUT /end AXIS_DESCR /end CHARACTERISTIC
/begin CHARACTERISTIC FRMAX "obere Regelbereichsgrenze" VALUE 0x8174A8 KwUw 1.999969 fak_uw_b2 0.00 1.999969 FUNCTION_LIST LRS IF_DATA DIM_X DIRECT 0x8174A8 /end CHARACTERISTIC
/begin CHARACTERISTIC FRMDPMO "obere frm Schwelle für passive Einschaltbedingungen Diagnose TEV" VALUE 0x829D0A KwUw 0.1499939 fak_uw_b2 1.000000 1.149994 FUNCTION_LIST DTEV IF_DATA DIM_X DIRECT 0x829D0A /end CHARACTERISTIC
/begin CHARACTERISTIC FRMDPMU "untere frm Schwelle für passive Einschaltbedingungen Diagnose TEV" VALUE 0x829D0C KwUw 0.1499939 fak_uw_b2 0.8500061 1.000000 FUNCTION_LIST DTEV IF_DATA DIM_X DIRECT 0x829D0C /end CHARACTERISTIC
/begin CHARACTERISTIC FRMDTEVO "obere frm Schwelle für passive i.O. Prüfung Diagnose TEV" VALUE 0x829D0E KwUw 0.1499939 fak_uw_b2 1.000000 1.149994 FUNCTION_LIST DTEV IF_DATA DIM_X DIRECT 0x829D0E /end CHARACTERISTIC
/begin CHARACTERISTIC FRMDTEVU "untere frm Schwelle für passive i.O. Prüfung Diagnose TEV" VALUE 0x829D10 KwUw 0.1499939 fak_uw_b2 0.8500061 1.000000 FUNCTION_LIST DTEV IF_DATA DIM_X DIRECT 0x829D10 /end CHARACTERISTIC
/begin CHARACTERISTIC FRMINKH "Magerbegrenzung Lambdaregelung bei KH mit SL" VALUE 0x8174AA KwUw 1.999969 fak_uw_b2 0.00 1.999969 FUNCTION_LIST LRS IF_DATA DIM_X DIRECT 0x8174AA /end CHARACTERISTIC
/begin CHARACTERISTIC FRMSTDN "untere Diagnoseschwelle (short test)" VALUE 0x81954C KwUb 1.992 fak_ub_b2 0.00 1.992 FUNCTION_LIST DKVS IF_DATA DIM_X DIRECT 0x81954C /end CHARACTERISTIC
/begin CHARACTERISTIC FRMSTDX "obere Diagnoseschwelle (short test)" VALUE 0x81954D KwUb 1.992 fak_ub_b2 0.00 1.992 FUNCTION_LIST DKVS IF_DATA DIM_X DIRECT 0x81954D /end CHARACTERISTIC
/begin CHARACTERISTIC FS1FO "Filterfaktor Segmentzeit-Filter 1 der fuel-on/-off Adaption" VALUE 0x813D36 KwUw 0.9999695 fak_uw_b2 0.00 0.9999695 FUNCTION_LIST DMDFON IF_DATA DIM_X DIRECT 0x813D36 /end CHARACTERISTIC
/begin CHARACTERISTIC FS2FO "Filterfaktor Segmentzeit-Filter 2 der fuel-on/-off Adaption" VALUE 0x813D38 KwUw 0.9999695 fak_uw_b2 0.00 0.9999695 FUNCTION_LIST DMDFON IF_DATA DIM_X DIRECT 0x813D38 /end CHARACTERISTIC
/begin CHARACTERISTIC FSRFTEF "Faktor Steilheit Spülratenregelung in der Nähe des gewünschten Krafstoffanteils" VALUE 0x812752 KwUb 59.75 fak_ub_b64 4.000 63.75 FUNCTION_LIST TEB IF_DATA DIM_X DIRECT 0x812752 /end CHARACTERISTIC
/begin CHARACTERISTIC FSTHO "Wichtung Startfaktor" CURVE 0x81908B KlAUbSstUbWUb 1.992 fak_ub_b2 0.00 1.992 FUNCTION_LIST ESSTT IF_DATA DIM_X DIRECT 0x81908B /begin AXIS_DESCR STD_AXIS fho fak_ub_b4 4 0.00 3.984 DEPOSIT ABSOLUT /end AXIS_DESCR /end CHARACTERISTIC
/begin CHARACTERISTIC FST_AOG "oberer Grenzwert Anpassung Faktor Start" VALUE 0x811C5A KwUb 1.992 fak_ub_b2 0.00 1.992 FUNCTION_LIST TKMWL KRACT IF_DATA DIM_X DIRECT 0x811C5A /end CHARACTERISTIC
/begin CHARACTERISTIC FST_AUG "unterer Grenzwert Anpassung Faktor Start" VALUE 0x811C5B KwUb 1.992 fak_ub_b2 0.00 1.992 FUNCTION_LIST TKMWL KRACT IF_DATA DIM_X DIRECT 0x811C5B /end CHARACTERISTIC
/begin CHARACTERISTIC FSWTM "Faktor Schließwinkelkorrektur tmot-abhängig" CURVE 0x81AA47 KlAUbSstUbWUb 1.992 fak_ub_b2 0.00 1.992 FUNCTION_LIST ZUESZ IF_DATA DIM_X DIRECT 0x81AA47
 /begin AXIS_DESCR STD_AXIS tmot temp_ub_q0p75_o48 5 -48.00 143.3 DEPOSIT ABSOLUT /end AXIS_DESCR
/end CHARACTERISTIC
/begin CHARACTERISTIC FSZTM "Faktor Schließzeitkorrektur tmot-abhängig" CURVE 0x81AA52 KlAUbSstUbWUb 1.992 fak_ub_b2 0.00 1.992 FUNCTION_LIST ZUESZ IF_DATA DIM_X DIRECT 0x81AA52
 /begin AXIS_DESCR STD_AXIS tmot temp_ub_q0p75_o48 5 -48.00 143.3 DEPOSIT ABSOLUT /end AXIS_DESCR
/end CHARACTERISTIC
/begin CHARACTERISTIC FTEADAB "Schwelle Beladung für Abbruch TE-Phase" VALUE 0x81A5A6 KwSb 127.5 fak_sb_b64 -64.00 63.50 FUNCTION_LIST TEB IF_DATA DIM_X DIRECT 0x81A5A6 /end CHARACTERISTIC
/begin CHARACTERISTIC FTEADDPO "obere Beladungsschwelle für passive i.O. Prüfung" VALUE 0x829D12 KwSw 30.00000 fak_sw_b64 20.00000 50.00000 FUNCTION_LIST DTEV IF_DATA DIM_X DIRECT 0x829D12 /end CHARACTERISTIC
/begin CHARACTERISTIC FTEADDPU "untere Beladungsschwelle für passive i.O. Prüfung" VALUE 0x829D14 KwSw 8.000000 fak_sw_b64 2.000000 10.00000 FUNCTION_LIST DTEV IF_DATA DIM_X DIRECT 0x829D14 /end CHARACTERISTIC
/begin CHARACTERISTIC FTEADMX "Maximalwert der Beladung des AKF's" VALUE 0x81A5A7 KwSb 127.5 fak_sb_b64 -64.00 63.50 FUNCTION_LIST TEB IF_DATA DIM_X DIRECT 0x81A5A7 /end CHARACTERISTIC
/begin CHARACTERISTIC FTEADSZ "Schwelle Beladung für TEV sofort schließen aus DTEV" VALUE 0x829D16 KwSw 15.00000 fak_sw_b64 0.00 15.00000 FUNCTION_LIST DTEV IF_DATA DIM_X DIRECT 0x829D16 /end CHARACTERISTIC
/begin CHARACTERISTIC FTEADZU "Schwelle Beladung für Unterbrechung TE-Phase für Diagnose Funktionen" VALUE 0x81E33C KwSw 127.9980 fak_sw_b64 -64.00000 63.99805 FUNCTION_LIST BBTEGA IF_DATA DIM_X DIRECT 0x81E33C /end CHARACTERISTIC
/begin CHARACTERISTIC FTEDS "Schwelle Beladung für Umschaltung auf Dauertankentlüftung" VALUE 0x81E33E KwSw 127.9980 fak_sw_b64 -64.00000 63.99805 FUNCTION_LIST BBTEGA IF_DATA DIM_X DIRECT 0x81E33E /end CHARACTERISTIC
/begin CHARACTERISTIC FTEFHB "Schwelle für Spülrate Tankentlüftung für Erkennung hohe Beladung" VALUE 0x81A5A8 KwUb 0.4980 fak_ub_b0p5 0.00 0.4980 FUNCTION_LIST TEB IF_DATA DIM_X DIRECT 0x81A5A8 /end CHARACTERISTIC
/begin CHARACTERISTIC FTEHB "Schwelle für Faktor Tankentlüftung für Erkennung hohe Beladung" VALUE 0x81A5A9 KwSb 127.5 fak_sb_b64 -64.00 63.50 FUNCTION_LIST TEB IF_DATA DIM_X DIRECT 0x81A5A9 /end CHARACTERISTIC
/begin CHARACTERISTIC FTEINIX "Kennlinie Max. Spülrate abhängig vom Integral Massenstrom TE nach TE Stop" CURVE 0x81A5AA KlAUbSstUbWUb 0.1992 fak_ub_b0p5 0.00 0.1992 FUNCTION_LIST TEB IF_DATA DIM_X DIRECT 0x81A5AA
 /begin AXIS_DESCR STD_AXIS imsteini m_ub_q0p0444 5 0.00 11.32 DEPOSIT ABSOLUT /end AXIS_DESCR
/end CHARACTERISTIC
/begin CHARACTERISTIC FTLDIA "Faktor für Entprellzeit Adaptionsfreigabe" VALUE 0x819CF2 KwUb 1.992 fak_ub_b2 0.00 1.992 FUNCTION_LIST LDRPID IF_DATA DIM_X DIRECT 0x819CF2 /end CHARACTERISTIC
/begin CHARACTERISTIC FTLDIAP "Faktor für Entprellzeit schnelle positive Nachführung" VALUE 0x819CF3 KwUb 1.992 fak_ub_b2 0.00 1.992 FUNCTION_LIST LDRPID IF_DATA DIM_X DIRECT 0x819CF3 /end CHARACTERISTIC
/begin CHARACTERISTIC FTOMN "minimale Öffnungszeit" VALUE 0x81AA5D KwUb 25.50 txms_ub_q0p1 0.00 25.50 FUNCTION_LIST ZUESZ IF_DATA DIM_X DIRECT 0x81AA5D /end CHARACTERISTIC
/begin CHARACTERISTIC FTSDRLW "Faktor Schließzeit bei Lastdynamik" CURVE 0x817BD6 KlAUwSstSwWUw 7.999878 fak_uw_b8 0.00 7.999878 FUNCTION_LIST ZUESZ IF_DATA DIM_X DIRECT 0x817BD6
 /begin AXIS_DESCR STD_AXIS tsdrlmx_w rel_sw_q0p0234 6 -768.0000 767.9766 DEPOSIT ABSOLUT /end AXIS_DESCR
/end CHARACTERISTIC
/begin CHARACTERISTIC FUBAOF "Offenzeit für Funkenbandzündung" VALUE 0x82AFF2 KwUw 43.69000 tsegment_sy 0.00 43.69000 FUNCTION_LIST ZUESZ IF_DATA DIM_X DIRECT 0x82AFF2 /end CHARACTERISTIC
/begin CHARACTERISTIC FUEPMLD "Faktor für gleitender Übergang Druckmittelwert(Referenzdruck) beim Turbo" CURVE 0x81D782 KlAUwSstSwWUw 0.9999847 fak_uw_b1 0.00 0.9999847 FUNCTION_LIST FUEDK IF_DATA DIM_X DIRECT 0x81D782
 /begin AXIS_DESCR STD_AXIS lditv_w tv_sw_q0p005 4 -163.8400 163.8350 DEPOSIT ABSOLUT /end AXIS_DESCR
/end CHARACTERISTIC
/begin CHARACTERISTIC FUKABAKI_0_A "Init.-Wert adaptiver ÜK-Korrekturfaktor BA für kalten Motor" VALUE 0x815F6E KwUb 3.984 fak_ub_b4 0.00 3.984 FUNCTION_LIST ESUKAS IF_DATA DIM_X DIRECT 0x815F6E /end CHARACTERISTIC
/begin CHARACTERISTIC FUKABAKI_1_A "Init.-Wert adaptiver ÜK-Korrekturfaktor BA für kalten Motor" VALUE 0x815F6F KwUb 3.984 fak_ub_b4 0.00 3.984 FUNCTION_LIST ESUKAS IF_DATA DIM_X DIRECT 0x815F6F /end CHARACTERISTIC
/begin CHARACTERISTIC FUKABAKO_0_A "Obergrenze adaptiver ÜK-Korrekturfaktor BA bei kaltem Motor" VALUE 0x815F70 KwUb 3.984 fak_ub_b4 0.00 3.984 FUNCTION_LIST ESUKAS IF_DATA DIM_X DIRECT 0x815F70 /end CHARACTERISTIC
/begin CHARACTERISTIC FUKABAKO_1_A "Obergrenze adaptiver ÜK-Korrekturfaktor BA bei kaltem Motor" VALUE 0x815F71 KwUb 3.984 fak_ub_b4 0.00 3.984 FUNCTION_LIST ESUKAS IF_DATA DIM_X DIRECT 0x815F71 /end CHARACTERISTIC
/begin CHARACTERISTIC FUKABAKU_0_A "Untergrenze adaptiver ÜK-Korrekturfaktor BA bei kaltem Motor" VALUE 0x815F72 KwUb 3.891 fak_ub_b4 0.09375 3.984 FUNCTION_LIST ESUKAS IF_DATA DIM_X DIRECT 0x815F72 /end CHARACTERISTIC
/begin CHARACTERISTIC FUKABAKU_1_A "Untergrenze adaptiver ÜK-Korrekturfaktor BA bei kaltem Motor" VALUE 0x815F73 KwUb 3.891 fak_ub_b4 0.09375 3.984 FUNCTION_LIST ESUKAS IF_DATA DIM_X DIRECT 0x815F73 /end CHARACTERISTIC
/begin CHARACTERISTIC FUKABAWI_0_A "Init.-Wert adaptiver ÜK-Korrekturfaktor BA für warmen Motor" VALUE 0x815F74 KwUb 3.984 fak_ub_b4 0.00 3.984 FUNCTION_LIST ESUKAS IF_DATA DIM_X DIRECT 0x815F74 /end CHARACTERISTIC
/begin CHARACTERISTIC FUKABAWI_1_A "Init.-Wert adaptiver ÜK-Korrekturfaktor BA für warmen Motor" VALUE 0x815F75 KwUb 3.984 fak_ub_b4 0.00 3.984 FUNCTION_LIST ESUKAS IF_DATA DIM_X DIRECT 0x815F75 /end CHARACTERISTIC
/begin CHARACTERISTIC FUKABAWO_0_A "Obergrenze adaptiver ÜK-Korrekturfaktor BA bei warmem Motor" VALUE 0x815F76 KwUb 3.984 fak_ub_b4 0.00 3.984 FUNCTION_LIST ESUKAS IF_DATA DIM_X DIRECT 0x815F76 /end CHARACTERISTIC
/begin CHARACTERISTIC FUKABAWO_1_A "Obergrenze adaptiver ÜK-Korrekturfaktor BA bei warmem Motor" VALUE 0x815F77 KwUb 3.984 fak_ub_b4 0.00 3.984 FUNCTION_LIST ESUKAS IF_DATA DIM_X DIRECT 0x815F77 /end CHARACTERISTIC
/begin CHARACTERISTIC FUKABAWU_0_A "Untergrenze adaptiver ÜK-Korrekturfaktor BA bei warmem Motor" VALUE 0x815F78 KwUb 3.891 fak_ub_b4 0.09375 3.984 FUNCTION_LIST ESUKAS IF_DATA DIM_X DIRECT 0x815F78 /end CHARACTERISTIC
/begin CHARACTERISTIC FUKABAWU_1_A "Untergrenze adaptiver ÜK-Korrekturfaktor BA bei warmem Motor" VALUE 0x815F79 KwUb 3.891 fak_ub_b4 0.09375 3.984 FUNCTION_LIST ESUKAS IF_DATA DIM_X DIRECT 0x815F79 /end CHARACTERISTIC
/begin CHARACTERISTIC FUKAVAKI_0_A "Init.-Wert adaptiver ÜK-Korrekturfaktor VA für kalten Motor" VALUE 0x815F7A KwUb 3.984 fak_ub_b4 0.00 3.984 FUNCTION_LIST ESUKAS IF_DATA DIM_X DIRECT 0x815F7A /end CHARACTERISTIC
/begin CHARACTERISTIC FUKAVAKI_1_A "Init.-Wert adaptiver ÜK-Korrekturfaktor VA für kalten Motor" VALUE 0x815F7B KwUb 3.984 fak_ub_b4 0.00 3.984 FUNCTION_LIST ESUKAS IF_DATA DIM_X DIRECT 0x815F7B /end CHARACTERISTIC
/begin CHARACTERISTIC FUKAVAKO_0_A "Obergrenze adaptiver ÜK-Korrekturfaktor VA bei kaltem Motor" VALUE 0x815F7C KwUb 3.984 fak_ub_b4 0.00 3.984 FUNCTION_LIST ESUKAS IF_DATA DIM_X DIRECT 0x815F7C /end CHARACTERISTIC
/begin CHARACTERISTIC FUKAVAKO_1_A "Obergrenze adaptiver ÜK-Korrekturfaktor VA bei kaltem Motor" VALUE 0x815F7D KwUb 3.984 fak_ub_b4 0.00 3.984 FUNCTION_LIST ESUKAS IF_DATA DIM_X DIRECT 0x815F7D /end CHARACTERISTIC
/begin CHARACTERISTIC FUKAVAKU_0_A "Untergrenze adaptiver ÜK-Korrekturfaktor VA bei kaltem Motor" VALUE 0x815F7E KwUb 3.891 fak_ub_b4 0.09375 3.984 FUNCTION_LIST ESUKAS IF_DATA DIM_X DIRECT 0x815F7E /end CHARACTERISTIC
/begin CHARACTERISTIC FUKAVAKU_1_A "Untergrenze adaptiver ÜK-Korrekturfaktor VA bei kaltem Motor" VALUE 0x815F7F KwUb 3.891 fak_ub_b4 0.09375 3.984 FUNCTION_LIST ESUKAS IF_DATA DIM_X DIRECT 0x815F7F /end CHARACTERISTIC
/begin CHARACTERISTIC FUKAVAWI_0_A "Init.-Wert adaptiver ÜK-Korrekturfaktor VA für warmen Motor" VALUE 0x815F80 KwUb 3.984 fak_ub_b4 0.00 3.984 FUNCTION_LIST ESUKAS IF_DATA DIM_X DIRECT 0x815F80 /end CHARACTERISTIC
/begin CHARACTERISTIC FUKAVAWI_1_A "Init.-Wert adaptiver ÜK-Korrekturfaktor VA für warmen Motor" VALUE 0x815F81 KwUb 3.984 fak_ub_b4 0.00 3.984 FUNCTION_LIST ESUKAS IF_DATA DIM_X DIRECT 0x815F81 /end CHARACTERISTIC
/begin CHARACTERISTIC FUKAVAWO_0_A "Obergrenze adaptiver ÜK-Korrekturfaktor VA bei warmem Motor" VALUE 0x815F82 KwUb 3.984 fak_ub_b4 0.00 3.984 FUNCTION_LIST ESUKAS IF_DATA DIM_X DIRECT 0x815F82 /end CHARACTERISTIC
/begin CHARACTERISTIC FUKAVAWO_1_A "Obergrenze adaptiver ÜK-Korrekturfaktor VA bei warmem Motor" VALUE 0x815F83 KwUb 3.984 fak_ub_b4 0.00 3.984 FUNCTION_LIST ESUKAS IF_DATA DIM_X DIRECT 0x815F83 /end CHARACTERISTIC
/begin CHARACTERISTIC FUKAVAWU_0_A "Untergrenze adaptiver ÜK-Korrekturfaktor VA bei warmem Motor" VALUE 0x815F84 KwUb 3.891 fak_ub_b4 0.09375 3.984 FUNCTION_LIST ESUKAS IF_DATA DIM_X DIRECT 0x815F84 /end CHARACTERISTIC
/begin CHARACTERISTIC FUKAVAWU_1_A "Untergrenze adaptiver ÜK-Korrekturfaktor VA bei warmem Motor" VALUE 0x815F85 KwUb 3.891 fak_ub_b4 0.09375 3.984 FUNCTION_LIST ESUKAS IF_DATA DIM_X DIRECT 0x815F85 /end CHARACTERISTIC
/begin CHARACTERISTIC FUKNSTHO "Hoehenfaktor ÜK im Nachstart" CURVE 0x819322 KlAUbSstUbWUb 1.992 fak_ub_b2 0.00 1.992 FUNCTION_LIST ESUK IF_DATA DIM_X DIRECT 0x819322 /begin AXIS_DESCR STD_AXIS fho fak_ub_b4 6 0.00 3.984 DEPOSIT ABSOLUT /end AXIS_DESCR /end CHARACTERISTIC
/begin CHARACTERISTIC FUKNSTM "Startwert Faktor ÜK im Nachstart" CURVE 0x81932F KlAUbSstUbWUb 3.984 fak_ub_b4 0.00 3.984 FUNCTION_LIST ESUK IF_DATA DIM_X DIRECT 0x81932F
 /begin AXIS_DESCR STD_AXIS tmst temp_ub_q0p75_o48 9 -48.00 143.3 DEPOSIT ABSOLUT /end AXIS_DESCR
/end CHARACTERISTIC
/begin CHARACTERISTIC FUMRBRK "Faktor Umrechnung HC-Konzentration in Beladung ftead" VALUE 0x81A5B5 KwUb 31.88 fak_ub_b32 0.00 31.88 FUNCTION_LIST TEB IF_DATA DIM_X DIRECT 0x81A5B5 /end CHARACTERISTIC
/begin CHARACTERISTIC FUMRMV "Faktor Dichte der Luft" VALUE 0x812796 KwUb 1.992 dichte_ub_b2 0.00 1.992 FUNCTION_LIST BGTEV IF_DATA DIM_X DIRECT 0x812796 /end CHARACTERISTIC
/begin CHARACTERISTIC FVANST "Gewichtungsfaktor VA im Nachstart" VALUE 0x811BEB KwUb 1.992 fak_ub_b2 0.00 1.992 FUNCTION_LIST ESUK IF_DATA DIM_X DIRECT 0x811BEB /end CHARACTERISTIC
/begin CHARACTERISTIC FVA_AOG "oberer Grenzwert Anpassung Faktor VA" VALUE 0x811C5C KwUb 1.992 fak_ub_b2 0.00 1.992 FUNCTION_LIST TKMWL KRACT IF_DATA DIM_X DIRECT 0x811C5C /end CHARACTERISTIC
/begin CHARACTERISTIC FVA_AUG "unterer Grenzwert Anpassung Faktor VA" VALUE 0x811C5D KwUb 1.992 fak_ub_b2 0.00 1.992 FUNCTION_LIST TKMWL KRACT IF_DATA DIM_X DIRECT 0x811C5D /end CHARACTERISTIC
/begin CHARACTERISTIC FVDMDWAN "Verstärkungsfaktor zur Bildung D-Ateil-Wandlermomnet" VALUE 0x811DC1 KwUb 7.969 fak_ub_b8 0.00 7.969 FUNCTION_LIST MDWAN IF_DATA DIM_X DIRECT 0x811DC1 /end CHARACTERISTIC
/begin CHARACTERISTIC FVERMN "Kennlinie Faktor Vermischung Regeneriergas Tankentlüftung mit Frischluft" CURVE 0x812753 KlAUbSstUbWUb 0.9961 fak_ub_b1 0.00 0.9961 FUNCTION_LIST TEB IF_DATA DIM_X DIRECT 0x812753 /begin AXIS_DESCR STD_AXIS nmot nmot_ub_q40 6 0.00 10200. DEPOSIT ABSOLUT /end AXIS_DESCR /end CHARACTERISTIC
/begin CHARACTERISTIC FVERZDYN "Dynamischer Faktor Verzögerung Regeneriergas zw. Drosselklappe, Einspritzventil" CURVE 0x8177EA GklWUw 0.003905886 t_min_q5p96em8 0.00 0.003905886 FUNCTION_LIST TEB IF_DATA DIM_X DIRECT 0x8177EA
 /begin AXIS_DESCR COM_AXIS qmsdyn fak_ub_b16 5 0.00 15.94 AXIS_PTS_REF SQM05TEUB /end AXIS_DESCR
/end CHARACTERISTIC
/begin CHARACTERISTIC FVFKUKA "Gewichtung des Korrekturfaktors in UK-Adaption" VALUE 0x811BF1 KwUb 7.969 fak_ub_b8 0.00 7.969 FUNCTION_LIST ESUKAS IF_DATA DIM_X DIRECT 0x811BF1 /end CHARACTERISTIC
/begin CHARACTERISTIC FVMXLDRA "Wichtungsfaktor  für max. zulässiges Druckverhältnis zur Auslösung von B_mxldra" VALUE 0x819E4F KwUb 1.992 fak_ub_b2 0.00 1.992 FUNCTION_LIST DLDR IF_DATA DIM_X DIRECT 0x819E4F /end CHARACTERISTIC
/begin CHARACTERISTIC FVPDKLDL "Wichtungsfaktor  für max. zulässiges Druckverhältnis zur Auslösung von E_lkvdk" VALUE 0x819E50 KwUb 1.992 fak_ub_b2 0.00 1.992 FUNCTION_LIST DLDR IF_DATA DIM_X DIRECT 0x819E50 /end CHARACTERISTIC
/begin CHARACTERISTIC FVPDKLDS "Wichtungsfaktor  für min. zulässiges Druckverhältnis zur Auslösung von E_lkvdk" VALUE 0x819E51 KwUb 1.992 fak_ub_b2 0.00 1.992 FUNCTION_LIST DLDR IF_DATA DIM_X DIRECT 0x819E51 /end CHARACTERISTIC
/begin CHARACTERISTIC FVRMDYN "dynamischer Faktor Vermischung Regeneriergas Tankentlüftung mit Frischluft" CURVE 0x812760 GklWUb 7.969 fak_ub_b8 0.00 7.969 FUNCTION_LIST TEB IF_DATA DIM_X DIRECT 0x812760
 /begin AXIS_DESCR COM_AXIS qmsdyn fak_ub_b16 5 0.00 15.94 AXIS_PTS_REF SQM05TEUB /end AXIS_DESCR
/end CHARACTERISTIC
/begin CHARACTERISTIC FWCBFT "Bewertungsfaktor Turbo für CAN-Ausgabe" VALUE 0x810175 KwUb 25.50 fak_q0p1 0.00 25.50 FUNCTION_LIST CAN IF_DATA DIM_X DIRECT 0x810175 /end CHARACTERISTIC
/begin CHARACTERISTIC FWDMVAD_0_A "Faktor zur Wichtung von dmvad_w in %MDMIN" CURVE 0x828088 KlAUwSstUwWUw 0.9999847 fak_uw_b1 0.00 0.9999847 FUNCTION_LIST MDMIN IF_DATA DIM_X INDIRECT 0x816236 /begin AXIS_DESCR STD_AXIS nver_w fak_uw_b8 8 0.00 7.999878 DEPOSIT ABSOLUT /end AXIS_DESCR /end CHARACTERISTIC
/begin CHARACTERISTIC FWDMVAD_1_A "Faktor zur Wichtung von dmvad_w in %MDMIN" CURVE 0x8280AA KlAUwSstUwWUw 0.9999847 fak_uw_b1 0.00 0.9999847 FUNCTION_LIST MDMIN IF_DATA DIM_X INDIRECT 0x81623A /begin AXIS_DESCR STD_AXIS nver_w fak_uw_b8 8 0.00 7.999878 DEPOSIT ABSOLUT /end AXIS_DESCR /end CHARACTERISTIC
/begin CHARACTERISTIC FWEAB "Rekursionskostante Wiedereinsetzfaktor abnehmend" VALUE 0x81120B KwUb 0.9961 fak_ub_b1 0.00 0.9961 FUNCTION_LIST ACIFI IF_DATA DIM_X DIRECT 0x81120B /end CHARACTERISTIC
/begin CHARACTERISTIC FWEAUF "Rekursionskonstante Wiedereinsetzfaktor zunehmend" VALUE 0x81120C KwUb 0.9961 fak_ub_b1 0.00 0.9961 FUNCTION_LIST ACIFI IF_DATA DIM_X DIRECT 0x81120C /end CHARACTERISTIC
/begin CHARACTERISTIC FWEHT "Faktor Wiedereinsetzmenge  temperaturabhängig (hartes WE)" CURVE 0x8191DA KlAUbSstUbWUb 1.992 fak_ub_b2 0.00 1.992 FUNCTION_LIST ESWE IF_DATA DIM_X DIRECT 0x8191DA
 /begin AXIS_DESCR STD_AXIS tmot temp_ub_q0p75_o48 9 -48.00 143.3 DEPOSIT ABSOLUT /end AXIS_DESCR
/end CHARACTERISTIC
/begin CHARACTERISTIC FWEMXT "maximaler Faktor Wiedereinsetzen Temperaturkennlinie" CURVE 0x818741 KlAUbSstUbWUb 0.9922 fak_ub_b2 1.000 1.992 FUNCTION_LIST ACIFI IF_DATA DIM_X DIRECT 0x818741
 /begin AXIS_DESCR STD_AXIS tmot temp_ub_q0p75_o48 8 -48.00 143.3 DEPOSIT ABSOLUT /end AXIS_DESCR
/end CHARACTERISTIC
/begin CHARACTERISTIC FWET "Faktor Wiedereinsetzmenge temperaturabhaengig" CURVE 0x8191ED KlAUbSstUbWUb 1.992 fak_ub_b2 0.00 1.992 FUNCTION_LIST ESWE IF_DATA DIM_X DIRECT 0x8191ED
 /begin AXIS_DESCR STD_AXIS tmot temp_ub_q0p75_o48 9 -48.00 143.3 DEPOSIT ABSOLUT /end AXIS_DESCR
/end CHARACTERISTIC
/begin CHARACTERISTIC FWFN "Faktor Wandfilm Drehzahleinfluss" VALUE 0x815F0C KwSw 2.999954 rel_sw_b1p5 -1.500000 1.499954 FUNCTION_LIST ESUK IF_DATA DIM_X DIRECT 0x815F0C /end CHARACTERISTIC
/begin CHARACTERISTIC FWFTBRTA "Wichtung ftbr in Abhängigkeit von tans" CURVE 0x8188DD KlAUbSstUbWUb 1.992 fak_ub_b2 0.00 1.992 FUNCTION_LIST BGTEMPK IF_DATA DIM_X DIRECT 0x8188DD
 /begin AXIS_DESCR STD_AXIS tempin temp_ub_q0p75_o48 14 -48.00 143.3 DEPOSIT ABSOLUT /end AXIS_DESCR
/end CHARACTERISTIC
/begin CHARACTERISTIC FWLKFTBR "Warmlaufkorrektur für Brennraumtemperaturmodell" CURVE 0x8188FA KlAUbSstUbWUb 1.992 fak_ub_b2 0.00 1.992 FUNCTION_LIST BGTEMPK IF_DATA DIM_X DIRECT 0x8188FA
 /begin AXIS_DESCR STD_AXIS tmotdif temp_ub_q0p75_o48 8 -48.00 143.3 DEPOSIT ABSOLUT /end AXIS_DESCR
/end CHARACTERISTIC
/begin CHARACTERISTIC FWL_AOG "oberer Grenzwert Anpassung Faktor Warmlauf" VALUE 0x811C5E KwUb 1.992 fak_ub_b2 0.00 1.992 FUNCTION_LIST TKMWL KRACT IF_DATA DIM_X DIRECT 0x811C5E /end CHARACTERISTIC
/begin CHARACTERISTIC FWL_AUG "unterer Grenzwert Anpassung Faktor Warmlauf" VALUE 0x811C5F KwUb 1.992 fak_ub_b2 0.00 1.992 FUNCTION_LIST TKMWL KRACT IF_DATA DIM_X DIRECT 0x811C5F /end CHARACTERISTIC
/begin CHARACTERISTIC FWMABGW "Faktor für Wärmemengen bei Wiederholstart für Taupunktende Abgas vor Vorkat" VALUE 0x8184B3 KwUb 0.9961 fak_ub_b1 0.00 0.9961 FUNCTION_LIST ATM IF_DATA DIM_X DIRECT 0x8184B3 /end CHARACTERISTIC
/begin CHARACTERISTIC FWMKATW "Faktor für Wärmemengen bei Wiederholstart für Taupunktende hinter Hauptkat" VALUE 0x8184B4 KwUb 0.9961 fak_ub_b1 0.00 0.9961 FUNCTION_LIST ATM IF_DATA DIM_X DIRECT 0x8184B4 /end CHARACTERISTIC
/begin CHARACTERISTIC FWMLHFMMN "Wichtungsfaktor für minimale HFM-Luftmassen Schwelle in Abhängigkeit von d.Höhe" CURVE 0x81D0D8 KlAUwSstUwWUw 0.9999847 fak_uw_b1 0.00 0.9999847 FUNCTION_LIST DHFM IF_DATA DIM_X DIRECT 0x81D0D8 /begin AXIS_DESCR STD_AXIS fho_w fak_uw_b4 2 0.00 3.999939 DEPOSIT ABSOLUT /end AXIS_DESCR /end CHARACTERISTIC
/begin CHARACTERISTIC FWNMOT "Einschaltschwelle nmot für Funkenbandzündung" VALUE 0x81AA5E KwUb 10200. nmot_ub_q40 0.00 10200. FUNCTION_LIST ZUESZ IF_DATA DIM_X DIRECT 0x81AA5E /end CHARACTERISTIC
/begin CHARACTERISTIC FWRLDKNM "KL für Wichtung der rel. Luftfüllung aus DK-Signal berechnet in Abh. von nmot" CURVE 0x815482 KlAUwSstUwWUw 1.999969 fak_uw_b2 0.00 1.999969 FUNCTION_LIST BGMSZS IF_DATA DIM_X DIRECT 0x815482
 /begin AXIS_DESCR STD_AXIS nmot_w nmot_uw_q0p25 6 0.00 16383.75 DEPOSIT ABSOLUT /end AXIS_DESCR
/end CHARACTERISTIC
/begin CHARACTERISTIC FWTMUEBO "Tmot-Schwelle zum Setzen Temperaturüberschutz" VALUE 0x8183CC KwUb 255.0 temp_ub_q0p75_o48 0.00 255.0 FUNCTION_LIST CAN IF_DATA DIM_X DIRECT 0x8183CC /end CHARACTERISTIC
/begin CHARACTERISTIC FWTMUEBU "Tmot-Schwelle zum Rücksetzen Temperaturüberschutz" VALUE 0x8183CD KwUb 255.0 temp_ub_q0p75_o48 0.00 255.0 FUNCTION_LIST CAN IF_DATA DIM_X DIRECT 0x8183CD /end CHARACTERISTIC
/begin CHARACTERISTIC FWTOUEBO "Töl-Schwelle zum Setzen Temperaturüberschutz" VALUE 0x81BD2E KwUw 65535.00 temp_q0p0234_o273 -0.009375000 65534.99 FUNCTION_LIST CAN IF_DATA DIM_X DIRECT 0x81BD2E /end CHARACTERISTIC
/begin CHARACTERISTIC FWTOUEBU "Töl-Schwelle zum Rücksetzen Temperaturüberschutz" VALUE 0x81BD30 KwUw 65535.00 temp_q0p0234_o273 -0.009375000 65534.99 FUNCTION_LIST CAN IF_DATA DIM_X DIRECT 0x81BD30 /end CHARACTERISTIC
/begin CHARACTERISTIC FZANSSA1_0_A "Faktor für zündsynchrone Abregelung des Nachstartfaktors bei Heißstart Bereich 1" CURVE 0x818B67 GklWUb 0.249023438 fak_ub_b0p25 0.00 0.249023438 FUNCTION_LIST ESNSWL IF_DATA DIM_X INDIRECT 0x813F42
 /begin AXIS_DESCR COM_AXIS tans temp_ub_q0p75_o48 6 -48.00 143.3 AXIS_PTS_REF STA06ESUB /end AXIS_DESCR
/end CHARACTERISTIC
/begin CHARACTERISTIC FZANSSA1_1_A "Faktor für zündsynchrone Abregelung des Nachstartfaktors bei Heißstart Bereich 1" CURVE 0x818B6D GklWUb 0.249023438 fak_ub_b0p25 0.00 0.249023438 FUNCTION_LIST ESNSWL IF_DATA DIM_X INDIRECT 0x813F46
 /begin AXIS_DESCR COM_AXIS tans temp_ub_q0p75_o48 6 -48.00 143.3 AXIS_PTS_REF STA06ESUB /end AXIS_DESCR
/end CHARACTERISTIC
/begin CHARACTERISTIC FZANSSA2_0_A "Faktor für zündsynchrone Abregelung des Nachstartfaktors bei Heißstart Bereich 2" CURVE 0x818B73 GklWUb 0.249023438 fak_ub_b0p25 0.00 0.249023438 FUNCTION_LIST ESNSWL IF_DATA DIM_X INDIRECT 0x813F4A
 /begin AXIS_DESCR COM_AXIS tans temp_ub_q0p75_o48 6 -48.00 143.3 AXIS_PTS_REF STA06ESUB /end AXIS_DESCR
/end CHARACTERISTIC
/begin CHARACTERISTIC FZANSSA2_1_A "Faktor für zündsynchrone Abregelung des Nachstartfaktors bei Heißstart Bereich 2" CURVE 0x818B79 GklWUb 0.249023438 fak_ub_b0p25 0.00 0.249023438 FUNCTION_LIST ESNSWL IF_DATA DIM_X INDIRECT 0x813F4E
 /begin AXIS_DESCR COM_AXIS tans temp_ub_q0p75_o48 6 -48.00 143.3 AXIS_PTS_REF STA06ESUB /end AXIS_DESCR
/end CHARACTERISTIC
/begin CHARACTERISTIC FZANSSM1_0_A "Faktor für zündsynchrone Abregelung des Nachstartfaktors oberhalb Schwelle" CURVE 0x818B7F GklWUb 0.249023438 fak_ub_b0p25 0.00 0.249023438 FUNCTION_LIST ESNSWL IF_DATA DIM_X INDIRECT 0x813F52
 /begin AXIS_DESCR COM_AXIS tmst temp_ub_q0p75_o48 12 -48.00 143.3 AXIS_PTS_REF STS12ESUB /end AXIS_DESCR
/end CHARACTERISTIC
/begin CHARACTERISTIC FZANSSM1_1_A "Faktor für zündsynchrone Abregelung des Nachstartfaktors oberhalb Schwelle" CURVE 0x818B8B GklWUb 0.249023438 fak_ub_b0p25 0.00 0.249023438 FUNCTION_LIST ESNSWL IF_DATA DIM_X INDIRECT 0x813F56
 /begin AXIS_DESCR COM_AXIS tmst temp_ub_q0p75_o48 12 -48.00 143.3 AXIS_PTS_REF STS12ESUB /end AXIS_DESCR
/end CHARACTERISTIC
/begin CHARACTERISTIC FZDA1SCH "Korrekturfaktor Dashpot-Zeitkonstante im Schichtbetrieb" VALUE 0x811F50 KwUb 3.00000 rfak_q0p5 1.00000 4.00000 FUNCTION_LIST MDFAW IF_DATA DIM_X DIRECT 0x811F50 /end CHARACTERISTIC
/begin CHARACTERISTIC FZDA2SCH "Korrekturfaktor Dashpot-Zeitkonstante bei kl. Kupplungsmoment im Schichtbetr." VALUE 0x811F51 KwUb 3.00000 rfak_q0p5 1.00000 4.00000 FUNCTION_LIST MDFAW IF_DATA DIM_X DIRECT 0x811F51 /end CHARACTERISTIC
/begin CHARACTERISTIC FZN0 "Zylinderindividueller Faktor bei neutraler NW-Stellung EV 1" CURVE 0x818752 GklWUb 1.992 fak_ub_b2 0.00 1.992 FUNCTION_LIST ACIFI IF_DATA DIM_X DIRECT 0x818752
 /begin AXIS_DESCR COM_AXIS nmot nmot_ub_q40 16 0.00 10200. AXIS_PTS_REF SNM16CIUB /end AXIS_DESCR
/end CHARACTERISTIC
/begin CHARACTERISTIC FZN1 "Zylinderindividueller Faktor bei neutraler NW-Stellung EV 1" CURVE 0x818762 GklWUb 1.992 fak_ub_b2 0.00 1.992 FUNCTION_LIST ACIFI IF_DATA DIM_X DIRECT 0x818762
 /begin AXIS_DESCR COM_AXIS nmot nmot_ub_q40 16 0.00 10200. AXIS_PTS_REF SNM16CIUB /end AXIS_DESCR
/end CHARACTERISTIC
/begin CHARACTERISTIC FZN2 "Zylinderindividueller Faktor bei neutraler NW-Stellung EV 2" CURVE 0x818772 GklWUb 1.992 fak_ub_b2 0.00 1.992 FUNCTION_LIST ACIFI IF_DATA DIM_X DIRECT 0x818772
 /begin AXIS_DESCR COM_AXIS nmot nmot_ub_q40 16 0.00 10200. AXIS_PTS_REF SNM16CIUB /end AXIS_DESCR
/end CHARACTERISTIC
/begin CHARACTERISTIC FZN3 "Zylinderindividueller Faktor bei neutraler NW-Stellung EV 3" CURVE 0x818782 GklWUb 1.992 fak_ub_b2 0.00 1.992 FUNCTION_LIST ACIFI IF_DATA DIM_X DIRECT 0x818782
 /begin AXIS_DESCR COM_AXIS nmot nmot_ub_q40 16 0.00 10200. AXIS_PTS_REF SNM16CIUB /end AXIS_DESCR
/end CHARACTERISTIC
/begin CHARACTERISTIC FZNWN0 "Zylinderindividueller Faktor bei aktiver NW-Stellung EV 1" CURVE 0x818792 GklWUb 1.992 fak_ub_b2 0.00 1.992 FUNCTION_LIST ACIFI IF_DATA DIM_X DIRECT 0x818792
 /begin AXIS_DESCR COM_AXIS nmot nmot_ub_q40 16 0.00 10200. AXIS_PTS_REF SNM16CIUB /end AXIS_DESCR
/end CHARACTERISTIC
/begin CHARACTERISTIC FZNWN1 "Zylinderindividueller Faktor bei aktiver NW-Stellung EV 1" CURVE 0x8187A2 GklWUb 1.992 fak_ub_b2 0.00 1.992 FUNCTION_LIST ACIFI IF_DATA DIM_X DIRECT 0x8187A2
 /begin AXIS_DESCR COM_AXIS nmot nmot_ub_q40 16 0.00 10200. AXIS_PTS_REF SNM16CIUB /end AXIS_DESCR
/end CHARACTERISTIC
/begin CHARACTERISTIC FZNWN2 "Zylinderindividueller Faktor bei aktiver NW-Stellung EV 2" CURVE 0x8187B2 GklWUb 1.992 fak_ub_b2 0.00 1.992 FUNCTION_LIST ACIFI IF_DATA DIM_X DIRECT 0x8187B2
 /begin AXIS_DESCR COM_AXIS nmot nmot_ub_q40 16 0.00 10200. AXIS_PTS_REF SNM16CIUB /end AXIS_DESCR
/end CHARACTERISTIC
/begin CHARACTERISTIC FZNWN3 "Zylinderindividueller Faktor bei aktiver NW-Stellung EV 3" CURVE 0x8187C2 GklWUb 1.992 fak_ub_b2 0.00 1.992 FUNCTION_LIST ACIFI IF_DATA DIM_X DIRECT 0x8187C2
 /begin AXIS_DESCR COM_AXIS nmot nmot_ub_q40 16 0.00 10200. AXIS_PTS_REF SNM16CIUB /end AXIS_DESCR
/end CHARACTERISTIC
/begin CHARACTERISTIC FZWKHMX "Normierung für Faktor Momentenreserve Katheizen" VALUE 0x812876 KwUb 0.9961 fak_ub_b1 0.00 0.9961 FUNCTION_LIST ZWMIN IF_DATA DIM_X DIRECT 0x812876 /end CHARACTERISTIC
/begin CHARACTERISTIC FZWWLRLN "Wichtung Delta-Zündwinkel im Warmlauf" MAP 0x812C50 GkfWUb 1.992 fak_ub_b2 0.00 1.992 FUNCTION_LIST ZWWL IF_DATA DIM_X DIRECT 0x812C50
 /begin AXIS_DESCR COM_AXIS nmot nmot_ub_q40 12 0.00 10200. AXIS_PTS_REF SNM12ESUB /end AXIS_DESCR
 /begin AXIS_DESCR COM_AXIS rl rel_ub_q0p75 6 0.00 191.3 AXIS_PTS_REF SRL06ESUB /end AXIS_DESCR
/end CHARACTERISTIC
/begin CHARACTERISTIC GFDLDN "LLR: Gewichtungsfaktor für D-Verstärkung auf Luftpfad" CURVE 0x811D04 GklWUb 0.9961 rel_ub_b1p0 0.00 0.9961 FUNCTION_LIST LLRRM IF_DATA DIM_X DIRECT 0x811D04
 /begin AXIS_DESCR COM_AXIS dns nmotd_sb_q10 6 -1280. 1270. AXIS_PTS_REF SNS06LLSB /end AXIS_DESCR
/end CHARACTERISTIC
/begin CHARACTERISTIC GRAOFLOGIN "Login-Code für GRA sperren" VALUE 0x8161B4 KwUw 65535.00 dez 0.00 65535.00 FUNCTION_LIST TKMWL K71SR KDIAG KWPDATR IF_DATA DIM_X DIRECT 0x8161B4 /end CHARACTERISTIC
/begin CHARACTERISTIC GRAONLOGIN "Login-Code für GRA freischalten" VALUE 0x8161B6 KwUw 65535.00 dez 0.00 65535.00 FUNCTION_LIST TKMWL K71SR KDIAG KWPDATR IF_DATA DIM_X DIRECT 0x8161B6 /end CHARACTERISTIC
/begin CHARACTERISTIC GWPLDOB "Gradient Pedalwinkel zum Ausloesen des Overboost" VALUE 0x819D59 KwUb 2000. rel_ub_q8 0.00 2000. FUNCTION_LIST LDOB IF_DATA DIM_X DIRECT 0x819D59 /end CHARACTERISTIC
/begin CHARACTERISTIC GWPLDU "Gradientenschwelle pedal für dynamische Freigabe Umluftventilsteuerung" VALUE 0x811C8C KwSb 99.60 rel_sb_q0p39 -50.00 49.61 FUNCTION_LIST LDUVST IF_DATA DIM_X DIRECT 0x811C8C /end CHARACTERISTIC
/begin CHARACTERISTIC HLDPU "Untere Höhenschwelle für Leckdiagnosemodul" VALUE 0x81A7AF KwUb 3.984 fak_ub_b4 0.00 3.984 FUNCTION_LIST DLDP IF_DATA DIM_X DIRECT 0x81A7AF /end CHARACTERISTIC
/begin CHARACTERISTIC HLOFFLOGIN "Login-Code für Heißland deaktiv" VALUE 0x8161B8 KwUw 65535.00 dez 0.00 65535.00 FUNCTION_LIST TKMWL K71SR KWPDATR IF_DATA DIM_X DIRECT 0x8161B8 /end CHARACTERISTIC
/begin CHARACTERISTIC HLONLOGIN "Login-Code für Heißland aktiv" VALUE 0x8161BA KwUw 65535.00 dez 0.00 65535.00 FUNCTION_LIST TKMWL K71SR KWPDATR IF_DATA DIM_X DIRECT 0x8161BA /end CHARACTERISTIC
/begin CHARACTERISTIC HLSUKORMX "Maximalwert des Korrekturfaktors für die  LSU-Heizleistung" VALUE 0x81A458 KwUb 1.992 fak_ub_b2 0.00 1.992 FUNCTION_LIST HLSU IF_DATA DIM_X DIRECT 0x81A458 /end CHARACTERISTIC
/begin CHARACTERISTIC HSLDSUA "Hysterese für stationäre Schubumluftventilansteuerung" VALUE 0x816350 KwUw 2559.961 p_uw_q0p039 0.00 2559.961 FUNCTION_LIST LDUVST IF_DATA DIM_X DIRECT 0x816350 /end CHARACTERISTIC
/begin CHARACTERISTIC HSSLDSUA "Hysterese zum Schließen der Turbo Umluftventile im Stationärpfad" VALUE 0x811C8E KwUb 3.984 fak_ub_b4 0.00 3.984 FUNCTION_LIST LDUVST IF_DATA DIM_X DIRECT 0x811C8E /end CHARACTERISTIC
/begin CHARACTERISTIC HYNMOTNW "Hysterese für nmot_w zur Adressierung von Kennfeld" VALUE 0x81A86F KwUb 10200. nmot_ub_q40 0.00 10200. FUNCTION_LIST BGARNW IF_DATA DIM_X DIRECT 0x81A86F /end CHARACTERISTIC
/begin CHARACTERISTIC IDTHMO "obere Schwelle der integrierten Luftmasse für Fehlererkennung Thermostatdiagnose" VALUE 0x8197CE KwUb 23.21 m_ub_b23p3 0.00 23.21 FUNCTION_LIST DTHM IF_DATA DIM_X DIRECT 0x8197CE /end CHARACTERISTIC
/begin CHARACTERISTIC IDTHMU "untere Schwelle der integrierten Luftmasse für Freigabe Thermostatdiagnose" VALUE 0x8197CF KwUb 23.21 m_ub_b23p3 0.00 23.21 FUNCTION_LIST DTHM IF_DATA DIM_X DIRECT 0x8197CF /end CHARACTERISTIC
/begin CHARACTERISTIC IGESGA "Gesamt-Übersetzungsverhältnis" CURVE 0x811030 FklWUb 25.50 fak_q0p1 0.00 25.50 FUNCTION_LIST BBGANG IF_DATA DIM_X DIRECT 0x811030 /begin AXIS_DESCR FIX_AXIS gangi dez 8 0.00 7.000 FIX_AXIS_PAR 0 0 8 /end AXIS_DESCR /end CHARACTERISTIC
/begin CHARACTERISTIC IGNDELAY "Synchroanzahl Zündfreigabeverzögerung AZUE" VALUE 0x810058 KwUb 255.0 DEZ 0.00 255.0 FUNCTION_LIST AZUE IF_DATA DIM_X DIRECT 0x810058 /end CHARACTERISTIC
/begin CHARACTERISTIC IKMTR "Index für Auswahl des entsprechenden Bytes im Fehlerarray" VALUE 0x8187EE KwUb 100.0 DEZ 0.00 100.0 FUNCTION_LIST DKMTR IF_DATA DIM_X DIRECT 0x8187EE /end CHARACTERISTIC
/begin CHARACTERISTIC ILMRN "Integratorverstärkung von Luftmassenregler" CURVE 0x818981 GklWUb 7.969 fak_ub_b8 0.00 7.969 FUNCTION_LIST FUEREG IF_DATA DIM_X DIRECT 0x818981
 /begin AXIS_DESCR COM_AXIS nmot nmot_ub_q40 8 0.00 10200. AXIS_PTS_REF SNM08FEUB /end AXIS_DESCR
/end CHARACTERISTIC
/begin CHARACTERISTIC IMLATDSL "min. Luftmassenfluß für Adaption/Zusatzdiagnose" VALUE 0x81B258 KwUw 23.30133 m_uw_b23p3 0.00 23.30133 FUNCTION_LIST DSLSLRS IF_DATA DIM_X DIRECT 0x81B258 /end CHARACTERISTIC
/begin CHARACTERISTIC IMLATDSLK "min. Luftmassenfluß für Kurztest" VALUE 0x81B25A KwUw 23.30133 m_uw_b23p3 0.00 23.30133 FUNCTION_LIST DSLSLRS IF_DATA DIM_X DIRECT 0x81B25A /end CHARACTERISTIC
/begin CHARACTERISTIC IMLATWS "Luftmassen-Schwelle für Kat-Heizen nach Wiederholstart" VALUE 0x81EB7E KwUw 23.30133 m_uw_b23p3 0.00 23.30133 FUNCTION_LIST BBKHZ IF_DATA DIM_X DIRECT 0x81EB7E /end CHARACTERISTIC
/begin CHARACTERISTIC IMLDSL "minimale durchgeströmte Luftmasse" VALUE 0x81836A KwUb 0.9961 fak_ub_b1 0.00 0.9961 FUNCTION_LIST DSLSLRS IF_DATA DIM_X DIRECT 0x81836A /end CHARACTERISTIC
/begin CHARACTERISTIC IMLEVABS "Schwelle Luftmassenintegral vor Freigabe Lambdaregelung nach Zylinderausblendung" VALUE 0x8174D6 KwUw 4660.267 m_uw_b4660 0.00 4660.267 FUNCTION_LIST LRSEB IF_DATA DIM_X DIRECT 0x8174D6 /end CHARACTERISTIC
/begin CHARACTERISTIC IMLHEMN "Minimale integierte Luftmasse zum Heilen eines Fehlers" VALUE 0x81C772 KwUw 1.820417 m_q2p777Em5_kg 0.00 1.820417 FUNCTION_LIST DLSU IF_DATA DIM_X DIRECT 0x81C772 /end CHARACTERISTIC
/begin CHARACTERISTIC IMLHEMNFA "Minimale integierte Luftmasse zum Heilen eines Fehlers, bei Bandendeprüfung" VALUE 0x81C774 KwUw 1.820417 m_q2p777Em5_kg 0.00 1.820417 FUNCTION_LIST DLSU IF_DATA DIM_X DIRECT 0x81C774 /end CHARACTERISTIC
/begin CHARACTERISTIC IMLHS "Luftmassenintegral Heißstart" VALUE 0x811657 KwUb 23.21 m_ub_b23p3 0.00 23.21 FUNCTION_LIST ESSTT IF_DATA DIM_X DIRECT 0x811657 /end CHARACTERISTIC
/begin CHARACTERISTIC IMLKAMN "Schwellwert integr. Luftmasse f. Mindestdauer Katalysator-Ausräumen" VALUE 0x8175A6 KwUw 291.2667 m_uw_b291p25 0.00 291.2667 FUNCTION_LIST LRSKA IF_DATA DIM_X DIRECT 0x8175A6 /end CHARACTERISTIC
/begin CHARACTERISTIC IMLKHMXTMS "max. Verhältnisfaktor für Ausschaltung Katheizen" CURVE 0x81EB80 KlAUbSstUbWUw 0.9999847 fak_uw_b1 0.00 0.9999847 FUNCTION_LIST BBKHZ IF_DATA DIM_X DIRECT 0x81EB80
 /begin AXIS_DESCR STD_AXIS tmst temp_ub_q0p75_o48 4 -48.00 143.3 DEPOSIT ABSOLUT /end AXIS_DESCR
/end CHARACTERISTIC
/begin CHARACTERISTIC IMLKHTMS "imlpr-Schwelle für Übergang auf Lambda-Katheizen" CURVE 0x81605E KlAUbSstUbWUb 0.9961 fak_ub_b1 0.00 0.9961 FUNCTION_LIST BBKHZ IF_DATA DIM_X DIRECT 0x81605E
 /begin AXIS_DESCR STD_AXIS tmst temp_ub_q0p75_o48 8 -48.00 143.3 DEPOSIT ABSOLUT /end AXIS_DESCR
/end CHARACTERISTIC
/begin CHARACTERISTIC IMLKS "Schwelle für integrierten Luftmassenstrom für Erkennung Benzin im Öl" VALUE 0x8196EE KwUb 23.21 m_ub_b23p3 0.00 23.21 FUNCTION_LIST BBBO IF_DATA DIM_X DIRECT 0x8196EE /end CHARACTERISTIC
/begin CHARACTERISTIC IMLKVSMX "Maximale Integrationsschwelle für Fehlerfreigabe in DKVS (Tank leer)" VALUE 0x81E4DC KwUw 233.0133 m_q0p00355 0.00 233.0133 FUNCTION_LIST DKVS IF_DATA DIM_X DIRECT 0x81E4DC /end CHARACTERISTIC
/begin CHARACTERISTIC IMLLASKH_0_A "imlpr-Schwelle für Übergang auf Lambda-Abgas-Vorgabe" VALUE 0x81F7C8 KwUb 0.9961 fak_ub_b1 0.00 0.9961 FUNCTION_LIST LAKH IF_DATA DIM_X DIRECT 0x81F7C8 /end CHARACTERISTIC
/begin CHARACTERISTIC IMLLASKH_1_A "imlpr-Schwelle für Übergang auf Lambda-Abgas-Vorgabe" VALUE 0x81F7C9 KwUb 0.9961 fak_ub_b1 0.00 0.9961 FUNCTION_LIST LAKH IF_DATA DIM_X DIRECT 0x81F7C9 /end CHARACTERISTIC
/begin CHARACTERISTIC IMLNWKHMX "Schwelle Lufmassenintegral Katheizen für Ende Nockenwellenkatheizfunktionalität" VALUE 0x81A821 KwUb 0.9961 fak_ub_b1 0.00 0.9961 FUNCTION_LIST BBNWS IF_DATA DIM_X DIRECT 0x81A821 /end CHARACTERISTIC
/begin CHARACTERISTIC IMLPLCMN "minimale integrierte Luftmasse für den Plausibilitätscheck" VALUE 0x81C776 KwUw 1.820417 m_q2p777Em5_kg 0.00 1.820417 FUNCTION_LIST DLSU IF_DATA DIM_X DIRECT 0x81C776 /end CHARACTERISTIC
/begin CHARACTERISTIC IMLPLCMNB "minimale integrierte Luftmasse für den erweiterten Plausibilitätscheck" VALUE 0x81C778 KwUw 1.820417 m_q2p777Em5_kg 0.00 1.820417 FUNCTION_LIST DLSU IF_DATA DIM_X DIRECT 0x81C778 /end CHARACTERISTIC
/begin CHARACTERISTIC IMLSALR "Schwellwert integr. Luftmasse f. Einschaltverzögerung LR nach SA" VALUE 0x8174D8 KwUw 4660.267 m_uw_b4660 0.00 4660.267 FUNCTION_LIST LRSEB IF_DATA DIM_X DIRECT 0x8174D8 /end CHARACTERISTIC
/begin CHARACTERISTIC IMLSLMN_0_A "min. Verhältnisfaktor psum_w/mlsu für Einschaltung SLS" VALUE 0x81B204 KwUb 0.9961 fak_ub_b1 0.00 0.9961 FUNCTION_LIST SLS IF_DATA DIM_X DIRECT 0x81B204 /end CHARACTERISTIC
/begin CHARACTERISTIC IMLSLMN_1_A "min. Verhältnisfaktor psum_w/mlsu für Einschaltung SLS" VALUE 0x81B205 KwUb 0.9961 fak_ub_b1 0.00 0.9961 FUNCTION_LIST SLS IF_DATA DIM_X DIRECT 0x81B205 /end CHARACTERISTIC
/begin CHARACTERISTIC IMLSLMX_0_A "max. Verhältnisfaktor psum_w/mlsu für Einschaltung SLS" VALUE 0x81B206 KwUb 0.9961 fak_ub_b1 0.00 0.9961 FUNCTION_LIST SLS IF_DATA DIM_X DIRECT 0x81B206 /end CHARACTERISTIC
/begin CHARACTERISTIC IMLSLMX_1_A "max. Verhältnisfaktor psum_w/mlsu für Einschaltung SLS" VALUE 0x81B207 KwUb 0.9961 fak_ub_b1 0.00 0.9961 FUNCTION_LIST SLS IF_DATA DIM_X DIRECT 0x81B207 /end CHARACTERISTIC
/begin CHARACTERISTIC IMLSLSA "Schwelle Luftmassenintegral für Anfang Sekundärluft im Abgas" VALUE 0x81B1B0 KwUw 4660.267 m_uw_b4660 0.00 4660.267 FUNCTION_LIST SLS IF_DATA DIM_X DIRECT 0x81B1B0 /end CHARACTERISTIC
/begin CHARACTERISTIC IMLSLSE "Schwelle Luftmassenintegral für Ende Sekundärluft im Abgas" VALUE 0x81B1B2 KwUw 4660.267 m_uw_b4660 0.00 4660.267 FUNCTION_LIST SLS IF_DATA DIM_X DIRECT 0x81B1B2 /end CHARACTERISTIC
/begin CHARACTERISTIC IMSDTEVA "Schwelle für Intergal des Massenstroms TEV nach längerm TE-Stop" VALUE 0x81A722 KwUb 11.32 m_ub_q0p0444 0.00 11.32 FUNCTION_LIST DTEV IF_DATA DIM_X DIRECT 0x81A722 /end CHARACTERISTIC
/begin CHARACTERISTIC IMTUMTA "Schwelle integrierte Luftmasse für Bestimmung Umgebungstemperatur" VALUE 0x81E4C2 KwUw 23.30133 m_uw_b23p3 0.00 23.30133 FUNCTION_LIST BGTUMG IF_DATA DIM_X DIRECT 0x81E4C2 /end CHARACTERISTIC
/begin CHARACTERISTIC IMTUMTAT "Schwelle integrierte Luftmasse für Bestimmung Umgebungstemperatur aus TANS" VALUE 0x8184B5 KwUb 23.21 m_ub_b23p3 0.00 23.21 FUNCTION_LIST ATM IF_DATA DIM_X DIRECT 0x8184B5 /end CHARACTERISTIC
/begin CHARACTERISTIC INCKSTAI "Inkrement-Step für STADAP-Faktor" CURVE 0x81161B KlAUbSstUbWSb 0.9922 fak_sb_b1 0.00 0.9922 FUNCTION_LIST STADAP IF_DATA DIM_X DIRECT 0x81161B /begin AXIS_DESCR STD_AXIS tmadb dez 3 0.00 255.0 DEPOSIT ABSOLUT /end AXIS_DESCR /end CHARACTERISTIC
/begin CHARACTERISTIC IP1A_MX_UM "max. Spannung für DK-Istwert-Poti 1 am unteren Anschlag für die Funktionsüberw." VALUE 0x814013 KwUb 4.9805 spg_ub_q0p019 0.00 4.9805 FUNCTION_LIST UFRLC IF_DATA DIM_X DIRECT 0x814013 /end CHARACTERISTIC
/begin CHARACTERISTIC IP2A_MN_UM "min. Spannung für DK-Istwert-Poti 2 am unteren Anschlag für die Funktionsüberw." VALUE 0x814014 KwUb 4.9805 spg_ub_q0p019 0.00 4.9805 FUNCTION_LIST UFRLC IF_DATA DIM_X DIRECT 0x814014 /end CHARACTERISTIC
/begin CHARACTERISTIC IPA_T_UM "Fehlertoleranzzeit für unteren DK-Anschlag im ungültigen Bereich f. d. Fktüberw." VALUE 0x814015 KwUb 10200.0 t40ms_ub_b10200 0.00 10200.0 FUNCTION_LIST UFRLC IF_DATA DIM_X DIRECT 0x814015 /end CHARACTERISTIC
/begin CHARACTERISTIC ITNMXH "Verweilzeit unterhalb unterer Drehzahlgrenze vor Aktivierung der oberen Grenze" VALUE 0x8172FA KwUw 655.3500 t10msxs_uw_b655p35 0.00 655.3500 FUNCTION_LIST NMAXMD IF_DATA DIM_X DIRECT 0x8172FA /end CHARACTERISTIC
/begin CHARACTERISTIC IVDYNLSU "Startwert für dynlsu_w" VALUE 0x81C77A KwUw 15.99976 fak_uw_b16 0.00 15.99976 FUNCTION_LIST DLSU IF_DATA DIM_X DIRECT 0x81C77A /end CHARACTERISTIC
/begin CHARACTERISTIC JKMTR "Index für Auswahl der entsprechenden Bits aus dem Byte im Fehlerarray" VALUE 0x8187EF KwUb 3.000 DEZ 0.00 3.000 FUNCTION_LIST DKMTR IF_DATA DIM_X DIRECT 0x8187EF /end CHARACTERISTIC
/begin CHARACTERISTIC KAFLTESG "Ausfußkonstante Leitung TEV-Saugrohr" VALUE 0x829DE4 KwUw 28.79956 fak1_q4p3945Em4 0.00 28.79956 FUNCTION_LIST BGTEV IF_DATA DIM_X DIRECT 0x829DE4 /end CHARACTERISTIC
/begin CHARACTERISTIC KAFPBKVPU "Korrektur Ausfluß abh. von pbkvmod_w/pubkv_w" CURVE 0x82B1B6 KlAUwSstUwWUw 1.999969 fak_uw_b2 0.00 1.999969 FUNCTION_LIST GGPBKV IF_DATA DIM_X DIRECT 0x82B1B6
 /begin AXIS_DESCR STD_AXIS pbkvmpu_w fak_uw_b2 4 0.00 1.999969 DEPOSIT ABSOLUT /end AXIS_DESCR
/end CHARACTERISTIC
/begin CHARACTERISTIC KATMEXML "Exotherme Temperatur im KAT tkatm" CURVE 0x8184B6 GklWSb 1275. temp_q5 -640.0 635.0 FUNCTION_LIST ATM IF_DATA DIM_X DIRECT 0x8184B6
 /begin AXIS_DESCR COM_AXIS ml_w m_uw_b6553p5 7 0.00 6553.500 AXIS_PTS_REF SML07TMUW /end AXIS_DESCR
/end CHARACTERISTIC
/begin CHARACTERISTIC KATMIEXML "Exotherme Temperatur im KAT tikatm" CURVE 0x8184BD GklWSb 1275. temp_q5 -640.0 635.0 FUNCTION_LIST ATM IF_DATA DIM_X DIRECT 0x8184BD
 /begin AXIS_DESCR COM_AXIS ml_w m_uw_b6553p5 7 0.00 6553.500 AXIS_PTS_REF SML07TMUW /end AXIS_DESCR
/end CHARACTERISTIC
/begin CHARACTERISTIC KD "BA Normierungsfaktor (DRIVE)" VALUE 0x81ABFA KwUb 255.0 dez 0.00 255.0 FUNCTION_LIST KVA IF_DATA DIM_X DIRECT 0x81ABFA /end CHARACTERISTIC
/begin CHARACTERISTIC KDLASHKI "Kennlinie über dlashkm, Bewertungsfaktor für I-Anteil in der LRHK" CURVE 0x817510 GklWSw 1.999969 fak_sw_b1 -1.000000 0.9999695 FUNCTION_LIST LRSHK IF_DATA DIM_X DIRECT 0x817510
 /begin AXIS_DESCR COM_AXIS dlashkm_w fak_sw_b1 8 -1.000000 0.9999695 AXIS_PTS_REF SM108LHSW /end AXIS_DESCR
/end CHARACTERISTIC
/begin CHARACTERISTIC KDLASHKP "Kennlinie über dlashkm_w, Bewertungsfaktor für P-Anteil in der LRHK" CURVE 0x817520 GklWSw 1.999969 fak_sw_b1 -1.000000 0.9999695 FUNCTION_LIST LRSHK IF_DATA DIM_X DIRECT 0x817520
 /begin AXIS_DESCR COM_AXIS dlashkm_w fak_sw_b1 8 -1.000000 0.9999695 AXIS_PTS_REF SM108LHSW /end AXIS_DESCR
/end CHARACTERISTIC
/begin CHARACTERISTIC KDLRIDDVE "Identifizierung des DLR-Parametersatzes zu DV-E-Typ" VALUE 0x818739 KwUb 255.0 dez 0.00 255.0 FUNCTION_LIST ADVE IF_DATA DIM_X DIRECT 0x818739 /end CHARACTERISTIC
/begin CHARACTERISTIC KDYNFA "Rekursionskonstante für LSU-Dynamik bei Kurztest" VALUE 0x81C77C KwUw 0.9999847 fak_uw_b1 0.00 0.9999847 FUNCTION_LIST DLSU IF_DATA DIM_X DIRECT 0x81C77C /end CHARACTERISTIC
/begin CHARACTERISTIC KEDNEG "Wert für die Reduzierung der Einschaltdauer LSU-Heizung nach Start" VALUE 0x812682 KwUb 99.22 tgrad_ub_b99p6 0.3906 99.61 FUNCTION_LIST HLSU IF_DATA DIM_X DIRECT 0x812682 /end CHARACTERISTIC
/begin CHARACTERISTIC KEDPOS "Wert für die Vergrößerung der Einschaltdauer LSU-Heizung nach Start" VALUE 0x812683 KwUb 99.22 tgrad_ub_b99p6 0.3906 99.61 FUNCTION_LIST HLSU IF_DATA DIM_X DIRECT 0x812683 /end CHARACTERISTIC
/begin CHARACTERISTIC KEMLN "Messfensterlänge für Klopfregelung" CURVE 0x81989C GklWUb 191.3 zw_ub_q0p75 0.00 191.3 FUNCTION_LIST GGKS IF_DATA DIM_X DIRECT 0x81989C
 /begin AXIS_DESCR COM_AXIS nmot nmot_ub_q40 16 0.00 10200. AXIS_PTS_REF SNM16KRUB /end AXIS_DESCR
/end CHARACTERISTIC
/begin CHARACTERISTIC KFABAK "Aufteilungsfaktor Wandfilm bei BA" MAP 0x819342 GkfWUb 0.9961 fak_ub_b1 0.00 0.9961 FUNCTION_LIST ESUK IF_DATA DIM_X DIRECT 0x819342
 /begin AXIS_DESCR COM_AXIS tmot temp_ub_q0p75_o48 9 -48.00 143.3 AXIS_PTS_REF STM09ESUB /end AXIS_DESCR
 /begin AXIS_DESCR COM_AXIS nmot nmot_ub_q40 7 0.00 10200. AXIS_PTS_REF SNM07ESUB /end AXIS_DESCR
/end CHARACTERISTIC
/begin CHARACTERISTIC KFAMAL_0_A "Kennfeld Absenkungsfaktor für Lur-Wert bei erkannten Mehrfachaussetzern" MAP 0x810809 GkfWUb 0.9961 fak_ub_b1 0.00 0.9961 FUNCTION_LIST DMDLU IF_DATA DIM_X INDIRECT 0x8173C0
 /begin AXIS_DESCR COM_AXIS rl rel_ub_q0p75 8 0.00 191.3 AXIS_PTS_REF SRL08DMUB /end AXIS_DESCR
 /begin AXIS_DESCR COM_AXIS nmot nmot_ub_q40 8 0.00 10200. AXIS_PTS_REF SNM08DMUB /end AXIS_DESCR
/end CHARACTERISTIC
/begin CHARACTERISTIC KFAMAL_1_A "Kennfeld Absenkungsfaktor für Lur-Wert bei erkannten Mehrfachaussetzern" MAP 0x810849 GkfWUb 0.9961 fak_ub_b1 0.00 0.9961 FUNCTION_LIST DMDLU IF_DATA DIM_X INDIRECT 0x8173C2
 /begin AXIS_DESCR COM_AXIS rl rel_ub_q0p75 8 0.00 191.3 AXIS_PTS_REF SRL08DMUB /end AXIS_DESCR
 /begin AXIS_DESCR COM_AXIS nmot nmot_ub_q40 8 0.00 10200. AXIS_PTS_REF SNM08DMUB /end AXIS_DESCR
/end CHARACTERISTIC
/begin CHARACTERISTIC KFAMAL1 "Kennfeld Absenkungsfaktor für Lur-Wert bei erkannten Mehrfachaussetzern" MAP 0x8108C9 GkfWUb 0.9961 fak_ub_b1 0.00 0.9961 FUNCTION_LIST DMDLU IF_DATA DIM_X DIRECT 0x8108C9
 /begin AXIS_DESCR COM_AXIS rl rel_ub_q0p75 8 0.00 191.3 AXIS_PTS_REF SRL08DMUB /end AXIS_DESCR
 /begin AXIS_DESCR COM_AXIS nmot nmot_ub_q40 8 0.00 10200. AXIS_PTS_REF SNM08DMUB /end AXIS_DESCR
/end CHARACTERISTIC
/begin CHARACTERISTIC KFANFPU "Kennfeld Anfahrverhalten" MAP 0x81AC1A KfAxUbAyUbSstxUbSstyUbWUb 191.3 temp_ub_q0p75_o48 -48.00 143.3 FUNCTION_LIST KMTR IF_DATA DIM_X DIRECT 0x81AC1A
 /begin AXIS_DESCR STD_AXIS tumgkmtr temp_ub_q0p75_o48 5 -48.00 143.3 DEPOSIT ABSOLUT /end AXIS_DESCR
 /begin AXIS_DESCR STD_AXIS pu p_ub_q5 5 0.00 1275. DEPOSIT ABSOLUT /end AXIS_DESCR
/end CHARACTERISTIC
/begin CHARACTERISTIC KFATLAK "Kennfeld Lambdakorrektur für Krümmerabgastemperatur" MAP 0x8184C4 GkfWSb 1275. temp_q5 -640.0 635.0 FUNCTION_LIST ATM IF_DATA DIM_X DIRECT 0x8184C4
 /begin AXIS_DESCR COM_AXIS ml_w m_uw_b6553p5 6 0.00 6553.500 AXIS_PTS_REF SMT06TMUW /end AXIS_DESCR
 /begin AXIS_DESCR COM_AXIS lamsbg_w fak_uw_b16 6 0.00 15.99976 AXIS_PTS_REF SLX06TMUW /end AXIS_DESCR
/end CHARACTERISTIC
/begin CHARACTERISTIC KFATMKR "Kennfeld stationäre Krümmerabgastemperatur f(nmot,rl)" MAP 0x818524 KfAxUbAyUbSstxUbSstyUbWUb 1275. temp_ub_q5_o50 -50.00 1225. FUNCTION_LIST ATM IF_DATA DIM_X DIRECT 0x818524 /begin AXIS_DESCR STD_AXIS nmot nmot_ub_q40 8 0.00 10200. DEPOSIT ABSOLUT /end AXIS_DESCR /begin AXIS_DESCR STD_AXIS rl rel_ub_q0p75 8 0.00 191.3 DEPOSIT ABSOLUT /end AXIS_DESCR /end CHARACTERISTIC
/begin CHARACTERISTIC KFATMLA "Kennfeld Abgastemperatur-Korrektur = f(Lambda)" MAP 0x818576 GkfWSb 1275. temp_q5 -640.0 635.0 FUNCTION_LIST ATM IF_DATA DIM_X DIRECT 0x818576
 /begin AXIS_DESCR COM_AXIS ml_w m_uw_b6553p5 6 0.00 6553.500 AXIS_PTS_REF SML06TMUW /end AXIS_DESCR
 /begin AXIS_DESCR COM_AXIS lamsbg_w fak_uw_b16 6 0.00 15.99976 AXIS_PTS_REF SLX06TMUW /end AXIS_DESCR
/end CHARACTERISTIC
/begin CHARACTERISTIC KFATMZW "Kennfeld Abgastemperatur-Korrektur = f(Zündwinkelverstellung)" MAP 0x81859A GkfWSb 1275. temp_q5 -640.0 635.0 FUNCTION_LIST ATM IF_DATA DIM_X DIRECT 0x81859A
 /begin AXIS_DESCR COM_AXIS ml_w m_uw_b6553p5 6 0.00 6553.500 AXIS_PTS_REF SML06TMUW /end AXIS_DESCR
 /begin AXIS_DESCR COM_AXIS etazwimt rel_ub_b127p5 6 0.00 127.5 AXIS_PTS_REF SEZ06TMUB /end AXIS_DESCR
/end CHARACTERISTIC
/begin CHARACTERISTIC KFATZWK "Kennfeld Zündwinkelkorrektur für Krümmerabgastemperatur" MAP 0x8185BE GkfWSb 1275. temp_q5 -640.0 635.0 FUNCTION_LIST ATM IF_DATA DIM_X DIRECT 0x8185BE
 /begin AXIS_DESCR COM_AXIS ml_w m_uw_b6553p5 6 0.00 6553.500 AXIS_PTS_REF SMT06TMUW /end AXIS_DESCR
 /begin AXIS_DESCR COM_AXIS etazwimt rel_ub_b127p5 6 0.00 127.5 AXIS_PTS_REF SEZ06TMUB /end AXIS_DESCR
/end CHARACTERISTIC
/begin CHARACTERISTIC KFAVAK "Aufteilungsfaktor Wandfilm bei VA" MAP 0x819381 GkfWUb 0.9961 fak_ub_b1 0.00 0.9961 FUNCTION_LIST ESUK IF_DATA DIM_X DIRECT 0x819381
 /begin AXIS_DESCR COM_AXIS tmot temp_ub_q0p75_o48 9 -48.00 143.3 AXIS_PTS_REF STM09ESUB /end AXIS_DESCR
 /begin AXIS_DESCR COM_AXIS nmot nmot_ub_q40 7 0.00 10200. AXIS_PTS_REF SNM07ESUB /end AXIS_DESCR
/end CHARACTERISTIC
/begin CHARACTERISTIC KFBAKL_0_A "Faktor Beschleunigungsanreicherung (K+L-Anteil)" MAP 0x8193C0 GkfWUb 15.94 fak_ub_b16 0.00 15.94 FUNCTION_LIST ESUK IF_DATA DIM_X INDIRECT 0x815B92
 /begin AXIS_DESCR COM_AXIS tmot temp_ub_q0p75_o48 9 -48.00 143.3 AXIS_PTS_REF STM09ESUB /end AXIS_DESCR
 /begin AXIS_DESCR COM_AXIS nmot nmot_ub_q40 7 0.00 10200. AXIS_PTS_REF SNM07ESUB /end AXIS_DESCR
/end CHARACTERISTIC
/begin CHARACTERISTIC KFBAKL_1_A "Faktor Beschleunigungsanreicherung (K+L-Anteil)" MAP 0x8193FF GkfWUb 15.94 fak_ub_b16 0.00 15.94 FUNCTION_LIST ESUK IF_DATA DIM_X INDIRECT 0x815B96
 /begin AXIS_DESCR COM_AXIS tmot temp_ub_q0p75_o48 9 -48.00 143.3 AXIS_PTS_REF STM09ESUB /end AXIS_DESCR
 /begin AXIS_DESCR COM_AXIS nmot nmot_ub_q40 7 0.00 10200. AXIS_PTS_REF SNM07ESUB /end AXIS_DESCR
/end CHARACTERISTIC
/begin CHARACTERISTIC KFBALB "Faktor Beschleunigungsanreicherung Ladebereich" MAP 0x81943E KfAxUbAyUbSstxUbSstyUbWUb 3.984 fak_q0p015625 0.00 3.984 FUNCTION_LIST ESUK IF_DATA DIM_X DIRECT 0x81943E /begin AXIS_DESCR STD_AXIS nmot nmot_ub_q40 6 0.00 10200. DEPOSIT ABSOLUT /end AXIS_DESCR /begin AXIS_DESCR STD_AXIS rlp rel_ub_q0p75 6 0.00 191.3 DEPOSIT ABSOLUT /end AXIS_DESCR /end CHARACTERISTIC
/begin CHARACTERISTIC KFBRAWA_0_A "Sollbeschleunigung bei Wiederaufnahme" MAP 0x81C920 KfAxUwAyUwSstxUwSstyUwWUw 27.7802865 bfzg_sw_q4p239Em4 0.00 27.7802865 FUNCTION_LIST FGRFULO IF_DATA DIM_X INDIRECT 0x813BCC
 /begin AXIS_DESCR STD_AXIS vfgr_w vfzg_uw_b512 8 0.00 511.9922 DEPOSIT ABSOLUT /end AXIS_DESCR
 /begin AXIS_DESCR STD_AXIS dvzi_w vfzg_uw_q0p0078125 6 0.00 511.9922 DEPOSIT ABSOLUT /end AXIS_DESCR
/end CHARACTERISTIC
/begin CHARACTERISTIC KFBRAWA_1_A "Sollbeschleunigung bei Wiederaufnahme" MAP 0x81C9A0 KfAxUwAyUwSstxUwSstyUwWUw 27.7802865 bfzg_sw_q4p239Em4 0.00 27.7802865 FUNCTION_LIST FGRFULO IF_DATA DIM_X INDIRECT 0x813BD0
 /begin AXIS_DESCR STD_AXIS vfgr_w vfzg_uw_b512 8 0.00 511.9922 DEPOSIT ABSOLUT /end AXIS_DESCR
 /begin AXIS_DESCR STD_AXIS dvzi_w vfzg_uw_q0p0078125 6 0.00 511.9922 DEPOSIT ABSOLUT /end AXIS_DESCR
/end CHARACTERISTIC
/begin CHARACTERISTIC KFCFO "Kennfeld zur Definition der Bereichseigenschaften (dominant..)" MAP 0x8101C3 GkfWUb 255.0 dez 0.00 255.0 FUNCTION_LIST DMDFON IF_DATA DIM_X DIRECT 0x8101C3
 /begin AXIS_DESCR COM_AXIS rl rel_ub_q0p75 3 0.00 191.3 AXIS_PTS_REF SDZ03DMUB /end AXIS_DESCR
 /begin AXIS_DESCR COM_AXIS nmot nmot_ub_q40 8 0.00 10200. AXIS_PTS_REF SDZ08DMUB /end AXIS_DESCR
/end CHARACTERISTIC
/begin CHARACTERISTIC KFCFO2 "Kennfeld zur Definition der Bereichseigenschaften (dominant..)" MAP 0x8101DB GkfWUb 255.0 dez 0.00 255.0 FUNCTION_LIST DMDFON IF_DATA DIM_X DIRECT 0x8101DB
 /begin AXIS_DESCR COM_AXIS rl rel_ub_q0p75 3 0.00 191.3 AXIS_PTS_REF SDZ03DMUB2 /end AXIS_DESCR
 /begin AXIS_DESCR COM_AXIS nmot nmot_ub_q40 8 0.00 10200. AXIS_PTS_REF SDZ08DMUB2 /end AXIS_DESCR
/end CHARACTERISTIC
/begin CHARACTERISTIC KFCFO3 "Kennfeld zur Definition der Bereichseigenschaften (dominant..)" MAP 0x8101F3 GkfWUb 255.0 dez 0.00 255.0 FUNCTION_LIST DMDFON IF_DATA DIM_X DIRECT 0x8101F3
 /begin AXIS_DESCR COM_AXIS rl rel_ub_q0p75 3 0.00 191.3 AXIS_PTS_REF SDZ03DMUB3 /end AXIS_DESCR
 /begin AXIS_DESCR COM_AXIS nmot nmot_ub_q40 8 0.00 10200. AXIS_PTS_REF SDZ08DMUB3 /end AXIS_DESCR
/end CHARACTERISTIC
/begin CHARACTERISTIC KFDETATE "Zündwinkelwirkungsgrad Korrektur for DTEV" MAP 0x81A723 KfAxUbAyUbSstxUbSstyUbWUb 127.5 rel_ub_b127p5 0.00 127.5 FUNCTION_LIST DTEV IF_DATA DIM_X DIRECT 0x81A723
 /begin AXIS_DESCR STD_AXIS etazwist rel_ub_b127p5 4 0.00 127.5 DEPOSIT ABSOLUT /end AXIS_DESCR
 /begin AXIS_DESCR STD_AXIS dmletanu m_q0p1 6 0.00 25.50 DEPOSIT ABSOLUT /end AXIS_DESCR
/end CHARACTERISTIC
/begin CHARACTERISTIC KFDFBTMN "Faktor Dynamikanteil Brennraumtemperaturmodell für negative Gradienten" MAP 0x81D668 KfAxUbAyUbSstxUwSstyUbWUb 1.992 fak_ub_b2 0.00 1.992 FUNCTION_LIST BGTEMPK IF_DATA DIM_X DIRECT 0x81D668
 /begin AXIS_DESCR STD_AXIS tabgm_w temp_uw_q0p0195_o50 6 -50.00000 1229.980 DEPOSIT ABSOLUT /end AXIS_DESCR
 /begin AXIS_DESCR STD_AXIS nmot nmot_ub_q40 8 0.00 10200. DEPOSIT ABSOLUT /end AXIS_DESCR
/end CHARACTERISTIC
/begin CHARACTERISTIC KFDFBTMP "Faktor Dynamikanteil Brennraumtemperaturmodell für positive Gradienten" MAP 0x81D6AE KfAxUbAyUbSstxUwSstyUbWUb 1.992 fak_ub_b2 0.00 1.992 FUNCTION_LIST BGTEMPK IF_DATA DIM_X DIRECT 0x81D6AE
 /begin AXIS_DESCR STD_AXIS tabgm_w temp_uw_q0p0195_o50 6 -50.00000 1229.980 DEPOSIT ABSOLUT /end AXIS_DESCR
 /begin AXIS_DESCR STD_AXIS nmot nmot_ub_q40 8 0.00 10200. DEPOSIT ABSOLUT /end AXIS_DESCR
/end CHARACTERISTIC
/begin CHARACTERISTIC KFDLASO "Kennfeld Lambdasollwert-Korrektur für stetigen Lambdaregler" MAP 0x81268B GkfWSb 0.06226 fak_sb_b0p03125 -0.03125 0.03101 FUNCTION_LIST LRS IF_DATA DIM_X DIRECT 0x81268B
 /begin AXIS_DESCR COM_AXIS nmot nmot_ub_q40 10 0.00 10200. AXIS_PTS_REF SNM10LSUB /end AXIS_DESCR
 /begin AXIS_DESCR COM_AXIS rl rel_ub_q0p75 10 0.00 191.3 AXIS_PTS_REF SRL10LSUB /end AXIS_DESCR
/end CHARACTERISTIC
/begin CHARACTERISTIC KFDLBTS "Delta Lambdasoll für Bauteileschutz" MAP 0x81E50C KfAxUbAyUbSstxUbSstyUbWSb 1.000 fak_sb_b1 -1.000 0.00 FUNCTION_LIST LAMBTS IF_DATA DIM_X DIRECT 0x81E50C
 /begin AXIS_DESCR STD_AXIS detazwbs rel_ub_b127p5 8 0.00 127.5 DEPOSIT ABSOLUT /end AXIS_DESCR
 /begin AXIS_DESCR STD_AXIS nmot nmot_ub_q40 4 0.00 10200. DEPOSIT ABSOLUT /end AXIS_DESCR
/end CHARACTERISTIC
/begin CHARACTERISTIC KFDLSD "Dämpfung PT2-Filter Lastschlagdämpfung" MAP 0x828544 GkfWUw 1.999969 fak_uw_b2 0.00 1.999969 FUNCTION_LIST MDFAW IF_DATA DIM_X DIRECT 0x828544 /begin AXIS_DESCR COM_AXIS gangi dez 8 0.00 255.0 AXIS_PTS_REF SGA08MDUB /end AXIS_DESCR
 /begin AXIS_DESCR COM_AXIS nmot_w nmot_uw_q0p25 6 0.00 16383.75 AXIS_PTS_REF SNM06MDUW /end AXIS_DESCR
/end CHARACTERISTIC
/begin CHARACTERISTIC KFDLUR_0_A "Kennfeld für Laufunruhedifferenz dluts Referenzwert" MAP 0x8104D9 GkfWSb 172.5 luquant -86.57 85.89 FUNCTION_LIST DMDDLU IF_DATA DIM_X INDIRECT 0x8173C4
 /begin AXIS_DESCR COM_AXIS rl rel_ub_q0p75 8 0.00 191.3 AXIS_PTS_REF SRL08DMUB /end AXIS_DESCR
 /begin AXIS_DESCR COM_AXIS nmot nmot_ub_q40 8 0.00 10200. AXIS_PTS_REF SNM08DMUB /end AXIS_DESCR
/end CHARACTERISTIC
/begin CHARACTERISTIC KFDLUR_1_A "Kennfeld für Laufunruhedifferenz dluts Referenzwert" MAP 0x810519 GkfWSb 172.5 luquant -86.57 85.89 FUNCTION_LIST DMDDLU IF_DATA DIM_X INDIRECT 0x8173C6
 /begin AXIS_DESCR COM_AXIS rl rel_ub_q0p75 8 0.00 191.3 AXIS_PTS_REF SRL08DMUB /end AXIS_DESCR
 /begin AXIS_DESCR COM_AXIS nmot nmot_ub_q40 8 0.00 10200. AXIS_PTS_REF SNM08DMUB /end AXIS_DESCR
/end CHARACTERISTIC
/begin CHARACTERISTIC KFDMDADP "Obere Schwelle für Momenteneingriff bei Dashpot" MAP 0x828380 GkfWUw 99.99847 rel_uw_b100 0.00 99.99847 FUNCTION_LIST ARMD IF_DATA DIM_X DIRECT 0x828380 /begin AXIS_DESCR COM_AXIS gangi dez 6 0.00 255.0 AXIS_PTS_REF SGA06MDUB /end AXIS_DESCR
 /begin AXIS_DESCR COM_AXIS mkar_w rel_sw_b100 8 -100.0000 99.99695 AXIS_PTS_REF SMK08MDSW /end AXIS_DESCR
/end CHARACTERISTIC
/begin CHARACTERISTIC KFDMDARO "Obere Schwelle für Momenteneingriff" MAP 0x8283E0 GkfWUw 99.99847 rel_uw_b100 0.00 99.99847 FUNCTION_LIST ARMD IF_DATA DIM_X DIRECT 0x8283E0 /begin AXIS_DESCR COM_AXIS gangi dez 6 0.00 255.0 AXIS_PTS_REF SGA06MDUB /end AXIS_DESCR
 /begin AXIS_DESCR COM_AXIS mkar_w rel_sw_b100 8 -100.0000 99.99695 AXIS_PTS_REF SMK08MDSW /end AXIS_DESCR
/end CHARACTERISTIC
/begin CHARACTERISTIC KFDMDAROS "Obere Schwelle für Momenteneingriff stationär" MAP 0x828440 GkfWUw 99.99847 rel_uw_b100 0.00 99.99847 FUNCTION_LIST ARMD IF_DATA DIM_X DIRECT 0x828440 /begin AXIS_DESCR COM_AXIS gangi dez 6 0.00 255.0 AXIS_PTS_REF SGA06MDUB /end AXIS_DESCR
 /begin AXIS_DESCR COM_AXIS mkar_w rel_sw_b100 8 -100.0000 99.99695 AXIS_PTS_REF SMK08MDSW /end AXIS_DESCR
/end CHARACTERISTIC
/begin CHARACTERISTIC KFDMDKOE "Anfangswert Momentenfilter bei Klimakompressor Einschalten" MAP 0x81A133 GkfWSb 99.60 rel_sb_q0p39 -50.00 49.61 FUNCTION_LIST MDVERB IF_DATA DIM_X DIRECT 0x81A133
 /begin AXIS_DESCR COM_AXIS nmot nmot_ub_q40 6 0.00 10200. AXIS_PTS_REF SNM06KOUB /end AXIS_DESCR
 /begin AXIS_DESCR COM_AXIS tlok temp_ub_q0p75_o48 6 -48.00 143.3 AXIS_PTS_REF STA06LLUB /end AXIS_DESCR
/end CHARACTERISTIC
/begin CHARACTERISTIC KFDMLSDO_0_A "Delta Moment Auslösung Lastschlagdämpfung" MAP 0x828766 KfAxUwAyUwSstxSwSstyUwWUw 99.99847 rel_uw_b100 0.00 99.99847 FUNCTION_LIST MDFAW IF_DATA DIM_X INDIRECT 0x816A20
 /begin AXIS_DESCR STD_AXIS mkfanb_w rel_sw_b100 8 -100.0000 99.99695 DEPOSIT ABSOLUT /end AXIS_DESCR
 /begin AXIS_DESCR STD_AXIS nmot_w nmot_uw_q0p25 6 0.00 16383.75 DEPOSIT ABSOLUT /end AXIS_DESCR
/end CHARACTERISTIC
/begin CHARACTERISTIC KFDMLSDS "Delta Moment Auslösung Lastschlagdämpfung nach Schaltvorgang" MAP 0x8288E6 GkfWUw 99.99847 rel_uw_b100 0.00 99.99847 FUNCTION_LIST MDFAW IF_DATA DIM_X DIRECT 0x8288E6 /begin AXIS_DESCR COM_AXIS gangi dez 8 0.00 255.0 AXIS_PTS_REF SGA08MDUB /end AXIS_DESCR
 /begin AXIS_DESCR COM_AXIS nmot_w nmot_uw_q0p25 6 0.00 16383.75 AXIS_PTS_REF SNM06MDUW /end AXIS_DESCR
/end CHARACTERISTIC
/begin CHARACTERISTIC KFDPVL "Druckabfall am Luftfilter zur Berechnung Massestrom Tankentlüftung hinter Lader" MAP 0x829DE6 KfAxUwAyUwSstxUwSstyUwWUw 2559.961 p_uw_q0p039 0.00 2559.961 FUNCTION_LIST BGTEV IF_DATA DIM_X DIRECT 0x829DE6
 /begin AXIS_DESCR STD_AXIS vfzg_w vfzg_uw_b512 3 0.00 511.9922 DEPOSIT ABSOLUT /end AXIS_DESCR
 /begin AXIS_DESCR STD_AXIS mshfm_w m_uw_b6553p5 6 0.00 6553.500 DEPOSIT ABSOLUT /end AXIS_DESCR
/end CHARACTERISTIC
/begin CHARACTERISTIC KFDQTMTU "Zusätzlicher Kühlbedarf abhängig von tmot, tum" MAP 0x81AC3F KfAxUbAyUbSstxUbSstyUbWUb 191.3 temp_ub_q0p75_o48 -48.00 143.3 FUNCTION_LIST KMTR IF_DATA DIM_X DIRECT 0x81AC3F
 /begin AXIS_DESCR STD_AXIS tmotkmtr temp_ub_q0p75_o48 5 -48.00 143.3 DEPOSIT ABSOLUT /end AXIS_DESCR
 /begin AXIS_DESCR STD_AXIS tume temp_ub_q0p75_o48 5 -48.00 143.3 DEPOSIT ABSOLUT /end AXIS_DESCR
/end CHARACTERISTIC
/begin CHARACTERISTIC KFDQUEBER "Kennfeld Wärmeüberschuss zur Ansteuerung der Lüfter" MAP 0x81AC64 GkfWUb 191.3 temp_ub_q0p75_o48 -48.00 143.3 FUNCTION_LIST KMTR IF_DATA DIM_X DIRECT 0x81AC64
 /begin AXIS_DESCR COM_AXIS dtmtka temp_sb_q0p75 5 -96.00 95.25 AXIS_PTS_REF STS05DTKA /end AXIS_DESCR
 /begin AXIS_DESCR COM_AXIS dkmts temp_sb_q0p75 5 -96.00 95.25 AXIS_PTS_REF STS05DTTS /end AXIS_DESCR
/end CHARACTERISTIC
/begin CHARACTERISTIC KFDTMRS "Kennfeld Motortemperatur-Gradient im Schub für Referenzmodell" MAP 0x81E8F0 KfAxUbAyUbSstxUbSstyUbWSb 0.1868 temp_sb_b0p093 -0.09375 0.09302 FUNCTION_LIST GGTFM IF_DATA DIM_X DIRECT 0x81E8F0 /begin AXIS_DESCR STD_AXIS mll1 m_ub_b1020 5 0.00 1020. DEPOSIT ABSOLUT /end AXIS_DESCR
 /begin AXIS_DESCR STD_AXIS tmrw temp_ub_q0p75_o48 4 -48.00 143.3 DEPOSIT ABSOLUT /end AXIS_DESCR
/end CHARACTERISTIC
/begin CHARACTERISTIC KFDTMTE "Kennfeld Motortemperaturgradient für Ersatztemperatur" MAP 0x81E910 KfAxUbAyUbSstxUbSstyUbWSb 0.1868 temp_sb_b0p093 -0.09375 0.09302 FUNCTION_LIST GGTFM IF_DATA DIM_X DIRECT 0x81E910 /begin AXIS_DESCR STD_AXIS mll1 m_ub_b1020 5 0.00 1020. DEPOSIT ABSOLUT /end AXIS_DESCR
 /begin AXIS_DESCR STD_AXIS tmew temp_ub_q0p75_o48 4 -48.00 143.3 DEPOSIT ABSOLUT /end AXIS_DESCR
/end CHARACTERISTIC
/begin CHARACTERISTIC KFDTMTR "Kennfeld Motortemperaturgradient für Referenztemperatur" MAP 0x81E930 KfAxUbAyUbSstxUbSstyUbWSb 0.1868 temp_sb_b0p093 -0.09375 0.09302 FUNCTION_LIST GGTFM IF_DATA DIM_X DIRECT 0x81E930 /begin AXIS_DESCR STD_AXIS mll1 m_ub_b1020 5 0.00 1020. DEPOSIT ABSOLUT /end AXIS_DESCR
 /begin AXIS_DESCR STD_AXIS tmrw temp_ub_q0p75_o48 4 -48.00 143.3 DEPOSIT ABSOLUT /end AXIS_DESCR
/end CHARACTERISTIC
/begin CHARACTERISTIC KFDTMTU "Kennfeld Korrekturgradient Motortemperatur bei geringer Erwärmung" MAP 0x81E950 KfAxUbAyUbSstxUbSstyUbWSb 0.1868 temp_sb_b0p093 -0.09375 0.09302 FUNCTION_LIST GGTFM IF_DATA DIM_X DIRECT 0x81E950 /begin AXIS_DESCR STD_AXIS mll1 m_ub_b1020 5 0.00 1020. DEPOSIT ABSOLUT /end AXIS_DESCR
 /begin AXIS_DESCR STD_AXIS tumginp temp_ub_q0p75_o48 4 -48.00 143.3 DEPOSIT ABSOLUT /end AXIS_DESCR
/end CHARACTERISTIC
/begin CHARACTERISTIC KFDYESP "Lastdynamikerkennungsschwelle" MAP 0x81F7EC GkfWSw 1279.961 p_sw_q0p039 0.00 1279.961 FUNCTION_LIST KRDY IF_DATA DIM_X DIRECT 0x81F7EC
 /begin AXIS_DESCR COM_AXIS nmot nmot_ub_q40 16 0.00 10200. AXIS_PTS_REF SNM16KRDYUB /end AXIS_DESCR
 /begin AXIS_DESCR COM_AXIS rl rel_ub_q0p75 6 0.00 191.3 AXIS_PTS_REF SRL06KRUB /end AXIS_DESCR
/end CHARACTERISTIC
/begin CHARACTERISTIC KFDYMNT "vorgesteuerter Dynamikvorhalt" MAP 0x819BC5 KfAxUbAyUbSstxUbSstyUbWUb 20.25 zw_ub_qn0p75 -20.25 0.00 FUNCTION_LIST KRDY IF_DATA DIM_X DIRECT 0x819BC5
 /begin AXIS_DESCR STD_AXIS evtmod temp_ub_q0p75_o48 16 -48.00 143.3 DEPOSIT ABSOLUT /end AXIS_DESCR
 /begin AXIS_DESCR STD_AXIS nmot nmot_ub_q40 16 0.00 10200. DEPOSIT ABSOLUT /end AXIS_DESCR
/end CHARACTERISTIC
/begin CHARACTERISTIC KFDYRSP "Dynamikvorhalt Erkennungsschwelle" MAP 0x81F8AC GkfWSw 1279.961 p_sw_q0p039 0.00 1279.961 FUNCTION_LIST KRDY IF_DATA DIM_X DIRECT 0x81F8AC
 /begin AXIS_DESCR COM_AXIS nmot nmot_ub_q40 16 0.00 10200. AXIS_PTS_REF SNM16KRDYUB /end AXIS_DESCR
 /begin AXIS_DESCR COM_AXIS rl rel_ub_q0p75 6 0.00 191.3 AXIS_PTS_REF SRL06KRUB /end AXIS_DESCR
/end CHARACTERISTIC
/begin CHARACTERISTIC KFDYRSPOF "Dynamikvorhalt Offsetschwelle" MAP 0x81F96C GkfWSw 1279.961 p_sw_q0p039 0.00 1279.961 FUNCTION_LIST KRDY IF_DATA DIM_X DIRECT 0x81F96C
 /begin AXIS_DESCR COM_AXIS nmot nmot_ub_q40 16 0.00 10200. AXIS_PTS_REF SNM16KRDYUB /end AXIS_DESCR
 /begin AXIS_DESCR COM_AXIS rl rel_ub_q0p75 6 0.00 191.3 AXIS_PTS_REF SRL06KRUB /end AXIS_DESCR
/end CHARACTERISTIC
/begin CHARACTERISTIC KFDZK "delta Zündwinkel bei Dauerklopfen" MAP 0x81A923 GkfWSb 191.3 zw_sb_q0p75 -96.00 95.25 FUNCTION_LIST ZWGRU IF_DATA DIM_X DIRECT 0x81A923
 /begin AXIS_DESCR COM_AXIS nmot_w nmot_uw_q0p25 16 0.00 16383.75 AXIS_PTS_REF SNM16ZUUW /end AXIS_DESCR
 /begin AXIS_DESCR COM_AXIS rl_w rel_uw_q0p0234 12 0.00 1535.977 AXIS_PTS_REF SRL12ZUUW /end AXIS_DESCR
/end CHARACTERISTIC
/begin CHARACTERISTIC KFDZMNST "Min-Zündwinkeloffset im Nachstart - Regelung des Startüberschwingers" MAP 0x812877 GkfWSb 191.3 zw_sb_q0p75 -96.00 95.25 FUNCTION_LIST ZWMIN IF_DATA DIM_X DIRECT 0x812877
 /begin AXIS_DESCR COM_AXIS nmot_w nmot_uw_q0p25 4 0.00 16383.75 AXIS_PTS_REF SNM04ZUUW /end AXIS_DESCR
 /begin AXIS_DESCR COM_AXIS dns nmotd_sb_q10 4 -1280. 1270. AXIS_PTS_REF SNS04ZUSB /end AXIS_DESCR
/end CHARACTERISTIC
/begin CHARACTERISTIC KFDZWKG "Zündwinkelkorrektur durch Verschieben der Klopfgrenze" MAP 0x82AF9E KfAxUbAyUbSstxUbSstyUbWSb 191.3 zw_sb_q0p75 -96.00 95.25 FUNCTION_LIST ZWGRU IF_DATA DIM_X DIRECT 0x82AF9E /begin AXIS_DESCR STD_AXIS nmot nmot_ub_q40 8 0.00 10200. DEPOSIT ABSOLUT /end AXIS_DESCR /begin AXIS_DESCR STD_AXIS lambas fak_ub_b2 5 0.00 1.992 DEPOSIT ABSOLUT /end AXIS_DESCR /end CHARACTERISTIC
/begin CHARACTERISTIC KFDZWOAGR "Offset des optimalen ZW bei AGR-Betrieb" MAP 0x82919A KfAxUwAyUwSstxUwSstyUwWUw 49151.25 zw_uw_q0p75 0.00 49151.25 FUNCTION_LIST MDBAS IF_DATA DIM_X DIRECT 0x82919A
 /begin AXIS_DESCR STD_AXIS nmot_w nmot_uw_q0p25 16 0.00 16383.75 DEPOSIT ABSOLUT /end AXIS_DESCR
 /begin AXIS_DESCR STD_AXIS rl_w rel_uw_q0p0234 11 0.00 1535.977 DEPOSIT ABSOLUT /end AXIS_DESCR
/end CHARACTERISTIC
/begin CHARACTERISTIC KFETATE "Kennfeld gewünscher Wirkungsgrad bei Tankentlüftung bei Erreichen te = TEMIN" MAP 0x829C6A KfAxUwAyUwSstxSwSstyUwWUw 50.00000 rel_q0p00195 50.00000 100.0000 FUNCTION_LIST TEB IF_DATA DIM_X DIRECT 0x829C6A
 /begin AXIS_DESCR STD_AXIS fteadf_w fak_q0p00195 3 -64.00000 63.99805 DEPOSIT ABSOLUT /end AXIS_DESCR
 /begin AXIS_DESCR STD_AXIS mifa_w rel_uw_b100 5 0.00 99.99847 DEPOSIT ABSOLUT /end AXIS_DESCR
/end CHARACTERISTIC
/begin CHARACTERISTIC KFFDLBTS "Faktor Delta Lambdasoll für Bauteileschutz" MAP 0x819559 GkfWUb 1.992 fak_ub_b2 0.00 1.992 FUNCTION_LIST LAMBTS IF_DATA DIM_X DIRECT 0x819559
 /begin AXIS_DESCR COM_AXIS rl_w rel_uw_q0p0234 12 0.00 1535.977 AXIS_PTS_REF SRL12GKUW /end AXIS_DESCR
 /begin AXIS_DESCR COM_AXIS nmot nmot_ub_q40 16 0.00 10200. AXIS_PTS_REF SNM16GKUB /end AXIS_DESCR
/end CHARACTERISTIC
/begin CHARACTERISTIC KFFFANZ "Anzahl Folgefunken" MAP 0x81AA5F KfAxUbAyUbSstxUbSstyUbWUb 255.0 dez 0.00 255.0 FUNCTION_LIST ZUESZ IF_DATA DIM_X DIRECT 0x81AA5F
 /begin AXIS_DESCR STD_AXIS tmot temp_ub_q0p75_o48 8 -48.00 143.3 DEPOSIT ABSOLUT /end AXIS_DESCR
 /begin AXIS_DESCR STD_AXIS nmot nmot_ub_q40 5 0.00 10200. DEPOSIT ABSOLUT /end AXIS_DESCR
/end CHARACTERISTIC
/begin CHARACTERISTIC KFFKRXTM "Faktor zur Korrektur von rlmax bei hoher Motortemperatur" MAP 0x82798B KfAxUbAyUbSstxUbSstyUbWUb 1.000 fak_ub_b2 0.00 1.000 FUNCTION_LIST LDRLMX IF_DATA DIM_X DIRECT 0x82798B
 /begin AXIS_DESCR STD_AXIS tmotldrlmx temp_ub_q0p75_o48 4 -48.00 143.3 DEPOSIT ABSOLUT /end AXIS_DESCR
 /begin AXIS_DESCR STD_AXIS vfzg vfzg_ub_q1p25 4 0.00 318.8 DEPOSIT ABSOLUT /end AXIS_DESCR
/end CHARACTERISTIC
/begin CHARACTERISTIC KFFLTA "Schwelle zur Erkennung Feinleck" MAP 0x829D40 KfAxUbAyUbSstxUbSstyUwWUb 12.75 t50msxs_ub_b12p75 0.00 12.75 FUNCTION_LIST DLDP TKMWL IF_DATA DIM_X DIRECT 0x829D40
 /begin AXIS_DESCR STD_AXIS tans temp_ub_q0p75_o48 4 -48.00 143.3 DEPOSIT ABSOLUT /end AXIS_DESCR
 /begin AXIS_DESCR STD_AXIS pukorf_w p_uw_q0p039 4 0.00 2559.961 DEPOSIT ABSOLUT /end AXIS_DESCR
/end CHARACTERISTIC
/begin CHARACTERISTIC KFFMSML "Abgasgegendruckkorrektur der Sekundärluftmasse" MAP 0x8182FB KfAxUbAyUbSstxUbSstyUbWUb 1.992 fak_ub_b2 0.00 1.992 FUNCTION_LIST SLS IF_DATA DIM_X DIRECT 0x8182FB /begin AXIS_DESCR STD_AXIS nmot nmot_ub_q40 8 0.00 10200. DEPOSIT ABSOLUT /end AXIS_DESCR /begin AXIS_DESCR STD_AXIS rl rel_ub_q0p75 8 0.00 191.3 DEPOSIT ABSOLUT /end AXIS_DESCR /end CHARACTERISTIC
/begin CHARACTERISTIC KFFNWE "Wichtung Nockenwelle Einlass" MAP 0x81A82B KfAxUbAyUbSstxUbSstyUbWUb 0.9961 fak_ub_b1 0.00 0.9961 FUNCTION_LIST NWFW IF_DATA DIM_X DIRECT 0x81A82B /begin AXIS_DESCR STD_AXIS fnwue fak_ub_b1 6 0.00 0.9961 DEPOSIT ABSOLUT /end AXIS_DESCR /begin AXIS_DESCR STD_AXIS rl rel_ub_q0p75 6 0.00 191.3 DEPOSIT ABSOLUT /end AXIS_DESCR /end CHARACTERISTIC
/begin CHARACTERISTIC KFFSLDE "Faktor für schnellen LDR-Eingriff(Absenkung)" MAP 0x827AA6 GkfWUw 1.000000 fak_uw_b2 0.00 1.000000 FUNCTION_LIST LDRLMX IF_DATA DIM_X DIRECT 0x827AA6
 /begin AXIS_DESCR COM_AXIS nmot_w nmot_uw_q0p25 8 0.00 16383.75 AXIS_PTS_REF SNM08LDUW /end AXIS_DESCR
 /begin AXIS_DESCR COM_AXIS wkrmdy_w zw_q0p1875 8 0.00 12287.81 AXIS_PTS_REF SWK108LDUW /end AXIS_DESCR
/end CHARACTERISTIC
/begin CHARACTERISTIC KFFTEAN "Kennfeld Maximale Spülrate bei Notlauftankentlüftung" MAP 0x81A5B6 GkfWUb 0.1992 fak_ub_b0p5 0.00 0.1992 FUNCTION_LIST TEB IF_DATA DIM_X DIRECT 0x81A5B6
 /begin AXIS_DESCR COM_AXIS nmot nmot_ub_q40 10 0.00 10200. AXIS_PTS_REF SNM10TEUB /end AXIS_DESCR
 /begin AXIS_DESCR COM_AXIS wdkba relDK_ub_b100 10 0.00 100.0 AXIS_PTS_REF SDK10TEUB /end AXIS_DESCR
/end CHARACTERISTIC
/begin CHARACTERISTIC KFFTEAX "Kennfeld maximale Spülrate" MAP 0x81A61A KfAxUbAyUbSstxUbSstyUbWUb 0.1992 fak_ub_b0p5 0.00 0.1992 FUNCTION_LIST TEB IF_DATA DIM_X DIRECT 0x81A61A /begin AXIS_DESCR STD_AXIS ml m_ub_b1020 5 0.00 1020. DEPOSIT ABSOLUT /end AXIS_DESCR
 /begin AXIS_DESCR STD_AXIS tans temp_ub_q0p75_o48 4 -48.00 143.3 DEPOSIT ABSOLUT /end AXIS_DESCR
/end CHARACTERISTIC
/begin CHARACTERISTIC KFFWLRL_1_A "Kennfeld Warmlauffaktor lastabhängiger Anteil" MAP 0x8113B4 GkfWUb 1.992 fak_ub_b2 0.00 1.992 FUNCTION_LIST ESNSWL IF_DATA DIM_X INDIRECT 0x813FA4
 /begin AXIS_DESCR COM_AXIS tmst temp_ub_q0p75_o48 8 -48.00 143.3 AXIS_PTS_REF STS08ESUB /end AXIS_DESCR
 /begin AXIS_DESCR COM_AXIS rlp rel_ub_q0p75 6 0.00 191.3 AXIS_PTS_REF SRP06ESUB /end AXIS_DESCR
/end CHARACTERISTIC
/begin CHARACTERISTIC KFFWLW_0_A "Kennfeld Wichtung Warmlauffaktor" MAP 0x818E25 GkfWUb 1.992 fak_ub_b2 0.00 1.992 FUNCTION_LIST ESNSWL IF_DATA DIM_X INDIRECT 0x813F7A
 /begin AXIS_DESCR COM_AXIS nmot nmot_ub_q40 6 0.00 10200. AXIS_PTS_REF SNM06ESUB /end AXIS_DESCR
 /begin AXIS_DESCR COM_AXIS rlp rel_ub_q0p75 6 0.00 191.3 AXIS_PTS_REF SRP06ESUB /end AXIS_DESCR
/end CHARACTERISTIC
/begin CHARACTERISTIC KFFWLW_1_A "Kennfeld Wichtung Warmlauffaktor" MAP 0x818E49 GkfWUb 1.992 fak_ub_b2 0.00 1.992 FUNCTION_LIST ESNSWL IF_DATA DIM_X INDIRECT 0x813F7E
 /begin AXIS_DESCR COM_AXIS nmot nmot_ub_q40 6 0.00 10200. AXIS_PTS_REF SNM06ESUB /end AXIS_DESCR
 /begin AXIS_DESCR COM_AXIS rlp rel_ub_q0p75 6 0.00 191.3 AXIS_PTS_REF SRP06ESUB /end AXIS_DESCR
/end CHARACTERISTIC
/begin CHARACTERISTIC KFFWLW_2_A "Kennfeld Wichtung Warmlauffaktor" MAP 0x818E73 GkfWUb 1.992 fak_ub_b2 0.00 1.992 FUNCTION_LIST ESNSWL IF_DATA DIM_X INDIRECT 0x813F82
 /begin AXIS_DESCR COM_AXIS nmot nmot_ub_q40 6 0.00 10200. AXIS_PTS_REF SNM06ESUB /end AXIS_DESCR
 /begin AXIS_DESCR COM_AXIS rlp rel_ub_q0p75 6 0.00 191.3 AXIS_PTS_REF SRP06ESUB /end AXIS_DESCR
/end CHARACTERISTIC
/begin CHARACTERISTIC KFFWLW_3_A "Kennfeld Wichtung Warmlauffaktor" MAP 0x818E97 GkfWUb 1.992 fak_ub_b2 0.00 1.992 FUNCTION_LIST ESNSWL IF_DATA DIM_X INDIRECT 0x813F86
 /begin AXIS_DESCR COM_AXIS nmot nmot_ub_q40 6 0.00 10200. AXIS_PTS_REF SNM06ESUB /end AXIS_DESCR
 /begin AXIS_DESCR COM_AXIS rlp rel_ub_q0p75 6 0.00 191.3 AXIS_PTS_REF SRP06ESUB /end AXIS_DESCR
/end CHARACTERISTIC
/begin CHARACTERISTIC KFFWTBR "Wichtungsfaktor Tans/Tmot für Brennraumtemperaturmodell" MAP 0x81890B KfAxUbAyUbSstxUbSstyUbWUb 1.992 fak_ub_b2 0.00 1.992 FUNCTION_LIST BGTEMPK IF_DATA DIM_X DIRECT 0x81890B /begin AXIS_DESCR STD_AXIS rl rel_ub_q0p75 10 0.00 191.3 DEPOSIT ABSOLUT /end AXIS_DESCR /begin AXIS_DESCR STD_AXIS nmot nmot_ub_q40 8 0.00 10200. DEPOSIT ABSOLUT /end AXIS_DESCR /end CHARACTERISTIC
/begin CHARACTERISTIC KFGLTA "Schwelle zur Erkennung Grobleck" MAP 0x829D5E KfAxUbAyUbSstxUbSstyUwWUb 12.75 t50msxs_ub_b12p75 0.00 12.75 FUNCTION_LIST DLDP IF_DATA DIM_X DIRECT 0x829D5E
 /begin AXIS_DESCR STD_AXIS tans temp_ub_q0p75_o48 4 -48.00 143.3 DEPOSIT ABSOLUT /end AXIS_DESCR
 /begin AXIS_DESCR STD_AXIS pukorf_w p_uw_q0p039 4 0.00 2559.961 DEPOSIT ABSOLUT /end AXIS_DESCR
/end CHARACTERISTIC
/begin CHARACTERISTIC KFHSTT_0_A "Faktor Heißstart" MAP 0x811658 KfAxUbAyUbSstxUbSstyUbWUb 63.75 fak_ub_b64 0.00 63.75 FUNCTION_LIST ESSTT IF_DATA DIM_X INDIRECT 0x815996
 /begin AXIS_DESCR STD_AXIS tans temp_ub_q0p75_o48 6 -48.00 143.3 DEPOSIT ABSOLUT /end AXIS_DESCR
 /begin AXIS_DESCR STD_AXIS tmst temp_ub_q0p75_o48 3 -48.00 143.3 DEPOSIT ABSOLUT /end AXIS_DESCR
/end CHARACTERISTIC
/begin CHARACTERISTIC KFHSTT_1_A "Faktor Heißstart" MAP 0x811675 KfAxUbAyUbSstxUbSstyUbWUb 63.75 fak_ub_b64 0.00 63.75 FUNCTION_LIST ESSTT IF_DATA DIM_X INDIRECT 0x815998
 /begin AXIS_DESCR STD_AXIS tans temp_ub_q0p75_o48 6 -48.00 143.3 DEPOSIT ABSOLUT /end AXIS_DESCR
 /begin AXIS_DESCR STD_AXIS tmst temp_ub_q0p75_o48 3 -48.00 143.3 DEPOSIT ABSOLUT /end AXIS_DESCR
/end CHARACTERISTIC
/begin CHARACTERISTIC KFKEF1 "Klopferkennungsfaktorkennfeld Zündung 1" MAP 0x8198FA GkfWUb 15.94 fak_ub_b16 0.00 15.94 FUNCTION_LIST KRKE IF_DATA DIM_X DIRECT 0x8198FA
 /begin AXIS_DESCR COM_AXIS nmot nmot_ub_q40 16 0.00 10200. AXIS_PTS_REF SNM16KRUB /end AXIS_DESCR
 /begin AXIS_DESCR COM_AXIS rl rel_ub_q0p75 3 0.00 191.3 AXIS_PTS_REF SRL03KRUB /end AXIS_DESCR
/end CHARACTERISTIC
/begin CHARACTERISTIC KFKEF2 "Klopferkennungsfaktorkennfeld Zündung 2" MAP 0x81992A GkfWUb 15.94 fak_ub_b16 0.00 15.94 FUNCTION_LIST KRKE IF_DATA DIM_X DIRECT 0x81992A
 /begin AXIS_DESCR COM_AXIS nmot nmot_ub_q40 16 0.00 10200. AXIS_PTS_REF SNM16KRUB /end AXIS_DESCR
 /begin AXIS_DESCR COM_AXIS rl rel_ub_q0p75 3 0.00 191.3 AXIS_PTS_REF SRL03KRUB /end AXIS_DESCR
/end CHARACTERISTIC
/begin CHARACTERISTIC KFKEF3 "Klopferkennungsfaktorkennfeld Zündung 3" MAP 0x81995A GkfWUb 15.94 fak_ub_b16 0.00 15.94 FUNCTION_LIST KRKE IF_DATA DIM_X DIRECT 0x81995A
 /begin AXIS_DESCR COM_AXIS nmot nmot_ub_q40 16 0.00 10200. AXIS_PTS_REF SNM16KRUB /end AXIS_DESCR
 /begin AXIS_DESCR COM_AXIS rl rel_ub_q0p75 3 0.00 191.3 AXIS_PTS_REF SRL03KRUB /end AXIS_DESCR
/end CHARACTERISTIC
/begin CHARACTERISTIC KFKEF4 "Klopferkennungsfaktorkennfeld Zündung 4" MAP 0x81998A GkfWUb 15.94 fak_ub_b16 0.00 15.94 FUNCTION_LIST KRKE IF_DATA DIM_X DIRECT 0x81998A
 /begin AXIS_DESCR COM_AXIS nmot nmot_ub_q40 16 0.00 10200. AXIS_PTS_REF SNM16KRUB /end AXIS_DESCR
 /begin AXIS_DESCR COM_AXIS rl rel_ub_q0p75 3 0.00 191.3 AXIS_PTS_REF SRL03KRUB /end AXIS_DESCR
/end CHARACTERISTIC
/begin CHARACTERISTIC KFKEF5 "Klopferkennungsfaktorkennfeld Zündung 5" MAP 0x8199BA GkfWUb 15.94 fak_ub_b16 0.00 15.94 FUNCTION_LIST KRKE IF_DATA DIM_X DIRECT 0x8199BA
 /begin AXIS_DESCR COM_AXIS nmot nmot_ub_q40 16 0.00 10200. AXIS_PTS_REF SNM16KRUB /end AXIS_DESCR
 /begin AXIS_DESCR COM_AXIS rl rel_ub_q0p75 3 0.00 191.3 AXIS_PTS_REF SRL03KRUB /end AXIS_DESCR
/end CHARACTERISTIC
/begin CHARACTERISTIC KFKEF6 "Klopferkennungsfaktorkennfeld Zündung 6" MAP 0x8199EA GkfWUb 15.94 fak_ub_b16 0.00 15.94 FUNCTION_LIST KRKE IF_DATA DIM_X DIRECT 0x8199EA
 /begin AXIS_DESCR COM_AXIS nmot nmot_ub_q40 16 0.00 10200. AXIS_PTS_REF SNM16KRUB /end AXIS_DESCR
 /begin AXIS_DESCR COM_AXIS rl rel_ub_q0p75 3 0.00 191.3 AXIS_PTS_REF SRL03KRUB /end AXIS_DESCR
/end CHARACTERISTIC
/begin CHARACTERISTIC KFKEF7 "Klopferkennungsfaktorkennfeld Zündung 7" MAP 0x819A1A GkfWUb 15.94 fak_ub_b16 0.00 15.94 FUNCTION_LIST KRKE IF_DATA DIM_X DIRECT 0x819A1A
 /begin AXIS_DESCR COM_AXIS nmot nmot_ub_q40 16 0.00 10200. AXIS_PTS_REF SNM16KRUB /end AXIS_DESCR
 /begin AXIS_DESCR COM_AXIS rl rel_ub_q0p75 3 0.00 191.3 AXIS_PTS_REF SRL03KRUB /end AXIS_DESCR
/end CHARACTERISTIC
/begin CHARACTERISTIC KFKEF8 "Klopferkennungsfaktorkennfeld Zündung 8" MAP 0x819A4A GkfWUb 15.94 fak_ub_b16 0.00 15.94 FUNCTION_LIST KRKE IF_DATA DIM_X DIRECT 0x819A4A
 /begin AXIS_DESCR COM_AXIS nmot nmot_ub_q40 16 0.00 10200. AXIS_PTS_REF SNM16KRUB /end AXIS_DESCR
 /begin AXIS_DESCR COM_AXIS rl rel_ub_q0p75 3 0.00 191.3 AXIS_PTS_REF SRL03KRUB /end AXIS_DESCR
/end CHARACTERISTIC
/begin CHARACTERISTIC KFKHFM "Korrekturkennfeld für HFM" MAP 0x811235 KfAxUbAyUbSstxUbSstyUbWUb 1.992 fak_ub_b2 0.00 1.992 FUNCTION_LIST GGHFM IF_DATA DIM_X DIRECT 0x811235 /begin AXIS_DESCR STD_AXIS nmot nmot_ub_q40 14 0.00 10200. DEPOSIT ABSOLUT /end AXIS_DESCR /begin AXIS_DESCR STD_AXIS rl rel_ub_q0p75 14 0.00 191.3 DEPOSIT ABSOLUT /end AXIS_DESCR /end CHARACTERISTIC
/begin CHARACTERISTIC KFKOMABNPU "mrfa-Schwelle ab der Klimakompressor nicht mehr abgeschalten wird" MAP 0x82B268 KfAxUwAyUwSstxUwSstyUwWUw 199.9969 rel_uw_b200 0.00 199.9969 FUNCTION_LIST BKV IF_DATA DIM_X DIRECT 0x82B268
 /begin AXIS_DESCR STD_AXIS nmot_w nmot_uw_q0p25 4 0.00 16383.75 DEPOSIT ABSOLUT /end AXIS_DESCR
 /begin AXIS_DESCR STD_AXIS fho_w fak_uw_b4 3 0.00 3.999939 DEPOSIT ABSOLUT /end AXIS_DESCR
/end CHARACTERISTIC
/begin CHARACTERISTIC KFKSWF "Kennfeld für Kat.-Schutz-Wichtungsfaktoren" MAP 0x810D2D KfAxUbAyUbSstxUbSstyUbWUb 255.0 dez 0.00 255.0 FUNCTION_LIST DMDMIL IF_DATA DIM_X DIRECT 0x810D2D /begin AXIS_DESCR STD_AXIS nmot nmot_ub_q40 6 0.00 10200. DEPOSIT ABSOLUT /end AXIS_DESCR /begin AXIS_DESCR STD_AXIS rl rel_ub_q0p75 6 0.00 191.3 DEPOSIT ABSOLUT /end AXIS_DESCR /end CHARACTERISTIC
/begin CHARACTERISTIC KFKTRLN "Kennfeld Motor-Solltemperatur" MAP 0x81AC7D KfAxUbAyUbSstxUbSstyUbWUb 191.3 temp_ub_q0p75_o48 -48.00 143.3 FUNCTION_LIST KMTR IF_DATA DIM_X DIRECT 0x81AC7D /begin AXIS_DESCR STD_AXIS nmot nmot_ub_q40 5 0.00 10200. DEPOSIT ABSOLUT /end AXIS_DESCR /begin AXIS_DESCR STD_AXIS rltmso1 rel_ub_q0p75 5 0.00 191.3 DEPOSIT ABSOLUT /end AXIS_DESCR /end CHARACTERISTIC
/begin CHARACTERISTIC KFKTRV "Motorsolltemperatur für Kühlmitteltemperaturregelung geschwindigkeitsabhängg" MAP 0x81ACA2 KfAxUbAyUbSstxUbSstyUbWUb 191.3 temp_ub_q0p75_o48 -48.00 143.3 FUNCTION_LIST KMTR IF_DATA DIM_X DIRECT 0x81ACA2
 /begin AXIS_DESCR STD_AXIS vfzgkmtr vfzg_ub_q1p25 5 0.00 318.8 DEPOSIT ABSOLUT /end AXIS_DESCR
 /begin AXIS_DESCR STD_AXIS tumgkmtr temp_ub_q0p75_o48 5 -48.00 143.3 DEPOSIT ABSOLUT /end AXIS_DESCR
/end CHARACTERISTIC
/begin CHARACTERISTIC KFKWTMP "Kennfeld Drehmomentenreserve für Kat warmhalten, zeitweise" MAP 0x81EE04 KfAxUwAyUwSstxUwSstyUwWUw 99.99847 rel_uw_b100 0.00 99.99847 FUNCTION_LIST KHMD IF_DATA DIM_X DIRECT 0x81EE04
 /begin AXIS_DESCR STD_AXIS nmot_w nmot_uw_q0p25 4 0.00 16383.75 DEPOSIT ABSOLUT /end AXIS_DESCR
 /begin AXIS_DESCR STD_AXIS mifakh_w rel_uw_b100 4 0.00 99.99847 DEPOSIT ABSOLUT /end AXIS_DESCR
/end CHARACTERISTIC
/begin CHARACTERISTIC KFLAFWL_0_A "Offset Lambda-Motor-Soll" MAP 0x819209 GkfWSb 1.992 fak_sb_b1 -1.000 0.9922 FUNCTION_LIST LAMFAW IF_DATA DIM_X INDIRECT 0x815B16
 /begin AXIS_DESCR COM_AXIS tmot temp_ub_q0p75_o48 8 -48.00 143.3 AXIS_PTS_REF STM08GKUB /end AXIS_DESCR
 /begin AXIS_DESCR COM_AXIS rl rel_ub_q0p75 6 0.00 191.3 AXIS_PTS_REF SRL06GKUB /end AXIS_DESCR
/end CHARACTERISTIC
/begin CHARACTERISTIC KFLAFWL_1_A "Offset Lambda-Motor-Soll" MAP 0x819239 GkfWSb 1.992 fak_sb_b1 -1.000 0.9922 FUNCTION_LIST LAMFAW IF_DATA DIM_X INDIRECT 0x815B1A
 /begin AXIS_DESCR COM_AXIS tmot temp_ub_q0p75_o48 8 -48.00 143.3 AXIS_PTS_REF STM08GKUB /end AXIS_DESCR
 /begin AXIS_DESCR COM_AXIS rl rel_ub_q0p75 6 0.00 191.3 AXIS_PTS_REF SRL06GKUB /end AXIS_DESCR
/end CHARACTERISTIC
/begin CHARACTERISTIC KFLAMKR_0_A "Wichtungsfaktor für Anfettung bei Zündwinkelspätverstellung" MAP 0x819269 GkfWUb 1.992 fak_ub_b2 0.00 1.992 FUNCTION_LIST LAMFAW IF_DATA DIM_X INDIRECT 0x815B1E
 /begin AXIS_DESCR COM_AXIS nmot nmot_ub_q40 6 0.00 10200. AXIS_PTS_REF SNM06GKUB /end AXIS_DESCR
 /begin AXIS_DESCR COM_AXIS rl rel_ub_q0p75 6 0.00 191.3 AXIS_PTS_REF SRL06GKUB /end AXIS_DESCR
/end CHARACTERISTIC
/begin CHARACTERISTIC KFLAMKR_1_A "Wichtungsfaktor für Anfettung bei Zündwinkelspätverstellung" MAP 0x81928D GkfWUb 1.992 fak_ub_b2 0.00 1.992 FUNCTION_LIST LAMFAW IF_DATA DIM_X INDIRECT 0x815B22
 /begin AXIS_DESCR COM_AXIS nmot nmot_ub_q40 6 0.00 10200. AXIS_PTS_REF SNM06GKUB /end AXIS_DESCR
 /begin AXIS_DESCR COM_AXIS rl rel_ub_q0p75 6 0.00 191.3 AXIS_PTS_REF SRL06GKUB /end AXIS_DESCR
/end CHARACTERISTIC
/begin CHARACTERISTIC KFLAMKRL "Anfettung bei Zündwinkelspätverstellung" MAP 0x8192B1 GkfWUb 1.992 fak_ub_b2 0.00 1.992 FUNCTION_LIST LAMFAW IF_DATA DIM_X DIRECT 0x8192B1
 /begin AXIS_DESCR COM_AXIS dzwlamfaw zw_ub_qn0p75 6 -191.3 0.00 AXIS_PTS_REF SDZ06GKUB /end AXIS_DESCR
 /begin AXIS_DESCR COM_AXIS rl rel_ub_q0p75 6 0.00 191.3 AXIS_PTS_REF SRL06GKUB /end AXIS_DESCR
/end CHARACTERISTIC
/begin CHARACTERISTIC KFLAMSLS "Kennfeld Lambda-Korrektur bei Sekundärluft" MAP 0x81867D KfAxUbAyUbSstxUbSstyUbWUb 0.4980 fak_ub_b1p25_o0p75 0.7500 1.248 FUNCTION_LIST GGLSU IF_DATA DIM_X DIRECT 0x81867D /begin AXIS_DESCR STD_AXIS nmot nmot_ub_q40 8 0.00 10200. DEPOSIT ABSOLUT /end AXIS_DESCR /begin AXIS_DESCR STD_AXIS rl rel_ub_q0p75 8 0.00 191.3 DEPOSIT ABSOLUT /end AXIS_DESCR /end CHARACTERISTIC
/begin CHARACTERISTIC KFLANSKH "Kennfeld Lambda-Motor-Vorgabe bei Katheizen im Nachstart" MAP 0x81F278 KfAxUbAyUbSstxUbSstyUwWUw 15.89990 fak_q0p000244 0.09985352 15.99976 FUNCTION_LIST LAKH IF_DATA DIM_X DIRECT 0x81F278
 /begin AXIS_DESCR STD_AXIS tmst temp_ub_q0p75_o48 6 -48.00 143.3 DEPOSIT ABSOLUT /end AXIS_DESCR
 /begin AXIS_DESCR STD_AXIS anztib_w dez 12 0.00 65535.00 DEPOSIT ABSOLUT /end AXIS_DESCR
/end CHARACTERISTIC
/begin CHARACTERISTIC KFLASKH_1_A "Kennfeld Lambda-Abgas-Soll bei Katheizen" MAP 0x81F3CC KfAxUwAyUwSstxUwSstyUwWUw 15.99976 fak_q0p000244 0.00 15.99976 FUNCTION_LIST LAKH IF_DATA DIM_X INDIRECT 0x815CE2
 /begin AXIS_DESCR STD_AXIS nmot_w nmot_uw_q0p25 8 0.00 16383.75 DEPOSIT ABSOLUT /end AXIS_DESCR
 /begin AXIS_DESCR STD_AXIS rl_w rel_uw_q0p0234 8 0.00 1535.977 DEPOSIT ABSOLUT /end AXIS_DESCR
/end CHARACTERISTIC
/begin CHARACTERISTIC KFLASWLR_0_A "Kennfeld Lambda-Motor-Soll im Warmlauf bei aktiver LR" MAP 0x819094 GkfWUb 1.992 fak_ub_b2 0.00 1.992 FUNCTION_LIST LANSWL IF_DATA DIM_X INDIRECT 0x815AF2
 /begin AXIS_DESCR COM_AXIS tmot temp_ub_q0p75_o48 12 -48.00 143.3 AXIS_PTS_REF STM12ESUB /end AXIS_DESCR
 /begin AXIS_DESCR COM_AXIS tmst temp_ub_q0p75_o48 12 -48.00 143.3 AXIS_PTS_REF STS12ESUB /end AXIS_DESCR
/end CHARACTERISTIC
/begin CHARACTERISTIC KFLASWLR_1_A "Kennfeld Lambda-Motor-Soll im Warmlauf bei aktiver LR" MAP 0x819124 GkfWUb 1.992 fak_ub_b2 0.00 1.992 FUNCTION_LIST LANSWL IF_DATA DIM_X INDIRECT 0x815AF6
 /begin AXIS_DESCR COM_AXIS tmot temp_ub_q0p75_o48 12 -48.00 143.3 AXIS_PTS_REF STM12ESUB /end AXIS_DESCR
 /begin AXIS_DESCR COM_AXIS tmst temp_ub_q0p75_o48 12 -48.00 143.3 AXIS_PTS_REF STS12ESUB /end AXIS_DESCR
/end CHARACTERISTIC
/begin CHARACTERISTIC KFLBTS "Lambdasoll für Bauteileschutz" MAP 0x819619 GkfWUb 1.992 fak_ub_b2 0.00 1.992 FUNCTION_LIST LAMBTS IF_DATA DIM_X DIRECT 0x819619
 /begin AXIS_DESCR COM_AXIS rl_w rel_uw_q0p0234 12 0.00 1535.977 AXIS_PTS_REF SRL12GKUW /end AXIS_DESCR
 /begin AXIS_DESCR COM_AXIS nmot nmot_ub_q40 16 0.00 10200. AXIS_PTS_REF SNM16GKUB /end AXIS_DESCR
/end CHARACTERISTIC
/begin CHARACTERISTIC KFLDFK "Ladedruck Filterkonstante" MAP 0x8158D4 KfAxUwAyUwSstxUwSstyUwWUw 655.34999985 zk10msxs_uw_b655 0.010000152590 655.36000000 FUNCTION_LIST GGDSAS IF_DATA DIM_X DIRECT 0x8158D4
 /begin AXIS_DESCR STD_AXIS nmot_w nmot_uw_q0p25 4 0.00 16383.75 DEPOSIT ABSOLUT /end AXIS_DESCR
 /begin AXIS_DESCR STD_AXIS psspvdkd_w fak_uw_b4 6 0.00 3.999939 DEPOSIT ABSOLUT /end AXIS_DESCR
/end CHARACTERISTIC
/begin CHARACTERISTIC KFLDHBN "LDR-Höhenbegrenzung (max. Verdichterdruckverhältnis)" MAP 0x827BA6 KfAxUbAyUbSstxUbSstyUbWUb 3.984 fak_ub_b4 0.00 3.984 FUNCTION_LIST LDRLMX IF_DATA DIM_X DIRECT 0x827BA6 /begin AXIS_DESCR STD_AXIS nmot nmot_ub_q40 8 0.00 10200. DEPOSIT ABSOLUT /end AXIS_DESCR
 /begin AXIS_DESCR STD_AXIS tsel temp_ub_q0p75_o48 8 -48.00 143.3 DEPOSIT ABSOLUT /end AXIS_DESCR
/end CHARACTERISTIC
/begin CHARACTERISTIC KFLDIMX "Kennfeld LDR I-Reglerbegrenzung" MAP 0x8274C6 GkfWUw 327.6750 tv_uw_q0p005 0.00 327.6750 FUNCTION_LIST LDRPID IF_DATA DIM_X DIRECT 0x8274C6
 /begin AXIS_DESCR COM_AXIS nmot_w nmot_uw_q0p25 16 0.00 16383.75 AXIS_PTS_REF SNM16LDUW /end AXIS_DESCR
 /begin AXIS_DESCR COM_AXIS plsolr_w p_uw_q0p039 8 0.00 2559.961 AXIS_PTS_REF SPL08LDUW /end AXIS_DESCR
/end CHARACTERISTIC
/begin CHARACTERISTIC KFLDIOPU "Korrektur der TV-Werte durch Höheneinfluß" MAP 0x819CF4 GkfWUb 163.2 tv_ub_q0p64 0.00 163.2 FUNCTION_LIST LDRPID IF_DATA DIM_X DIRECT 0x819CF4
 /begin AXIS_DESCR COM_AXIS nmot nmot_ub_q40 8 0.00 10200. AXIS_PTS_REF SNM08LDUB /end AXIS_DESCR
 /begin AXIS_DESCR COM_AXIS pu p_ub_q5 8 0.00 1275. AXIS_PTS_REF SPU08LDUB /end AXIS_DESCR
/end CHARACTERISTIC
/begin CHARACTERISTIC KFLDIWL "Korrektur LDR I-Begrenzung im Warmlauf" MAP 0x8275C6 KfAxUbAyUbSstxUbSstyUbWSb 163.2 tv_ub_q0p64 -81.92 81.28 FUNCTION_LIST LDRPID IF_DATA DIM_X DIRECT 0x8275C6
 /begin AXIS_DESCR STD_AXIS tmst temp_ub_q0p75_o48 8 -48.00 143.3 DEPOSIT ABSOLUT /end AXIS_DESCR
 /begin AXIS_DESCR STD_AXIS imlatm m_ub_b23p3 8 0.00 23.21 DEPOSIT ABSOLUT /end AXIS_DESCR
/end CHARACTERISTIC
/begin CHARACTERISTIC KFLDRAPP "Kennfeld für LDR-Applikation ohne Md-Koordination" MAP 0x819DCA KfAxUbAyUbSstxUbSstyUbWUb 99.61 tv_ub_b100 0.00 99.61 FUNCTION_LIST LDTVMA IF_DATA DIM_X DIRECT 0x819DCA /begin AXIS_DESCR STD_AXIS nmot nmot_ub_q40 8 0.00 10200. DEPOSIT ABSOLUT /end AXIS_DESCR /begin AXIS_DESCR STD_AXIS wped relPED_ub_b100 8 0.00 100.0 DEPOSIT ABSOLUT /end AXIS_DESCR /end CHARACTERISTIC
/begin CHARACTERISTIC KFLDRL "KF zur Linearisierung Ladedruck=f(TV)" MAP 0x827618 GkfWSw 327.6750 tv_sw_q0p005 -163.8400 163.8350 FUNCTION_LIST LDRPID IF_DATA DIM_X DIRECT 0x827618
 /begin AXIS_DESCR COM_AXIS nmot_w nmot_uw_q0p25 16 0.00 16383.75 AXIS_PTS_REF SNM16LDUW /end AXIS_DESCR
 /begin AXIS_DESCR COM_AXIS ldtvr_w tv_sw_q0p005 10 -163.8400 163.8350 AXIS_PTS_REF STV10LDSW /end AXIS_DESCR
/end CHARACTERISTIC
/begin CHARACTERISTIC KFLDRQ0 "LDR-Regelparameter Q0" MAP 0x827758 GkfWUw 3276.750 rel_uw_b3276p75 0.00 3276.750 FUNCTION_LIST LDRPID IF_DATA DIM_X DIRECT 0x827758
 /begin AXIS_DESCR COM_AXIS nmot nmot_ub_q40 16 0.00 10200. AXIS_PTS_REF SNM16LDUB /end AXIS_DESCR
 /begin AXIS_DESCR COM_AXIS lde p_sb_q10 4 0.00 2550. AXIS_PTS_REF SLD04LDUB /end AXIS_DESCR
/end CHARACTERISTIC
/begin CHARACTERISTIC KFLDRQ1 "LDR-Reglerparameter Q1 (Integratorbeiwert)" MAP 0x8277D8 GkfWUw 3276.750 rel_uw_b3276p75 0.00 3276.750 FUNCTION_LIST LDRPID IF_DATA DIM_X DIRECT 0x8277D8
 /begin AXIS_DESCR COM_AXIS nmot nmot_ub_q40 16 0.00 10200. AXIS_PTS_REF SNM16LDUB /end AXIS_DESCR
 /begin AXIS_DESCR COM_AXIS lde p_sb_q10 4 0.00 2550. AXIS_PTS_REF SLD04LDUB /end AXIS_DESCR
/end CHARACTERISTIC
/begin CHARACTERISTIC KFLDRQ2 "Kennfeld LDR-Reglerparameter Q2" MAP 0x827858 GkfWUw 3276.750 rel_uw_b3276p75 0.00 3276.750 FUNCTION_LIST LDRPID IF_DATA DIM_X DIRECT 0x827858
 /begin AXIS_DESCR COM_AXIS nmot nmot_ub_q40 16 0.00 10200. AXIS_PTS_REF SNM16LDUB /end AXIS_DESCR
 /begin AXIS_DESCR COM_AXIS lde p_sb_q10 4 0.00 2550. AXIS_PTS_REF SLD04LDUB /end AXIS_DESCR
/end CHARACTERISTIC
/begin CHARACTERISTIC KFLDRXO "Delta Füllung (rl) im Overboostbetrieb" MAP 0x819D5A KfAxUbAyUbSstxUbSstyUbWUb 24.75 rel_ub_q0p75 0.00 24.75 FUNCTION_LIST LDOB IF_DATA DIM_X DIRECT 0x819D5A /begin AXIS_DESCR STD_AXIS nmot nmot_ub_q40 8 0.00 10200. DEPOSIT ABSOLUT /end AXIS_DESCR
 /begin AXIS_DESCR STD_AXIS tans temp_ub_q0p75_o48 4 -48.00 143.3 DEPOSIT ABSOLUT /end AXIS_DESCR
/end CHARACTERISTIC
/begin CHARACTERISTIC KFLF "Lambdakennfeld bei Teillast" MAP 0x818A1A KfAxUbAyUbSstxUbSstyUbWUb 1.992 fak_ub_b2 0.00 1.992 FUNCTION_LIST ESGRU IF_DATA DIM_X DIRECT 0x818A1A /begin AXIS_DESCR STD_AXIS nmot nmot_ub_q40 12 0.00 10200. DEPOSIT ABSOLUT /end AXIS_DESCR /begin AXIS_DESCR STD_AXIS rl rel_ub_q0p75 16 0.00 191.3 DEPOSIT ABSOLUT /end AXIS_DESCR /end CHARACTERISTIC
/begin CHARACTERISTIC KFLMSKH_0_A "Kennfeld Lambda-Motor-Soll bei Katheizen" MAP 0x81F470 KfAxUwAyUwSstxUwSstyUwWUw 15.99976 fak_q0p000244 0.00 15.99976 FUNCTION_LIST LAKH IF_DATA DIM_X INDIRECT 0x815CE6
 /begin AXIS_DESCR STD_AXIS nmot_w nmot_uw_q0p25 8 0.00 16383.75 DEPOSIT ABSOLUT /end AXIS_DESCR
 /begin AXIS_DESCR STD_AXIS rl_w rel_uw_q0p0234 8 0.00 1535.977 DEPOSIT ABSOLUT /end AXIS_DESCR
/end CHARACTERISTIC
/begin CHARACTERISTIC KFLMSKH_1_A "Kennfeld Lambda-Motor-Soll bei Katheizen" MAP 0x81F514 KfAxUwAyUwSstxUwSstyUwWUw 15.99976 fak_q0p000244 0.00 15.99976 FUNCTION_LIST LAKH IF_DATA DIM_X INDIRECT 0x815CEA
 /begin AXIS_DESCR STD_AXIS nmot_w nmot_uw_q0p25 8 0.00 16383.75 DEPOSIT ABSOLUT /end AXIS_DESCR
 /begin AXIS_DESCR STD_AXIS rl_w rel_uw_q0p0234 8 0.00 1535.977 DEPOSIT ABSOLUT /end AXIS_DESCR
/end CHARACTERISTIC
/begin CHARACTERISTIC KFLRSG1 "Kennfeld Reglerparameter g1 stetiger Lambdaregler" MAP 0x8297E0 GkfWSw 63.99902 fak_sw_b32 -32.00000 31.99902 FUNCTION_LIST LRS IF_DATA DIM_X DIRECT 0x8297E0
 /begin AXIS_DESCR COM_AXIS nmot_w nmot_uw_q0p25 7 0.00 16383.75 AXIS_PTS_REF SNM07LSUW /end AXIS_DESCR
 /begin AXIS_DESCR COM_AXIS rl_w rel_uw_q0p0234 8 0.00 1535.977 AXIS_PTS_REF SRL08LSUW /end AXIS_DESCR
/end CHARACTERISTIC
/begin CHARACTERISTIC KFLRSG2 "Kennfeld Reglerparameter g2 stetiger Lambdaregler" MAP 0x829850 GkfWUw 63.99902 fak_uw_b64 0.00 63.99902 FUNCTION_LIST LRS IF_DATA DIM_X DIRECT 0x829850
 /begin AXIS_DESCR COM_AXIS nmot_w nmot_uw_q0p25 7 0.00 16383.75 AXIS_PTS_REF SNM07LSUW /end AXIS_DESCR
 /begin AXIS_DESCR COM_AXIS rl_w rel_uw_q0p0234 8 0.00 1535.977 AXIS_PTS_REF SRL08LSUW /end AXIS_DESCR
/end CHARACTERISTIC
/begin CHARACTERISTIC KFLRSG4 "Kennfeld Reglerparameter g4 stetiger Lambdaregler" MAP 0x8298C0 GkfWSw 3.999939 fak_sw_b2 -2.000000 1.999939 FUNCTION_LIST LRS IF_DATA DIM_X DIRECT 0x8298C0
 /begin AXIS_DESCR COM_AXIS nmot_w nmot_uw_q0p25 7 0.00 16383.75 AXIS_PTS_REF SNM07LSUW /end AXIS_DESCR
 /begin AXIS_DESCR COM_AXIS rl_w rel_uw_q0p0234 8 0.00 1535.977 AXIS_PTS_REF SRL08LSUW /end AXIS_DESCR
/end CHARACTERISTIC
/begin CHARACTERISTIC KFLRSP1 "Kennfeld Reglerparameter p1 stetiger Lambdaregler" MAP 0x829930 GkfWUw 127.9980 fak_uw_b128 0.00 127.9980 FUNCTION_LIST LRS IF_DATA DIM_X DIRECT 0x829930
 /begin AXIS_DESCR COM_AXIS nmot_w nmot_uw_q0p25 7 0.00 16383.75 AXIS_PTS_REF SNM07LSUW /end AXIS_DESCR
 /begin AXIS_DESCR COM_AXIS rl_w rel_uw_q0p0234 8 0.00 1535.977 AXIS_PTS_REF SRL08LSUW /end AXIS_DESCR
/end CHARACTERISTIC
/begin CHARACTERISTIC KFLRSP2 "Kennfeld Reglerparameter p2 stetiger Lambdaregler" MAP 0x8299A0 GkfWUw 127.9980 fak_uw_b128 0.00 127.9980 FUNCTION_LIST LRS IF_DATA DIM_X DIRECT 0x8299A0
 /begin AXIS_DESCR COM_AXIS nmot_w nmot_uw_q0p25 7 0.00 16383.75 AXIS_PTS_REF SNM07LSUW /end AXIS_DESCR
 /begin AXIS_DESCR COM_AXIS rl_w rel_uw_q0p0234 8 0.00 1535.977 AXIS_PTS_REF SRL08LSUW /end AXIS_DESCR
/end CHARACTERISTIC
/begin CHARACTERISTIC KFLRSP3 "Kennfeld Reglerparameter p3 stetiger Lambdaregler" MAP 0x829A10 GkfWUw 127.9980 fak_uw_b128 0.00 127.9980 FUNCTION_LIST LRS IF_DATA DIM_X DIRECT 0x829A10
 /begin AXIS_DESCR COM_AXIS nmot_w nmot_uw_q0p25 7 0.00 16383.75 AXIS_PTS_REF SNM07LSUW /end AXIS_DESCR
 /begin AXIS_DESCR COM_AXIS rl_w rel_uw_q0p0234 8 0.00 1535.977 AXIS_PTS_REF SRL08LSUW /end AXIS_DESCR
/end CHARACTERISTIC
/begin CHARACTERISTIC KFLRSP4 "Kennfeld Reglerparameter p4 stetiger Lambdaregler" MAP 0x829A80 GkfWSw 127.9980 fak_sw_b64 -64.00000 63.99805 FUNCTION_LIST LRS IF_DATA DIM_X DIRECT 0x829A80
 /begin AXIS_DESCR COM_AXIS nmot_w nmot_uw_q0p25 7 0.00 16383.75 AXIS_PTS_REF SNM07LSUW /end AXIS_DESCR
 /begin AXIS_DESCR COM_AXIS rl_w rel_uw_q0p0234 8 0.00 1535.977 AXIS_PTS_REF SRL08LSUW /end AXIS_DESCR
/end CHARACTERISTIC
/begin CHARACTERISTIC KFLRST "Kennfeld Streckentotzeit" MAP 0x829AF0 KfAxUwAyUwSstxUwSstyUwWUw 327.67000000 tz10msxs_uw_b327p68 0.010000000000 327.68000000 FUNCTION_LIST LRS IF_DATA DIM_X DIRECT 0x829AF0
 /begin AXIS_DESCR STD_AXIS nmot_w nmot_uw_q0p25 7 0.00 16383.75 DEPOSIT ABSOLUT /end AXIS_DESCR
 /begin AXIS_DESCR STD_AXIS rl_w rel_uw_q0p0234 8 0.00 1535.977 DEPOSIT ABSOLUT /end AXIS_DESCR
/end CHARACTERISTIC
/begin CHARACTERISTIC KFLRSZ "Kennfeld Streckenzeitkonstante der LRS, 16-Bit" MAP 0x829B82 KfAxUwAyUwSstxUwSstyUwWUw 655.34999985 zk10msxs_uw_b655 0.010000152590 655.36000000 FUNCTION_LIST LRS IF_DATA DIM_X DIRECT 0x829B82
 /begin AXIS_DESCR STD_AXIS nmot_w nmot_uw_q0p25 7 0.00 16383.75 DEPOSIT ABSOLUT /end AXIS_DESCR
 /begin AXIS_DESCR STD_AXIS rl_w rel_uw_q0p0234 8 0.00 1535.977 DEPOSIT ABSOLUT /end AXIS_DESCR
/end CHARACTERISTIC
/begin CHARACTERISTIC KFLSUED "Kennfeld für die Einschaltdauer der LSU-Heizung abh. von Abgastemperatur und ml" MAP 0x81A459 KfAxUbAyUbSstxUbSstyUbWUb 2.550 t10msxs_ub_b2p55 0.00 2.550 FUNCTION_LIST HLSU IF_DATA DIM_X DIRECT 0x81A459
 /begin AXIS_DESCR STD_AXIS tabgm temp_ub_q5_o50 7 -50.00 1225. DEPOSIT ABSOLUT /end AXIS_DESCR
 /begin AXIS_DESCR STD_AXIS msabg m_ub_b1020 5 0.00 1020. DEPOSIT ABSOLUT /end AXIS_DESCR
/end CHARACTERISTIC
/begin CHARACTERISTIC KFLUAR_0_A "Kennfeld für Laufunruhe-Abstandsmass-Referenzwert" MAP 0x810280 GkfWUb 172.5 luquant 0.00 172.5 FUNCTION_LIST DMDLUA IF_DATA DIM_X INDIRECT 0x8173C8
 /begin AXIS_DESCR COM_AXIS rl rel_ub_q0p75 8 0.00 191.3 AXIS_PTS_REF SRL08DMUB /end AXIS_DESCR
 /begin AXIS_DESCR COM_AXIS nmot nmot_ub_q40 8 0.00 10200. AXIS_PTS_REF SNM08DMUB /end AXIS_DESCR
/end CHARACTERISTIC
/begin CHARACTERISTIC KFLUAR_1_A "Kennfeld für Laufunruhe-Abstandsmass-Referenzwert" MAP 0x8102C0 GkfWUb 172.5 luquant 0.00 172.5 FUNCTION_LIST DMDLUA IF_DATA DIM_X INDIRECT 0x8173CA
 /begin AXIS_DESCR COM_AXIS rl rel_ub_q0p75 8 0.00 191.3 AXIS_PTS_REF SRL08DMUB /end AXIS_DESCR
 /begin AXIS_DESCR COM_AXIS nmot nmot_ub_q40 8 0.00 10200. AXIS_PTS_REF SNM08DMUB /end AXIS_DESCR
/end CHARACTERISTIC
/begin CHARACTERISTIC KFLUAR1 "Kennfeld für Laufunruhe-Abstandsmass-Referenzwert" MAP 0x810380 GkfWUb 172.5 luquant 0.00 172.5 FUNCTION_LIST DMDLUA IF_DATA DIM_X DIRECT 0x810380
 /begin AXIS_DESCR COM_AXIS rl rel_ub_q0p75 8 0.00 191.3 AXIS_PTS_REF SRL08DMUB /end AXIS_DESCR
 /begin AXIS_DESCR COM_AXIS nmot nmot_ub_q40 8 0.00 10200. AXIS_PTS_REF SNM08DMUB /end AXIS_DESCR
/end CHARACTERISTIC
/begin CHARACTERISTIC KFLUAR2 "Kennfeld für Laufunruhe-Abstandsmass-Referenzwert" MAP 0x8103C0 GkfWUb 172.5 luquant 0.00 172.5 FUNCTION_LIST DMDLUA IF_DATA DIM_X DIRECT 0x8103C0
 /begin AXIS_DESCR COM_AXIS rl rel_ub_q0p75 8 0.00 191.3 AXIS_PTS_REF SRL08DMUB /end AXIS_DESCR
 /begin AXIS_DESCR COM_AXIS nmot nmot_ub_q40 8 0.00 10200. AXIS_PTS_REF SNM08DMUB /end AXIS_DESCR
/end CHARACTERISTIC
/begin CHARACTERISTIC KFLUARZ "Kennfeld für Laufunruhe-Abstandsmass-Referenzwert bei ZAS" MAP 0x810480 GkfWUb 172.5 luquant 0.00 172.5 FUNCTION_LIST DMDLUA IF_DATA DIM_X DIRECT 0x810480
 /begin AXIS_DESCR COM_AXIS rl rel_ub_q0p75 8 0.00 191.3 AXIS_PTS_REF SRL08DMUB /end AXIS_DESCR
 /begin AXIS_DESCR COM_AXIS nmot nmot_ub_q40 8 0.00 10200. AXIS_PTS_REF SNM08DMUB /end AXIS_DESCR
/end CHARACTERISTIC
/begin CHARACTERISTIC KFLURB_0_A "Kennfeld für Laufunruhe-Referenz-Basiswert" MAP 0x810949 GkfWSb 172.5 luquant -86.57 85.89 FUNCTION_LIST DMDLU IF_DATA DIM_X INDIRECT 0x8173CC
 /begin AXIS_DESCR COM_AXIS rl rel_ub_q0p75 8 0.00 191.3 AXIS_PTS_REF SRL08DMUB /end AXIS_DESCR
 /begin AXIS_DESCR COM_AXIS nmot nmot_ub_q40 8 0.00 10200. AXIS_PTS_REF SNM08DMUB /end AXIS_DESCR
/end CHARACTERISTIC
/begin CHARACTERISTIC KFLURB_1_A "Kennfeld für Laufunruhe-Referenz-Basiswert" MAP 0x810989 GkfWSb 172.5 luquant -86.57 85.89 FUNCTION_LIST DMDLU IF_DATA DIM_X INDIRECT 0x8173CE
 /begin AXIS_DESCR COM_AXIS rl rel_ub_q0p75 8 0.00 191.3 AXIS_PTS_REF SRL08DMUB /end AXIS_DESCR
 /begin AXIS_DESCR COM_AXIS nmot nmot_ub_q40 8 0.00 10200. AXIS_PTS_REF SNM08DMUB /end AXIS_DESCR
/end CHARACTERISTIC
/begin CHARACTERISTIC KFLURB1 "Kennfeld für Laufunruhe-Referenz-Basiswert" MAP 0x810A49 GkfWSb 172.5 luquant -86.57 85.89 FUNCTION_LIST DMDLU IF_DATA DIM_X DIRECT 0x810A49
 /begin AXIS_DESCR COM_AXIS rl rel_ub_q0p75 8 0.00 191.3 AXIS_PTS_REF SRL08DMUB /end AXIS_DESCR
 /begin AXIS_DESCR COM_AXIS nmot nmot_ub_q40 8 0.00 10200. AXIS_PTS_REF SNM08DMUB /end AXIS_DESCR
/end CHARACTERISTIC
/begin CHARACTERISTIC KFLURB2 "Kennfeld für Laufunruhe-Referenz-Basiswert" MAP 0x810A89 GkfWSb 172.5 luquant -86.57 85.89 FUNCTION_LIST DMDLU IF_DATA DIM_X DIRECT 0x810A89
 /begin AXIS_DESCR COM_AXIS rl rel_ub_q0p75 8 0.00 191.3 AXIS_PTS_REF SRL08DMUB /end AXIS_DESCR
 /begin AXIS_DESCR COM_AXIS nmot nmot_ub_q40 8 0.00 10200. AXIS_PTS_REF SNM08DMUB /end AXIS_DESCR
/end CHARACTERISTIC
/begin CHARACTERISTIC KFLURBZ "Kennfeld für Laufunruhe-Referenz-Basiswert bei ZAS" MAP 0x810B49 GkfWSb 172.5 luquant -86.57 85.89 FUNCTION_LIST DMDLU IF_DATA DIM_X DIRECT 0x810B49
 /begin AXIS_DESCR COM_AXIS rl rel_ub_q0p75 8 0.00 191.3 AXIS_PTS_REF SRL08DMUB /end AXIS_DESCR
 /begin AXIS_DESCR COM_AXIS nmot nmot_ub_q40 8 0.00 10200. AXIS_PTS_REF SNM08DMUB /end AXIS_DESCR
/end CHARACTERISTIC
/begin CHARACTERISTIC KFLURM_0_A "Kennfeld für Laufunruhe-Referenzwert zur Mehrfachaussetzererkennung ->Lum-Vergl." MAP 0x810B89 GkfWSb 172.5 luquant -86.57 85.89 FUNCTION_LIST DMDLU IF_DATA DIM_X INDIRECT 0x8173D0
 /begin AXIS_DESCR COM_AXIS rl rel_ub_q0p75 8 0.00 191.3 AXIS_PTS_REF SRL08DMUB /end AXIS_DESCR
 /begin AXIS_DESCR COM_AXIS nmot nmot_ub_q40 8 0.00 10200. AXIS_PTS_REF SNM08DMUB /end AXIS_DESCR
/end CHARACTERISTIC
/begin CHARACTERISTIC KFLURM_1_A "Kennfeld für Laufunruhe-Referenzwert zur Mehrfachaussetzererkennung ->Lum-Vergl." MAP 0x810BC9 GkfWSb 172.5 luquant -86.57 85.89 FUNCTION_LIST DMDLU IF_DATA DIM_X INDIRECT 0x8173D2
 /begin AXIS_DESCR COM_AXIS rl rel_ub_q0p75 8 0.00 191.3 AXIS_PTS_REF SRL08DMUB /end AXIS_DESCR
 /begin AXIS_DESCR COM_AXIS nmot nmot_ub_q40 8 0.00 10200. AXIS_PTS_REF SNM08DMUB /end AXIS_DESCR
/end CHARACTERISTIC
/begin CHARACTERISTIC KFLURM1 "Kennfeld für Laufunruhe-Referenzwert zur Mehrfachaussetzererkennung ->Lum-Vergl." MAP 0x810C89 GkfWSb 172.5 luquant -86.57 85.89 FUNCTION_LIST DMDLU IF_DATA DIM_X DIRECT 0x810C89
 /begin AXIS_DESCR COM_AXIS rl rel_ub_q0p75 8 0.00 191.3 AXIS_PTS_REF SRL08DMUB /end AXIS_DESCR
 /begin AXIS_DESCR COM_AXIS nmot nmot_ub_q40 8 0.00 10200. AXIS_PTS_REF SNM08DMUB /end AXIS_DESCR
/end CHARACTERISTIC
/begin CHARACTERISTIC KFMAKR "Kennfeld Meßfensteranfang Klopfregelung" MAP 0x8198AC GkfWUb 191.3 zw_ub_q0p75 0.00 191.3 FUNCTION_LIST GGKS IF_DATA DIM_X DIRECT 0x8198AC
 /begin AXIS_DESCR COM_AXIS nmot nmot_ub_q40 16 0.00 10200. AXIS_PTS_REF SNM16KRUB /end AXIS_DESCR
 /begin AXIS_DESCR COM_AXIS rl rel_ub_q0p75 4 0.00 191.3 AXIS_PTS_REF SRL04KRUB /end AXIS_DESCR
/end CHARACTERISTIC
/begin CHARACTERISTIC KFMDBGRG "Kennfeld mit dem Wert der Momentenbegrenzung" MAP 0x82954C KfAxUwAyUwSstxUwSstyUwWUw 99.99847 rel_uw_b100 0.00 99.99847 FUNCTION_LIST MDBGRG IF_DATA DIM_X DIRECT 0x82954C /begin AXIS_DESCR STD_AXIS nmot nmot_ub_q40 4 0.00 2621400. DEPOSIT ABSOLUT /end AXIS_DESCR /begin AXIS_DESCR STD_AXIS gangi dez 7 0.00 65535.00 DEPOSIT ABSOLUT /end AXIS_DESCR /end CHARACTERISTIC
/begin CHARACTERISTIC KFMDDLWS "Lenkhilfelastmoment abhängig von der Lenkwinkelgeschwindigkeit" MAP 0x816736 KfAxSwAySwSstxSwSstySwWSw 99.99847 rel_uw_b100 -50.00000 49.99847 FUNCTION_LIST MDVERB IF_DATA DIM_X DIRECT 0x816736
 /begin AXIS_DESCR STD_AXIS dlwsu_w dlw_sw_q0p04375 6 -1434.044 1434.000 DEPOSIT ABSOLUT /end AXIS_DESCR
 /begin AXIS_DESCR STD_AXIS lws_w lw_sw_q0p04375 6 -1434.044 1434.000 DEPOSIT ABSOLUT /end AXIS_DESCR
/end CHARACTERISTIC
/begin CHARACTERISTIC KFMDDSLAD "Kennfeld Drehmomentenreserve bei Aktivdiagnose-Sekundärluft" MAP 0x81EE38 KfAxUwAyUwSstxUwSstyUwWUw 99.99847 rel_uw_b100 0.00 99.99847 FUNCTION_LIST KHMD IF_DATA DIM_X DIRECT 0x81EE38
 /begin AXIS_DESCR STD_AXIS mifakh_w rel_uw_b100 4 0.00 99.99847 DEPOSIT ABSOLUT /end AXIS_DESCR
 /begin AXIS_DESCR STD_AXIS nmot_w nmot_uw_q0p25 4 0.00 16383.75 DEPOSIT ABSOLUT /end AXIS_DESCR
/end CHARACTERISTIC
/begin CHARACTERISTIC KFMDDSLFA "Kennfeld Drehmomentenreserve bei Testereingriff Sekundärluftdiagnose" MAP 0x81EE6C KfAxUwAyUwSstxUwSstyUwWUw 99.99847 rel_uw_b100 0.00 99.99847 FUNCTION_LIST KHMD IF_DATA DIM_X DIRECT 0x81EE6C
 /begin AXIS_DESCR STD_AXIS nmot_w nmot_uw_q0p25 4 0.00 16383.75 DEPOSIT ABSOLUT /end AXIS_DESCR
 /begin AXIS_DESCR STD_AXIS mifakh_w rel_uw_b100 4 0.00 99.99847 DEPOSIT ABSOLUT /end AXIS_DESCR
/end CHARACTERISTIC
/begin CHARACTERISTIC KFMDGEN "Drehmomentenaufnahme Generator" MAP 0x81A157 KfAxUbAyUbSstxUbSstyUbWUb 49.80 rel_q0p1953 0.00 49.80 FUNCTION_LIST MDVERB IF_DATA DIM_X DIRECT 0x81A157 /begin AXIS_DESCR STD_AXIS nmot nmot_ub_q40 5 0.00 10200. DEPOSIT ABSOLUT /end AXIS_DESCR /begin AXIS_DESCR STD_AXIS kldfpwm rel_ub_b99p6 6 0.00 99.61 DEPOSIT ABSOLUT /end AXIS_DESCR /end CHARACTERISTIC
/begin CHARACTERISTIC KFMDKH_0_A "Kennfeld Drehmomentenreserve für Katheizen" MAP 0x81EEA0 KfAxUwAyUwSstxUwSstyUwWUw 99.99847 rel_uw_b100 0.00 99.99847 FUNCTION_LIST KHMD IF_DATA DIM_X INDIRECT 0x815CCE
 /begin AXIS_DESCR STD_AXIS nmot_w nmot_uw_q0p25 8 0.00 16383.75 DEPOSIT ABSOLUT /end AXIS_DESCR
 /begin AXIS_DESCR STD_AXIS mifakh_w rel_uw_b100 8 0.00 99.99847 DEPOSIT ABSOLUT /end AXIS_DESCR
/end CHARACTERISTIC
/begin CHARACTERISTIC KFMDKH_1_A "Kennfeld Drehmomentenreserve für Katheizen" MAP 0x81EFE8 KfAxUwAyUwSstxUwSstyUwWUw 99.99847 rel_uw_b100 0.00 99.99847 FUNCTION_LIST KHMD IF_DATA DIM_X INDIRECT 0x815CD2
 /begin AXIS_DESCR STD_AXIS nmot_w nmot_uw_q0p25 8 0.00 16383.75 DEPOSIT ABSOLUT /end AXIS_DESCR
 /begin AXIS_DESCR STD_AXIS mifakh_w rel_uw_b100 8 0.00 99.99847 DEPOSIT ABSOLUT /end AXIS_DESCR
/end CHARACTERISTIC
/begin AXIS_PTS SDK10TEUB "wdkba abhängige Stützstellen (Anzahl 10)" 0x8181C4 wdkba SstAUbSstUb 100.0 relDK_ub_b100 10 0.00 100.0 FUNCTION_LIST SSTB TEB DEPOSIT ABSOLUT IF_DATA DIM_X DIRECT 0x8181C4 /end AXIS_PTS
/begin AXIS_PTS SDZ03DMUB "SST-Verteilung in DMD, 3 Drehzahl-SST" 0x810228 rl SstAUbSstUb 191.3 rel_ub_q0p75 3 0.00 191.3 FUNCTION_LIST DMDFON DEPOSIT ABSOLUT IF_DATA DIM_X DIRECT 0x810228 /end AXIS_PTS
/begin AXIS_PTS SDZ03DMUB2 "SST-Verteilung in DMD, 3 Drehzahl-SST" 0x81022C rl SstAUbSstUb 191.3 rel_ub_q0p75 3 0.00 191.3 FUNCTION_LIST DMDFON DEPOSIT ABSOLUT IF_DATA DIM_X DIRECT 0x81022C /end AXIS_PTS
/begin AXIS_PTS SDZ03DMUB3 "SST-Verteilung in DMD, 3 Drehzahl-SST" 0x810230 rl SstAUbSstUb 191.3 rel_ub_q0p75 3 0.00 191.3 FUNCTION_LIST DMDFON DEPOSIT ABSOLUT IF_DATA DIM_X DIRECT 0x810230 /end AXIS_PTS
/begin AXIS_PTS SDZ06GKUB "Stützstellen KFLAMKRL" 0x8192FB dzwlamfaw SstAUbSstUb 191.3 zw_ub_qn0p75 6 -191.3 0.00 FUNCTION_LIST LAMFAW DEPOSIT ABSOLUT IF_DATA DIM_X DIRECT 0x8192FB /end AXIS_PTS
/begin AXIS_PTS SDZ08DMUB "SST-Verteilung in DMD, 8 Drehzahl-SST" 0x810234 nmot SstAUbSstUb 10200. nmot_ub_q40 8 0.00 10200. FUNCTION_LIST DMDFON DEPOSIT ABSOLUT IF_DATA DIM_X DIRECT 0x810234 /end AXIS_PTS
/begin AXIS_PTS SDZ08DMUB2 "SST-Verteilung in DMD, 8 Drehzahl-SST" 0x81023D nmot SstAUbSstUb 10200. nmot_ub_q40 8 0.00 10200. FUNCTION_LIST DMDFON DEPOSIT ABSOLUT IF_DATA DIM_X DIRECT 0x81023D /end AXIS_PTS
/begin AXIS_PTS SDZ08DMUB3 "SST-Verteilung in DMD, 8 Drehzahl-SST" 0x810246 nmot SstAUbSstUb 10200. nmot_ub_q40 8 0.00 10200. FUNCTION_LIST DMDFON DEPOSIT ABSOLUT IF_DATA DIM_X DIRECT 0x810246 /end AXIS_PTS
/begin AXIS_PTS SEZ06TMUB "Stützstellenverteilung, Zündwinkelwirkungsgrad" 0x8181CF etazwimt SstAUbSstUb 127.5 rel_ub_b127p5 6 0.00 127.5 FUNCTION_LIST SSTB ATM DEPOSIT ABSOLUT IF_DATA DIM_X DIRECT 0x8181CF /end AXIS_PTS
/begin AXIS_PTS SGA06MDUB "Stützstellenverteilung Ist Gang 6 Sst." 0x81B12E gangi SstAUbSstUb 255.0 dez 6 0.00 255.0 FUNCTION_LIST SSTB ARMD DEPOSIT ABSOLUT IF_DATA DIM_X DIRECT 0x81B12E /end AXIS_PTS
/begin AXIS_PTS SGA08MDUB "Stützstellenverteilung Ist Gang 8 Sst." 0x810060 gangi SstAUbSstUb 255.0 dez 8 0.00 255.0 FUNCTION_LIST SSTB BBSAWE DMDSTP MDFAW NMAXMD DEPOSIT ABSOLUT IF_DATA DIM_X DIRECT 0x810060 /end AXIS_PTS
/begin AXIS_PTS SLD04LDUB "Stützstellenverteilung für Ladedruckregelung" 0x810070 lde SstAUbSstUb 2550. p_sb_q10 4 0.00 2550. FUNCTION_LIST SSTB LDRPID DEPOSIT ABSOLUT IF_DATA DIM_X DIRECT 0x810070 /end AXIS_PTS
/begin AXIS_PTS SLX06TMUW "Stützstellenverteilung, Lambdasoll" 0x81B144 lamsbg_w SstAUwSstUw 15.99976 fak_uw_b16 6 0.00 15.99976 FUNCTION_LIST SSTB ATM DEPOSIT ABSOLUT IF_DATA DIM_X DIRECT 0x81B144 /end AXIS_PTS
/begin AXIS_PTS SM108LHSW "dlashk_w abhängige Stützstellen (Anzahl 8)" 0x81B152 dlashkm_w SstASwSstSw 1.999969 fak_sw_b1 8 -1.000000 0.9999695 FUNCTION_LIST SSTB LRSHK DEPOSIT ABSOLUT IF_DATA DIM_X DIRECT 0x81B152 /end AXIS_PTS
/begin AXIS_PTS SMK08MDSW "Antiruckelmoment-abhängige Stützstellen (Anzahl =8)" 0x82850E mkar_w SstASwSstSw 199.9969 rel_sw_b100 8 -100.0000 99.99695 FUNCTION_LIST ARMD DEPOSIT ABSOLUT IF_DATA DIM_X DIRECT 0x82850E /end AXIS_PTS
/begin AXIS_PTS SML06TMUW "Stützstellenverteilung, Luftmasse, 6 Stützstellen" 0x81B164 ml_w SstAUwSstUw 6553.500 m_uw_b6553p5 6 0.00 6553.500 FUNCTION_LIST SSTB ATM DEPOSIT ABSOLUT IF_DATA DIM_X DIRECT 0x81B164 /end AXIS_PTS
/begin AXIS_PTS SML07TMUW "Stützstellenverteilung, Luftmasse, 7 Stützstellen" 0x81B172 ml_w SstAUwSstUw 6553.500 m_uw_b6553p5 7 0.00 6553.500 FUNCTION_LIST SSTB ATM DEPOSIT ABSOLUT IF_DATA DIM_X DIRECT 0x81B172 /end AXIS_PTS
/begin AXIS_PTS SMT06TMUW "Stützstellenverteilung, Luftmasse, 6 Stützstellen" 0x81B182 ml_w SstAUwSstUw 6553.500 m_uw_b6553p5 6 0.00 6553.500 FUNCTION_LIST SSTB ATM DEPOSIT ABSOLUT IF_DATA DIM_X DIRECT 0x81B182 /end AXIS_PTS
/begin AXIS_PTS SNM04ZUUW "Stützstellenverteilung Drehzahl" 0x817B7E nmot_w SstAUwSstUw 16383.75 nmot_uw_q0p25 4 0.00 16383.75 FUNCTION_LIST ZWMIN DEPOSIT ABSOLUT IF_DATA DIM_X DIRECT 0x817B7E /end AXIS_PTS
/begin AXIS_PTS SNM06ESUB "SST-Verteilung für Drehzahl" 0x8181F2 nmot SstAUbSstUb 10200. nmot_ub_q40 6 0.00 10200. FUNCTION_LIST SSTB ESNSWL DEPOSIT ABSOLUT IF_DATA DIM_X DIRECT 0x8181F2 /end AXIS_PTS
/begin AXIS_PTS SNM06GKUB "Stützstellen KFLAMKR, DLAMOB" 0x8181F9 nmot SstAUbSstUb 10200. nmot_ub_q40 6 0.00 10200. FUNCTION_LIST SSTB LAMFAW DEPOSIT ABSOLUT IF_DATA DIM_X DIRECT 0x8181F9 /end AXIS_PTS
/begin AXIS_PTS SNM06KOUB "Verteilung für Klimakompressorkennlinien" 0x81A20B nmot SstAUbSstUb 10200. nmot_ub_q40 6 0.00 10200. FUNCTION_LIST MDVERB DEPOSIT ABSOLUT IF_DATA DIM_X DIRECT 0x81A20B /end AXIS_PTS
/begin AXIS_PTS SNM06MDUW "Rover" 0x81B190 nmot_w SstAUwSstUw 16383.75 nmot_uw_q0p25 6 0.00 16383.75 FUNCTION_LIST SSTB MDFAW DEPOSIT ABSOLUT IF_DATA DIM_X DIRECT 0x81B190 /end AXIS_PTS
/begin AXIS_PTS SNM07ESUB "Stützstellenverteilung Drehzahl, 7 Sst." 0x818200 nmot SstAUbSstUb 10200. nmot_ub_q40 7 0.00 10200. FUNCTION_LIST SSTB ESUK LAMFAW DEPOSIT ABSOLUT IF_DATA DIM_X DIRECT 0x818200 /end AXIS_PTS
/begin AXIS_PTS SNM07LSUW "Stützstellenverteilung Reglerparameter LRS" 0x813A7A nmot_w SstAUwSstUw 16383.75 nmot_uw_q0p25 7 0.00 16383.75 FUNCTION_LIST SSTB LRS DEPOSIT ABSOLUT IF_DATA DIM_X DIRECT 0x813A7A /end AXIS_PTS
/begin AXIS_PTS SNM08DMUB "SST-Verteilung in DMD, 8 Drehzahl-SST" 0x81007C nmot SstAUbSstUb 10200. nmot_ub_q40 8 0.00 10200. FUNCTION_LIST SSTB DMDDLU DMDLU DMDLUA DMDMIL DMDSTP DEPOSIT ABSOLUT IF_DATA DIM_X DIRECT 0x81007C /end AXIS_PTS
/begin AXIS_PTS SNM08FEUB "Stützstellenverteilung Drehzahl, 08 Sst., Füllungseingriffe" 0x818208 nmot SstAUbSstUb 10200. nmot_ub_q40 8 0.00 10200. FUNCTION_LIST SSTB FUEREG DEPOSIT ABSOLUT IF_DATA DIM_X DIRECT 0x818208 /end AXIS_PTS
/begin AXIS_PTS SNM08LDUB "Stützstellenverteilung für Ladedruckregelung" 0x810085 nmot SstAUbSstUb 10200. nmot_ub_q40 8 0.00 10200. FUNCTION_LIST SSTB LDOB LDRLMX LDRPID DEPOSIT ABSOLUT IF_DATA DIM_X DIRECT 0x810085 /end AXIS_PTS
/begin AXIS_PTS SNM08LDUW "Stützstellenverteilung für Ladedruckregelung" 0x813A8A nmot_w SstAUwSstUw 16383.75 nmot_uw_q0p25 8 0.00 16383.75 FUNCTION_LIST SSTB BGPLGU LDRLMX LDRPID DEPOSIT ABSOLUT IF_DATA DIM_X DIRECT 0x813A8A /end AXIS_PTS
/begin AXIS_PTS SNM10LSUB "Stützstellenverteilung Kat-Vorsteuerwert LRS" 0x810097 nmot SstAUbSstUb 10200. nmot_ub_q40 10 0.00 10200. FUNCTION_LIST SSTB LRS DEPOSIT ABSOLUT IF_DATA DIM_X DIRECT 0x810097 /end AXIS_PTS
/begin AXIS_PTS SNM10TEUB "nmot abhängige Stützstellen (Anzahl 10)" 0x818223 nmot SstAUbSstUb 10200. nmot_ub_q40 10 0.00 10200. FUNCTION_LIST SSTB TEB DEPOSIT ABSOLUT IF_DATA DIM_X DIRECT 0x818223 /end AXIS_PTS
/begin AXIS_PTS SNM12ESUB "SST-Verteilung für die Motordrehzahl nmot" 0x8100A2 nmot SstAUbSstUb 10200. nmot_ub_q40 12 0.00 10200. FUNCTION_LIST SSTB ZWWL DEPOSIT ABSOLUT IF_DATA DIM_X DIRECT 0x8100A2 /end AXIS_PTS
/begin AXIS_PTS SNM16CIUB "Stützstellenverteilung Drehzahl, 16 Sst." 0x81822E nmot SstAUbSstUb 10200. nmot_ub_q40 16 0.00 10200. FUNCTION_LIST SSTB ACIFI DEPOSIT ABSOLUT IF_DATA DIM_X DIRECT 0x81822E /end AXIS_PTS
/begin AXIS_PTS SNM16GKUB "Stützstellenverteilung Gemischkontrolle 16 nmot Stützstellen" 0x8196D9 nmot SstAUbSstUb 10200. nmot_ub_q40 16 0.00 10200. FUNCTION_LIST LAMBTS DEPOSIT ABSOLUT IF_DATA DIM_X DIRECT 0x8196D9 /end AXIS_PTS
/begin AXIS_PTS SNM16KRDYUB "" 0x81823F nmot SstAUbSstUb 10200. nmot_ub_q40 16 0.00 10200. FUNCTION_LIST SSTB KRDY DEPOSIT ABSOLUT IF_DATA DIM_X DIRECT 0x81823F /end AXIS_PTS
/begin AXIS_PTS SNM16KRUB "Stützstellenverteilung Drehzahl, 16 Sst." 0x818250 nmot SstAUbSstUb 10200. nmot_ub_q40 16 0.00 10200. FUNCTION_LIST SSTB DKRS GGKS KRDY KRKE KRRA DEPOSIT ABSOLUT IF_DATA DIM_X DIRECT 0x818250 /end AXIS_PTS
/begin AXIS_PTS SNM16LDUB "Stützstellenverteilung für Ladedruckregelung" 0x8100BC nmot SstAUbSstUb 10200. nmot_ub_q40 16 0.00 10200. FUNCTION_LIST SSTB LDRPID DEPOSIT ABSOLUT IF_DATA DIM_X DIRECT 0x8100BC /end AXIS_PTS
/begin AXIS_PTS SNM16LDUW "Stützstellenverteilung für Ladedruckregelung" 0x813AC8 nmot_w SstAUwSstUw 16383.75 nmot_uw_q0p25 16 0.00 16383.75 FUNCTION_LIST SSTB LDRPID DEPOSIT ABSOLUT IF_DATA DIM_X DIRECT 0x813AC8 /end AXIS_PTS
/begin AXIS_PTS SNM16ZUUW "Stützstellenverteilung Drehzahl, 16 Sst." 0x813B2E nmot_w SstAUwSstUw 16383.75 nmot_uw_q0p25 16 0.00 16383.75 FUNCTION_LIST SSTB ZWGRU ZWMIN DEPOSIT ABSOLUT IF_DATA DIM_X DIRECT 0x813B2E /end AXIS_PTS
/begin AXIS_PTS SNS04ZUSB "Stützstellenverteilung Drehzahlgradient" 0x812AC7 dns SstAUbSstSb 2550. nmotd_sb_q10 4 -1280. 1270. FUNCTION_LIST ZWMIN DEPOSIT ABSOLUT IF_DATA DIM_X DIRECT 0x812AC7 /end AXIS_PTS
/begin AXIS_PTS SNS06LLSB "Stützstellenvert., Solldrehzahlabw., 06 Sst., LL-Regel." 0x81A071 dns SstAUbSstSb 2550. nmotd_sb_q10 6 -1280. 1270. FUNCTION_LIST LLRNS LLRMR LLRRM DEPOSIT ABSOLUT IF_DATA DIM_X DIRECT 0x81A071 /end AXIS_PTS
/begin AXIS_PTS SPL08LDUW "Stützstellenverteilung für Ladedruckregelung" 0x8165BA plsolr_w SstAUbSstUw 2559.961 p_uw_q0p039 8 0.00 2559.961 FUNCTION_LIST LDRPID DEPOSIT ABSOLUT IF_DATA DIM_X DIRECT 0x8165BA /end AXIS_PTS
/begin AXIS_PTS SPU08LDUB "Stützstellenverteilung für Ladedruckregelung" 0x8100CD pu SstAUbSstUb 1275. p_ub_q5 8 0.00 1275. FUNCTION_LIST SSTB LDRPID DEPOSIT ABSOLUT IF_DATA DIM_X DIRECT 0x8100CD /end AXIS_PTS
/begin AXIS_PTS SQM05TEUB "Luftmassenquotient-abhängige Stützstellen (Anzahl =5)" 0x8100D6 qmsdyn SstAUbSstUb 15.94 fak_ub_b16 5 0.00 15.94 FUNCTION_LIST SSTB TEB DEPOSIT ABSOLUT IF_DATA DIM_X DIRECT 0x8100D6 /end AXIS_PTS
/begin AXIS_PTS SRL03KRUB "Stützstellenverteilung relative Füllung, 3 Sst." 0x818261 rl SstAUbSstUb 191.3 rel_ub_q0p75 3 0.00 191.3 FUNCTION_LIST SSTB KRKE DEPOSIT ABSOLUT IF_DATA DIM_X DIRECT 0x818261 /end AXIS_PTS
/begin AXIS_PTS SRL04KRUB "Stützstellenverteilung relative Füllung, 4 Sst." 0x818265 rl SstAUbSstUb 191.3 rel_ub_q0p75 4 0.00 191.3 FUNCTION_LIST SSTB GGKS DEPOSIT ABSOLUT IF_DATA DIM_X DIRECT 0x818265 /end AXIS_PTS
/begin AXIS_PTS SRL06ESUB "Sst-Verteilung für die relative Füllung rl" 0x8100DC rl SstAUbSstUb 191.3 rel_ub_q0p75 6 0.00 191.3 FUNCTION_LIST SSTB ZWWL DEPOSIT ABSOLUT IF_DATA DIM_X DIRECT 0x8100DC /end AXIS_PTS
/begin AXIS_PTS SRL06GKUB "Stützstellen KFLAMKRL, KFLAFWL, KFLAMKR" 0x81826A rl SstAUbSstUb 191.3 rel_ub_q0p75 6 0.00 191.3 FUNCTION_LIST SSTB LAMFAW DEPOSIT ABSOLUT IF_DATA DIM_X DIRECT 0x81826A /end AXIS_PTS
/begin AXIS_PTS SRL06KRUB "" 0x818271 rl SstAUbSstUb 191.3 rel_ub_q0p75 6 0.00 191.3 FUNCTION_LIST SSTB KRDY DEPOSIT ABSOLUT IF_DATA DIM_X DIRECT 0x818271 /end AXIS_PTS
/begin AXIS_PTS SRL08DMUB "SST-Verteilung in DMD, 8 Last-SST" 0x8100E3 rl SstAUbSstUb 191.3 rel_ub_q0p75 8 0.00 191.3 FUNCTION_LIST SSTB DMDDLU DMDLU DMDLUA DMDSTP DEPOSIT ABSOLUT IF_DATA DIM_X DIRECT 0x8100E3 /end AXIS_PTS
/begin AXIS_PTS SRL08LSUW "Stützstellenverteilung Reglerparameter" 0x813B6A rl_w SstAUwSstUw 1535.977 rel_uw_q0p0234 8 0.00 1535.977 FUNCTION_LIST SSTB LRS DEPOSIT ABSOLUT IF_DATA DIM_X DIRECT 0x813B6A /end AXIS_PTS
/begin AXIS_PTS SRL10LSUB "Stützstellenverteilung Kat-Vorsteuerwert LRS" 0x8100EC rl SstAUbSstUb 191.3 rel_ub_q0p75 10 0.00 191.3 FUNCTION_LIST SSTB LRS DEPOSIT ABSOLUT IF_DATA DIM_X DIRECT 0x8100EC /end AXIS_PTS
/begin AXIS_PTS SRL12GKUW "Stützstellenverteilung Gemischkontrolle 12 rl_w Stützstellen" 0x81E5B8 rl_w SstAUwSstUw 1535.977 rel_uw_q0p0234 12 0.00 1535.977 FUNCTION_LIST LAMBTS DEPOSIT ABSOLUT IF_DATA DIM_X DIRECT 0x81E5B8 /end AXIS_PTS
/begin AXIS_PTS SRL12ZUUW "Stützstellenverteilung relative Luftfüllung, 12 St." 0x813B8E rl_w SstAUwSstUw 1535.977 rel_uw_q0p0234 12 0.00 1535.977 FUNCTION_LIST SSTB ZWGRU ZWMIN DEPOSIT ABSOLUT IF_DATA DIM_X DIRECT 0x813B8E /end AXIS_PTS
/begin AXIS_PTS SRP06ESUB "SST-Verteilung für rel. Luftfüllung präd. für Einspritzung" 0x8100F7 rlp SstAUbSstUb 191.3 rel_ub_q0p75 6 0.00 191.3 FUNCTION_LIST SSTB ESNSWL DEPOSIT ABSOLUT IF_DATA DIM_X DIRECT 0x8100F7 /end AXIS_PTS
/begin AXIS_PTS STA06ESUB "SST-Verteilung für die Ansauglufttemperatur" 0x818291 tans SstAUbSstUb 191.3 temp_ub_q0p75_o48 6 -48.00 143.3 FUNCTION_LIST SSTB ESNSWL DEPOSIT ABSOLUT IF_DATA DIM_X DIRECT 0x818291 /end AXIS_PTS
/begin AXIS_PTS STA06LLUB "Temperatur: Ansaugluft bzw. PWM-Signal von AC/Kompressor" 0x81A219 tlok SstAUbSstUb 191.3 temp_ub_q0p75_o48 6 -48.00 143.3 FUNCTION_LIST MDVERB DEPOSIT ABSOLUT IF_DATA DIM_X DIRECT 0x81A219 /end AXIS_PTS
/begin AXIS_PTS STM08GKUB "8 Motortemperaturstützstellen für KFLAFWL" 0x8182B7 tmot SstAUbSstUb 191.3 temp_ub_q0p75_o48 8 -48.00 143.3 FUNCTION_LIST SSTB LAMFAW DEPOSIT ABSOLUT IF_DATA DIM_X DIRECT 0x8182B7 /end AXIS_PTS
/begin AXIS_PTS STM09ESUB "Stützstellenverteilung Motortemperatur, 9 Sst." 0x8182C0 tmot SstAUbSstUb 191.3 temp_ub_q0p75_o48 9 -48.00 143.3 FUNCTION_LIST SSTB ESUK ESUKAS DEPOSIT ABSOLUT IF_DATA DIM_X DIRECT 0x8182C0 /end AXIS_PTS
/begin AXIS_PTS STM12ESUB "SST-Verteilung für die Motortemperatur tmot" 0x810127 tmot SstAUbSstUb 191.3 temp_ub_q0p75_o48 12 -48.00 143.3 FUNCTION_LIST SSTB ESNSWL LAMKO LANSWL ZWWL DEPOSIT ABSOLUT IF_DATA DIM_X DIRECT 0x810127 /end AXIS_PTS
/begin AXIS_PTS STS05DTKA "Stützstellenverteilung in Abhängigkeit von Differenztemp. Motor/ Kühleraustritt" 0x81AF33 dtmtka SstAUbSstSb 191.3 temp_sb_q0p75 5 -96.00 95.25 FUNCTION_LIST KMTR DEPOSIT ABSOLUT IF_DATA DIM_X DIRECT 0x81AF33 /end AXIS_PTS
/begin AXIS_PTS STS05DTTS "Stützstellenverteilung in Abhängigkeit von Differenztemp. Motor-Soll/Isttemp." 0x81AF39 dkmts SstAUbSstSb 191.3 temp_sb_q0p75 5 -96.00 95.25 FUNCTION_LIST KMTR DEPOSIT ABSOLUT IF_DATA DIM_X DIRECT 0x81AF39 /end AXIS_PTS
/begin AXIS_PTS STS08ESUB "SST-Verteilung für Motorstarttemperatur" 0x810134 tmst SstAUbSstUb 191.3 temp_ub_q0p75_o48 8 -48.00 143.3 FUNCTION_LIST SSTB ESNSWL DEPOSIT ABSOLUT IF_DATA DIM_X DIRECT 0x810134 /end AXIS_PTS
/begin AXIS_PTS STS12ESUB "SST-Verteilung für Motorstarttemperatur" 0x810146 tmst SstAUbSstUb 191.3 temp_ub_q0p75_o48 12 -48.00 143.3 FUNCTION_LIST SSTB ESNSWL LANSWL DEPOSIT ABSOLUT IF_DATA DIM_X DIRECT 0x810146 /end AXIS_PTS
/begin AXIS_PTS STV10LDSW "Stützstellenverteilung für Ladedruckregelung" 0x82796A ldtvr_w SstAUbSstSw 327.6750 tv_sw_q0p005 10 -163.8400 163.8350 FUNCTION_LIST LDRPID DEPOSIT ABSOLUT IF_DATA DIM_X DIRECT 0x82796A /end AXIS_PTS
/begin AXIS_PTS STW08MDUB "Stützstellenverteilung  Temperatur des Drehmomentenwandlers" 0x81A0DE twnd SstAUbSstUb 191.3 temp_ub_q0p75_o48 8 -48.00 143.3 FUNCTION_LIST MDWAN DEPOSIT ABSOLUT IF_DATA DIM_X DIRECT 0x81A0DE /end AXIS_PTS
/begin AXIS_PTS SUV07MDUB "Stützstellenverteilung für die Übertragungsfunktion der Getriebesteuerung" 0x8182DC uefktget SstAUbSstUb 25.50 uefktget_ub_b25p4 7 0.00 25.50 FUNCTION_LIST SSTB ARMD DEPOSIT ABSOLUT IF_DATA DIM_X DIRECT 0x8182DC /end AXIS_PTS
/begin AXIS_PTS SWK108LDUW "Stützstellenverteilung für Ladedruckregelung" 0x827F5E wkrmdy_w SstAUbSstUw 12287.81 zw_q0p1875 8 0.00 12287.81 FUNCTION_LIST LDRLMX DEPOSIT ABSOLUT IF_DATA DIM_X DIRECT 0x827F5E /end AXIS_PTS
/begin COMPU_METHOD bfzg_sw_q4p239Em4 "" RAT_FUNC "%10.7" "m/s^2" COEFFS 0 1 0 0 0 0.0004239 /end COMPU_METHOD
/begin COMPU_METHOD DEZ "1 : 1 Umrechnug (dez/hex)" RAT_FUNC "%6.2" "" COEFFS 0 1 0 0 0 1 /end COMPU_METHOD
/begin COMPU_METHOD dez "1 : 1 Umrechnug (dez/hex)" RAT_FUNC "%6.2" "" COEFFS 0 1 0 0 0 1 /end COMPU_METHOD
/begin COMPU_METHOD dichte_ub_b2 "" RAT_FUNC "%6.4" "kg/m^3" COEFFS 0 256 0 0 0 2 /end COMPU_METHOD
/begin COMPU_METHOD dlw_sw_q0p04375 "" RAT_FUNC "%6.4" "°/s" COEFFS 0 32767 0 0 0 1434 /end COMPU_METHOD
/begin COMPU_METHOD fak1_q4p3945Em4 "" RAT_FUNC "%6.5" "[kg/h]/g" COEFFS 0 65536 0 0 0 28.8 /end COMPU_METHOD
/begin COMPU_METHOD fak_q0p000244 "" RAT_FUNC "%6.5" "-" COEFFS 0 65536 0 0 0 16 /end COMPU_METHOD
/begin COMPU_METHOD fak_q0p00195 "" RAT_FUNC "%6.4" "-" COEFFS 0 65536 0 0 0 128 /end COMPU_METHOD
/begin COMPU_METHOD fak_q0p015625 "" RAT_FUNC "%6.4" "hPa/(g*s)" COEFFS 0 65536 0 0 0 1024 /end COMPU_METHOD
/begin COMPU_METHOD fak_q0p1 "" RAT_FUNC "%6.3" "" COEFFS 0 1 0 0 0 0.1 /end COMPU_METHOD
/begin COMPU_METHOD fak_sb_b0p03125 "" RAT_FUNC "%6.5" "-" COEFFS 0 256 0 0 0 0.0625 /end COMPU_METHOD
/begin COMPU_METHOD fak_sb_b1 "" RAT_FUNC "%6.4" "-" COEFFS 0 256 0 0 0 2 /end COMPU_METHOD
/begin COMPU_METHOD fak_sb_b16 "" RAT_FUNC "%6.3" "-" COEFFS 0 256 0 0 0 32 /end COMPU_METHOD
/begin COMPU_METHOD fak_sb_b64 "" RAT_FUNC "%6.3" "-" COEFFS 0 256 0 0 0 128 /end COMPU_METHOD
/begin COMPU_METHOD fak_sw_b1 "" RAT_FUNC "%7.6" "-" COEFFS 0 65536 0 0 0 2 /end COMPU_METHOD
/begin COMPU_METHOD fak_sw_b2 "" RAT_FUNC "%7.6" "-" COEFFS 0 65536 0 0 0 4 /end COMPU_METHOD
/begin COMPU_METHOD fak_sw_b32 "" RAT_FUNC "%6.5" "-" COEFFS 0 65536 0 0 0 64 /end COMPU_METHOD
/begin COMPU_METHOD fak_sw_b64 "" RAT_FUNC "%6.4" "-" COEFFS 0 65536 0 0 0 128 /end COMPU_METHOD
/begin COMPU_METHOD fak_ub_b0p25 "" RAT_FUNC "%10.7" "-" COEFFS 0 256 0 0 0 0.25 /end COMPU_METHOD
/begin COMPU_METHOD fak_ub_b0p5 "" RAT_FUNC "%6.4" "-" COEFFS 0 256 0 0 0 0.5 /end COMPU_METHOD
/begin COMPU_METHOD fak_ub_b1 "" RAT_FUNC "%6.4" "-" COEFFS 0 256 0 0 0 1 /end COMPU_METHOD
/begin COMPU_METHOD fak_ub_b16 "" RAT_FUNC "%6.4" "-" COEFFS 0 256 0 0 0 16 /end COMPU_METHOD
/begin COMPU_METHOD fak_ub_b1p25_o0p75 "" RAT_FUNC "%6.3" "-" COEFFS 0 1 -0.75 0 0 0.00195313 /end COMPU_METHOD
/begin COMPU_METHOD fak_ub_b2 "" RAT_FUNC "%6.4" "-" COEFFS 0 256 0 0 0 2 /end COMPU_METHOD
/begin COMPU_METHOD fak_ub_b32 "" RAT_FUNC "%6.3" "-" COEFFS 0 256 0 0 0 32 /end COMPU_METHOD
/begin COMPU_METHOD fak_ub_b3p125 "" RAT_FUNC "%6.4" "%/Upm" COEFFS 0 2048 0 0 0 25 /end COMPU_METHOD
/begin COMPU_METHOD fak_ub_b4 "" RAT_FUNC "%6.4" "-" COEFFS 0 256 0 0 0 4 /end COMPU_METHOD
/begin COMPU_METHOD fak_ub_b64 "" RAT_FUNC "%6.3" "-" COEFFS 0 256 0 0 0 64 /end COMPU_METHOD
/begin COMPU_METHOD fak_ub_b8 "" RAT_FUNC "%6.4" "-" COEFFS 0 256 0 0 0 8 /end COMPU_METHOD
/begin COMPU_METHOD fak_ub_q4p7Em7 "" RAT_FUNC "%11.10" "-" COEFFS 0 1 0 0 0 4.7e-007 /end COMPU_METHOD
/begin COMPU_METHOD fak_uw_b1 "" RAT_FUNC "%7.6" "-" COEFFS 0 65536 0 0 0 1 /end COMPU_METHOD
/begin COMPU_METHOD fak_uw_b128 "" RAT_FUNC "%6.4" "-" COEFFS 0 65536 0 0 0 128 /end COMPU_METHOD
/begin COMPU_METHOD fak_uw_b16 "" RAT_FUNC "%6.5" "-" COEFFS 0 65536 0 0 0 16 /end COMPU_METHOD
/begin COMPU_METHOD fak_uw_b160 "" RAT_FUNC "%6.4" "" COEFFS 0 65536 0 0 0 160 /end COMPU_METHOD
/begin COMPU_METHOD fak_uw_b2 "" RAT_FUNC "%7.6" "-" COEFFS 0 65536 0 0 0 2 /end COMPU_METHOD
/begin COMPU_METHOD fak_uw_b4 "" RAT_FUNC "%7.6" "-" COEFFS 0 65536 0 0 0 4 /end COMPU_METHOD
/begin COMPU_METHOD fak_uw_b4_no1 "" RAT_FUNC "%6.3" "" COEFFS 0 65536 65536 0 0 4 /end COMPU_METHOD
/begin COMPU_METHOD fak_uw_b64 "" RAT_FUNC "%6.5" "-" COEFFS 0 65536 0 0 0 64 /end COMPU_METHOD
/begin COMPU_METHOD fak_uw_b8 "" RAT_FUNC "%6.5" "-" COEFFS 0 65536 0 0 0 8 /end COMPU_METHOD
/begin COMPU_METHOD fmfkr_dez "" RAT_FUNC "%6.2" "kHz" COEFFS 0 1 0 0 0 1 /end COMPU_METHOD
/begin COMPU_METHOD kw_q1 "" RAT_FUNC "%6.2" "°KW" COEFFS 0 1 0 0 0 1 /end COMPU_METHOD
/begin COMPU_METHOD luquant "Umrechnung Laufunruhe in DMD" RAT_FUNC "%6.3" "(Umdr./sec)^2" COEFFS 0 1.47862 0 0 0 1 /end COMPU_METHOD
/begin COMPU_METHOD lw_sw_q0p04375 "" RAT_FUNC "%6.4" "°" COEFFS 0 32767 0 0 0 1434 /end COMPU_METHOD
/begin COMPU_METHOD m_q0p00355 "" RAT_FUNC "%6.4" "kg" COEFFS 0 1125 0 0 0 4 /end COMPU_METHOD
/begin COMPU_METHOD m_q0p1 "" RAT_FUNC "%6.3" "kg/h" COEFFS 0 10 0 0 0 1 /end COMPU_METHOD
/begin COMPU_METHOD m_q2p777Em5_kg "" RAT_FUNC "%7.6" "kg" COEFFS 0 3600 0 0 0 0.1 /end COMPU_METHOD
/begin COMPU_METHOD m_ub_b1020 "" RAT_FUNC "%6.2" "kg/h" COEFFS 0 1 0 0 0 4 /end COMPU_METHOD
/begin COMPU_METHOD m_ub_b23p3 "" RAT_FUNC "%6.3" "kg" COEFFS 0 2812.5 0 0 0 256 /end COMPU_METHOD
/begin COMPU_METHOD m_ub_q0p0444 "" RAT_FUNC "%6.4" "g" COEFFS 0 1 0 0 0 0.0444 /end COMPU_METHOD
/begin COMPU_METHOD m_uw_b23p3 "" RAT_FUNC "%6.5" "kg" COEFFS 0 2812.5 0 0 0 1 /end COMPU_METHOD
/begin COMPU_METHOD m_uw_b291p25 "" RAT_FUNC "%6.4" "g" COEFFS 0 225 0 0 0 1 /end COMPU_METHOD
/begin COMPU_METHOD m_uw_b4660 "" RAT_FUNC "%6.4" "g" COEFFS 0 3600 0 0 0 256 /end COMPU_METHOD
/begin COMPU_METHOD m_uw_b6553p5 "" RAT_FUNC "%6.3" "kg/h" COEFFS 0 1 0 0 0 0.1 /end COMPU_METHOD
/begin COMPU_METHOD nmotd_sb_q10 "" RAT_FUNC "%6.1" "U/min" COEFFS 0 1 0 0 0 10 /end COMPU_METHOD
/begin COMPU_METHOD nmot_ub_q10 "" RAT_FUNC "%6.1" "U/min" COEFFS 0 1 0 0 0 10 /end COMPU_METHOD
/begin COMPU_METHOD nmot_ub_q40 "" RAT_FUNC "%6.1" "Upm" COEFFS 0 1 0 0 0 40 /end COMPU_METHOD
/begin COMPU_METHOD nmot_uw_q0p25 "" RAT_FUNC "%6.3" "U/min" COEFFS 0 1 0 0 0 0.25 /end COMPU_METHOD
/begin COMPU_METHOD p_sb_q0p25 "" RAT_FUNC "%6.3" "hPa" COEFFS 0 1 0 0 0 0.25 /end COMPU_METHOD
/begin COMPU_METHOD p_sb_q10 "" RAT_FUNC "%6.1" "hPa" COEFFS 0 1 0 0 0 10 /end COMPU_METHOD
/begin COMPU_METHOD p_sw_q0p039 "" RAT_FUNC "%6.4" "hPa" COEFFS 0 256 0 0 0 10 /end COMPU_METHOD
/begin COMPU_METHOD p_sw_q0p312 "" RAT_FUNC "%6.3" "hPa" COEFFS 0 256 0 0 0 80 /end COMPU_METHOD
/begin COMPU_METHOD p_ub_q5 "" RAT_FUNC "%6.2" "hPa" COEFFS 0 1 0 0 0 5 /end COMPU_METHOD
/begin COMPU_METHOD p_uw_q0p039 "" RAT_FUNC "%6.4" "hPa" COEFFS 0 256 0 0 0 10 /end COMPU_METHOD
/begin COMPU_METHOD relDK_ub_b100 "" RAT_FUNC "%6.3" "% DK" COEFFS 0 255 0 0 0 100 /end COMPU_METHOD
/begin COMPU_METHOD relPED_ub_b100 "" RAT_FUNC "%6.3" "% PED" COEFFS 0 255 0 0 0 100 /end COMPU_METHOD
/begin COMPU_METHOD relPED_uw_b100 "" RAT_FUNC "%6.4" "% PED" COEFFS 0 65535 0 0 0 100 /end COMPU_METHOD
/begin COMPU_METHOD rel_q0p00195 "" RAT_FUNC "%6.4" "%" COEFFS 0 65536 0 0 0 128 /end COMPU_METHOD
/begin COMPU_METHOD rel_q0p002383 "" RAT_FUNC "%6.4" "%/(s*U/min)" COEFFS 0 256 0 0 0 0.61 /end COMPU_METHOD
/begin COMPU_METHOD rel_q0p0195 "" RAT_FUNC "%6.4" "%" COEFFS 0 256 0 0 0 5 /end COMPU_METHOD
/begin COMPU_METHOD rel_q0p025 "" RAT_FUNC "%6.4" "%" COEFFS 0 1 0 0 0 0.025 /end COMPU_METHOD
/begin COMPU_METHOD rel_q0p0977 "" RAT_FUNC "%6.3" "%" COEFFS 0 1 0 0 0 0.0977 /end COMPU_METHOD
/begin COMPU_METHOD rel_q0p1953 "" RAT_FUNC "%6.3" "%" COEFFS 0 256 0 0 0 50 /end COMPU_METHOD
/begin COMPU_METHOD rel_q0p39 "" RAT_FUNC "%6.3" "%" COEFFS 0 256 0 0 0 100 /end COMPU_METHOD
/begin COMPU_METHOD rel_q0p4 "" RAT_FUNC "%6.3" "%" COEFFS 0 1 0 0 0 0.4 /end COMPU_METHOD
/begin COMPU_METHOD rel_q0p7629Em3 "" RAT_FUNC "%6.5" "%" COEFFS 0 65536 0 0 0 50 /end COMPU_METHOD
/begin COMPU_METHOD rel_q1p5 "" RAT_FUNC "%6.2" "%" COEFFS 0 1 0 0 0 1.5 /end COMPU_METHOD
/begin COMPU_METHOD rel_sb_q0p39 "" RAT_FUNC "%6.3" "%" COEFFS 0 1 0 0 0 0.3906 /end COMPU_METHOD
/begin COMPU_METHOD rel_sb_q0p75 "" RAT_FUNC "%6.3" "%" COEFFS 0 1 0 0 0 0.75 /end COMPU_METHOD
/begin COMPU_METHOD rel_sw_b100 "" RAT_FUNC "%6.4" "%" COEFFS 0 32768 0 0 0 100 /end COMPU_METHOD
/begin COMPU_METHOD rel_sw_b1p5 "" RAT_FUNC "%7.6" "%/(1/min)" COEFFS 0 32768 0 0 0 1.5 /end COMPU_METHOD
/begin COMPU_METHOD rel_sw_q0p0234 "" RAT_FUNC "%6.4" "%/seg" COEFFS 0 32 0 0 0 0.75 /end COMPU_METHOD
/begin COMPU_METHOD rel_sw_q0p0468 "" RAT_FUNC "%6.4" "%" COEFFS 0 65536 0 0 0 3072 /end COMPU_METHOD
/begin COMPU_METHOD rel_sw_q0p1953 "" RAT_FUNC "%6.3" "%" COEFFS 0 65536 0 0 0 12800 /end COMPU_METHOD
/begin COMPU_METHOD rel_ub_b127p5 "" RAT_FUNC "%6.3" "%" COEFFS 0 2 0 0 0 1 /end COMPU_METHOD
/begin COMPU_METHOD rel_ub_b1p0 "" RAT_FUNC "%6.4" "%" COEFFS 0 256 0 0 0 1 /end COMPU_METHOD
/begin COMPU_METHOD rel_ub_b2p0 "" RAT_FUNC "%6.4" "%" COEFFS 0 256 0 0 0 2 /end COMPU_METHOD
/begin COMPU_METHOD rel_ub_b99p6 "" RAT_FUNC "%6.3" "%" COEFFS 0 256 0 0 0 100 /end COMPU_METHOD
/begin COMPU_METHOD rel_ub_q0p0029 "" RAT_FUNC "%6.4" "%" COEFFS 0 256 0 0 0 0.75 /end COMPU_METHOD
/begin COMPU_METHOD rel_ub_q0p1875 "" RAT_FUNC "%6.3" "Grad KW/ms" COEFFS 0 256 0 0 0 48 /end COMPU_METHOD
/begin COMPU_METHOD rel_ub_q0p75 "" RAT_FUNC "%6.3" "%" COEFFS 0 1 0 0 0 0.75 /end COMPU_METHOD
/begin COMPU_METHOD rel_ub_q8 "" RAT_FUNC "%6.2" "%/s" COEFFS 0 1 0 0 0 8 /end COMPU_METHOD
/begin COMPU_METHOD rel_uw_b100 "" RAT_FUNC "%6.4" "%" COEFFS 0 65536 0 0 0 100 /end COMPU_METHOD
/begin COMPU_METHOD rel_uw_b192 "" RAT_FUNC "%6.4" "%" COEFFS 0 65536 0 0 0 192 /end COMPU_METHOD
/begin COMPU_METHOD rel_uw_b200 "" RAT_FUNC "%6.4" "%" COEFFS 0 65536 0 0 0 200 /end COMPU_METHOD
/begin COMPU_METHOD rel_uw_b3276p75 "" RAT_FUNC "%6.4" "%/100hPa" COEFFS 0 1 0 0 0 0.05 /end COMPU_METHOD
/begin COMPU_METHOD rel_uw_q0p0234 "" RAT_FUNC "%6.4" "%" COEFFS 0 32 0 0 0 0.75 /end COMPU_METHOD
/begin COMPU_METHOD rfak_q0p5 "" RAT_FUNC "%6.2" "-" COEFFS 0 0 128 0 1 0 /end COMPU_METHOD
/begin COMPU_METHOD spg_ubatt "" RAT_FUNC "%6.4" "V" COEFFS 0 1 0 0 0 0.0704 /end COMPU_METHOD
/begin COMPU_METHOD spg_ub_q0p019 "" RAT_FUNC "%6.4" "V" COEFFS 0 256 0 0 0 5 /end COMPU_METHOD
/begin COMPU_METHOD t10msxs_sb_q0p01 "" RAT_FUNC "%6.4" "s" COEFFS 0 1 0 0 0 0.01 /end COMPU_METHOD
/begin COMPU_METHOD t10msxs_ub_b2p55 "" RAT_FUNC "%6.4" "s" COEFFS 0 1 0 0 0 0.01 /end COMPU_METHOD
/begin COMPU_METHOD t10msxs_uw_b655p35 "" RAT_FUNC "%6.4" "s" COEFFS 0 1 0 0 0 0.01 /end COMPU_METHOD
/begin COMPU_METHOD t1sxs_ub_b255 "" RAT_FUNC "%6.2" "s" COEFFS 0 1 0 0 0 1 /end COMPU_METHOD
/begin COMPU_METHOD t40ms_ub_b10200 "" RAT_FUNC "%7.2" "ms" COEFFS 0 1 0 0 0 40 /end COMPU_METHOD
/begin COMPU_METHOD t50msxs_ub_b12p75 "" RAT_FUNC "%6.4" "s" COEFFS 0 1 0 0 0 0.05 /end COMPU_METHOD
/begin COMPU_METHOD temp_q0p0234_o273 "" RAT_FUNC "%6.1" "Grad C" COEFFS 0 1 273.15 0 0 0.0234375 /end COMPU_METHOD
/begin COMPU_METHOD temp_q5 "" RAT_FUNC "%6.2" "Grad C" COEFFS 0 1 0 0 0 5 /end COMPU_METHOD
/begin COMPU_METHOD temp_sb_b0p093 "" RAT_FUNC "%6.5" "Grad C" COEFFS 0 512 0 0 0 0.375 /end COMPU_METHOD
/begin COMPU_METHOD temp_sb_q0p75 "" RAT_FUNC "%6.3" "Grad C" COEFFS 0 1 0 0 0 0.75 /end COMPU_METHOD
/begin COMPU_METHOD temp_ub_q0p75_o48 "" RAT_FUNC "%6.2" "Grad C" COEFFS 0 1 48 0 0 0.75 /end COMPU_METHOD
/begin COMPU_METHOD temp_ub_q1_o60 "" RAT_FUNC "%6.2" "Grad C" COEFFS 0 1 60 0 0 1 /end COMPU_METHOD
/begin COMPU_METHOD temp_ub_q5_o50 "" RAT_FUNC "%6.2" "Grad C" COEFFS 0 1 50 0 0 5 /end COMPU_METHOD
/begin COMPU_METHOD temp_uw_q0p0195_o50 "" RAT_FUNC "%6.2" "Grad C" COEFFS 0 256 12800 0 0 5 /end COMPU_METHOD
/begin COMPU_METHOD tgrad_ub_b99p6 "" RAT_FUNC "%6.3" "ms/s" COEFFS 0 1 0 0 0 0.390625 /end COMPU_METHOD
/begin COMPU_METHOD tinjection_sy "" RAT_FUNC "%6.4" "ms" COEFFS 0 375 0 0 0 1 /end COMPU_METHOD
/begin COMPU_METHOD tsegment_sy "" RAT_FUNC "%6.5" "ms" COEFFS 0 1500 0 0 0 1 /end COMPU_METHOD
/begin COMPU_METHOD ttemp_q0p04 "" RAT_FUNC "%6.4" "s / Grad C" COEFFS 0 1 0 0 0 0.04 /end COMPU_METHOD
/begin COMPU_METHOD tv_sw_q0p005 "" RAT_FUNC "%6.4" "%" COEFFS 0 1 0 0 0 0.005 /end COMPU_METHOD
/begin COMPU_METHOD tv_ub_b100 "" RAT_FUNC "%6.3" "%" COEFFS 0 256 0 0 0 100 /end COMPU_METHOD
/begin COMPU_METHOD tv_ub_q0p64 "" RAT_FUNC "%6.3" "%" COEFFS 0 100 0 0 0 64 /end COMPU_METHOD
/begin COMPU_METHOD tv_uw_q0p005 "" RAT_FUNC "%6.4" "%" COEFFS 0 1 0 0 0 0.005 /end COMPU_METHOD
/begin COMPU_METHOD txms_ub_q0p1 "" RAT_FUNC "%6.3" "ms" COEFFS 0 10 0 0 0 1 /end COMPU_METHOD
/begin COMPU_METHOD tz10msxs_uw_b327p68 "" RAT_FUNC "%6.2" "s" COEFFS 0 0 327.68 0 1 0 /end COMPU_METHOD
/begin COMPU_METHOD t_min_q5p96em8 "" RAT_FUNC "%10.9" "Min" COEFFS 0 1 0 0 0 5.96e-008 /end COMPU_METHOD
/begin COMPU_METHOD uefktget_ub_b25p4 "" RAT_FUNC "%6.3" "" COEFFS 0 10 0 0 0 1 /end COMPU_METHOD
/begin COMPU_METHOD vfzg_sw_q0p00781 "" RAT_FUNC "%6.4" "km/h" COEFFS 0 1 0 0 0 0.0078125 /end COMPU_METHOD
/begin COMPU_METHOD vfzg_ub_q1p25 "" RAT_FUNC "%6.2" "km/h" COEFFS 0 1 0 0 0 1.25 /end COMPU_METHOD
/begin COMPU_METHOD vfzg_uw_b512 "" RAT_FUNC "%6.4" "km/h" COEFFS 0 65536 0 0 0 512 /end COMPU_METHOD
/begin COMPU_METHOD vfzg_uw_q0p0078125 "" RAT_FUNC "%6.4" "km/h" COEFFS 0 1 0 0 0 0.0078125 /end COMPU_METHOD
/begin COMPU_METHOD zk10msxs_uw_b655 "" RAT_FUNC "%12.5" "s" COEFFS 0 0 65536 0 100 0 /end COMPU_METHOD
/begin COMPU_METHOD zw_q0p1875 "" RAT_FUNC "%6.3" "Grad KW" COEFFS 0 1 0 0 0 0.1875 /end COMPU_METHOD
/begin COMPU_METHOD zw_sb_q0p75 "" RAT_FUNC "%6.3" "grad KW" COEFFS 0 255 0 0 0 191.25 /end COMPU_METHOD
/begin COMPU_METHOD zw_ub_q0p75 "" RAT_FUNC "%6.3" "Grad KW" COEFFS 0 255 0 0 0 191.25 /end COMPU_METHOD
/begin COMPU_METHOD zw_ub_qn0p75 "" RAT_FUNC "%6.4" "grad KW" COEFFS 0 1 0 0 0 -0.75 /end COMPU_METHOD
/begin COMPU_METHOD zw_uw_q0p75 "" RAT_FUNC "%6.3" "Grad KW" COEFFS 0 1 0 0 0 0.75 /end COMPU_METHOD
/begin RECORD_LAYOUT FklWUb FNC_VALUES 1 UBYTE COLUMN_DIR DIRECT /end RECORD_LAYOUT
/begin RECORD_LAYOUT GkfWSb FNC_VALUES 1 SBYTE COLUMN_DIR DIRECT /end RECORD_LAYOUT
/begin RECORD_LAYOUT GkfWSw FNC_VALUES 1 SWORD COLUMN_DIR DIRECT /end RECORD_LAYOUT
/begin RECORD_LAYOUT GkfWUb FNC_VALUES 1 UBYTE COLUMN_DIR DIRECT /end RECORD_LAYOUT
/begin RECORD_LAYOUT GkfWUw FNC_VALUES 1 UWORD COLUMN_DIR DIRECT /end RECORD_LAYOUT
/begin RECORD_LAYOUT GklWSb FNC_VALUES 1 SBYTE COLUMN_DIR DIRECT /end RECORD_LAYOUT
/begin RECORD_LAYOUT GklWSw FNC_VALUES 1 SWORD COLUMN_DIR DIRECT /end RECORD_LAYOUT
/begin RECORD_LAYOUT GklWUb FNC_VALUES 1 UBYTE COLUMN_DIR DIRECT /end RECORD_LAYOUT
/begin RECORD_LAYOUT GklWUw FNC_VALUES 1 UWORD COLUMN_DIR DIRECT /end RECORD_LAYOUT
/begin RECORD_LAYOUT KfAxSwAySwSstxSwSstySwWSw NO_AXIS_PTS_X 1 SWORD NO_AXIS_PTS_Y 2 SWORD AXIS_PTS_X 3 SWORD INDEX_INCR DIRECT AXIS_PTS_Y 4 SWORD INDEX_INCR DIRECT FNC_VALUES 5 SWORD COLUMN_DIR DIRECT /end RECORD_LAYOUT
/begin RECORD_LAYOUT KfAxUbAyUbSstxUbSstyUbWSb NO_AXIS_PTS_X 1 UBYTE NO_AXIS_PTS_Y 2 UBYTE AXIS_PTS_X 3 UBYTE INDEX_INCR DIRECT AXIS_PTS_Y 4 UBYTE INDEX_INCR DIRECT FNC_VALUES 5 SBYTE COLUMN_DIR DIRECT /end RECORD_LAYOUT
/begin RECORD_LAYOUT KfAxUbAyUbSstxUbSstyUbWUb NO_AXIS_PTS_X 1 UBYTE NO_AXIS_PTS_Y 2 UBYTE AXIS_PTS_X 3 UBYTE INDEX_INCR DIRECT AXIS_PTS_Y 4 UBYTE INDEX_INCR DIRECT FNC_VALUES 5 UBYTE COLUMN_DIR DIRECT /end RECORD_LAYOUT
/begin RECORD_LAYOUT KfAxUbAyUbSstxUbSstyUwWUb NO_AXIS_PTS_X 1 UBYTE NO_AXIS_PTS_Y 2 UBYTE AXIS_PTS_X 3 UBYTE INDEX_INCR DIRECT AXIS_PTS_Y 4 UWORD INDEX_INCR DIRECT FNC_VALUES 5 UBYTE COLUMN_DIR DIRECT /end RECORD_LAYOUT
/begin RECORD_LAYOUT KfAxUbAyUbSstxUbSstyUwWUw NO_AXIS_PTS_X 1 UBYTE NO_AXIS_PTS_Y 2 UBYTE AXIS_PTS_X 3 UBYTE INDEX_INCR DIRECT AXIS_PTS_Y 4 UWORD INDEX_INCR DIRECT FNC_VALUES 5 UWORD COLUMN_DIR DIRECT /end RECORD_LAYOUT
/begin RECORD_LAYOUT KfAxUbAyUbSstxUwSstyUbWUb NO_AXIS_PTS_X 1 UBYTE NO_AXIS_PTS_Y 2 UBYTE AXIS_PTS_X 3 UWORD INDEX_INCR DIRECT AXIS_PTS_Y 4 UBYTE INDEX_INCR DIRECT FNC_VALUES 5 UBYTE COLUMN_DIR DIRECT /end RECORD_LAYOUT
/begin RECORD_LAYOUT KfAxUwAyUwSstxSwSstyUwWUw NO_AXIS_PTS_X 1 UWORD NO_AXIS_PTS_Y 2 UWORD AXIS_PTS_X 3 SWORD INDEX_INCR DIRECT AXIS_PTS_Y 4 UWORD INDEX_INCR DIRECT FNC_VALUES 5 UWORD COLUMN_DIR DIRECT /end RECORD_LAYOUT
/begin RECORD_LAYOUT KfAxUwAyUwSstxUwSstyUwWUw NO_AXIS_PTS_X 1 UWORD NO_AXIS_PTS_Y 2 UWORD AXIS_PTS_X 3 UWORD INDEX_INCR DIRECT AXIS_PTS_Y 4 UWORD INDEX_INCR DIRECT FNC_VALUES 5 UWORD COLUMN_DIR DIRECT /end RECORD_LAYOUT
/begin RECORD_LAYOUT KlASwSstSwWSw NO_AXIS_PTS_X 1 SWORD AXIS_PTS_X 2 SWORD INDEX_INCR DIRECT FNC_VALUES 3 SWORD COLUMN_DIR DIRECT /end RECORD_LAYOUT
/begin RECORD_LAYOUT KlAUbSstSbWSb NO_AXIS_PTS_X 1 UBYTE AXIS_PTS_X 2 SBYTE INDEX_INCR DIRECT FNC_VALUES 3 SBYTE COLUMN_DIR DIRECT /end RECORD_LAYOUT
/begin RECORD_LAYOUT KlAUbSstUbWSb NO_AXIS_PTS_X 1 UBYTE AXIS_PTS_X 2 UBYTE INDEX_INCR DIRECT FNC_VALUES 3 SBYTE COLUMN_DIR DIRECT /end RECORD_LAYOUT
/begin RECORD_LAYOUT KlAUbSstUbWUb NO_AXIS_PTS_X 1 UBYTE AXIS_PTS_X 2 UBYTE INDEX_INCR DIRECT FNC_VALUES 3 UBYTE COLUMN_DIR DIRECT /end RECORD_LAYOUT
/begin RECORD_LAYOUT KlAUbSstUbWUw NO_AXIS_PTS_X 1 UBYTE AXIS_PTS_X 2 UBYTE INDEX_INCR DIRECT FNC_VALUES 3 UWORD COLUMN_DIR DIRECT /end RECORD_LAYOUT
/begin RECORD_LAYOUT KlAUwSstSwWUw NO_AXIS_PTS_X 1 UWORD AXIS_PTS_X 2 SWORD INDEX_INCR DIRECT FNC_VALUES 3 UWORD COLUMN_DIR DIRECT /end RECORD_LAYOUT
/begin RECORD_LAYOUT KlAUwSstUwWUb NO_AXIS_PTS_X 1 UWORD AXIS_PTS_X 2 UWORD INDEX_INCR DIRECT FNC_VALUES 3 UBYTE COLUMN_DIR DIRECT /end RECORD_LAYOUT
/begin RECORD_LAYOUT KlAUwSstUwWUw NO_AXIS_PTS_X 1 UWORD AXIS_PTS_X 2 UWORD INDEX_INCR DIRECT FNC_VALUES 3 UWORD COLUMN_DIR DIRECT /end RECORD_LAYOUT
/begin RECORD_LAYOUT KwbUb FNC_VALUES 1 UBYTE COLUMN_DIR DIRECT /end RECORD_LAYOUT
/begin RECORD_LAYOUT KwSb FNC_VALUES 1 SBYTE COLUMN_DIR DIRECT /end RECORD_LAYOUT
/begin RECORD_LAYOUT KwSw FNC_VALUES 1 SWORD COLUMN_DIR DIRECT /end RECORD_LAYOUT
/begin RECORD_LAYOUT KwUb FNC_VALUES 1 UBYTE COLUMN_DIR DIRECT /end RECORD_LAYOUT
/begin RECORD_LAYOUT KwUw FNC_VALUES 1 UWORD COLUMN_DIR DIRECT /end RECORD_LAYOUT
/begin RECORD_LAYOUT SstASwSstSw NO_AXIS_PTS_X 1 SWORD AXIS_PTS_X 2 SWORD INDEX_INCR DIRECT /end RECORD_LAYOUT
/begin RECORD_LAYOUT SstAUbSstSb NO_AXIS_PTS_X 1 UBYTE AXIS_PTS_X 2 SBYTE INDEX_INCR DIRECT /end RECORD_LAYOUT
/begin RECORD_LAYOUT SstAUbSstSw NO_AXIS_PTS_X 1 SWORD AXIS_PTS_X 2 SWORD INDEX_INCR DIRECT /end RECORD_LAYOUT
/begin RECORD_LAYOUT SstAUbSstUb NO_AXIS_PTS_X 1 UBYTE AXIS_PTS_X 2 UBYTE INDEX_INCR DIRECT /end RECORD_LAYOUT
/begin RECORD_LAYOUT SstAUbSstUw NO_AXIS_PTS_X 1 UWORD AXIS_PTS_X 2 UWORD INDEX_INCR DIRECT /end RECORD_LAYOUT
/begin RECORD_LAYOUT SstAUwSstUw NO_AXIS_PTS_X 1 UWORD AXIS_PTS_X 2 UWORD INDEX_INCR DIRECT /end RECORD_LAYOUT
/end MODULE
/end PROJECT
