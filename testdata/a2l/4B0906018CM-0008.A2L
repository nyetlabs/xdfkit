ASAP2_VERSION 1 3
/begin PROJECT X505P_24HG_1 "X505P"
/begin HEADER "" VERSION "X505P_24HG_1" PROJECT_NO X505P_24HG_1 /end HEADER
/begin MODULE DIM ""
/begin MOD_COMMON "" BYTE_ORDER MSB_LAST ALIGNMENT_BYTE 1 ALIGNMENT_WORD 2 ALIGNMENT_LONG 2 /end MOD_COMMON
/begin CHARACTERISTIC ADRONLOGIN "Logincode zum Aktivieren ADR" VALUE 0x815CB8 KwUw 65535.00 dez 0.00 65535.00 FORMAT "%8.2" /end CHARACTERISTIC
/begin CHARACTERISTIC AGR_AOG "oberer Grenzwert Anpassung AGR-Rate" VALUE 0x81158C KwUb 1.992 fak_ub_b2 0.00 1.992 FORMAT "%5.3" /end CHARACTERISTIC
/begin CHARACTERISTIC AGR_AUG "unterer Grenzwert Anpassung AGR-Rate" VALUE 0x81158D KwUb 1.992 fak_ub_b2 0.00 1.992 FORMAT "%5.3" /end CHARACTERISTIC
/begin CHARACTERISTIC ANRZUEMX "Zündungszähler-Schwelle bis zu der STADAP aktiv" VALUE 0x8110A8 KwUb 255.0 dez 0.00 255.0 FORMAT "%5.1" /end CHARACTERISTIC
/begin CHARACTERISTIC BACC_T_UM "Fehlerentprellung: Fehler in Botschaftsabsicherung der ACC-Botschaft" VALUE 0x814003 KwUb 10200.0 t40ms_ub_b10200 0.00 10200.0 FORMAT "%7.1" /end CHARACTERISTIC
/begin CHARACTERISTIC BGRA_T_UM "Fehlerentprellung: Botschaftsfehler GRA" VALUE 0x814006 KwUb 10200.0 t40ms_ub_b10200 0.00 10200.0 FORMAT "%7.1" /end CHARACTERISTIC
/begin CHARACTERISTIC BRACC_T_UM "Entprellzeit für betätigte Bremse in der Funktionsüberwachung für ACC" VALUE 0x814007 KwUb 10200.0 t40ms_ub_b10200 0.00 10200.0 FORMAT "%7.1" /end CHARACTERISTIC
/begin CHARACTERISTIC BREMS_T_UM "Entprellzeit für betätigte Bremse in der Funktionsüberwachung" VALUE 0x814008 KwUb 10200.0 t40ms_ub_b10200 0.00 10200.0 FORMAT "%7.1" /end CHARACTERISTIC
/begin CHARACTERISTIC BRESP_T_UM "Entprellzeit für betätigte Bremse in der Funktionsüberw. (ext. Bremseingriff)" VALUE 0x814009 KwUb 10200.0 t40ms_ub_b10200 0.00 10200.0 FORMAT "%7.1" /end CHARACTERISTIC
/begin CHARACTERISTIC BZ_MSR_UM "" VALUE 0x814077 KwUb 255.0 dez 0.00 255.0 FORMAT "%5.1" /end CHARACTERISTIC
/begin CHARACTERISTIC CNSDEF "Codewort für Solldrehzahlumschaltung (Defaultwert)" VALUE 0x81158E KwUb 255.0 dez 0.00 255.0 FORMAT "%5.1" /end CHARACTERISTIC
/begin CHARACTERISTIC CNS_AOG "oberer Grenzwert Anpassung Codewort LL-Solldrehzahl-Umsch." VALUE 0x81158F KwUb 255.0 dez 0.00 255.0 FORMAT "%5.1" /end CHARACTERISTIC
/begin CHARACTERISTIC CNS_AUG "unterer Grenzwert Anpassung Codewort LL-Solldrehzahl-Umsch." VALUE 0x811590 KwUb 255.0 dez 0.00 255.0 FORMAT "%5.1" /end CHARACTERISTIC
/begin CHARACTERISTIC CWFA107 "Codewort Kurztripanforderungen Anzeigegruppe 107" VALUE 0x81EB9A KwUw 65535.00 dez 0.00 65535.00 FORMAT "%8.2" /end CHARACTERISTIC
/begin CHARACTERISTIC CWFA107A "Ergänzung Codewort Kurztripanforderungen Anzeigegruppe 107" VALUE 0x81EB9C KwUw 65535.00 dez 0.00 65535.00 FORMAT "%8.2" /end CHARACTERISTIC
/begin CHARACTERISTIC CWFA108 "Codewort Kurztripanforderungen Anzeigegruppe 108" VALUE 0x81EB9E KwUw 65535.00 dez 0.00 65535.00 FORMAT "%8.2" /end CHARACTERISTIC
/begin CHARACTERISTIC CWFA108A "Ergänzung Codewort Kurztripanforderungen Anzeigegruppe 108" VALUE 0x81EBA0 KwUw 65535.00 dez 0.00 65535.00 FORMAT "%8.2" /end CHARACTERISTIC
/begin CHARACTERISTIC CWFA109 "Codewort Kurztripanforderungen Anzeigegruppe 109" VALUE 0x81EBA2 KwUw 65535.00 dez 0.00 65535.00 FORMAT "%8.2" /end CHARACTERISTIC
/begin CHARACTERISTIC CWFA109A "Ergänzung Codewort Kurztripanforderungen Anzeigegruppe 109" VALUE 0x81EBA4 KwUw 65535.00 dez 0.00 65535.00 FORMAT "%8.2" /end CHARACTERISTIC
/begin CHARACTERISTIC CWFA130 "Codewort Kurztripanforderungen Anzeigegruppe 130" VALUE 0x81EBA6 KwUw 65535.00 dez 0.00 65535.00 FORMAT "%8.2" /end CHARACTERISTIC
/begin CHARACTERISTIC CWFA130A "Ergänzung Codewort Kurztripanforderungen Anzeigegruppe 130" VALUE 0x81EBA8 KwUw 65535.00 dez 0.00 65535.00 FORMAT "%8.2" /end CHARACTERISTIC
/begin CHARACTERISTIC CWFA140 "Codewort Kurztripanforderungen Anzeigegruppe 140" VALUE 0x81EBAA KwUw 65535.00 dez 0.00 65535.00 FORMAT "%8.2" /end CHARACTERISTIC
/begin CHARACTERISTIC CWFA140A "Ergänzung Codewort Kurztripanforderungen Anzeigegruppe 140" VALUE 0x81EBAC KwUw 65535.00 dez 0.00 65535.00 FORMAT "%8.2" /end CHARACTERISTIC
/begin CHARACTERISTIC CWFA145 "Codewort Kurztripanforderungen Anzeigegruppe 145" VALUE 0x81EBAE KwUw 65535.00 dez 0.00 65535.00 FORMAT "%8.2" /end CHARACTERISTIC
/begin CHARACTERISTIC CWFA145A "Ergänzung Codewort Kurztripanforderungen Anzeigegruppe 145" VALUE 0x81EBB0 KwUw 65535.00 dez 0.00 65535.00 FORMAT "%8.2" /end CHARACTERISTIC
/begin CHARACTERISTIC CWFA146 "Codewort Kurztripanforderungen Anzeigegruppe 146" VALUE 0x81EBB2 KwUw 65535.00 dez 0.00 65535.00 FORMAT "%8.2" /end CHARACTERISTIC
/begin CHARACTERISTIC CWFA146A "Ergänzung Codewort Kurztripanforderungen Anzeigegruppe 146" VALUE 0x81EBB4 KwUw 65535.00 dez 0.00 65535.00 FORMAT "%8.2" /end CHARACTERISTIC
/begin CHARACTERISTIC CWFA147 "Codewort Kurztripanforderungen Anzeigegruppe 147" VALUE 0x81EBB6 KwUw 65535.00 dez 0.00 65535.00 FORMAT "%8.2" /end CHARACTERISTIC
/begin CHARACTERISTIC CWFA147A "Ergänzung Codewort Kurztripanforderungen Anzeigegruppe 147" VALUE 0x81EBB8 KwUw 65535.00 dez 0.00 65535.00 FORMAT "%8.2" /end CHARACTERISTIC
/begin CHARACTERISTIC CWFA152 "Codewort Kurztripanforderungen Anzeigegruppe 152" VALUE 0x81EBBA KwUw 65535.00 dez 0.00 65535.00 FORMAT "%8.2" /end CHARACTERISTIC
/begin CHARACTERISTIC CWFA152A "Ergänzung Codewort Kurztripanforderungen Anzeigegruppe 152" VALUE 0x81EBBC KwUw 65535.00 dez 0.00 65535.00 FORMAT "%8.2" /end CHARACTERISTIC
/begin CHARACTERISTIC CWFA162 "Codewort Kurztripanforderungen Anzeigegruppe 162" VALUE 0x81EBBE KwUw 65535.00 dez 0.00 65535.00 FORMAT "%8.2" /end CHARACTERISTIC
/begin CHARACTERISTIC CWFA162A "Ergänzung Codewort Kurztripanforderungen Anzeigegruppe 162" VALUE 0x81EBC0 KwUw 65535.00 dez 0.00 65535.00 FORMAT "%8.2" /end CHARACTERISTIC
/begin CHARACTERISTIC CWFA163 "Codewort Kurztripanforderungen Anzeigegruppe 163" VALUE 0x81EBC2 KwUw 65535.00 dez 0.00 65535.00 FORMAT "%8.2" /end CHARACTERISTIC
/begin CHARACTERISTIC CWFA163A "Ergänzung Codewort Kurztripanforderungen Anzeigegruppe 163" VALUE 0x81EBC4 KwUw 65535.00 dez 0.00 65535.00 FORMAT "%8.2" /end CHARACTERISTIC
/begin CHARACTERISTIC CWFA190 "Codewort Kurztripanforderungen Anzeigegruppe 190" VALUE 0x81EBC6 KwUw 65535.00 dez 0.00 65535.00 FORMAT "%8.2" /end CHARACTERISTIC
/begin CHARACTERISTIC CWFA190A "Ergänzung Codewort Kurztripanforderungen Anzeigegruppe 190" VALUE 0x81EBC8 KwUw 65535.00 dez 0.00 65535.00 FORMAT "%8.2" /end CHARACTERISTIC
/begin CHARACTERISTIC CWFA191 "Codewort Kurztripanforderungen Anzeigegruppe 191" VALUE 0x81EBCA KwUw 65535.00 dez 0.00 65535.00 FORMAT "%8.2" /end CHARACTERISTIC
/begin CHARACTERISTIC CWFA191A "Ergänzung Codewort Kurztripanforderungen Anzeigegruppe 191" VALUE 0x81EBCC KwUw 65535.00 dez 0.00 65535.00 FORMAT "%8.2" /end CHARACTERISTIC
/begin CHARACTERISTIC CWFA192 "Codewort Kurztripanforderungen Anzeigegruppe 192" VALUE 0x81EBCE KwUw 65535.00 dez 0.00 65535.00 FORMAT "%8.2" /end CHARACTERISTIC
/begin CHARACTERISTIC CWFA192A "Ergänzung Codewort Kurztripanforderungen Anzeigegruppe 192" VALUE 0x81EBD0 KwUw 65535.00 dez 0.00 65535.00 FORMAT "%8.2" /end CHARACTERISTIC
/begin CHARACTERISTIC CWFA193 "Codewort Kurztripanforderungen Anzeigegruppe 193" VALUE 0x81EBD2 KwUw 65535.00 dez 0.00 65535.00 FORMAT "%8.2" /end CHARACTERISTIC
/begin CHARACTERISTIC CWFA193A "Ergänzung Codewort Kurztripanforderungen Anzeigegruppe 193" VALUE 0x81EBD4 KwUw 65535.00 dez 0.00 65535.00 FORMAT "%8.2" /end CHARACTERISTIC
/begin CHARACTERISTIC CWFA194 "Codewort Kurztripanforderungen Anzeigegruppe 194" VALUE 0x81EBD6 KwUw 65535.00 dez 0.00 65535.00 FORMAT "%8.2" /end CHARACTERISTIC
/begin CHARACTERISTIC CWFA194A "Ergänzung Codewort Kurztripanforderungen Anzeigegruppe 194" VALUE 0x81EBD8 KwUw 65535.00 dez 0.00 65535.00 FORMAT "%8.2" /end CHARACTERISTIC
/begin CHARACTERISTIC CWFA195 "Codewort Kurztripanforderungen Anzeigegruppe 195" VALUE 0x81EBDA KwUw 65535.00 dez 0.00 65535.00 FORMAT "%8.2" /end CHARACTERISTIC
/begin CHARACTERISTIC CWFA195A "Ergänzung Codewort Kurztripanforderungen Anzeigegruppe 195" VALUE 0x81EBDC KwUw 65535.00 dez 0.00 65535.00 FORMAT "%8.2" /end CHARACTERISTIC
/begin CHARACTERISTIC CWFA196 "Codewort Kurztripanforderungen Anzeigegruppe 196" VALUE 0x81EBDE KwUw 65535.00 dez 0.00 65535.00 FORMAT "%8.2" /end CHARACTERISTIC
/begin CHARACTERISTIC CWFA196A "Ergänzung Codewort Kurztripanforderungen Anzeigegruppe 196" VALUE 0x81EBE0 KwUw 65535.00 dez 0.00 65535.00 FORMAT "%8.2" /end CHARACTERISTIC
/begin CHARACTERISTIC CWFA197 "Codewort Kurztripanforderungen Anzeigegruppe 197" VALUE 0x81EBE2 KwUw 65535.00 dez 0.00 65535.00 FORMAT "%8.2" /end CHARACTERISTIC
/begin CHARACTERISTIC CWFA197A "Ergänzung Codewort Kurztripanforderungen Anzeigegruppe 197" VALUE 0x81EBE4 KwUw 65535.00 dez 0.00 65535.00 FORMAT "%8.2" /end CHARACTERISTIC
/begin CHARACTERISTIC CWFA198 "Codewort Kurztripanforderungen Anzeigegruppe 198" VALUE 0x81EBE6 KwUw 65535.00 dez 0.00 65535.00 FORMAT "%8.2" /end CHARACTERISTIC
/begin CHARACTERISTIC CWFA198A "Ergänzung Codewort Kurztripanforderungen Anzeigegruppe 198" VALUE 0x81EBE8 KwUw 65535.00 dez 0.00 65535.00 FORMAT "%8.2" /end CHARACTERISTIC
/begin CHARACTERISTIC CWFA199 "Codewort Kurztripanforderungen Anzeigegruppe 199" VALUE 0x81EBEA KwUw 65535.00 dez 0.00 65535.00 FORMAT "%8.2" /end CHARACTERISTIC
/begin CHARACTERISTIC CWFA199A "Ergänzung Codewort Kurztripanforderungen Anzeigegruppe 199" VALUE 0x81EBEC KwUw 65535.00 dez 0.00 65535.00 FORMAT "%8.2" /end CHARACTERISTIC
/begin CHARACTERISTIC CWFA201 "Codewort Kurztripanforderung Anzeigegruppe 201" VALUE 0x81EBEE KwUw 65535.00 dez 0.00 65535.00 FORMAT "%8.2" /end CHARACTERISTIC
/begin CHARACTERISTIC CWFA201A "Ergänzung Codewort Kurztripanforderungen Anzeigegruppe 201" VALUE 0x81EBF0 KwUw 65535.00 dez 0.00 65535.00 FORMAT "%8.2" /end CHARACTERISTIC
/begin CHARACTERISTIC CWFA202 "Codewort Kurztripanforderung Anzeigegruppe 202" VALUE 0x81EBF2 KwUw 65535.00 dez 0.00 65535.00 FORMAT "%8.2" /end CHARACTERISTIC
/begin CHARACTERISTIC CWFA202A "Ergänzung Codewort Kurztripanforderungen Anzeigegruppe 202" VALUE 0x81EBF4 KwUw 65535.00 dez 0.00 65535.00 FORMAT "%8.2" /end CHARACTERISTIC
/begin CHARACTERISTIC CWFA203 "Codewort Kurztripanforderung Anzeigegruppe 203" VALUE 0x81EBF6 KwUw 65535.00 dez 0.00 65535.00 FORMAT "%8.2" /end CHARACTERISTIC
/begin CHARACTERISTIC CWFA203A "Ergänzung Codewort Kurztripanforderungen Anzeigegruppe 203" VALUE 0x81EBF8 KwUw 65535.00 dez 0.00 65535.00 FORMAT "%8.2" /end CHARACTERISTIC
/begin CHARACTERISTIC CWFA204 "Codewort Kurztripanforderung Anzeigegruppe 204" VALUE 0x81EBFA KwUw 65535.00 dez 0.00 65535.00 FORMAT "%8.2" /end CHARACTERISTIC
/begin CHARACTERISTIC CWFA204A "Ergänzung Codewort Kurztripanforderungen Anzeigegruppe 204" VALUE 0x81EBFC KwUw 65535.00 dez 0.00 65535.00 FORMAT "%8.2" /end CHARACTERISTIC
/begin CHARACTERISTIC CWFA205 "Codewort Kurztripanforderung Anzeigegruppe 205" VALUE 0x81EBFE KwUw 65535.00 dez 0.00 65535.00 FORMAT "%8.2" /end CHARACTERISTIC
/begin CHARACTERISTIC CWFA205A "Ergänzung Codewort Kurztripanforderungen Anzeigegruppe 205" VALUE 0x81EC00 KwUw 65535.00 dez 0.00 65535.00 FORMAT "%8.2" /end CHARACTERISTIC
/begin CHARACTERISTIC CWFA206 "Codewort Kurztripanforderung Anzeigegruppe 206" VALUE 0x81EC02 KwUw 65535.00 dez 0.00 65535.00 FORMAT "%8.2" /end CHARACTERISTIC
/begin CHARACTERISTIC CWFA206A "Ergänzung Codewort Kurztripanforderungen Anzeigegruppe 206" VALUE 0x81EC04 KwUw 65535.00 dez 0.00 65535.00 FORMAT "%8.2" /end CHARACTERISTIC
/begin CHARACTERISTIC CWFA207 "Codewort Kurztripanforderung Anzeigegruppe 207" VALUE 0x81EC06 KwUw 65535.00 dez 0.00 65535.00 FORMAT "%8.2" /end CHARACTERISTIC
/begin CHARACTERISTIC CWFA207A "Ergänzung Codewort Kurztripanforderungen Anzeigegruppe 207" VALUE 0x81EC08 KwUw 65535.00 dez 0.00 65535.00 FORMAT "%8.2" /end CHARACTERISTIC
/begin CHARACTERISTIC CWFA208 "Codewort Kurztripanforderung Anzeigegruppe 208" VALUE 0x81EC0A KwUw 65535.00 dez 0.00 65535.00 FORMAT "%8.2" /end CHARACTERISTIC
/begin CHARACTERISTIC CWFA208A "Ergänzung Codewort Kurztripanforderungen Anzeigegruppe 208" VALUE 0x81EC0C KwUw 65535.00 dez 0.00 65535.00 FORMAT "%8.2" /end CHARACTERISTIC
/begin CHARACTERISTIC CWFA209 "Codewort Kurztripanforderung Anzeigegruppe 209" VALUE 0x81EC0E KwUw 65535.00 dez 0.00 65535.00 FORMAT "%8.2" /end CHARACTERISTIC
/begin CHARACTERISTIC CWFA209A "Ergänzung Codewort Kurztripanforderungen Anzeigegruppe 209" VALUE 0x81EC10 KwUw 65535.00 dez 0.00 65535.00 FORMAT "%8.2" /end CHARACTERISTIC
/begin CHARACTERISTIC CWFA210 "Codewort Kurztripanforderung Anzeigegruppe 210" VALUE 0x81EC12 KwUw 65535.00 dez 0.00 65535.00 FORMAT "%8.2" /end CHARACTERISTIC
/begin CHARACTERISTIC CWFA210A "Ergänzung Codewort Kurztripanforderungen Anzeigegruppe 210" VALUE 0x81EC14 KwUw 65535.00 dez 0.00 65535.00 FORMAT "%8.2" /end CHARACTERISTIC
/begin CHARACTERISTIC CWFA211 "Codewort Kurztripanforderung Anzeigegruppe 211" VALUE 0x81EC16 KwUw 65535.00 dez 0.00 65535.00 FORMAT "%8.2" /end CHARACTERISTIC
/begin CHARACTERISTIC CWFA211A "Ergänzung Codewort Kurztripanforderungen Anzeigegruppe 211" VALUE 0x81EC18 KwUw 65535.00 dez 0.00 65535.00 FORMAT "%8.2" /end CHARACTERISTIC
/begin CHARACTERISTIC CWFA212 "Codewort Kurztripanforderung Anzeigegruppe 212" VALUE 0x81EC1A KwUw 65535.00 dez 0.00 65535.00 FORMAT "%8.2" /end CHARACTERISTIC
/begin CHARACTERISTIC CWFA212A "Ergänzung Codewort Kurztripanforderungen Anzeigegruppe 212" VALUE 0x81EC1C KwUw 65535.00 dez 0.00 65535.00 FORMAT "%8.2" /end CHARACTERISTIC
/begin CHARACTERISTIC CWFA213 "Codewort Kurtripanforderung Anzeigegruppe 213" VALUE 0x81EC1E KwUw 65535.00 dez 0.00 65535.00 FORMAT "%8.2" /end CHARACTERISTIC
/begin CHARACTERISTIC CWFA213A "Ergänzung Codewort Kurztripanforderungen Anzeigegruppe 213" VALUE 0x81EC20 KwUw 65535.00 dez 0.00 65535.00 FORMAT "%8.2" /end CHARACTERISTIC
/begin CHARACTERISTIC CWFA214 "Codewort Kurztripanforderung Anzeigegruppe 214" VALUE 0x81EC22 KwUw 65535.00 dez 0.00 65535.00 FORMAT "%8.2" /end CHARACTERISTIC
/begin CHARACTERISTIC CWFA214A "Ergänzung Codewort Kurztripanforderungen Anzeigegruppe 214" VALUE 0x81EC24 KwUw 65535.00 dez 0.00 65535.00 FORMAT "%8.2" /end CHARACTERISTIC
/begin CHARACTERISTIC CWFA215 "Codewort Kurztripanforderung Anzeigegruppe 215" VALUE 0x81EC26 KwUw 65535.00 dez 0.00 65535.00 FORMAT "%8.2" /end CHARACTERISTIC
/begin CHARACTERISTIC CWFA215A "Ergänzung Codewort Kurztripanforderungen Anzeigegruppe 215" VALUE 0x81EC28 KwUw 65535.00 dez 0.00 65535.00 FORMAT "%8.2" /end CHARACTERISTIC
/begin CHARACTERISTIC CWFA216 "Codewort Kurztripanforderung Anzeigegruppe 216" VALUE 0x81EC2A KwUw 65535.00 dez 0.00 65535.00 FORMAT "%8.2" /end CHARACTERISTIC
/begin CHARACTERISTIC CWFA216A "Ergänzung Codewort Kurztripanforderungen Anzeigegruppe 216" VALUE 0x81EC2C KwUw 65535.00 dez 0.00 65535.00 FORMAT "%8.2" /end CHARACTERISTIC
/begin CHARACTERISTIC CWFA217 "Codewort Kurztripanforderung Anzeigegruppe 217" VALUE 0x81EC2E KwUw 65535.00 dez 0.00 65535.00 FORMAT "%8.2" /end CHARACTERISTIC
/begin CHARACTERISTIC CWFA217A "Ergänzung Codewort Kurztripanforderungen Anzeigegruppe 217" VALUE 0x81EC30 KwUw 65535.00 dez 0.00 65535.00 FORMAT "%8.2" /end CHARACTERISTIC
/begin CHARACTERISTIC CWFA218 "Codewort Kurztripanforderung Anzeigegruppe 218" VALUE 0x81EC32 KwUw 65535.00 dez 0.00 65535.00 FORMAT "%8.2" /end CHARACTERISTIC
/begin CHARACTERISTIC CWFA218A "Ergänzung Codewort Kurztripanforderungen Anzeigegruppe 218" VALUE 0x81EC34 KwUw 65535.00 dez 0.00 65535.00 FORMAT "%8.2" /end CHARACTERISTIC
/begin CHARACTERISTIC CWFA219 "Codewort Kurztripanforderung Anzeigegruppe 219" VALUE 0x81EC36 KwUw 65535.00 dez 0.00 65535.00 FORMAT "%8.2" /end CHARACTERISTIC
/begin CHARACTERISTIC CWFA219A "Ergänzung Codewort Kurztripanforderungen Anzeigegruppe 219" VALUE 0x81EC38 KwUw 65535.00 dez 0.00 65535.00 FORMAT "%8.2" /end CHARACTERISTIC
/begin CHARACTERISTIC CWFA220 "Codewort Kurztripanforderung Anzeigegruppe 220" VALUE 0x81EC3A KwUw 65535.00 dez 0.00 65535.00 FORMAT "%8.2" /end CHARACTERISTIC
/begin CHARACTERISTIC CWFA220A "Ergänzung Codewort Kurztripanforderung Anzeigegruppe 220A" VALUE 0x81EC3C KwUw 65535.00 dez 0.00 65535.00 FORMAT "%8.2" /end CHARACTERISTIC
/begin CHARACTERISTIC CWFA221 "Codewort Kurztripanforderung Anzeigegruppe 221" VALUE 0x81EC3E KwUw 65535.00 dez 0.00 65535.00 FORMAT "%8.2" /end CHARACTERISTIC
/begin CHARACTERISTIC CWFA221A "Ergänzung Codewort Kurztripanforderung Anzeigegruppe 2221A" VALUE 0x81EC40 KwUw 65535.00 dez 0.00 65535.00 FORMAT "%8.2" /end CHARACTERISTIC
/begin CHARACTERISTIC CWFA222 "Codewort Kurztripanforderung Anzeigegruppe 222" VALUE 0x81EC42 KwUw 65535.00 dez 0.00 65535.00 FORMAT "%8.2" /end CHARACTERISTIC
/begin CHARACTERISTIC CWFA222A "Ergänzung Codewort Kurztripanforderung Anzeigegruppe 222A" VALUE 0x81EC44 KwUw 65535.00 dez 0.00 65535.00 FORMAT "%8.2" /end CHARACTERISTIC
/begin CHARACTERISTIC CWFA223 "Codewort Kurztripanforderung Anzeigegruppe 223" VALUE 0x81EC46 KwUw 65535.00 dez 0.00 65535.00 FORMAT "%8.2" /end CHARACTERISTIC
/begin CHARACTERISTIC CWFA223A "Ergänzung Codewort Kurztripanforderung Anzeigegruppe 223A" VALUE 0x81EC48 KwUw 65535.00 dez 0.00 65535.00 FORMAT "%8.2" /end CHARACTERISTIC
/begin CHARACTERISTIC CWFA224 "Codewort Kurztripanforderung Anzeigegruppe 224" VALUE 0x81EC4A KwUw 65535.00 dez 0.00 65535.00 FORMAT "%8.2" /end CHARACTERISTIC
/begin CHARACTERISTIC CWFA224A "Ergänzung Codewort Kurztripanforderung Anzeigegruppe 224A" VALUE 0x81EC4C KwUw 65535.00 dez 0.00 65535.00 FORMAT "%8.2" /end CHARACTERISTIC
/begin CHARACTERISTIC CWFA225 "Codewort Kurztripanforderung Anzeigegruppe 225" VALUE 0x81EC4E KwUw 65535.00 dez 0.00 65535.00 FORMAT "%8.2" /end CHARACTERISTIC
/begin CHARACTERISTIC CWFA225A "Ergänzung Codewort Kurztripanforderung Anzeigegruppe 225A" VALUE 0x81EC50 KwUw 65535.00 dez 0.00 65535.00 FORMAT "%8.2" /end CHARACTERISTIC
/begin CHARACTERISTIC CWFA226 "Codewort Kurztripanforderung Anzeigegruppe 226" VALUE 0x81EC52 KwUw 65535.00 dez 0.00 65535.00 FORMAT "%8.2" /end CHARACTERISTIC
/begin CHARACTERISTIC CWFA226A "Ergänzung Codewort Kurztripanforderung Anzeigegruppe 226A" VALUE 0x81EC54 KwUw 65535.00 dez 0.00 65535.00 FORMAT "%8.2" /end CHARACTERISTIC
/begin CHARACTERISTIC CWFA227 "Codewort Kurztripanforderung Anzeigegruppe 227" VALUE 0x81EC56 KwUw 65535.00 dez 0.00 65535.00 FORMAT "%8.2" /end CHARACTERISTIC
/begin CHARACTERISTIC CWFA227A "Ergänzung Codewort Kurztripanforderung Anzeigegruppe 227A" VALUE 0x81EC58 KwUw 65535.00 dez 0.00 65535.00 FORMAT "%8.2" /end CHARACTERISTIC
/begin CHARACTERISTIC CWFA228 "Codewort Kurztripanforderung Anzeigegruppe 228" VALUE 0x81EC5A KwUw 65535.00 dez 0.00 65535.00 FORMAT "%8.2" /end CHARACTERISTIC
/begin CHARACTERISTIC CWFA228A "Ergänzung Codewort Kurztripanforderung Anzeigegruppe 228A" VALUE 0x81EC5C KwUw 65535.00 dez 0.00 65535.00 FORMAT "%8.2" /end CHARACTERISTIC
/begin CHARACTERISTIC CWFA229 "Codewort Kurztripanforderung Anzeigegruppe 229" VALUE 0x81EC5E KwUw 65535.00 dez 0.00 65535.00 FORMAT "%8.2" /end CHARACTERISTIC
/begin CHARACTERISTIC CWFA229A "Ergänzung Codewort Kurztripanforderung Anzeigegruppe 229A" VALUE 0x81EC60 KwUw 65535.00 dez 0.00 65535.00 FORMAT "%8.2" /end CHARACTERISTIC
/begin CHARACTERISTIC CWFA230 "Codewort Kurztripanforderung Anzeigegruppe 230" VALUE 0x81EC62 KwUw 65535.00 dez 0.00 65535.00 FORMAT "%8.2" /end CHARACTERISTIC
/begin CHARACTERISTIC CWFA230A "Ergänzung Codewort Kurztripanforderung Anzeigegruppe 230A" VALUE 0x81EC64 KwUw 65535.00 dez 0.00 65535.00 FORMAT "%8.2" /end CHARACTERISTIC
/begin CHARACTERISTIC CWFA231 "Codewort Kurztripanforderung Anzeigegruppe 231" VALUE 0x81EC66 KwUw 65535.00 dez 0.00 65535.00 FORMAT "%8.2" /end CHARACTERISTIC
/begin CHARACTERISTIC CWFA231A "Ergänzung Codewort Kurztripanforderung Anzeigegruppe 231A" VALUE 0x81EC68 KwUw 65535.00 dez 0.00 65535.00 FORMAT "%8.2" /end CHARACTERISTIC
/begin CHARACTERISTIC CWFA232 "Codewort Kurztripanforderung Anzeigegruppe 232" VALUE 0x81EC6A KwUw 65535.00 dez 0.00 65535.00 FORMAT "%8.2" /end CHARACTERISTIC
/begin CHARACTERISTIC CWFA232A "Ergänzung Codewort Kurztripanforderung Anzeigegruppe 232A" VALUE 0x81EC6C KwUw 65535.00 dez 0.00 65535.00 FORMAT "%8.2" /end CHARACTERISTIC
/begin CHARACTERISTIC CWFA233 "Codewort Kurztripanforderung Anzeigegruppe 233" VALUE 0x81EC6E KwUw 65535.00 dez 0.00 65535.00 FORMAT "%8.2" /end CHARACTERISTIC
/begin CHARACTERISTIC CWFA233A "Ergänzung Codewort Kurztripanforderung Anzeigegruppe 233A" VALUE 0x81EC70 KwUw 65535.00 dez 0.00 65535.00 FORMAT "%8.2" /end CHARACTERISTIC
/begin CHARACTERISTIC CWFA234 "Codewort Kurztripanforderung Anzeigegruppe 234" VALUE 0x81EC72 KwUw 65535.00 dez 0.00 65535.00 FORMAT "%8.2" /end CHARACTERISTIC
/begin CHARACTERISTIC CWFA234A "Ergänzung Codewort Kurztripanforderung Anzeigegruppe 234A" VALUE 0x81EC74 KwUw 65535.00 dez 0.00 65535.00 FORMAT "%8.2" /end CHARACTERISTIC
/begin CHARACTERISTIC CWFA235 "Codewort Kurztripanforderung Anzeigegruppe 235" VALUE 0x81EC76 KwUw 65535.00 dez 0.00 65535.00 FORMAT "%8.2" /end CHARACTERISTIC
/begin CHARACTERISTIC CWFA235A "Ergänzung Codewort Kurztripanforderung Anzeigegruppe 235A" VALUE 0x81EC78 KwUw 65535.00 dez 0.00 65535.00 FORMAT "%8.2" /end CHARACTERISTIC
/begin CHARACTERISTIC CWFA236 "Codewort Kurztripanforderung Anzeigegruppe 236" VALUE 0x81EC7A KwUw 65535.00 dez 0.00 65535.00 FORMAT "%8.2" /end CHARACTERISTIC
/begin CHARACTERISTIC CWFA236A "Ergänzung Codewort Kurztripanforderung Anzeigegruppe 236A" VALUE 0x81EC7C KwUw 65535.00 dez 0.00 65535.00 FORMAT "%8.2" /end CHARACTERISTIC
/begin CHARACTERISTIC CWFA237 "Codewort Kurztripanforderung Anzeigegruppe 237" VALUE 0x81EC7E KwUw 65535.00 dez 0.00 65535.00 FORMAT "%8.2" /end CHARACTERISTIC
/begin CHARACTERISTIC CWFA237A "Ergänzung Codewort Kurztripanforderung Anzeigegruppe 237A" VALUE 0x81EC80 KwUw 65535.00 dez 0.00 65535.00 FORMAT "%8.2" /end CHARACTERISTIC
/begin CHARACTERISTIC CWFA238 "Codewort Kurztripanforderung Anzeigegruppe 238" VALUE 0x81EC82 KwUw 65535.00 dez 0.00 65535.00 FORMAT "%8.2" /end CHARACTERISTIC
/begin CHARACTERISTIC CWFA238A "Ergänzung Codewort Kurztripanforderung Anzeigegruppe 238A" VALUE 0x81EC84 KwUw 65535.00 dez 0.00 65535.00 FORMAT "%8.2" /end CHARACTERISTIC
/begin CHARACTERISTIC CWFA239 "Codewort Kurztripanforderung Anzeigegruppe 239" VALUE 0x81EC86 KwUw 65535.00 dez 0.00 65535.00 FORMAT "%8.2" /end CHARACTERISTIC
/begin CHARACTERISTIC CWFA239A "Ergänzung Codewort Kurztripanforderung Anzeigegruppe 239A" VALUE 0x81EC88 KwUw 65535.00 dez 0.00 65535.00 FORMAT "%8.2" /end CHARACTERISTIC
/begin CHARACTERISTIC CWFA240 "Codewort Kurztripanforderung Anzeigegruppe 240" VALUE 0x81EC8A KwUw 65535.00 dez 0.00 65535.00 FORMAT "%8.2" /end CHARACTERISTIC
/begin CHARACTERISTIC CWFA240A "Ergänzung Codewort Kurztripanforderung Anzeigegruppe 240A" VALUE 0x81EC8C KwUw 65535.00 dez 0.00 65535.00 FORMAT "%8.2" /end CHARACTERISTIC
/begin CHARACTERISTIC CWFA241 "Codewort Kurztripanforderung Anzeigegruppe 241" VALUE 0x81EC8E KwUw 65535.00 dez 0.00 65535.00 FORMAT "%8.2" /end CHARACTERISTIC
/begin CHARACTERISTIC CWFA241A "Ergänzung Codewort Kurztripanforderung Anzeigegruppe 241A" VALUE 0x81EC90 KwUw 65535.00 dez 0.00 65535.00 FORMAT "%8.2" /end CHARACTERISTIC
/begin CHARACTERISTIC CWFA242 "Codewort Kurztripanforderung Anzeigegruppe 242" VALUE 0x81EC92 KwUw 65535.00 dez 0.00 65535.00 FORMAT "%8.2" /end CHARACTERISTIC
/begin CHARACTERISTIC CWFA242A "Ergänzung Codewort Kurztripanforderung Anzeigegruppe 242A" VALUE 0x81EC94 KwUw 65535.00 dez 0.00 65535.00 FORMAT "%8.2" /end CHARACTERISTIC
/begin CHARACTERISTIC CWFA243 "Codewort Kurztripanforderung Anzeigegruppe 243" VALUE 0x81EC96 KwUw 65535.00 dez 0.00 65535.00 FORMAT "%8.2" /end CHARACTERISTIC
/begin CHARACTERISTIC CWFA243A "Ergänzung Codewort Kurztripanforderung Anzeigegruppe 243A" VALUE 0x81EC98 KwUw 65535.00 dez 0.00 65535.00 FORMAT "%8.2" /end CHARACTERISTIC
/begin CHARACTERISTIC CWFA244 "Codewort Kurztripanforderung Anzeigegruppe 244" VALUE 0x81EC9A KwUw 65535.00 dez 0.00 65535.00 FORMAT "%8.2" /end CHARACTERISTIC
/begin CHARACTERISTIC CWFA244A "Ergänzung Codewort Kurztripanforderung Anzeigegruppe 244A" VALUE 0x81EC9C KwUw 65535.00 dez 0.00 65535.00 FORMAT "%8.2" /end CHARACTERISTIC
/begin CHARACTERISTIC CWFA245 "Codewort Kurztripanforderung Anzeigegruppe 245" VALUE 0x81EC9E KwUw 65535.00 dez 0.00 65535.00 FORMAT "%8.2" /end CHARACTERISTIC
/begin CHARACTERISTIC CWFA245A "Ergänzung Codewort Kurztripanforderung Anzeigegruppe 245A" VALUE 0x81ECA0 KwUw 65535.00 dez 0.00 65535.00 FORMAT "%8.2" /end CHARACTERISTIC
/begin CHARACTERISTIC CWFA246 "Codewort Kurztripanforderung Anzeigegruppe 246" VALUE 0x81ECA2 KwUw 65535.00 dez 0.00 65535.00 FORMAT "%8.2" /end CHARACTERISTIC
/begin CHARACTERISTIC CWFA246A "Ergänzung Codewort Kurztripanforderung Anzeigegruppe 246A" VALUE 0x81ECA4 KwUw 65535.00 dez 0.00 65535.00 FORMAT "%8.2" /end CHARACTERISTIC
/begin CHARACTERISTIC CWFA247 "Codewort Kurztripanforderung Anzeigegruppe 247" VALUE 0x81ECA6 KwUw 65535.00 dez 0.00 65535.00 FORMAT "%8.2" /end CHARACTERISTIC
/begin CHARACTERISTIC CWFA247A "Ergänzung Codewort Kurztripanforderung Anzeigegruppe 247A" VALUE 0x81ECA8 KwUw 65535.00 dez 0.00 65535.00 FORMAT "%8.2" /end CHARACTERISTIC
/begin CHARACTERISTIC CWFA248 "Codewort Kurztripanforderung Anzeigegruppe 248" VALUE 0x81ECAA KwUw 65535.00 dez 0.00 65535.00 FORMAT "%8.2" /end CHARACTERISTIC
/begin CHARACTERISTIC CWFA248A "Ergänzung Codewort Kurztripanforderung Anzeigegruppe 248A" VALUE 0x81ECAC KwUw 65535.00 dez 0.00 65535.00 FORMAT "%8.2" /end CHARACTERISTIC
/begin CHARACTERISTIC CWFA249 "Codewort Kurztripanforderung Anzeigegruppe 249" VALUE 0x81ECAE KwUw 65535.00 dez 0.00 65535.00 FORMAT "%8.2" /end CHARACTERISTIC
/begin CHARACTERISTIC CWFA249A "Ergänzung Codewort Kurztripanforderung Anzeigegruppe 249A" VALUE 0x81ECB0 KwUw 65535.00 dez 0.00 65535.00 FORMAT "%8.2" /end CHARACTERISTIC
/begin CHARACTERISTIC CWFA250 "Codewort Kurztripanforderung Anzeigegruppe 250" VALUE 0x81ECB2 KwUw 65535.00 dez 0.00 65535.00 FORMAT "%8.2" /end CHARACTERISTIC
/begin CHARACTERISTIC CWFA250A "Ergänzung Codewort Kurztripanforderung Anzeigegruppe 250A" VALUE 0x81ECB4 KwUw 65535.00 dez 0.00 65535.00 FORMAT "%8.2" /end CHARACTERISTIC
/begin CHARACTERISTIC CWFA251 "Codewort Kurztripanforderung Anzeigegruppe 251" VALUE 0x81ECB6 KwUw 65535.00 dez 0.00 65535.00 FORMAT "%8.2" /end CHARACTERISTIC
/begin CHARACTERISTIC CWFA251A "Ergänzung Codewort Kurztripanforderung Anzeigegruppe 251A" VALUE 0x81ECB8 KwUw 65535.00 dez 0.00 65535.00 FORMAT "%8.2" /end CHARACTERISTIC
/begin CHARACTERISTIC CWFA252 "Codewort Kurztripanforderung Anzeigegruppe 252" VALUE 0x81ECBA KwUw 65535.00 dez 0.00 65535.00 FORMAT "%8.2" /end CHARACTERISTIC
/begin CHARACTERISTIC CWFA252A "Ergänzung Codewort Kurztripanforderung Anzeigegruppe 252A" VALUE 0x81ECBC KwUw 65535.00 dez 0.00 65535.00 FORMAT "%8.2" /end CHARACTERISTIC
/begin CHARACTERISTIC CWFA253 "Codewort Kurztripanforderung Anzeigegruppe 253" VALUE 0x81ECBE KwUw 65535.00 dez 0.00 65535.00 FORMAT "%8.2" /end CHARACTERISTIC
/begin CHARACTERISTIC CWFA253A "Ergänzung Codewort Kurztripanforderung Anzeigegruppe 253A" VALUE 0x81ECC0 KwUw 65535.00 dez 0.00 65535.00 FORMAT "%8.2" /end CHARACTERISTIC
/begin CHARACTERISTIC CWFA254 "Codewort Kurztripanforderung Anzeigegruppe 254" VALUE 0x81ECC2 KwUw 65535.00 dez 0.00 65535.00 FORMAT "%8.2" /end CHARACTERISTIC
/begin CHARACTERISTIC CWFA254A "Ergänzung Codewort Kurztripanforderung Anzeigegruppe 254A" VALUE 0x81ECC4 KwUw 65535.00 dez 0.00 65535.00 FORMAT "%8.2" /end CHARACTERISTIC
/begin CHARACTERISTIC CWFA255 "Codewort Kurztripanforderung Anzeigegruppe 255" VALUE 0x81ECC6 KwUw 65535.00 dez 0.00 65535.00 FORMAT "%8.2" /end CHARACTERISTIC
/begin CHARACTERISTIC CWFA255A "Ergänzung Codewort Kurztripanforderung Anzeigegruppe 255A" VALUE 0x81ECC8 KwUw 65535.00 dez 0.00 65535.00 FORMAT "%8.2" /end CHARACTERISTIC
/begin CHARACTERISTIC CWFA28 "Codewort Kurztripanforderungen Anzeigegruppe 28" VALUE 0x81ECCA KwUw 65535.00 dez 0.00 65535.00 FORMAT "%8.2" /end CHARACTERISTIC
/begin CHARACTERISTIC CWFA28A "Ergänzung Codewort Kurztripanforderungen Anzeigegruppe 28" VALUE 0x81ECCC KwUw 65535.00 dez 0.00 65535.00 FORMAT "%8.2" /end CHARACTERISTIC
/begin CHARACTERISTIC CWFA34 "Codewort Kurztripanforderungen Anzeigegruppe 34" VALUE 0x81ECCE KwUw 65535.00 dez 0.00 65535.00 FORMAT "%8.2" /end CHARACTERISTIC
/begin CHARACTERISTIC CWFA34A "Ergänzung Codewort Kurztripanforderungen Anzeigegruppe 34" VALUE 0x81ECD0 KwUw 65535.00 dez 0.00 65535.00 FORMAT "%8.2" /end CHARACTERISTIC
/begin CHARACTERISTIC CWFA35 "Codewort Kurztripanforderungen Anzeigegruppe 35" VALUE 0x81ECD2 KwUw 65535.00 dez 0.00 65535.00 FORMAT "%8.2" /end CHARACTERISTIC
/begin CHARACTERISTIC CWFA35A "Ergänzung Codewort Kurztripanforderungen Anzeigegruppe 35" VALUE 0x81ECD4 KwUw 65535.00 dez 0.00 65535.00 FORMAT "%8.2" /end CHARACTERISTIC
/begin CHARACTERISTIC CWFA36 "Codewort Kurztripanforderungen Anzeigegruppe 36" VALUE 0x81ECD6 KwUw 65535.00 dez 0.00 65535.00 FORMAT "%8.2" /end CHARACTERISTIC
/begin CHARACTERISTIC CWFA36A "Ergänzung Codewort Kurztripanforderungen Anzeigegruppe 36" VALUE 0x81ECD8 KwUw 65535.00 dez 0.00 65535.00 FORMAT "%8.2" /end CHARACTERISTIC
/begin CHARACTERISTIC CWFA37 "Codewort Kurztripanforderungen Anzeigegruppe 37" VALUE 0x81ECDA KwUw 65535.00 dez 0.00 65535.00 FORMAT "%8.2" /end CHARACTERISTIC
/begin CHARACTERISTIC CWFA37A "Ergänzung Codewort Kurztripanforderungen Anzeigegruppe 37" VALUE 0x81ECDC KwUw 65535.00 dez 0.00 65535.00 FORMAT "%8.2" /end CHARACTERISTIC
/begin CHARACTERISTIC CWFA38 "Codewort Kurztripanforderungen Anzeigegruppe 38" VALUE 0x81ECDE KwUw 65535.00 dez 0.00 65535.00 FORMAT "%8.2" /end CHARACTERISTIC
/begin CHARACTERISTIC CWFA38A "Ergänzung Codewort Kurztripanforderungen Anzeigegruppe 38" VALUE 0x81ECE0 KwUw 65535.00 dez 0.00 65535.00 FORMAT "%8.2" /end CHARACTERISTIC
/begin CHARACTERISTIC CWFA39 "Codewort Kurztripanforderungen Anzeigegruppe 39" VALUE 0x81ECE2 KwUw 65535.00 dez 0.00 65535.00 FORMAT "%8.2" /end CHARACTERISTIC
/begin CHARACTERISTIC CWFA39A "Ergänzung Codewort Kurztripanforderungen Anzeigegruppe 39" VALUE 0x81ECE4 KwUw 65535.00 dez 0.00 65535.00 FORMAT "%8.2" /end CHARACTERISTIC
/begin CHARACTERISTIC CWFA43 "Codewort Kurztripanforderungen Anzeigegruppe 43" VALUE 0x81ECE6 KwUw 65535.00 dez 0.00 65535.00 FORMAT "%8.2" /end CHARACTERISTIC
/begin CHARACTERISTIC CWFA43A "Ergänzung Codewort Kurztripanforderungen Anzeigegruppe 43" VALUE 0x81ECE8 KwUw 65535.00 dez 0.00 65535.00 FORMAT "%8.2" /end CHARACTERISTIC
/begin CHARACTERISTIC CWFA44 "Codewort Kurztripanforderungen Anzeigegruppe 44" VALUE 0x81ECEA KwUw 65535.00 dez 0.00 65535.00 FORMAT "%8.2" /end CHARACTERISTIC
/begin CHARACTERISTIC CWFA44A "Ergänzung Codewort Kurztripanforderungen Anzeigegruppe 44" VALUE 0x81ECEC KwUw 65535.00 dez 0.00 65535.00 FORMAT "%8.2" /end CHARACTERISTIC
/begin CHARACTERISTIC CWFA46 "Codewort Kurztripanforderungen Anzeigegruppe 46" VALUE 0x81ECEE KwUw 65535.00 dez 0.00 65535.00 FORMAT "%8.2" /end CHARACTERISTIC
/begin CHARACTERISTIC CWFA46A "Ergänzung Codewort Kurztripanforderungen Anzeigegruppe 46" VALUE 0x81ECF0 KwUw 65535.00 dez 0.00 65535.00 FORMAT "%8.2" /end CHARACTERISTIC
/begin CHARACTERISTIC CWFA47 "Codewort Kurztripanforderungen Anzeigegruppe 47" VALUE 0x81ECF2 KwUw 65535.00 dez 0.00 65535.00 FORMAT "%8.2" /end CHARACTERISTIC
/begin CHARACTERISTIC CWFA47A "Ergänzung Codewort Kurztripanforderungen Anzeigegruppe 47" VALUE 0x81ECF4 KwUw 65535.00 dez 0.00 65535.00 FORMAT "%8.2" /end CHARACTERISTIC
/begin CHARACTERISTIC CWFA48 "Codewort Kurztripanforderungen Anzeigegruppe 48" VALUE 0x81ECF6 KwUw 65535.00 dez 0.00 65535.00 FORMAT "%8.2" /end CHARACTERISTIC
/begin CHARACTERISTIC CWFA48A "Ergänzung Codewort Kurztripanforderungen Anzeigegruppe 48" VALUE 0x81ECF8 KwUw 65535.00 dez 0.00 65535.00 FORMAT "%8.2" /end CHARACTERISTIC
/begin CHARACTERISTIC CWFA49 "Codewort Kurztripanforderungen Anzeigegruppe 49" VALUE 0x81ECFA KwUw 65535.00 dez 0.00 65535.00 FORMAT "%8.2" /end CHARACTERISTIC
/begin CHARACTERISTIC CWFA49A "Ergänzung Codewort Kurztripanforderungen Anzeigegruppe 49" VALUE 0x81ECFC KwUw 65535.00 dez 0.00 65535.00 FORMAT "%8.2" /end CHARACTERISTIC
/begin CHARACTERISTIC CWFA70 "Codewort Kurztripanforderungen Anzeigegruppe 70" VALUE 0x81ECFE KwUw 65535.00 dez 0.00 65535.00 FORMAT "%8.2" /end CHARACTERISTIC
/begin CHARACTERISTIC CWFA70A "Ergänzung Codewort Kurztripanforderungen Anzeigegruppe 70" VALUE 0x81ED00 KwUw 65535.00 dez 0.00 65535.00 FORMAT "%8.2" /end CHARACTERISTIC
/begin CHARACTERISTIC CWFA71 "Codewort Kurztripanforderungen Anzeigegruppe 71" VALUE 0x81ED02 KwUw 65535.00 dez 0.00 65535.00 FORMAT "%8.2" /end CHARACTERISTIC
/begin CHARACTERISTIC CWFA71A "Ergänzung Codewort Kurztripanforderungen Anzeigegruppe 71" VALUE 0x81ED04 KwUw 65535.00 dez 0.00 65535.00 FORMAT "%8.2" /end CHARACTERISTIC
/begin CHARACTERISTIC CWFA75 "Codewort Kurztripanforderungen Anzeigegruppe 75" VALUE 0x81ED06 KwUw 65535.00 dez 0.00 65535.00 FORMAT "%8.2" /end CHARACTERISTIC
/begin CHARACTERISTIC CWFA75A "Ergänzung Codewort Kurztripanforderungen Anzeigegruppe 75" VALUE 0x81ED08 KwUw 65535.00 dez 0.00 65535.00 FORMAT "%8.2" /end CHARACTERISTIC
/begin CHARACTERISTIC CWFA77 "Codewort Kurztripanforderungen Anzeigegruppe 77" VALUE 0x81ED0A KwUw 65535.00 dez 0.00 65535.00 FORMAT "%8.2" /end CHARACTERISTIC
/begin CHARACTERISTIC CWFA77A "Ergänzung Codewort Kurztripanforderungen Anzeigegruppe 77" VALUE 0x81ED0C KwUw 65535.00 dez 0.00 65535.00 FORMAT "%8.2" /end CHARACTERISTIC
/begin CHARACTERISTIC CWFA78 "Codewort Kurztripanforderungen Anzeigegruppe 78" VALUE 0x81ED0E KwUw 65535.00 dez 0.00 65535.00 FORMAT "%8.2" /end CHARACTERISTIC
/begin CHARACTERISTIC CWFA78A "Ergänzung Codewort Kurztripanforderungen Anzeigegruppe 78" VALUE 0x81ED10 KwUw 65535.00 dez 0.00 65535.00 FORMAT "%8.2" /end CHARACTERISTIC
/begin CHARACTERISTIC CWFA94 "Codewort Kurztripanforderungen Anzeigegruppe 94" VALUE 0x81ED12 KwUw 65535.00 dez 0.00 65535.00 FORMAT "%8.2" /end CHARACTERISTIC
/begin CHARACTERISTIC CWFA94A "Ergänzung Codewort Kurztripanforderungen Anzeigegruppe 94" VALUE 0x81ED14 KwUw 65535.00 dez 0.00 65535.00 FORMAT "%8.2" /end CHARACTERISTIC
/begin CHARACTERISTIC CWFA96 "Codewort Kurztripanforderungen Anzeigegruppe 96" VALUE 0x81ED16 KwUw 65535.00 dez 0.00 65535.00 FORMAT "%8.2" /end CHARACTERISTIC
/begin CHARACTERISTIC CWFA96A "Ergänzung Codewort Kurztripanforderungen Anzeigegruppe 96" VALUE 0x81ED18 KwUw 65535.00 dez 0.00 65535.00 FORMAT "%8.2" /end CHARACTERISTIC
/begin CHARACTERISTIC CWKUEKD "Codewort zur Konfiguration der Stellglieddiagnose Motorkühlung" VALUE 0x81EB92 KwUw 65535.00 dez 0.00 65535.00 FORMAT "%8.2" /end CHARACTERISTIC
/begin CHARACTERISTIC CWM9CVNSUP "Codewort Support der VITs $05 und $06 (CVN-Ausgabe) im Mode/Service $09" VALUE 0x810B37 KwUb 255.0 dez 0.00 255.0 FORMAT "%5.1" /end CHARACTERISTIC
/begin CHARACTERISTIC CWNOSCAT "Codewort zum Abschalten der Scan Tool Kommunikation" VALUE 0x8183CC KwUb 3.000 dez 0.00 3.000 FORMAT "%5.3" /end CHARACTERISTIC
/begin CHARACTERISTIC CWPWF "Codewort Powerfail" VALUE 0x81A24D KwUb 255.0 dez 0.00 255.0 FORMAT "%5.1" /end CHARACTERISTIC
/begin CHARACTERISTIC CWSTADAP "Codewort Startadaption" VALUE 0x8110A9 KwUb 255.0 dez 0.00 255.0 FORMAT "%5.1" /end CHARACTERISTIC
/begin CHARACTERISTIC CWSTADK "" VALUE 0x8186CB KwUb 255.0 dez 0.00 255.0 FORMAT "%5.1" /end CHARACTERISTIC
/begin CHARACTERISTIC CWSTAKD "Codewort zur Konfiguration der Stellglieddiagnose" VALUE 0x81EB94 KwUw 65535.00 dez 0.00 65535.00 FORMAT "%8.2" /end CHARACTERISTIC
/begin CHARACTERISTIC CWSTAKD2 "Codewort 2 zur Konfiguration der Stellglieddiagnose" VALUE 0x81EB96 KwUw 65535.00 dez 0.00 65535.00 FORMAT "%8.2" /end CHARACTERISTIC
/begin CHARACTERISTIC CWSTEVKD "Codewort zur Freigabe der Stellglieddiagnose Einspritzventile" VALUE 0x81EB98 KwUw 65535.00 dez 0.00 65535.00 FORMAT "%8.2" /end CHARACTERISTIC
/begin CHARACTERISTIC CWTAF "Codewort für Testeranpassung: Anpassung frei" VALUE 0x81ED1A KwUw 65535.00 dez 0.00 65535.00 FORMAT "%8.2" /end CHARACTERISTIC
/begin CHARACTERISTIC CWTAK "Codewort für Testeranpassung: Anpassung für Kundendienst" VALUE 0x81ED1C KwUw 65535.00 dez 0.00 65535.00 FORMAT "%8.2" /end CHARACTERISTIC
/begin CHARACTERISTIC CWTAS "Codewort für Testeranpassung: Anpassung für Entwicklung" VALUE 0x81ED1E KwUw 65535.00 dez 0.00 65535.00 FORMAT "%8.2" /end CHARACTERISTIC
/begin CHARACTERISTIC CWTEACFG "ausserordentliche Konfiguration der Tankentlüftung" VALUE 0x81A25C KwUb 255.0 dez 0.00 255.0 FORMAT "%5.1" /end CHARACTERISTIC
/begin CHARACTERISTIC DBACCMX_UM "Fehlerschwelle Botschaftszähler in ACC-Botschaft" VALUE 0x814004 KwUb 255.0 dez 0.00 255.0 FORMAT "%5.1" /end CHARACTERISTIC
/begin CHARACTERISTIC DBACC_T_UM "Fehlerentprellung:  Fehler in Botschaftszähler der ACC-Botschaft" VALUE 0x814005 KwUb 10200.0 t40ms_ub_b10200 0.00 10200.0 FORMAT "%7.1" /end CHARACTERISTIC
/begin CHARACTERISTIC DBGRAMX_UM "Fehlerschwelle Botschaftszähler in GRA-Botschaft" VALUE 0x81400A KwUb 255.0 dez 0.00 255.0 FORMAT "%5.1" /end CHARACTERISTIC
/begin CHARACTERISTIC DBGRA_T_UM "Fehlerentprellung Botschaftszähler in GRA-Botschaft" VALUE 0x81400B KwUb 10200.0 t40ms_ub_b10200 0.00 10200.0 FORMAT "%7.1" /end CHARACTERISTIC
/begin CHARACTERISTIC DBZ_MN_UM "kleinstes zulässiges Delta des Botschaftszählers" VALUE 0x814078 KwUb 255.0 dez 0.00 255.0 FORMAT "%5.1" /end CHARACTERISTIC
/begin CHARACTERISTIC DBZ_MX_UM "größtes zulässiges Delta des Botschaftszählers" VALUE 0x814079 KwUb 255.0 dez 0.00 255.0 FORMAT "%5.1" /end CHARACTERISTIC
/begin CHARACTERISTIC DECKSTAI "Decrement-Step für STADAP-Faktor" CURVE 0x8110AA KlAUbSstUbWSb 1.000 fak_sb_b1 -1.000 0.00 FORMAT "%5.3"
 /begin AXIS_DESCR STD_AXIS tmadb dez 3 0.00 255.0 FORMAT "%5.1" DEPOSIT ABSOLUTE /end AXIS_DESCR
/end CHARACTERISTIC
/begin CHARACTERISTIC DFTEAHB "Schwelle Gemischanteil Tankentlüftung zum Setzen Bit ""Hohe Beladung""" VALUE 0x81A25F KwSb 1.992 fak_sb_b1 -1.000 0.9922 FORMAT "%5.3" /end CHARACTERISTIC
/begin CHARACTERISTIC DMSTES "Kennlinie maximale Zunahme Massenstrom Tankentlüftung" CURVE 0x817694 KlAUwSstUwWUw 3276.800 m_uw_q3p2 0.00 3276.800 FORMAT "%8.3"
 /begin AXIS_DESCR STD_AXIS mstesoll_w m_uw_b25p6 6 0.00 25.59961 FORMAT "%8.5" DEPOSIT ABSOLUTE /end AXIS_DESCR
/end CHARACTERISTIC
/begin CHARACTERISTIC DNBURN0 "Minimaler Drehzahlanstieg für erkannte Verbrennung im Bereich 0" CURVE 0x81579C KlAUwSstUwWUw 4112.000 nmot_uw_q0p25 0.00 4112.000 FORMAT "%8.3"
 /begin AXIS_DESCR STD_AXIS nmot_w nmot_uw_q0p25 12 0.00 16383.75 FORMAT "%8.2" DEPOSIT ABSOLUTE /end AXIS_DESCR
/end CHARACTERISTIC
/begin CHARACTERISTIC DNBURN1 "Minimaler Drehzahlanstieg für erkannte Verbrennung im Bereich 1" CURVE 0x8157CE KlAUwSstUwWUw 4112.000 nmot_uw_q0p25 0.00 4112.000 FORMAT "%8.3"
 /begin AXIS_DESCR STD_AXIS nmot_w nmot_uw_q0p25 12 0.00 16383.75 FORMAT "%8.2" DEPOSIT ABSOLUTE /end AXIS_DESCR
/end CHARACTERISTIC
/begin CHARACTERISTIC DNBURN2 "Minimaler Drehzahlanstieg für erkannte Verbrennung im Bereich 2" CURVE 0x815800 KlAUwSstUwWUw 4112.000 nmot_uw_q0p25 0.00 4112.000 FORMAT "%8.3"
 /begin AXIS_DESCR STD_AXIS nmot_w nmot_uw_q0p25 12 0.00 16383.75 FORMAT "%8.2" DEPOSIT ABSOLUTE /end AXIS_DESCR
/end CHARACTERISTIC
/begin CHARACTERISTIC DSTEMIN "Minimalwert für Weitertransport in Totzeitglied Gemischtransport" VALUE 0x8176AE KwUw 0.9999695 fak_uw_b2 0.00 0.9999695 FORMAT "%9.7" /end CHARACTERISTIC
/begin CHARACTERISTIC DZW_AOG "oberer Grenzwert Anpassung Zündwinkel additiv" VALUE 0x811591 KwSb 191.3 zw_sb_q0p75 -96.00 95.25 FORMAT "%5.2" /end CHARACTERISTIC
/begin CHARACTERISTIC DZW_AUG "unterer Grenzwert Anpassung Zündwinkel additiv" VALUE 0x811592 KwSb 191.3 zw_sb_q0p75 -96.00 95.25 FORMAT "%5.2" /end CHARACTERISTIC
/begin CHARACTERISTIC FBA_AOG "oberer Grenzwert Anpassung Faktor BA" VALUE 0x811593 KwUb 1.992 fak_ub_b2 0.00 1.992 FORMAT "%5.3" /end CHARACTERISTIC
/begin CHARACTERISTIC FBA_AUG "unterer Grenzwert Anpassung Faktor BA" VALUE 0x811594 KwUb 1.992 fak_ub_b2 0.00 1.992 FORMAT "%5.3" /end CHARACTERISTIC
/begin CHARACTERISTIC FBTEB "Faktor Begrenzung Lerngeschwindigkeit für Beladung" CURVE 0x81A260 KlAUbSstUbWUb 0.9961 fak_ub_b1 0.00 0.9961
 /begin AXIS_DESCR STD_AXIS ftefvab fak_ub_b0p03125 6 0.00 0.03113 FORMAT "%7.5" DEPOSIT ABSOLUTE /end AXIS_DESCR
/end CHARACTERISTIC
/begin CHARACTERISTIC FBTEVA "Faktor ftefva-abhängige Lerngeschwindigkeit der Beladung" CURVE 0x81A26D KlAUbSstUbWUb 0.9961 fak_ub_b1 0.00 0.9961 /begin AXIS_DESCR STD_AXIS ftefva fak_ub_b0p5 6 0.00 0.4980 DEPOSIT ABSOLUTE /end AXIS_DESCR /end CHARACTERISTIC
/begin CHARACTERISTIC FBZBTEML "Bewertungsfaktor Integrationsgeschwindigkeit Beladungsfaktor" CURVE 0x81A27A KlAUbSstUbWUb 0.9961 fak_ub_b1 0.00 0.9961
 /begin AXIS_DESCR STD_AXIS abo dez 5 0.00 255.0 FORMAT "%5.1" DEPOSIT ABSOLUTE /end AXIS_DESCR
/end CHARACTERISTIC
/begin CHARACTERISTIC FETATEBN "Kennlinie für drehzahlabhängigen Sollwert des Motorwirkungsgrades" CURVE 0x81A285 KlAUbSstUbWUb 0.9961 fak_ub_b1 0.00 0.9961
 /begin AXIS_DESCR STD_AXIS nmot nmot_ub_q40 5 0.00 10200. FORMAT "%5.0" DEPOSIT ABSOLUTE /end AXIS_DESCR
/end CHARACTERISTIC
/begin AXIS_PTS FHO04ESUB "SST-Verteilung für Höhenfaktor" 0x81005A fho SstAUbSstUb 3.984 fak_ub_b4 4 0.00 3.984 FORMAT "%5.3" DEPOSIT ABSOLUTE /end AXIS_PTS
/begin CHARACTERISTIC FKATEB "Kennlinie Kraftstoffanteil Tankentlüftung abh. von te / TEMIN" CURVE 0x81A290 KlAUbSstUbWUb 0.9961 fak_ub_b1 0.00 0.9961
 /begin AXIS_DESCR STD_AXIS qtetemin fak_ub_b4 5 0.00 3.984 FORMAT "%5.3" DEPOSIT ABSOLUTE /end AXIS_DESCR
/end CHARACTERISTIC
/begin CHARACTERISTIC FLR_AOG "oberer Grenzwert Anpassung Lambdaregelung-TV-Verschiebung" VALUE 0x811595 KwSb 2.550 t10msxs_sb_q0p01 -1.280 1.270 FORMAT "%5.3" /end CHARACTERISTIC
/begin CHARACTERISTIC FLR_AUG "unterer Grenzwert Anpassung Lambdaregelung-TV-Verschiebung" VALUE 0x811596 KwSb 2.550 t10msxs_sb_q0p01 -1.280 1.270 FORMAT "%5.3" /end CHARACTERISTIC
/begin CHARACTERISTIC FNS_AOG "oberer Grenzwert Anpassung Faktor Nachstart" VALUE 0x811597 KwUb 1.992 fak_ub_b2 0.00 1.992 FORMAT "%5.3" /end CHARACTERISTIC
/begin CHARACTERISTIC FNS_AUG "unterer Grenzwert Anpassung Faktor Nachstart" VALUE 0x811598 KwUb 1.992 fak_ub_b2 0.00 1.992 FORMAT "%5.3" /end CHARACTERISTIC
/begin CHARACTERISTIC FQTEDL "Kennlinie Faktor für exponentielle Absteuerung Spülrate" CURVE 0x81A29B KlAUbSstUbWUb 1.992 fak_ub_b2 0.00 1.992 FORMAT "%5.3"
 /begin AXIS_DESCR STD_AXIS dmlftef fak_ub_b0p5 5 0.00 0.4980 DEPOSIT ABSOLUTE /end AXIS_DESCR
/end CHARACTERISTIC
/begin CHARACTERISTIC FQTEFR "Kennlinie stetige Grenzwertregelung (fr)" CURVE 0x827EE2 KlAUbSstUbWSb 15.88 fak_sb_b16 0.00 15.88 FORMAT "%5.2"
 /begin AXIS_DESCR STD_AXIS frmxa fak_ub_b2 8 0.00 1.992 FORMAT "%5.3" DEPOSIT ABSOLUTE /end AXIS_DESCR
/end CHARACTERISTIC
/begin CHARACTERISTIC FQTEPT "Kennlinie Tankunterdruckbegrenzung" CURVE 0x81A2A6 KlAUbSstSbWSb 15.88 fak_sb_b16 0.00 15.88 FORMAT "%5.2"
 /begin AXIS_DESCR STD_AXIS pte p_sb_q0p25 6 -32.00 31.75 FORMAT "%5.2" DEPOSIT ABSOLUTE /end AXIS_DESCR
/end CHARACTERISTIC
/begin CHARACTERISTIC FQTEVA "Progression bei Spülratenaufsteuerung" CURVE 0x81A2B3 KlAUbSstUbWUb 15.94 fak_ub_b16 0.00 15.94 FORMAT "%5.2" /begin AXIS_DESCR STD_AXIS ftefva fak_ub_b0p5 6 0.00 0.4980 DEPOSIT ABSOLUTE /end AXIS_DESCR /end CHARACTERISTIC
/begin CHARACTERISTIC FRHB "fr-Schwelle für mögliches Rücksetzten Flip-Flop ""Hohe Beladung""" VALUE 0x81A2C0 KwUb 1.992 fak_ub_b2 0.00 1.992 FORMAT "%5.3" /end CHARACTERISTIC
/begin CHARACTERISTIC FRK_AOG "oberer Grenzwert Anpassung Faktor Grundanpassung" VALUE 0x811599 KwUb 0.4980 fak_ub_b1p25_o0p75 0.7500 1.248 FORMAT "%5.3" /end CHARACTERISTIC
/begin CHARACTERISTIC FRK_AUG "unterer Grenzwert Anpassung Faktor Grundanpassung" VALUE 0x81159A KwUb 0.4980 fak_ub_b1p25_o0p75 0.7500 1.248 FORMAT "%5.3" /end CHARACTERISTIC
/begin CHARACTERISTIC FSRFTEF "Faktor Steilheit Spülratenregelung in der Nähe des gewünschten Krafstoffanteils" VALUE 0x812122 KwUb 59.75 fak_ub_b64 4.000 63.75 FORMAT "%5.2" /end CHARACTERISTIC
/begin CHARACTERISTIC FST_AOG "oberer Grenzwert Anpassung Faktor Start" VALUE 0x81159B KwUb 1.992 fak_ub_b2 0.00 1.992 FORMAT "%5.3" /end CHARACTERISTIC
/begin CHARACTERISTIC FST_AUG "unterer Grenzwert Anpassung Faktor Start" VALUE 0x81159C KwUb 1.992 fak_ub_b2 0.00 1.992 FORMAT "%5.3" /end CHARACTERISTIC
/begin CHARACTERISTIC FTEADAB "Schwelle Beladung für Abbruch TE-Phase" VALUE 0x81A2C1 KwSb 127.5 fak_sb_b64 -64.00 63.50 FORMAT "%5.2" /end CHARACTERISTIC
/begin CHARACTERISTIC FTEADMX "Maximalwert der Beladung des AKFs" VALUE 0x81A2C2 KwSb 127.5 fak_sb_b64 -64.00 63.50 FORMAT "%5.2" /end CHARACTERISTIC
/begin CHARACTERISTIC FTEFHB "Schwelle für Spülrate Tankentlüftung für Erkennung hohe Beladung" VALUE 0x81A2C3 KwUb 0.4980 fak_ub_b0p5 0.00 0.4980 /end CHARACTERISTIC
/begin CHARACTERISTIC FTEHB "Schwelle für Faktor Tankentlüftung für Erkennung hohe Beladung" VALUE 0x81A2C4 KwSb 127.5 fak_sb_b64 -64.00 63.50 FORMAT "%5.2" /end CHARACTERISTIC
/begin CHARACTERISTIC FTEINIX "Kennlinie Max. Spülrate abhängig vom Integral Massenstrom TE nach TE Stop" CURVE 0x81A2C5 KlAUbSstUbWUb 0.1992 fak_ub_b0p5 0.00 0.1992
 /begin AXIS_DESCR STD_AXIS imsteini m_ub_q0p0444 5 0.00 11.32 FORMAT "%5.2" DEPOSIT ABSOLUTE /end AXIS_DESCR
/end CHARACTERISTIC
/begin CHARACTERISTIC FUMRBRK "Faktor Umrechnung HC-Konzentration in Beladung ftead" VALUE 0x81A2D0 KwUb 31.88 fak_ub_b32 0.00 31.88 FORMAT "%5.2" /end CHARACTERISTIC
/begin CHARACTERISTIC FVA_AOG "oberer Grenzwert Anpassung Faktor VA" VALUE 0x81159D KwUb 1.992 fak_ub_b2 0.00 1.992 FORMAT "%5.3" /end CHARACTERISTIC
/begin CHARACTERISTIC FVA_AUG "unterer Grenzwert Anpassung Faktor VA" VALUE 0x81159E KwUb 1.992 fak_ub_b2 0.00 1.992 FORMAT "%5.3" /end CHARACTERISTIC
/begin CHARACTERISTIC FVERMN "Kennlinie Faktor Vermischung Regeneriergas Tankentlüftung mit Frischluft" CURVE 0x812123 KlAUbSstUbWUb 0.9961 fak_ub_b1 0.00 0.9961
 /begin AXIS_DESCR STD_AXIS nmot nmot_ub_q40 6 0.00 10200. FORMAT "%5.0" DEPOSIT ABSOLUTE /end AXIS_DESCR
/end CHARACTERISTIC
/begin CHARACTERISTIC FVERZDYN "Dynamischer Faktor Verzögerung Regeneriergas zw. Drosselklappe, Einspritzventil" CURVE 0x8176B0 GklWUw 0.003905886 t_min_q5p96em8 0.00 0.003905886 FORMAT "%11.9"
 /begin AXIS_DESCR COM_AXIS qmsdyn fak_ub_b16 5 0.00 15.94 AXIS_PTS_REF SQM05TEUB /end AXIS_DESCR
/end CHARACTERISTIC
/begin CHARACTERISTIC FVRMDYN "dynamischer Faktor Vermischung Regeneriergas Tankentlüftung mit Frischluft" CURVE 0x812130 GklWUb 7.969 fak_ub_b8 0.00 7.969 FORMAT "%5.3"
 /begin AXIS_DESCR COM_AXIS qmsdyn fak_ub_b16 5 0.00 15.94 AXIS_PTS_REF SQM05TEUB /end AXIS_DESCR
/end CHARACTERISTIC
/begin CHARACTERISTIC FWL_AOG "oberer Grenzwert Anpassung Faktor Warmlauf" VALUE 0x81159F KwUb 1.992 fak_ub_b2 0.00 1.992 FORMAT "%5.3" /end CHARACTERISTIC
/begin CHARACTERISTIC FWL_AUG "unterer Grenzwert Anpassung Faktor Warmlauf" VALUE 0x8115A0 KwUb 1.992 fak_ub_b2 0.00 1.992 FORMAT "%5.3" /end CHARACTERISTIC
/begin CHARACTERISTIC GRAOFLOGIN "Login-Code für GRA sperren" VALUE 0x815CBA KwUw 65535.00 dez 0.00 65535.00 FORMAT "%8.2" /end CHARACTERISTIC
/begin CHARACTERISTIC GRAONLOGIN "Login-Code für GRA freischalten" VALUE 0x815CBC KwUw 65535.00 dez 0.00 65535.00 FORMAT "%8.2" /end CHARACTERISTIC
/begin CHARACTERISTIC HLOFFLOGIN "Login-Code für Heißland deaktiv" VALUE 0x815CBE KwUw 65535.00 dez 0.00 65535.00 FORMAT "%8.2" /end CHARACTERISTIC
/begin CHARACTERISTIC HLONLOGIN "Login-Code für Heißland aktiv" VALUE 0x815CC0 KwUw 65535.00 dez 0.00 65535.00 FORMAT "%8.2" /end CHARACTERISTIC
/begin CHARACTERISTIC INCKSTAI "Inkrement-Step für STADAP-Faktor" CURVE 0x8110B1 KlAUbSstUbWSb 0.9922 fak_sb_b1 0.00 0.9922
 /begin AXIS_DESCR STD_AXIS tmadb dez 3 0.00 255.0 FORMAT "%5.1" DEPOSIT ABSOLUTE /end AXIS_DESCR
/end CHARACTERISTIC
/begin CHARACTERISTIC KFETATE "Kennfeld gewünscher Wirkungsgrad bei Tankentlüftung bei Erreichen te = TEMIN" MAP 0x827EF4 KfAxUwAyUwSstxSwSstyUwWUw 50.00000 rel_q0p00195 50.00000 100.0000 FORMAT "%8.4"
 /begin AXIS_DESCR STD_AXIS fteadf_w fak_q0p00195 3 -64.00000 63.99805 FORMAT "%8.5" DEPOSIT ABSOLUTE /end AXIS_DESCR
 /begin AXIS_DESCR STD_AXIS mifa_w rel_uw_b100 5 0.00 99.99847 FORMAT "%8.5" DEPOSIT ABSOLUTE /end AXIS_DESCR
/end CHARACTERISTIC
/begin CHARACTERISTIC KFFTEAN "Kennfeld Maximale Spülrate bei Notlauftankentlüftung" MAP 0x81A2D1 GkfWUb 0.1992 fak_ub_b0p5 0.00 0.1992
 /begin AXIS_DESCR COM_AXIS nmot nmot_ub_q40 10 0.00 10200. AXIS_PTS_REF SNM10TEUB /end AXIS_DESCR
 /begin AXIS_DESCR COM_AXIS wdkba relDK_ub_b100 10 0.00 100.0 AXIS_PTS_REF SDK10TEUB /end AXIS_DESCR
/end CHARACTERISTIC
/begin CHARACTERISTIC KFFTEAX "Kennfeld maximale Spülrate" MAP 0x81A335 KfAxUbAyUbSstxUbSstyUbWUb 0.1992 fak_ub_b0p5 0.00 0.1992
 /begin AXIS_DESCR STD_AXIS ml m_ub_b1020 5 0.00 1020. FORMAT "%5.0" DEPOSIT ABSOLUTE /end AXIS_DESCR
 /begin AXIS_DESCR STD_AXIS tans temp_ub_q0p75_o48 4 -48.00 143.3 FORMAT "%5.1" DEPOSIT ABSOLUTE /end AXIS_DESCR
/end CHARACTERISTIC
/begin CHARACTERISTIC KFMI_UM "Kennfeld optimales Motormoment in der Funktionsüberwachung" MAP 0x8140A0 GkfWUb 99.61 rel_ub_b99p6 0.00 99.61 FORMAT "%5.2"
 /begin AXIS_DESCR COM_AXIS rl_um rel_ub_q0p75 8 0.00 191.3 AXIS_PTS_REF RLV08_UM /end AXIS_DESCR
 /begin AXIS_DESCR COM_AXIS nmot_um nmot_ub_q40 8 0.00 10200. AXIS_PTS_REF NZWV08_UM /end AXIS_DESCR
/end CHARACTERISTIC
/begin CHARACTERISTIC KFNSTAMX "Drehzahlschwelle für STADAP aktiv" MAP 0x818FB1 KfAxUbAyUbSstxUbSstyUbWUb 10200. nmot_ub_q40 0.00 10200. FORMAT "%5.0"
 /begin AXIS_DESCR STD_AXIS fho fak_ub_b4 4 0.00 3.984 FORMAT "%5.3" DEPOSIT ABSOLUTE /end AXIS_DESCR
 /begin AXIS_DESCR STD_AXIS nstat nmot_ub_q10 4 0.00 2550. FORMAT "%5.0" DEPOSIT ABSOLUTE /end AXIS_DESCR
/end CHARACTERISTIC
/begin CHARACTERISTIC KFQTE "Kennfeld Auf-/Absteuergeschwindigkeit der Sollspülrate Tankentlüftung" MAP 0x81A354 GkfWUb 0.0121593164 perio_ub_b0p012207 0.00 0.0121593164 FORMAT "%12.10" /begin AXIS_DESCR COM_AXIS ml m_ub_b1020 6 0.00 1020. AXIS_PTS_REF SML06TEUB /end AXIS_DESCR
 /begin AXIS_DESCR COM_AXIS frmit fak_ub_b2 5 0.00 1.992 AXIS_PTS_REF SFR05TEUB /end AXIS_DESCR
/end CHARACTERISTIC
/begin CHARACTERISTIC KFTADMS "dynamischer Bewertungsfaktor für das Absteuern des TEV" MAP 0x8176BA KfAxUbAyUbSstxSbSstyUbWUb 1.992 fak_ub_b2 0.00 1.992 FORMAT "%5.3"
 /begin AXIS_DESCR STD_AXIS dmssginr fak_sb_b1 5 -1.000 0.9922 FORMAT "%5.3" DEPOSIT ABSOLUTE /end AXIS_DESCR
 /begin AXIS_DESCR STD_AXIS nmot nmot_ub_q40 4 0.00 10200. FORMAT "%5.0" DEPOSIT ABSOLUTE /end AXIS_DESCR
/end CHARACTERISTIC
/begin CHARACTERISTIC KFTATX "Kennfeld für maximales Tastverhältnis" MAP 0x81A372 KfAxUbAyUbSstxUbSstyUbWUb 99.61 rel_ub_b99p6 0.00 99.61 FORMAT "%5.2"
 /begin AXIS_DESCR STD_AXIS nmot nmot_ub_q40 10 0.00 10200. FORMAT "%5.0" DEPOSIT ABSOLUTE /end AXIS_DESCR
 /begin AXIS_DESCR STD_AXIS pspu fak_ub_b2 6 0.00 1.992 FORMAT "%5.3" DEPOSIT ABSOLUTE /end AXIS_DESCR
/end CHARACTERISTIC
/begin CHARACTERISTIC KFTEKA "Kennfeld Sollkraftstoffanteil bei Regenerierung" MAP 0x827F26 KfAxUbAyUbSstxUbSstyUbWSb 0.9922 fak_sb_b1 0.00 0.9922
 /begin AXIS_DESCR STD_AXIS nmot nmot_ub_q40 5 0.00 10200. FORMAT "%5.0" DEPOSIT ABSOLUTE /end AXIS_DESCR
 /begin AXIS_DESCR STD_AXIS rl rel_ub_q0p75 5 0.00 191.3 FORMAT "%5.1" DEPOSIT ABSOLUTE /end AXIS_DESCR
/end CHARACTERISTIC
/begin CHARACTERISTIC KFZW_UM "Kennfeld für optimalen Zündwinkel in der Funktionsüberwachung" MAP 0x8140E0 GkfWSb 191.3 zw_sb_q0p75 -96.00 95.25 FORMAT "%5.2"
 /begin AXIS_DESCR COM_AXIS rl_um rel_ub_q0p75 8 0.00 191.3 AXIS_PTS_REF RLV08_UM /end AXIS_DESCR
 /begin AXIS_DESCR COM_AXIS nmot_um nmot_ub_q40 8 0.00 10200. AXIS_PTS_REF NZWV08_UM /end AXIS_DESCR
/end CHARACTERISTIC
/begin CHARACTERISTIC KHCTEAMX "Maximalwert HC-Konzentration Regeneriergas Tankentlüftung (bei B_abor)" VALUE 0x81A3C0 KwSb 3.984 fak_sb_b2 -2.000 1.984 FORMAT "%5.3" /end CHARACTERISTIC
/begin CHARACTERISTIC KHCTEMN "Minimalwert HC-Konzentration Regeneriergas Tankentlüftung" VALUE 0x81A3C1 KwSb 3.984 fak_sb_b2 -2.000 1.984 FORMAT "%5.3" /end CHARACTERISTIC
/begin CHARACTERISTIC KHCTEMX "Maximalwert HC-Konzentration Regeneriergas Tankentlüftung" VALUE 0x81A3C2 KwSb 3.984 fak_sb_b2 -2.000 1.984 FORMAT "%5.3" /end CHARACTERISTIC
/begin CHARACTERISTIC KLDNFHO "Wichtung Minimaler Drehzahlanstieg für erkannte Verbrennung" CURVE 0x818FCB KlAUbSstUbWUb 1.992 fak_ub_b2 0.00 1.992 FORMAT "%5.3"
 /begin AXIS_DESCR STD_AXIS fho fak_ub_b4 4 0.00 3.984 FORMAT "%5.3" DEPOSIT ABSOLUTE /end AXIS_DESCR
/end CHARACTERISTIC
/begin CHARACTERISTIC KLETAZW_UM "ZW-Wirkungsgrad in Abhängigkeit von delta ZW in der Funktionsüberwachung" CURVE 0x814120 KlAUbSstUbWUb 127.5 rel_ub_b127p5 0.00 127.5 FORMAT "%5.1"
 /begin AXIS_DESCR STD_AXIS dzw_um zw_ub_q0p75 8 0.00 191.3 FORMAT "%5.1" DEPOSIT ABSOLUTE /end AXIS_DESCR
/end CHARACTERISTIC
/begin CHARACTERISTIC KLOGIN "Login-Code für Kundendienst" VALUE 0x815CC2 KwUw 65535.00 dez 0.00 65535.00 FORMAT "%8.2" /end CHARACTERISTIC
/begin CHARACTERISTIC KLOSCKL "" CURVE 0x81C4D8 KlAUbSstUwWUb 7.000 dez 0.00 7.000 FORMAT "%5.3"
 /begin AXIS_DESCR STD_AXIS oscdktf_w fak_uw_b16 16 0.00 15.99976 FORMAT "%8.5" DEPOSIT ABSOLUTE /end AXIS_DESCR
/end CHARACTERISTIC
/begin CHARACTERISTIC KSTA0INI "Initialisierungswert STADAP-Faktor in Bereich 0" VALUE 0x8110B8 KwUb 1.992 fak_ub_b2 0.00 1.992 FORMAT "%5.3" /end CHARACTERISTIC
/begin CHARACTERISTIC KSTA1INI "Initialisierungswert STADAP-Faktor in Bereich 1" VALUE 0x8110B9 KwUb 1.992 fak_ub_b2 0.00 1.992 FORMAT "%5.3" /end CHARACTERISTIC
/begin CHARACTERISTIC KSTA2INI "Initialisierungswert STADAP-Faktor in Bereich 2" VALUE 0x8110BA KwUb 1.992 fak_ub_b2 0.00 1.992 FORMAT "%5.3" /end CHARACTERISTIC
/begin CHARACTERISTIC KSTAI "Arbeitsbereiche für STADAP-Faktoren" CURVE 0x8110BB KlAUbSstUbWUb 255.0 dez 0.00 255.0 FORMAT "%5.1"
 /begin AXIS_DESCR STD_AXIS tmst temp_ub_q0p75_o48 12 -48.00 143.3 FORMAT "%5.1" DEPOSIT ABSOLUTE /end AXIS_DESCR
/end CHARACTERISTIC
/begin CHARACTERISTIC KSTAMN0 "Min-Begrenzung des STADAP-Faktors in Bereich 0" VALUE 0x8110D4 KwUb 1.992 fak_ub_b2 0.00 1.992 FORMAT "%5.3" /end CHARACTERISTIC
/begin CHARACTERISTIC KSTAMN1 "Min-Begrenzung des STADAP-Faktors in Bereich 1" VALUE 0x8110D5 KwUb 1.992 fak_ub_b2 0.00 1.992 FORMAT "%5.3" /end CHARACTERISTIC
/begin CHARACTERISTIC KSTAMN2 "Min-Begrenzung des STADAP-Faktors in Bereich 2" VALUE 0x8110D6 KwUb 1.992 fak_ub_b2 0.00 1.992 FORMAT "%5.3" /end CHARACTERISTIC
/begin CHARACTERISTIC KSTAMX0 "Max-Begrenzung des STADAP-Faktors in Bereich 0" VALUE 0x8110D7 KwUb 0.9922 fak_ub_b2 1.000 1.992 FORMAT "%5.3" /end CHARACTERISTIC
/begin CHARACTERISTIC KSTAMX1 "Max-Begrenzung des STADAP-Faktors in Bereich 1" VALUE 0x8110D8 KwUb 0.9922 fak_ub_b2 1.000 1.992 FORMAT "%5.3" /end CHARACTERISTIC
/begin CHARACTERISTIC KSTAMX2 "Max-Begrenzung des STADAP-Faktors in Bereich 2" VALUE 0x8110D9 KwUb 0.9922 fak_ub_b2 1.000 1.992 FORMAT "%5.3" /end CHARACTERISTIC
/begin CHARACTERISTIC KSTTOPMN "Minimale Betriebsdauer seit PWF für Startmengenadaption" VALUE 0x815832 KwUw 393210.0 t6minxmin_q6 0.00 393210.0 FORMAT "%8.1" /end CHARACTERISTIC
/begin CHARACTERISTIC LAMTEMN "minimale Lambda-Schwelle, bei der die Tankentlüftung aktiv sein kann" VALUE 0x827EDC KwUw 15.99976 fak_uw_b16 0.00 15.99976 FORMAT "%8.5" /end CHARACTERISTIC
/begin CHARACTERISTIC LAMTEMX "maximale Lambda-Schwelle, bei der die Tankentlüftung aktiv sein kann" VALUE 0x827EDE KwUw 15.99976 fak_uw_b16 0.00 15.99976 FORMAT "%8.5" /end CHARACTERISTIC
/begin CHARACTERISTIC LUEN1LOGIN "Login-Code für Drehzahlfenster 1 aktiv (Lüftersteuerung)" VALUE 0x815CC4 KwUw 65535.00 dez 0.00 65535.00 FORMAT "%8.2" /end CHARACTERISTIC
/begin CHARACTERISTIC LUEN2LOGIN "Login-Code für Drehzahlfenster 2 aktiv (Lüftersteuerung)" VALUE 0x815CC6 KwUw 65535.00 dez 0.00 65535.00 FORMAT "%8.2" /end CHARACTERISTIC
/begin CHARACTERISTIC LUEN3LOGIN "Login-Code für Drehzahlfenster 3 aktiv (Lüftersteuerung)" VALUE 0x815CC8 KwUw 65535.00 dez 0.00 65535.00 FORMAT "%8.2" /end CHARACTERISTIC
/begin CHARACTERISTIC MDR_AOG "oberer Grenzwert Anpassung Momentenreserve Leerlaufregelung" VALUE 0x8115A1 KwUb 24.90 rel_ub_b25 0.00 24.90 FORMAT "%5.2" /end CHARACTERISTIC
/begin CHARACTERISTIC MDR_AUG "unterer Grenzwert Anpassung Momentenreserve Leerlaufregelung" VALUE 0x8115A2 KwUb 24.90 rel_ub_b25 0.00 24.90 FORMAT "%5.2" /end CHARACTERISTIC
/begin CHARACTERISTIC MSDKLMMN "minimaler Massenstrom über Drosselklappe in TE" VALUE 0x8176DA KwUw 6553.500 m_uw_b6553p5 0.00 6553.500 FORMAT "%8.3" /end CHARACTERISTIC
/begin CHARACTERISTIC MSRC_T_UM "Fehlerzeit für MSR-Eingriff-Überwachung der Funktionsüberwachung" VALUE 0x81407A KwUb 10200.0 t40ms_ub_b10200 0.00 10200.0 FORMAT "%7.1" /end CHARACTERISTIC
/begin CHARACTERISTIC MVER_T_UM "Fehlerzeit beim Momentenvergleich in der Funktionsüberwachung" VALUE 0x8141FC KwUb 10200.0 t40ms_ub_b10200 0.00 10200.0 FORMAT "%7.1" /end CHARACTERISTIC
/begin CHARACTERISTIC MWNTKB0 "Meßwert lesen normiert Testerkommunikation Block 0" VAL_BLK 0x81ED20 KwbUw 65535.00 dez 0.00 65535.00 FORMAT "%8.2" NUMBER 36 /end CHARACTERISTIC
/begin CHARACTERISTIC MWNTKB1 "Meßwert lesen normiert Testerkommunikation Block 1" VAL_BLK 0x81ED68 KwbUw 65535.00 dez 0.00 65535.00 FORMAT "%8.2" NUMBER 40 /end CHARACTERISTIC
/begin CHARACTERISTIC MWNTKB10 "Meßwert lesen normiert Testerkommunikation Block 10" VAL_BLK 0x81EDB8 KwbUw 65535.00 dez 0.00 65535.00 FORMAT "%8.2" NUMBER 40 /end CHARACTERISTIC
/begin CHARACTERISTIC MWNTKB11 "Meßwert lesen normiert Testerkommunikation Block 11" VAL_BLK 0x81EE08 KwbUw 65535.00 dez 0.00 65535.00 FORMAT "%8.2" NUMBER 40 /end CHARACTERISTIC
/begin CHARACTERISTIC MWNTKB12 "Meßwert lesen normiert Testerkommunikation Block 12" VAL_BLK 0x81EE58 KwbUw 65535.00 dez 0.00 65535.00 FORMAT "%8.2" NUMBER 40 /end CHARACTERISTIC
/begin CHARACTERISTIC MWNTKB13 "Meßwert lesen normiert Testerkommunikation Block 13" VAL_BLK 0x81EEA8 KwbUw 65535.00 dez 0.00 65535.00 FORMAT "%8.2" NUMBER 40 /end CHARACTERISTIC
/begin CHARACTERISTIC MWNTKB14 "Meßwert lesen normiert Testerkommunikation Block 14" VAL_BLK 0x81EEF8 KwbUw 65535.00 dez 0.00 65535.00 FORMAT "%8.2" NUMBER 40 /end CHARACTERISTIC
/begin CHARACTERISTIC MWNTKB15 "Meßwert lesen normiert Testerkommunikation Block 15" VAL_BLK 0x81EF48 KwbUw 65535.00 dez 0.00 65535.00 FORMAT "%8.2" NUMBER 40 /end CHARACTERISTIC
/begin CHARACTERISTIC MWNTKB16 "Meßwert lesen normiert Testerkommunikation Block 16" VAL_BLK 0x81EF98 KwbUw 65535.00 dez 0.00 65535.00 FORMAT "%8.2" NUMBER 40 /end CHARACTERISTIC
/begin CHARACTERISTIC MWNTKB17 "Meßwert lesen normiert Testerkommunikation Block 17" VAL_BLK 0x81EFE8 KwbUw 65535.00 dez 0.00 65535.00 FORMAT "%8.2" NUMBER 40 /end CHARACTERISTIC
/begin CHARACTERISTIC MWNTKB18 "Meßwert lesen normiert Testerkommunikation Block 18" VAL_BLK 0x81F038 KwbUw 65535.00 dez 0.00 65535.00 FORMAT "%8.2" NUMBER 40 /end CHARACTERISTIC
/begin CHARACTERISTIC MWNTKB19 "Meßwert lesen normiert Testerkommunikation Block 19" VAL_BLK 0x81F088 KwbUw 65535.00 dez 0.00 65535.00 FORMAT "%8.2" NUMBER 40 /end CHARACTERISTIC
/begin CHARACTERISTIC MWNTKB2 "Meßwert lesen normiert Testerkommunikation Block 2" VAL_BLK 0x81F0D8 KwbUw 65535.00 dez 0.00 65535.00 FORMAT "%8.2" NUMBER 40 /end CHARACTERISTIC
/begin CHARACTERISTIC MWNTKB20 "Meßwert lesen normiert Testerkommunikation Block 20" VAL_BLK 0x81F128 KwbUw 65535.00 dez 0.00 65535.00 FORMAT "%8.2" NUMBER 40 /end CHARACTERISTIC
/begin CHARACTERISTIC MWNTKB21 "Meßwert lesen normiert Testerkommunikation Block 21" VAL_BLK 0x81F178 KwbUw 65535.00 dez 0.00 65535.00 FORMAT "%8.2" NUMBER 40 /end CHARACTERISTIC
/begin CHARACTERISTIC MWNTKB22 "Meßwert lesen normiert Testerkommunikation Block 22" VAL_BLK 0x81F1C8 KwbUw 65535.00 dez 0.00 65535.00 FORMAT "%8.2" NUMBER 40 /end CHARACTERISTIC
/begin CHARACTERISTIC MWNTKB23 "Meßwert lesen normiert Testerkommunikation Block 23" VAL_BLK 0x81F218 KwbUw 65535.00 dez 0.00 65535.00 FORMAT "%8.2" NUMBER 40 /end CHARACTERISTIC
/begin CHARACTERISTIC MWNTKB24 "Meßwert lesen normiert Testerkommunikation Block 24" VAL_BLK 0x81F268 KwbUw 65535.00 dez 0.00 65535.00 FORMAT "%8.2" NUMBER 40 /end CHARACTERISTIC
/begin CHARACTERISTIC MWNTKB25 "Meßwert lesen normiert Testerkommunikation Block 25" VAL_BLK 0x81F2B8 KwbUw 65535.00 dez 0.00 65535.00 FORMAT "%8.2" NUMBER 24 /end CHARACTERISTIC
/begin CHARACTERISTIC MWNTKB3 "Meßwert lesen normiert Testerkommunikation Block 3" VAL_BLK 0x81F2E8 KwbUw 65535.00 dez 0.00 65535.00 FORMAT "%8.2" NUMBER 40 /end CHARACTERISTIC
/begin CHARACTERISTIC MWNTKB4 "Meßwert lesen normiert Testerkommunikation Block 4" VAL_BLK 0x81F338 KwbUw 65535.00 dez 0.00 65535.00 FORMAT "%8.2" NUMBER 40 /end CHARACTERISTIC
/begin CHARACTERISTIC MWNTKB5 "Meßwert lesen normiert Testerkommunikation Block 5" VAL_BLK 0x81F388 KwbUw 65535.00 dez 0.00 65535.00 FORMAT "%8.2" NUMBER 40 /end CHARACTERISTIC
/begin CHARACTERISTIC MWNTKB6 "Meßwert lesen normiert Testerkommunikation Block 6" VAL_BLK 0x81F3D8 KwbUw 65535.00 dez 0.00 65535.00 FORMAT "%8.2" NUMBER 40 /end CHARACTERISTIC
/begin CHARACTERISTIC MWNTKB7 "Meßwert lesen normiert Testerkommunikation Block 7" VAL_BLK 0x81F428 KwbUw 65535.00 dez 0.00 65535.00 FORMAT "%8.2" NUMBER 40 /end CHARACTERISTIC
/begin CHARACTERISTIC MWNTKB8 "Meßwert lesen normiert Testerkommunikation Block 8" VAL_BLK 0x81F478 KwbUw 65535.00 dez 0.00 65535.00 FORMAT "%8.2" NUMBER 40 /end CHARACTERISTIC
/begin CHARACTERISTIC MWNTKB9 "Meßwert lesen normiert Testerkommunikation Block 9" VAL_BLK 0x81F4C8 KwbUw 65535.00 dez 0.00 65535.00 FORMAT "%8.2" NUMBER 40 /end CHARACTERISTIC
/begin CHARACTERISTIC MZFFIL_UM "Filter-Zeitkonstante für verzögertes Moment in der Funktionsüberwachung" VALUE 0x8141FA KwUb 10159.4 zk40ms_ub_b10200 40.6299 10200.0 FORMAT "%7.1" /end CHARACTERISTIC
/begin CHARACTERISTIC MZFTV_UM "Verzugszeit für zulässiges Moment mz_um in der Funktionsüberwachg" VALUE 0x8141FB KwUb 280.000 t40ms_ub_b10200 40.0000 320.000 FORMAT "%7.3" /end CHARACTERISTIC
/begin CHARACTERISTIC NLS_AOG "oberer Grenzwert Anpassung LL-Solldrehzahl" VALUE 0x8115A3 KwSb 2550. nmot_q10 -1280. 1270. FORMAT "%5.0" /end CHARACTERISTIC
/begin CHARACTERISTIC NLS_AUG "unterer Grenzwert Anpassung LL-Solldrehzahl" VALUE 0x8115A4 KwSb 2550. nmot_q10 -1280. 1270. FORMAT "%5.0" /end CHARACTERISTIC
/begin AXIS_PTS NMV08_UM "Stützstellenverteilung für Motordrehzahl in der Funktionsüberwachung" 0x81407C nmot_um SstAUbSstUb 10200. nmot_ub_q40 8 0.00 10200. FORMAT "%5.0" DEPOSIT ABSOLUTE /end AXIS_PTS
/begin CHARACTERISTIC NOASR_UM "Inaktivmaske für ASR" VALUE 0x81407B KwUb 99.61 rel_ub_q0p3906 0.00 99.61 FORMAT "%5.2" /end CHARACTERISTIC
/begin CHARACTERISTIC NSTAK "Anlassdrehzahlschwelle für Hochlauferkennung" VALUE 0x815834 KwUw 16383.75 nmot_uw_q0p25 0.00 16383.75 FORMAT "%8.2" /end CHARACTERISTIC
/begin CHARACTERISTIC NVERZMN "minimale Drehzahl für Verzögerung" VALUE 0x8176DC KwUw 16383.75 nmot_uw_q0p25 0.00 16383.75 FORMAT "%8.2" /end CHARACTERISTIC
/begin AXIS_PTS NZWV08_UM "" 0x814085 nmot_um SstAUbSstUb 10200. nmot_ub_q40 8 0.00 10200. FORMAT "%5.0" DEPOSIT ABSOLUTE /end AXIS_PTS
/begin AXIS_PTS RLV08_UM "Stutzstellenverteilung für Lastinfo in der Funktionsüberwachung" 0x81408E rl_um SstAUbSstUb 191.3 rel_ub_q0p75 8 0.00 191.3 FORMAT "%5.1" DEPOSIT ABSOLUTE /end AXIS_PTS
/begin CHARACTERISTIC RLX_AOG "oberer Grenzwert Anpassung maximaler Ladedruck" VALUE 0x8115A5 KwUb 0.9961 fak_ub_b1 0.00 0.9961 /end CHARACTERISTIC
/begin CHARACTERISTIC RLX_AUG "unterer Grenzwert Anpassung maximaler Ladedruck" VALUE 0x8115A6 KwUb 0.9961 fak_ub_b1 0.00 0.9961 /end CHARACTERISTIC
/begin AXIS_PTS SDK10TEUB "wdkba abhängige Stützstellen (Anzahl 10)" 0x8181C6 wdkba SstAUbSstUb 100.0 relDK_ub_b100 10 0.00 100.0 FORMAT "%5.1" DEPOSIT ABSOLUTE /end AXIS_PTS
/begin AXIS_PTS SEZ06TMUB "Stützstellenverteilung, Zündwinkelwirkungsgrad" 0x8181D1 etazwimt SstAUbSstUb 127.5 rel_ub_b127p5 6 0.00 127.5 FORMAT "%5.1" DEPOSIT ABSOLUTE /end AXIS_PTS
/begin AXIS_PTS SFR05TEUB "frmit abhängige Stützstellen (Anzahl 5)" 0x8181D8 frmit SstAUbSstUb 1.992 fak_ub_b2 5 0.00 1.992 FORMAT "%5.3" DEPOSIT ABSOLUTE /end AXIS_PTS
/begin AXIS_PTS SGA06MDUB "Stützstellenverteilung Ist Gang 6 Sst." 0x81AE6C gangi SstAUbSstUb 255.0 dez 6 0.00 255.0 FORMAT "%5.1" DEPOSIT ABSOLUTE /end AXIS_PTS
/begin AXIS_PTS SGA08MDUB "Stützstellenverteilung Ist Gang 8 Sst." 0x81005F gangi SstAUbSstUb 255.0 dez 8 0.00 255.0 FORMAT "%5.1" DEPOSIT ABSOLUTE /end AXIS_PTS
/begin CHARACTERISTIC SGIDB1 "BOSCH-Hardwarenummer" ASCII 0x8115A7 KwbUb 255.0 KennText 0.00 255.0 FORMAT "%5.1" NUMBER 12 /end CHARACTERISTIC
/begin CHARACTERISTIC SGIDB2 "BOSCH-Softwarenummer" ASCII 0x8115B3 KwbUb 255.0 KennText 0.00 255.0 FORMAT "%5.1" NUMBER 20 /end CHARACTERISTIC
/begin CHARACTERISTIC SGIDB3 "Kunden-Teilenummer" ASCII 0x8115C7 KwbUb 255.0 KennText 0.00 255.0 FORMAT "%5.1" NUMBER 4 /end CHARACTERISTIC
/begin AXIS_PTS SIM06ESUW "SST-Verteilung für integrierten Luftmassenstrom ab Startende" 0x81AE74 imlatm_w SstAUwSstUw 23.30133 m_uw_b23p3 6 0.00 23.30133 FORMAT "%8.5" DEPOSIT ABSOLUTE /end AXIS_PTS
/begin AXIS_PTS SKS06ESUB "SST-Verteilung für den Startadaptionsfaktor kstaa" 0x810068 kstaa SstAUbSstUb 1.992 fak_ub_b2 6 0.00 1.992 FORMAT "%5.3" DEPOSIT ABSOLUTE /end AXIS_PTS
/begin AXIS_PTS SLA05ESUB "Stützstellenverteilung Regelabweichung Lambda, 5 Sst." 0x81340E ladiff_w SstAUwSstUw 1.999969 fak_sw_b1 5 0.00 1.999969 FORMAT "%8.6" DEPOSIT ABSOLUTE /end AXIS_PTS
/begin AXIS_PTS SLD04LDUB "Stützstellenverteilung für Ladedruckregelung" 0x81006F lde SstAUbSstUb 2550. p_sb_q10 4 0.00 2550. FORMAT "%5.0" DEPOSIT ABSOLUTE /end AXIS_PTS
/begin CHARACTERISTIC SLOGIN "Login-Code für Entwicklung" VALUE 0x815CCA KwUw 65535.00 dez 0.00 65535.00 FORMAT "%8.2" /end CHARACTERISTIC
/begin AXIS_PTS SLX06TMUW "Stützstellenverteilung, Lambdasoll" 0x81AE82 lamsbg_w SstAUwSstUw 15.99976 fak_uw_b16 6 0.00 15.99976 FORMAT "%8.5" DEPOSIT ABSOLUTE /end AXIS_PTS
/begin AXIS_PTS SM108LHSW "dlashk_w abhängige Stützstellen (Anzahl 8)" 0x81AE90 dlashkm_w SstASwSstSw 1.999969 fak_sw_b1 8 -1.000000 0.9999695 FORMAT "%8.6" DEPOSIT ABSOLUTE /end AXIS_PTS
/begin AXIS_PTS SMI04LLUB "Stützstellenverteilung: ind. Moment für Momentenreserve" 0x81341A mifa_w SstAUwSstUw 99.99847 rel_uw_b100 4 0.00 99.99847 FORMAT "%8.5" DEPOSIT ABSOLUTE /end AXIS_PTS
/begin AXIS_PTS SML06TEUB "ml abhängige Stützstellen (Anzahl 6)" 0x8181DE ml SstAUbSstUb 1020. m_ub_b1020 6 0.00 1020. FORMAT "%5.0" DEPOSIT ABSOLUTE /end AXIS_PTS
/begin AXIS_PTS SML06TMUW "Stützstellenverteilung, Luftmasse, 6 Stützstellen" 0x81AEA2 ml_w SstAUwSstUw 6553.500 m_uw_b6553p5 6 0.00 6553.500 FORMAT "%8.3" DEPOSIT ABSOLUTE /end AXIS_PTS
/begin AXIS_PTS SML07TMUW "Stützstellenverteilung, Luftmasse, 7 Stützstellen" 0x81AEB0 ml_w SstAUwSstUw 6553.500 m_uw_b6553p5 7 0.00 6553.500 FORMAT "%8.3" DEPOSIT ABSOLUTE /end AXIS_PTS
/begin AXIS_PTS SML08LHUB "ml abhängige Stützstellen (Anzahl 8)" 0x8181E5 ml SstAUbSstUb 1020. m_ub_b1020 8 0.00 1020. FORMAT "%5.0" DEPOSIT ABSOLUTE /end AXIS_PTS
/begin AXIS_PTS SMT06TMUW "Stützstellenverteilung, Luftmasse, 6 Stützstellen" 0x81AEC0 ml_w SstAUwSstUw 6553.500 m_uw_b6553p5 6 0.00 6553.500 FORMAT "%8.3" DEPOSIT ABSOLUTE /end AXIS_PTS
/begin AXIS_PTS SNG06LLSB "Stützstellenverteilung Drehzahlgradient, 6 Sst." 0x810074 ngfil SstAUbSstSb 25500. nmotg_sb_q100 6 -12800. 12700. FORMAT "%5.0" DEPOSIT ABSOLUTE /end AXIS_PTS
/begin AXIS_PTS SNM05NEUW "Drehzahlstützstellen Nockenwellensollwinkel Einlaß" 0x813424 nmot_w SstAUwSstUw 16383.75 nmot_uw_q0p25 5 0.00 16383.75 FORMAT "%8.2" DEPOSIT ABSOLUTE /end AXIS_PTS
/begin AXIS_PTS SNM05NWUB "Drehzahlstützstellen Nockenwellensollwinkel" 0x8181EE nmot SstAUbSstUb 10200. nmot_ub_q40 5 0.00 10200. FORMAT "%5.0" DEPOSIT ABSOLUTE /end AXIS_PTS
/begin AXIS_PTS SNM06ESUB "SST-Verteilung für Drehzahl" 0x8181F4 nmot SstAUbSstUb 10200. nmot_ub_q40 6 0.00 10200. FORMAT "%5.0" DEPOSIT ABSOLUTE /end AXIS_PTS
/begin AXIS_PTS SNM06GKUB "Stützstellen KFLAMKR, DLAMOB" 0x8181FB nmot SstAUbSstUb 10200. nmot_ub_q40 6 0.00 10200. FORMAT "%5.0" DEPOSIT ABSOLUTE /end AXIS_PTS
/begin AXIS_PTS SNM06LLUB "Sützstellenverteilung für Motordrehzahl" 0x813430 nmot_w SstAUwSstUw 16383.75 nmot_uw_q0p25 6 0.00 16383.75 FORMAT "%8.2" DEPOSIT ABSOLUTE /end AXIS_PTS
/begin AXIS_PTS SNM06MDUW "Stützstellenverteilung Motordrehzahl (nmot_w), 6 Stützstellen" 0x81AECE nmot_w SstAUwSstUw 16383.75 nmot_uw_q0p25 6 0.00 16383.75 FORMAT "%8.2" DEPOSIT ABSOLUTE /end AXIS_PTS
/begin AXIS_PTS SNM07ESUB "Stützstellenverteilung Drehzahl, 7 Sst." 0x818202 nmot SstAUbSstUb 10200. nmot_ub_q40 7 0.00 10200. FORMAT "%5.0" DEPOSIT ABSOLUTE /end AXIS_PTS
/begin AXIS_PTS SNM07LSUW "Stützstellenverteilung Reglerparameter LRS" 0x81343E nmot_w SstAUwSstUw 16383.75 nmot_uw_q0p25 7 0.00 16383.75 FORMAT "%8.2" DEPOSIT ABSOLUTE /end AXIS_PTS
/begin AXIS_PTS SNM08DMUB "SST-Verteilung in DMD, 8 Drehzahl-SST" 0x81007B nmot SstAUbSstUb 10200. nmot_ub_q40 8 0.00 10200. FORMAT "%5.0" DEPOSIT ABSOLUTE /end AXIS_PTS
/begin AXIS_PTS SNM08FEUB "Stützstellenverteilung Drehzahl, 08 Sst., Füllungseingriffe" 0x81820A nmot SstAUbSstUb 10200. nmot_ub_q40 8 0.00 10200. FORMAT "%5.0" DEPOSIT ABSOLUTE /end AXIS_PTS
/begin AXIS_PTS SNM08LDUB "Stützstellenverteilung für Ladedruckregelung" 0x810084 nmot SstAUbSstUb 10200. nmot_ub_q40 8 0.00 10200. FORMAT "%5.0" DEPOSIT ABSOLUTE /end AXIS_PTS
/begin AXIS_PTS SNM08LDUW "Stützstellenverteilung für Ladedruckregelung" 0x81344E nmot_w SstAUwSstUw 16383.75 nmot_uw_q0p25 8 0.00 16383.75 FORMAT "%8.2" DEPOSIT ABSOLUTE /end AXIS_PTS
/begin AXIS_PTS SNM08LHUB "nmot abhängige Stützstellen (Anzahl 8)" 0x818213 nmot SstAUbSstUb 10200. nmot_ub_q40 8 0.00 10200. FORMAT "%5.0" DEPOSIT ABSOLUTE /end AXIS_PTS
/begin AXIS_PTS SNM08OPUB "Stützstellenverteilung für Motordrehzahl nmot" 0x81008D nmot SstAUbSstUb 10200. nmot_ub_q40 8 0.00 10200. FORMAT "%5.0" DEPOSIT ABSOLUTE /end AXIS_PTS
/begin AXIS_PTS SNM08__UB "Stützstellenverteilung Drehzahl, 8 Sst." 0x81821C nmot SstAUbSstUb 10200. nmot_ub_q40 8 0.00 10200. FORMAT "%5.0" DEPOSIT ABSOLUTE /end AXIS_PTS
/begin AXIS_PTS SNM10LSUB "Stützstellenverteilung Kat-Vorsteuerwert LRS" 0x810096 nmot SstAUbSstUb 10200. nmot_ub_q40 10 0.00 10200. FORMAT "%5.0" DEPOSIT ABSOLUTE /end AXIS_PTS
/begin AXIS_PTS SNM10TEUB "nmot abhängige Stützstellen (Anzahl 10)" 0x818225 nmot SstAUbSstUb 10200. nmot_ub_q40 10 0.00 10200. FORMAT "%5.0" DEPOSIT ABSOLUTE /end AXIS_PTS
/begin AXIS_PTS SNM12ESUB "SST-Verteilung für die Motordrehzahl nmot" 0x8100A1 nmot SstAUbSstUb 10200. nmot_ub_q40 12 0.00 10200. FORMAT "%5.0" DEPOSIT ABSOLUTE /end AXIS_PTS
/begin AXIS_PTS SNM12FEUB "Stützstellen für WDKSMX, WDKUGDN" 0x8100AE nmot SstAUbSstUb 10200. nmot_ub_q40 12 0.00 10200. FORMAT "%5.0" DEPOSIT ABSOLUTE /end AXIS_PTS
/begin AXIS_PTS SNM12LDUW "Stützstellenverteilung für Ladedruckregelung" 0x813460 nmot_w SstAUwSstUw 16383.75 nmot_uw_q0p25 12 0.00 16383.75 FORMAT "%8.2" DEPOSIT ABSOLUTE /end AXIS_PTS
/begin AXIS_PTS SNM16CIUB "Stützstellenverteilung Drehzahl, 16 Sst." 0x818230 nmot SstAUbSstUb 10200. nmot_ub_q40 16 0.00 10200. FORMAT "%5.0" DEPOSIT ABSOLUTE /end AXIS_PTS
/begin AXIS_PTS SNM16KRDYUB "" 0x818241 nmot SstAUbSstUb 10200. nmot_ub_q40 16 0.00 10200. FORMAT "%5.0" DEPOSIT ABSOLUTE /end AXIS_PTS
/begin AXIS_PTS SNM16KRUB "Stützstellenverteilung Drehzahl, 16 Sst." 0x818252 nmot SstAUbSstUb 10200. nmot_ub_q40 16 0.00 10200. FORMAT "%5.0" DEPOSIT ABSOLUTE /end AXIS_PTS
/begin AXIS_PTS SNM16LDUB "Stützstellenverteilung für Ladedruckregelung" 0x8100BB nmot SstAUbSstUb 10200. nmot_ub_q40 16 0.00 10200. FORMAT "%5.0" DEPOSIT ABSOLUTE /end AXIS_PTS
/begin AXIS_PTS SNM16LDUW "Stützstellenverteilung für Ladedruckregelung" 0x81347A nmot_w SstAUwSstUw 16383.75 nmot_uw_q0p25 16 0.00 16383.75 FORMAT "%8.2" DEPOSIT ABSOLUTE /end AXIS_PTS
/begin AXIS_PTS SNM16NEUW "Drehzahlstützstellen Nockenwellensollwinkel Einlaß" 0x81349C nmot_w SstAUwSstUw 16383.75 nmot_uw_q0p25 16 0.00 16383.75 FORMAT "%8.2" DEPOSIT ABSOLUTE /end AXIS_PTS
/begin AXIS_PTS SNM16OPUW "Stützstellenverteilung Drehzahl" 0x8134BE nmot_w SstAUwSstUw 16383.75 nmot_uw_q0p25 16 0.00 16383.75 FORMAT "%8.2" DEPOSIT ABSOLUTE /end AXIS_PTS
/begin AXIS_PTS SNM16ZUUW "Stützstellenverteilung Drehzahl, 16 Sst." 0x8134E0 nmot_w SstAUwSstUw 16383.75 nmot_uw_q0p25 16 0.00 16383.75 FORMAT "%8.2" DEPOSIT ABSOLUTE /end AXIS_PTS
/begin AXIS_PTS SPSNV08_UM "Stützstellenverteilung für Pedalwert in der Funktionsüberwachung" 0x814097 spsn_um SstAUbSstUb 4.9805 spg_ub_q0p019 8 0.00 4.9805 DEPOSIT ABSOLUTE /end AXIS_PTS
/begin AXIS_PTS SPU08LDUB "Stützstellenverteilung für Ladedruckregelung" 0x8100CC pu SstAUbSstUb 1275. p_ub_q5 8 0.00 1275. FORMAT "%5.0" DEPOSIT ABSOLUTE /end AXIS_PTS
/begin AXIS_PTS SQM05TEUB "Luftmassenquotient-abhängige Stützstellen (Anzahl =5)" 0x8100D5 qmsdyn SstAUbSstUb 15.94 fak_ub_b16 5 0.00 15.94 FORMAT "%5.2" DEPOSIT ABSOLUTE /end AXIS_PTS
/begin AXIS_PTS SRL03KRUB "Stützstellenverteilung relative Füllung, 3 Sst." 0x818263 rl SstAUbSstUb 191.3 rel_ub_q0p75 3 0.00 191.3 FORMAT "%5.1" DEPOSIT ABSOLUTE /end AXIS_PTS
/begin AXIS_PTS SRL04KRUB "Stützstellenverteilung relative Füllung, 4 Sst." 0x818267 rl SstAUbSstUb 191.3 rel_ub_q0p75 4 0.00 191.3 FORMAT "%5.1" DEPOSIT ABSOLUTE /end AXIS_PTS
/begin AXIS_PTS SRL05NEUW "Laststützstellen Nockenwellensollwinkel Einlaß" 0x813502 rlnw_w SstAUwSstUw 1535.977 rel_uw_q0p0234 5 0.00 1535.977 FORMAT "%8.3" DEPOSIT ABSOLUTE /end AXIS_PTS
/begin AXIS_PTS SRL06ESUB "Sst-Verteilung für die relative Füllung rl" 0x8100DB rl SstAUbSstUb 191.3 rel_ub_q0p75 6 0.00 191.3 FORMAT "%5.1" DEPOSIT ABSOLUTE /end AXIS_PTS
/begin AXIS_PTS SRL06GKUB "Stützstellen KFLAMKRL, KFLAFWL, KFLAMKR" 0x81826C rl SstAUbSstUb 191.3 rel_ub_q0p75 6 0.00 191.3 FORMAT "%5.1" DEPOSIT ABSOLUTE /end AXIS_PTS
/begin AXIS_PTS SRL06KRUB "Stützstellenverteilung relative Füllung (rl), 6 Sst." 0x818273 rl SstAUbSstUb 191.3 rel_ub_q0p75 6 0.00 191.3 FORMAT "%5.1" DEPOSIT ABSOLUTE /end AXIS_PTS
/begin AXIS_PTS SRL08DMUB "SST-Verteilung in DMD, 8 Last-SST" 0x8100E2 rl SstAUbSstUb 191.3 rel_ub_q0p75 8 0.00 191.3 FORMAT "%5.1" DEPOSIT ABSOLUTE /end AXIS_PTS
/begin AXIS_PTS SRL08LSUW "Stützstellenverteilung Reglerparameter" 0x81350E rl_w SstAUwSstUw 1535.977 rel_uw_q0p0234 8 0.00 1535.977 FORMAT "%8.3" DEPOSIT ABSOLUTE /end AXIS_PTS
/begin AXIS_PTS SRL08NEUW "Laststützstellen Nockenwellensollwinkel Einlaß" 0x813520 rlnw_w SstAUwSstUw 1535.977 rel_uw_q0p0234 8 0.00 1535.977 FORMAT "%8.3" DEPOSIT ABSOLUTE /end AXIS_PTS
/begin AXIS_PTS SRL08NXUB "Stützstellenverteilung relative Luftfüllung 8 Sst." 0x81827A rl SstAUbSstUb 191.3 rel_ub_q0p75 8 0.00 191.3 FORMAT "%5.1" DEPOSIT ABSOLUTE /end AXIS_PTS
/begin AXIS_PTS SRL10LSUB "Stützstellenverteilung Kat-Vorsteuerwert LRS" 0x8100EB rl SstAUbSstUb 191.3 rel_ub_q0p75 10 0.00 191.3 FORMAT "%5.1" DEPOSIT ABSOLUTE /end AXIS_PTS
/begin AXIS_PTS SRL12ZUUW "Stützstellenverteilung relative Luftfüllung, 12 St." 0x813532 rl_w SstAUwSstUw 1535.977 rel_uw_q0p0234 12 0.00 1535.977 FORMAT "%8.3" DEPOSIT ABSOLUTE /end AXIS_PTS
/begin AXIS_PTS SRP06ESUB "SST-Verteilung für rel. Luftfüllung präd. für Einspritzung" 0x8100F6 rlp SstAUbSstUb 191.3 rel_ub_q0p75 6 0.00 191.3 FORMAT "%5.1" DEPOSIT ABSOLUTE /end AXIS_PTS
/begin AXIS_PTS ST107TMUB "Stützstellenverteilung, Starttemperatur an Sonde vorne" 0x818283 tabgmst SstAUbSstUb 1275. temp_ub_q5_o50 7 -50.00 1225. FORMAT "%5.0" DEPOSIT ABSOLUTE /end AXIS_PTS
/begin AXIS_PTS ST307TMUB "Stützstellenverteilung, Starttemperatur an Sonde hinten" 0x81828B tkatmst SstAUbSstUb 1275. temp_ub_q5_o50 7 -50.00 1225. FORMAT "%5.0" DEPOSIT ABSOLUTE /end AXIS_PTS
/begin AXIS_PTS STA04LLUB "Stützstellenverteilung: tans für Momentenreserve" 0x81354C tans SstAUwSstUw 49151.25 temp_ub_q0p75_o48 4 -48.00000 49103.25 FORMAT "%8.2" DEPOSIT ABSOLUTE /end AXIS_PTS
/begin AXIS_PTS STA06ESUB "SST-Verteilung für die Ansauglufttemperatur" 0x818293 tans SstAUbSstUb 191.3 temp_ub_q0p75_o48 6 -48.00 143.3 FORMAT "%5.1" DEPOSIT ABSOLUTE /end AXIS_PTS
/begin AXIS_PTS STA08LDUB "Stützstellenverteilung für Ladedruckregelung" 0x8100FD tans SstAUbSstUb 191.3 temp_ub_q0p75_o48 8 -48.00 143.3 FORMAT "%5.1" DEPOSIT ABSOLUTE /end AXIS_PTS
/begin AXIS_PTS STA12WLUB "SST-Verteilung für die Ansauglufttemperatur" 0x810106 tans SstAUbSstUb 191.3 temp_ub_q0p75_o48 12 -48.00 143.3 FORMAT "%5.1" DEPOSIT ABSOLUTE /end AXIS_PTS
/begin AXIS_PTS STK04SAUB "SST-Verteilung Kattemperatur für Funktion SAWE" 0x81829A tkatm SstAUbSstUb 1275. temp_ub_q5_o50 4 -50.00 1225. FORMAT "%5.0" DEPOSIT ABSOLUTE /end AXIS_PTS
/begin AXIS_PTS STM04FEUB "Stützstellenverteilung Motortemperatur" 0x810113 tmot SstAUbSstUb 191.3 temp_ub_q0p75_o48 4 -48.00 143.3 FORMAT "%5.1" DEPOSIT ABSOLUTE /end AXIS_PTS
/begin AXIS_PTS STM04SAUB "Stützstellenverteilung Motortemperatur, 4 Sst." 0x810118 tmot SstAUbSstUb 191.3 temp_ub_q0p75_o48 4 -48.00 143.3 FORMAT "%5.1" DEPOSIT ABSOLUTE /end AXIS_PTS
/begin AXIS_PTS STM05SAUB "Stützstellenverteilung" 0x81829F tmot SstAUbSstUb 191.3 temp_ub_q0p75_o48 5 -48.00 143.3 FORMAT "%5.1" DEPOSIT ABSOLUTE /end AXIS_PTS
/begin AXIS_PTS STM05TMUB "Stützstellenverteilung, Motorstarttemperatur" 0x8182A5 tmst SstAUbSstUb 191.3 temp_ub_q0p75_o48 5 -48.00 143.3 FORMAT "%5.1" DEPOSIT ABSOLUTE /end AXIS_PTS
/begin AXIS_PTS STM06LLUB "Stützstellenverteilung Motortemperatur, 6 Sst." 0x8182AB tmot SstAUbSstUb 191.3 temp_ub_q0p75_o48 6 -48.00 143.3 FORMAT "%5.1" DEPOSIT ABSOLUTE /end AXIS_PTS
/begin AXIS_PTS STM06__UB "Stützstellenverteilung Motortemperatur, 6 Sst." 0x8182B2 tmot SstAUbSstUb 191.3 temp_ub_q0p75_o48 6 -48.00 143.3 FORMAT "%5.1" DEPOSIT ABSOLUTE /end AXIS_PTS
/begin AXIS_PTS STM08DMUB "8 Motortemperaturstützstellen für DMD" 0x81011D tmot SstAUbSstUb 191.3 temp_ub_q0p75_o48 8 -48.00 143.3 FORMAT "%5.1" DEPOSIT ABSOLUTE /end AXIS_PTS
/begin AXIS_PTS STM08GKUB "8 Motortemperaturstützstellen für KFLAFWL" 0x8182B9 tmot SstAUbSstUb 191.3 temp_ub_q0p75_o48 8 -48.00 143.3 FORMAT "%5.1" DEPOSIT ABSOLUTE /end AXIS_PTS
/begin AXIS_PTS STM09ESUB "Stützstellenverteilung Motortemperatur, 9 Sst." 0x8182C2 tmot SstAUbSstUb 191.3 temp_ub_q0p75_o48 9 -48.00 143.3 FORMAT "%5.1" DEPOSIT ABSOLUTE /end AXIS_PTS
/begin AXIS_PTS STM10__UB "" 0x8182CC tmot SstAUbSstUb 191.3 temp_ub_q0p75_o48 10 -48.00 143.3 FORMAT "%5.1" DEPOSIT ABSOLUTE /end AXIS_PTS
/begin AXIS_PTS STM12ESUB "SST-Verteilung für die Motortemperatur tmot" 0x810126 tmot SstAUbSstUb 191.3 temp_ub_q0p75_o48 12 -48.00 143.3 FORMAT "%5.1" DEPOSIT ABSOLUTE /end AXIS_PTS
/begin AXIS_PTS STN06LLUB "Stützstellenverteilung: Zeit nach Start; für Drehzahlverlauf nach Start" 0x8182D7 tnst SstAUbSstUb 255.0 t1sxs_ub_b255 6 0.00 255.0 FORMAT "%5.1" DEPOSIT ABSOLUTE /end AXIS_PTS
/begin AXIS_PTS STS08ESUB "SST-Verteilung für Motorstarttemperatur" 0x810133 tmst SstAUbSstUb 191.3 temp_ub_q0p75_o48 8 -48.00 143.3 FORMAT "%5.1" DEPOSIT ABSOLUTE /end AXIS_PTS
/begin AXIS_PTS STS08LDUB "Stützstellenverteilung tsel für Ladedruckregelung" 0x81013C tsel SstAUbSstUb 191.3 temp_ub_q0p75_o48 8 -48.00 143.3 FORMAT "%5.1" DEPOSIT ABSOLUTE /end AXIS_PTS
/begin AXIS_PTS STS12ESUB "SST-Verteilung für Motorstarttemperatur" 0x810145 tmst SstAUbSstUb 191.3 temp_ub_q0p75_o48 12 -48.00 143.3 FORMAT "%5.1" DEPOSIT ABSOLUTE /end AXIS_PTS
/begin AXIS_PTS SUV07MDUB "Stützstellenverteilung für die Übertragungsfunktion der Getriebesteuerung" 0x8182DE uefktget SstAUbSstUb 25.50 uefktget_ub_b25p4 7 0.00 25.50 FORMAT "%5.2" DEPOSIT ABSOLUTE /end AXIS_PTS
/begin AXIS_PTS SVP12LDUW "Stützstellenverteilung für vpssplg bei LDR" 0x813556 vpssplg_w SstAUwSstUw 3.999939 fak_uw_b4 12 0.00 3.999939 FORMAT "%8.6" DEPOSIT ABSOLUTE /end AXIS_PTS
/begin AXIS_PTS SWP08OPUB "Stützstellenverteilung für Pedalstellung wped" 0x810152 wped SstAUbSstUb 100.0 relPED_ub_b100 8 0.00 100.0 FORMAT "%5.1" DEPOSIT ABSOLUTE /end AXIS_PTS
/begin CHARACTERISTIC TFTEINI "Zeit für Erkennung TE Stop" VALUE 0x8176DE KwUw 6553.500 t100msxs_uw_b6553p5 0.00 6553.500 FORMAT "%8.3" /end CHARACTERISTIC
/begin CHARACTERISTIC TMADB0 "Motortemperaturbereich 0 für Berechnung Kaltstartanreicherung" VALUE 0x8110DA KwUb 255.0 dez 0.00 255.0 FORMAT "%5.1" /end CHARACTERISTIC
/begin CHARACTERISTIC TMADB1 "Motortemperaturbereich 1 für Berechnung Kaltstartanreicherung" VALUE 0x8110DB KwUb 255.0 dez 0.00 255.0 FORMAT "%5.1" /end CHARACTERISTIC
/begin CHARACTERISTIC TMADB2 "Motortemperaturbereich 2 für Berechnung Kaltstartanreicherung" VALUE 0x8110DC KwUb 255.0 dez 0.00 255.0 FORMAT "%5.1" /end CHARACTERISTIC
/begin CHARACTERISTIC TMLIM "TMOT Schwelle für  KSTAA aktiv im Nachstart" VALUE 0x8110DD KwUb 191.3 temp_ub_q0p75_o48 -48.00 143.3 FORMAT "%5.1" /end CHARACTERISTIC
/begin CHARACTERISTIC TMOD8TE "Aktivzeit für TE-Dichtheitsprüfung in Mode 8" VALUE 0x81BB9E KwUw 65535.00 t1sxs_uw_q1 0.00 65535.00 FORMAT "%8.2" /end CHARACTERISTIC
/begin CHARACTERISTIC TMSTTE "Starttemperaturschwelle, bei der die TE sofort aktiv werden kann" VALUE 0x81A25D KwUb 191.3 temp_ub_q0p75_o48 -48.00 143.3 FORMAT "%5.1" /end CHARACTERISTIC
/begin CHARACTERISTIC TMTE "TMOT - Schwelle für Tankentlüftung" VALUE 0x81A25E KwUb 191.3 temp_ub_q0p75_o48 -48.00 143.3 FORMAT "%5.1" /end CHARACTERISTIC
/begin CHARACTERISTIC TQTEAB "Zeit für Absteuerung Spülrate Tankentlüftung" VALUE 0x812135 KwUb 81.28 t20msxs_ub_q0p32 0.3200 81.60 FORMAT "%5.2" /end CHARACTERISTIC
/begin CHARACTERISTIC TQTEDAB "Zeit für schnelle Absteuerung Spülrate Tankentlüftung" VALUE 0x812136 KwUb 81.28 t20msxs_ub_q0p32 0.3200 81.60 FORMAT "%5.2" /end CHARACTERISTIC
/begin CHARACTERISTIC TTEAUS "Zeit nach Start bis TEB aktiv wird" VALUE 0x827EE0 KwUw 195.0000 t100msxs_uw_q100 5.000000 200.0000 FORMAT "%8.4" /end CHARACTERISTIC
/begin CHARACTERISTIC TVAGRFTE "Verzögerungszeit für Freigabe der AGR nach einer Sperrung" VALUE 0x81A3C3 KwUb 25.50 t100msxs_ub_b25p5 0.00 25.50 FORMAT "%5.2" /end CHARACTERISTIC
/begin CHARACTERISTIC TVSATEM "Verzögerungszeit für TEV zu nach SA-Bereitschaft" CURVE 0x812137 KlAUbSstUbWUb 5.100 t20msxs_ub_b5p1 0.00 5.100 FORMAT "%5.3"
 /begin AXIS_DESCR STD_AXIS tmot temp_ub_q0p75_o48 6 -48.00 143.3 FORMAT "%5.1" DEPOSIT ABSOLUTE /end AXIS_DESCR
/end CHARACTERISTIC
/begin CHARACTERISTIC UBKST "Ubat-Schwelle für ZUBKSTMX" VALUE 0x8110DE KwUb 17.95 spg_ubatt 0.00 17.95 FORMAT "%5.2" /end CHARACTERISTIC
/begin CHARACTERISTIC UBKSTMX "Anzahlschwelle Ubat unter UBKST für Adaptionssperrung" VALUE 0x8110DF KwUb 255.0 dez 0.00 255.0 FORMAT "%5.1" /end CHARACTERISTIC
/begin CHARACTERISTIC VARDEF "Default Variante für Variantencodierung" VALUE 0x815CCC KwUw 32767.00 dez 0.00 32767.00 FORMAT "%8.2" /end CHARACTERISTIC
/begin CHARACTERISTIC VMIN_UM "Minimalgeschwindigkeit für FGR-Betrieb in der Funktionsüberwachung" VALUE 0x814222 KwUw 511.9922 vfzg_uw_q0p00781 0.00 511.9922 FORMAT "%8.4" /end CHARACTERISTIC
/begin CHARACTERISTIC VVR_AOG "oberer Grenzwert Anpassung V-Verriegelung" VALUE 0x8115CB KwSb 255.0 vfzg_q1p0 -128.0 127.0 FORMAT "%5.1" /end CHARACTERISTIC
/begin CHARACTERISTIC VVR_AUG "unterer Grenzwert Anpassung V-Verriegelung" VALUE 0x8115CC KwSb 255.0 vfzg_q1p0 -128.0 127.0 FORMAT "%5.1" /end CHARACTERISTIC
/begin CHARACTERISTIC WAD0T1 "Wichtungsfaktor Adaptionsbereich 0 zu 1" VALUE 0x8110E0 KwUb 15.94 fak_ub_b16 0.00 15.94 FORMAT "%5.2" /end CHARACTERISTIC
/begin CHARACTERISTIC WAD0T2 "Wichtungsfaktor Adaptionsbereich 0 zu 2" VALUE 0x8110E1 KwUb 15.94 fak_ub_b16 0.00 15.94 FORMAT "%5.2" /end CHARACTERISTIC
/begin CHARACTERISTIC WAD1T0 "Wichtungsfaktor Adaptionsbereich 1 zu 0" VALUE 0x8110E2 KwUb 15.94 fak_ub_b16 0.00 15.94 FORMAT "%5.2" /end CHARACTERISTIC
/begin CHARACTERISTIC WAD1T2 "Wichtungsfaktor Adaptionsbereich 1 zu 2" VALUE 0x8110E3 KwUb 15.94 fak_ub_b16 0.00 15.94 FORMAT "%5.2" /end CHARACTERISTIC
/begin CHARACTERISTIC WAD2T0 "Wichtungsfaktor Adaptionsbereich 2 zu 0" VALUE 0x8110E4 KwUb 15.94 fak_ub_b16 0.00 15.94 FORMAT "%5.2" /end CHARACTERISTIC
/begin CHARACTERISTIC WAD2T1 "Wichtungsfaktor Adaptionsbereich 2 zu 1" VALUE 0x8110E5 KwUb 15.94 fak_ub_b16 0.00 15.94 FORMAT "%5.2" /end CHARACTERISTIC
/begin CHARACTERISTIC WNWAMAX "maximaler Auslaßnockenwellensollwinkel" VALUE 0x8182E6 KwUb 127.5 kw_ub_q0p5 0.00 127.5 FORMAT "%5.1" /end CHARACTERISTIC
/begin CHARACTERISTIC WNWEMAX "maximaler Nockenwellensollwinkel Einlaß" VALUE 0x8182E7 KwUb 127.5 kw_ub_q0p5 0.00 127.5 FORMAT "%5.1" /end CHARACTERISTIC
/begin CHARACTERISTIC ZBTEML "Integrationsgeschwindigkeit Beladungsfaktor" CURVE 0x81A3C4 GklWUb 6.101 perio_ub_b6p125 0.00 6.101 FORMAT "%5.3" /begin AXIS_DESCR COM_AXIS ml m_ub_b1020 6 0.00 1020. AXIS_PTS_REF SML06TEUB /end AXIS_DESCR /end CHARACTERISTIC
/begin CHARACTERISTIC ZBURNABR "Verbrennungsanzahl für Entscheidung Adaptionsabbruch" VALUE 0x8110E6 KwUb 255.0 dez 0.00 255.0 FORMAT "%5.1" /end CHARACTERISTIC
/begin CHARACTERISTIC ZBURNDEC "Zu überschreitende Verbrennungsanzahl für ""Abmagern""" VALUE 0x8110E7 KwUb 255.0 dez 0.00 255.0 FORMAT "%5.1" /end CHARACTERISTIC
/begin CHARACTERISTIC ZBURNSOL "Erforderliche Verbrennungsanzahl für ""keine Anreicherung""" VALUE 0x8110E8 KwUb 255.0 dez 0.00 255.0 FORMAT "%5.1" /end CHARACTERISTIC
/begin CHARACTERISTIC ZETATE "Rampensteilheit für Veränderung Motorwirkungsgrad durch Tankentlüftung" VALUE 0x827F4C KwUw 1279.590 rgrad_uw_b1280 0.3906250 1279.980 FORMAT "%8.3" /end CHARACTERISTIC
/begin CHARACTERISTIC ZKFTEAD "Zeitkonstante gefilterter Faktor Beladung Spülstrom bei Tankentlüftung" VALUE 0x827F4E KwUw 6553.4999985 zk100msxs_uw_b6553 0.10000152590 6553.6000000 FORMAT "%12.7" /end CHARACTERISTIC
/begin CHARACTERISTIC ZMLTE "Zeitkonstante für ml-Filter in beladungsabh. Tankentlüftung" VALUE 0x827F50 KwUw 6553.4999985 zk100msxs_uw_b655 0.10000152590 6553.6000000 FORMAT "%12.7" /end CHARACTERISTIC
/begin CHARACTERISTIC ZMSSGIN "Filterzeitkonstante für Berechnung der relativen Änderung von mssgin_w" VALUE 0x81A3CA KwUb 25.4996 zk100msxs_ub_b25p5 0.100392 25.6000 FORMAT "%7.4" /end CHARACTERISTIC
/begin CHARACTERISTIC ZSYNABR "Zündungsanzahl für Entscheidung Adaptionsabbruch" VALUE 0x8110E9 KwUb 255.0 dez 0.00 255.0 FORMAT "%5.1" /end CHARACTERISTIC
/begin CHARACTERISTIC ZSYNAUSW "Anzahl Zündungen (Synchros) bis Auswerten" VALUE 0x8110EA KwUb 255.0 dez 0.00 255.0 FORMAT "%5.1" /end CHARACTERISTIC
/begin CHARACTERISTIC ZSYNDEL "Anzahl ausgeblendete Verbrennungen für Verbrennungserkennung" VALUE 0x8110EB KwUb 255.0 dez 0.00 255.0 FORMAT "%5.1" /end CHARACTERISTIC
/begin MEASUREMENT adastep "Adaptionsschritt für STADAP-Faktor" SBYTE fak_sb_b1 1 100 -1 0.992188 FORMAT "%5.3" ECU_ADDRESS 0x3809EF /end MEASUREMENT
/begin MEASUREMENT ahkat "Mittelwert der Amplitude Sondensignal hinter Kat. korrigiert mit KB" UBYTE fak_ub_b1 1 100 0 0.996094 ECU_ADDRESS 0x384800 /end MEASUREMENT
/begin MEASUREMENT arstadk "" UWORD dez 1 100 0 65535 FORMAT "%8.2" ARRAY_SIZE 8 ECU_ADDRESS 0x384040 /end MEASUREMENT
/begin MEASUREMENT azlrdkt "Lambdaregler-Zwangsamplitude aus Kat-Diagnose" UBYTE fak_ub_b0p25 1 100 0 0.249023 FORMAT "%11.9" ECU_ADDRESS 0x38088E /end MEASUREMENT
/begin MEASUREMENT b2acc_um "" UBYTE dez 1 100 0 255 FORMAT "%5.1" ECU_ADDRESS 0x38080C /end MEASUREMENT
/begin MEASUREMENT b2gra_um "CAN GRA-Botschaft Byte 2 in FU" UBYTE dez 1 100 0 255 FORMAT "%5.1" ECU_ADDRESS 0x380812 /end MEASUREMENT
/begin MEASUREMENT b3gra_um "CAN GRA-Botschaft Byte 3 in FU" UBYTE dez 1 100 0 255 FORMAT "%5.1" ECU_ADDRESS 0x380813 /end MEASUREMENT
/begin MEASUREMENT bacc_c_um "Fehlerzähler: Botschaftsabsicherung ACC-Botschaft" UBYTE t40ms_ub_b10200 1 100 0 10200 FORMAT "%7.1" ECU_ADDRESS 0x38080D /end MEASUREMENT
/begin MEASUREMENT bgra_c_um "Fehlerzähler: Botschaftsabsicherung GRA-Botschaft" UBYTE t40ms_ub_b10200 1 100 0 10200 FORMAT "%7.1" ECU_ADDRESS 0x380814 /end MEASUREMENT
/begin MEASUREMENT bracc_c_um "Entprellzähler für betätigte Bremse in der Funktionsüberwachung" UBYTE t40ms_ub_b10200 1 100 0 10200 FORMAT "%7.1" ECU_ADDRESS 0x380815 /end MEASUREMENT
/begin MEASUREMENT brems_c_um "Entprellzähler für betätigte Bremse in der Funktionsüberwachung" UBYTE t40ms_ub_b10200 1 100 0 10200 FORMAT "%7.1" ECU_ADDRESS 0x380816 /end MEASUREMENT
/begin MEASUREMENT bresp_c_um "Entprellzähler für betätigte Bremse" UBYTE t40ms_ub_b10200 1 100 0 10200 FORMAT "%7.1" ECU_ADDRESS 0x380817 /end MEASUREMENT
/begin MEASUREMENT bzacc_a_um "Botschaftszähler (alter Wert) der ACC-Canbotschaft in der Überwachung" UBYTE dez 1 100 0 255 FORMAT "%5.1" ECU_ADDRESS 0x38080E /end MEASUREMENT
/begin MEASUREMENT bzacc_um "Botschaftszähler der ACC-Canbotschaft in der Überwachung" UBYTE dez 1 100 0 255 FORMAT "%5.1" ECU_ADDRESS 0x38080F /end MEASUREMENT
/begin MEASUREMENT bzgra_a_um "Botschaftszähler (alter Wert) der GRA-Canbotschaft in der Überwachung" UBYTE dez 1 100 0 255 FORMAT "%5.1" ECU_ADDRESS 0x380818 /end MEASUREMENT
/begin MEASUREMENT bzgra_um "Botschaftszähler der GRA-Canbotschaft in der Überwachung" UBYTE dez 1 100 0 255 FORMAT "%5.1" ECU_ADDRESS 0x380819 /end MEASUREMENT
/begin MEASUREMENT bzmsr_a_um "alter MSR-Botschaftszähler" UBYTE dez 1 100 0 255 FORMAT "%5.1" ECU_ADDRESS 0x380838 /end MEASUREMENT
/begin MEASUREMENT B_acc "Bedingung: ACC-Steuergerät vorhanden" UWORD B_TRUE 1 100 0 1 BIT_MASK 0x4 FORMAT "%13.11" ECU_ADDRESS 0xFD76 /end MEASUREMENT
/begin MEASUREMENT B_accab "Bedingung: reversible Sperrung der Beschleunigungsschnittstelle an %UFACC" UWORD B_TRUE 1 100 0 1 BIT_MASK 0x4 FORMAT "%13.11" ECU_ADDRESS 0xFD0A /end MEASUREMENT
/begin MEASUREMENT B_accen "Bedingung ADR über Login freigeschaltet" UWORD B_TRUE 1 100 0 1 BIT_MASK 0x8 FORMAT "%13.11" ECU_ADDRESS 0xFD76 /end MEASUREMENT
/begin MEASUREMENT B_acce_um "Fehlerinformation bzgl. ACC aus der ACC-Canbotschaft in der Überwachung" UBYTE B_TRUE 1 100 0 1 BIT_MASK 0x10 FORMAT "%13.11" ECU_ADDRESS 0x38080C /end MEASUREMENT
/begin MEASUREMENT B_ad "Bedingung Adaption erlaubt" UWORD B_TRUE 1 100 0 1 BIT_MASK 0x1 FORMAT "%13.11" ECU_ADDRESS 0x384B2A /end MEASUREMENT
/begin MEASUREMENT B_adb0 "Bedingung Adaptionsbereich 0" UWORD B_TRUE 1 100 0 1 BIT_MASK 0x2 FORMAT "%13.11" ECU_ADDRESS 0x384B2A /end MEASUREMENT
/begin MEASUREMENT B_adb1 "Bedingung Adaptionsbereich 1" UWORD B_TRUE 1 100 0 1 BIT_MASK 0x4 FORMAT "%13.11" ECU_ADDRESS 0x384B2A /end MEASUREMENT
/begin MEASUREMENT B_adb2 "Bedingung Adaptionsbereich 2" UWORD B_TRUE 1 100 0 1 BIT_MASK 0x8 FORMAT "%13.11" ECU_ADDRESS 0x384B2A /end MEASUREMENT
/begin MEASUREMENT B_adlck "Richtungsabhängige Startadaptionssperre" UWORD B_TRUE 1 100 0 1 BIT_MASK 0x10 FORMAT "%13.11" ECU_ADDRESS 0x384B2A /end MEASUREMENT
/begin MEASUREMENT B_agrlrasp "Bedingung Sperren der Gemischadaption während der AGR-Kennlinienadaption" UWORD B_TRUE 1 100 0 1 BIT_MASK 0x8 FORMAT "%13.11" ECU_ADDRESS 0xFD0A /end MEASUREMENT
/begin MEASUREMENT B_agrste "Bedingung AGR von Tankentlüftung gesperrt" UWORD B_TRUE 1 100 0 1 BIT_MASK 0x10 FORMAT "%13.11" ECU_ADDRESS 0xFD9C /end MEASUREMENT
/begin MEASUREMENT B_anschlag "" UWORD B_TRUE 1 100 0 1 BIT_MASK 0x4 FORMAT "%13.11" ECU_ADDRESS 0xFD06 /end MEASUREMENT
/begin MEASUREMENT B_asc_reg "CAN-Botschaft: ASC regelt (mit Bremsen-Eingriff)" UWORD B_TRUE 1 100 0 1 BIT_MASK 0x10 FORMAT "%13.11" ECU_ADDRESS 0xFD0A /end MEASUREMENT
/begin MEASUREMENT B_ausw "Bedingung Auswerten nach Verbrennungen" UWORD B_TRUE 1 100 0 1 BIT_MASK 0x20 FORMAT "%13.11" ECU_ADDRESS 0x384B2A /end MEASUREMENT
/begin MEASUREMENT B_bacce_um "Fehler in ACC-Botschaft in der Funktionsüberwachung" UWORD B_TRUE 1 100 0 1 BIT_MASK 0x40 FORMAT "%13.11" ECU_ADDRESS 0xFD92 /end MEASUREMENT
/begin MEASUREMENT B_bgrae_um "Fehler in GRA-Botschaft in der Funktionsüberwachung" UWORD B_TRUE 1 100 0 1 BIT_MASK 0x100 FORMAT "%13.11" ECU_ADDRESS 0xFD92 /end MEASUREMENT
/begin MEASUREMENT B_burn "letzte Verbrennung als erfolgreich erkannt (dnmot_w > dnburnsol)" UWORD B_TRUE 1 100 0 1 BIT_MASK 0x4000 FORMAT "%13.11" ECU_ADDRESS 0xFD5A /end MEASUREMENT
/begin MEASUREMENT B_bzsync "system has not yet detected a gap" UWORD B_TRUE 1 100 0 1 BIT_MASK 0x8 FORMAT "%13.11" ECU_ADDRESS 0xFD06 /end MEASUREMENT
/begin MEASUREMENT B_craus "Ausgewertet durch LREB: Werkstattbit zum Stillegen LR" UWORD B_TRUE 1 100 0 1 BIT_MASK 0x10 FORMAT "%13.11" ECU_ADDRESS 0xFD76 /end MEASUREMENT
/begin MEASUREMENT B_decr "Bedingung Dekrementierung Startadaptionsfaktor" UWORD B_TRUE 1 100 0 1 BIT_MASK 0x40 FORMAT "%13.11" ECU_ADDRESS 0x384B2A /end MEASUREMENT
/begin MEASUREMENT B_dktlp "Umschaltung der Lambdaregelungsparameter angefordert" UWORD B_TRUE 1 100 0 1 BIT_MASK 0x20 FORMAT "%13.11" ECU_ADDRESS 0xFD0A /end MEASUREMENT
/begin MEASUREMENT B_dmmtev "TEV-schließen wegen Bedingung Endstufentest DMTL-Magnetventil" UWORD B_TRUE 1 100 0 1 BIT_MASK 0x40 FORMAT "%13.11" ECU_ADDRESS 0xFD0A /end MEASUREMENT
/begin MEASUREMENT B_dmtltz "Bedingung TEV soll geschlossen werden" UWORD B_TRUE 1 100 0 1 BIT_MASK 0x80 FORMAT "%13.11" ECU_ADDRESS 0xFD0A /end MEASUREMENT
/begin MEASUREMENT B_dslsk "Bedingung Diagnose Sekundärluftsystem für Kurztest" UWORD B_TRUE 1 100 0 1 BIT_MASK 0x100 FORMAT "%13.11" ECU_ADDRESS 0xFD0A /end MEASUREMENT
/begin MEASUREMENT B_edss "Bedingung Fehler DSS (ohne Entprellung)" UWORD B_TRUE 1 100 0 1 BIT_MASK 0x200 FORMAT "%13.11" ECU_ADDRESS 0xFD0A /end MEASUREMENT
/begin MEASUREMENT B_fa "Bedingung Funktionsanforderung allgemein" UWORD B_TRUE 1 100 0 1 BIT_MASK 0x20 FORMAT "%13.11" ECU_ADDRESS 0xFD76 /end MEASUREMENT
/begin MEASUREMENT B_faa "Bedingung Funktionsanforderung automatischer Testablauf" UWORD B_TRUE 1 100 0 1 BIT_MASK 0x40 FORMAT "%13.11" ECU_ADDRESS 0xFD76 /end MEASUREMENT
/begin MEASUREMENT B_faadagl "Bedingung externe Anforderung der Adaption Lagesensor" UWORD B_TRUE 1 100 0 1 BIT_MASK 0x80 FORMAT "%13.11" ECU_ADDRESS 0xFD76 /end MEASUREMENT
/begin MEASUREMENT B_faadkl "Bedingung Funktionsanforderung Adaption AGR-Drosselklappe" UWORD B_TRUE 1 100 0 1 BIT_MASK 0x100 FORMAT "%13.11" ECU_ADDRESS 0xFD76 /end MEASUREMENT
/begin MEASUREMENT B_faagr "Bedingung Funktionsanforderung AGR und Diagnose für Kurztest" UWORD B_TRUE 1 100 0 1 BIT_MASK 0x200 FORMAT "%13.11" ECU_ADDRESS 0xFD76 /end MEASUREMENT
/begin MEASUREMENT B_faam "Anforderung allgemeine Momentenreserve Kurztrip" UWORD B_TRUE 1 100 0 1 BIT_MASK 0x400 FORMAT "%13.11" ECU_ADDRESS 0xFD76 /end MEASUREMENT
/begin MEASUREMENT B_faan "Bedingung Funktionsanforderung Allgemeine Drehzahlerhöhung" UWORD B_TRUE 1 100 0 1 BIT_MASK 0x800 FORMAT "%13.11" ECU_ADDRESS 0xFD76 /end MEASUREMENT
/begin MEASUREMENT B_faatm "Bedingung Funktionsanforderung kurze Taupunktendezeiten" UWORD B_TRUE 1 100 0 1 BIT_MASK 0x1000 FORMAT "%13.11" ECU_ADDRESS 0xFD76 /end MEASUREMENT
/begin MEASUREMENT B_fabkv "Bedingung: Funktionsanforderung Bremskraftverstärker" UWORD B_TRUE 1 100 0 1 BIT_MASK 0x2000 FORMAT "%13.11" ECU_ADDRESS 0xFD76 /end MEASUREMENT
/begin MEASUREMENT B_fadsv "Bedingung Funktionsanforderung Diagnose Drucksteuerventil BDE" UWORD B_TRUE 1 100 0 1 BIT_MASK 0x4000 FORMAT "%13.11" ECU_ADDRESS 0xFD76 /end MEASUREMENT
/begin MEASUREMENT B_faevz "Bedingung Zylinderausblendung durch Tester" UWORD B_TRUE 1 100 0 1 BIT_MASK 0x400 FORMAT "%13.11" ECU_ADDRESS 0xFD0A /end MEASUREMENT
/begin MEASUREMENT B_faezla "Bedingung : Funktionsanforderung EZLA" UWORD B_TRUE 1 100 0 1 BIT_MASK 0x8000 FORMAT "%13.11" ECU_ADDRESS 0xFD76 /end MEASUREMENT
/begin MEASUREMENT B_fafrst "Funktionsanforderung Kurztest" UWORD B_TRUE 1 100 0 1 BIT_MASK 0x1 FORMAT "%13.11" ECU_ADDRESS 0xFD78 /end MEASUREMENT
/begin MEASUREMENT B_fakat "Bedingung Funktionsanforderung Katalysatorüberwachung" UWORD B_TRUE 1 100 0 1 BIT_MASK 0x2 FORMAT "%13.11" ECU_ADDRESS 0xFD78 /end MEASUREMENT
/begin MEASUREMENT B_fakat2 "Bedingung Funktionsanforderung Katalysatorüberwachung, Bank2" UWORD B_TRUE 1 100 0 1 BIT_MASK 0x4 FORMAT "%13.11" ECU_ADDRESS 0xFD78 /end MEASUREMENT
/begin MEASUREMENT B_fakd "Bedingung Funktionsanforderung Kick-Down-Adaption" UWORD B_TRUE 1 100 0 1 BIT_MASK 0x8 FORMAT "%13.11" ECU_ADDRESS 0xFD78 /end MEASUREMENT
/begin MEASUREMENT B_fakmtr "Bedingung Funktionsanforderung Kühlmitteltemperaturregelung" UWORD B_TRUE 1 100 0 1 BIT_MASK 0x10 FORMAT "%13.11" ECU_ADDRESS 0xFD78 /end MEASUREMENT
/begin MEASUREMENT B_fakrs "Bedingung Funktionsanforderung Klopfsensordiagnose" UWORD B_TRUE 1 100 0 1 BIT_MASK 0x20 FORMAT "%13.11" ECU_ADDRESS 0xFD78 /end MEASUREMENT
/begin MEASUREMENT B_fakth "Bedingung Funktionsanforderung thermische Katalysatordiagnose" UWORD B_TRUE 1 100 0 1 BIT_MASK 0x40 FORMAT "%13.11" ECU_ADDRESS 0xFD78 /end MEASUREMENT
/begin MEASUREMENT B_fakth2 "Bedingung Funktionsanforderung thermische Katalysatordiagnose, Bank 2" UWORD B_TRUE 1 100 0 1 BIT_MASK 0x80 FORMAT "%13.11" ECU_ADDRESS 0xFD78 /end MEASUREMENT
/begin MEASUREMENT B_fakvs "Funktionsaufforderung Diagnose Kraftstoffsystem für Schnelltest" UWORD B_TRUE 1 100 0 1 BIT_MASK 0x100 FORMAT "%13.11" ECU_ADDRESS 0xFD78 /end MEASUREMENT
/begin MEASUREMENT B_falbk "Funktionsaufforderung Offsetlernen der LBK" UWORD B_TRUE 1 100 0 1 BIT_MASK 0x200 FORMAT "%13.11" ECU_ADDRESS 0xFD78 /end MEASUREMENT
/begin MEASUREMENT B_faldp "Bedingung Funktionsanforderung Leckdiagnosepumpe" UWORD B_TRUE 1 100 0 1 BIT_MASK 0x400 FORMAT "%13.11" ECU_ADDRESS 0xFD78 /end MEASUREMENT
/begin MEASUREMENT B_falr "Bedingung: Funktionsanforderung Lambdaregelung aus" UWORD B_TRUE 1 100 0 1 BIT_MASK 0x800 FORMAT "%13.11" ECU_ADDRESS 0xFD0A /end MEASUREMENT
/begin MEASUREMENT B_falra "Bedingung: Funktionsanforderung Lambdaregelung-Adaption" UWORD B_TRUE 1 100 0 1 BIT_MASK 0x800 FORMAT "%13.11" ECU_ADDRESS 0xFD78 /end MEASUREMENT
/begin MEASUREMENT B_falrshk "Bedingung Funktionsanforderung LRSHK" UWORD B_TRUE 1 100 0 1 BIT_MASK 0x1000 FORMAT "%13.11" ECU_ADDRESS 0xFD78 /end MEASUREMENT
/begin MEASUREMENT B_falrshk2 "Bedingung Funktionsanforderung LRSHK Bank 2" UWORD B_TRUE 1 100 0 1 BIT_MASK 0x2000 FORMAT "%13.11" ECU_ADDRESS 0xFD78 /end MEASUREMENT
/begin MEASUREMENT B_falsh "Bedingung Funktionsanforderung Lambda-Sonde hinter KAT" UWORD B_TRUE 1 100 0 1 BIT_MASK 0x4000 FORMAT "%13.11" ECU_ADDRESS 0xFD78 /end MEASUREMENT
/begin MEASUREMENT B_falshv "Bedingung Funktionsanforderung für Kurztrip Vertauschung Lambda-Sonde hinter KAT" UWORD B_TRUE 1 100 0 1 BIT_MASK 0x8000 FORMAT "%13.11" ECU_ADDRESS 0xFD78 /end MEASUREMENT
/begin MEASUREMENT B_falsv "Bedingung Funktionsanforderung Lambda-Sonde vor KAT" UWORD B_TRUE 1 100 0 1 BIT_MASK 0x1 FORMAT "%13.11" ECU_ADDRESS 0xFD7A /end MEASUREMENT
/begin MEASUREMENT B_falsv2 "Bedingung Funktionsanforderung Lambda-Sonde vor KAT Bank2" UWORD B_TRUE 1 100 0 1 BIT_MASK 0x2 FORMAT "%13.11" ECU_ADDRESS 0xFD7A /end MEASUREMENT
/begin MEASUREMENT B_fan "Bedingung Funktionsanforderung Drehzahlerhöhung für Kurztrip" UWORD B_TRUE 1 100 0 1 BIT_MASK 0x4 FORMAT "%13.11" ECU_ADDRESS 0xFD7A /end MEASUREMENT
/begin MEASUREMENT B_fanws "Bedingung Funktionsanforderung Diagnose Nockenwellensteuerung" UWORD B_TRUE 1 100 0 1 BIT_MASK 0x8 FORMAT "%13.11" ECU_ADDRESS 0xFD7A /end MEASUREMENT
/begin MEASUREMENT B_fanwsa "Bedingung Funktionsanforderung Diagnose Nockenwellensteuerung (Auslaß)" UWORD B_TRUE 1 100 0 1 BIT_MASK 0x10 FORMAT "%13.11" ECU_ADDRESS 0xFD7A /end MEASUREMENT
/begin MEASUREMENT B_fanwse "Bedingung Funktionsanforderung Diagnose Nockenwellensteuerung (Einlaßseitig)" UWORD B_TRUE 1 100 0 1 BIT_MASK 0x20 FORMAT "%13.11" ECU_ADDRESS 0xFD7A /end MEASUREMENT
/begin MEASUREMENT B_faobv "Bedingung Funktionsanforderung Overboost-Verbot" UWORD B_TRUE 1 100 0 1 BIT_MASK 0x40 FORMAT "%13.11" ECU_ADDRESS 0xFD7A /end MEASUREMENT
/begin MEASUREMENT B_fash "Bedingung Funktionsanforderung Schwingungsprüfung" UWORD B_TRUE 1 100 0 1 BIT_MASK 0x80 FORMAT "%13.11" ECU_ADDRESS 0xFD7A /end MEASUREMENT
/begin MEASUREMENT B_fash2 "Bedingung Funktionsanforderung Schwingungsprüfung Bank2" UWORD B_TRUE 1 100 0 1 BIT_MASK 0x100 FORMAT "%13.11" ECU_ADDRESS 0xFD7A /end MEASUREMENT
/begin MEASUREMENT B_faskno "Bedingung Funktionsanforderung Speicherkatdiagnose" UWORD B_TRUE 1 100 0 1 BIT_MASK 0x200 FORMAT "%13.11" ECU_ADDRESS 0xFD7A /end MEASUREMENT
/begin MEASUREMENT B_faskno2 "Bedingung Funktionsanforderung Speicherkatdiagnose Bank 2" UWORD B_TRUE 1 100 0 1 BIT_MASK 0x400 FORMAT "%13.11" ECU_ADDRESS 0xFD7A /end MEASUREMENT
/begin MEASUREMENT B_fasls "Bedingung Funktionsanforderung Sekundärluftsystem" UWORD B_TRUE 1 100 0 1 BIT_MASK 0x800 FORMAT "%13.11" ECU_ADDRESS 0xFD7A /end MEASUREMENT
/begin MEASUREMENT B_fates "Bedingung Funktionsanforderung Tankentlüftungssystem" UWORD B_TRUE 1 100 0 1 BIT_MASK 0x1000 FORMAT "%13.11" ECU_ADDRESS 0xFD7A /end MEASUREMENT
/begin MEASUREMENT B_fatnv "Bedingung: Funktionsanforderung %DGGTNVK" UWORD B_TRUE 1 100 0 1 BIT_MASK 0x2000 FORMAT "%13.11" ECU_ADDRESS 0xFD7A /end MEASUREMENT
/begin MEASUREMENT B_fatnv2 "Bedingung: Funktionsanforderung %DGGTNVK Bank 2" UWORD B_TRUE 1 100 0 1 BIT_MASK 0x4000 FORMAT "%13.11" ECU_ADDRESS 0xFD7A /end MEASUREMENT
/begin MEASUREMENT B_fatp "Bedingung Funktionsanforderung TP-Überwachung" UWORD B_TRUE 1 100 0 1 BIT_MASK 0x8000 FORMAT "%13.11" ECU_ADDRESS 0xFD7A /end MEASUREMENT
/begin MEASUREMENT B_fatp2 "Bedingung Funktionsanforderung TP-Überwachung Bank2" UWORD B_TRUE 1 100 0 1 BIT_MASK 0x1 FORMAT "%13.11" ECU_ADDRESS 0xFD7C /end MEASUREMENT
/begin MEASUREMENT B_fatv "Bedingung Funktionsanforderung TV-Überwachung" UWORD B_TRUE 1 100 0 1 BIT_MASK 0x2 FORMAT "%13.11" ECU_ADDRESS 0xFD7C /end MEASUREMENT
/begin MEASUREMENT B_fatv2 "Bedingung Funktionsanforderung TV-Überwachung Bank2" UWORD B_TRUE 1 100 0 1 BIT_MASK 0x4 FORMAT "%13.11" ECU_ADDRESS 0xFD7C /end MEASUREMENT
/begin MEASUREMENT B_fgrte "Bedingung FGR vom Tester freigegeben" UWORD B_TRUE 1 100 0 1 BIT_MASK 0x8 FORMAT "%13.11" ECU_ADDRESS 0xFD7C /end MEASUREMENT
/begin MEASUREMENT B_fgr_um "FGR-/ACC-Momenteneingriff in der Funktionsüberwachung erlaubt" UWORD B_TRUE 1 100 0 1 BIT_MASK 0x10 FORMAT "%13.11" ECU_ADDRESS 0xFD94 /end MEASUREMENT
/begin MEASUREMENT B_fhz "Bedingung Frontscheibenheizung" UWORD B_TRUE 1 100 0 1 BIT_MASK 0x1000 FORMAT "%13.11" ECU_ADDRESS 0xFD0A /end MEASUREMENT
/begin MEASUREMENT B_firstSyn "" UWORD B_TRUE 1 100 0 1 BIT_MASK 0x10 FORMAT "%13.11" ECU_ADDRESS 0xFD06 /end MEASUREMENT
/begin MEASUREMENT B_gang0 "Bedingung kein Gang eingelegt" UWORD B_TRUE 1 100 0 1 BIT_MASK 0x2000 FORMAT "%13.11" ECU_ADDRESS 0xFD0A /end MEASUREMENT
/begin MEASUREMENT B_graat_um "Bedingung GRA-Tipschalter Aus betätigt in Funktionsüberwachung" UBYTE B_TRUE 1 100 0 1 BIT_MASK 0x2 FORMAT "%13.11" ECU_ADDRESS 0x380812 /end MEASUREMENT
/begin MEASUREMENT B_graen_um "Freigabe des FGR über GRA-Bedienhebel in der Überwachung" UWORD B_TRUE 1 100 0 1 BIT_MASK 0x200 FORMAT "%13.11" ECU_ADDRESS 0xFD92 /end MEASUREMENT
/begin MEASUREMENT B_grahe_um "Bedingung GRA-Bedienhebelfehler in Funktionsüberwachung" UBYTE B_TRUE 1 100 0 1 BIT_MASK 0x40 FORMAT "%13.11" ECU_ADDRESS 0x380812 /end MEASUREMENT
/begin MEASUREMENT B_grahs_um "Bedingung GRA-Hauptschalter betätigt in Funktionsüberwachung" UBYTE B_TRUE 1 100 0 1 BIT_MASK 0x1 FORMAT "%13.11" ECU_ADDRESS 0x380812 /end MEASUREMENT
/begin MEASUREMENT B_grase_um "Bedingung GRA-Tipschalter Setzen betätigt in Funktionsüberwachung" UBYTE B_TRUE 1 100 0 1 BIT_MASK 0x1 FORMAT "%13.11" ECU_ADDRESS 0x380813 /end MEASUREMENT
/begin MEASUREMENT B_gratd_um "Bedingung GRA-Tipschalter Tip-DOWN betätigt in Funktionsüberwachung" UBYTE B_TRUE 1 100 0 1 BIT_MASK 0x4 FORMAT "%13.11" ECU_ADDRESS 0x380812 /end MEASUREMENT
/begin MEASUREMENT B_gratu_um "Bedingung GRA-Tipschalter Tip-UP betätigt in Funktionsüberwachung" UBYTE B_TRUE 1 100 0 1 BIT_MASK 0x8 FORMAT "%13.11" ECU_ADDRESS 0x380812 /end MEASUREMENT
/begin MEASUREMENT B_grawa_um "Bedingung GRA-Tipschalter Wiederaufnahme betätigt in Funktionsüberwachung" UBYTE B_TRUE 1 100 0 1 BIT_MASK 0x2 FORMAT "%13.11" ECU_ADDRESS 0x380813 /end MEASUREMENT
/begin MEASUREMENT B_grdst "Bedingung Grundeinstellung" UWORD B_TRUE 1 100 0 1 BIT_MASK 0x10 FORMAT "%13.11" ECU_ADDRESS 0xFD7C /end MEASUREMENT
/begin MEASUREMENT B_gwrte "Bedingung fr-Grenzwertregelung Tankentlüftung aktiv" UWORD B_TRUE 1 100 0 1 BIT_MASK 0x20 FORMAT "%13.11" ECU_ADDRESS 0xFD9C /end MEASUREMENT
/begin MEASUREMENT B_hab "Bedingung Höhenadaptionsbedarf" UWORD B_TRUE 1 100 0 1 BIT_MASK 0x4000 FORMAT "%13.11" ECU_ADDRESS 0xFD0A /end MEASUREMENT
/begin MEASUREMENT B_hlon "Bedingung Heißland aktiv" UWORD B_TRUE 1 100 0 1 BIT_MASK 0x20 FORMAT "%13.11" ECU_ADDRESS 0xFD7C /end MEASUREMENT
/begin MEASUREMENT B_incr "Bedingung Inkrementierung Startadaptionsfaktor" UWORD B_TRUE 1 100 0 1 BIT_MASK 0x80 FORMAT "%13.11" ECU_ADDRESS 0x384B2A /end MEASUREMENT
/begin MEASUREMENT B_intswe "" UWORD B_TRUE 1 100 0 1 BIT_MASK 0x400 FORMAT "%13.11" ECU_ADDRESS 0xFD06 /end MEASUREMENT
/begin MEASUREMENT B_intsweerr "" UWORD B_TRUE 1 100 0 1 BIT_MASK 0x800 FORMAT "%13.11" ECU_ADDRESS 0xFD06 /end MEASUREMENT
/begin MEASUREMENT B_intswefirstneg "" UWORD B_TRUE 1 100 0 1 BIT_MASK 0x1000 FORMAT "%13.11" ECU_ADDRESS 0xFD06 /end MEASUREMENT
/begin MEASUREMENT B_intswefirstpos "" UWORD B_TRUE 1 100 0 1 BIT_MASK 0x2000 FORMAT "%13.11" ECU_ADDRESS 0xFD06 /end MEASUREMENT
/begin MEASUREMENT B_kas "Kat.schutzfunktion aktiv" UWORD B_TRUE 1 100 0 1 BIT_MASK 0x8000 FORMAT "%13.11" ECU_ADDRESS 0xFD0A /end MEASUREMENT
/begin MEASUREMENT B_kolhrc "" UWORD B_TRUE 1 100 0 1 BIT_MASK 0x1 FORMAT "%13.11" ECU_ADDRESS 0xFD0C /end MEASUREMENT
/begin MEASUREMENT B_kstai "Bedingung Inkrementierung/Dekrementierung Startadaptionsfaktor" UWORD B_TRUE 1 100 0 1 BIT_MASK 0x100 FORMAT "%13.11" ECU_ADDRESS 0x384B2A /end MEASUREMENT
/begin MEASUREMENT B_kstaue "Startmengenadaptionswerte beim nächsten Start gültig" UWORD B_TRUE 1 100 0 1 BIT_MASK 0x200 FORMAT "%13.11" ECU_ADDRESS 0x384B2A /end MEASUREMENT
/begin MEASUREMENT B_kstebf "Bedingung Kraftstofferstbefüllung" UWORD B_TRUE 1 100 0 1 BIT_MASK 0x40 FORMAT "%13.11" ECU_ADDRESS 0xFD7C /end MEASUREMENT
/begin MEASUREMENT B_lrar "Bedingung reduzierte Korrekturbereiche in der LRA" UWORD B_TRUE 1 100 0 1 BIT_MASK 0x40 FORMAT "%13.11" ECU_ADDRESS 0xFD9C /end MEASUREMENT
/begin MEASUREMENT B_lrndia "Bedingung: DV-E-Adaption und Prüfungen per Diagnose-Tester aktivieren" UWORD B_TRUE 1 100 0 1 BIT_MASK 0x80 FORMAT "%13.11" ECU_ADDRESS 0xFD7C /end MEASUREMENT
/begin MEASUREMENT B_lsvvsp "Bedingung Vertauschte Lambda-Sonden, Regelung sperren" UWORD B_TRUE 1 100 0 1 BIT_MASK 0x2 FORMAT "%13.11" ECU_ADDRESS 0xFD0C /end MEASUREMENT
/begin MEASUREMENT B_luef1 "Bedingung zur Aktivierung Drehzahlfenster 1 für Lüftersteuerung" UBYTE B_TRUE 1 100 0 1 BIT_MASK 0x1 FORMAT "%13.11" ECU_ADDRESS 0x384023 /end MEASUREMENT
/begin MEASUREMENT B_luef2 "Bedingung zur Aktivierung Drehzahlfenster 2 für Lüftersteuerung" UBYTE B_TRUE 1 100 0 1 BIT_MASK 0x2 FORMAT "%13.11" ECU_ADDRESS 0x384023 /end MEASUREMENT
/begin MEASUREMENT B_luef3 "Bedingung zur Aktivierung Drehzahlfenster 3 für Lüftersteuerung" UBYTE B_TRUE 1 100 0 1 BIT_MASK 0x4 FORMAT "%13.11" ECU_ADDRESS 0x384023 /end MEASUREMENT
/begin MEASUREMENT B_m9cvn "Bedingung zur Berechnung der Checksumme (CVN) nach SAE/ISO Mode/Service $09" UBYTE B_TRUE 1 100 0 1 BIT_MASK 0x1 FORMAT "%13.11" ECU_ADDRESS 0x3808FE /end MEASUREMENT
/begin MEASUREMENT B_m9cvnout "Bedingung; Checksumme (CVN) im Mode/Service $09 mind. 1-mal ausgegeben" UBYTE B_TRUE 1 100 0 1 BIT_MASK 0x2 FORMAT "%13.11" ECU_ADDRESS 0x3808FE /end MEASUREMENT
/begin MEASUREMENT B_nkons_um "Bedingung MSR-Botschaft ist nicht konsistent" UWORD B_TRUE 1 100 0 1 BIT_MASK 0x20 FORMAT "%13.11" ECU_ADDRESS 0xFD94 /end MEASUREMENT
/begin MEASUREMENT B_nmaxext "Externe Drehzahlbegrenzung aktiv" UWORD B_TRUE 1 100 0 1 BIT_MASK 0x4 FORMAT "%13.11" ECU_ADDRESS 0xFD0C /end MEASUREMENT
/begin MEASUREMENT B_noacc_fr "Bedingung: irreversible Sperrung der Beschleunigungsschnittstelle an %UFACC" UWORD B_TRUE 1 100 0 1 BIT_MASK 0x8 FORMAT "%13.11" ECU_ADDRESS 0xFD0C /end MEASUREMENT
/begin MEASUREMENT B_noacc_um "Bedingung keine Übernahme des ACC-Momentes in E2" UWORD B_TRUE 1 100 0 1 BIT_MASK 0x80 FORMAT "%13.11" ECU_ADDRESS 0xFD92 /end MEASUREMENT
/begin MEASUREMENT B_nodec "Bedingung kein Dekrementieren des Startadaptionsfactors innerhalb dieses Starts" UWORD B_TRUE 1 100 0 1 BIT_MASK 0x400 FORMAT "%13.11" ECU_ADDRESS 0x384B2A /end MEASUREMENT
/begin MEASUREMENT B_noinc "Bedingung kein Inkrementieren des Startadaptionsfaktors innerhalb dieses Starts" UWORD B_TRUE 1 100 0 1 BIT_MASK 0x800 FORMAT "%13.11" ECU_ADDRESS 0x384B2A /end MEASUREMENT
/begin MEASUREMENT B_nokatfz "Bedingung Nicht-KAT Fahrzeug" UWORD B_TRUE 1 100 0 1 BIT_MASK 0x10 FORMAT "%13.11" ECU_ADDRESS 0xFD0C /end MEASUREMENT
/begin MEASUREMENT B_nomsr_um "MSR-Momentenvorgabe in der Funktionsüberwachung nicht übernommen" UWORD B_TRUE 1 100 0 1 BIT_MASK 0x40 FORMAT "%13.11" ECU_ADDRESS 0xFD94 /end MEASUREMENT
/begin MEASUREMENT B_portStatussweOld "" UWORD B_TRUE 1 100 0 1 BIT_MASK 0x4000 FORMAT "%13.11" ECU_ADDRESS 0xFD06 /end MEASUREMENT
/begin MEASUREMENT B_pripv "Bedingung Port schalten für Pumpimpuls vor KAT" UWORD B_TRUE 1 100 0 1 BIT_MASK 0x20 FORMAT "%13.11" ECU_ADDRESS 0xFD0C /end MEASUREMENT
/begin MEASUREMENT B_pripv2 "Bedingung Port schalten für Pumpimpuls vor KAT Bank2" UWORD B_TRUE 1 100 0 1 BIT_MASK 0x40 FORMAT "%13.11" ECU_ADDRESS 0xFD0C /end MEASUREMENT
/begin MEASUREMENT B_pwf "Bedingung Powerfail" UWORD B_TRUE 1 100 0 1 BIT_MASK 0x400 FORMAT "%13.11" ECU_ADDRESS 0xFD9A /end MEASUREMENT
/begin MEASUREMENT B_qtedab "Bedingung schnelle Absteuerung der Spülrate" UWORD B_TRUE 1 100 0 1 BIT_MASK 0x8000 FORMAT "%13.11" ECU_ADDRESS 0xFD9A /end MEASUREMENT
/begin MEASUREMENT B_ripuv "Bedingung Strom-Pumpen für Sonde vor KAT" UWORD B_TRUE 1 100 0 1 BIT_MASK 0x80 FORMAT "%13.11" ECU_ADDRESS 0xFD0C /end MEASUREMENT
/begin MEASUREMENT B_ripuv2 "Bedingung Strom-Pumpen für Sonde vor KAT Bank2" UWORD B_TRUE 1 100 0 1 BIT_MASK 0x100 FORMAT "%13.11" ECU_ADDRESS 0xFD0C /end MEASUREMENT
/begin MEASUREMENT B_savacc "Bedingung: Schubabschalteverbot von ACC" UWORD B_TRUE 1 100 0 1 BIT_MASK 0x200 FORMAT "%13.11" ECU_ADDRESS 0xFD0C /end MEASUREMENT
/begin MEASUREMENT B_savmd "Bedingung: Schubabschalteverbot wegen Momentenanforderung" UWORD B_TRUE 1 100 0 1 BIT_MASK 0x400 FORMAT "%13.11" ECU_ADDRESS 0xFD0C /end MEASUREMENT
/begin MEASUREMENT B_sbbnhhk "Bedingung Sonde hinter Haupt-Kat betriebsbereit" UWORD B_TRUE 1 100 0 1 BIT_MASK 0x800 FORMAT "%13.11" ECU_ADDRESS 0xFD0C /end MEASUREMENT
/begin MEASUREMENT B_sersw "" UWORD B_TRUE 1 100 0 1 BIT_MASK 0x1000 FORMAT "%13.11" ECU_ADDRESS 0xFD90 /end MEASUREMENT
/begin MEASUREMENT B_sgs "Bedingung: Momenteingriff zur Drehzahlsynchronisation bei Getriebeschaltung" UWORD B_TRUE 1 100 0 1 BIT_MASK 0x1000 FORMAT "%13.11" ECU_ADDRESS 0xFD0C /end MEASUREMENT
/begin MEASUREMENT B_sl "Bedingung Servo-Lenkung" UWORD B_TRUE 1 100 0 1 BIT_MASK 0x2000 FORMAT "%13.11" ECU_ADDRESS 0xFD0C /end MEASUREMENT
/begin MEASUREMENT B_staa "Bedingung Startadaption aktiv im Nachstart" UWORD B_TRUE 1 100 0 1 BIT_MASK 0x8000 FORMAT "%13.11" ECU_ADDRESS 0xFD5A /end MEASUREMENT
/begin MEASUREMENT B_stdperr "Bedingung Adaptionsende aufgrund erkanntem Fehler" UWORD B_TRUE 1 100 0 1 BIT_MASK 0x1000 FORMAT "%13.11" ECU_ADDRESS 0x384B2A /end MEASUREMENT
/begin MEASUREMENT B_sttakt "Bedingung Stellgliedtest aktiv" UWORD B_TRUE 1 100 0 1 BIT_MASK 0x8000 FORMAT "%13.11" ECU_ADDRESS 0xFD74 /end MEASUREMENT
/begin MEASUREMENT B_svuerf "Bedingung Sondenspannung vor KAT erfassen" UWORD B_TRUE 1 100 0 1 BIT_MASK 0x4000 FORMAT "%13.11" ECU_ADDRESS 0xFD0C /end MEASUREMENT
/begin MEASUREMENT B_svuerf2 "Bedingung Sondenspannung vor KAT erfassen Bank2" UWORD B_TRUE 1 100 0 1 BIT_MASK 0x8000 FORMAT "%13.11" ECU_ADDRESS 0xFD0C /end MEASUREMENT
/begin MEASUREMENT B_tDelayEnd "" UWORD B_TRUE 1 100 0 1 BIT_MASK 0x2000 FORMAT "%13.11" ECU_ADDRESS 0xFD90 /end MEASUREMENT
/begin MEASUREMENT B_te "Bedingung Tankentlüftung" UWORD B_TRUE 1 100 0 1 BIT_MASK 0x1 FORMAT "%13.11" ECU_ADDRESS 0xFD9C /end MEASUREMENT
/begin MEASUREMENT B_teabb "Bedingung Tankentlüftung abbruchbereit" UWORD B_TRUE 1 100 0 1 BIT_MASK 0x80 FORMAT "%13.11" ECU_ADDRESS 0xFD9C /end MEASUREMENT
/begin MEASUREMENT B_teakt "Bedingung Tankentlüftung aktiv (normaler Betrieb oder Notlauf)" UWORD B_TRUE 1 100 0 1 BIT_MASK 0x100 FORMAT "%13.11" ECU_ADDRESS 0xFD9C /end MEASUREMENT
/begin MEASUREMENT B_tef "Bedingung Tankentlüftung prinzipiell freigegeben" UWORD B_TRUE 1 100 0 1 BIT_MASK 0x2 FORMAT "%13.11" ECU_ADDRESS 0xFD9C /end MEASUREMENT
/begin MEASUREMENT B_tehb "Bedingung Tankentlüftung mit hoher Beladung" UWORD B_TRUE 1 100 0 1 BIT_MASK 0x200 FORMAT "%13.11" ECU_ADDRESS 0xFD9C /end MEASUREMENT
/begin MEASUREMENT B_tehbx "Bedingung Beladungsintegrator ftead am Maximalanschlag" UWORD B_TRUE 1 100 0 1 BIT_MASK 0x400 FORMAT "%13.11" ECU_ADDRESS 0xFD9C /end MEASUREMENT
/begin MEASUREMENT B_tei "Bedingung Tankentlüftung funktionsintern" UWORD B_TRUE 1 100 0 1 BIT_MASK 0x4 FORMAT "%13.11" ECU_ADDRESS 0xFD9C /end MEASUREMENT
/begin MEASUREMENT B_ten "Bedingung Tankentlüftung im Notlaufbetrieb (ohne Lambdaregelung)" UWORD B_TRUE 1 100 0 1 BIT_MASK 0x8 FORMAT "%13.11" ECU_ADDRESS 0xFD9C /end MEASUREMENT
/begin MEASUREMENT B_tenmda "Notlauf TE beim Aussetzer" UBYTE B_TRUE 1 100 0 1 BIT_MASK 0x1 FORMAT "%13.11" ECU_ADDRESS 0x3848EF /end MEASUREMENT
/begin MEASUREMENT B_timev_inc "" UWORD B_TRUE 1 100 0 1 BIT_MASK 0x200 FORMAT "%13.11" ECU_ADDRESS 0xFD06 /end MEASUREMENT
/begin MEASUREMENT B_timfast "EGAS: DFH Geschwindigkeit; Timer läuft schnell" UWORD B_TRUE 1 100 0 1 BIT_MASK 0x200 FORMAT "%13.11" ECU_ADDRESS 0xFD4C /end MEASUREMENT
/begin MEASUREMENT B_trev_inc "" UWORD B_TRUE 1 100 0 1 BIT_MASK 0x20 FORMAT "%13.11" ECU_ADDRESS 0xFD06 /end MEASUREMENT
/begin MEASUREMENT B_tuning "" UWORD B_TRUE 1 100 0 1 BIT_MASK 0x4000 FORMAT "%13.11" ECU_ADDRESS 0xFD90 /end MEASUREMENT
/begin MEASUREMENT B_ubkst "Ubat-Schwelle ZUBKSTMX mal unterschritten" UWORD B_TRUE 1 100 0 1 BIT_MASK 0x1 FORMAT "%13.11" ECU_ADDRESS 0xFD5C /end MEASUREMENT
/begin MEASUREMENT B_vs "Bedingung Ventilhub gross" UWORD B_TRUE 1 100 0 1 BIT_MASK 0x1 FORMAT "%13.11" ECU_ADDRESS 0xFD0E /end MEASUREMENT
/begin MEASUREMENT ccpersweSav "" UWORD dez 1 100 0 65535 FORMAT "%8.2" ECU_ADDRESS 0xF7B0 /end MEASUREMENT
/begin MEASUREMENT ccpwsweSav "" UWORD dez 1 100 0 65535 FORMAT "%8.2" ECU_ADDRESS 0xF7B2 /end MEASUREMENT
/begin MEASUREMENT ctr_hscmp "" UBYTE dez 1 100 0 255 FORMAT "%5.1" ECU_ADDRESS 0x380AE5 /end MEASUREMENT
/begin MEASUREMENT dbacc_c_um "Fehlerzähler: Botschaftsabsicherung ACC-Botschaft (Alive)" UBYTE t40ms_ub_b10200 1 100 0 10200 FORMAT "%7.1" ECU_ADDRESS 0x380810 /end MEASUREMENT
/begin MEASUREMENT dbgra_c_um "Entprellzähler für Botschaftzählerüberwachung" UBYTE t40ms_ub_b10200 1 100 0 10200 FORMAT "%7.1" ECU_ADDRESS 0x38081A /end MEASUREMENT
/begin MEASUREMENT dcysdk_w "" UWORD dez 1 100 0 65535 FORMAT "%8.2" ECU_ADDRESS 0x384050 /end MEASUREMENT
/begin MEASUREMENT devoff "EV-Ausblendmaske bei Testeranforderung" UBYTE dez 1 100 0 255 FORMAT "%5.1" ECU_ADDRESS 0x38088F /end MEASUREMENT
/begin MEASUREMENT dftef_w "Eingang Integrator Spülrate" SWORD perio_sw_b1p562 1 100 -1.562 1.56195 FORMAT "%8.6" ECU_ADDRESS 0x382AAE /end MEASUREMENT
/begin MEASUREMENT dkatefrg "Abweichung Kraftstoffanteil Tankentlüftung bei Sollspülrate von Zielwert" SBYTE fak_sb_b1 1 100 -1 0.992188 FORMAT "%5.3" ECU_ADDRESS 0x380B30 /end MEASUREMENT
/begin MEASUREMENT dkhc_w "Eingang Integrator HC-Konzentration" SWORD perio_sw_b6p125 1 100 -6.125 6.12481 FORMAT "%8.6" ECU_ADDRESS 0x38532A /end MEASUREMENT
/begin MEASUREMENT dmlftef "Produkt Spülrate mal prozentuale Luftmassenänderung" UBYTE fak_ub_b0p5 1 100 0 0.498047 ECU_ADDRESS 0x380B31 /end MEASUREMENT
/begin MEASUREMENT dmrdagr_w "Momentenreserve für Diagnose AGR" UWORD rel_uw_b100 1 100 0 99.9985 FORMAT "%8.5" ECU_ADDRESS 0x3849CA /end MEASUREMENT
/begin MEASUREMENT dmssginr "relative Änderung des Massenstromes mssgin_w" SBYTE fak_sb_b1 1 100 -1 0.992188 FORMAT "%5.3" ECU_ADDRESS 0x380B32 /end MEASUREMENT
/begin MEASUREMENT dnburns_w "Minimaler Drehzahlanstieg für Erkennung einer Verbrennung" SWORD nmot_sw_q0p25 1 100 -8192 8191.75 FORMAT "%8.3" ECU_ADDRESS 0x3820EE /end MEASUREMENT
/begin MEASUREMENT dstert20_w "Normierte Weitertransportstrecke Regeneriergas im Saugrohr im 20ms-Raster" UWORD fak_uw_b2 1 100 0 1.99997 FORMAT "%8.6" ECU_ADDRESS 0x382AB0 /end MEASUREMENT
/begin MEASUREMENT dynPeriod "" SWORD dez 1 100 -32768 32767 FORMAT "%8.2" ECU_ADDRESS 0x380B9C /end MEASUREMENT
/begin MEASUREMENT dzw_um "Delta Zündwinkel zwischen zwopt und zwout in der Funktionsüberwachung" UBYTE zw_ub_q0p75 1 100 0 191.25 FORMAT "%5.1" ECU_ADDRESS 0x38083B /end MEASUREMENT
/begin MEASUREMENT ei_msrc_um "irreversibles Fehlerbit bei der MSR-Überwachung der Funktionsüberwachung" UWORD B_TRUE 1 100 0 1 BIT_MASK 0x80 FORMAT "%13.11" ECU_ADDRESS 0xFD94 /end MEASUREMENT
/begin MEASUREMENT ei_mver_um "irreversibles Fehlerbit beim Momentenvergleich der Funktionsüberwachung" UWORD B_TRUE 1 100 0 1 BIT_MASK 0x200 FORMAT "%13.11" ECU_ADDRESS 0xFD94 /end MEASUREMENT
/begin MEASUREMENT errorCntTcsort "" UBYTE dez 1 100 0 255 FORMAT "%5.1" ECU_ADDRESS 0x384822 /end MEASUREMENT
/begin MEASUREMENT esst_fho04esub "" UWORD dez 1 100 0 65535 FORMAT "%8.2" ECU_ADDRESS 0x380C44 /end MEASUREMENT
/begin MEASUREMENT esst_sdk10teub "" UWORD dez 1 100 0 65535 FORMAT "%8.2" ECU_ADDRESS 0x384972 /end MEASUREMENT
/begin MEASUREMENT esst_sez06tmub "" UWORD dez 1 100 0 65535 FORMAT "%8.2" ECU_ADDRESS 0x384974 /end MEASUREMENT
/begin MEASUREMENT esst_sfr05teub "" UWORD dez 1 100 0 65535 FORMAT "%8.2" ECU_ADDRESS 0x384976 /end MEASUREMENT
/begin MEASUREMENT esst_sga06mdub "" UWORD dez 1 100 0 65535 FORMAT "%8.2" ECU_ADDRESS 0x384978 /end MEASUREMENT
/begin MEASUREMENT esst_sga08mdub "" UWORD dez 1 100 0 65535 FORMAT "%8.2" ECU_ADDRESS 0x380C46 /end MEASUREMENT
/begin MEASUREMENT esst_sim06esuw "" UWORD dez 1 100 0 65535 FORMAT "%8.2" ECU_ADDRESS 0x38497A /end MEASUREMENT
/begin MEASUREMENT esst_sks06esub "" UWORD dez 1 100 0 65535 FORMAT "%8.2" ECU_ADDRESS 0x380C48 /end MEASUREMENT
/begin MEASUREMENT esst_sla05esub "" UWORD dez 1 100 0 65535 FORMAT "%8.2" ECU_ADDRESS 0x380C4A /end MEASUREMENT
/begin MEASUREMENT esst_sld04ldub "" UWORD dez 1 100 0 65535 FORMAT "%8.2" ECU_ADDRESS 0x380C4C /end MEASUREMENT
/begin MEASUREMENT esst_slx06tmuw "" UWORD dez 1 100 0 65535 FORMAT "%8.2" ECU_ADDRESS 0x38497C /end MEASUREMENT
/begin MEASUREMENT esst_sm108lhsw "" UWORD dez 1 100 0 65535 FORMAT "%8.2" ECU_ADDRESS 0x38497E /end MEASUREMENT
/begin MEASUREMENT esst_smi04llub "" UWORD dez 1 100 0 65535 FORMAT "%8.2" ECU_ADDRESS 0x380C4E /end MEASUREMENT
/begin MEASUREMENT esst_sml06teub "" UWORD dez 1 100 0 65535 FORMAT "%8.2" ECU_ADDRESS 0x384980 /end MEASUREMENT
/begin MEASUREMENT esst_sml06tmuw "" UWORD dez 1 100 0 65535 FORMAT "%8.2" ECU_ADDRESS 0x384982 /end MEASUREMENT
/begin MEASUREMENT esst_sml07tmuw "" UWORD dez 1 100 0 65535 FORMAT "%8.2" ECU_ADDRESS 0x384984 /end MEASUREMENT
/begin MEASUREMENT esst_sml08lhub "" UWORD dez 1 100 0 65535 FORMAT "%8.2" ECU_ADDRESS 0x384986 /end MEASUREMENT
/begin MEASUREMENT esst_smt06tmuw "" UWORD dez 1 100 0 65535 FORMAT "%8.2" ECU_ADDRESS 0x384988 /end MEASUREMENT
/begin MEASUREMENT esst_sng06llsb "" UWORD dez 1 100 0 65535 FORMAT "%8.2" ECU_ADDRESS 0x380C50 /end MEASUREMENT
/begin MEASUREMENT esst_snm05neuw "" UWORD dez 1 100 0 65535 FORMAT "%8.2" ECU_ADDRESS 0x380C52 /end MEASUREMENT
/begin MEASUREMENT esst_snm05nwub "" UWORD dez 1 100 0 65535 FORMAT "%8.2" ECU_ADDRESS 0x38498A /end MEASUREMENT
/begin MEASUREMENT esst_snm06esub "" UWORD dez 1 100 0 65535 FORMAT "%8.2" ECU_ADDRESS 0x38498C /end MEASUREMENT
/begin MEASUREMENT esst_snm06gkub "" UWORD dez 1 100 0 65535 FORMAT "%8.2" ECU_ADDRESS 0x38498E /end MEASUREMENT
/begin MEASUREMENT esst_snm06llub "" UWORD dez 1 100 0 65535 FORMAT "%8.2" ECU_ADDRESS 0x380C54 /end MEASUREMENT
/begin MEASUREMENT esst_snm06mduw "" UWORD dez 1 100 0 65535 FORMAT "%8.2" ECU_ADDRESS 0x384990 /end MEASUREMENT
/begin MEASUREMENT esst_snm07esub "" UWORD dez 1 100 0 65535 FORMAT "%8.2" ECU_ADDRESS 0x384992 /end MEASUREMENT
/begin MEASUREMENT esst_snm07lsuw "" UWORD dez 1 100 0 65535 FORMAT "%8.2" ECU_ADDRESS 0x380C56 /end MEASUREMENT
/begin MEASUREMENT esst_snm08dmub "" UWORD dez 1 100 0 65535 FORMAT "%8.2" ECU_ADDRESS 0x380C58 /end MEASUREMENT
/begin MEASUREMENT esst_snm08feub "" UWORD dez 1 100 0 65535 FORMAT "%8.2" ECU_ADDRESS 0x384994 /end MEASUREMENT
/begin MEASUREMENT esst_snm08ldub "" UWORD dez 1 100 0 65535 FORMAT "%8.2" ECU_ADDRESS 0x380C5A /end MEASUREMENT
/begin MEASUREMENT esst_snm08lduw "" UWORD dez 1 100 0 65535 FORMAT "%8.2" ECU_ADDRESS 0x380C5C /end MEASUREMENT
/begin MEASUREMENT esst_snm08lhub "" UWORD dez 1 100 0 65535 FORMAT "%8.2" ECU_ADDRESS 0x384996 /end MEASUREMENT
/begin MEASUREMENT esst_snm08opub "" UWORD dez 1 100 0 65535 FORMAT "%8.2" ECU_ADDRESS 0x380C5E /end MEASUREMENT
/begin MEASUREMENT esst_snm08__ub "" UWORD dez 1 100 0 65535 FORMAT "%8.2" ECU_ADDRESS 0x384998 /end MEASUREMENT
/begin MEASUREMENT esst_snm10lsub "" UWORD dez 1 100 0 65535 FORMAT "%8.2" ECU_ADDRESS 0x380C60 /end MEASUREMENT
/begin MEASUREMENT esst_snm10teub "" UWORD dez 1 100 0 65535 FORMAT "%8.2" ECU_ADDRESS 0x38499A /end MEASUREMENT
/begin MEASUREMENT esst_snm12esub "" UWORD dez 1 100 0 65535 FORMAT "%8.2" ECU_ADDRESS 0x380C62 /end MEASUREMENT
/begin MEASUREMENT esst_snm12feub "" UWORD dez 1 100 0 65535 FORMAT "%8.2" ECU_ADDRESS 0x380C64 /end MEASUREMENT
/begin MEASUREMENT esst_snm12lduw "" UWORD dez 1 100 0 65535 FORMAT "%8.2" ECU_ADDRESS 0x380C66 /end MEASUREMENT
/begin MEASUREMENT esst_snm16ciub "" UWORD dez 1 100 0 65535 FORMAT "%8.2" ECU_ADDRESS 0x38499C /end MEASUREMENT
/begin MEASUREMENT esst_snm16krdyub "" UWORD dez 1 100 0 65535 FORMAT "%8.2" ECU_ADDRESS 0x38499E /end MEASUREMENT
/begin MEASUREMENT esst_snm16krub "" UWORD dez 1 100 0 65535 FORMAT "%8.2" ECU_ADDRESS 0x3849A0 /end MEASUREMENT
/begin MEASUREMENT esst_snm16ldub "" UWORD dez 1 100 0 65535 FORMAT "%8.2" ECU_ADDRESS 0x380C68 /end MEASUREMENT
/begin MEASUREMENT esst_snm16lduw "" UWORD dez 1 100 0 65535 FORMAT "%8.2" ECU_ADDRESS 0x380C6A /end MEASUREMENT
/begin MEASUREMENT esst_snm16neuw "" UWORD dez 1 100 0 65535 FORMAT "%8.2" ECU_ADDRESS 0x380C6C /end MEASUREMENT
/begin MEASUREMENT esst_snm16opuw "" UWORD dez 1 100 0 65535 FORMAT "%8.2" ECU_ADDRESS 0x380C6E /end MEASUREMENT
/begin MEASUREMENT esst_snm16zuuw "" UWORD dez 1 100 0 65535 FORMAT "%8.2" ECU_ADDRESS 0x380C70 /end MEASUREMENT
/begin MEASUREMENT esst_spu08ldub "" UWORD dez 1 100 0 65535 FORMAT "%8.2" ECU_ADDRESS 0x380C72 /end MEASUREMENT
/begin MEASUREMENT esst_sqm05teub "" UWORD dez 1 100 0 65535 FORMAT "%8.2" ECU_ADDRESS 0x380C74 /end MEASUREMENT
/begin MEASUREMENT esst_srl03krub "" UWORD dez 1 100 0 65535 FORMAT "%8.2" ECU_ADDRESS 0x3849A2 /end MEASUREMENT
/begin MEASUREMENT esst_srl04krub "" UWORD dez 1 100 0 65535 FORMAT "%8.2" ECU_ADDRESS 0x3849A4 /end MEASUREMENT
/begin MEASUREMENT esst_srl05neuw "" UWORD dez 1 100 0 65535 FORMAT "%8.2" ECU_ADDRESS 0x3849A6 /end MEASUREMENT
/begin MEASUREMENT esst_srl06esub "" UWORD dez 1 100 0 65535 FORMAT "%8.2" ECU_ADDRESS 0x380C76 /end MEASUREMENT
/begin MEASUREMENT esst_srl06gkub "" UWORD dez 1 100 0 65535 FORMAT "%8.2" ECU_ADDRESS 0x3849A8 /end MEASUREMENT
/begin MEASUREMENT esst_srl06krub "" UWORD dez 1 100 0 65535 FORMAT "%8.2" ECU_ADDRESS 0x3849AA /end MEASUREMENT
/begin MEASUREMENT esst_srl08dmub "" UWORD dez 1 100 0 65535 FORMAT "%8.2" ECU_ADDRESS 0x380C78 /end MEASUREMENT
/begin MEASUREMENT esst_srl08lsuw "" UWORD dez 1 100 0 65535 FORMAT "%8.2" ECU_ADDRESS 0x380C7A /end MEASUREMENT
/begin MEASUREMENT esst_srl08neuw "" UWORD dez 1 100 0 65535 FORMAT "%8.2" ECU_ADDRESS 0x3849AC /end MEASUREMENT
/begin MEASUREMENT esst_srl08nxub "" UWORD dez 1 100 0 65535 FORMAT "%8.2" ECU_ADDRESS 0x3849AE /end MEASUREMENT
/begin MEASUREMENT esst_srl10lsub "" UWORD dez 1 100 0 65535 FORMAT "%8.2" ECU_ADDRESS 0x380C7C /end MEASUREMENT
/begin MEASUREMENT esst_srl12zuuw "" UWORD dez 1 100 0 65535 FORMAT "%8.2" ECU_ADDRESS 0x380C7E /end MEASUREMENT
/begin MEASUREMENT esst_srp06esub "" UWORD dez 1 100 0 65535 FORMAT "%8.2" ECU_ADDRESS 0x380C80 /end MEASUREMENT
/begin MEASUREMENT esst_st107tmub "" UWORD dez 1 100 0 65535 FORMAT "%8.2" ECU_ADDRESS 0x3849B0 /end MEASUREMENT
/begin MEASUREMENT esst_st307tmub "" UWORD dez 1 100 0 65535 FORMAT "%8.2" ECU_ADDRESS 0x3849B2 /end MEASUREMENT
/begin MEASUREMENT esst_sta04llub "" UWORD dez 1 100 0 65535 FORMAT "%8.2" ECU_ADDRESS 0x380C82 /end MEASUREMENT
/begin MEASUREMENT esst_sta06esub "" UWORD dez 1 100 0 65535 FORMAT "%8.2" ECU_ADDRESS 0x3849B4 /end MEASUREMENT
/begin MEASUREMENT esst_sta08ldub "" UWORD dez 1 100 0 65535 FORMAT "%8.2" ECU_ADDRESS 0x380C84 /end MEASUREMENT
/begin MEASUREMENT esst_sta12wlub "" UWORD dez 1 100 0 65535 FORMAT "%8.2" ECU_ADDRESS 0x380C86 /end MEASUREMENT
/begin MEASUREMENT esst_stk04saub "" UWORD dez 1 100 0 65535 FORMAT "%8.2" ECU_ADDRESS 0x3849B6 /end MEASUREMENT
/begin MEASUREMENT esst_stm04feub "" UWORD dez 1 100 0 65535 FORMAT "%8.2" ECU_ADDRESS 0x380C88 /end MEASUREMENT
/begin MEASUREMENT esst_stm04saub "" UWORD dez 1 100 0 65535 FORMAT "%8.2" ECU_ADDRESS 0x380C8A /end MEASUREMENT
/begin MEASUREMENT esst_stm05saub "" UWORD dez 1 100 0 65535 FORMAT "%8.2" ECU_ADDRESS 0x3849B8 /end MEASUREMENT
/begin MEASUREMENT esst_stm05tmub "" UWORD dez 1 100 0 65535 FORMAT "%8.2" ECU_ADDRESS 0x3849BA /end MEASUREMENT
/begin MEASUREMENT esst_stm06llub "" UWORD dez 1 100 0 65535 FORMAT "%8.2" ECU_ADDRESS 0x3849BC /end MEASUREMENT
/begin MEASUREMENT esst_stm06__ub "" UWORD dez 1 100 0 65535 FORMAT "%8.2" ECU_ADDRESS 0x3849BE /end MEASUREMENT
/begin MEASUREMENT esst_stm08dmub "" UWORD dez 1 100 0 65535 FORMAT "%8.2" ECU_ADDRESS 0x380C8C /end MEASUREMENT
/begin MEASUREMENT esst_stm08gkub "" UWORD dez 1 100 0 65535 FORMAT "%8.2" ECU_ADDRESS 0x3849C0 /end MEASUREMENT
/begin MEASUREMENT esst_stm09esub "" UWORD dez 1 100 0 65535 FORMAT "%8.2" ECU_ADDRESS 0x3849C2 /end MEASUREMENT
/begin MEASUREMENT esst_stm10__ub "" UWORD dez 1 100 0 65535 FORMAT "%8.2" ECU_ADDRESS 0x3849C4 /end MEASUREMENT
/begin MEASUREMENT esst_stm12esub "" UWORD dez 1 100 0 65535 FORMAT "%8.2" ECU_ADDRESS 0x380C8E /end MEASUREMENT
/begin MEASUREMENT esst_stn06llub "" UWORD dez 1 100 0 65535 FORMAT "%8.2" ECU_ADDRESS 0x3849C6 /end MEASUREMENT
/begin MEASUREMENT esst_sts08esub "" UWORD dez 1 100 0 65535 FORMAT "%8.2" ECU_ADDRESS 0x380C90 /end MEASUREMENT
/begin MEASUREMENT esst_sts08ldub "" UWORD dez 1 100 0 65535 FORMAT "%8.2" ECU_ADDRESS 0x380C92 /end MEASUREMENT
/begin MEASUREMENT esst_sts12esub "" UWORD dez 1 100 0 65535 FORMAT "%8.2" ECU_ADDRESS 0x380C94 /end MEASUREMENT
/begin MEASUREMENT esst_suv07mdub "" UWORD dez 1 100 0 65535 FORMAT "%8.2" ECU_ADDRESS 0x3849C8 /end MEASUREMENT
/begin MEASUREMENT esst_svp12lduw "" UWORD dez 1 100 0 65535 FORMAT "%8.2" ECU_ADDRESS 0x380C96 /end MEASUREMENT
/begin MEASUREMENT esst_swp08opub "" UWORD dez 1 100 0 65535 FORMAT "%8.2" ECU_ADDRESS 0x380C98 /end MEASUREMENT
/begin MEASUREMENT etate "Motorwirkungsgrad bei Tankentlüftung mit hoher Beladung" UBYTE rel_ub_b127p5 1 100 0 127.5 FORMAT "%5.1" ECU_ADDRESS 0x3848F0 /end MEASUREMENT
/begin MEASUREMENT etateint "Integrator Motrwirkungsgrad bei Tankentlüftung" UBYTE rel_ub_b127p5 1 100 0 127.5 FORMAT "%5.1" ECU_ADDRESS 0x3848F1 /end MEASUREMENT
/begin MEASUREMENT etatesol "beladungsabhängiger Soll-Motorwirkungsgrad bei Betrieb mit Tankentlüftung" UBYTE rel_ub_b127p5 1 100 0 127.5 FORMAT "%5.1" ECU_ADDRESS 0x3848F2 /end MEASUREMENT
/begin MEASUREMENT etazw_um "Ist-Zündwinkelwirkungsgrad in der Funktionsüberwachung" UBYTE rel_ub_b127p5 1 100 0 127.5 FORMAT "%5.1" ECU_ADDRESS 0x380AEC /end MEASUREMENT
/begin MEASUREMENT evz_aus_um "Einspritzausblendmuster in der Funktionsüberwachung" UBYTE dez 1 100 0 255 FORMAT "%5.1" ECU_ADDRESS 0x380809 /end MEASUREMENT
/begin MEASUREMENT fbetate "gewünschter Motorwirkungsgrad als f(nmot) bei TE zur Vermeidung von te <= TEMIN" UBYTE fak_ub_b1 1 100 0 0.996094 ECU_ADDRESS 0x3848F3 /end MEASUREMENT
/begin MEASUREMENT fbkate "Faktor Kraftstoffanteil Tankentlüftung abhängig von te / TEMIN" UBYTE fak_ub_b1 1 100 0 0.996094 ECU_ADDRESS 0x3848F4 /end MEASUREMENT
/begin MEASUREMENT fgwrte "Eingriff Grenzwertregelung Tankentlüftung" SBYTE fak_sb_b16 1 100 -16 15.875 FORMAT "%5.2" ECU_ADDRESS 0x3848F5 /end MEASUREMENT
/begin MEASUREMENT fkateapp "Faktor applizierter Krafstoffanteil Tankentlüftung" SBYTE fak_sb_b1 1 100 -1 0.992188 FORMAT "%5.3" ECU_ADDRESS 0x3848F6 /end MEASUREMENT
/begin MEASUREMENT fkatefrg "Faktor Kraftstoffanteil Tankentlüftung bei Sollspülrate" SBYTE fak_sb_b1 1 100 -1 0.992188 FORMAT "%5.3" ECU_ADDRESS 0x380B33 /end MEASUREMENT
/begin MEASUREMENT fkatei "Faktor Kraftstoffanteil Tankentlüftung (aktueller Istwert)" SBYTE fak_sb_b1 1 100 -1 0.992188 FORMAT "%5.3" ECU_ADDRESS 0x380B34 /end MEASUREMENT
/begin MEASUREMENT fkates "Faktor Kraftstoffanteil Tankentlüftung (Sollwert)" SBYTE fak_sb_b1 1 100 -1 0.992188 FORMAT "%5.3" ECU_ADDRESS 0x3848F7 /end MEASUREMENT
/begin MEASUREMENT fngwrte "Faktor Regelung Spülrate nach Grenzwertregeleingriff" SBYTE fak_sb_b16 1 100 -16 15.875 FORMAT "%5.2" ECU_ADDRESS 0x380B35 /end MEASUREMENT
/begin MEASUREMENT fregfte "Faktor Regelung Spülrate vor Grenzwertregeleingriff" SBYTE fak_sb_b16 1 100 -16 15.875 FORMAT "%5.2" ECU_ADDRESS 0x380B36 /end MEASUREMENT
/begin MEASUREMENT frmit "Bei Stereo-LR: Mittelwert des fr,fr2 oder bei Ausfall einer Bank: fr der i.O. Bk" UBYTE fak_ub_b2 1 100 0 1.99219 FORMAT "%5.3" ECU_ADDRESS 0x380B37 /end MEASUREMENT
/begin MEASUREMENT frmit_w "Mittelwert aus fr und fr2 (16 bit)" UWORD fak_uw_b2 1 100 0 1.99997 FORMAT "%8.6" ECU_ADDRESS 0x382AB2 /end MEASUREMENT
/begin MEASUREMENT frmxa "fr-Max-Auschlag: Bei Stereo-LR: der fr, der am weitesten von 1.0 entfernt" UBYTE fak_ub_b2 1 100 0 1.99219 FORMAT "%5.3" ECU_ADDRESS 0x380B38 /end MEASUREMENT
/begin MEASUREMENT frmxaold_w "Mittelwert Lambdaregler - alter Wert (16 bit)" UWORD fak_uw_b2 1 100 0 1.99997 FORMAT "%8.6" ECU_ADDRESS 0x382AB4 /end MEASUREMENT
/begin MEASUREMENT frmxa_w "fr-Max-Ausschlag: Bei Stereo LR der fr, der am weitesten von 1.0 weg (16 bit)" UWORD fak_uw_b2 1 100 0 1.99997 FORMAT "%8.6" ECU_ADDRESS 0x382AB6 /end MEASUREMENT
/begin MEASUREMENT ftadmste "Bewrtungsfaktor für Absteuern des TEV bei dynamischer Vorgänge" UBYTE fak_ub_b2 1 100 0 1.99219 FORMAT "%5.3" ECU_ADDRESS 0x380B39 /end MEASUREMENT
/begin MEASUREMENT fteadf "gefilterter Faktor Tankentlüftungs-Adaption" SBYTE fak_sb_q0p5 1 100 -64 63.5 FORMAT "%5.2" ECU_ADDRESS 0x3848F8 /end MEASUREMENT
/begin MEASUREMENT fteadf_w "gefilterter Faktor Tankentlüftungs-Adaption" SWORD fak_q0p00195 1 100 -64 63.998 FORMAT "%8.5" ECU_ADDRESS 0x38532C /end MEASUREMENT
/begin MEASUREMENT ftead_w "Faktor Tankentlüftungs-Adaption" SWORD fak_sw_b64 1 100 -64 63.998 FORMAT "%8.5" ECU_ADDRESS 0x38532E /end MEASUREMENT
/begin MEASUREMENT ftefsold_w "Letzter Sollwert der Spülrate Tankentlüftung vor Absteuerung" UWORD fak_uw_b0p5 1 100 0 0.499992 FORMAT "%9.7" ECU_ADDRESS 0x382AB8 /end MEASUREMENT
/begin MEASUREMENT ftefsoll_w "Sollwert der Spülrate Tankentlüftung" UWORD fak_uw_b0p5 1 100 0 0.499992 FORMAT "%9.7" ECU_ADDRESS 0x382ABA /end MEASUREMENT
/begin MEASUREMENT ftefva "Spülrate der Tankentlüftung" UBYTE fak_ub_b0p5 1 100 0 0.498047 ECU_ADDRESS 0x380B3A /end MEASUREMENT
/begin MEASUREMENT ftefvab "Begrenzungswert der Spülrate Tankentlüftung" UBYTE fak_ub_b0p03125 1 100 0 0.0311279 FORMAT "%7.5" ECU_ADDRESS 0x3848F9 /end MEASUREMENT
/begin MEASUREMENT ftefvamx_w "max. Spülrate (Begrenzung absolut, 16 bit)" UWORD fak_uw_b0p5 1 100 0 0.499992 FORMAT "%9.7" ECU_ADDRESS 0x382ABC /end MEASUREMENT
/begin MEASUREMENT ftefva_w "Spülrate Tankentlüftung" UWORD fak_uw_b0p5 1 100 0 0.499992 FORMAT "%9.7" ECU_ADDRESS 0x382ABE /end MEASUREMENT
/begin MEASUREMENT fteml "Aufsteuergeschwindigkeit der Spülrate und des Massenstroms TEV" UBYTE perio_ub_b0p012207 1 100 0 0.0121593 FORMAT "%12.10" ECU_ADDRESS 0x3848FA /end MEASUREMENT
/begin MEASUREMENT fvermte_w "Faktor Vermischung Regeneriergas im Saugrohr" UWORD fak_uw_b1 1 100 0 0.999985 FORMAT "%9.7" ECU_ADDRESS 0x382AC0 /end MEASUREMENT
/begin MEASUREMENT ilmlkat_w "Gültig gemessener Wert des Sauerstoffspeichers" UWORD m_uw_b4660 1 100 0 4660.27 FORMAT "%8.3" ECU_ADDRESS 0x380C9A /end MEASUREMENT
/begin MEASUREMENT imsteini "Integral Massenstrom TEV nach längerem TE-Stop" UBYTE m_ub_q0p0444 1 100 0 11.322 FORMAT "%5.2" ECU_ADDRESS 0x3848FB /end MEASUREMENT
/begin MEASUREMENT khc_w "Adaptierte HC-Konzentration Regenerierstrom" SWORD fak_sw_b2 1 100 -2 1.99994 FORMAT "%8.6" ECU_ADDRESS 0x385330 /end MEASUREMENT
/begin MEASUREMENT ksta0 "Kaltstartanreicherung Bereich 0, gepuffert" UBYTE fak_ub_b2 1 100 0 1.99219 FORMAT "%5.3" ECU_ADDRESS 0x38332E /end MEASUREMENT
/begin MEASUREMENT ksta0w "Kaltstartanreicherung Bereich 0, aktuell eingerechnet" UBYTE fak_ub_b2 1 100 0 1.99219 FORMAT "%5.3" ECU_ADDRESS 0x3809F0 /end MEASUREMENT
/begin MEASUREMENT ksta1 "Kaltstartanreicherung Bereich 1, gepuffert" UBYTE fak_ub_b2 1 100 0 1.99219 FORMAT "%5.3" ECU_ADDRESS 0x38332F /end MEASUREMENT
/begin MEASUREMENT ksta1w "Kaltstartanreicherung Bereich 1, aktuell eingerechnet" UBYTE fak_ub_b2 1 100 0 1.99219 FORMAT "%5.3" ECU_ADDRESS 0x3809F1 /end MEASUREMENT
/begin MEASUREMENT ksta2 "Kaltstartanreicherung Bereich 2, gepuffert" UBYTE fak_ub_b2 1 100 0 1.99219 FORMAT "%5.3" ECU_ADDRESS 0x383330 /end MEASUREMENT
/begin MEASUREMENT ksta2w "Kaltstartanreicherung Bereich 2, aktuell eingerechnet" UBYTE fak_ub_b2 1 100 0 1.99219 FORMAT "%5.3" ECU_ADDRESS 0x3809F2 /end MEASUREMENT
/begin MEASUREMENT kstaa "Aktueller Startmengenadaptionsfaktor" UBYTE fak_ub_b2 1 100 0 1.99219 FORMAT "%5.3" ECU_ADDRESS 0x3809F3 /end MEASUREMENT
/begin MEASUREMENT kteev_w "Konzentration Regeneriergas im Saugrohr auf Höhe der Einspritzventile" UWORD fak_uw_b1 1 100 0 0.999985 FORMAT "%9.7" ECU_ADDRESS 0x382AC2 /end MEASUREMENT
/begin MEASUREMENT ktetevvz_w "Konzentration Regeneriergas im Saugrohr verzögert" UWORD fak_uw_b1 1 100 0 0.999985 FORMAT "%9.7" ECU_ADDRESS 0x382AC4 /end MEASUREMENT
/begin MEASUREMENT ktetev_w "Konzentration Regeneriergas im Saugrohr auf Höhe vom TEV" UWORD fak_uw_b1 1 100 0 0.999985 FORMAT "%9.7" ECU_ADDRESS 0x382AC6 /end MEASUREMENT
/begin MEASUREMENT lokBits_Tebeb "" UBYTE dez 1 100 0 255 FORMAT "%5.1" ECU_ADDRESS 0x3848EF /end MEASUREMENT
/begin MEASUREMENT mdif_w_um "Differenz zwischen zulässigem und Ist-Moment in der Funktionsüberwachung" SWORD rel_ub_q0p3906 1 100 -12800 12799.6 FORMAT "%8.2" ECU_ADDRESS 0x3828BE /end MEASUREMENT
/begin MEASUREMENT mfgr_um "Momentenwunsch aus der Fahrgeschwindigkeitsregelung für die Funktionsüberwachung" UBYTE rel_ub_q0p3906 1 100 0 99.6094 FORMAT "%5.2" ECU_ADDRESS 0x380837 /end MEASUREMENT
/begin MEASUREMENT migsl_w "Inneres Soll-Motormoment zur Füllungsbegrenzung bei GSf" UWORD dez 1 100 0 65535 FORMAT "%8.2" ECU_ADDRESS 0x3849CC /end MEASUREMENT
/begin MEASUREMENT miopt_um "optimales indiziertes Moment in der Funktionsüberwachung" UBYTE rel_ub_b99p6 1 100 0 99.6094 FORMAT "%5.2" ECU_ADDRESS 0x380AED /end MEASUREMENT
/begin MEASUREMENT misgsl_w "Inneres Soll-Motormoment luftseitig für Drehzahlsynchr. bei Getriebeschaltung" UWORD dez 1 100 0 65535 FORMAT "%8.2" ECU_ADDRESS 0x3849CE /end MEASUREMENT
/begin MEASUREMENT mitebg_w "Momentvorgabe für Mindestfüllung Tankentlüftung" UWORD rel_uw_b100 1 100 0 99.9985 FORMAT "%8.5" ECU_ADDRESS 0x382AC8 /end MEASUREMENT
/begin MEASUREMENT mi_um "Berechnetes Ist-Moment in der Funktionsüberwachung" UBYTE rel_ub_b99p6 1 100 0 99.6094 FORMAT "%5.2" ECU_ADDRESS 0x38083C /end MEASUREMENT
/begin MEASUREMENT mmsr_um "zulässiger MSR-Momentenwunsch für die Funktionsüberwachung" UBYTE rel_ub_q0p3906 1 100 0 99.6094 FORMAT "%5.2" ECU_ADDRESS 0x380839 /end MEASUREMENT
/begin MEASUREMENT mracc_um "Momentenwunsch von ACC in Funktionsüberwachung" UBYTE rel_ub_q0p3906 1 100 0 99.6094 FORMAT "%5.2" ECU_ADDRESS 0x380811 /end MEASUREMENT
/begin MEASUREMENT mracc_w "Relativer Momentenwunsch von ACC" UWORD rel_uw_b200 1 100 0 199.997 FORMAT "%8.4" ECU_ADDRESS 0x380C9C /end MEASUREMENT
/begin MEASUREMENT msndko_w "normierter Leckluftmassenstrom über Drosselklappe (word)" UWORD m_uw_b6553p5 1 100 0 6553.5 FORMAT "%8.3" ECU_ADDRESS 0x383452 /end MEASUREMENT
/begin MEASUREMENT msrc_c_um "Fehlerzähler für MSR-Eingriff-Überwachung der Funktionsüberwachung" UBYTE t40ms_ub_b10200 1 100 0 10200 FORMAT "%7.1" ECU_ADDRESS 0x38083A /end MEASUREMENT
/begin MEASUREMENT mssginmn_w "Minmaler ins Saugrohr strömender Massenstrom (Drosselklappe + TEV)" UWORD m_uw_b6553p5 1 100 0 6553.5 FORMAT "%8.3" ECU_ADDRESS 0x382ACA /end MEASUREMENT
/begin MEASUREMENT mssgin_w "Ins Saugrohr strömender Massenstrom (Drosselklappe + TEV)" UWORD m_uw_b6553p5 1 100 0 6553.5 FORMAT "%8.3" ECU_ADDRESS 0x382ACC /end MEASUREMENT
/begin MEASUREMENT msteev_w "Massenstrom Regeneriergas auf Höhe Einspritzventil" UWORD m_uw_b25p6 1 100 0 25.5996 FORMAT "%8.5" ECU_ADDRESS 0x382ACE /end MEASUREMENT
/begin MEASUREMENT mstesmx_w "Maximal möglicher Sollmassenstrom Tankentlüftung" UWORD m_uw_b25p6 1 100 0 25.5996 FORMAT "%8.5" ECU_ADDRESS 0x382AD0 /end MEASUREMENT
/begin MEASUREMENT mstesoll_w "Massenstrom Tankentlüftung ins Saugrohr, Sollwert" UWORD m_uw_b25p6 1 100 0 25.5996 FORMAT "%8.5" ECU_ADDRESS 0x382AD2 /end MEASUREMENT
/begin MEASUREMENT mver_c_um "Fehlerzähler für Momentenvergleich der Funktionsüberwachung" UBYTE t40ms_ub_b10200 1 100 0 10200 FORMAT "%7.1" ECU_ADDRESS 0x38084A /end MEASUREMENT
/begin MEASUREMENT mzfo_um "gefiltertes zulässiges Moment inclusive Offset in der Funktionsüberwachung" UBYTE rel_ub_q0p3906 1 100 0 99.6094 FORMAT "%5.2" ECU_ADDRESS 0x38084B /end MEASUREMENT
/begin MEASUREMENT mzf_low_um "Nachkommastellen für gefiltertes zulässiges Moment der Funktionsüberwachung" UBYTE rel_ub_q0p00153 1 100 0 0.389074 ECU_ADDRESS 0x38083F /end MEASUREMENT
/begin MEASUREMENT mzf_ptr_um "Zeiger des Registers mzf_reg_um" UBYTE dez 1 100 0 255 FORMAT "%5.1" ECU_ADDRESS 0x380840 /end MEASUREMENT
/begin MEASUREMENT mzf_reg_um "Register für zulässiges Moment zeitverzögert" UBYTE rel_ub_q0p3906 1 100 0 99.6094 FORMAT "%5.2" ARRAY_SIZE 8 ECU_ADDRESS 0x380841 /end MEASUREMENT
/begin MEASUREMENT mzf_um "gefiltertes zulässiges Moment der Funktionsüberwachung" UBYTE rel_ub_q0p3906 1 100 0 99.6094 FORMAT "%5.2" ECU_ADDRESS 0x380849 /end MEASUREMENT
/begin MEASUREMENT nlldagkt "Drehzahlerhöhung bei Diagnose im Kurztest" UBYTE nmot_ub_q40 1 100 0 10200 FORMAT "%5.0" ECU_ADDRESS 0x384801 /end MEASUREMENT
/begin MEASUREMENT nmaxext_w "Externe Drehzahlgrenze" UWORD nmot_uw_q0p25 1 100 0 16383.8 FORMAT "%8.2" ECU_ADDRESS 0x380C9E /end MEASUREMENT
/begin MEASUREMENT nmst08_um "Stützstelle für Motordrehzahl in der Funktionsüberwachung (NMOT_UM)" UWORD dez 1 100 0 65535 FORMAT "%8.2" ECU_ADDRESS 0x380864 /end MEASUREMENT
/begin MEASUREMENT nturbc_w "Wandler-Turbinendrehzahl über CAN" UWORD dez 1 100 0 65535 FORMAT "%8.2" ECU_ADDRESS 0x380CA0 /end MEASUREMENT
/begin MEASUREMENT nzwst08_um "" UWORD dez 1 100 0 65535 FORMAT "%8.2" ECU_ADDRESS 0x380866 /end MEASUREMENT
/begin MEASUREMENT oscdkto_w "" UWORD fak_uw_b16 1 100 0 15.9998 FORMAT "%8.5" ECU_ADDRESS 0x384052 /end MEASUREMENT
/begin MEASUREMENT osckls "" UBYTE dez 1 100 0 255 FORMAT "%5.1" ECU_ADDRESS 0x384850 /end MEASUREMENT
/begin MEASUREMENT psdss_w "Saugrohrdruck gemessen mit Drucksensor am Saugrohr (DS-S)" UWORD p_uw_q0p039 1 100 0 2559.96 FORMAT "%8.3" ECU_ADDRESS 0x3849D0 /end MEASUREMENT
/begin MEASUREMENT psl "Öldruck von der Servo-Lenkung" UBYTE dez 1 100 0 255 FORMAT "%5.1" ECU_ADDRESS 0x384802 /end MEASUREMENT
/begin MEASUREMENT pspu "Quotient Saugrohrdruck Umgebungsdruck" UBYTE fak_ub_b2 1 100 0 1.99219 FORMAT "%5.3" ECU_ADDRESS 0x380B3B /end MEASUREMENT
/begin MEASUREMENT qmsdyn "Quotient aus ml_w und mssgin_w" UBYTE fak_ub_b16 1 100 0 15.9375 FORMAT "%5.2" ECU_ADDRESS 0x380B3C /end MEASUREMENT
/begin MEASUREMENT qtetemin "Quotient: te / TEMIN für BDE teh_w/teminh_w bzw. tes_w/temins" UBYTE fak_ub_b4 1 100 0 3.98438 FORMAT "%5.3" ECU_ADDRESS 0x380B3D /end MEASUREMENT
/begin MEASUREMENT rkte_w "Relativer Gemischanteil Tankentlüftung" SWORD rel_sw_q0p0468 1 100 -1536 1535.95 FORMAT "%8.3" ECU_ADDRESS 0x382AD4 /end MEASUREMENT
/begin MEASUREMENT rlst08_um "Stützstelle der SSV RLV08_UM" UWORD dez 1 100 0 65535 FORMAT "%8.2" ECU_ADDRESS 0x380868 /end MEASUREMENT
/begin MEASUREMENT rlteev_w "Relative Füllung verursacht durch Regeneriergas Tankentlüftung" UWORD rel_uw_b192 1 100 0 191.997 FORMAT "%8.4" ECU_ADDRESS 0x382AD6 /end MEASUREMENT
/begin MEASUREMENT spsnst08_um "" UWORD dez 1 100 0 65535 FORMAT "%8.2" ECU_ADDRESS 0x38086A /end MEASUREMENT
/begin MEASUREMENT stactr "Startadaptionscounter" UBYTE dez 1 100 0 255 FORMAT "%5.1" ECU_ADDRESS 0x3809F4 /end MEASUREMENT
/begin MEASUREMENT STADAPlokBits "" UWORD dez 1 100 0 65535 FORMAT "%8.2" ECU_ADDRESS 0x384B2A /end MEASUREMENT
/begin MEASUREMENT synstate "Aktueller Synchronisierzustand" UBYTE dez 1 100 0 255 FORMAT "%5.1" ECU_ADDRESS 0xF8C7 /end MEASUREMENT
/begin MEASUREMENT synstate_o "Sychronisationszustand des vorherigen Synchros" UBYTE dez 1 100 0 255 FORMAT "%5.1" ECU_ADDRESS 0xF8C8 /end MEASUREMENT
/begin MEASUREMENT systemStackUsage "" UWORD fak_uw_b1 1 100 0 0.999985 FORMAT "%9.7" ECU_ADDRESS 0x385324 /end MEASUREMENT
/begin MEASUREMENT tahsom_w "Abgastemperatur an Sonde hinter Kat aus Modell" UWORD temp_q0p0234_o273 1 100 -273.15 1262.83 FORMAT "%8.3" ECU_ADDRESS 0x384A6E /end MEASUREMENT
/begin MEASUREMENT taikrm_w "Abgastemperatur im Krümmer (Zusammenführung aller Zylinder) aus Modell" UWORD temp_q0p0234_o273 1 100 -273.15 1262.83 FORMAT "%8.3" ECU_ADDRESS 0x384A70 /end MEASUREMENT
/begin MEASUREMENT takols "Klimakompressor-Signal als PWM-Signal" UBYTE dez 1 100 0 255 FORMAT "%5.1" ECU_ADDRESS 0x384803 /end MEASUREMENT
/begin MEASUREMENT talsuf "gefilterte Abgastemperatur aus Modell" UBYTE temp_ub_q5_o50 1 100 -50 1225 FORMAT "%5.0" ECU_ADDRESS 0x384804 /end MEASUREMENT
/begin MEASUREMENT tanhkm_w "Abgastemperatur hinter Hauptkat aus Modell" UWORD temp_q0p0234_o273 1 100 -273.15 1262.83 FORMAT "%8.3" ECU_ADDRESS 0x384A72 /end MEASUREMENT
/begin MEASUREMENT tans_um "Ansaugluft-Temperatur in der Funktionsüberwachung" UBYTE temp_ub_q0p75_o48 1 100 -48 143.25 FORMAT "%5.1" ECU_ADDRESS 0x38080A /end MEASUREMENT
/begin MEASUREMENT tanvk_w "Abgastemperatur nach dem Vorkat" UWORD temp_q0p0234_o273 1 100 -273.15 1262.83 FORMAT "%8.3" ECU_ADDRESS 0x384A74 /end MEASUREMENT
/begin MEASUREMENT tatuk "Ansaugluft- oder Umgebungstemperatur, Ausgabe in Grad C, intern in Kelvin" UBYTE temp_q6_o273 1 100 -273.15 1256.85 FORMAT "%5.0" ECU_ADDRESS 0x384854 /end MEASUREMENT
/begin MEASUREMENT tatuk_w "Ansaugluft- oder Umgebungstemperatur, Ausgabe in Grad C, intern in Kelvin" UWORD temp_q0p0234_o273 1 100 -273.15 1262.83 FORMAT "%8.3" ECU_ADDRESS 0x384A76 /end MEASUREMENT
/begin MEASUREMENT tavhkm_w "Abgastemperatur vor Hauptkat aus Modell" UWORD temp_q0p0234_o273 1 100 -273.15 1262.83 FORMAT "%8.3" ECU_ADDRESS 0x384A78 /end MEASUREMENT
/begin MEASUREMENT tavrom_w "Abgastemperatur im Rohrstuck nach Krümmer modelliert" UWORD temp_q0p0234_o273 1 100 -273.15 1262.83 FORMAT "%8.3" ECU_ADDRESS 0x384A7A /end MEASUREMENT
/begin MEASUREMENT tavsom_w "Abgastemperatur an Sonde vor Kat aus Modell" UWORD temp_q0p0234_o273 1 100 -273.15 1262.83 FORMAT "%8.3" ECU_ADDRESS 0x384A7C /end MEASUREMENT
/begin MEASUREMENT tavvkm_w "Abgastemperatur vor Vorkat aus Modell" UWORD temp_q0p0234_o273 1 100 -273.15 1262.83 FORMAT "%8.3" ECU_ADDRESS 0x384A7E /end MEASUREMENT
/begin MEASUREMENT tc6katc "Ausgabe-Code SCAN-Tool Mode 6 aus KAT-Diagnose" UBYTE dez 1 100 0 255 FORMAT "%5.1" ECU_ADDRESS 0x383248 /end MEASUREMENT
/begin MEASUREMENT tc6kats "Ausgabe Schwellwert SCAN-Tool Mode 6 aus KAT-Diagnose" UBYTE dez 1 100 0 255 FORMAT "%5.1" ECU_ADDRESS 0x380890 /end MEASUREMENT
/begin MEASUREMENT tc6katw "Ausgabe Prüfwert SCAN-Tool Mode 6 aus KAT-Diagnose" UBYTE dez 1 100 0 255 FORMAT "%5.1" ECU_ADDRESS 0x380891 /end MEASUREMENT
/begin MEASUREMENT tcchswe_w "Highzeit Schlechtwegsignal ABS von CC-Einheit" UWORD dez 1 100 0 65535 FORMAT "%8.2" ECU_ADDRESS 0xF7B4 /end MEASUREMENT
/begin MEASUREMENT tccpswe_w "Periodendauer Schlechtwegsignal ABS von CC-Einheit" UWORD dez 1 100 0 65535 FORMAT "%8.2" ECU_ADDRESS 0xF7B6 /end MEASUREMENT
/begin MEASUREMENT timevovCtr "" UWORD dez 1 100 0 65535 FORMAT "%8.2" ECU_ADDRESS 0xF7AE /end MEASUREMENT
/begin MEASUREMENT timevovCtr_sweisr_Old "" UWORD dez 1 100 0 65535 FORMAT "%8.2" ECU_ADDRESS 0xF7B8 /end MEASUREMENT
/begin MEASUREMENT tkihkm_w "Temperatur Katalysator im Hauptkat aus Modell" UWORD temp_q0p0234_o273 1 100 -273.15 1262.83 FORMAT "%8.3" ECU_ADDRESS 0x384A80 /end MEASUREMENT
/begin MEASUREMENT tmadb "Bereich Motortemperatur für Startmengenadaption" UBYTE dez 1 100 0 255 FORMAT "%5.1" ECU_ADDRESS 0x3809F5 /end MEASUREMENT
/begin MEASUREMENT tmotk "Motor-Temperatur, Ausgabe in Grad C, intern in Kelvin" UBYTE temp_q6_o273 1 100 -273.15 1256.85 FORMAT "%5.0" ECU_ADDRESS 0x384855 /end MEASUREMENT
/begin MEASUREMENT tmotk_w "Motor-Temperatur, Ausgabe in Grad C, intern in Kelvin" UWORD temp_q0p0234_o273 1 100 -273.15 1262.83 FORMAT "%8.3" ECU_ADDRESS 0x384A82 /end MEASUREMENT
/begin MEASUREMENT tmot_um "Motor-Temperatur in der Funktionsüberwachung" UBYTE temp_ub_q0p75_o48 1 100 -48 143.25 FORMAT "%5.1" ECU_ADDRESS 0x38080B /end MEASUREMENT
/begin MEASUREMENT tn2 "Segmentzeit pro Zündung" UWORD tinjection_sy 1 100 0 174.76 FORMAT "%8.4" ECU_ADDRESS 0xF99C /end MEASUREMENT
/begin MEASUREMENT trevovCtr "" UWORD dez 1 100 0 65535 FORMAT "%8.2" ECU_ADDRESS 0xF7AC /end MEASUREMENT
/begin MEASUREMENT tr_zahn "Zahnzähler (Winkel an TR-Marke)" UWORD dez 1 100 0 65535 FORMAT "%8.2" ECU_ADDRESS 0xF7A4 /end MEASUREMENT
/begin MEASUREMENT tr_zahn2 "Zahnzähler (Winkel an TR-Marke)" UWORD dez 1 100 0 65535 FORMAT "%8.2" ECU_ADDRESS 0xF7A6 /end MEASUREMENT
/begin MEASUREMENT tr_zeit "Timerstand zum Zeitpunkt der TR-Marke" UWORD dez 1 100 0 65535 FORMAT "%8.2" ECU_ADDRESS 0xF7A8 /end MEASUREMENT
/begin MEASUREMENT tr_zeit2 "Timerstand zum Zeitpunkt der TR-Marke" UWORD dez 1 100 0 65535 FORMAT "%8.2" ECU_ADDRESS 0xF7AA /end MEASUREMENT
/begin MEASUREMENT tr_zeit_msb "" UBYTE dez 1 100 0 255 FORMAT "%5.1" ECU_ADDRESS 0xF7A2 /end MEASUREMENT
/begin MEASUREMENT tumta "Umgebungstemperatur aus Ansauglufttemperatur" UBYTE temp_ub_q0p75_o48 1 100 -48 143.25 FORMAT "%5.1" ECU_ADDRESS 0x380892 /end MEASUREMENT
/begin MEASUREMENT tum_ein "Umgebungstemperatur für Abstellzeitberechnung" UBYTE dez 1 100 0 255 FORMAT "%5.1" ECU_ADDRESS 0x380893 /end MEASUREMENT
/begin MEASUREMENT tun_det "" UBYTE dez 1 100 0 255 FORMAT "%5.1" ECU_ADDRESS 0x380AE6 /end MEASUREMENT
/begin MEASUREMENT tun_errcode "" UBYTE dez 1 100 0 255 FORMAT "%5.1" ECU_ADDRESS 0x380AE7 /end MEASUREMENT
/begin MEASUREMENT tun_errcycle "" UBYTE dez 1 100 0 255 FORMAT "%5.1" ECU_ADDRESS 0x380AE8 /end MEASUREMENT
/begin MEASUREMENT tzlrdkt_w "Lambdaregler-Periodendauer aus Katdiagnose" UWORD t10msxs_uw_b655p35 1 100 0 655.35 FORMAT "%8.4" ECU_ADDRESS 0x380CA2 /end MEASUREMENT
/begin MEASUREMENT uhepoti "Spannung Heizungspoti" UBYTE dez 1 100 0 255 FORMAT "%5.1" ECU_ADDRESS 0x384805 /end MEASUREMENT
/begin MEASUREMENT userStackUsage "" UWORD fak_uw_b1 1 100 0 0.999985 FORMAT "%9.7" ECU_ADDRESS 0x385326 /end MEASUREMENT
/begin MEASUREMENT usnhhk_w "Spannung Lambdasonde (4.88mV/LSB) hinter Hauptkatalysator" UWORD dez 1 100 0 65535 FORMAT "%8.2" ECU_ADDRESS 0x380CA4 /end MEASUREMENT
/begin MEASUREMENT usvk "Spannung Lambdasonde vor Kat" UBYTE spg_ub_q0p0052_o0p2 1 100 -0.2 1.13 FORMAT "%5.3" ECU_ADDRESS 0x384806 /end MEASUREMENT
/begin MEASUREMENT usvk2 "Spannung Lambdasonde vor Kat 2" UBYTE spg_ub_q0p0052_o0p2 1 100 -0.2 1.13 FORMAT "%5.3" ECU_ADDRESS 0x384807 /end MEASUREMENT
/begin MEASUREMENT vsksml_w "Volumenstrom Kraftstoff in ml/s" UWORD volgrd_q5p96Em4 1 100 0 39.0619 FORMAT "%8.5" ECU_ADDRESS 0x3849D2 /end MEASUREMENT
/begin MEASUREMENT vstagr "Anpassung AGR-Rate (Testerschnittstelle)" UBYTE fak_ub_b2 1 100 0 1.99219 FORMAT "%5.3" ECU_ADDRESS 0x380A89 /end MEASUREMENT
/begin MEASUREMENT vstcns "Anpassung Codewort LL-Solldrehzahl-Umschaltung" UBYTE dez 1 100 0 255 FORMAT "%5.1" ECU_ADDRESS 0x380A8A /end MEASUREMENT
/begin MEASUREMENT vstdzw "Anpassung Zündwinkel additiv" SBYTE zw_sb_q0p75 1 100 -96 95.25 FORMAT "%5.2" ECU_ADDRESS 0x380A8B /end MEASUREMENT
/begin MEASUREMENT vstfba "Faktor Beschleunigungsanreicherung (Testerschnittstelle)" UBYTE fak_ub_b2 1 100 0 1.99219 FORMAT "%5.3" ECU_ADDRESS 0x380A8C /end MEASUREMENT
/begin MEASUREMENT vstfns "Anpassung Faktor Nachstart (Testerschnittstelle)" UBYTE fak_ub_b2 1 100 0 1.99219 FORMAT "%5.3" ECU_ADDRESS 0x380A8D /end MEASUREMENT
/begin MEASUREMENT vstfrk "Korrektur der relativen Kraftstoffmasse über Tester" UBYTE fak_ub_b1p25_o0p75 1 100 0.75 1.24805 FORMAT "%5.3" ECU_ADDRESS 0x380A8E /end MEASUREMENT
/begin MEASUREMENT vstfst "Anpassung Faktor Start (Testerschnittstelle)" UBYTE fak_ub_b2 1 100 0 1.99219 FORMAT "%5.3" ECU_ADDRESS 0x380A8F /end MEASUREMENT
/begin MEASUREMENT vstfva "Faktor Verzoegerungsabmagerung (Testerschnittstelle)" UBYTE fak_ub_b2 1 100 0 1.99219 FORMAT "%5.3" ECU_ADDRESS 0x380A90 /end MEASUREMENT
/begin MEASUREMENT vstfwl "Anpassung Faktor Warmlauf (Testerschnittstelle)" UBYTE fak_ub_b2 1 100 0 1.99219 FORMAT "%5.3" ECU_ADDRESS 0x380A91 /end MEASUREMENT
/begin MEASUREMENT vstlr "Anpassung tv-Zeit  (Testerschnittstelle)" SBYTE t10msxs_sb_q0p01 1 100 -1.28 1.27 FORMAT "%5.3" ECU_ADDRESS 0x380A92 /end MEASUREMENT
/begin MEASUREMENT vstmdr "Anpassung Momentenreserve Leerlaufregelung (Testerschnitst.)" UBYTE rel_ub_b25 1 100 0 24.9023 FORMAT "%5.2" ECU_ADDRESS 0x380A93 /end MEASUREMENT
/begin MEASUREMENT vstnls "Anpassung LL-Solldrehzahl (Testerschittstelle)" SBYTE nmot_sb_q10 1 100 -1280 1270 FORMAT "%5.0" ECU_ADDRESS 0x380A94 /end MEASUREMENT
/begin MEASUREMENT vstrlx "Verstellgröße Maximalfüllung vom Tester" UBYTE fak_ub_b1 1 100 0 0.996094 ECU_ADDRESS 0x380A95 /end MEASUREMENT
/begin MEASUREMENT vstvvr "Erhöhung des Sollwerts der VMAX-Regelung über Werkstatt-Tester" SBYTE vfzg_q1p0 1 100 -128 127 FORMAT "%5.1" ECU_ADDRESS 0x380A96 /end MEASUREMENT
/begin MEASUREMENT wnwem "Nockenwellenwinkel Einlaß (Mittelwert)" SBYTE kw_q0p5 1 100 -64 63.5 FORMAT "%5.2" ECU_ADDRESS 0x380894 /end MEASUREMENT
/begin MEASUREMENT wnwi2_w "Istwinkel für Nockenwelle 2 (word)" SWORD kw_sw_b128 1 100 -128 127.996 FORMAT "%8.4" ECU_ADDRESS 0x3849D4 /end MEASUREMENT
/begin MEASUREMENT wnwi_w "Istwinkel für Nockenwelle (word)" SWORD kw_sw_b128 1 100 -128 127.996 FORMAT "%8.4" ECU_ADDRESS 0x3849D6 /end MEASUREMENT
/begin MEASUREMENT wtol "A/D-Wert für (Motor-) Oeltemperatur" UBYTE dez 1 100 0 255 FORMAT "%5.1" ECU_ADDRESS 0x380895 /end MEASUREMENT
/begin MEASUREMENT zburn "Anzahl erkannter Verbrennungen" UBYTE dez 1 100 0 255 FORMAT "%5.1" ECU_ADDRESS 0x3809F6 /end MEASUREMENT
/begin MEASUREMENT zburnsu "Summe aller erkannten Verbrennungen während ZSYNABR" UBYTE dez 1 100 0 255 FORMAT "%5.1" ECU_ADDRESS 0x3809F7 /end MEASUREMENT
/begin MEASUREMENT zsynchro "Anzahl Zündungen bis Auswertung der Verbrennungen" UBYTE dez 1 100 0 255 FORMAT "%5.1" ECU_ADDRESS 0x3809F8 /end MEASUREMENT
/begin MEASUREMENT zsyndelc "Zähler Verzögerung Verbrennungserkennung" UBYTE dez 1 100 0 255 FORMAT "%5.1" ECU_ADDRESS 0x3809F9 /end MEASUREMENT
/begin MEASUREMENT zsynsu "Zündungszähler für Begrenzung Startmengenadaption" UBYTE dez 1 100 0 255 FORMAT "%5.1" ECU_ADDRESS 0x3809FA /end MEASUREMENT
/begin MEASUREMENT zubkst "Zähler: UBatt < UBKST" UBYTE dez 1 100 0 255 FORMAT "%5.1" ECU_ADDRESS 0x3809FB /end MEASUREMENT
/begin MEASUREMENT zwopt_um "optimaler Zündwinkel in der Funktionsüberwachung" SBYTE zw_sb_q0p75 1 100 -96 95.25 FORMAT "%5.2" ECU_ADDRESS 0x380AEE /end MEASUREMENT
/begin MEASUREMENT zzylkr "Zylinderzähler der Klopfregelung" UBYTE dez 1 100 0 255 FORMAT "%5.1" ECU_ADDRESS 0xF7A0 /end MEASUREMENT
/begin MEASUREMENT zzylzue "SW-Zylinderzähler für Zündungsberechnung" UBYTE dez 1 100 0 255 FORMAT "%5.1" ECU_ADDRESS 0x38088C /end MEASUREMENT
/begin FUNCTION SSTB ""
 /begin DEF_CHARACTERISTIC FHO04ESUB SDK10TEUB SEZ06TMUB SFR05TEUB SGA06MDUB SGA08MDUB SIM06ESUW SKS06ESUB SLA05ESUB SLD04LDUB SLX06TMUW SM108LHSW SMI04LLUB SML06TEUB SML06TMUW SML07TMUW SML08LHUB SMT06TMUW SNG06LLSB SNM05NEUW SNM05NWUB SNM06ESUB SNM06GKUB SNM06LLUB SNM06MDUW SNM07ESUB SNM07LSUW SNM08DMUB SNM08FEUB SNM08LDUB SNM08LDUW SNM08LHUB SNM08OPUB SNM08__UB SNM10LSUB SNM10TEUB SNM12ESUB SNM12FEUB SNM12LDUW SNM16CIUB SNM16KRDYUB SNM16KRUB SNM16LDUB SNM16LDUW SNM16NEUW SNM16OPUW SNM16ZUUW SPU08LDUB SQM05TEUB SRL03KRUB SRL04KRUB SRL05NEUW SRL06ESUB SRL06GKUB SRL06KRUB SRL08DMUB SRL08LSUW SRL08NEUW SRL08NXUB SRL10LSUB SRL12ZUUW SRP06ESUB ST107TMUB ST307TMUB STA04LLUB STA06ESUB STA08LDUB STA12WLUB STK04SAUB STM04FEUB STM04SAUB STM05SAUB STM05TMUB STM06LLUB STM06__UB STM08DMUB STM08GKUB STM09ESUB STM10__UB STM12ESUB STN06LLUB STS08ESUB STS08LDUB STS12ESUB SUV07MDUB SVP12LDUW SWP08OPUB /end DEF_CHARACTERISTIC
 /begin REF_CHARACTERISTIC /end REF_CHARACTERISTIC
 /begin IN_MEASUREMENT anztib_w dlashkm_w etazwimt fho frmit gangi imlatm_w kstaa ladiff_w lamsbg_w lde mifa_w ml ml_w msabg ngfil nmot nmot_w plsolr_w pu qmsdyn rl rlnw_w rlp rl_w tabgmst tabstatm_w tans tkatm tkatmst tmot tmst tnst tsel uefktget vpssplg_w vpsspu_w wdkba wkrmdy_w wkrmstat_w wkrmsu_w wped /end IN_MEASUREMENT
 /begin OUT_MEASUREMENT esst_fho04esub esst_sdk10teub esst_sez06tmub esst_sfr05teub esst_sga06mdub esst_sga08mdub esst_sim06esuw esst_sks06esub esst_sla05esub esst_sld04ldub esst_slx06tmuw esst_sm108lhsw esst_smi04llub esst_sml06teub esst_sml06tmuw esst_sml07tmuw esst_sml08lhub esst_smt06tmuw esst_sng06llsb esst_snm05neuw esst_snm05nwub esst_snm06esub esst_snm06gkub esst_snm06llub esst_snm06mduw esst_snm07esub esst_snm07lsuw esst_snm08dmub esst_snm08feub esst_snm08ldub esst_snm08lduw esst_snm08lhub esst_snm08opub esst_snm08__ub esst_snm10lsub esst_snm10teub esst_snm12esub esst_snm12feub esst_snm12lduw esst_snm16ciub esst_snm16krdyub esst_snm16krub esst_snm16ldub esst_snm16lduw esst_snm16neuw esst_snm16opuw esst_snm16zuuw esst_spu08ldub esst_sqm05teub esst_srl03krub esst_srl04krub esst_srl05neuw esst_srl06esub esst_srl06gkub esst_srl06krub esst_srl08dmub esst_srl08lsuw esst_srl08neuw esst_srl08nxub esst_srl10lsub esst_srl12zuuw esst_srp06esub esst_st107tmub esst_st307tmub esst_sta04llub esst_sta06esub esst_sta08ldub esst_sta12wlub esst_stk04saub esst_stm04feub esst_stm04saub esst_stm05saub esst_stm05tmub esst_stm06llub esst_stm06__ub esst_stm08dmub esst_stm08gkub esst_stm09esub esst_stm10__ub esst_stm12esub esst_stn06llub esst_sts08esub esst_sts08ldub esst_sts12esub esst_suv07mdub esst_svp12lduw esst_swp08opub /end OUT_MEASUREMENT
 /begin LOC_MEASUREMENT /end LOC_MEASUREMENT
 /begin SUB_FUNCTION /end SUB_FUNCTION
/end FUNCTION
/begin FUNCTION STACKMON "" /begin DEF_CHARACTERISTIC /end DEF_CHARACTERISTIC /begin REF_CHARACTERISTIC /end REF_CHARACTERISTIC /begin IN_MEASUREMENT /end IN_MEASUREMENT /begin OUT_MEASUREMENT systemStackUsage userStackUsage /end OUT_MEASUREMENT /begin LOC_MEASUREMENT /end LOC_MEASUREMENT /begin SUB_FUNCTION /end SUB_FUNCTION /end FUNCTION
/begin FUNCTION STADAP "6.80      Startmengen-Adaption"
 /begin DEF_CHARACTERISTIC ANRZUEMX CWSTADAP DECKSTAI DNBURN0 DNBURN1 DNBURN2 INCKSTAI KFNSTAMX KLDNFHO KSTA0INI KSTA1INI KSTA2INI KSTAI KSTAMN0 KSTAMN1 KSTAMN2 KSTAMX0 KSTAMX1 KSTAMX2 KSTTOPMN NSTAK TMADB0 TMADB1 TMADB2 TMLIM UBKST UBKSTMX WAD0T1 WAD0T2 WAD1T0 WAD1T2 WAD2T0 WAD2T1 ZBURNABR ZBURNDEC ZBURNSOL ZSYNABR ZSYNAUSW ZSYNDEL /end DEF_CHARACTERISTIC
 /begin REF_CHARACTERISTIC /end REF_CHARACTERISTIC
 /begin IN_MEASUREMENT B_adrsta B_nmin B_pwf B_stend B_umsync B_vbemg B_wks dnmot_w E_ev1 E_ev2 E_ev3 E_ev4 E_frao E_frau E_n E_ph E_rkat E_tankl E_tm E_ub fho nmot nmot_w nstat tmot tmst top_w ub vfzg /end IN_MEASUREMENT
 /begin OUT_MEASUREMENT B_staa kstaa /end OUT_MEASUREMENT
 /begin LOC_MEASUREMENT adastep B_ad B_adb0 B_adb1 B_adb2 B_adlck B_ausw B_burn B_decr B_incr B_kstai B_kstaue B_nodec B_noinc B_stdperr B_ubkst dnburns_w ksta0 ksta0w ksta1 ksta1w ksta2 ksta2w stactr STADAPlokBits tmadb zburn zburnsu zsynchro zsyndelc zsynsu zubkst /end LOC_MEASUREMENT
 /begin SUB_FUNCTION /end SUB_FUNCTION
/end FUNCTION
/begin FUNCTION STADK "1.20      ." /begin DEF_CHARACTERISTIC CWSTADK KLOSCKL /end DEF_CHARACTERISTIC /begin REF_CHARACTERISTIC TMSUKTDS /end REF_CHARACTERISTIC /begin IN_MEASUREMENT B_cdkatsp B_dcy oscdktf_w tmst /end IN_MEASUREMENT /begin OUT_MEASUREMENT /end OUT_MEASUREMENT /begin LOC_MEASUREMENT arstadk dcysdk_w oscdkto_w osckls /end LOC_MEASUREMENT /begin SUB_FUNCTION /end SUB_FUNCTION /end FUNCTION
/begin FUNCTION STARTUF "" /begin DEF_CHARACTERISTIC CWPWF /end DEF_CHARACTERISTIC /begin REF_CHARACTERISTIC /end REF_CHARACTERISTIC /begin IN_MEASUREMENT /end IN_MEASUREMENT /begin OUT_MEASUREMENT B_pwf /end OUT_MEASUREMENT /begin LOC_MEASUREMENT /end LOC_MEASUREMENT /begin SUB_FUNCTION /end SUB_FUNCTION /end FUNCTION
/begin FUNCTION SWADP "Software-Adapter" /begin DEF_CHARACTERISTIC WNWAMAX WNWEMAX /end DEF_CHARACTERISTIC /begin REF_CHARACTERISTIC NMAXOG /end REF_CHARACTERISTIC
 /begin IN_MEASUREMENT B_acc B_kow B_nmin B_stend nmot_w ofmsndk_w talsuf_w tumg vfzg_w /end IN_MEASUREMENT
 /begin OUT_MEASUREMENT azlrdkt B_accab B_agrlrasp B_asc_reg B_dktlp B_dmmtev B_dmtltz B_dslsk B_edss B_faevz B_falr B_fhz B_gang0 B_hab B_kas B_kolhrc B_lsvvsp B_nmaxext B_noacc_fr B_nokatfz B_pripv B_pripv2 B_ripuv B_ripuv2 B_savacc B_savmd B_sbbnhhk B_sgs B_sl B_svuerf B_svuerf2 B_vs devoff dmrdagr_w ilmlkat_w migsl_w misgsl_w mracc_w msndko_w nlldagkt nmaxext_w nturbc_w psdss_w psl takols talsuf tc6katc tc6kats tc6katw tumta tum_ein tzlrdkt_w uhepoti usnhhk_w usvk usvk2 vsksml_w wnwem wnwi2_w wnwi_w wtol /end OUT_MEASUREMENT
 /begin LOC_MEASUREMENT ahkat /end LOC_MEASUREMENT
 /begin SUB_FUNCTION /end SUB_FUNCTION
/end FUNCTION
/begin FUNCTION SWEISR "" /begin DEF_CHARACTERISTIC /end DEF_CHARACTERISTIC /begin REF_CHARACTERISTIC /end REF_CHARACTERISTIC /begin IN_MEASUREMENT B_timev_inc timevovCtr /end IN_MEASUREMENT /begin OUT_MEASUREMENT B_intswe B_intsweerr tcchswe_w tccpswe_w /end OUT_MEASUREMENT
 /begin LOC_MEASUREMENT B_intswefirstneg B_intswefirstpos B_portStatussweOld ccpersweSav ccpwsweSav timevovCtr_sweisr_Old /end LOC_MEASUREMENT
 /begin SUB_FUNCTION /end SUB_FUNCTION
/end FUNCTION
/begin FUNCTION SYK051 "" /begin DEF_CHARACTERISTIC /end DEF_CHARACTERISTIC /begin REF_CHARACTERISTIC /end REF_CHARACTERISTIC /begin IN_MEASUREMENT /end IN_MEASUREMENT /begin OUT_MEASUREMENT /end OUT_MEASUREMENT /begin LOC_MEASUREMENT /end LOC_MEASUREMENT /begin SUB_FUNCTION /end SUB_FUNCTION /end FUNCTION
/begin FUNCTION SYNC71 "" /begin DEF_CHARACTERISTIC /end DEF_CHARACTERISTIC /begin REF_CHARACTERISTIC /end REF_CHARACTERISTIC /begin IN_MEASUREMENT B_nosynph /end IN_MEASUREMENT
 /begin OUT_MEASUREMENT B_bzsync B_firstSyn tr_zahn tr_zahn2 tr_zeit tr_zeit2 tr_zeit_msb zzylzue /end OUT_MEASUREMENT
 /begin LOC_MEASUREMENT /end LOC_MEASUREMENT
 /begin SUB_FUNCTION /end SUB_FUNCTION
/end FUNCTION
/begin FUNCTION SYSYNC "3.20      System-Synchronisation" /begin DEF_CHARACTERISTIC /end DEF_CHARACTERISTIC /begin REF_CHARACTERISTIC /end REF_CHARACTERISTIC /begin IN_MEASUREMENT /end IN_MEASUREMENT /begin OUT_MEASUREMENT synstate synstate_o /end OUT_MEASUREMENT /begin LOC_MEASUREMENT /end LOC_MEASUREMENT /begin SUB_FUNCTION /end SUB_FUNCTION /end FUNCTION
/begin FUNCTION SY_DFPM3 "" /begin DEF_CHARACTERISTIC /end DEF_CHARACTERISTIC /begin REF_CHARACTERISTIC /end REF_CHARACTERISTIC /begin IN_MEASUREMENT /end IN_MEASUREMENT /begin OUT_MEASUREMENT /end OUT_MEASUREMENT /begin LOC_MEASUREMENT /end LOC_MEASUREMENT /begin SUB_FUNCTION /end SUB_FUNCTION /end FUNCTION
/begin FUNCTION T71XXX_T "" /begin DEF_CHARACTERISTIC /end DEF_CHARACTERISTIC /begin REF_CHARACTERISTIC /end REF_CHARACTERISTIC /begin IN_MEASUREMENT B_nachl swOffDlBits /end IN_MEASUREMENT /begin OUT_MEASUREMENT dynPeriod /end OUT_MEASUREMENT /begin LOC_MEASUREMENT /end LOC_MEASUREMENT /begin SUB_FUNCTION /end SUB_FUNCTION /end FUNCTION
/begin FUNCTION TC1MOD "20.120    Testerkommunikation CARB; Mode 1" /begin DEF_CHARACTERISTIC /end DEF_CHARACTERISTIC /begin REF_CHARACTERISTIC CWOBD /end REF_CHARACTERISTIC
 /begin IN_MEASUREMENT B_cdkvs B_cdmd B_kmmilsct B_lsh B_lsh2 B_lsv B_lsv2 B_milstat B_sls B_slsfz evsup1 flglrs fra_w fr_w iplsuvj_w kmstmil_w lalsuvj_w mshfm_w nmot_w ready rml tanslin tmotlin ushkj vfzg wdkba zwzyl1 /end IN_MEASUREMENT
 /begin OUT_MEASUREMENT /end OUT_MEASUREMENT
 /begin LOC_MEASUREMENT /end LOC_MEASUREMENT
 /begin SUB_FUNCTION /end SUB_FUNCTION
/end FUNCTION
/begin FUNCTION TC2MOD "Testerkommunikation CARB; Mode 2" /begin DEF_CHARACTERISTIC /end DEF_CHARACTERISTIC /begin REF_CHARACTERISTIC /end REF_CHARACTERISTIC /begin IN_MEASUREMENT ffzdfp /end IN_MEASUREMENT /begin OUT_MEASUREMENT /end OUT_MEASUREMENT /begin LOC_MEASUREMENT /end LOC_MEASUREMENT /begin SUB_FUNCTION /end SUB_FUNCTION /end FUNCTION
/begin FUNCTION TC5MOD "20.30     Testerkommunikation CARB; Mode 5, Ausgabe Sondenmeßwerte" /begin DEF_CHARACTERISTIC /end DEF_CHARACTERISTIC
 /begin REF_CHARACTERISTIC DLAHISATO DLAHISATU DYNLSUTO DYNLSUTU LAMSSAMN LAMSSAMX USMNSHMN USMNSHMX USMXSHMN USMXSHMX USRHKSHJ /end REF_CHARACTERISTIC
 /begin IN_MEASUREMENT B_lsh B_lsh2 B_lsv B_lsv2 dlahisa dynlsusa lamsisa lamsosa usmnshn usmxshn /end IN_MEASUREMENT
 /begin OUT_MEASUREMENT /end OUT_MEASUREMENT
 /begin LOC_MEASUREMENT /end LOC_MEASUREMENT
 /begin SUB_FUNCTION /end SUB_FUNCTION
/end FUNCTION
/begin FUNCTION TC6MOD "20.100    Testerkommunikation CARB/EOBD; Mode/Service 6, Ausgabe Prüfschwellen" /begin DEF_CHARACTERISTIC /end DEF_CHARACTERISTIC /begin REF_CHARACTERISTIC /end REF_CHARACTERISTIC
 /begin IN_MEASUREMENT B_cdkatsp B_cdkatspf B_cdldp B_cdsls B_cdtes B_cwdslt m6cktsp m6cmsl m6cmslv m6sktsp_w m6smslv_w m6smsl_w m6wktsp_w m6wmslv_w m6wmsl_w tc6ldpc tc6ldps tc6ldpw tc6tesc tc6tess tc6tesw /end IN_MEASUREMENT
 /begin OUT_MEASUREMENT /end OUT_MEASUREMENT
 /begin LOC_MEASUREMENT /end LOC_MEASUREMENT
 /begin SUB_FUNCTION /end SUB_FUNCTION
/end FUNCTION
/begin FUNCTION TC8MOD "21.50     Testerkommunikation CARB; Mode 8, Funktionsaktivierungen" /begin DEF_CHARACTERISTIC TMOD8TE /end DEF_CHARACTERISTIC /begin REF_CHARACTERISTIC /end REF_CHARACTERISTIC /begin IN_MEASUREMENT B_ldp B_ll B_m8te /end IN_MEASUREMENT /begin OUT_MEASUREMENT /end OUT_MEASUREMENT /begin LOC_MEASUREMENT /end LOC_MEASUREMENT /begin SUB_FUNCTION /end SUB_FUNCTION /end FUNCTION
/begin FUNCTION TC9MOD "8.20      Testerkommunikation CARB; Mode 9, Request Vehicle Information" /begin DEF_CHARACTERISTIC CWM9CVNSUP /end DEF_CHARACTERISTIC /begin REF_CHARACTERISTIC SGIDB1 SGIDB3 /end REF_CHARACTERISTIC /begin IN_MEASUREMENT B_cksbrdy cvnh_w cvnl_w nmot_w /end IN_MEASUREMENT /begin OUT_MEASUREMENT B_m9cvn B_m9cvnout /end OUT_MEASUREMENT /begin LOC_MEASUREMENT /end LOC_MEASUREMENT /begin SUB_FUNCTION /end SUB_FUNCTION /end FUNCTION
/begin FUNCTION TCKOMUE "2.10      Testerkommunikation CARB; Kommunikationsaufbau Übersicht" /begin DEF_CHARACTERISTIC CWNOSCAT /end DEF_CHARACTERISTIC /begin REF_CHARACTERISTIC /end REF_CHARACTERISTIC /begin IN_MEASUREMENT /end IN_MEASUREMENT /begin OUT_MEASUREMENT /end OUT_MEASUREMENT /begin LOC_MEASUREMENT /end LOC_MEASUREMENT /begin SUB_FUNCTION /end SUB_FUNCTION /end FUNCTION
/begin FUNCTION TCSORT "3.10      Testerkommunikation CARB; Sortierfunktion" /begin DEF_CHARACTERISTIC /end DEF_CHARACTERISTIC /begin REF_CHARACTERISTIC /end REF_CHARACTERISTIC /begin IN_MEASUREMENT cw_erfil fcmEnd FCMTab ffzdfp /end IN_MEASUREMENT /begin OUT_MEASUREMENT errorCntTcsort /end OUT_MEASUREMENT /begin LOC_MEASUREMENT /end LOC_MEASUREMENT /begin SUB_FUNCTION /end SUB_FUNCTION /end FUNCTION
/begin FUNCTION TEB "95.120    Tankentlüftung beladungsabhängig"
 /begin DEF_CHARACTERISTIC DFTEAHB DMSTES DSTEMIN FBTEB FBTEVA FBZBTEML FETATEBN FKATEB FQTEDL FQTEFR FQTEPT FQTEVA FRHB FSRFTEF FTEADAB FTEADMX FTEFHB FTEHB FTEINIX FUMRBRK FVERMN FVERZDYN FVRMDYN KFETATE KFFTEAN KFFTEAX KFQTE KFTADMS KFTATX KFTEKA KHCTEAMX KHCTEMN KHCTEMX MSDKLMMN NVERZMN TFTEINI TQTEAB TQTEDAB TVAGRFTE TVSATEM ZBTEML ZETATE ZKFTEAD ZMLTE ZMSSGIN /end DEF_CHARACTERISTIC
 /begin REF_CHARACTERISTIC SDK10TEUB SFR05TEUB SML06TEUB SNM10TEUB SQM05TEUB TEMIN /end REF_CHARACTERISTIC
 /begin IN_MEASUREMENT abo B_abor B_evloc B_frmax B_frmin B_lr B_lrasp B_nmot B_nswo1 B_qtedab B_sab B_te B_tef B_tei B_ten B_tep esst_sdk10teub esst_sfr05teub esst_sml06teub esst_snm10teub esst_sqm05teub frm_w mifa_w miopt_w ml mlsol_w ml_w msdkalm_w mste mstedte_w msteo_w mste_w nmot nmot_w ps_w pte pu rl tans te_w tmot umsrln_w wdkba /end IN_MEASUREMENT
 /begin OUT_MEASUREMENT B_agrste B_lrar B_teabb B_tehb B_tehbx etate fkatei frmit_w frmxa fteadf ftead_w ftefsoll_w ftefva_w imsteini mitebg_w mstesoll_w rkte_w /end OUT_MEASUREMENT
 /begin LOC_MEASUREMENT B_gwrte B_teakt dftef_w dkatefrg dkhc_w dmlftef dmssginr dstert20_w etateint etatesol fbetate fbkate fgwrte fkateapp fkatefrg fkates fngwrte fregfte frmit frmxaold_w frmxa_w ftadmste fteadf_w ftefsold_w ftefva ftefvab ftefvamx_w fteml fvermte_w khc_w kteev_w ktetevvz_w ktetev_w mssginmn_w mssgin_w msteev_w mstesmx_w pspu qmsdyn qtetemin rlteev_w /end LOC_MEASUREMENT
 /begin SUB_FUNCTION /end SUB_FUNCTION
/end FUNCTION
/begin FUNCTION TEBEB "4.140     Einschaltbedingungen Tankentlüftung" /begin DEF_CHARACTERISTIC CWTEACFG LAMTEMN LAMTEMX TMSTTE TMTE TTEAUS /end DEF_CHARACTERISTIC /begin REF_CHARACTERISTIC /end REF_CHARACTERISTIC
 /begin IN_MEASUREMENT B_atmtpa B_dldpte B_dllra B_dsls B_dteaa B_eobdlr B_fraoan B_ftedab B_lamka B_lamsdef B_ldpi B_lr B_lrasp B_lrssa B_m8te B_mdarv B_mlrsa B_sbbvk B_sls B_stend B_tep lamsons_w tateist_w tatesoll tmot tmst /end IN_MEASUREMENT
 /begin OUT_MEASUREMENT B_qtedab B_te B_tef B_tei B_ten /end OUT_MEASUREMENT
 /begin LOC_MEASUREMENT B_tenmda lokBits_Tebeb /end LOC_MEASUREMENT
 /begin SUB_FUNCTION /end SUB_FUNCTION
/end FUNCTION
/begin FUNCTION TEMPKON "3.40      Temperatur-Konvertermodul" /begin DEF_CHARACTERISTIC /end DEF_CHARACTERISTIC /begin REF_CHARACTERISTIC /end REF_CHARACTERISTIC /begin IN_MEASUREMENT tabgm_w tatu tikatm_w tkatm_w tmot /end IN_MEASUREMENT
 /begin OUT_MEASUREMENT tahsom_w taikrm_w tanhkm_w tanvk_w tatuk tatuk_w tavhkm_w tavrom_w tavsom_w tavvkm_w tkihkm_w tmotk tmotk_w /end OUT_MEASUREMENT
 /begin LOC_MEASUREMENT /end LOC_MEASUREMENT
 /begin SUB_FUNCTION /end SUB_FUNCTION
/end FUNCTION
/begin FUNCTION TIMEV_OV "" /begin DEF_CHARACTERISTIC /end DEF_CHARACTERISTIC /begin REF_CHARACTERISTIC /end REF_CHARACTERISTIC /begin IN_MEASUREMENT /end IN_MEASUREMENT /begin OUT_MEASUREMENT B_timev_inc timevovCtr /end OUT_MEASUREMENT /begin LOC_MEASUREMENT /end LOC_MEASUREMENT /begin SUB_FUNCTION /end SUB_FUNCTION /end FUNCTION
/begin FUNCTION TIMU "Timerumschaltung im Start bei Einspritzausgabe" /begin DEF_CHARACTERISTIC /end DEF_CHARACTERISTIC /begin REF_CHARACTERISTIC /end REF_CHARACTERISTIC
 /begin IN_MEASUREMENT B_stend B_ti_cha0 B_ti_cha1 B_ti_cha2 B_ti_cha3 B_ti_out0 B_ti_out1 B_ti_out2 B_ti_out3 B_ti_wai0 B_ti_wai1 B_ti_wai2 B_ti_wai3 cc_cha_0 cc_cha_1 cc_cha_2 cc_cha_3 ti_ev0 ti_ev1 ti_ev2 ti_ev3 tseghi tseg_w /end IN_MEASUREMENT
 /begin OUT_MEASUREMENT B_timfast tn2 /end OUT_MEASUREMENT
 /begin LOC_MEASUREMENT /end LOC_MEASUREMENT
 /begin SUB_FUNCTION /end SUB_FUNCTION
/end FUNCTION
/begin FUNCTION TKMWL "22.320    Testerkommunikation; Meßwerte lesen"
 /begin DEF_CHARACTERISTIC ADRONLOGIN AGR_AOG AGR_AUG CNSDEF CNS_AOG CNS_AUG CWFA107 CWFA107A CWFA108 CWFA108A CWFA109 CWFA109A CWFA130 CWFA130A CWFA140 CWFA140A CWFA145 CWFA145A CWFA146 CWFA146A CWFA147 CWFA147A CWFA152 CWFA152A CWFA162 CWFA162A CWFA163 CWFA163A CWFA190 CWFA190A CWFA191 CWFA191A CWFA192 CWFA192A CWFA193 CWFA193A CWFA194 CWFA194A CWFA195 CWFA195A CWFA196 CWFA196A CWFA197 CWFA197A CWFA198 CWFA198A CWFA199 CWFA199A CWFA201 CWFA201A CWFA202 CWFA202A CWFA203 CWFA203A CWFA204 CWFA204A CWFA205 CWFA205A CWFA206 CWFA206A CWFA207 CWFA207A CWFA208 CWFA208A CWFA209 CWFA209A CWFA210 CWFA210A CWFA211 CWFA211A CWFA212 CWFA212A CWFA213 CWFA213A CWFA214 CWFA214A CWFA215 CWFA215A CWFA216 CWFA216A CWFA217 CWFA217A CWFA218 CWFA218A CWFA219 CWFA219A CWFA220 CWFA220A CWFA221 CWFA221A CWFA222 CWFA222A CWFA223 CWFA223A CWFA224 CWFA224A CWFA225 CWFA225A CWFA226 CWFA226A CWFA227 CWFA227A CWFA228 CWFA228A CWFA229 CWFA229A CWFA230 CWFA230A CWFA231 CWFA231A CWFA232 CWFA232A CWFA233 CWFA233A CWFA234 CWFA234A CWFA235 CWFA235A CWFA236 CWFA236A CWFA237 CWFA237A CWFA238 CWFA238A CWFA239 CWFA239A CWFA240 CWFA240A CWFA241 CWFA241A CWFA242 CWFA242A CWFA243 CWFA243A CWFA244 CWFA244A CWFA245 CWFA245A CWFA246 CWFA246A CWFA247 CWFA247A CWFA248 CWFA248A CWFA249 CWFA249A CWFA250 CWFA250A CWFA251 CWFA251A CWFA252 CWFA252A CWFA253 CWFA253A CWFA254 CWFA254A CWFA255 CWFA255A CWFA28 CWFA28A CWFA34 CWFA34A CWFA35 CWFA35A CWFA36 CWFA36A CWFA37 CWFA37A CWFA38 CWFA38A CWFA39 CWFA39A CWFA43 CWFA43A CWFA44 CWFA44A CWFA46 CWFA46A CWFA47 CWFA47A CWFA48 CWFA48A CWFA49 CWFA49A CWFA70 CWFA70A CWFA71 CWFA71A CWFA75 CWFA75A CWFA77 CWFA77A CWFA78 CWFA78A CWFA94 CWFA94A CWFA96 CWFA96A CWTAF CWTAK CWTAS DZW_AOG DZW_AUG FBA_AOG FBA_AUG FLR_AOG FLR_AUG FNS_AOG FNS_AUG FRK_AOG FRK_AUG FST_AOG FST_AUG FVA_AOG FVA_AUG FWL_AOG FWL_AUG GRAOFLOGIN GRAONLOGIN HLOFFLOGIN HLONLOGIN KLOGIN LUEN1LOGIN LUEN2LOGIN LUEN3LOGIN MDR_AOG MDR_AUG MWNTKB0 MWNTKB1 MWNTKB10 MWNTKB11 MWNTKB12 MWNTKB13 MWNTKB14 MWNTKB15 MWNTKB16 MWNTKB17 MWNTKB18 MWNTKB19 MWNTKB2 MWNTKB20 MWNTKB21 MWNTKB22 MWNTKB23 MWNTKB24 MWNTKB25 MWNTKB3 MWNTKB4 MWNTKB5 MWNTKB6 MWNTKB7 MWNTKB8 MWNTKB9 NLS_AOG NLS_AUG RLX_AOG RLX_AUG SGIDB1 SGIDB2 SGIDB3 SLOGIN VARDEF VVR_AOG VVR_AUG /end DEF_CHARACTERISTIC
 /begin REF_CHARACTERISTIC CWCANKBI CWCSER CWGGFGRH CWGRABH CW_CAN_R_0___A CW_CAN_R_1___A CW_CAN_R_2___A CW_CAN_R_3___A CW_CAN_R_4___A CW_CAN_R_5___A CW_CAN_R_6___A CW_CAN_R_7___A KFFLTA LRNVB_T MDNORM TVETRMN TVLSUBM TVLU1MN TVLU2MN UHEMN UHEMX /end REF_CHARACTERISTIC
 /begin IN_MEASUREMENT abo afnmn afnmx afrlmn afrlmx ahkat anzdyn anzmsls_w anzumrl_w apdkt avdtev bbdcy bbwuc B_abgle B_adshs B_afklt B_afwrm B_airbag B_airbz B_aircan B_atmtpa B_atmtpk B_atr B_autget B_ba B_bevab B_bkvp B_bl B_bm B_br B_br2k B_brems B_brlmx B_bxf1 B_bxf2 B_bxf3 B_bxf4 B_bxf5 B_bxf6 B_bxf7 B_bxf8 B_bxf9 B_cankbi B_cdbkvp B_cddsbkv B_crcan B_ddylash B_dfrmoff B_dknolu B_dktb B_dktens B_dktm B_dktsbs B_dktsps B_dkvsf B_dlash B_dldp B_dllr B_dnwse B_drlmx B_ds B_dshen B_dsl B_dsl1 B_dsl2 B_dsl3 B_dsl4 B_dsl5 B_dslerr B_dslmab B_dslme B_dslmes B_dslo B_dsloab B_dsloe B_dsls B_dslset B_dsltab B_dteaa B_dteaab B_dteaam B_dteabu B_dteanfl B_dteendl B_dteenf B_dtelbm B_dtelbr B_dtelnm B_dtenam B_dtephm B_dtepm B_dteres B_dternm B_dtes B_dtest B_dtezam B_dushsch B_dylash B_dylsu B_dylsuav B_edkvs B_ehfs B_ehlsu B_ehsh B_elaof B_elsu B_enlash B_entest B_epwmcs B_errofs B_evloc B_falsu B_fasla B_faslarq B_fempos B_fempus B_fev1 B_fev10 B_fev11 B_fev12 B_fev2 B_fev3 B_fev4 B_fev5 B_fev6 B_fev7 B_fev8 B_fev9 B_fgratc B_fgren B_fgrhsc B_fgrsec B_fgrtdc B_fgrtuc B_fgrwac B_fkmsmn B_fkmsmx B_fkpvdk B_fkpvmn B_fkpvmx B_fprakt B_fproe B_fprook B_fprordy B_fprovb B_fprrdy B_fprzab B_fprze B_fprzok B_fprzvb B_frao B_frau B_fraur B_frmax B_frmin B_fs B_furena B_gae B_gaefra B_gaeing B_gafraos B_gafraus B_gap B_gasp B_heatf B_helsu B_hfm B_hshe B_hsokh B_hsve B_ildkt B_kd B_kfzk B_kh B_khab B_khll B_khoab B_kmtre B_koe B_kosrc B_kr B_krldy B_krndy B_kuppl B_lalgf B_lambts B_lamfas B_lamka B_lamlash B_lamnswl B_lamverg B_ldb B_ldob B_ldobsp B_ldp B_ldpi B_ldr B_lds B_ldsua B_ldsuad B_ldsuas B_ll B_lr B_lra B_lrar B_lrasp B_lrhk B_lrhkp B_lrka B_lrnakt B_lrnerf B_lrnrdy B_lrnvb B_lrnws B_lsahksp B_lshkpft B_lshkpmr B_lshswok B_lsuabgl B_lsufta B_lsuftb B_lsulone B_lsumra B_lsumrb B_lsumx B_lsuna B_lsupft B_lsupmr B_luft B_madfk B_madfs B_madko B_madll B_maxflsu B_mdarv B_mdkat B_messe B_mibeg B_mil B_milabg B_milkat B_minflsu B_mldyn B_mlustest B_mnslspr B_mslmin B_msloff B_mslon B_mszsdkb B_mxslvpr B_nac B_nlel B_nlpe B_nlperf B_nlsgls B_nmot B_nowuc B_nphlsu B_nphsv B_nplflsh B_nplflsu B_nplsv B_npsna B_npvshns B_nwflade B_nwrpose B_nws B_nwse B_phad B_phade B_plenvh B_plra B_pwf B_rinh B_risigh B_rkam B_rkat B_rkatr B_rkaz B_rmsval B_sa B_sbbhk B_sbbvk B_sigflsh B_sigflsu B_sksc B_sla B_slar B_slas B_slkhof B_slpena B_slpoff B_slpofst B_slsinhi B_slsoab B_slsoff B_spsa B_steigm B_synph B_syserrk B_tabgbts B_tal B_talval B_te B_tehb B_teslash B_tevioi B_teviol B_teviop B_tevior B_teviot B_tevnio B_tkatbts B_trfash B_trip B_trkh B_trsah B_ttbmhh B_uhsig B_umae B_umauab B_ushkf B_ushkm B_ushsch B_vekat B_vl B_wnws0e B_zwp cmibeg_w cserk ctrerf1 ctrzyf0 ctrzyf1 ctr_phade dfrmoff_w dgafram_w dkmts dlahi_w dlahp_w dlamatr_w dlashkm_w dmdafmb dmdlfmb dmdsfmb_w dmletanf_w dmletan_w dmllri_w dmrlash_w dmvadfk_w dmvadfs_w dmvadko_w dmvadll_w dmvad_w drldkzu_w drlfue_w drlmaxo dtmtka dwkrz dwnwsp_w dwped dynlsu_w etazwbm fcmEnd fforn1 fgdkt_w fho fkatei fkmsdks_w fkmsdk_w fkpvdk_w flakh fldrrx_w fldrxl_w flg_m fmdkh fmsla fprstep_c fprtim_c fpvdk frao_w frau_w fra_w frmfdif_w frmfref_w frmitf_w frmxaf_w frm_w frxt frxta_w fr_w ftead_w ftefsoll_w ftefva_w fukabak_w fukabaw_w fukavak_w fukavaw_w fzabgs_w fzabg_w fzmd gangi imlatm_w imlbbo imlkvs_w imllaka_w imlpr kmdp1km_w kmstmil_w kmst_w ksta0 ksta1 ksta2 kstaa kusvk_w ladiff_w lambts_w lamdkt_w lamelsh_w lamfa_w lamlash_w lamsbg_w lamsoni_w lamsons_w lamzak_w lbz ldimn_w ldimxa ldimxak_w ldimx_w ldrlms_w ldrlts_w ldtv ldtvm lrnstat lrnstep_c lrntim_c lrnvb_c lws_w m6smsl_w m6wktsp_w m6wmslv_w m6wmsl_w mds_w mdverb mdverl_w miasrl_w miasrs_w miext_w mifab_w mifafu_w mifa_w miges_w migs_w miist_w milsol_w misol_w miszul_w mkolsc ml mldmn_w mldmx_w mldyn_w mlhfmm_w ml_w mrfa_w mrfgr_w mrped_w msabg_w msdk_w mshfm_w msl mslift mslt_w mslvt_w mslv_w msndko_w mspcv mstedtef_w nllkh nlp1tim nmot nmotll nmot_w nsol oscdkta_w oscdktf_w oscdktm_w oscdktn_w oscdktr_w oscdktt_w oscdkt_w pbkv pbkvmod_w pbkv_w phlsnh pkodrc plsol ps_w pukorf_w pus_w pvdk pvdkds_w pvdks_w ready rinh_w rinsh_w rkat_w rkaz_w rkrn_w rkte_w rk_w rl rldkofk_w rlmax_w rlmxko_w rlmx_w rlsol_w rlzuhfs_w rmsl rmslf rmslt rmstevuf_w rmstev_w statgra S_fgrat S_fgrhs S_fgrsv S_fgrwb taats2_w taats_w tabgbts_w tabgm tadtea tahsomf_w talsuf tans tanslin tateout tats2_w tats_w tavvkm_w tc6ldpc tc6ldps tc6ldpw tedtml tedub tephc te_w tikatm_w timrs timxth_w timx_w timzldp tispldpx_w tispldp_w ti_b1 tka tkalin tkatm tldppmw tmadb tmki tmkic tmot tmotlin tmotsoll tmst tnlkmtr_w tnst_w tolc top_w tpfifo tpldptcx_w tpldptc_w tumc tvkmtr tvlues1 tvlues2 tvluesic tvluessc ub udknlp1r udknlp2r udkp1asr_w udkp1_w udkp2asr_w udkp2_w uhepoti uhsv upwg1_w upwg2_w upwkd_w ushfmxstg ushk ushkmxstg ushksteig usvkk_w uulsuv_w vfil_w vfzg vfzroh_w vziel_w wdkba wdks wkrdya wkrm wkrma wkrmdy_w wkrmstat_w wnweos wnwe_w wnwise_w wnwi_w wnwkwas_w wnwse_w wnwsp_w wped_w wub wubr zhklsu zlash_w zlkd zwdynsh zwist zwout /end IN_MEASUREMENT
 /begin OUT_MEASUREMENT B_acc B_accen B_craus B_fa B_faa B_faadagl B_faadkl B_faagr B_faam B_faan B_faatm B_fabkv B_fadsv B_faezla B_fafrst B_fakat B_fakat2 B_fakd B_fakmtr B_fakrs B_fakth B_fakth2 B_fakvs B_falbk B_faldp B_falra B_falrshk B_falrshk2 B_falsh B_falshv B_falsv B_falsv2 B_fan B_fanws B_fanwsa B_fanwse B_faobv B_fash B_fash2 B_faskno B_faskno2 B_fasls B_fates B_fatnv B_fatnv2 B_fatp B_fatp2 B_fatv B_fatv2 B_fgrte B_grdst B_hlon B_kstebf B_lrndia B_luef1 B_luef2 B_luef3 vstagr vstcns vstdzw vstfba vstfns vstfrk vstfst vstfva vstfwl vstlr vstmdr vstnls vstrlx vstvvr /end OUT_MEASUREMENT
 /begin LOC_MEASUREMENT /end LOC_MEASUREMENT
 /begin SUB_FUNCTION /end SUB_FUNCTION
/end FUNCTION
/begin FUNCTION TKSTA "3.150     Testerkommunikation; Stellgliedansteuerung" /begin DEF_CHARACTERISTIC CWKUEKD CWSTAKD CWSTAKD2 CWSTEVKD /end DEF_CHARACTERISTIC /begin REF_CHARACTERISTIC /end REF_CHARACTERISTIC /begin IN_MEASUREMENT B_cdbkvp B_hlon B_slsfz nmot_w /end IN_MEASUREMENT /begin OUT_MEASUREMENT B_sttakt /end OUT_MEASUREMENT /begin LOC_MEASUREMENT /end LOC_MEASUREMENT /begin SUB_FUNCTION /end SUB_FUNCTION /end FUNCTION
/begin FUNCTION TN "3.20      Drehzahlmesser Signal" /begin DEF_CHARACTERISTIC /end DEF_CHARACTERISTIC /begin REF_CHARACTERISTIC /end REF_CHARACTERISTIC /begin IN_MEASUREMENT B_syn zzyl /end IN_MEASUREMENT /begin OUT_MEASUREMENT /end OUT_MEASUREMENT /begin LOC_MEASUREMENT /end LOC_MEASUREMENT /begin SUB_FUNCTION /end SUB_FUNCTION /end FUNCTION
/begin FUNCTION TNOT "" /begin DEF_CHARACTERISTIC /end DEF_CHARACTERISTIC /begin REF_CHARACTERISTIC /end REF_CHARACTERISTIC /begin IN_MEASUREMENT zzyl /end IN_MEASUREMENT /begin OUT_MEASUREMENT B_anschlag zzylkr /end OUT_MEASUREMENT /begin LOC_MEASUREMENT /end LOC_MEASUREMENT /begin SUB_FUNCTION /end SUB_FUNCTION /end FUNCTION
/begin FUNCTION TREV_OV "" /begin DEF_CHARACTERISTIC /end DEF_CHARACTERISTIC /begin REF_CHARACTERISTIC /end REF_CHARACTERISTIC /begin IN_MEASUREMENT /end IN_MEASUREMENT /begin OUT_MEASUREMENT B_trev_inc trevovCtr /end OUT_MEASUREMENT /begin LOC_MEASUREMENT /end LOC_MEASUREMENT /begin SUB_FUNCTION /end SUB_FUNCTION /end FUNCTION
/begin FUNCTION TUNING "Tuningschutz" /begin DEF_CHARACTERISTIC /end DEF_CHARACTERISTIC /begin REF_CHARACTERISTIC SGIDB5 /end REF_CHARACTERISTIC /begin IN_MEASUREMENT B_pwf /end IN_MEASUREMENT /begin OUT_MEASUREMENT /end OUT_MEASUREMENT
 /begin LOC_MEASUREMENT B_sersw B_tDelayEnd B_tuning ctr_hscmp tun_det tun_errcode tun_errcycle /end LOC_MEASUREMENT
 /begin SUB_FUNCTION /end SUB_FUNCTION
/end FUNCTION
/begin FUNCTION UFACCC "1.10      EGAS Überwachungskonzept: ACC Eingangssignalüberwachung der Funktionüberwachung" /begin DEF_CHARACTERISTIC BACC_T_UM DBACCMX_UM DBACC_T_UM /end DEF_CHARACTERISTIC /begin REF_CHARACTERISTIC /end REF_CHARACTERISTIC /begin IN_MEASUREMENT B_accab B_noacc_fr /end IN_MEASUREMENT /begin OUT_MEASUREMENT bzacc_um B_acce_um B_bacce_um B_noacc_um mracc_um /end OUT_MEASUREMENT /begin LOC_MEASUREMENT b2acc_um bacc_c_um bzacc_a_um dbacc_c_um /end LOC_MEASUREMENT /begin SUB_FUNCTION /end SUB_FUNCTION /end FUNCTION
/begin FUNCTION UFEING "13.10     EGAS Überwachungskonzept: Eingangssignalübernahme für Funktionsüberwachung" /begin DEF_CHARACTERISTIC /end DEF_CHARACTERISTIC /begin REF_CHARACTERISTIC /end REF_CHARACTERISTIC /begin IN_MEASUREMENT B_i_ska_fr B_notlu_fr B_ub_ok evz_austot tans tmot /end IN_MEASUREMENT /begin OUT_MEASUREMENT evz_aus_um tans_um tmot_um /end OUT_MEASUREMENT /begin LOC_MEASUREMENT /end LOC_MEASUREMENT /begin SUB_FUNCTION /end SUB_FUNCTION /end FUNCTION
/begin FUNCTION UFEINS "" /begin DEF_CHARACTERISTIC NMV08_UM NZWV08_UM RLV08_UM SPSNV08_UM /end DEF_CHARACTERISTIC /begin REF_CHARACTERISTIC /end REF_CHARACTERISTIC /begin IN_MEASUREMENT nmot_um rl_um spsn_um /end IN_MEASUREMENT /begin OUT_MEASUREMENT nmst08_um nzwst08_um rlst08_um spsnst08_um /end OUT_MEASUREMENT /begin LOC_MEASUREMENT /end LOC_MEASUREMENT /begin SUB_FUNCTION /end SUB_FUNCTION /end FUNCTION
/begin FUNCTION UFFGRC "5.10      EGAS Überwachungskonzept: FGR-Überwachung der Funktionsüberwachung" /begin DEF_CHARACTERISTIC VMIN_UM /end DEF_CHARACTERISTIC /begin REF_CHARACTERISTIC /end REF_CHARACTERISTIC /begin IN_MEASUREMENT B_fgr mifa vfzg_w /end IN_MEASUREMENT /begin OUT_MEASUREMENT B_fgr_um mfgr_um /end OUT_MEASUREMENT /begin LOC_MEASUREMENT /end LOC_MEASUREMENT /begin SUB_FUNCTION /end SUB_FUNCTION /end FUNCTION
/begin FUNCTION UFFGRE "14.20     EGAS Überwachungskonzept: FGR-Eingangsinfos für die Funktionsüberwachung"
 /begin DEF_CHARACTERISTIC BGRA_T_UM BRACC_T_UM BREMS_T_UM BRESP_T_UM DBGRAMX_UM DBGRA_T_UM /end DEF_CHARACTERISTIC
 /begin REF_CHARACTERISTIC CWGRABH /end REF_CHARACTERISTIC
 /begin IN_MEASUREMENT B_acc B_bkva B_bkvv B_fabr B_fgrab S_bls S_brs S_fgrat S_fgrhs S_fgrsv S_fgrwb /end IN_MEASUREMENT
 /begin OUT_MEASUREMENT B_bgrae_um /end OUT_MEASUREMENT
 /begin LOC_MEASUREMENT b2gra_um b3gra_um bgra_c_um bracc_c_um brems_c_um bresp_c_um bzgra_a_um bzgra_um B_graat_um B_graen_um B_grahe_um B_grahs_um B_grase_um B_gratd_um B_gratu_um B_grawa_um dbgra_c_um /end LOC_MEASUREMENT
 /begin SUB_FUNCTION /end SUB_FUNCTION
/end FUNCTION
/begin FUNCTION UFMIST "2.10      EGAS Überwachungskonzept: Ist-Moment der Funktionsüberwachung" /begin DEF_CHARACTERISTIC KFMI_UM KFZW_UM KLETAZW_UM /end DEF_CHARACTERISTIC /begin REF_CHARACTERISTIC NZWV08_UM RLV08_UM /end REF_CHARACTERISTIC /begin IN_MEASUREMENT nmot_um nzwst08_um rlst08_um rl_um zwout_um /end IN_MEASUREMENT /begin OUT_MEASUREMENT mi_um /end OUT_MEASUREMENT /begin LOC_MEASUREMENT dzw_um etazw_um miopt_um zwopt_um /end LOC_MEASUREMENT /begin SUB_FUNCTION /end SUB_FUNCTION /end FUNCTION
/begin FUNCTION UFMSRC "5.20      EGAS Überwachungskonzept: MSR-Eingriff-Überwachung für die Funktionsüberwachung" /begin DEF_CHARACTERISTIC BZ_MSR_UM DBZ_MN_UM DBZ_MX_UM MSRC_T_UM NOASR_UM /end DEF_CHARACTERISTIC /begin REF_CHARACTERISTIC /end REF_CHARACTERISTIC /begin IN_MEASUREMENT bz_msr B_nomsr_fr /end IN_MEASUREMENT /begin OUT_MEASUREMENT B_nkons_um B_nomsr_um ei_msrc_um mmsr_um /end OUT_MEASUREMENT /begin LOC_MEASUREMENT bzmsr_a_um msrc_c_um /end LOC_MEASUREMENT /begin SUB_FUNCTION /end SUB_FUNCTION /end FUNCTION
/begin FUNCTION UFMVER "2.10      EGAS Überwachungskonzept: Momentenvergleich der Funktionsüberwachung" /begin DEF_CHARACTERISTIC MVER_T_UM /end DEF_CHARACTERISTIC /begin REF_CHARACTERISTIC /end REF_CHARACTERISTIC /begin IN_MEASUREMENT B_i_ska_um mi_um mzf_um mzo_um /end IN_MEASUREMENT /begin OUT_MEASUREMENT /end OUT_MEASUREMENT /begin LOC_MEASUREMENT ei_mver_um mdif_w_um mver_c_um mzfo_um /end LOC_MEASUREMENT /begin SUB_FUNCTION /end SUB_FUNCTION /end FUNCTION
/begin FUNCTION UFMZF "1.10      EGAS Überwachungskonzept: Momentenfilter für die Funktionsüberwachung" /begin DEF_CHARACTERISTIC MZFFIL_UM MZFTV_UM /end DEF_CHARACTERISTIC /begin REF_CHARACTERISTIC /end REF_CHARACTERISTIC /begin IN_MEASUREMENT mz_um /end IN_MEASUREMENT /begin OUT_MEASUREMENT /end OUT_MEASUREMENT /begin LOC_MEASUREMENT mzf_low_um mzf_ptr_um mzf_reg_um mzf_um /end LOC_MEASUREMENT /begin SUB_FUNCTION /end SUB_FUNCTION /end FUNCTION
/begin COMPU_METHOD B_TRUE "boolsche Zustände, positive Logik" TAB_VERB "%6.3" "" COMPU_TAB_REF B_TRUE /end COMPU_METHOD
/begin COMPU_VTAB B_TRUE "boolsche Zustände, positive Logik" TAB_VERB 2 0 "----" 1 "TRUE" /end COMPU_VTAB
/begin COMPU_METHOD dez "1 : 1 Umrechnug (dez/hex)" RAT_FUNC "%6.2" "" COEFFS 0 1 0 0 0 1 /end COMPU_METHOD
/begin COMPU_METHOD fak_q0p00195 "" RAT_FUNC "%6.4" "-" COEFFS 0 65536 0 0 0 128 /end COMPU_METHOD
/begin COMPU_METHOD fak_sb_b1 "" RAT_FUNC "%6.4" "-" COEFFS 0 256 0 0 0 2 /end COMPU_METHOD
/begin COMPU_METHOD fak_sb_b16 "" RAT_FUNC "%6.3" "-" COEFFS 0 256 0 0 0 32 /end COMPU_METHOD
/begin COMPU_METHOD fak_sb_b2 "" RAT_FUNC "%6.4" "-" COEFFS 0 256 0 0 0 4 /end COMPU_METHOD
/begin COMPU_METHOD fak_sb_b64 "" RAT_FUNC "%6.3" "-" COEFFS 0 256 0 0 0 128 /end COMPU_METHOD
/begin COMPU_METHOD fak_sb_q0p5 "" RAT_FUNC "%6.3" "-" COEFFS 0 256 0 0 0 128 /end COMPU_METHOD
/begin COMPU_METHOD fak_sw_b1 "" RAT_FUNC "%7.6" "-" COEFFS 0 65536 0 0 0 2 /end COMPU_METHOD
/begin COMPU_METHOD fak_sw_b2 "" RAT_FUNC "%7.6" "-" COEFFS 0 65536 0 0 0 4 /end COMPU_METHOD
/begin COMPU_METHOD fak_sw_b64 "" RAT_FUNC "%6.4" "-" COEFFS 0 65536 0 0 0 128 /end COMPU_METHOD
/begin COMPU_METHOD fak_ub_b0p03125 "" RAT_FUNC "%6.5" "-" COEFFS 0 256 0 0 0 0.03125 /end COMPU_METHOD
/begin COMPU_METHOD fak_ub_b0p25 "" RAT_FUNC "%10.7" "-" COEFFS 0 256 0 0 0 0.25 /end COMPU_METHOD
/begin COMPU_METHOD fak_ub_b0p5 "" RAT_FUNC "%6.4" "-" COEFFS 0 256 0 0 0 0.5 /end COMPU_METHOD
/begin COMPU_METHOD fak_ub_b1 "" RAT_FUNC "%6.4" "-" COEFFS 0 256 0 0 0 1 /end COMPU_METHOD
/begin COMPU_METHOD fak_ub_b16 "" RAT_FUNC "%6.4" "-" COEFFS 0 256 0 0 0 16 /end COMPU_METHOD
/begin COMPU_METHOD fak_ub_b1p25_o0p75 "" RAT_FUNC "%6.3" "-" COEFFS 0 1 -0.75 0 0 0.00195313 /end COMPU_METHOD
/begin COMPU_METHOD fak_ub_b2 "" RAT_FUNC "%6.4" "-" COEFFS 0 256 0 0 0 2 /end COMPU_METHOD
/begin COMPU_METHOD fak_ub_b32 "" RAT_FUNC "%6.3" "-" COEFFS 0 256 0 0 0 32 /end COMPU_METHOD
/begin COMPU_METHOD fak_ub_b4 "" RAT_FUNC "%6.4" "-" COEFFS 0 256 0 0 0 4 /end COMPU_METHOD
/begin COMPU_METHOD fak_ub_b64 "" RAT_FUNC "%6.3" "-" COEFFS 0 256 0 0 0 64 /end COMPU_METHOD
/begin COMPU_METHOD fak_ub_b8 "" RAT_FUNC "%6.4" "-" COEFFS 0 256 0 0 0 8 /end COMPU_METHOD
/begin COMPU_METHOD fak_uw_b0p5 "" RAT_FUNC "%8.7" "-" COEFFS 0 65536 0 0 0 0.5 /end COMPU_METHOD
/begin COMPU_METHOD fak_uw_b1 "" RAT_FUNC "%7.6" "-" COEFFS 0 65536 0 0 0 1 /end COMPU_METHOD
/begin COMPU_METHOD fak_uw_b16 "" RAT_FUNC "%6.5" "-" COEFFS 0 65536 0 0 0 16 /end COMPU_METHOD
/begin COMPU_METHOD fak_uw_b2 "" RAT_FUNC "%7.6" "-" COEFFS 0 65536 0 0 0 2 /end COMPU_METHOD
/begin COMPU_METHOD fak_uw_b4 "" RAT_FUNC "%7.6" "-" COEFFS 0 65536 0 0 0 4 /end COMPU_METHOD
/begin COMPU_METHOD KennText "" RAT_FUNC "%6.2" "" COEFFS 0 1 0 0 0 1 /end COMPU_METHOD
/begin COMPU_METHOD kw_q0p5 "" RAT_FUNC "%6.3" "°KW" COEFFS 0 2 0 0 0 1 /end COMPU_METHOD
/begin COMPU_METHOD kw_sw_b128 "" RAT_FUNC "%6.4" "°KW" COEFFS 0 65536 0 0 0 256 /end COMPU_METHOD
/begin COMPU_METHOD kw_ub_q0p5 "" RAT_FUNC "%6.3" "°KW" COEFFS 0 256 0 0 0 128 /end COMPU_METHOD
/begin COMPU_METHOD m_ub_b1020 "" RAT_FUNC "%6.2" "kg/h" COEFFS 0 1 0 0 0 4 /end COMPU_METHOD
/begin COMPU_METHOD m_ub_q0p0444 "" RAT_FUNC "%6.4" "g" COEFFS 0 1 0 0 0 0.0444 /end COMPU_METHOD
/begin COMPU_METHOD m_uw_b23p3 "" RAT_FUNC "%6.5" "kg" COEFFS 0 2812.5 0 0 0 1 /end COMPU_METHOD
/begin COMPU_METHOD m_uw_b25p6 "" RAT_FUNC "%6.5" "kg/h" COEFFS 0 65536 0 0 0 25.6 /end COMPU_METHOD
/begin COMPU_METHOD m_uw_b4660 "" RAT_FUNC "%6.4" "g" COEFFS 0 3600 0 0 0 256 /end COMPU_METHOD
/begin COMPU_METHOD m_uw_b6553p5 "" RAT_FUNC "%6.3" "kg/h" COEFFS 0 1 0 0 0 0.1 /end COMPU_METHOD
/begin COMPU_METHOD m_uw_q3p2 "" RAT_FUNC "%6.2" "kg/h" COEFFS 0 1 0 0 0 3.2 /end COMPU_METHOD
/begin COMPU_METHOD nmotg_sb_q100 "" RAT_FUNC "%6.0" "U/min/s" COEFFS 0 1 0 0 0 100 /end COMPU_METHOD
/begin COMPU_METHOD nmot_q10 "" RAT_FUNC "%6.1" "" COEFFS 0 1 0 0 0 10 /end COMPU_METHOD
/begin COMPU_METHOD nmot_sb_q10 "" RAT_FUNC "%6.1" "U/min" COEFFS 0 1 0 0 0 10 /end COMPU_METHOD
/begin COMPU_METHOD nmot_sw_q0p25 "" RAT_FUNC "%6.3" "U/min" COEFFS 0 1 0 0 0 0.25 /end COMPU_METHOD
/begin COMPU_METHOD nmot_ub_q10 "" RAT_FUNC "%6.1" "U/min" COEFFS 0 1 0 0 0 10 /end COMPU_METHOD
/begin COMPU_METHOD nmot_ub_q40 "" RAT_FUNC "%6.1" "Upm" COEFFS 0 1 0 0 0 40 /end COMPU_METHOD
/begin COMPU_METHOD nmot_uw_q0p25 "" RAT_FUNC "%6.3" "U/min" COEFFS 0 1 0 0 0 0.25 /end COMPU_METHOD
/begin COMPU_METHOD perio_sw_b1p562 "" RAT_FUNC "%7.6" "1/s" COEFFS 0 65536 0 0 0 3.124 /end COMPU_METHOD
/begin COMPU_METHOD perio_sw_b6p125 "" RAT_FUNC "%6.5" "1/s" COEFFS 0 65536 0 0 0 12.25 /end COMPU_METHOD
/begin COMPU_METHOD perio_ub_b0p012207 "" RAT_FUNC "%10.8" "1/s" COEFFS 0 256 0 0 0 0.012207 /end COMPU_METHOD
/begin COMPU_METHOD perio_ub_b6p125 "" RAT_FUNC "%6.4" "1/s" COEFFS 0 256 0 0 0 6.125 /end COMPU_METHOD
/begin COMPU_METHOD p_sb_q0p25 "" RAT_FUNC "%6.3" "hPa" COEFFS 0 1 0 0 0 0.25 /end COMPU_METHOD
/begin COMPU_METHOD p_sb_q10 "" RAT_FUNC "%6.1" "hPa" COEFFS 0 1 0 0 0 10 /end COMPU_METHOD
/begin COMPU_METHOD p_ub_q5 "" RAT_FUNC "%6.2" "hPa" COEFFS 0 1 0 0 0 5 /end COMPU_METHOD
/begin COMPU_METHOD p_uw_q0p039 "" RAT_FUNC "%6.4" "hPa" COEFFS 0 256 0 0 0 10 /end COMPU_METHOD
/begin COMPU_METHOD relDK_ub_b100 "" RAT_FUNC "%6.3" "% DK" COEFFS 0 255 0 0 0 100 /end COMPU_METHOD
/begin COMPU_METHOD relPED_ub_b100 "" RAT_FUNC "%6.3" "% PED" COEFFS 0 255 0 0 0 100 /end COMPU_METHOD
/begin COMPU_METHOD rel_q0p00195 "" RAT_FUNC "%6.4" "%" COEFFS 0 65536 0 0 0 128 /end COMPU_METHOD
/begin COMPU_METHOD rel_sw_q0p0468 "" RAT_FUNC "%6.4" "%" COEFFS 0 65536 0 0 0 3072 /end COMPU_METHOD
/begin COMPU_METHOD rel_ub_b127p5 "" RAT_FUNC "%6.3" "%" COEFFS 0 2 0 0 0 1 /end COMPU_METHOD
/begin COMPU_METHOD rel_ub_b25 "" RAT_FUNC "%6.3" "%" COEFFS 0 256 0 0 0 25 /end COMPU_METHOD
/begin COMPU_METHOD rel_ub_b99p6 "" RAT_FUNC "%6.3" "%" COEFFS 0 256 0 0 0 100 /end COMPU_METHOD
/begin COMPU_METHOD rel_ub_q0p00153 "" RAT_FUNC "%6.4" "%" COEFFS 0 256 0 0 0 0.3906 /end COMPU_METHOD
/begin COMPU_METHOD rel_ub_q0p3906 "" RAT_FUNC "%6.3" "%" COEFFS 0 256 0 0 0 100 /end COMPU_METHOD
/begin COMPU_METHOD rel_ub_q0p75 "" RAT_FUNC "%6.3" "%" COEFFS 0 1 0 0 0 0.75 /end COMPU_METHOD
/begin COMPU_METHOD rel_uw_b100 "" RAT_FUNC "%6.4" "%" COEFFS 0 65536 0 0 0 100 /end COMPU_METHOD
/begin COMPU_METHOD rel_uw_b192 "" RAT_FUNC "%6.4" "%" COEFFS 0 65536 0 0 0 192 /end COMPU_METHOD
/begin COMPU_METHOD rel_uw_b200 "" RAT_FUNC "%6.4" "%" COEFFS 0 65536 0 0 0 200 /end COMPU_METHOD
/begin COMPU_METHOD rel_uw_q0p0234 "" RAT_FUNC "%6.4" "%" COEFFS 0 32 0 0 0 0.75 /end COMPU_METHOD
/begin COMPU_METHOD rgrad_uw_b1280 "" RAT_FUNC "%6.4" "%/s" COEFFS 0 65536 0 0 0 1280 /end COMPU_METHOD
/begin COMPU_METHOD spg_ubatt "" RAT_FUNC "%6.4" "V" COEFFS 0 1 0 0 0 0.0704 /end COMPU_METHOD
/begin COMPU_METHOD spg_ub_q0p0052_o0p2 "" RAT_FUNC "%6.3" "V" COEFFS 0 255 51 0 0 1.33 /end COMPU_METHOD
/begin COMPU_METHOD spg_ub_q0p019 "" RAT_FUNC "%6.4" "V" COEFFS 0 256 0 0 0 5 /end COMPU_METHOD
/begin COMPU_METHOD t100msxs_ub_b25p5 "" RAT_FUNC "%6.3" "s" COEFFS 0 1 0 0 0 0.1 /end COMPU_METHOD
/begin COMPU_METHOD t100msxs_uw_b6553p5 "" RAT_FUNC "%6.3" "s" COEFFS 0 1 0 0 0 0.1 /end COMPU_METHOD
/begin COMPU_METHOD t100msxs_uw_q100 "" RAT_FUNC "%6.3" "s" COEFFS 0 1 0 0 0 0.1 /end COMPU_METHOD
/begin COMPU_METHOD t10msxs_sb_q0p01 "" RAT_FUNC "%6.4" "s" COEFFS 0 1 0 0 0 0.01 /end COMPU_METHOD
/begin COMPU_METHOD t10msxs_uw_b655p35 "" RAT_FUNC "%6.4" "s" COEFFS 0 1 0 0 0 0.01 /end COMPU_METHOD
/begin COMPU_METHOD t1sxs_ub_b255 "" RAT_FUNC "%6.2" "s" COEFFS 0 1 0 0 0 1 /end COMPU_METHOD
/begin COMPU_METHOD t1sxs_uw_q1 "" RAT_FUNC "%6.2" "s" COEFFS 0 1 0 0 0 1 /end COMPU_METHOD
/begin COMPU_METHOD t20msxs_ub_b5p1 "" RAT_FUNC "%6.4" "s" COEFFS 0 1 0 0 0 0.02 /end COMPU_METHOD
/begin COMPU_METHOD t20msxs_ub_q0p32 "" RAT_FUNC "%6.3" "s" COEFFS 0 256 0 0 0 81.92 /end COMPU_METHOD
/begin COMPU_METHOD t40ms_ub_b10200 "" RAT_FUNC "%7.2" "ms" COEFFS 0 1 0 0 0 40 /end COMPU_METHOD
/begin COMPU_METHOD t6minxmin_q6 "" RAT_FUNC "%6.2" "min" COEFFS 0 1 0 0 0 6 /end COMPU_METHOD
/begin COMPU_METHOD temp_q0p0234_o273 "" RAT_FUNC "%6.1" "Grad C" COEFFS 0 1 273.15 0 0 0.0234375 /end COMPU_METHOD
/begin COMPU_METHOD temp_q6_o273 "" RAT_FUNC "%6.1" "Grad C" COEFFS 0 1 273.15 0 0 6 /end COMPU_METHOD
/begin COMPU_METHOD temp_ub_q0p75_o48 "" RAT_FUNC "%6.2" "Grad C" COEFFS 0 1 48 0 0 0.75 /end COMPU_METHOD
/begin COMPU_METHOD temp_ub_q5_o50 "" RAT_FUNC "%6.2" "Grad C" COEFFS 0 1 50 0 0 5 /end COMPU_METHOD
/begin COMPU_METHOD tinjection_sy "" RAT_FUNC "%6.4" "ms" COEFFS 0 375 0 0 0 1 /end COMPU_METHOD
/begin COMPU_METHOD t_min_q5p96em8 "" RAT_FUNC "%10.9" "Min" COEFFS 0 1 0 0 0 5.96e-008 /end COMPU_METHOD
/begin COMPU_METHOD uefktget_ub_b25p4 "" RAT_FUNC "%6.3" "" COEFFS 0 10 0 0 0 1 /end COMPU_METHOD
/begin COMPU_METHOD vfzg_q1p0 "" RAT_FUNC "%6.2" "km/h" COEFFS 0 1 0 0 0 1 /end COMPU_METHOD
/begin COMPU_METHOD vfzg_uw_q0p00781 "" RAT_FUNC "%6.4" "km/h" COEFFS 0 1 0 0 0 0.0078125 /end COMPU_METHOD
/begin COMPU_METHOD volgrd_q5p96Em4 "" RAT_FUNC "%6.5" "mL/s" COEFFS 0 65536 0 0 0 39.0625 /end COMPU_METHOD
/begin COMPU_METHOD zk100msxs_ub_b25p5 "" RAT_FUNC "%6.3" "s" COEFFS 0 0 256 0 10 0 /end COMPU_METHOD
/begin COMPU_METHOD zk100msxs_uw_b655 "" RAT_FUNC "%6.1" "s" COEFFS 0 0 65536 0 10 0 /end COMPU_METHOD
/begin COMPU_METHOD zk100msxs_uw_b6553 "" RAT_FUNC "%12.4" "s" COEFFS 0 0 65536 0 10 0 /end COMPU_METHOD
/begin COMPU_METHOD zk40ms_ub_b10200 "" RAT_FUNC "%6.1" "ms" COEFFS 0 0 10240 0 1 40 /end COMPU_METHOD
/begin COMPU_METHOD zw_sb_q0p75 "" RAT_FUNC "%6.3" "grad KW" COEFFS 0 255 0 0 0 191.25 /end COMPU_METHOD
/begin COMPU_METHOD zw_ub_q0p75 "" RAT_FUNC "%6.3" "Grad KW" COEFFS 0 255 0 0 0 191.25 /end COMPU_METHOD
/begin RECORD_LAYOUT GkfWSb FNC_VALUES 1 SBYTE COLUMN_DIR DIRECT /end RECORD_LAYOUT
/begin RECORD_LAYOUT GkfWUb FNC_VALUES 1 UBYTE COLUMN_DIR DIRECT /end RECORD_LAYOUT
/begin RECORD_LAYOUT GklWUb FNC_VALUES 1 UBYTE COLUMN_DIR DIRECT /end RECORD_LAYOUT
/begin RECORD_LAYOUT GklWUw FNC_VALUES 1 UWORD COLUMN_DIR DIRECT /end RECORD_LAYOUT
/begin RECORD_LAYOUT KfAxUbAyUbSstxSbSstyUbWUb NO_AXIS_PTS_X 1 UBYTE NO_AXIS_PTS_Y 2 UBYTE AXIS_PTS_X 3 SBYTE INDEX_INCR DIRECT AXIS_PTS_Y 4 UBYTE INDEX_INCR DIRECT FNC_VALUES 5 UBYTE COLUMN_DIR DIRECT /end RECORD_LAYOUT
/begin RECORD_LAYOUT KfAxUbAyUbSstxUbSstyUbWSb NO_AXIS_PTS_X 1 UBYTE NO_AXIS_PTS_Y 2 UBYTE AXIS_PTS_X 3 UBYTE INDEX_INCR DIRECT AXIS_PTS_Y 4 UBYTE INDEX_INCR DIRECT FNC_VALUES 5 SBYTE COLUMN_DIR DIRECT /end RECORD_LAYOUT
/begin RECORD_LAYOUT KfAxUbAyUbSstxUbSstyUbWUb NO_AXIS_PTS_X 1 UBYTE NO_AXIS_PTS_Y 2 UBYTE AXIS_PTS_X 3 UBYTE INDEX_INCR DIRECT AXIS_PTS_Y 4 UBYTE INDEX_INCR DIRECT FNC_VALUES 5 UBYTE COLUMN_DIR DIRECT /end RECORD_LAYOUT
/begin RECORD_LAYOUT KfAxUwAyUwSstxSwSstyUwWUw NO_AXIS_PTS_X 1 UWORD NO_AXIS_PTS_Y 2 UWORD AXIS_PTS_X 3 SWORD INDEX_INCR DIRECT AXIS_PTS_Y 4 UWORD INDEX_INCR DIRECT FNC_VALUES 5 UWORD COLUMN_DIR DIRECT /end RECORD_LAYOUT
/begin RECORD_LAYOUT KlAUbSstSbWSb NO_AXIS_PTS_X 1 UBYTE AXIS_PTS_X 2 SBYTE INDEX_INCR DIRECT FNC_VALUES 3 SBYTE COLUMN_DIR DIRECT /end RECORD_LAYOUT
/begin RECORD_LAYOUT KlAUbSstUbWSb NO_AXIS_PTS_X 1 UBYTE AXIS_PTS_X 2 UBYTE INDEX_INCR DIRECT FNC_VALUES 3 SBYTE COLUMN_DIR DIRECT /end RECORD_LAYOUT
/begin RECORD_LAYOUT KlAUbSstUbWUb NO_AXIS_PTS_X 1 UBYTE AXIS_PTS_X 2 UBYTE INDEX_INCR DIRECT FNC_VALUES 3 UBYTE COLUMN_DIR DIRECT /end RECORD_LAYOUT
/begin RECORD_LAYOUT KlAUbSstUwWUb NO_AXIS_PTS_X 1 UWORD AXIS_PTS_X 2 UWORD INDEX_INCR DIRECT FNC_VALUES 3 UBYTE COLUMN_DIR DIRECT /end RECORD_LAYOUT
/begin RECORD_LAYOUT KlAUwSstUwWUw NO_AXIS_PTS_X 1 UWORD AXIS_PTS_X 2 UWORD INDEX_INCR DIRECT FNC_VALUES 3 UWORD COLUMN_DIR DIRECT /end RECORD_LAYOUT
/begin RECORD_LAYOUT KwbUb FNC_VALUES 1 UBYTE COLUMN_DIR DIRECT /end RECORD_LAYOUT
/begin RECORD_LAYOUT KwbUw FNC_VALUES 1 UWORD COLUMN_DIR DIRECT /end RECORD_LAYOUT
/begin RECORD_LAYOUT KwSb FNC_VALUES 1 SBYTE COLUMN_DIR DIRECT /end RECORD_LAYOUT
/begin RECORD_LAYOUT KwUb FNC_VALUES 1 UBYTE COLUMN_DIR DIRECT /end RECORD_LAYOUT
/begin RECORD_LAYOUT KwUw FNC_VALUES 1 UWORD COLUMN_DIR DIRECT /end RECORD_LAYOUT
/begin RECORD_LAYOUT SstASwSstSw NO_AXIS_PTS_X 1 SWORD AXIS_PTS_X 2 SWORD INDEX_INCR DIRECT /end RECORD_LAYOUT
/begin RECORD_LAYOUT SstAUbSstSb NO_AXIS_PTS_X 1 UBYTE AXIS_PTS_X 2 SBYTE INDEX_INCR DIRECT /end RECORD_LAYOUT
/begin RECORD_LAYOUT SstAUbSstUb NO_AXIS_PTS_X 1 UBYTE AXIS_PTS_X 2 UBYTE INDEX_INCR DIRECT /end RECORD_LAYOUT
/begin RECORD_LAYOUT SstAUwSstUw NO_AXIS_PTS_X 1 UWORD AXIS_PTS_X 2 UWORD INDEX_INCR DIRECT /end RECORD_LAYOUT
/end MODULE
/end PROJECT
