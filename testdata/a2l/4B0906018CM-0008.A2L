ASAP2_VERSION 1 3
/begin PROJECT X505P_24HG_1 "X505P"
/begin HEADER "" VERSION "X505P_24HG_1" PROJECT_NO X505P_24HG_1 /end HEADER
/begin MODULE DIM ""
/begin MOD_COMMON "" BYTE_ORDER MSB_LAST ALIGNMENT_BYTE 1 ALIGNMENT_WORD 2 ALIGNMENT_LONG 2 /end MOD_COMMON
/begin CHARACTERISTIC ATISLATM "Anzti-Schwelle zur Umschaltung von lamns_w auf lamwl_w" CURVE 0x81DA7A GklWUw 65535.00 dez 0.00 65535.00 FORMAT "%8.2"
 /begin AXIS_DESCR COM_AXIS tmst temp_ub_q0p75_o48 12 -48.00 143.3 AXIS_PTS_REF STS12ESUB /end AXIS_DESCR
/end CHARACTERISTIC
/begin CHARACTERISTIC ATIWKSTM "Anzti-Schwelle zur Umschaltung von lamns_w auf lamwl_w bei Wiederholkaltstart" CURVE 0x81DA92 GklWUw 65535.00 dez 0.00 65535.00 FORMAT "%8.2"
 /begin AXIS_DESCR COM_AXIS tmst temp_ub_q0p75_o48 12 -48.00 143.3 AXIS_PTS_REF STS12ESUB /end AXIS_DESCR
/end CHARACTERISTIC
/begin CHARACTERISTIC AZKELDYN "Zündungen pro Zylinder bei KR-Lastdynamik => Klopferkennung" CURVE 0x819A49 GklWUb 254.0 dez 1.000 255.0 FORMAT "%5.1"
 /begin AXIS_DESCR COM_AXIS nmot nmot_ub_q40 16 0.00 10200. AXIS_PTS_REF SNM16KRUB /end AXIS_DESCR
/end CHARACTERISTIC
/begin CHARACTERISTIC AZKRLDYN "Anzahl Zündungen pro Zyl. bei KR-Lastdynamik" CURVE 0x819A59 GklWUb 254.0 dez 1.000 255.0 FORMAT "%5.1"
 /begin AXIS_DESCR COM_AXIS nmot nmot_ub_q40 16 0.00 10200. AXIS_PTS_REF SNM16KRUB /end AXIS_DESCR
/end CHARACTERISTIC
/begin CHARACTERISTIC AZKRNDYN "Anzahl Zündungen für KR-Drehzahldynamik" CURVE 0x819A69 GklWUb 254.0 dez 1.000 255.0 FORMAT "%5.1"
 /begin AXIS_DESCR COM_AXIS nmot nmot_ub_q40 16 0.00 10200. AXIS_PTS_REF SNM16KRUB /end AXIS_DESCR
/end CHARACTERISTIC
/begin CHARACTERISTIC CDWGANG_0_A "Gangerkennung für Kompressorabschalten bei Vollgas" VALUE 0x817A8E KwUb 255.0 dez 0.00 255.0 FORMAT "%5.1" /end CHARACTERISTIC
/begin CHARACTERISTIC CDWGANG_1_A "Gangerkennung für Kompressorabschalten bei Vollgas" VALUE 0x817A8F KwUb 255.0 dez 0.00 255.0 FORMAT "%5.1" /end CHARACTERISTIC
/begin CHARACTERISTIC CDWGANGB_0_A "Gangerkennung bei Beschleunigung" VALUE 0x817A90 KwUb 255.0 dez 0.00 255.0 FORMAT "%5.1" /end CHARACTERISTIC
/begin CHARACTERISTIC CDWGANGB_1_A "Gangerkennung bei Beschleunigung" VALUE 0x817A91 KwUb 255.0 dez 0.00 255.0 FORMAT "%5.1" /end CHARACTERISTIC
/begin CHARACTERISTIC CDWKOB_0_A "Codewort: Auswahl zur Gangerkennung für KO-Ausschalten (gangi oder nmot/vfzw)" VALUE 0x817A92 KwUb 255.0 dez 0.00 255.0 FORMAT "%5.1" /end CHARACTERISTIC
/begin CHARACTERISTIC CDWKOB_1_A "Codewort: Auswahl zur Gangerkennung für KO-Ausschalten (gangi oder nmot/vfzw)" VALUE 0x817A93 KwUb 255.0 dez 0.00 255.0 FORMAT "%5.1" /end CHARACTERISTIC
/begin CHARACTERISTIC CNFKUPPL "Konfigurationsflag für die Auswertung des Kuplg.schalters in der LLR" VALUE 0x8115E7 KwUb 255.0 dez 0.00 255.0 FORMAT "%5.1" /end CHARACTERISTIC
/begin CHARACTERISTIC CWCKBI "Codewort zum Empfang der CAN-Botschaft Kombi1" VALUE 0x81A94F KwUb 255.0 dez 0.00 255.0 FORMAT "%5.1" /end CHARACTERISTIC
/begin CHARACTERISTIC CWDEZWO "Konfiguration für AU621" VALUE 0x81A966 KwUb 255.0 dez 0.00 255.0 FORMAT "%5.1" /end CHARACTERISTIC
/begin CHARACTERISTIC CWKMTR "Codewort zur Konfiguration der Kühlmitteltemperaturregelung" VALUE 0x828EF0 KwUw 65535.00 dez 0.00 65535.00 FORMAT "%8.2" /end CHARACTERISTIC
/begin CHARACTERISTIC CWKOC "Codewort: Konfiguration der Klimakompressorsteuerung" VALUE 0x81274E KwUb 255.0 dez 0.00 255.0 FORMAT "%5.1" /end CHARACTERISTIC
/begin CHARACTERISTIC CWKOCAN "Konfiguration für CAN und Klimakompressor" VALUE 0x81274F KwUb 255.0 dez 0.00 255.0 FORMAT "%5.1" /end CHARACTERISTIC
/begin CHARACTERISTIC CWKOR "Konfiguration zur Leistungsreduzierung des Klimakompressors" VALUE 0x812750 KwUb 255.0 dez 0.00 255.0 FORMAT "%5.1" /end CHARACTERISTIC
/begin CHARACTERISTIC CWKRDY "Codewort für Dynamikerkennung" VALUE 0x819A79 KwUb 255.0 dez 0.00 255.0 FORMAT "%5.1" /end CHARACTERISTIC
/begin CHARACTERISTIC CWKRLZFK "Codewort: Klopferkennung wird bei geführten Zylindern nicht abgeschaltet" VALUE 0x819962 KwUb 255.0 dez 0.00 255.0 FORMAT "%5.1" /end CHARACTERISTIC
/begin CHARACTERISTIC CWKRNLR "Codewort Notlauf KR bei Abfall eines  KS" VALUE 0x819963 KwUb 255.0 dez 0.00 255.0 FORMAT "%5.1" /end CHARACTERISTIC
/begin CHARACTERISTIC CWKRRA "Codewort für die Funktion %KRRA" VALUE 0x819964 KwUb 255.0 dez 0.00 255.0 FORMAT "%5.1" /end CHARACTERISTIC
/begin CHARACTERISTIC CWKRREF "Codewort: Verhalten Referenzpegelnachführung bei Drehzahldynamik" VALUE 0x8197BF KwUb 1.000 dez 0.00 1.000 FORMAT "%5.3" /end CHARACTERISTIC
/begin CHARACTERISTIC CWLAKH "Codewort für Funktion %LAKH" VALUE 0x819748 KwUb 255.0 dez 0.00 255.0 FORMAT "%5.1" /end CHARACTERISTIC
/begin CHARACTERISTIC CWLAMBTS "Codewort: Lambda Bauteileschutz" VALUE 0x81949A KwUb 255.0 dez 0.00 255.0 FORMAT "%5.1" /end CHARACTERISTIC
/begin CHARACTERISTIC CWLAMFAW "Codeword LAMFAW" VALUE 0x819149 KwUb 255.0 dez 0.00 255.0 FORMAT "%5.1" /end CHARACTERISTIC
/begin CHARACTERISTIC CWLAMKH "Codewort Lambdakoordination bei Kat-heizen" VALUE 0x8110A4 KwUb 255.0 dez 0.00 255.0 FORMAT "%5.1" /end CHARACTERISTIC
/begin CHARACTERISTIC CWLDIMX "Codewort für Applikationsverfahren KFLDIMX/KFLDIOPU" VALUE 0x819BFA KwUb 255.0 DEZ 0.00 255.0 FORMAT "%5.1" /end CHARACTERISTIC
/begin CHARACTERISTIC CWLDRPLS "Codewort für %LDRPLS" VALUE 0x819BB7 KwUb 255.0 DEZ 0.00 255.0 FORMAT "%5.1" /end CHARACTERISTIC
/begin CHARACTERISTIC CWLUEKO "Codewort Lüfterkonfiguration" VALUE 0x828EF2 KwUw 65535.00 dez 0.00 65535.00 FORMAT "%8.2" /end CHARACTERISTIC
/begin CHARACTERISTIC CWREFI "Codewort: Neuinitialisierung von rkr mit REFINI bei Dynamik" VALUE 0x8197C0 KwUb 1.000 dez 0.00 1.000 FORMAT "%5.3" /end CHARACTERISTIC
/begin CHARACTERISTIC CWRLMX "Codeword für LDRLMX (Ladedruckregelung)" VALUE 0x819CAB KwUb 255.0 dez 0.00 255.0 FORMAT "%5.1" /end CHARACTERISTIC
/begin CHARACTERISTIC CWTIPIN "Codewort für Tip in - Funktion" VALUE 0x819A7A KwUb 255.0 dez 0.00 255.0 FORMAT "%5.1" /end CHARACTERISTIC
/begin CHARACTERISTIC CWTIPIN_G "Codewort für Tip in - Funktion Gangspezifisch" VALUE 0x819A7B KwUb 255.0 dez 0.00 255.0 FORMAT "%5.1" /end CHARACTERISTIC
/begin CHARACTERISTIC CWWL "Codewort für Warmlaufsteuerung" VALUE 0x811509 KwUb 255.0 dez 0.00 255.0 FORMAT "%5.1" /end CHARACTERISTIC
/begin CHARACTERISTIC DKL1DTEV "Zusätzliche Klimaanforderung für Lüfter 1 während Tankentlüftungsdiagnose" VALUE 0x81A967 KwUb 191.3 temp_ub_q0p75_o48 -48.00 143.3 FORMAT "%5.1" /end CHARACTERISTIC
/begin CHARACTERISTIC DKL2DTEV "Zusätzliche Klimaanforderung für Lüfter 2 während Tankentlüftungsdiagnose" VALUE 0x81A968 KwUb 191.3 temp_ub_q0p75_o48 -48.00 143.3 FORMAT "%5.1" /end CHARACTERISTIC
/begin CHARACTERISTIC DLAMFAW "Schwellwert für Aktivierung Anfettung über Fahrerwunsch" VALUE 0x81914A KwUb 1.992 fak_ub_b2 0.00 1.992 FORMAT "%5.3" /end CHARACTERISTIC
/begin CHARACTERISTIC DLAMNSWL "max. Abweichung für lamnswl_w=1.0" VALUE 0x81150A KwUb 0.9961 fak_ub_b1 0.00 0.9961 /end CHARACTERISTIC
/begin CHARACTERISTIC DLAMOB "Delta Lambda bei Overboost" CURVE 0x81914B GklWUb 1.992 fak_ub_b2 0.00 1.992 FORMAT "%5.3"
 /begin AXIS_DESCR COM_AXIS nmot nmot_ub_q40 6 0.00 10200. AXIS_PTS_REF SNM06GKUB /end AXIS_DESCR
/end CHARACTERISTIC
/begin CHARACTERISTIC DLAMTANS "Lufttemperaturabhängige Anfettung" CURVE 0x81DAE2 KlAUbSstUbWSb 1.992 fak_sb_b1 -1.000 0.9922 FORMAT "%5.3"
 /begin AXIS_DESCR STD_AXIS tans temp_ub_q0p75_o48 4 -48.00 143.3 FORMAT "%5.1" DEPOSIT ABSOLUTE /end AXIS_DESCR
/end CHARACTERISTIC
/begin CHARACTERISTIC DMTSMN "Untere Regelschwelle Differenz Soll-Ist Motortemperatur" VALUE 0x81A969 KwSb 191.3 temp_sb_q0p75 -96.00 95.25 FORMAT "%5.2" /end CHARACTERISTIC
/begin CHARACTERISTIC DMTSMX "Obere Regelschwelle Differenz Soll-Ist Motortemperatur" VALUE 0x81A96A KwSb 191.3 temp_sb_q0p75 -96.00 95.25 FORMAT "%5.2" /end CHARACTERISTIC
/begin CHARACTERISTIC DNLLR "Drehzahlband oberhalb nstat für LLR-Freigabe" VALUE 0x8115E8 KwUb 2550. nmot_ub_q10 0.00 2550. FORMAT "%5.0" /end CHARACTERISTIC
/begin CHARACTERISTIC DPSKRAN "Erkennungsschwelle Lastdynamik für Stationäradaption" CURVE 0x81E8B2 GklWSw 1279.961 p_sw_q0p039 0.00 1279.961 FORMAT "%8.3"
 /begin AXIS_DESCR COM_AXIS nmot nmot_ub_q40 16 0.00 10200. AXIS_PTS_REF SNM16KRUB /end AXIS_DESCR
/end CHARACTERISTIC
/begin CHARACTERISTIC DQUEBERMN "Minimaler überschüssiger Wärmestrom" VALUE 0x81A96B KwUb 191.3 temp_ub_q0p75_o48 -48.00 143.3 FORMAT "%5.1" /end CHARACTERISTIC
/begin CHARACTERISTIC DQUEBERMX "Maximaler überschüssiger Wärmestrom" VALUE 0x81A96C KwUb 191.3 temp_ub_q0p75_o48 -48.00 143.3 FORMAT "%5.1" /end CHARACTERISTIC
/begin CHARACTERISTIC DQUEBMX "Maximaler Überschüssiger Wärmestrom" VALUE 0x81A96D KwUb 143.3 temp_ub_q0p75_o48 0.00 143.3 FORMAT "%5.1" /end CHARACTERISTIC
/begin CHARACTERISTIC DRLKRSTMX "maximales drl im KR-stationär Betrieb" VALUE 0x815C76 KwSw 767.9766 rel_sw_q0p0234 0.00 767.9766 FORMAT "%8.4" /end CHARACTERISTIC
/begin CHARACTERISTIC DTBTS "Temperaturhysterese für Bauteileschutz" VALUE 0x81DC44 KwUw 1279.980 temp_uw_q0p0195 0.00 1279.980 FORMAT "%8.3" /end CHARACTERISTIC
/begin CHARACTERISTIC DWKRMSN "delta Winkel KR Abstand zur gemittelten Spätverstellung" CURVE 0x819965 GklWUb 191.3 zw_ub_qn0p75 -191.3 0.00 FORMAT "%5.1"
 /begin AXIS_DESCR COM_AXIS nmot nmot_ub_q40 16 0.00 10200. AXIS_PTS_REF SNM16KRUB /end AXIS_DESCR
/end CHARACTERISTIC
/begin CHARACTERISTIC DWPEDKOB "Gradient des norm. Fahrpedalwinkels für KOS-Ausschalten" VALUE 0x812751 KwSb 99.60 rel_sb_q0p39 -50.00 49.61 FORMAT "%5.2" /end CHARACTERISTIC
/begin CHARACTERISTIC DYADMXN "Max. Wert des add. Dynamikvorhalts" CURVE 0x811579 FklWUb 20.25 zw_ub_qn0p75 -20.25 0.00 FORMAT "%5.2"
 /begin AXIS_DESCR FIX_AXIS stuetz dez 5 0.00 4.000 FORMAT "%5.3" FIX_AXIS_PAR 0 0 5 /end AXIS_DESCR
/end CHARACTERISTIC
/begin CHARACTERISTIC DYADS "Add. Spätverstellung pro Zyk. durch lern. Dyn." VALUE 0x81157E KwUb 24.00 zw_ub_qn0p75 -24.00 0.00 FORMAT "%5.2" /end CHARACTERISTIC
/begin CHARACTERISTIC DYAFVS "Stufenhöhe für Abregelung des Dynamikvorhalts" VALUE 0x81157F KwUb 20.25 zw_ub_q0p75 0.00 20.25 FORMAT "%5.2" /end CHARACTERISTIC
/begin CHARACTERISTIC DYAMNV "Min. Wert des add. Dynamikvorhalts" VALUE 0x811580 KwUb 24.00 zw_ub_qn0p75 -24.00 0.00 FORMAT "%5.2" /end CHARACTERISTIC
/begin CHARACTERISTIC DYAVF "Abregelkonstante für Dynamikvorhalt" VALUE 0x811581 KwUb 254.0 dez 1.000 255.0 FORMAT "%5.1" /end CHARACTERISTIC
/begin CHARACTERISTIC DZWTIN "delta-Zündwinkel bei Tip in" CURVE 0x819A7C GklWUb 20.25 zw_ub_qn0p75 -20.25 0.00 FORMAT "%5.2"
 /begin AXIS_DESCR COM_AXIS nmot nmot_ub_q40 16 0.00 10200. AXIS_PTS_REF SNM16KRUB /end AXIS_DESCR
/end CHARACTERISTIC
/begin CHARACTERISTIC ELDOB "Regelabweichungsschwelle für Start Zeitzähler LDR-Overboost activ" VALUE 0x819C59 KwSb 1270. p_sb_q10 0.00 1270. FORMAT "%5.0" /end CHARACTERISTIC
/begin CHARACTERISTIC ETRIMN "Minimaler I-Anteil Tastverhältnis zur Ansteuerung elektr. Thermostatventil" VALUE 0x81A96E KwSb 199.2 rel_sb_b100 -100.0 99.22 FORMAT "%5.1" /end CHARACTERISTIC
/begin CHARACTERISTIC ETRIMX "Maximaler I-Anteil Tastverhältnis zur Ansteuerung elektr. Thermostatventil" VALUE 0x81A96F KwSb 199.2 rel_sb_b100 -100.0 99.22 FORMAT "%5.1" /end CHARACTERISTIC
/begin CHARACTERISTIC FBSTABGM "Faktor Bauteileschutz abhängig von model. Abgastemperatur" CURVE 0x81DC46 KlAUwSstUwWUw 1.999969 fak_uw_b2 0.00 1.999969 FORMAT "%8.6"
 /begin AXIS_DESCR STD_AXIS tabgbts_w temp_uw_q0p0195_o50 4 -50.00000 1229.980 FORMAT "%8.3" DEPOSIT ABSOLUTE /end AXIS_DESCR
/end CHARACTERISTIC
/begin CHARACTERISTIC FBSTMOT "Offset Bauteileschutz abhängig von Motor-Temperatur" CURVE 0x81DC58 KlAUbSstUbWSb 1.992 fak_sb_b1 -1.000 0.9922 FORMAT "%5.3"
 /begin AXIS_DESCR STD_AXIS tmot temp_ub_q0p75_o48 4 -48.00 143.3 FORMAT "%5.1" DEPOSIT ABSOLUTE /end AXIS_DESCR
/end CHARACTERISTIC
/begin CHARACTERISTIC FHOKOB "Höhenschwelle für Kompressorabschaltung bei Beschleunigung" VALUE 0x812752 KwUb 3.984 fak_ub_b4 0.00 3.984 FORMAT "%5.3" /end CHARACTERISTIC
/begin CHARACTERISTIC FKEFMC "Korrekturfaktor für Klopferkennungsschwelle bei Filtermittenfrequenzumschaltung" VALUE 0x81153F KwUb 2.000 fak_ub_b16 0.00 2.000 FORMAT "%5.3" /end CHARACTERISTIC
/begin CHARACTERISTIC FKELDY "Korrekturfaktor für Klopferkennungsschwelle bei Lastdynamik" VALUE 0x811540 KwUb 2.000 fak_ub_b16 0.00 2.000 FORMAT "%5.3" /end CHARACTERISTIC
/begin CHARACTERISTIC FKELDYA "Korrekturfaktor für Klopferkennungsschwelle bei Lastdynamikadaption" VALUE 0x811582 KwUb 0.6250 fak_ub_b16 0.6250 1.250 FORMAT "%5.3" /end CHARACTERISTIC
/begin CHARACTERISTIC FKENDY "Korrekturfaktor für Klopferkennungsschwelle bei Drehzahldynamik" VALUE 0x811541 KwUb 2.000 fak_ub_b16 0.00 2.000 FORMAT "%5.3" /end CHARACTERISTIC
/begin CHARACTERISTIC FKLDOBG "Korrekturfaktor für Delta rl im Overboostbetrieb" CURVE 0x819C5A FklWUb 0.9961 fak_ub_b1 0.00 0.9961
 /begin AXIS_DESCR FIX_AXIS gangi dez 8 0.00 7.000 FORMAT "%5.3" FIX_AXIS_PAR 0 0 8 /end AXIS_DESCR
/end CHARACTERISTIC
/begin CHARACTERISTIC FKRFTPFMC "Korrekturfaktor des Tiefpaßverhaltens bei Umschaltung der Filtermittenfrequenz" VALUE 0x811542 KwUb 0.5000 fak_ub_b2 0.5000 1.000 FORMAT "%5.3" /end CHARACTERISTIC
/begin CHARACTERISTIC FKRXTOL "Faktor zur Korrektur von rlmax bei hoher Motoröltemperatur" CURVE 0x826A02 KlAUbSstUbWUb 1.992 fak_ub_b2 0.00 1.992 FORMAT "%5.3"
 /begin AXIS_DESCR STD_AXIS toelldrlmx temp_ub_q1_o60 4 -60.00 195.0 FORMAT "%5.1" DEPOSIT ABSOLUTE /end AXIS_DESCR
/end CHARACTERISTIC
/begin CHARACTERISTIC FKVA "Konstanter Umrechnungsfaktor für Verbrauchsanzeige" VALUE 0x81A950 KwUb 15.94 fak_ub_b16 0.00 15.94 FORMAT "%5.2" /end CHARACTERISTIC
/begin CHARACTERISTIC FNLPRUEF "Faktor Wiederholprüfung Nachlaufzeitberechnung" VALUE 0x81A970 KwUb 0.9961 fak_ub_b1 0.00 0.9961 /end CHARACTERISTIC
/begin CHARACTERISTIC FTLDIA "Faktor für Entprellzeit Adaptionsfreigabe" VALUE 0x819BFB KwUb 1.992 fak_ub_b2 0.00 1.992 FORMAT "%5.3" /end CHARACTERISTIC
/begin CHARACTERISTIC FTLDIAP "Faktor für Entprellzeit schnelle positive Nachführung" VALUE 0x819BFC KwUb 1.992 fak_ub_b2 0.00 1.992 FORMAT "%5.3" /end CHARACTERISTIC
/begin CHARACTERISTIC GWPLDOB "Gradient Pedalwinkel zum Ausloesen des Overboost" VALUE 0x819C62 KwUb 2000. rel_ub_q8 0.00 2000. FORMAT "%5.0" /end CHARACTERISTIC
/begin CHARACTERISTIC GWPLDU "Gradientenschwelle Pedal für dynamische Freigabe Umluftventilsteuerung" VALUE 0x8115CD KwSb 99.60 rel_sb_q0p39 -50.00 49.61 FORMAT "%5.2" /end CHARACTERISTIC
/begin CHARACTERISTIC GWPLDUR "Gradient Pedalwert für Reset LDR Umluftventilansteuerung dynamisch" VALUE 0x8115CE KwSb 99.60 rel_sb_q0p39 -50.00 49.61 FORMAT "%5.2" /end CHARACTERISTIC
/begin CHARACTERISTIC HSLDSUA "Hysterese für stationäre Schubumluftventilansteuerung" VALUE 0x815E34 KwUw 2559.961 p_uw_q0p039 0.00 2559.961 FORMAT "%8.3" /end CHARACTERISTIC
/begin CHARACTERISTIC HSSLDSUA "Hysterese zum Schließen der Turbo Umluftventile im Stationärpfad" VALUE 0x8115CF KwUb 3.984 fak_ub_b4 0.00 3.984 FORMAT "%5.3" /end CHARACTERISTIC
/begin CHARACTERISTIC IMLLASKH_0_A "imlpr-Schwelle für Übergang auf Lambda-Abgas-Vorgabe" VALUE 0x81E8AE KwUb 0.9961 fak_ub_b1 0.00 0.9961 /end CHARACTERISTIC
/begin CHARACTERISTIC IMLLASKH_1_A "imlpr-Schwelle für Übergang auf Lambda-Abgas-Vorgabe" VALUE 0x81E8AF KwUb 0.9961 fak_ub_b1 0.00 0.9961 /end CHARACTERISTIC
/begin CHARACTERISTIC KD "BA Normierungsfaktor (DRIVE)" VALUE 0x81A951 KwUb 255.0 dez 0.00 255.0 FORMAT "%5.1" /end CHARACTERISTIC
/begin CHARACTERISTIC KFANFPU "Kennfeld Anfahrverhalten" MAP 0x81A971 KfAxUbAyUbSstxUbSstyUbWUb 191.3 temp_ub_q0p75_o48 -48.00 143.3 FORMAT "%5.1"
 /begin AXIS_DESCR STD_AXIS tumgkmtr temp_ub_q0p75_o48 5 -48.00 143.3 FORMAT "%5.1" DEPOSIT ABSOLUTE /end AXIS_DESCR
 /begin AXIS_DESCR STD_AXIS pu p_ub_q5 5 0.00 1275. FORMAT "%5.0" DEPOSIT ABSOLUTE /end AXIS_DESCR
/end CHARACTERISTIC
/begin CHARACTERISTIC KFDLBTS "Delta Lambdasoll für Bauteileschutz" MAP 0x81DC62 KfAxUbAyUbSstxUbSstyUbWSb 1.000 fak_sb_b1 -1.000 0.00 FORMAT "%5.3"
 /begin AXIS_DESCR STD_AXIS detazwbs rel_ub_b127p5 8 0.00 127.5 FORMAT "%5.1" DEPOSIT ABSOLUTE /end AXIS_DESCR
 /begin AXIS_DESCR STD_AXIS nmot nmot_ub_q40 4 0.00 10200. FORMAT "%5.0" DEPOSIT ABSOLUTE /end AXIS_DESCR
/end CHARACTERISTIC
/begin CHARACTERISTIC KFDQTMTU "Zusätzlicher Kühlbedarf abhängig von tmot, tum" MAP 0x81A996 KfAxUbAyUbSstxUbSstyUbWUb 191.3 temp_ub_q0p75_o48 -48.00 143.3 FORMAT "%5.1"
 /begin AXIS_DESCR STD_AXIS tmotkmtr temp_ub_q0p75_o48 5 -48.00 143.3 FORMAT "%5.1" DEPOSIT ABSOLUTE /end AXIS_DESCR
 /begin AXIS_DESCR STD_AXIS tume temp_ub_q0p75_o48 5 -48.00 143.3 FORMAT "%5.1" DEPOSIT ABSOLUTE /end AXIS_DESCR
/end CHARACTERISTIC
/begin CHARACTERISTIC KFDQUEBER "Kennfeld Wärmeüberschuss zur Ansteuerung der Lüfter" MAP 0x81A9BB GkfWUb 191.3 temp_ub_q0p75_o48 -48.00 143.3 FORMAT "%5.1"
 /begin AXIS_DESCR COM_AXIS dtmtka temp_sb_q0p75 5 -96.00 95.25 AXIS_PTS_REF STS05DTKA /end AXIS_DESCR
 /begin AXIS_DESCR COM_AXIS dkmts temp_sb_q0p75 5 -96.00 95.25 AXIS_PTS_REF STS05DTTS /end AXIS_DESCR
/end CHARACTERISTIC
/begin CHARACTERISTIC KFDYESP "Lastdynamikerkennungsschwelle" MAP 0x81E8D2 GkfWSw 1279.961 p_sw_q0p039 0.00 1279.961 FORMAT "%8.3"
 /begin AXIS_DESCR COM_AXIS nmot nmot_ub_q40 16 0.00 10200. AXIS_PTS_REF SNM16KRDYUB /end AXIS_DESCR
 /begin AXIS_DESCR COM_AXIS rl rel_ub_q0p75 6 0.00 191.3 AXIS_PTS_REF SRL06KRUB /end AXIS_DESCR
/end CHARACTERISTIC
/begin CHARACTERISTIC KFDYMNT "vorgesteuerter Dynamikvorhalt" MAP 0x819A8C KfAxUbAyUbSstxUbSstyUbWUb 20.25 zw_ub_qn0p75 -20.25 0.00 FORMAT "%5.2"
 /begin AXIS_DESCR STD_AXIS evtmod temp_ub_q0p75_o48 16 -48.00 143.3 FORMAT "%5.1" DEPOSIT ABSOLUTE /end AXIS_DESCR
 /begin AXIS_DESCR STD_AXIS nmot nmot_ub_q40 16 0.00 10200. FORMAT "%5.0" DEPOSIT ABSOLUTE /end AXIS_DESCR
/end CHARACTERISTIC
/begin CHARACTERISTIC KFDYRSP "Dynamikvorhalt Erkennungsschwelle" MAP 0x81E992 GkfWSw 1279.961 p_sw_q0p039 0.00 1279.961 FORMAT "%8.3"
 /begin AXIS_DESCR COM_AXIS nmot nmot_ub_q40 16 0.00 10200. AXIS_PTS_REF SNM16KRDYUB /end AXIS_DESCR
 /begin AXIS_DESCR COM_AXIS rl rel_ub_q0p75 6 0.00 191.3 AXIS_PTS_REF SRL06KRUB /end AXIS_DESCR
/end CHARACTERISTIC
/begin CHARACTERISTIC KFDYRSPOF "Dynamikvorhalt Offsetschwelle" MAP 0x81EA52 GkfWSw 1279.961 p_sw_q0p039 0.00 1279.961 FORMAT "%8.3"
 /begin AXIS_DESCR COM_AXIS nmot nmot_ub_q40 16 0.00 10200. AXIS_PTS_REF SNM16KRDYUB /end AXIS_DESCR
 /begin AXIS_DESCR COM_AXIS rl rel_ub_q0p75 6 0.00 191.3 AXIS_PTS_REF SRL06KRUB /end AXIS_DESCR
/end CHARACTERISTIC
/begin CHARACTERISTIC KFFDLBTS "Faktor Delta Lambdasoll für Bauteileschutz" MAP 0x81949B GkfWUb 1.992 fak_ub_b2 0.00 1.992 FORMAT "%5.3"
 /begin AXIS_DESCR COM_AXIS rl_w rel_uw_q0p0234 12 0.00 1535.977 AXIS_PTS_REF SRL12GKUW /end AXIS_DESCR
 /begin AXIS_DESCR COM_AXIS nmot nmot_ub_q40 16 0.00 10200. AXIS_PTS_REF SNM16GKUB /end AXIS_DESCR
/end CHARACTERISTIC
/begin CHARACTERISTIC KFFKRXTM "Faktor zur Korrektur von rlmax bei hoher Motortemperatur" MAP 0x826A0B KfAxUbAyUbSstxUbSstyUbWUb 1.992 fak_ub_b2 0.00 1.992 FORMAT "%5.3"
 /begin AXIS_DESCR STD_AXIS tmotldrlmx temp_ub_q0p75_o48 4 -48.00 143.3 FORMAT "%5.1" DEPOSIT ABSOLUTE /end AXIS_DESCR
 /begin AXIS_DESCR STD_AXIS vfzg vfzg_ub_q1p25 4 0.00 318.8 FORMAT "%5.1" DEPOSIT ABSOLUTE /end AXIS_DESCR
/end CHARACTERISTIC
/begin CHARACTERISTIC KFFLDEO "Faktor für Ladedruckeingriff auf Overboostwert durch KR" MAP 0x826A26 GkfWUw 0.9999847 fak_uw_b1 0.00 0.9999847 FORMAT "%9.7"
 /begin AXIS_DESCR COM_AXIS nmot_w nmot_uw_q0p25 8 0.00 16383.75 AXIS_PTS_REF SNM08LDUW /end AXIS_DESCR
 /begin AXIS_DESCR COM_AXIS wkrmsu_w zw_q0p1875 8 0.00 12287.81 AXIS_PTS_REF SWK208LDUW /end AXIS_DESCR
/end CHARACTERISTIC
/begin CHARACTERISTIC KFFLLDE "Faktor für langsamen Ladedruckeingriff auf rlmax durch KR" MAP 0x826AA6 GkfWUw 1.999969 fak_uw_b2 0.00 1.999969 FORMAT "%8.6"
 /begin AXIS_DESCR COM_AXIS nmot_w nmot_uw_q0p25 8 0.00 16383.75 AXIS_PTS_REF SNM08LDUW /end AXIS_DESCR
 /begin AXIS_DESCR COM_AXIS wkrmstat_w zw_q0p1875 8 0.00 12287.81 AXIS_PTS_REF SWK08LDUW /end AXIS_DESCR
/end CHARACTERISTIC
/begin CHARACTERISTIC KFFSLDE "Faktor für schnellen LDR-Eingriff(Absenkung)" MAP 0x826B26 GkfWUw 1.999969 fak_uw_b2 0.00 1.999969 FORMAT "%8.6"
 /begin AXIS_DESCR COM_AXIS nmot_w nmot_uw_q0p25 8 0.00 16383.75 AXIS_PTS_REF SNM08LDUW /end AXIS_DESCR
 /begin AXIS_DESCR COM_AXIS wkrmdy_w zw_q0p1875 8 0.00 12287.81 AXIS_PTS_REF SWK108LDUW /end AXIS_DESCR
/end CHARACTERISTIC
/begin CHARACTERISTIC KFFWLLDE "Wichtungsfaktor für langsamen Ladedruckeingriff auf rlmax durch KR" MAP 0x826BA6 GkfWUw 1.999969 fak_uw_b2 0.00 1.999969 FORMAT "%8.6"
 /begin AXIS_DESCR COM_AXIS tans temp_ub_q0p75_o48 8 -48.00 143.3 AXIS_PTS_REF STA08LDUB /end AXIS_DESCR
 /begin AXIS_DESCR COM_AXIS wkrmstat_w zw_q0p1875 8 0.00 12287.81 AXIS_PTS_REF SWK08LDUW /end AXIS_DESCR
/end CHARACTERISTIC
/begin CHARACTERISTIC KFKEF1 "Klopferkennungsfaktorkennfeld Zündung 1" MAP 0x8197C1 GkfWUb 15.94 fak_ub_b16 0.00 15.94 FORMAT "%5.2"
 /begin AXIS_DESCR COM_AXIS nmot nmot_ub_q40 16 0.00 10200. AXIS_PTS_REF SNM16KRUB /end AXIS_DESCR
 /begin AXIS_DESCR COM_AXIS rl rel_ub_q0p75 3 0.00 191.3 AXIS_PTS_REF SRL03KRUB /end AXIS_DESCR
/end CHARACTERISTIC
/begin CHARACTERISTIC KFKEF2 "Klopferkennungsfaktorkennfeld Zündung 2" MAP 0x8197F1 GkfWUb 15.94 fak_ub_b16 0.00 15.94 FORMAT "%5.2"
 /begin AXIS_DESCR COM_AXIS nmot nmot_ub_q40 16 0.00 10200. AXIS_PTS_REF SNM16KRUB /end AXIS_DESCR
 /begin AXIS_DESCR COM_AXIS rl rel_ub_q0p75 3 0.00 191.3 AXIS_PTS_REF SRL03KRUB /end AXIS_DESCR
/end CHARACTERISTIC
/begin CHARACTERISTIC KFKEF3 "Klopferkennungsfaktorkennfeld Zündung 3" MAP 0x819821 GkfWUb 15.94 fak_ub_b16 0.00 15.94 FORMAT "%5.2"
 /begin AXIS_DESCR COM_AXIS nmot nmot_ub_q40 16 0.00 10200. AXIS_PTS_REF SNM16KRUB /end AXIS_DESCR
 /begin AXIS_DESCR COM_AXIS rl rel_ub_q0p75 3 0.00 191.3 AXIS_PTS_REF SRL03KRUB /end AXIS_DESCR
/end CHARACTERISTIC
/begin CHARACTERISTIC KFKEF4 "Klopferkennungsfaktorkennfeld Zündung 4" MAP 0x819851 GkfWUb 15.94 fak_ub_b16 0.00 15.94 FORMAT "%5.2"
 /begin AXIS_DESCR COM_AXIS nmot nmot_ub_q40 16 0.00 10200. AXIS_PTS_REF SNM16KRUB /end AXIS_DESCR
 /begin AXIS_DESCR COM_AXIS rl rel_ub_q0p75 3 0.00 191.3 AXIS_PTS_REF SRL03KRUB /end AXIS_DESCR
/end CHARACTERISTIC
/begin CHARACTERISTIC KFKEF5 "Klopferkennungsfaktorkennfeld Zündung 5" MAP 0x819881 GkfWUb 15.94 fak_ub_b16 0.00 15.94 FORMAT "%5.2"
 /begin AXIS_DESCR COM_AXIS nmot nmot_ub_q40 16 0.00 10200. AXIS_PTS_REF SNM16KRUB /end AXIS_DESCR
 /begin AXIS_DESCR COM_AXIS rl rel_ub_q0p75 3 0.00 191.3 AXIS_PTS_REF SRL03KRUB /end AXIS_DESCR
/end CHARACTERISTIC
/begin CHARACTERISTIC KFKEF6 "Klopferkennungsfaktorkennfeld Zündung 6" MAP 0x8198B1 GkfWUb 15.94 fak_ub_b16 0.00 15.94 FORMAT "%5.2"
 /begin AXIS_DESCR COM_AXIS nmot nmot_ub_q40 16 0.00 10200. AXIS_PTS_REF SNM16KRUB /end AXIS_DESCR
 /begin AXIS_DESCR COM_AXIS rl rel_ub_q0p75 3 0.00 191.3 AXIS_PTS_REF SRL03KRUB /end AXIS_DESCR
/end CHARACTERISTIC
/begin CHARACTERISTIC KFKEF7 "Klopferkennungsfaktorkennfeld Zündung 7" MAP 0x8198E1 GkfWUb 15.94 fak_ub_b16 0.00 15.94 FORMAT "%5.2"
 /begin AXIS_DESCR COM_AXIS nmot nmot_ub_q40 16 0.00 10200. AXIS_PTS_REF SNM16KRUB /end AXIS_DESCR
 /begin AXIS_DESCR COM_AXIS rl rel_ub_q0p75 3 0.00 191.3 AXIS_PTS_REF SRL03KRUB /end AXIS_DESCR
/end CHARACTERISTIC
/begin CHARACTERISTIC KFKEF8 "Klopferkennungsfaktorkennfeld Zündung 8" MAP 0x819911 GkfWUb 15.94 fak_ub_b16 0.00 15.94 FORMAT "%5.2"
 /begin AXIS_DESCR COM_AXIS nmot nmot_ub_q40 16 0.00 10200. AXIS_PTS_REF SNM16KRUB /end AXIS_DESCR
 /begin AXIS_DESCR COM_AXIS rl rel_ub_q0p75 3 0.00 191.3 AXIS_PTS_REF SRL03KRUB /end AXIS_DESCR
/end CHARACTERISTIC
/begin CHARACTERISTIC KFKTRLN "Kennfeld Motor-Solltemperatur" MAP 0x81A9D4 KfAxUbAyUbSstxUbSstyUbWUb 191.3 temp_ub_q0p75_o48 -48.00 143.3 FORMAT "%5.1"
 /begin AXIS_DESCR STD_AXIS nmot nmot_ub_q40 5 0.00 10200. FORMAT "%5.0" DEPOSIT ABSOLUTE /end AXIS_DESCR
 /begin AXIS_DESCR STD_AXIS rltmso1 rel_ub_q0p75 5 0.00 191.3 FORMAT "%5.1" DEPOSIT ABSOLUTE /end AXIS_DESCR
/end CHARACTERISTIC
/begin CHARACTERISTIC KFKTRV "Motorsolltemperatur für Kühlmitteltemperaturregelung geschwindigkeitsabhängg" MAP 0x81A9F9 KfAxUbAyUbSstxUbSstyUbWUb 191.3 temp_ub_q0p75_o48 -48.00 143.3 FORMAT "%5.1"
 /begin AXIS_DESCR STD_AXIS vfzgkmtr vfzg_ub_q1p25 5 0.00 318.8 FORMAT "%5.1" DEPOSIT ABSOLUTE /end AXIS_DESCR
 /begin AXIS_DESCR STD_AXIS tumgkmtr temp_ub_q0p75_o48 5 -48.00 143.3 FORMAT "%5.1" DEPOSIT ABSOLUTE /end AXIS_DESCR
/end CHARACTERISTIC
/begin CHARACTERISTIC KFLAFWL_0_A "Offset Lambda-Motor-Soll" MAP 0x819151 GkfWSb 1.992 fak_sb_b1 -1.000 0.9922 FORMAT "%5.3"
 /begin AXIS_DESCR COM_AXIS tmot temp_ub_q0p75_o48 8 -48.00 143.3 AXIS_PTS_REF STM08GKUB /end AXIS_DESCR
 /begin AXIS_DESCR COM_AXIS rl rel_ub_q0p75 6 0.00 191.3 AXIS_PTS_REF SRL06GKUB /end AXIS_DESCR
/end CHARACTERISTIC
/begin CHARACTERISTIC KFLAFWL_1_A "Offset Lambda-Motor-Soll" MAP 0x819181 GkfWSb 1.992 fak_sb_b1 -1.000 0.9922 FORMAT "%5.3"
 /begin AXIS_DESCR COM_AXIS tmot temp_ub_q0p75_o48 8 -48.00 143.3 AXIS_PTS_REF STM08GKUB /end AXIS_DESCR
 /begin AXIS_DESCR COM_AXIS rl rel_ub_q0p75 6 0.00 191.3 AXIS_PTS_REF SRL06GKUB /end AXIS_DESCR
/end CHARACTERISTIC
/begin CHARACTERISTIC KFLAMKR_0_A "Wichtungsfaktor für Anfettung bei Zündwinkelspätverstellung" MAP 0x8191B1 GkfWUb 1.992 fak_ub_b2 0.00 1.992 FORMAT "%5.3"
 /begin AXIS_DESCR COM_AXIS nmot nmot_ub_q40 6 0.00 10200. AXIS_PTS_REF SNM06GKUB /end AXIS_DESCR
 /begin AXIS_DESCR COM_AXIS rl rel_ub_q0p75 6 0.00 191.3 AXIS_PTS_REF SRL06GKUB /end AXIS_DESCR
/end CHARACTERISTIC
/begin CHARACTERISTIC KFLAMKR_1_A "Wichtungsfaktor für Anfettung bei Zündwinkelspätverstellung" MAP 0x8191D5 GkfWUb 1.992 fak_ub_b2 0.00 1.992 FORMAT "%5.3"
 /begin AXIS_DESCR COM_AXIS nmot nmot_ub_q40 6 0.00 10200. AXIS_PTS_REF SNM06GKUB /end AXIS_DESCR
 /begin AXIS_DESCR COM_AXIS rl rel_ub_q0p75 6 0.00 191.3 AXIS_PTS_REF SRL06GKUB /end AXIS_DESCR
/end CHARACTERISTIC
/begin CHARACTERISTIC KFLAMKRL "Anfettung bei Zündwinkelspätverstellung" MAP 0x8191F9 GkfWUb 1.992 fak_ub_b2 0.00 1.992 FORMAT "%5.3"
 /begin AXIS_DESCR COM_AXIS dzwlamfaw zw_ub_qn0p75 6 -191.3 0.00 AXIS_PTS_REF SDZ06GKUB /end AXIS_DESCR
 /begin AXIS_DESCR COM_AXIS rl rel_ub_q0p75 6 0.00 191.3 AXIS_PTS_REF SRL06GKUB /end AXIS_DESCR
/end CHARACTERISTIC
/begin CHARACTERISTIC KFLANS "Kennfeld Lambda-Motor-Beschreibung im Nachstart" MAP 0x81593A KfAxUbAyUbSstxUbSstyUwWUw 15.99976 fak_uw_b16 0.00 15.99976 FORMAT "%8.5"
 /begin AXIS_DESCR STD_AXIS tmst temp_ub_q0p75_o48 12 -48.00 143.3 FORMAT "%5.1" DEPOSIT ABSOLUTE /end AXIS_DESCR
 /begin AXIS_DESCR STD_AXIS anztib1_w dez 12 0.00 65535.00 FORMAT "%8.2" DEPOSIT ABSOLUTE /end AXIS_DESCR
/end CHARACTERISTIC
/begin CHARACTERISTIC KFLANSKH "Kennfeld Lambda-Motor-Vorgabe bei Katheizen im Nachstart" MAP 0x81E54A KfAxUbAyUbSstxUbSstyUwWUw 15.89990 fak_q0p000244 0.09985352 15.99976 FORMAT "%8.5"
 /begin AXIS_DESCR STD_AXIS tmst temp_ub_q0p75_o48 6 -48.00 143.3 FORMAT "%5.1" DEPOSIT ABSOLUTE /end AXIS_DESCR
 /begin AXIS_DESCR STD_AXIS anztib_w dez 12 0.00 65535.00 FORMAT "%8.2" DEPOSIT ABSOLUTE /end AXIS_DESCR
/end CHARACTERISTIC
/begin CHARACTERISTIC KFLASKH_0_A "Kennfeld Lambda-Abgas-Soll bei Katheizen" MAP 0x81E5FA KfAxUwAyUwSstxUwSstyUwWUw 15.99976 fak_q0p000244 0.00 15.99976 FORMAT "%8.5"
 /begin AXIS_DESCR STD_AXIS nmot_w nmot_uw_q0p25 8 0.00 16383.75 FORMAT "%8.2" DEPOSIT ABSOLUTE /end AXIS_DESCR
 /begin AXIS_DESCR STD_AXIS rl_w rel_uw_q0p0234 8 0.00 1535.977 FORMAT "%8.3" DEPOSIT ABSOLUTE /end AXIS_DESCR
/end CHARACTERISTIC
/begin CHARACTERISTIC KFLASKH_1_A "Kennfeld Lambda-Abgas-Soll bei Katheizen" MAP 0x81E69E KfAxUwAyUwSstxUwSstyUwWUw 15.99976 fak_q0p000244 0.00 15.99976 FORMAT "%8.5"
 /begin AXIS_DESCR STD_AXIS nmot_w nmot_uw_q0p25 8 0.00 16383.75 FORMAT "%8.2" DEPOSIT ABSOLUTE /end AXIS_DESCR
 /begin AXIS_DESCR STD_AXIS rl_w rel_uw_q0p0234 8 0.00 1535.977 FORMAT "%8.3" DEPOSIT ABSOLUTE /end AXIS_DESCR
/end CHARACTERISTIC
/begin CHARACTERISTIC KFLASWLR_0_A "Kennfeld Lambda-Motor-Soll im Warmlauf bei aktiver LR" MAP 0x818FDD GkfWUb 1.992 fak_ub_b2 0.00 1.992 FORMAT "%5.3"
 /begin AXIS_DESCR COM_AXIS tmot temp_ub_q0p75_o48 12 -48.00 143.3 AXIS_PTS_REF STM12ESUB /end AXIS_DESCR
 /begin AXIS_DESCR COM_AXIS tmst temp_ub_q0p75_o48 12 -48.00 143.3 AXIS_PTS_REF STS12ESUB /end AXIS_DESCR
/end CHARACTERISTIC
/begin CHARACTERISTIC KFLASWLR_1_A "Kennfeld Lambda-Motor-Soll im Warmlauf bei aktiver LR" MAP 0x81906D GkfWUb 1.992 fak_ub_b2 0.00 1.992 FORMAT "%5.3"
 /begin AXIS_DESCR COM_AXIS tmot temp_ub_q0p75_o48 12 -48.00 143.3 AXIS_PTS_REF STM12ESUB /end AXIS_DESCR
 /begin AXIS_DESCR COM_AXIS tmst temp_ub_q0p75_o48 12 -48.00 143.3 AXIS_PTS_REF STS12ESUB /end AXIS_DESCR
/end CHARACTERISTIC
/begin CHARACTERISTIC KFLBTS "Lambdasoll für Bauteileschutz" MAP 0x81955B GkfWUb 1.992 fak_ub_b2 0.00 1.992 FORMAT "%5.3"
 /begin AXIS_DESCR COM_AXIS rl_w rel_uw_q0p0234 12 0.00 1535.977 AXIS_PTS_REF SRL12GKUW /end AXIS_DESCR
 /begin AXIS_DESCR COM_AXIS nmot nmot_ub_q40 16 0.00 10200. AXIS_PTS_REF SNM16GKUB /end AXIS_DESCR
/end CHARACTERISTIC
/begin CHARACTERISTIC KFLDHBN "LDR-Höhenbegrenzung (max. Verdichterdruckverhältnis)" MAP 0x826C26 KfAxUbAyUbSstxUbSstyUbWUb 3.984 fak_ub_b4 0.00 3.984 FORMAT "%5.3"
 /begin AXIS_DESCR STD_AXIS nmot nmot_ub_q40 8 0.00 10200. FORMAT "%5.0" DEPOSIT ABSOLUTE /end AXIS_DESCR
 /begin AXIS_DESCR STD_AXIS tsel temp_ub_q0p75_o48 8 -48.00 143.3 FORMAT "%5.1" DEPOSIT ABSOLUTE /end AXIS_DESCR
/end CHARACTERISTIC
/begin CHARACTERISTIC KFLDIMX "Kennfeld LDR I-Reglerbegrenzung" MAP 0x81F684 GkfWUw 327.6750 tv_uw_q0p005 0.00 327.6750 FORMAT "%8.4"
 /begin AXIS_DESCR COM_AXIS nmot_w nmot_uw_q0p25 16 0.00 16383.75 AXIS_PTS_REF SNM16LDUW /end AXIS_DESCR
 /begin AXIS_DESCR COM_AXIS plsolr_w p_uw_q0p039 8 0.00 2559.961 AXIS_PTS_REF SPL08LDUW /end AXIS_DESCR
/end CHARACTERISTIC
/begin CHARACTERISTIC KFLDIOPU "Korrektur der TV-Werte durch Höheneinfluß" MAP 0x819BFD GkfWUb 163.2 tv_ub_q0p64 0.00 163.2 FORMAT "%5.1"
 /begin AXIS_DESCR COM_AXIS nmot nmot_ub_q40 8 0.00 10200. AXIS_PTS_REF SNM08LDUB /end AXIS_DESCR
 /begin AXIS_DESCR COM_AXIS pu p_ub_q5 8 0.00 1275. AXIS_PTS_REF SPU08LDUB /end AXIS_DESCR
/end CHARACTERISTIC
/begin CHARACTERISTIC KFLDIWL "Korrektur LDR I-Begrenzung im Warmlauf" MAP 0x81F784 KfAxUbAyUbSstxUbSstyUbWSb 163.2 tv_ub_q0p64 -81.92 81.28 FORMAT "%5.2"
 /begin AXIS_DESCR STD_AXIS tmst temp_ub_q0p75_o48 8 -48.00 143.3 FORMAT "%5.1" DEPOSIT ABSOLUTE /end AXIS_DESCR
 /begin AXIS_DESCR STD_AXIS imlatm m_ub_b23p3 8 0.00 23.21 FORMAT "%5.2" DEPOSIT ABSOLUTE /end AXIS_DESCR
/end CHARACTERISTIC
/begin CHARACTERISTIC KFLDRAPP "Kennfeld für LDR-Applikation ohne Md-Koordination" MAP 0x819CC8 KfAxUbAyUbSstxUbSstyUbWUb 99.61 tv_ub_b100 0.00 99.61 FORMAT "%5.2"
 /begin AXIS_DESCR STD_AXIS nmot nmot_ub_q40 8 0.00 10200. FORMAT "%5.0" DEPOSIT ABSOLUTE /end AXIS_DESCR
 /begin AXIS_DESCR STD_AXIS wped relPED_ub_b100 8 0.00 100.0 FORMAT "%5.1" DEPOSIT ABSOLUTE /end AXIS_DESCR
/end CHARACTERISTIC
/begin CHARACTERISTIC KFLDRL "KF zur Linearisierung Ladedruck=f(TV)" MAP 0x81F7D6 GkfWSw 327.6750 tv_sw_q0p005 -163.8400 163.8350 FORMAT "%8.4"
 /begin AXIS_DESCR COM_AXIS nmot_w nmot_uw_q0p25 16 0.00 16383.75 AXIS_PTS_REF SNM16LDUW /end AXIS_DESCR
 /begin AXIS_DESCR COM_AXIS ldtvr_w tv_sw_q0p005 10 -163.8400 163.8350 AXIS_PTS_REF STV10LDSW /end AXIS_DESCR
/end CHARACTERISTIC
/begin CHARACTERISTIC KFLDRQ0 "LDR-Regelparameter Q0" MAP 0x81F916 GkfWUw 3276.750 rel_uw_b3276p75 0.00 3276.750 FORMAT "%8.3"
 /begin AXIS_DESCR COM_AXIS nmot nmot_ub_q40 16 0.00 10200. AXIS_PTS_REF SNM16LDUB /end AXIS_DESCR
 /begin AXIS_DESCR COM_AXIS lde p_sb_q10 4 0.00 2550. AXIS_PTS_REF SLD04LDUB /end AXIS_DESCR
/end CHARACTERISTIC
/begin CHARACTERISTIC KFLDRQ1 "LDR-Reglerparameter Q1 (Integratorbeiwert)" MAP 0x81F996 GkfWUw 3276.750 rel_uw_b3276p75 0.00 3276.750 FORMAT "%8.3"
 /begin AXIS_DESCR COM_AXIS nmot nmot_ub_q40 16 0.00 10200. AXIS_PTS_REF SNM16LDUB /end AXIS_DESCR
 /begin AXIS_DESCR COM_AXIS lde p_sb_q10 4 0.00 2550. AXIS_PTS_REF SLD04LDUB /end AXIS_DESCR
/end CHARACTERISTIC
/begin CHARACTERISTIC KFLDRQ2 "Kennfeld LDR-Reglerparameter Q2" MAP 0x81FA16 GkfWUw 3276.750 rel_uw_b3276p75 0.00 3276.750 FORMAT "%8.3"
 /begin AXIS_DESCR COM_AXIS nmot nmot_ub_q40 16 0.00 10200. AXIS_PTS_REF SNM16LDUB /end AXIS_DESCR
 /begin AXIS_DESCR COM_AXIS lde p_sb_q10 4 0.00 2550. AXIS_PTS_REF SLD04LDUB /end AXIS_DESCR
/end CHARACTERISTIC
/begin CHARACTERISTIC KFLDRXO "Delta Füllung (rl) im Overboostbetrieb" MAP 0x819C63 KfAxUbAyUbSstxUbSstyUbWUb 24.75 rel_ub_q0p75 0.00 24.75 FORMAT "%5.2"
 /begin AXIS_DESCR STD_AXIS nmot nmot_ub_q40 8 0.00 10200. FORMAT "%5.0" DEPOSIT ABSOLUTE /end AXIS_DESCR
 /begin AXIS_DESCR STD_AXIS tans temp_ub_q0p75_o48 4 -48.00 143.3 FORMAT "%5.1" DEPOSIT ABSOLUTE /end AXIS_DESCR
/end CHARACTERISTIC
/begin CHARACTERISTIC KFLMSKH_0_A "Kennfeld Lambda-Motor-Soll bei Katheizen" MAP 0x81E742 KfAxUwAyUwSstxUwSstyUwWUw 15.99976 fak_q0p000244 0.00 15.99976 FORMAT "%8.5"
 /begin AXIS_DESCR STD_AXIS nmot_w nmot_uw_q0p25 8 0.00 16383.75 FORMAT "%8.2" DEPOSIT ABSOLUTE /end AXIS_DESCR
 /begin AXIS_DESCR STD_AXIS rl_w rel_uw_q0p0234 8 0.00 1535.977 FORMAT "%8.3" DEPOSIT ABSOLUTE /end AXIS_DESCR
/end CHARACTERISTIC
/begin CHARACTERISTIC KFLMSKH_1_A "Kennfeld Lambda-Motor-Soll bei Katheizen" MAP 0x81E7E6 KfAxUwAyUwSstxUwSstyUwWUw 15.99976 fak_q0p000244 0.00 15.99976 FORMAT "%8.5"
 /begin AXIS_DESCR STD_AXIS nmot_w nmot_uw_q0p25 8 0.00 16383.75 FORMAT "%8.2" DEPOSIT ABSOLUTE /end AXIS_DESCR
 /begin AXIS_DESCR STD_AXIS rl_w rel_uw_q0p0234 8 0.00 1535.977 FORMAT "%8.3" DEPOSIT ABSOLUTE /end AXIS_DESCR
/end CHARACTERISTIC
/begin CHARACTERISTIC KFNL2TUM "Kennfeld Nachlaufzeit bei Nachtriggerung" MAP 0x828EF4 KfAxUwAyUwSstxUwSstyUwWUw 65535.00 t1sxs_uw_b65535 0.00 65535.00 FORMAT "%8.2"
 /begin AXIS_DESCR STD_AXIS tmotkmtr temp_ub_q0p75_o48 5 -48.00000 49103.25 FORMAT "%8.2" DEPOSIT ABSOLUTE /end AXIS_DESCR
 /begin AXIS_DESCR STD_AXIS tumgkmtr temp_ub_q0p75_o48 5 -48.00000 49103.25 FORMAT "%8.2" DEPOSIT ABSOLUTE /end AXIS_DESCR
/end CHARACTERISTIC
/begin CHARACTERISTIC KFNLTKV "Kennfeld Nachlaufzeit" MAP 0x828F3E KfAxUwAyUwSstxUwSstyUwWUw 65535.00 t1sxs_uw_b65535 0.00 65535.00 FORMAT "%8.2"
 /begin AXIS_DESCR STD_AXIS tmotkmtr temp_ub_q0p75_o48 5 -48.00000 49103.25 FORMAT "%8.2" DEPOSIT ABSOLUTE /end AXIS_DESCR
 /begin AXIS_DESCR STD_AXIS vsksmlf_w volgrd_q5p96Em4 5 0.00 39.06190 FORMAT "%8.5" DEPOSIT ABSOLUTE /end AXIS_DESCR
/end CHARACTERISTIC
/begin CHARACTERISTIC KFNLTUM "Kennfeld Nachlaufzeit aus TUM / TMOT" MAP 0x828F88 KfAxUwAyUwSstxUwSstyUwWUw 65535.00 t1sxs_uw_b65535 0.00 65535.00 FORMAT "%8.2"
 /begin AXIS_DESCR STD_AXIS tmotkmtr temp_ub_q0p75_o48 5 -48.00000 49103.25 FORMAT "%8.2" DEPOSIT ABSOLUTE /end AXIS_DESCR
 /begin AXIS_DESCR STD_AXIS tumgkmtr temp_ub_q0p75_o48 5 -48.00000 49103.25 FORMAT "%8.2" DEPOSIT ABSOLUTE /end AXIS_DESCR
/end CHARACTERISTIC
/begin CHARACTERISTIC KFQNVP1 "Benötigter Volumenstrom dürch den Kühler, Lüfter 1" MAP 0x81AA1E KfAxUbAyUbSstxUbSstyUbWUb 1020. m_ub_b1020 0.00 1020. FORMAT "%5.0"
 /begin AXIS_DESCR STD_AXIS qmaxl1 temp_ub_q0p75_o48 6 -48.00 143.3 FORMAT "%5.1" DEPOSIT ABSOLUTE /end AXIS_DESCR
 /begin AXIS_DESCR STD_AXIS nmot nmot_ub_q40 6 0.00 10200. FORMAT "%5.0" DEPOSIT ABSOLUTE /end AXIS_DESCR
/end CHARACTERISTIC
/begin CHARACTERISTIC KFQNVP2 "Benötigter Volumenstrom dürch den Kühler, Lüfter 2" MAP 0x81AA50 KfAxUbAyUbSstxUbSstyUbWUb 1020. m_ub_b1020 0.00 1020. FORMAT "%5.0"
 /begin AXIS_DESCR STD_AXIS qmaxl2 temp_ub_q0p75_o48 6 -48.00 143.3 FORMAT "%5.1" DEPOSIT ABSOLUTE /end AXIS_DESCR
 /begin AXIS_DESCR STD_AXIS nmot nmot_ub_q40 6 0.00 10200. FORMAT "%5.0" DEPOSIT ABSOLUTE /end AXIS_DESCR
/end CHARACTERISTIC
/begin CHARACTERISTIC KFQVAC "Kennfeld Wärmestrom ECC in °C" MAP 0x81AA82 KfAxUbAyUbSstxUbSstyUbWUb 191.3 temp_ub_q0p75_o48 -48.00 143.3 FORMAT "%5.1"
 /begin AXIS_DESCR STD_AXIS tmotkmtr temp_ub_q0p75_o48 5 -48.00 143.3 FORMAT "%5.1" DEPOSIT ABSOLUTE /end AXIS_DESCR
 /begin AXIS_DESCR STD_AXIS tumgkmtr temp_ub_q0p75_o48 5 -48.00 143.3 FORMAT "%5.1" DEPOSIT ABSOLUTE /end AXIS_DESCR
/end CHARACTERISTIC
/begin CHARACTERISTIC KFQVKOM "Kennfeld Wärmestrom erhöhter Kältebedarf" MAP 0x81AAA7 KfAxUbAyUbSstxUbSstyUbWUb 191.3 temp_ub_q0p75_o48 -48.00 143.3 FORMAT "%5.1"
 /begin AXIS_DESCR STD_AXIS tmotkmtr temp_ub_q0p75_o48 5 -48.00 143.3 FORMAT "%5.1" DEPOSIT ABSOLUTE /end AXIS_DESCR
 /begin AXIS_DESCR STD_AXIS tumgkmtr temp_ub_q0p75_o48 5 -48.00 143.3 FORMAT "%5.1" DEPOSIT ABSOLUTE /end AXIS_DESCR
/end CHARACTERISTIC
/begin CHARACTERISTIC KFRBGOF "Offset für I-Anteilbegrenzung LDRPID" MAP 0x81FA96 KfAxUbAyUbSstxSwSstyUbWSw 327.6750 tv_sw_q0p005 -163.8400 163.8350 FORMAT "%8.4"
 /begin AXIS_DESCR STD_AXIS ngfil nmotg_sb_q100 4 -12800.00 12700.00 FORMAT "%8.2" DEPOSIT ABSOLUTE /end AXIS_DESCR
 /begin AXIS_DESCR STD_AXIS nmot nmot_ub_q40 6 0.00 10200. FORMAT "%5.0" DEPOSIT ABSOLUTE /end AXIS_DESCR
/end CHARACTERISTIC
/begin CHARACTERISTIC KFTARX "Kennfeld Maximalfuellung Tans Korrekturfaktor" MAP 0x826C78 GkfWUw 1.999969 fak_uw_b2 0.00 1.999969 FORMAT "%8.6"
 /begin AXIS_DESCR COM_AXIS nmot_w nmot_uw_q0p25 12 0.00 16383.75 AXIS_PTS_REF SNM12LDUW /end AXIS_DESCR
 /begin AXIS_DESCR COM_AXIS tans temp_ub_q0p75_o48 10 -48.00 143.3 AXIS_PTS_REF STA10LDUB /end AXIS_DESCR
/end CHARACTERISTIC
/begin CHARACTERISTIC KFTARXZK "Kennfeld Maximalfuellung Tans Korrekturfaktor bei Dauerklopfen" MAP 0x826D68 GkfWUw 1.999969 fak_uw_b2 0.00 1.999969 FORMAT "%8.6"
 /begin AXIS_DESCR COM_AXIS nmot_w nmot_uw_q0p25 12 0.00 16383.75 AXIS_PTS_REF SNM12LDUW /end AXIS_DESCR
 /begin AXIS_DESCR COM_AXIS tans temp_ub_q0p75_o48 10 -48.00 143.3 AXIS_PTS_REF STA10LDUB /end AXIS_DESCR
/end CHARACTERISTIC
/begin CHARACTERISTIC KFTMOTKR "Kennfeld" MAP 0x828FD2 KfAxUbAyUbSstxUbSstyUwWUb 191.3 temp_ub_q0p75_o48 -48.00 143.3 FORMAT "%5.1"
 /begin AXIS_DESCR STD_AXIS tmotkmtr temp_ub_q0p75_o48 5 -48.00 143.3 FORMAT "%5.1" DEPOSIT ABSOLUTE /end AXIS_DESCR
 /begin AXIS_DESCR STD_AXIS vsksmlf_w volgrd_q5p96Em4 5 0.00 39.06190 FORMAT "%8.5" DEPOSIT ABSOLUTE /end AXIS_DESCR
/end CHARACTERISTIC
/begin CHARACTERISTIC KFTNSTKO "Kennfeld Unterdrückungszeit des Kompressors nach dem Start" MAP 0x828EBC KfAxUbAyUbSstxUwSstyUbWUb 51.00 t200msxs_ub_b51 0.00 51.00 FORMAT "%5.2"
 /begin AXIS_DESCR STD_AXIS fho_w fak_uw_b4 2 0.00 3.999939 FORMAT "%8.6" DEPOSIT ABSOLUTE /end AXIS_DESCR
 /begin AXIS_DESCR STD_AXIS tmst temp_ub_q0p75_o48 2 -48.00 143.3 FORMAT "%5.1" DEPOSIT ABSOLUTE /end AXIS_DESCR
/end CHARACTERISTIC
/begin CHARACTERISTIC KFTVETR "Kennfeld benötigtes Tastverhältnis für ETR" MAP 0x817A94 KfAxUbAyUbSstxSbSstyUbWUb 99.61 tv_ub_b100 0.00 99.61 FORMAT "%5.2"
 /begin AXIS_DESCR STD_AXIS dkmts temp_sb_q0p75 6 -96.00 95.25 FORMAT "%5.2" DEPOSIT ABSOLUTE /end AXIS_DESCR
 /begin AXIS_DESCR STD_AXIS tmotsoll temp_ub_q0p75_o48 6 -48.00 143.3 FORMAT "%5.1" DEPOSIT ABSOLUTE /end AXIS_DESCR
/end CHARACTERISTIC
/begin CHARACTERISTIC KFTVLBTS "Verzögerungszeit Lambdasoll Bauteileschutz f(nmot,rl)" MAP 0x81DC90 KfAxUbAyUbSstxUbSstyUwWUb 25.50 t100msxs_ub_b25p5 0.00 25.50 FORMAT "%5.2"
 /begin AXIS_DESCR STD_AXIS nmot nmot_ub_q40 12 0.00 10200. FORMAT "%5.0" DEPOSIT ABSOLUTE /end AXIS_DESCR
 /begin AXIS_DESCR STD_AXIS rl_w rel_uw_q0p0234 8 0.00 1535.977 FORMAT "%8.3" DEPOSIT ABSOLUTE /end AXIS_DESCR
/end CHARACTERISTIC
/begin CHARACTERISTIC KFTVLDRE "Kennfeld Tastverhältnisersatzwert für LDR" MAP 0x819D1A KfAxUbAyUbSstxUbSstyUbWUb 99.61 tv_ub_b100 0.00 99.61 FORMAT "%5.2"
 /begin AXIS_DESCR STD_AXIS nmot nmot_ub_q40 8 0.00 10200. FORMAT "%5.0" DEPOSIT ABSOLUTE /end AXIS_DESCR
 /begin AXIS_DESCR STD_AXIS plsol p_ub_q10 4 0.00 2550. FORMAT "%5.0" DEPOSIT ABSOLUTE /end AXIS_DESCR
/end CHARACTERISTIC
/begin CHARACTERISTIC KFTVLUE1 "Umsetzung Drehzahl in Tastverhältnis Lüfter 1" MAP 0x81AACC KfAxUbAyUbSstxUbSstyUbWUb 99.61 tv_ub_b100 0.00 99.61 FORMAT "%5.2"
 /begin AXIS_DESCR STD_AXIS nluez1 nmot_ub_q20 6 0.00 5100. FORMAT "%5.0" DEPOSIT ABSOLUTE /end AXIS_DESCR
 /begin AXIS_DESCR STD_AXIS nmot nmot_ub_q40 6 0.00 10200. FORMAT "%5.0" DEPOSIT ABSOLUTE /end AXIS_DESCR
/end CHARACTERISTIC
/begin CHARACTERISTIC KFTVLUE2 "Umsetzung Drehzahl in Tastverhältnis Lüfter 2" MAP 0x81AAFE KfAxUbAyUbSstxUbSstyUbWUb 99.61 tv_ub_b100 0.00 99.61 FORMAT "%5.2"
 /begin AXIS_DESCR STD_AXIS nluez2 nmot_ub_q20 6 0.00 5100. FORMAT "%5.0" DEPOSIT ABSOLUTE /end AXIS_DESCR
 /begin AXIS_DESCR STD_AXIS nmot nmot_ub_q40 6 0.00 10200. FORMAT "%5.0" DEPOSIT ABSOLUTE /end AXIS_DESCR
/end CHARACTERISTIC
/begin CHARACTERISTIC KFVPDKSD "Solldruckverhältnis DK im Dynamikbetrieb" MAP 0x815E5C GkfWUw 1.999969 fak_uw_b2 0.00 1.999969 FORMAT "%8.6"
 /begin AXIS_DESCR COM_AXIS nmot_w nmot_uw_q0p25 12 0.00 16383.75 AXIS_PTS_REF SNM12LDUW /end AXIS_DESCR
 /begin AXIS_DESCR COM_AXIS vpssplg_w fak_uw_b4 12 0.00 3.999939 AXIS_PTS_REF SVP12LDUW /end AXIS_DESCR
/end CHARACTERISTIC
/begin CHARACTERISTIC KFVPDKSE "Solldruckverhältnis DK im Stationärbetrieb" MAP 0x815F7C GkfWUw 1.999969 fak_uw_b2 0.00 1.999969 FORMAT "%8.6"
 /begin AXIS_DESCR COM_AXIS nmot_w nmot_uw_q0p25 12 0.00 16383.75 AXIS_PTS_REF SNM12LDUW /end AXIS_DESCR
 /begin AXIS_DESCR COM_AXIS vpssplg_w fak_uw_b4 12 0.00 3.999939 AXIS_PTS_REF SVP12LDUW /end AXIS_DESCR
/end CHARACTERISTIC
/begin CHARACTERISTIC KFVPNLU1 "Benötigte Lüfterdrehzahl für Lüfter 1" MAP 0x81AB30 KfAxUbAyUbSstxUbSstyUbWUb 5100. nmot_ub_q20 0.00 5100. FORMAT "%5.0"
 /begin AXIS_DESCR STD_AXIS qnvp1 m_ub_b1020 6 0.00 1020. FORMAT "%5.0" DEPOSIT ABSOLUTE /end AXIS_DESCR
 /begin AXIS_DESCR STD_AXIS nmot nmot_ub_q40 6 0.00 10200. FORMAT "%5.0" DEPOSIT ABSOLUTE /end AXIS_DESCR
/end CHARACTERISTIC
/begin CHARACTERISTIC KFVPNLU2 "Benötigte Lüfterdrehzahl für Lüfter 2" MAP 0x81AB62 KfAxUbAyUbSstxUbSstyUbWUb 5100. nmot_ub_q20 0.00 5100. FORMAT "%5.0"
 /begin AXIS_DESCR STD_AXIS qnvp2 m_ub_b1020 6 0.00 1020. FORMAT "%5.0" DEPOSIT ABSOLUTE /end AXIS_DESCR
 /begin AXIS_DESCR STD_AXIS nmot nmot_ub_q40 6 0.00 10200. FORMAT "%5.0" DEPOSIT ABSOLUTE /end AXIS_DESCR
/end CHARACTERISTIC
/begin CHARACTERISTIC KLAH1 "Kühlleistungsanhebung Stufe 1" VALUE 0x81AB94 KwUb 191.3 temp_ub_q0p75_o48 -48.00 143.3 FORMAT "%5.1" /end CHARACTERISTIC
/begin CHARACTERISTIC KLAH2 "Kühlleistungsanhebung Stufe 2" VALUE 0x81AB95 KwUb 191.3 temp_ub_q0p75_o48 -48.00 143.3 FORMAT "%5.1" /end CHARACTERISTIC
/begin CHARACTERISTIC KLAHEW "Ersatzwert Kühlleistungsanhebung" VALUE 0x81AB96 KwUb 255.0 dez 0.00 255.0 FORMAT "%5.1" /end CHARACTERISTIC
/begin CHARACTERISTIC KLAHTMSMX1 "Kühlleistungsanhebung bei 1.  max. Motorsolltemperatur" VALUE 0x81AB97 KwUb 191.3 temp_ub_q0p75_o48 -48.00 143.3 FORMAT "%5.1" /end CHARACTERISTIC
/begin CHARACTERISTIC KLAHTMSMX2 "Kühlleistungsanhebung bei 2. max. Motorsolltemperatur" VALUE 0x81AB98 KwUb 191.3 temp_ub_q0p75_o48 -48.00 143.3 FORMAT "%5.1" /end CHARACTERISTIC
/begin CHARACTERISTIC KLAHTVLUE1 "Tastverhältnis Lüfteransteuerung 1 bei max. Kühlleistungsanhebung" VALUE 0x81AB99 KwUb 99.61 rel_ub_b100 0.00 99.61 FORMAT "%5.2" /end CHARACTERISTIC
/begin CHARACTERISTIC KLAHTVLUE2 "Tastverhältnis Lüfteransteuerung 2 bei max. Kühlleistungsanhebung" VALUE 0x81AB9A KwUb 99.61 rel_ub_b100 0.00 99.61 FORMAT "%5.2" /end CHARACTERISTIC
/begin CHARACTERISTIC KLANFVFZ "Korrekturkennlinie Lüfteransteuerung in Abhängigkeit  vom Anfahrverhalten" CURVE 0x81AB9B KlAUbSstUbWUb 0.9961 fak_ub_b1 0.00 0.9961
 /begin AXIS_DESCR STD_AXIS vfzgkmtr vfzg_ub_q1p25 5 0.00 318.8 FORMAT "%5.1" DEPOSIT ABSOLUTE /end AXIS_DESCR
/end CHARACTERISTIC
/begin CHARACTERISTIC KLFDQV "Geschwindigkeitsabhängiger Absteuerfaktor des Wärmeüberschusses" CURVE 0x81ABA6 KlAUbSstUbWUb 0.9961 fak_ub_b1 0.00 0.9961
 /begin AXIS_DESCR STD_AXIS vfzgkmtr vfzg_ub_q1p25 4 0.00 318.8 FORMAT "%5.1" DEPOSIT ABSOLUTE /end AXIS_DESCR
/end CHARACTERISTIC
/begin CHARACTERISTIC KLFQKV "Geschwindigkeitsabhängiger Absteuerfaktor des Wärmestroms Klimakondensator" CURVE 0x81ABAF KlAUbSstUbWUb 0.9961 fak_ub_b1 0.00 0.9961
 /begin AXIS_DESCR STD_AXIS vfzgkmtr vfzg_ub_q1p25 4 0.00 318.8 FORMAT "%5.1" DEPOSIT ABSOLUTE /end AXIS_DESCR
/end CHARACTERISTIC
/begin CHARACTERISTIC KLLAKHFH "Umgebungsdruckkorrektur Lambda Katheizen" CURVE 0x81E88A KlAUwSstUwWUw 1.999969 fak_uw_b2 0.00 1.999969 FORMAT "%8.6"
 /begin AXIS_DESCR STD_AXIS fho_w fak_uw_b4 4 0.00 3.999939 FORMAT "%8.6" DEPOSIT ABSOLUTE /end AXIS_DESCR
/end CHARACTERISTIC
/begin CHARACTERISTIC KLLUESIC "Umrechnung Tastverhältnis Lüfteransteuerung in Istzustand Lüftersteuerung" CURVE 0x81ABB8 KlAUbSstUbWUb 99.61 tv_ub_b100 0.00 99.61 FORMAT "%5.2"
 /begin AXIS_DESCR STD_AXIS tvluesicb tv_ub_b100 8 0.00 99.61 FORMAT "%5.2" DEPOSIT ABSOLUTE /end AXIS_DESCR
/end CHARACTERISTIC
/begin CHARACTERISTIC KLMLFT "Umrechnung Tastverhältnis Lüfteransteuerung in abzuführende Wärmemenge" CURVE 0x81ABC9 KlAUbSstUbWUb 191.3 temp_ub_q0p75_o48 -48.00 143.3 FORMAT "%5.1"
 /begin AXIS_DESCR STD_AXIS tvlueskmtr tv_ub_b100 5 0.00 99.61 FORMAT "%5.2" DEPOSIT ABSOLUTE /end AXIS_DESCR
/end CHARACTERISTIC
/begin CHARACTERISTIC KLNLOEL "Nachlaufzeitanforderung in Abhängigkreit der Öltemperatur" CURVE 0x828FFE KlAUwSstUwWUw 65535.00 t1sxs_uw_b65535 0.00 65535.00 FORMAT "%8.2"
 /begin AXIS_DESCR STD_AXIS toelkmtr temp_ub_q1_o60 6 -60.00000 65475.00 FORMAT "%8.2" DEPOSIT ABSOLUTE /end AXIS_DESCR
/end CHARACTERISTIC
/begin CHARACTERISTIC KLNLSTP "Abbruchbedingung Nachlaufzeit abhängig von Umgebungstemp." CURVE 0x81ABD4 KlAUbSstUbWUb 191.3 temp_ub_q0p75_o48 -48.00 143.3 FORMAT "%5.1"
 /begin AXIS_DESCR STD_AXIS tmotnl2 temp_ub_q0p75_o48 6 -48.00 143.3 FORMAT "%5.1" DEPOSIT ABSOLUTE /end AXIS_DESCR
/end CHARACTERISTIC
/begin CHARACTERISTIC KLNLTUM "Korrektrufaktor Nachlaufzeit über Umgebungstemperatur" CURVE 0x81ABE1 KlAUbSstUbWUb 0.9961 fak_ub_b1 0.00 0.9961
 /begin AXIS_DESCR STD_AXIS tumgkmtr temp_ub_q0p75_o48 4 -48.00 143.3 FORMAT "%5.1" DEPOSIT ABSOLUTE /end AXIS_DESCR
/end CHARACTERISTIC
/begin CHARACTERISTIC KLQKLIMA "Abzuführende Wärme f. Klimakondensator" CURVE 0x81ABEA KlAUbSstUbWUb 191.3 temp_ub_q0p75_o48 -48.00 143.3 FORMAT "%5.1"
 /begin AXIS_DESCR STD_AXIS pklimakmtr p_q0p2 5 0.00 51.00 FORMAT "%5.2" DEPOSIT ABSOLUTE /end AXIS_DESCR
/end CHARACTERISTIC
/begin CHARACTERISTIC KLQVHDS "Klimahochdruckanforderung in Abhängigkeit der Umgebungstemperatur" CURVE 0x81ABF5 KlAUbSstUbWUb 191.3 temp_ub_q0p75_o48 -48.00 143.3 FORMAT "%5.1"
 /begin AXIS_DESCR STD_AXIS tumgkmtr temp_ub_q0p75_o48 6 -48.00 143.3 FORMAT "%5.1" DEPOSIT ABSOLUTE /end AXIS_DESCR
/end CHARACTERISTIC
/begin CHARACTERISTIC KLSZKLAMFA "Schwelle für Zeitkonstante bei Filterung Anfettung auf Fahrerwunsch" CURVE 0x81DAEC GklWUw 15.99976 fak_uw_b16 0.00 15.99976 FORMAT "%8.5"
 /begin AXIS_DESCR COM_AXIS nmot nmot_ub_q40 6 0.00 10200. AXIS_PTS_REF SNM06GKUB /end AXIS_DESCR
/end CHARACTERISTIC
/begin CHARACTERISTIC KLTLAFA "Verzögerungszeit bis Lambda Fahrerwunsch aktiv" CURVE 0x81921D GklWUb 25.50 t100msxs_ub_b25p5 0.00 25.50 FORMAT "%5.2"
 /begin AXIS_DESCR COM_AXIS nmot nmot_ub_q40 6 0.00 10200. AXIS_PTS_REF SNM06GKUB /end AXIS_DESCR
/end CHARACTERISTIC
/begin CHARACTERISTIC KLTLAFAKR "Verzögerungszeit Lambda Fahrerwunsch bei Zündwinkelspätverst." CURVE 0x819223 GklWUb 25.50 t100msxs_ub_b25p5 0.00 25.50 FORMAT "%5.2"
 /begin AXIS_DESCR COM_AXIS nmot nmot_ub_q40 6 0.00 10200. AXIS_PTS_REF SNM06GKUB /end AXIS_DESCR
/end CHARACTERISTIC
/begin CHARACTERISTIC KLTMSKR "Kennfeld Motor-Soll-Temperatur in Abh. von der KR-Spätverstellung" CURVE 0x81AC02 KlAUbSstUbWUb 191.3 temp_ub_q0p75_o48 -48.00 143.3 FORMAT "%5.1"
 /begin AXIS_DESCR STD_AXIS krtmso zw_ub_qn0p75 4 -191.3 0.00 FORMAT "%5.1" DEPOSIT ABSOLUTE /end AXIS_DESCR
/end CHARACTERISTIC
/begin CHARACTERISTIC KLTVLU1EW "Ersatzwert Tastverhältnis Lüfter 1 geschwindigkeitsabhängig" CURVE 0x81AC0B KlAUbSstUbWUb 99.61 tv_ub_b100 0.00 99.61 FORMAT "%5.2"
 /begin AXIS_DESCR STD_AXIS vfzgkmtr vfzg_ub_q1p25 4 0.00 318.8 FORMAT "%5.1" DEPOSIT ABSOLUTE /end AXIS_DESCR
/end CHARACTERISTIC
/begin CHARACTERISTIC KLTVLU2EW "Ersatzwert Tastverhältnis Lüfter 2 geschwindigkeitsabhängig" CURVE 0x81AC14 KlAUbSstUbWUb 99.61 tv_ub_b100 0.00 99.61 FORMAT "%5.2"
 /begin AXIS_DESCR STD_AXIS vfzgkmtr vfzg_ub_q1p25 4 0.00 318.8 FORMAT "%5.1" DEPOSIT ABSOLUTE /end AXIS_DESCR
/end CHARACTERISTIC
/begin CHARACTERISTIC KLWLAFWL_0_A "Wichtungskennlinie Offset Lambda Motor soll" CURVE 0x819229 GklWUb 1.992 fak_ub_b2 0.00 1.992 FORMAT "%5.3"
 /begin AXIS_DESCR COM_AXIS nmot nmot_ub_q40 6 0.00 10200. AXIS_PTS_REF SNM06GKUB /end AXIS_DESCR
/end CHARACTERISTIC
/begin CHARACTERISTIC KLWLAFWL_1_A "Wichtungskennlinie Offset Lambda Motor soll" CURVE 0x81922F GklWUb 1.992 fak_ub_b2 0.00 1.992 FORMAT "%5.3"
 /begin AXIS_DESCR COM_AXIS nmot nmot_ub_q40 6 0.00 10200. AXIS_PTS_REF SNM06GKUB /end AXIS_DESCR
/end CHARACTERISTIC
/begin CHARACTERISTIC KLZKLAMFAW "Zeitkonstante Filterung Anfettung durch Fahrerwunsch" CURVE 0x81DAF8 GklWUw 3276.7499992 zk50msxs_uw_b3276p8 0.050000762951 3276.8000000 FORMAT "%12.7"
 /begin AXIS_DESCR COM_AXIS nmot nmot_ub_q40 6 0.00 10200. AXIS_PTS_REF SNM06GKUB /end AXIS_DESCR
/end CHARACTERISTIC
/begin CHARACTERISTIC KRAL1N "Klopfregeladaption Lastbereich 1" CURVE 0x819975 GklWUb 191.3 rel_ub_q0p75 0.00 191.3 FORMAT "%5.1"
 /begin AXIS_DESCR COM_AXIS nmot nmot_ub_q40 16 0.00 10200. AXIS_PTS_REF SNM16KRUB /end AXIS_DESCR
/end CHARACTERISTIC
/begin CHARACTERISTIC KRAL2N "Klopfregeladaption Lastbereich 2" CURVE 0x819985 GklWUb 191.3 rel_ub_q0p75 0.00 191.3 FORMAT "%5.1"
 /begin AXIS_DESCR COM_AXIS nmot nmot_ub_q40 16 0.00 10200. AXIS_PTS_REF SNM16KRUB /end AXIS_DESCR
/end CHARACTERISTIC
/begin CHARACTERISTIC KRAL3N "Klopfregeladaption Lastbereich 3" CURVE 0x819995 GklWUb 191.3 rel_ub_q0p75 0.00 191.3 FORMAT "%5.1"
 /begin AXIS_DESCR COM_AXIS nmot nmot_ub_q40 16 0.00 10200. AXIS_PTS_REF SNM16KRUB /end AXIS_DESCR
/end CHARACTERISTIC
/begin CHARACTERISTIC KRALH "Klopfregeladaption Lasthysterese" VALUE 0x8199A5 KwUb 191.3 rel_ub_q0p75 0.00 191.3 FORMAT "%5.1" /end CHARACTERISTIC
/begin CHARACTERISTIC KRAN1_0_A "Klopfregeladaption Drehzahlbereich, Stützstelle 1" VALUE 0x81E8B0 KwUb 10200. nmot_ub_q40 0.00 10200. FORMAT "%5.0" /end CHARACTERISTIC
/begin CHARACTERISTIC KRAN1_1_A "Klopfregeladaption Drehzahlbereich, Stützstelle 1" VALUE 0x81E8B1 KwUb 10200. nmot_ub_q40 0.00 10200. FORMAT "%5.0" /end CHARACTERISTIC
/begin CHARACTERISTIC KRAN2 "Klopfregeladaption Drehzahlbereich, Stützstelle 2" VALUE 0x8199A6 KwUb 10200. nmot_ub_q40 0.00 10200. FORMAT "%5.0" /end CHARACTERISTIC
/begin CHARACTERISTIC KRAN3 "Klopfregeladaption Drehzahlbereich, Stützstelle 3" VALUE 0x8199A7 KwUb 10200. nmot_ub_q40 0.00 10200. FORMAT "%5.0" /end CHARACTERISTIC
/begin CHARACTERISTIC KRAN4 "Klopfregeladaption Drehzahlbereich, Stützstelle 4" VALUE 0x8199A8 KwUb 10200. nmot_ub_q40 0.00 10200. FORMAT "%5.0" /end CHARACTERISTIC
/begin CHARACTERISTIC KRANH "Klopfregeladaption Drehzahlhysterese" VALUE 0x8199A9 KwUb 10200. nmot_ub_q40 0.00 10200. FORMAT "%5.0" /end CHARACTERISTIC
/begin CHARACTERISTIC KRDWA "Klopfregelung Differenz aktueller ZW zu Adaptionskennfeld" VALUE 0x811551 KwUb 191.3 zw_ub_q0p75 0.00 191.3 FORMAT "%5.1" /end CHARACTERISTIC
/begin CHARACTERISTIC KRDWAA "zulässiger ZW-Sprung nach früh bei Auslesen Adaptionswerte" VALUE 0x811552 KwUb 191.3 zw_ub_qn0p75 -191.3 0.00 FORMAT "%5.1" /end CHARACTERISTIC
/begin CHARACTERISTIC KRDWKLA "Der SV-Lernbetrag für die KR-Adaption nach einem erkannten Klopfereignis" VALUE 0x811553 KwUb 6.000 zw_ub_qn0p75 -6.000 0.00 FORMAT "%5.3" /end CHARACTERISTIC
/begin CHARACTERISTIC KRDWSA "Der FV-Lernbetrag für die KR-Adaption wenn wkra-wkr > KRDWA" VALUE 0x811554 KwUb 6.000 zw_ub_q0p75 0.00 6.000 FORMAT "%5.3" /end CHARACTERISTIC
/begin CHARACTERISTIC KRDWSN "Klopfregelung delta - Winkel Sicherheit" CURVE 0x8199AA GklWUb 191.3 zw_ub_qn0p75 -191.3 0.00 FORMAT "%5.1"
 /begin AXIS_DESCR COM_AXIS nmot nmot_ub_q40 16 0.00 10200. AXIS_PTS_REF SNM16KRUB /end AXIS_DESCR
/end CHARACTERISTIC
/begin CHARACTERISTIC KRFKLN "Spätverstellung pro Klopfereignis bei langsamer Frühverstellung" CURVE 0x8199BA GklWUb 191.3 zw_ub_qn0p75 -191.3 0.00 FORMAT "%5.1"
 /begin AXIS_DESCR COM_AXIS nmot nmot_ub_q40 16 0.00 10200. AXIS_PTS_REF SNM16KRUB /end AXIS_DESCR
/end CHARACTERISTIC
/begin CHARACTERISTIC KRFKN "Spätverstellung pro Klopfereignis" CURVE 0x8199CA GklWUb 191.3 zw_ub_qn0p75 -191.3 0.00 FORMAT "%5.1"
 /begin AXIS_DESCR COM_AXIS nmot nmot_ub_q40 16 0.00 10200. AXIS_PTS_REF SNM16KRUB /end AXIS_DESCR
/end CHARACTERISTIC
/begin CHARACTERISTIC KRFTP1 "Tiefpassverhalten normal" VALUE 0x811543 KwUb 24.00 dez 8.000 32.00 FORMAT "%5.2" /end CHARACTERISTIC
/begin CHARACTERISTIC KRFTP2 "Tiefpassverhalten bei Drehzahldynamik" VALUE 0x811544 KwUb 14.00 dez 2.000 16.00 FORMAT "%5.2" /end CHARACTERISTIC
/begin CHARACTERISTIC KRFTP3 "Tiefpassverhalten bei Lastdynamik" VALUE 0x811545 KwUb 14.00 dez 2.000 16.00 FORMAT "%5.2" /end CHARACTERISTIC
/begin CHARACTERISTIC KRKFKS "Zuordnung der Kloperkennungskennlinie bei fehlender Zyl.-1-Erkennung" VALUE 0x811546 KwUb 255.0 dez 0.00 255.0 FORMAT "%5.1" /end CHARACTERISTIC
/begin CHARACTERISTIC KRLVFN "Anz. Zünd./Zyl., Zeitangabe von Frühverst. zu Frühverst. (langsame Frühverst.)" CURVE 0x8199DA GklWUb 254.0 dez 1.000 255.0 FORMAT "%5.1"
 /begin AXIS_DESCR COM_AXIS nmot nmot_ub_q40 16 0.00 10200. AXIS_PTS_REF SNM16KRUB /end AXIS_DESCR
/end CHARACTERISTIC
/begin CHARACTERISTIC KRMXN "maximale Spätverstellung" CURVE 0x8199EA GklWUb 190.5 zw_ub_qn0p75 -191.3 -0.7500 FORMAT "%5.1"
 /begin AXIS_DESCR COM_AXIS nmot nmot_ub_q40 16 0.00 10200. AXIS_PTS_REF SNM16KRUB /end AXIS_DESCR
/end CHARACTERISTIC
/begin CHARACTERISTIC KRNLZ "Drehzahlschwelle, oberhalb der Führung durch Leitzylinder aktiv ist" VAL_BLK 0x8199FA KwbUb 10200. nmot_ub_q40 0.00 10200. FORMAT "%5.0" NUMBER 8 /end CHARACTERISTIC
/begin CHARACTERISTIC KRVFN "Anz. Zünd./Zyl., bzw. Zeitangabe von Frühverst. zu Frühverst. (Stufenbreite-KR)" CURVE 0x819A02 GklWUb 254.0 dez 1.000 255.0 FORMAT "%5.1"
 /begin AXIS_DESCR COM_AXIS nmot nmot_ub_q40 16 0.00 10200. AXIS_PTS_REF SNM16KRUB /end AXIS_DESCR
/end CHARACTERISTIC
/begin CHARACTERISTIC KRVFSN "Anzahl Zündungen/Zyl., oder Zeitangabe für schnelle Frühverstellung der KR" CURVE 0x819A12 GklWUb 254.0 dez 1.000 255.0 FORMAT "%5.1"
 /begin AXIS_DESCR COM_AXIS nmot nmot_ub_q40 16 0.00 10200. AXIS_PTS_REF SNM16KRUB /end AXIS_DESCR
/end CHARACTERISTIC
/begin CHARACTERISTIC KRVST "Verstärkung nach Start" VALUE 0x811547 KwUb 6.000 dez 0.00 6.000 FORMAT "%5.3" /end CHARACTERISTIC
/begin CHARACTERISTIC KRWKRAIN "Initialisierungswert für Adaptionswerte" VALUE 0x811555 KwUb 191.3 zw_ub_qn0p75 -191.3 0.00 FORMAT "%5.1" /end CHARACTERISTIC
/begin CHARACTERISTIC KSZA "Anzahl Klopfsensoren" VALUE 0x811548 KwUb 3.000 dez 1.000 4.000 FORMAT "%5.3" /end CHARACTERISTIC
/begin CHARACTERISTIC KVB "Konstante für Verbrauchsanzeige" VALUE 0x81A952 KwUb 777.0 m_ub_b780 0.00 777.0 FORMAT "%5.1" /end CHARACTERISTIC
/begin CHARACTERISTIC LAMFA "Lambda Fahrerwunsch" MAP 0x81DB04 KfAxUbAyUbSstxUbSstyUwWUb 1.992 fak_ub_b2 0.00 1.992 FORMAT "%5.3"
 /begin AXIS_DESCR STD_AXIS nmot nmot_ub_q40 15 0.00 10200. FORMAT "%5.0" DEPOSIT ABSOLUTE /end AXIS_DESCR
 /begin AXIS_DESCR STD_AXIS mrfa_w rel_uw_b200 6 0.00 199.9969 FORMAT "%8.4" DEPOSIT ABSOLUTE /end AXIS_DESCR
/end CHARACTERISTIC
/begin CHARACTERISTIC LAMFLGSL "Lambda Motorlaufgrenze  fett bei Sekundärlufteinblasung" CURVE 0x818F64 KlAUbSstUbWUb 1.992 fak_ub_b2 0.00 1.992 FORMAT "%5.3"
 /begin AXIS_DESCR STD_AXIS imlatm m_ub_b23p3 6 0.00 23.21 FORMAT "%5.2" DEPOSIT ABSOLUTE /end AXIS_DESCR
/end CHARACTERISTIC
/begin CHARACTERISTIC LAMLGFKT "Laufgrenze ""fett"" im Kurz Test" VALUE 0x818F71 KwUb 1.992 fak_ub_b2 0.00 1.992 FORMAT "%5.3" /end CHARACTERISTIC
/begin CHARACTERISTIC LAMLGFTM "Lambda Motorlaufgrenze fett" CURVE 0x818F72 GklWUb 1.992 fak_ub_b2 0.00 1.992 FORMAT "%5.3"
 /begin AXIS_DESCR COM_AXIS tmot temp_ub_q0p75_o48 12 -48.00 143.3 AXIS_PTS_REF STM12ESUB /end AXIS_DESCR
/end CHARACTERISTIC
/begin CHARACTERISTIC LAMLGMKT "Laufgrenze ""mager"" im Kurz Test" VALUE 0x818F7E KwUb 1.992 fak_ub_b2 0.00 1.992 FORMAT "%5.3" /end CHARACTERISTIC
/begin CHARACTERISTIC LAMLGMTM "Laufgrenze ""mager""" CURVE 0x818F7F GklWUb 1.992 fak_ub_b2 0.00 1.992 FORMAT "%5.3"
 /begin AXIS_DESCR COM_AXIS tmot temp_ub_q0p75_o48 12 -48.00 143.3 AXIS_PTS_REF STM12ESUB /end AXIS_DESCR
/end CHARACTERISTIC
/begin CHARACTERISTIC LAMRLMN "Lambdavorsteuerung bei rl < RLLAMMN zur Verbesserung der Brennbarkeit" VALUE 0x819235 KwUb 1.992 fak_ub_b2 0.00 1.992 FORMAT "%5.3" /end CHARACTERISTIC
/begin CHARACTERISTIC LAMSOSOF "Lambdasonde Soll Obergrenze für 1.0-Fenster" VALUE 0x813FE6 KwUw 15.99976 fak_uw_b16 0.00 15.99976 FORMAT "%8.5" /end CHARACTERISTIC
/begin CHARACTERISTIC LAMSOSUF "Lambdasonde Soll Untergrenze für 1.0-Fenster" VALUE 0x813FE8 KwUw 15.99976 fak_uw_b16 0.00 15.99976 FORMAT "%8.5" /end CHARACTERISTIC
/begin CHARACTERISTIC LASDSLA "Lambda-Abgas-Soll bei Sekundärluftadaption/Kurztest" CURVE 0x81E89C KlAUwSstUwWUw 15.99976 fak_q0p000244 0.00 15.99976 FORMAT "%8.5"
 /begin AXIS_DESCR STD_AXIS ml_w m_uw_b6553p5 4 0.00 6553.500 FORMAT "%8.3" DEPOSIT ABSOLUTE /end AXIS_DESCR
/end CHARACTERISTIC
/begin CHARACTERISTIC LASOAB "Lambdasollwert bei Bankabschaltung" VALUE 0x8110A5 KwUb 1.992 fak_ub_b2 0.00 1.992 FORMAT "%5.3" /end CHARACTERISTIC
/begin CHARACTERISTIC LASTMOT "Motortemp.-Korrektur von Lambda-Abgas-Soll" CURVE 0x819749 KlAUbSstUbWUb 1.992 fak_ub_b2 0.00 1.992 FORMAT "%5.3"
 /begin AXIS_DESCR STD_AXIS tmot temp_ub_q0p75_o48 4 -48.00 143.3 FORMAT "%5.1" DEPOSIT ABSOLUTE /end AXIS_DESCR
/end CHARACTERISTIC
/begin CHARACTERISTIC LASWLTM_0_A "Offset Lambda-Motor-Soll bei inaktiver Lambdaregelung" CURVE 0x8190FD GklWSb 1.992 fak_sb_b1 -1.000 0.9922 FORMAT "%5.3"
 /begin AXIS_DESCR COM_AXIS tmot temp_ub_q0p75_o48 12 -48.00 143.3 AXIS_PTS_REF STM12ESUB /end AXIS_DESCR
/end CHARACTERISTIC
/begin CHARACTERISTIC LASWLTM_1_A "Offset Lambda-Motor-Soll bei inaktiver Lambdaregelung" CURVE 0x819109 GklWSb 1.992 fak_sb_b1 -1.000 0.9922 FORMAT "%5.3"
 /begin AXIS_DESCR COM_AXIS tmot temp_ub_q0p75_o48 12 -48.00 143.3 AXIS_PTS_REF STM12ESUB /end AXIS_DESCR
/end CHARACTERISTIC
/begin CHARACTERISTIC LDAMN "Minimalwertbegrenzung der Adaption LDR I-Adaption" VALUE 0x81FAD6 KwSw 327.6750 tv_sw_q0p005 -163.8400 163.8350 FORMAT "%8.4" /end CHARACTERISTIC
/begin CHARACTERISTIC LDDIAN "Schrittweite pro Programmdurchlauf für negativ-Nachführung I-Begrenzung" VALUE 0x81FAD8 KwSw 327.6750 tv_sw_q0p005 -163.8400 163.8350 FORMAT "%8.4" /end CHARACTERISTIC
/begin CHARACTERISTIC LDDIAP "Schrittweite pro Programmdurchlauf für positiv-Nachführung I-Begrenzung" VALUE 0x81FADA KwSw 327.6750 tv_sw_q0p005 -163.8400 163.8350 FORMAT "%8.4" /end CHARACTERISTIC
/begin CHARACTERISTIC LDDIMNN "Sicherheitsabstand LDR I-Regler Begrenzung negativ" CURVE 0x81FADC GklWSw 327.6750 tv_sw_q0p005 -163.8400 163.8350 FORMAT "%8.4"
 /begin AXIS_DESCR COM_AXIS nmot_w nmot_uw_q0p25 8 0.00 16383.75 AXIS_PTS_REF SNM08LDUW /end AXIS_DESCR
/end CHARACTERISTIC
/begin CHARACTERISTIC LDDIMXN "Sicherheitsabstand LDR I-Regler Begrenzung" CURVE 0x81FAEC GklWSw 327.6750 tv_sw_q0p005 -163.8400 163.8350 FORMAT "%8.4"
 /begin AXIS_DESCR COM_AXIS nmot_w nmot_uw_q0p25 8 0.00 16383.75 AXIS_PTS_REF SNM08LDUW /end AXIS_DESCR
/end CHARACTERISTIC
/begin CHARACTERISTIC LDEIAO "Obere Regelabweichungsschwelle für Negativ-Verstellung" VALUE 0x819C3D KwSb 2550. p_sb_q10 -1280. 1270. FORMAT "%5.0" /end CHARACTERISTIC
/begin CHARACTERISTIC LDEIAP "Regelabweichungsschwelle für  Positiv Adaption I-Regler" VALUE 0x819C3E KwSb 2550. p_sb_q10 -1280. 1270. FORMAT "%5.0" /end CHARACTERISTIC
/begin CHARACTERISTIC LDEIAPS "Regelabweichungsschwelle für schnelle Positiv-Nachführung" VALUE 0x819C3F KwSb 2550. p_sb_q10 -1280. 1270. FORMAT "%5.0" /end CHARACTERISTIC
/begin CHARACTERISTIC LDEIAU "Untere Regelabweichungsschwelle für Negativ-Verstellung" VALUE 0x819C40 KwSb 2550. p_sb_q10 -1280. 1270. FORMAT "%5.0" /end CHARACTERISTIC
/begin CHARACTERISTIC LDHIA "Hysterese für LDR I-Adaptionskennlinie" VALUE 0x819C41 KwUb 10200. nmot_ub_q40 0.00 10200. FORMAT "%5.0" /end CHARACTERISTIC
/begin CHARACTERISTIC LDIATA "Korrektur I-Begrenzung LDR PID Rgler als Funktion von Tans" CURVE 0x819C42 GklWSb 163.2 tv_ub_q0p64 -81.92 81.28 FORMAT "%5.2"
 /begin AXIS_DESCR COM_AXIS tans temp_ub_q0p75_o48 8 -48.00 143.3 AXIS_PTS_REF STA08LDUB /end AXIS_DESCR
/end CHARACTERISTIC
/begin CHARACTERISTIC LDMXNN "Begrenzung max. Nachführung LDR negativ für Regleradaption" VALUE 0x81FAFC KwSw 163.8400 tv_sw_q0p005 -163.8400 0.00 FORMAT "%8.4" /end CHARACTERISTIC
/begin CHARACTERISTIC LDMXNP "Begrenzung max. Nachführung LDR Adaption positiv bei Bereichswechsel" VALUE 0x81FAFE KwSw 163.8350 tv_sw_q0p005 0.00 163.8350 FORMAT "%8.4" /end CHARACTERISTIC
/begin CHARACTERISTIC LDORXN "Maximalfuellung LDR bei E_ldo (Überladefehler)" CURVE 0x819CAC GklWUb 191.3 rel_ub_q0p75 0.00 191.3 FORMAT "%5.1"
 /begin AXIS_DESCR COM_AXIS nmot nmot_ub_q40 8 0.00 10200. AXIS_PTS_REF SNM08LDUB /end AXIS_DESCR
/end CHARACTERISTIC
/begin CHARACTERISTIC LDPBN "LDR p-Begrenzung bei zu hoher Motortemperatur" CURVE 0x819CB4 GklWUb 2550. p_ub_q10 0.00 2550. FORMAT "%5.0"
 /begin AXIS_DESCR COM_AXIS nmot nmot_ub_q40 8 0.00 10200. AXIS_PTS_REF SNM08LDUB /end AXIS_DESCR
/end CHARACTERISTIC
/begin CHARACTERISTIC LDRAPP "Festwert für LDR-Applikation ohne Md-Koordination" VALUE 0x819D48 KwUb 99.61 tv_ub_b100 0.00 99.61 FORMAT "%5.2" /end CHARACTERISTIC
/begin CHARACTERISTIC LDRPBU "P-Regler Kennwert LDR back up Regler" VALUE 0x819D49 KwUb 0.2621 tv_q0p001028 0.00 0.2621 /end CHARACTERISTIC
/begin CHARACTERISTIC LDRQ0S "Reglerparameter Q0 LDR-PID Regler im Stationärbetrieb" VALUE 0x81FB00 KwUw 3276.750 rel_uw_b3276p75 0.00 3276.750 FORMAT "%8.3" /end CHARACTERISTIC
/begin CHARACTERISTIC LDRQ1ST "Reglerparameter Q1 PID-Regler im Stationärbetrieb (Integrationsbeiwert)" CURVE 0x81FB02 GklWUw 3276.750 rel_uw_b3276p75 0.00 3276.750 FORMAT "%8.3"
 /begin AXIS_DESCR COM_AXIS nmot nmot_ub_q40 16 0.00 10200. AXIS_PTS_REF SNM16LDUB /end AXIS_DESCR
/end CHARACTERISTIC
/begin CHARACTERISTIC LDRVL "Vollast Erkennungsschwelle LDR" VALUE 0x819C4A KwUb 99.61 rel_ub_b99p6 0.00 99.61 FORMAT "%5.2" /end CHARACTERISTIC
/begin CHARACTERISTIC LDRXN "Maximalfuellung LDR" CURVE 0x826E58 KlAUbSstUwWUw 1535.977 rel_uw_q0p0234 0.00 1535.977 FORMAT "%8.3"
 /begin AXIS_DESCR STD_AXIS nmot_w nmot_uw_q0p25 16 0.00 16383.75 FORMAT "%8.2" DEPOSIT ABSOLUTE /end AXIS_DESCR
/end CHARACTERISTIC
/begin CHARACTERISTIC LDRXNZK "Maximalfuellung LDR bei Dauerklopfen" CURVE 0x826E9A KlAUbSstUwWUw 1535.977 rel_uw_q0p0234 0.00 1535.977 FORMAT "%8.3"
 /begin AXIS_DESCR STD_AXIS nmot_w nmot_uw_q0p25 16 0.00 16383.75 FORMAT "%8.2" DEPOSIT ABSOLUTE /end AXIS_DESCR
/end CHARACTERISTIC
/begin CHARACTERISTIC LDUVRS "LDR Umluftventilsteuerung Reset vom Sollwert" VALUE 0x815E36 KwUw 2559.961 p_uw_q0p039 0.00 2559.961 FORMAT "%8.3" /end CHARACTERISTIC
/begin CHARACTERISTIC LKRAN "Lastschwelle Klopfregel-Adaption" CURVE 0x819A22 GklWUb 191.3 rel_ub_q0p75 0.00 191.3 FORMAT "%5.1"
 /begin AXIS_DESCR COM_AXIS nmot nmot_ub_q40 16 0.00 10200. AXIS_PTS_REF SNM16KRUB /end AXIS_DESCR
/end CHARACTERISTIC
/begin CHARACTERISTIC LKRN "Lastschwelle Klopfregelung" CURVE 0x819A32 GklWUb 191.3 rel_ub_q0p75 0.00 191.3 FORMAT "%5.1"
 /begin AXIS_DESCR COM_AXIS nmot nmot_ub_q40 16 0.00 10200. AXIS_PTS_REF SNM16KRUB /end AXIS_DESCR
/end CHARACTERISTIC
/begin CHARACTERISTIC LMSTMOT "Motortemp.-Korrektur von Lambda-Motor-Soll" CURVE 0x819752 KlAUbSstUbWUb 1.992 fak_ub_b2 0.00 1.992 FORMAT "%5.3"
 /begin AXIS_DESCR STD_AXIS tmot temp_ub_q0p75_o48 4 -48.00 143.3 FORMAT "%5.1" DEPOSIT ABSOLUTE /end AXIS_DESCR
/end CHARACTERISTIC
/begin CHARACTERISTIC LUEKO1 "Alternative Lüfterkonfiguration 1 zu CWLUEKO über Login Code" VALUE 0x829018 KwUw 65535.00 dez 0.00 65535.00 FORMAT "%8.2" /end CHARACTERISTIC
/begin CHARACTERISTIC LUEKO2 "Alternative Lüfterkonfiguration 2 zu CWLUEKO über Login Code" VALUE 0x82901A KwUw 65535.00 dez 0.00 65535.00 FORMAT "%8.2" /end CHARACTERISTIC
/begin CHARACTERISTIC LUEKO3 "Alternative Lüfterkonfiguration 3 zu CWLUEKO über Login Code" VALUE 0x82901C KwUw 65535.00 dez 0.00 65535.00 FORMAT "%8.2" /end CHARACTERISTIC
/begin CHARACTERISTIC LZB1 "Leitzylinderzuordnung: Bank1 führt Bank2 bei Fehler KS 2" VAL_BLK 0x811556 KwbUb 255.0 dez 0.00 255.0 FORMAT "%5.1" NUMBER 8 /end CHARACTERISTIC
/begin CHARACTERISTIC LZB2 "Leitzylinderzuordnung: Bank2 führt Bank1 bei Fehler KS 1" VAL_BLK 0x81155E KwbUb 255.0 dez 0.00 255.0 FORMAT "%5.1" NUMBER 8 /end CHARACTERISTIC
/begin CHARACTERISTIC LZFUER "Festwerteblock: Leitzylinderzuordnung" VAL_BLK 0x811566 KwbUb 255.0 dez 0.00 255.0 FORMAT "%5.1" NUMBER 8 /end CHARACTERISTIC
/begin CHARACTERISTIC MDKOAB "Drehmomentschwelle um den Kompressor in Beschleunigung abzuschalten" CURVE 0x812753 GklWUb 199.2 rel_ub_b200 0.00 199.2 FORMAT "%5.1"
 /begin AXIS_DESCR COM_AXIS nmot nmot_ub_q40 8 0.00 10200. AXIS_PTS_REF SNM08KOUB /end AXIS_DESCR
/end CHARACTERISTIC
/begin CHARACTERISTIC MDKOAN "Drehmomentschwelle um den Klimakompressor abzuschalten" CURVE 0x81275B GklWUb 199.2 rel_ub_b200 0.00 199.2 FORMAT "%5.1"
 /begin AXIS_DESCR COM_AXIS nmot nmot_ub_q40 8 0.00 10200. AXIS_PTS_REF SNM08KOUB /end AXIS_DESCR
/end CHARACTERISTIC
/begin CHARACTERISTIC MDKOEN "Drehmomentschwelle um den Klimakompressor einzuschalten" CURVE 0x812763 GklWUb 199.2 rel_ub_b200 0.00 199.2 FORMAT "%5.1"
 /begin AXIS_DESCR COM_AXIS nmot nmot_ub_q40 8 0.00 10200. AXIS_PTS_REF SNM08KOUB /end AXIS_DESCR
/end CHARACTERISTIC
/begin CHARACTERISTIC NGKRAWN "Schwellwert Drehzahlgradient für Dynamikerkennung KRRA" CURVE 0x81EB12 GklWSw 12799.77 nmotg_sw_q0p39 0.00 12799.77 FORMAT "%8.2"
 /begin AXIS_DESCR COM_AXIS nmot nmot_ub_q40 16 0.00 10200. AXIS_PTS_REF SNM16KRUB /end AXIS_DESCR
/end CHARACTERISTIC
/begin CHARACTERISTIC NGKRSTMX "maximaler Drehzahlgradient im KR stationär Betrieb" VALUE 0x815C78 KwSw 12799.77 nmotg_sw_q0p39 0.00 12799.77 FORMAT "%8.2" /end CHARACTERISTIC
/begin CHARACTERISTIC NGKRWN "Schwellwert Drehzahlgradient für Dynamikerkennung" CURVE 0x81EB32 GklWSw 12799.77 nmotg_sw_q0p39 0.00 12799.77 FORMAT "%8.2"
 /begin AXIS_DESCR COM_AXIS nmot nmot_ub_q40 16 0.00 10200. AXIS_PTS_REF SNM16KRUB /end AXIS_DESCR
/end CHARACTERISTIC
/begin CHARACTERISTIC NKRAMAX "Drehzahl oberhalb der KR-Adaption gefreezt wird" VALUE 0x819A42 KwUb 10200. nmot_ub_q40 0.00 10200. FORMAT "%5.0" /end CHARACTERISTIC
/begin CHARACTERISTIC NKRAMIN "Drehzahl unterhalb der KR-Adaption gefreezt wird" VALUE 0x819A43 KwUb 10200. nmot_ub_q40 0.00 10200. FORMAT "%5.0" /end CHARACTERISTIC
/begin CHARACTERISTIC NKRF "Drehzahlschwelle für Klopfregelfreigabe" VALUE 0x819A44 KwUb 10200. nmot_ub_q40 0.00 10200. FORMAT "%5.0" /end CHARACTERISTIC
/begin CHARACTERISTIC NKRMAX "Drehzahl oberhalb der KR gefreezt wird" VALUE 0x819A45 KwUb 10200. nmot_ub_q40 0.00 10200. FORMAT "%5.0" /end CHARACTERISTIC
/begin CHARACTERISTIC NLDIAPU "Drehzahlschwelle für Adaption I-Begrenzung" CURVE 0x81FB22 KlAUbSstUbWUb 10200. nmot_ub_q40 0.00 10200. FORMAT "%5.0"
 /begin AXIS_DESCR STD_AXIS pu p_ub_q5 2 0.00 1275. FORMAT "%5.0" DEPOSIT ABSOLUTE /end AXIS_DESCR
/end CHARACTERISTIC
/begin CHARACTERISTIC NM1MN1 "untere Grenze Ausblendbereich 1 für Solldrehzahl Lüfter 1" VALUE 0x81AC1D KwUb 5100. nmot_ub_q20 0.00 5100. FORMAT "%5.0" /end CHARACTERISTIC
/begin CHARACTERISTIC NM1MN2 "untere Grenze Ausblendbereich 2 für Solldrehzahl Lüfter 1" VALUE 0x81AC1E KwUb 5100. nmot_ub_q20 0.00 5100. FORMAT "%5.0" /end CHARACTERISTIC
/begin CHARACTERISTIC NM1MN3 "untere Grenze Ausblendbereich 3 für Solldrehzahl Lüfter 1" VALUE 0x81AC1F KwUb 5100. nmot_ub_q20 0.00 5100. FORMAT "%5.0" /end CHARACTERISTIC
/begin CHARACTERISTIC NM1MX1 "obere Grenze Ausblendbereich 1 für Solldrehzahl Lüfter 1" VALUE 0x81AC20 KwUb 5100. nmot_ub_q20 0.00 5100. FORMAT "%5.0" /end CHARACTERISTIC
/begin CHARACTERISTIC NM1MX2 "obere Grenze Ausblendbereich 2 für Solldrehzahl Lüfter 1" VALUE 0x81AC21 KwUb 5100. nmot_ub_q20 0.00 5100. FORMAT "%5.0" /end CHARACTERISTIC
/begin CHARACTERISTIC NM1MX3 "obere Grenze Ausblendbereich 3 für Solldrehzahl Lüfter 1" VALUE 0x81AC22 KwUb 5100. nmot_ub_q20 0.00 5100. FORMAT "%5.0" /end CHARACTERISTIC
/begin CHARACTERISTIC NM1VMN "Kennlinie minimale Lüfterdrehzahl 1 abhängig von Fahrzeuggeschwindigkeit" CURVE 0x81AC23 KlAUbSstUbWUb 5100. nmot_ub_q20 0.00 5100. FORMAT "%5.0"
 /begin AXIS_DESCR STD_AXIS vfzgkmtr vfzg_ub_q1p25 6 0.00 318.8 FORMAT "%5.1" DEPOSIT ABSOLUTE /end AXIS_DESCR
/end CHARACTERISTIC
/begin CHARACTERISTIC NM1VN "Untere kleinste Lüfterdrehzahlschwelle geschwindigkeitsabhängig" CURVE 0x81AC30 KlAUbSstUbWUb 5100. nmot_ub_q20 0.00 5100. FORMAT "%5.0"
 /begin AXIS_DESCR STD_AXIS vfzgkmtr vfzg_ub_q1p25 6 0.00 318.8 FORMAT "%5.1" DEPOSIT ABSOLUTE /end AXIS_DESCR
/end CHARACTERISTIC
/begin CHARACTERISTIC NM1VP "Obere kleinste  Lüfterdrehzahlschwelle geschwindigkeitsabhängig" CURVE 0x81AC3D KlAUbSstUbWUb 5100. nmot_ub_q20 0.00 5100. FORMAT "%5.0"
 /begin AXIS_DESCR STD_AXIS vfzgkmtr vfzg_ub_q1p25 6 0.00 318.8 FORMAT "%5.1" DEPOSIT ABSOLUTE /end AXIS_DESCR
/end CHARACTERISTIC
/begin CHARACTERISTIC NM2MN1 "untere Grenze Ausblendbereich 1 für Solldrehzahl Lüfter 2" VALUE 0x81AC4A KwUb 5100. nmot_ub_q20 0.00 5100. FORMAT "%5.0" /end CHARACTERISTIC
/begin CHARACTERISTIC NM2MN2 "untere Grenze Ausblendbereich 2 für Solldrehzahl Lüfter 2" VALUE 0x81AC4B KwUb 5100. nmot_ub_q20 0.00 5100. FORMAT "%5.0" /end CHARACTERISTIC
/begin CHARACTERISTIC NM2MN3 "untere Grenze Ausblendbereich 3 für Solldrehzahl Lüfter 2" VALUE 0x81AC4C KwUb 5100. nmot_ub_q20 0.00 5100. FORMAT "%5.0" /end CHARACTERISTIC
/begin CHARACTERISTIC NM2MX1 "obere Grenze Ausblendbereich 1 für Solldrehzahl Lüfter 2" VALUE 0x81AC4D KwUb 5100. nmot_ub_q20 0.00 5100. FORMAT "%5.0" /end CHARACTERISTIC
/begin CHARACTERISTIC NM2MX2 "obere Grenze Ausblendbereich 2 für Solldrehzahl Lüfter 2" VALUE 0x81AC4E KwUb 5100. nmot_ub_q20 0.00 5100. FORMAT "%5.0" /end CHARACTERISTIC
/begin CHARACTERISTIC NM2MX3 "obere Grenze Ausblendbereich 3 für Solldrehzahl Lüfter 2" VALUE 0x81AC4F KwUb 5100. nmot_ub_q20 0.00 5100. FORMAT "%5.0" /end CHARACTERISTIC
/begin CHARACTERISTIC NM2VMN "Kennlinie minimale Lüfterdrehzahl 2 abhängig von Fahrzeuggeschwindigkeit" CURVE 0x81AC50 KlAUbSstUbWUb 5100. nmot_ub_q20 0.00 5100. FORMAT "%5.0"
 /begin AXIS_DESCR STD_AXIS vfzgkmtr vfzg_ub_q1p25 6 0.00 318.8 FORMAT "%5.1" DEPOSIT ABSOLUTE /end AXIS_DESCR
/end CHARACTERISTIC
/begin CHARACTERISTIC NM2VN "Untere kleinste Lüfterdrehzahlschwelle geschwindigkeitsabhängig" CURVE 0x81AC5D KlAUbSstUbWUb 5100. nmot_ub_q20 0.00 5100. FORMAT "%5.0"
 /begin AXIS_DESCR STD_AXIS vfzgkmtr vfzg_ub_q1p25 6 0.00 318.8 FORMAT "%5.1" DEPOSIT ABSOLUTE /end AXIS_DESCR
/end CHARACTERISTIC
/begin CHARACTERISTIC NM2VP "Obere kleinste  Lüfterdrehzahlschwelle geschwindigkeitsabhängig" CURVE 0x81AC6A KlAUbSstUbWUb 5100. nmot_ub_q20 0.00 5100. FORMAT "%5.0"
 /begin AXIS_DESCR STD_AXIS vfzgkmtr vfzg_ub_q1p25 6 0.00 318.8 FORMAT "%5.1" DEPOSIT ABSOLUTE /end AXIS_DESCR
/end CHARACTERISTIC
/begin CHARACTERISTIC NSTNMKMTR "Schwelle für Mindestdrehzahl zur Berechnung gefilterter Kraftstoffverbrauch" VALUE 0x81AC77 KwUb 10200. nmot_ub_q40 0.00 10200. FORMAT "%5.0" /end CHARACTERISTIC
/begin CHARACTERISTIC PIDLDSUA "Prädiktionsintervall für dynamische Schubumluftventilansteuerung" VALUE 0x8115D0 KwUb 63.75 fak_ub_b64 0.00 63.75 FORMAT "%5.2" /end CHARACTERISTIC
/begin CHARACTERISTIC PKLIHDV "Klimadruck-Schwelle für Lüfter schnell-Hochlauf" VALUE 0x81AC78 KwUb 51.00 p_q0p2 0.00 51.00 FORMAT "%5.2" /end CHARACTERISTIC
/begin CHARACTERISTIC PKLIMA "Kennlinie Systemdruck Klimaanlage" CURVE 0x81AC79 KlAUbSstUbWUb 51.00 p_q0p2 0.00 51.00 FORMAT "%5.2"
 /begin AXIS_DESCR STD_AXIS takols dez 5 0.00 255.0 FORMAT "%5.1" DEPOSIT ABSOLUTE /end AXIS_DESCR
/end CHARACTERISTIC
/begin CHARACTERISTIC PKODR "Ersatzwert Druck Klimaanlage für KMTR" VALUE 0x81AC84 KwUb 51.00 p_q0p2 0.00 51.00 FORMAT "%5.2" /end CHARACTERISTIC
/begin CHARACTERISTIC PKODRCMX "Kältemitteldruckschwelle zur Kompressorabschaltung" VALUE 0x81A93C KwUb 51.00 p_q0p2 0.00 51.00 FORMAT "%5.2" /end CHARACTERISTIC
/begin CHARACTERISTIC PZWKRA "Prozentuale Häufigkeit der ZW-Ausgabe durch die KR während Dynamikadaption" VALUE 0x811583 KwUb 99.61 rel_ub_b99p6 0.00 99.61 FORMAT "%5.2" /end CHARACTERISTIC
/begin CHARACTERISTIC QKLIHDV "Wärmestrom-Schwelle für Lüfter schnell-Hochlauf" VALUE 0x81AC85 KwUb 191.3 temp_ub_q0p75_o48 -48.00 143.3 FORMAT "%5.1" /end CHARACTERISTIC
/begin CHARACTERISTIC QKLILU1 "Festwert Wärmestrom Klima f. Lüfter 1" VALUE 0x81AC86 KwUb 191.3 temp_ub_q0p75_o48 -48.00 143.3 FORMAT "%5.1" /end CHARACTERISTIC
/begin CHARACTERISTIC QKLILU2 "Festwert Wärmestrom Klima f. Lüfter 2" VALUE 0x81AC87 KwUb 191.3 temp_ub_q0p75_o48 -48.00 143.3 FORMAT "%5.1" /end CHARACTERISTIC
/begin CHARACTERISTIC QMAXL1INI "Initialisierungswert Einschaltschwelle Lüfter 1" VALUE 0x81AC88 KwUb 191.3 temp_ub_q0p75_o48 -48.00 143.3 FORMAT "%5.1" /end CHARACTERISTIC
/begin CHARACTERISTIC QMAXL2INI "Initialisierungswert Einschaltschwelle Lüfter 2" VALUE 0x81AC89 KwUb 191.3 temp_ub_q0p75_o48 -48.00 143.3 FORMAT "%5.1" /end CHARACTERISTIC
/begin CHARACTERISTIC REFINI "Startwert Referenzpegel bei Klopfregelung aktiv" VALUE 0x811549 KwUb 0.7227 spg_ub_b5 0.2930 1.016 FORMAT "%5.3" /end CHARACTERISTIC
/begin CHARACTERISTIC RKRMX1N "Maximaler Referenzpegel für Klopferkennungsschwelle Zyl.-gruppe 1" CURVE 0x819941 GklWUb 317.5 spg_ub_b320 1.250 318.8 FORMAT "%5.1"
 /begin AXIS_DESCR COM_AXIS nmot nmot_ub_q40 16 0.00 10200. AXIS_PTS_REF SNM16KRUB /end AXIS_DESCR
/end CHARACTERISTIC
/begin CHARACTERISTIC RKRMX2N "Maximaler Referenzpegel für Klopferkennungsschwelle Zyl.-gruppe 2" CURVE 0x819951 GklWUb 317.5 spg_ub_b320 1.250 318.8 FORMAT "%5.1"
 /begin AXIS_DESCR COM_AXIS nmot nmot_ub_q40 16 0.00 10200. AXIS_PTS_REF SNM16KRUB /end AXIS_DESCR
/end CHARACTERISTIC
/begin CHARACTERISTIC RLKRLDA "Rl-Schwelle für langsamen LDR-Eingriff (Adaption)" CURVE 0x819CBC GklWUb 191.3 rel_ub_q0p75 0.00 191.3 FORMAT "%5.1"
 /begin AXIS_DESCR COM_AXIS nmot nmot_ub_q40 8 0.00 10200. AXIS_PTS_REF SNM08LDUB /end AXIS_DESCR
/end CHARACTERISTIC
/begin CHARACTERISTIC RLLAMMN "RL-min Schwelle zur Anfettung wegen Brennbarkeit" CURVE 0x819236 GklWUb 191.3 rel_ub_q0p75 0.00 191.3 FORMAT "%5.1"
 /begin AXIS_DESCR COM_AXIS nmot nmot_ub_q40 7 0.00 10200. AXIS_PTS_REF SNM07ESUB /end AXIS_DESCR
/end CHARACTERISTIC
/begin CHARACTERISTIC SDLDSUA "Schwelle für dynamische Schubumluftventilsteuerung aktiv" CURVE 0x815E38 FklWUw 2559.961 p_uw_q0p039 0.00 2559.961 FORMAT "%8.3"
 /begin AXIS_DESCR FIX_AXIS plmaxa_w p_uw_q0p039 16 0.00 2559.961 FORMAT "%8.3" FIX_AXIS_PAR 0 12 16 /end AXIS_DESCR
/end CHARACTERISTIC
/begin AXIS_PTS SDZ06GKUB "Stützstellen KFLAMKRL" 0x81923D dzwlamfaw SstAUbSstUb 191.3 zw_ub_qn0p75 6 -191.3 0.00 FORMAT "%5.1" DEPOSIT ABSOLUTE /end AXIS_PTS
/begin AXIS_PTS SLD04LDUB "Stützstellenverteilung für Ladedruckregelung" 0x81006F lde SstAUbSstUb 2550. p_sb_q10 4 0.00 2550. FORMAT "%5.0" DEPOSIT ABSOLUTE /end AXIS_PTS
/begin AXIS_PTS SNM06GKUB "Stützstellen KFLAMKR, DLAMOB" 0x8181FB nmot SstAUbSstUb 10200. nmot_ub_q40 6 0.00 10200. FORMAT "%5.0" DEPOSIT ABSOLUTE /end AXIS_PTS
/begin AXIS_PTS SNM07ESUB "Stützstellenverteilung Drehzahl, 7 Sst." 0x818202 nmot SstAUbSstUb 10200. nmot_ub_q40 7 0.00 10200. FORMAT "%5.0" DEPOSIT ABSOLUTE /end AXIS_PTS
/begin AXIS_PTS SNM08KOUB "Stützstellenverteilung für Klimakompressorsteuerung  8  nmot" 0x81276B nmot SstAUbSstUb 10200. nmot_ub_q40 8 0.00 10200. FORMAT "%5.0" DEPOSIT ABSOLUTE /end AXIS_PTS
/begin AXIS_PTS SNM08LDUB "Stützstellenverteilung für Ladedruckregelung" 0x810084 nmot SstAUbSstUb 10200. nmot_ub_q40 8 0.00 10200. FORMAT "%5.0" DEPOSIT ABSOLUTE /end AXIS_PTS
/begin AXIS_PTS SNM08LDUW "Stützstellenverteilung für Ladedruckregelung" 0x81344E nmot_w SstAUwSstUw 16383.75 nmot_uw_q0p25 8 0.00 16383.75 FORMAT "%8.2" DEPOSIT ABSOLUTE /end AXIS_PTS
/begin AXIS_PTS SNM12LDUW "Stützstellenverteilung für Ladedruckregelung" 0x813460 nmot_w SstAUwSstUw 16383.75 nmot_uw_q0p25 12 0.00 16383.75 FORMAT "%8.2" DEPOSIT ABSOLUTE /end AXIS_PTS
/begin AXIS_PTS SNM16GKUB "Stützstellenverteilung Gemischkontrolle 16 nmot Stützstellen" 0x81961B nmot SstAUbSstUb 10200. nmot_ub_q40 16 0.00 10200. FORMAT "%5.0" DEPOSIT ABSOLUTE /end AXIS_PTS
/begin AXIS_PTS SNM16KRDYUB "" 0x818241 nmot SstAUbSstUb 10200. nmot_ub_q40 16 0.00 10200. FORMAT "%5.0" DEPOSIT ABSOLUTE /end AXIS_PTS
/begin AXIS_PTS SNM16KRUB "Stützstellenverteilung Drehzahl, 16 Sst." 0x818252 nmot SstAUbSstUb 10200. nmot_ub_q40 16 0.00 10200. FORMAT "%5.0" DEPOSIT ABSOLUTE /end AXIS_PTS
/begin AXIS_PTS SNM16LDUB "Stützstellenverteilung für Ladedruckregelung" 0x8100BB nmot SstAUbSstUb 10200. nmot_ub_q40 16 0.00 10200. FORMAT "%5.0" DEPOSIT ABSOLUTE /end AXIS_PTS
/begin AXIS_PTS SNM16LDUW "Stützstellenverteilung für Ladedruckregelung" 0x81347A nmot_w SstAUwSstUw 16383.75 nmot_uw_q0p25 16 0.00 16383.75 FORMAT "%8.2" DEPOSIT ABSOLUTE /end AXIS_PTS
/begin AXIS_PTS SPL08LDUW "Stützstellenverteilung für Ladedruckregelung" 0x81609E plsolr_w SstAUbSstUw 2559.961 p_uw_q0p039 8 0.00 2559.961 FORMAT "%8.3" DEPOSIT ABSOLUTE /end AXIS_PTS
/begin AXIS_PTS SPU08LDUB "Stützstellenverteilung für Ladedruckregelung" 0x8100CC pu SstAUbSstUb 1275. p_ub_q5 8 0.00 1275. FORMAT "%5.0" DEPOSIT ABSOLUTE /end AXIS_PTS
/begin AXIS_PTS SRL03KRUB "Stützstellenverteilung relative Füllung, 3 Sst." 0x818263 rl SstAUbSstUb 191.3 rel_ub_q0p75 3 0.00 191.3 FORMAT "%5.1" DEPOSIT ABSOLUTE /end AXIS_PTS
/begin AXIS_PTS SRL06GKUB "Stützstellen KFLAMKRL, KFLAFWL, KFLAMKR" 0x81826C rl SstAUbSstUb 191.3 rel_ub_q0p75 6 0.00 191.3 FORMAT "%5.1" DEPOSIT ABSOLUTE /end AXIS_PTS
/begin AXIS_PTS SRL06KRUB "Stützstellenverteilung relative Füllung (rl), 6 Sst." 0x818273 rl SstAUbSstUb 191.3 rel_ub_q0p75 6 0.00 191.3 FORMAT "%5.1" DEPOSIT ABSOLUTE /end AXIS_PTS
/begin AXIS_PTS SRL12GKUW "Stützstellenverteilung Gemischkontrolle 12 rl_w Stützstellen" 0x81DD0E rl_w SstAUwSstUw 1535.977 rel_uw_q0p0234 12 0.00 1535.977 FORMAT "%8.3" DEPOSIT ABSOLUTE /end AXIS_PTS
/begin AXIS_PTS STA08LDUB "Stützstellenverteilung für Ladedruckregelung" 0x8100FD tans SstAUbSstUb 191.3 temp_ub_q0p75_o48 8 -48.00 143.3 FORMAT "%5.1" DEPOSIT ABSOLUTE /end AXIS_PTS
/begin AXIS_PTS STA10LDUB "Stützstellenverteilung für Ladedruckregelung" 0x8115D1 tans SstAUbSstUb 191.3 temp_ub_q0p75_o48 10 -48.00 143.3 FORMAT "%5.1" DEPOSIT ABSOLUTE /end AXIS_PTS
/begin CHARACTERISTIC STLDIA1 "Stützstelle1 für LDR Adaptionskennlinie" VALUE 0x819C4B KwUb 10200. nmot_ub_q40 0.00 10200. FORMAT "%5.0" /end CHARACTERISTIC
/begin CHARACTERISTIC STLDIA2 "Stützstelle2 für LDR Adaptionskennlinie" VALUE 0x819C4C KwUb 10200. nmot_ub_q40 0.00 10200. FORMAT "%5.0" /end CHARACTERISTIC
/begin CHARACTERISTIC STLDIA3 "Stützstelle3 für LDR Adaptionskennlinie" VALUE 0x819C4D KwUb 10200. nmot_ub_q40 0.00 10200. FORMAT "%5.0" /end CHARACTERISTIC
/begin CHARACTERISTIC STLDIA4 "Stützstelle4 für LDR Adaptionskennlinie" VALUE 0x819C4E KwUb 10200. nmot_ub_q40 0.00 10200. FORMAT "%5.0" /end CHARACTERISTIC
/begin AXIS_PTS STM08GKUB "8 Motortemperaturstützstellen für KFLAFWL" 0x8182B9 tmot SstAUbSstUb 191.3 temp_ub_q0p75_o48 8 -48.00 143.3 FORMAT "%5.1" DEPOSIT ABSOLUTE /end AXIS_PTS
/begin AXIS_PTS STM12ESUB "SST-Verteilung für die Motortemperatur tmot" 0x810126 tmot SstAUbSstUb 191.3 temp_ub_q0p75_o48 12 -48.00 143.3 FORMAT "%5.1" DEPOSIT ABSOLUTE /end AXIS_PTS
/begin AXIS_PTS STS05DTKA "Stützstellenverteilung in Abhängigkeit von Differenztemp. Motor/ Kühleraustritt" 0x81AC8A dtmtka SstAUbSstSb 191.3 temp_sb_q0p75 5 -96.00 95.25 FORMAT "%5.2" DEPOSIT ABSOLUTE /end AXIS_PTS
/begin AXIS_PTS STS05DTTS "Stützstellenverteilung in Abhängigkeit von Differenztemp. Motor-Soll/Isttemp." 0x81AC90 dkmts SstAUbSstSb 191.3 temp_sb_q0p75 5 -96.00 95.25 FORMAT "%5.2" DEPOSIT ABSOLUTE /end AXIS_PTS
/begin AXIS_PTS STS12ESUB "SST-Verteilung für Motorstarttemperatur" 0x810145 tmst SstAUbSstUb 191.3 temp_ub_q0p75_o48 12 -48.00 143.3 FORMAT "%5.1" DEPOSIT ABSOLUTE /end AXIS_PTS
/begin AXIS_PTS STV10LDSW "Stützstellenverteilung für Ladedruckregelung" 0x81FB28 ldtvr_w SstAUbSstSw 327.6750 tv_sw_q0p005 10 -163.8400 163.8350 FORMAT "%8.4" DEPOSIT ABSOLUTE /end AXIS_PTS
/begin CHARACTERISTIC SVDLDUVS "Schwelle Verdichterdruckverhältnis für LDR Umluftventilsteuerung" CURVE 0x81F518 KlAUbSstUbWUb 3.984 fak_ub_b4 0.00 3.984 FORMAT "%5.3"
 /begin AXIS_DESCR STD_AXIS nmot nmot_ub_q40 16 0.00 10200. FORMAT "%5.0" DEPOSIT ABSOLUTE /end AXIS_DESCR
/end CHARACTERISTIC
/begin AXIS_PTS SVP12LDUW "Stützstellenverteilung für vpssplg bei LDR" 0x813556 vpssplg_w SstAUwSstUw 3.999939 fak_uw_b4 12 0.00 3.999939 FORMAT "%8.6" DEPOSIT ABSOLUTE /end AXIS_PTS
/begin AXIS_PTS SWK08LDUW "Stützstellenverteilung für Ladedruckregelung" 0x8160B0 wkrmstat_w SstAUwSstUw 12287.81 zw_q0p1875 8 0.00 12287.81 FORMAT "%8.2" DEPOSIT ABSOLUTE /end AXIS_PTS
/begin AXIS_PTS SWK108LDUW "Stützstellenverteilung für Ladedruckregelung" 0x8160C2 wkrmdy_w SstAUwSstUw 12287.81 zw_q0p1875 8 0.00 12287.81 FORMAT "%8.2" DEPOSIT ABSOLUTE /end AXIS_PTS
/begin AXIS_PTS SWK208LDUW "Stützstellenverteilung für Ladedruckregelung" 0x8160D4 wkrmsu_w SstAUwSstUw 12287.81 zw_q0p1875 8 0.00 12287.81 FORMAT "%8.2" DEPOSIT ABSOLUTE /end AXIS_PTS
/begin CHARACTERISTIC TABGBTS "Abgastemperaturschwelle für Bauteileschutz" VALUE 0x81DD28 KwUw 1279.980 temp_uw_q0p0195_o50 -50.00000 1229.980 FORMAT "%8.3" /end CHARACTERISTIC
/begin CHARACTERISTIC TABLDOBN "Abregelzeit für LDR-Overboost" CURVE 0x819C91 GklWUb 12.7498039 zk50msxs_ub_b12p8 0.0501960784 12.8000000 FORMAT "%10.7"
 /begin AXIS_DESCR COM_AXIS nmot nmot_ub_q40 8 0.00 10200. AXIS_PTS_REF SNM08LDUB /end AXIS_DESCR
/end CHARACTERISTIC
/begin CHARACTERISTIC TALDUVSE "Zeit bis zur Aktivierung LDR Umluftventilsteuerung nach Startende" VALUE 0x815E58 KwUw 3276.750 t50msxs_uw_b3276p75 0.00 3276.750 FORMAT "%8.3" /end CHARACTERISTIC
/begin CHARACTERISTIC TANSKOB "Ansauglufttemperaturschwelle für Kompressorabschaltung" VALUE 0x812774 KwUb 191.3 temp_ub_q0p75_o48 -48.00 143.3 FORMAT "%5.1" /end CHARACTERISTIC
/begin CHARACTERISTIC TDLAMBTS "einmalige Verzögerungszeit für Freigabe Lambda-Bauteileschutz" VALUE 0x81DD2A KwUw 6553.500 t100msxs_uw_b6553p5 0.00 6553.500 FORMAT "%8.3" /end CHARACTERISTIC
/begin CHARACTERISTIC TDPDK "Zeitkonstante Abregelung für Faktor fmvp_w" VALUE 0x81609C KwUw 655.34999985 zk10msxs_uw_b655 0.010000152590 655.36000000 FORMAT "%12.8" /end CHARACTERISTIC
/begin CHARACTERISTIC TETRST "Beginn Regelung Thermostat nach Start" VALUE 0x81AC96 KwUb 51.00 t200msxs_ub_b51 0.00 51.00 FORMAT "%5.2" /end CHARACTERISTIC
/begin CHARACTERISTIC TFLZLR "Verzögerung des B_fpld_ok  während Lüfterdeaktivierung" VALUE 0x81AC97 KwUb 25.50 t100msxs_ub_b25p5 0.00 25.50 FORMAT "%5.2" /end CHARACTERISTIC
/begin CHARACTERISTIC THLDUVD "Haltezeit LDR Umluftventilsteuerung dynamisch" VALUE 0x815E5A KwUw 3276.750 t50msxs_uw_b3276p75 0.00 3276.750 FORMAT "%8.3" /end CHARACTERISTIC
/begin CHARACTERISTIC TIKATBTS "Temperaturschwelle im Kat für Bauteileschutz" VALUE 0x81DD2C KwUw 1279.980 temp_uw_q0p0195_o50 -50.00000 1229.980 FORMAT "%8.3" /end CHARACTERISTIC
/begin CHARACTERISTIC TKATBTS "Kat-Temperaturschwelle für Bauteileschutz" VALUE 0x81DD2E KwUw 1279.980 temp_uw_q0p0195_o50 -50.00000 1229.980 FORMAT "%8.3" /end CHARACTERISTIC
/begin CHARACTERISTIC TKATVLSMN "Minimalwert-Soll-TKA" VALUE 0x81AC98 KwUb 191.3 temp_ub_q0p75_o48 -48.00 143.3 FORMAT "%5.1" /end CHARACTERISTIC
/begin CHARACTERISTIC TKATVLSMX "Maximalwert-Soll-Tka" VALUE 0x81AC99 KwUb 191.3 temp_ub_q0p75_o48 -48.00 143.3 FORMAT "%5.1" /end CHARACTERISTIC
/begin CHARACTERISTIC TKLIHDV "Totzeit für Lüfter schnell-Hochlauf" VALUE 0x81AC9A KwUb 255.0 t1sxs_ub_b255 0.00 255.0 FORMAT "%5.1" /end CHARACTERISTIC
/begin CHARACTERISTIC TKOAMAD "Kompressorsperrzeit für Bedarfsadaption" VALUE 0x812775 KwUb 51.00 t200msxs_ub_b51 0.00 51.00 FORMAT "%5.2" /end CHARACTERISTIC
/begin CHARACTERISTIC TKOAMNN "Minimale Abschaltzeit des Klimakompressors" CURVE 0x817A7A GklWUw 1310.700 t20msxs_uw_b1310 0.00 1310.700 FORMAT "%8.3"
 /begin AXIS_DESCR COM_AXIS nmot nmot_ub_q40 8 0.00 10200. AXIS_PTS_REF SNM08KOUB /end AXIS_DESCR
/end CHARACTERISTIC
/begin CHARACTERISTIC TKOAMXN "Maximale Abschaltzeit des Klimakompressors" CURVE 0x812776 GklWUb 51.00 t200msxs_ub_b51 0.00 51.00 FORMAT "%5.2"
 /begin AXIS_DESCR COM_AXIS nmot nmot_ub_q40 8 0.00 10200. AXIS_PTS_REF SNM08KOUB /end AXIS_DESCR
/end CHARACTERISTIC
/begin CHARACTERISTIC TKOBEMNN "Minimale Einschaltzeit des Kompres. nach Auslösung über B_kobped oder B_kobwped" CURVE 0x81277E GklWUb 51.00 t200msxs_ub_b51 0.00 51.00 FORMAT "%5.2"
 /begin AXIS_DESCR COM_AXIS nmot nmot_ub_q40 8 0.00 10200. AXIS_PTS_REF SNM08KOUB /end AXIS_DESCR
/end CHARACTERISTIC
/begin CHARACTERISTIC TKODPAMNN "minimale Abschaltzeit des Klimakompressors  bei Beschleunigung ( dwped )" CURVE 0x812786 GklWUb 51.00 t200msxs_ub_b51 0.00 51.00 FORMAT "%5.2"
 /begin AXIS_DESCR COM_AXIS nmot nmot_ub_q40 8 0.00 10200. AXIS_PTS_REF SNM08KOUB /end AXIS_DESCR
/end CHARACTERISTIC
/begin CHARACTERISTIC TKODPAMXN "Maximale Ausschaltzeit bei Kompressorausschalten  über dwped" CURVE 0x81278E GklWUb 51.00 t200msxs_ub_b51 0.00 51.00 FORMAT "%5.2"
 /begin AXIS_DESCR COM_AXIS nmot nmot_ub_q40 8 0.00 10200. AXIS_PTS_REF SNM08KOUB /end AXIS_DESCR
/end CHARACTERISTIC
/begin CHARACTERISTIC TKOEMNN "Minimale Einschaltzeit des Klimakompressors" CURVE 0x812796 GklWUb 51.00 t200msxs_ub_b51 0.00 51.00 FORMAT "%5.2"
 /begin AXIS_DESCR COM_AXIS nmot nmot_ub_q40 8 0.00 10200. AXIS_PTS_REF SNM08KOUB /end AXIS_DESCR
/end CHARACTERISTIC
/begin CHARACTERISTIC TKOMBKOA "Motortemperaturschwelle aus Kombiinstrument für Kompressorabschaltung" VALUE 0x81279E KwUb 191.3 temp_ub_q0p75_o48 -48.00 143.3 FORMAT "%5.1" /end CHARACTERISTIC
/begin CHARACTERISTIC TKOMBKOE "Motortemperaturschwelle aus Kombiinstrument für Kompressoreinschaltung" VALUE 0x81279F KwUb 191.3 temp_ub_q0p75_o48 -48.00 143.3 FORMAT "%5.1" /end CHARACTERISTIC
/begin CHARACTERISTIC TKOTMSK "Minimale Abschaltzeit des Klimakompressors nach Klima aus" VALUE 0x828EC8 KwUw 1310.700 t20msxs_uw_q0p02 0.00 1310.700 FORMAT "%8.3" /end CHARACTERISTIC
/begin CHARACTERISTIC TKOVKO "Überwachungzeit  zur Klimatasteerken. nach Reset von B_kov (bidrekt. Schnittst.)" VALUE 0x8127A0 KwUb 5.100 t20msxs_ub_b5p1 0.00 5.100 FORMAT "%5.3" /end CHARACTERISTIC
/begin CHARACTERISTIC TKOWPAMNN "Minimale Abschaltzeit bei Vollast (über wped)" CURVE 0x8127A1 GklWUb 51.00 t200msxs_ub_b51 0.00 51.00 FORMAT "%5.2"
 /begin AXIS_DESCR COM_AXIS nmot nmot_ub_q40 8 0.00 10200. AXIS_PTS_REF SNM08KOUB /end AXIS_DESCR
/end CHARACTERISTIC
/begin CHARACTERISTIC TKOWPAMXN "maximale Ausschaltzeit bei Vollast (über wped)" CURVE 0x8127A9 GklWUb 51.00 t200msxs_ub_b51 0.00 51.00 FORMAT "%5.2"
 /begin AXIS_DESCR COM_AXIS nmot nmot_ub_q40 8 0.00 10200. AXIS_PTS_REF SNM08KOUB /end AXIS_DESCR
/end CHARACTERISTIC
/begin CHARACTERISTIC TLDIAN "Entprellzeit für Nachführung I-Adaption negativ" VALUE 0x819C4F KwUb 12.75 t50msxs_ub_b12p75 0.00 12.75 FORMAT "%5.2" /end CHARACTERISTIC
/begin CHARACTERISTIC TLDIAPN "Entprellzeit für Nachführung I-Adaption positiv" CURVE 0x819C50 GklWUb 12.75 t50msxs_ub_b12p75 0.00 12.75 FORMAT "%5.2"
 /begin AXIS_DESCR COM_AXIS nmot nmot_ub_q40 8 0.00 10200. AXIS_PTS_REF SNM08LDUB /end AXIS_DESCR
/end CHARACTERISTIC
/begin CHARACTERISTIC TLDOBAN "Zeit für LDR-Overboost aktiv" CURVE 0x819C99 GklWUb 255.0 t1sxs_ub_b255 0.00 255.0 FORMAT "%5.1"
 /begin AXIS_DESCR COM_AXIS nmot nmot_ub_q40 8 0.00 10200. AXIS_PTS_REF SNM08LDUB /end AXIS_DESCR
/end CHARACTERISTIC
/begin CHARACTERISTIC TLDOBN "Sperrzeit für LDR-Overboost" CURVE 0x819CA1 GklWUb 12.75 t50msxs_ub_b12p75 0.00 12.75 FORMAT "%5.2"
 /begin AXIS_DESCR COM_AXIS nmot nmot_ub_q40 8 0.00 10200. AXIS_PTS_REF SNM08LDUB /end AXIS_DESCR
/end CHARACTERISTIC
/begin CHARACTERISTIC TLKRLDAB "Zeitkonstante für langsame LDR-Absenkung" CURVE 0x826EDC GklWUw 3276.7499992 zk50msxs_uw_b3276p8 0.050000762951 3276.8000000 FORMAT "%12.7"
 /begin AXIS_DESCR COM_AXIS nmot_w nmot_uw_q0p25 8 0.00 16383.75 AXIS_PTS_REF SNM08LDUW /end AXIS_DESCR
/end CHARACTERISTIC
/begin CHARACTERISTIC TLKRLDAU "Zeitkonstante für langsame LDR-Aufregelung" CURVE 0x826EEC GklWUw 3276.7499992 zk50msxs_uw_b3276p8 0.050000762951 3276.8000000 FORMAT "%12.7"
 /begin AXIS_DESCR COM_AXIS nmot_w nmot_uw_q0p25 8 0.00 16383.75 AXIS_PTS_REF SNM08LDUW /end AXIS_DESCR
/end CHARACTERISTIC
/begin CHARACTERISTIC TLUEST "Beginn Regelung Lüfter nach Start" VALUE 0x81AC9B KwUb 51.00 t200msxs_ub_b51 0.00 51.00 FORMAT "%5.2" /end CHARACTERISTIC
/begin CHARACTERISTIC TMDYNA "TMOT - Schwelle für Lastdynamikadaption aktiv" VALUE 0x811584 KwUb 191.3 temp_ub_q0p75_o48 -48.00 143.3 FORMAT "%5.1" /end CHARACTERISTIC
/begin CHARACTERISTIC TMEWKMTR "KMTR Ersatzwert Motortemperatur" VALUE 0x81AC9C KwUb 191.3 temp_ub_q0p75_o48 -48.00 143.3 FORMAT "%5.1" /end CHARACTERISTIC
/begin CHARACTERISTIC TMKOAO "Obere Motortemperaturschwelle für Kompressorabschaltung" VALUE 0x8127B1 KwUb 191.3 temp_ub_q0p75_o48 -48.00 143.3 FORMAT "%5.1" /end CHARACTERISTIC
/begin CHARACTERISTIC TMKOAU "Untere Motortemperaturschwelle für Kompressorabschaltung" VALUE 0x8127B2 KwUb 191.3 temp_ub_q0p75_o48 -48.00 143.3 FORMAT "%5.1" /end CHARACTERISTIC
/begin CHARACTERISTIC TMKR "Motortemperaturschwelle für Klopfregelung aktiv" VALUE 0x819A46 KwUb 191.3 temp_ub_q0p75_o48 -48.00 143.3 FORMAT "%5.1" /end CHARACTERISTIC
/begin CHARACTERISTIC TMKRA "Motortemperaturschwelle für adaptive Klopfregelung" VALUE 0x819A47 KwUb 191.3 temp_ub_q0p75_o48 -48.00 143.3 FORMAT "%5.1" /end CHARACTERISTIC
/begin CHARACTERISTIC TMKRAS "Temperaturschwelle für Freigabe Schreibzugriffe auf Adaptions-KF" VALUE 0x819A48 KwUb 191.3 temp_ub_q0p75_o48 -48.00 143.3 FORMAT "%5.1" /end CHARACTERISTIC
/begin CHARACTERISTIC TMOTDQMX "Max. Kühlmitteltemperaturschwelle zur Ansteuerung Lüfter über TKA" VALUE 0x81AC9D KwUb 191.3 temp_ub_q0p75_o48 -48.00 143.3 FORMAT "%5.1" /end CHARACTERISTIC
/begin CHARACTERISTIC TMOTDTEV "Maximale Temperatur für Lüfter nicht anschalten beim TEV-Diagnose" VALUE 0x81AC9E KwUb 191.3 temp_ub_q0p75_o48 -48.00 143.3 FORMAT "%5.1" /end CHARACTERISTIC
/begin CHARACTERISTIC TMOTKRMN "Minimale Motortemperatur für" VALUE 0x81AC9F KwUb 191.3 temp_ub_q0p75_o48 -48.00 143.3 FORMAT "%5.1" /end CHARACTERISTIC
/begin CHARACTERISTIC TMOTKRMX "Maximale Motortemperatur für" VALUE 0x81ACA0 KwUb 191.3 temp_ub_q0p75_o48 -48.00 143.3 FORMAT "%5.1" /end CHARACTERISTIC
/begin CHARACTERISTIC TMOTMX "Motortemperaturschwelle für Erstbefüllung Kraftstoffsystem" VALUE 0x819CC4 KwUb 191.3 temp_ub_q0p75_o48 -48.00 143.3 FORMAT "%5.1" /end CHARACTERISTIC
/begin CHARACTERISTIC TMSO5INI "Initialisierungswert Sollwert Motortemperatur 5" VALUE 0x81ACA1 KwUb 191.3 temp_ub_q0p75_o48 -48.00 143.3 FORMAT "%5.1" /end CHARACTERISTIC
/begin CHARACTERISTIC TMSOINI "Initialisierungswert Tiefpass Motor-Soll-Temperatur" VALUE 0x81ACA2 KwUb 191.3 temp_ub_q0p75_o48 -48.00 143.3 FORMAT "%5.1" /end CHARACTERISTIC
/begin CHARACTERISTIC TMSOLLEW "KMTR Ersatzwert Motor-Solltemperatur" VALUE 0x81ACA3 KwUb 191.3 temp_ub_q0p75_o48 -48.00 143.3 FORMAT "%5.1" /end CHARACTERISTIC
/begin CHARACTERISTIC TMSOTOEL "Solltemperatur abhängig von Öltemperatur" CURVE 0x81ACA4 KlAUbSstUbWUb 191.3 temp_ub_q0p75_o48 -48.00 143.3 FORMAT "%5.1"
 /begin AXIS_DESCR STD_AXIS toelkmtr temp_ub_q1_o60 5 -60.00 195.0 FORMAT "%5.1" DEPOSIT ABSOLUTE /end AXIS_DESCR
/end CHARACTERISTIC
/begin CHARACTERISTIC TMSTMAD "Schwelle für tmot im Start für Bedarfsadaption" VALUE 0x8127B3 KwUb 191.3 temp_ub_q0p75_o48 -48.00 143.3 FORMAT "%5.1" /end CHARACTERISTIC
/begin CHARACTERISTIC TNLARAMP "Minimale SG-Nachlaufzeit für rampenförmige Lüfterabsteuerung" VALUE 0x82901E KwUw 65535.00 t1sxs_uw_b65535 0.00 65535.00 FORMAT "%8.2" /end CHARACTERISTIC
/begin CHARACTERISTIC TNLKMTRMN "Minimal notwendige SG-Nachlaufzeit zur Freigabe der Lüfteransteuerung" VALUE 0x829020 KwUw 65535.00 t1sxs_uw_b65535 0.00 65535.00 FORMAT "%8.2" /end CHARACTERISTIC
/begin CHARACTERISTIC TNLSTMX "Max. SG-Laufzeit nach Startende für Reset Lüfternachlauftimer" VALUE 0x829022 KwUw 6553.500 t100msxs_uw_b6553p5 0.00 6553.500 FORMAT "%8.3" /end CHARACTERISTIC
/begin CHARACTERISTIC TNLSTP "Abbruchbedingung Nachlaufzeit für Lüfteransteuerung" VALUE 0x829024 KwUw 65535.00 t1sxs_uw_b65535 0.00 65535.00 FORMAT "%8.2" /end CHARACTERISTIC
/begin CHARACTERISTIC TNSTKO "Unterdrückungszeit des Kompressors nach dem Start" VALUE 0x8127B4 KwUb 51.00 t200msxs_ub_b51 0.00 51.00 FORMAT "%5.2" /end CHARACTERISTIC
/begin CHARACTERISTIC TOELMX "Oeltemperaturschwelle fuer Motorschutz bei Getriebenotlauf" VALUE 0x819CC5 KwUb 255.0 temp_ub_q1_o60 -60.00 195.0 FORMAT "%5.1" /end CHARACTERISTIC
/begin CHARACTERISTIC TOLEWKMTR "Ersatzwert Öltemperatur in KMTR" VALUE 0x81ACAF KwUb 255.0 temp_ub_q1_o60 -60.00 195.0 FORMAT "%5.1" /end CHARACTERISTIC
/begin CHARACTERISTIC TOLEWRLMX "Ersatzwert Öltemperatur bei fehlerhafter CAN-Botschaft" VALUE 0x819CC6 KwUb 255.0 temp_ub_q1_o60 -60.00 195.0 FORMAT "%5.1" /end CHARACTERISTIC
/begin CHARACTERISTIC TSKRLDAB "Zeitkonstante für schnelle LDR-Absenkung" CURVE 0x826EFC GklWUw 3276.7499992 zk50msxs_uw_b3276p8 0.050000762951 3276.8000000 FORMAT "%12.7"
 /begin AXIS_DESCR COM_AXIS nmot_w nmot_uw_q0p25 8 0.00 16383.75 AXIS_PTS_REF SNM08LDUW /end AXIS_DESCR
/end CHARACTERISTIC
/begin CHARACTERISTIC TSKRLDAU "Zeitkonstante für schnelle LDR-Aufregelung" CURVE 0x826F0C GklWUw 3276.7499992 zk50msxs_uw_b3276p8 0.050000762951 3276.8000000 FORMAT "%12.7"
 /begin AXIS_DESCR COM_AXIS nmot_w nmot_uw_q0p25 8 0.00 16383.75 AXIS_PTS_REF SNM08LDUW /end AXIS_DESCR
/end CHARACTERISTIC
/begin CHARACTERISTIC TSTLDOBA "Maximalzeit bis Start Overboost Aktiv Zeit" VALUE 0x819CA9 KwUb 255.0 t1sxs_ub_b255 0.00 255.0 FORMAT "%5.1" /end CHARACTERISTIC
/begin CHARACTERISTIC TUHEMN "Minimale Solltemperatur abhängig vom Heizungspoti" CURVE 0x81ACB0 KlAUbSstUbWUb 191.3 temp_ub_q0p75_o48 -48.00 143.3 FORMAT "%5.1"
 /begin AXIS_DESCR STD_AXIS uhepoti dez 5 0.00 255.0 FORMAT "%5.1" DEPOSIT ABSOLUTE /end AXIS_DESCR
/end CHARACTERISTIC
/begin CHARACTERISTIC TUHEMX "Maximale Solltemperatur abhängig vom Heizungspoti" CURVE 0x81ACBB KlAUbSstUbWUb 191.3 temp_ub_q0p75_o48 -48.00 143.3 FORMAT "%5.1"
 /begin AXIS_DESCR STD_AXIS uhepoti dez 5 0.00 255.0 FORMAT "%5.1" DEPOSIT ABSOLUTE /end AXIS_DESCR
/end CHARACTERISTIC
/begin CHARACTERISTIC TUMEWKMTR "Ersatzwert Umgebungstemperatur in KMTR" VALUE 0x81ACC6 KwUb 191.3 temp_ub_q0p75_o48 -48.00 143.3 FORMAT "%5.1" /end CHARACTERISTIC
/begin CHARACTERISTIC TUMKLIHDV "Umgebgungstemperatur-Schwelle für Lüfter schnell-Hochlauf" VALUE 0x81ACC7 KwUb 191.3 temp_ub_q0p75_o48 -48.00 143.3 FORMAT "%5.1" /end CHARACTERISTIC
/begin CHARACTERISTIC TUMLUESEW "Ersatzwert Umgebungstemperatur" VALUE 0x81ACC8 KwUb 191.3 temp_ub_q0p75_o48 -48.00 143.3 FORMAT "%5.1" /end CHARACTERISTIC
/begin CHARACTERISTIC TUMMX_LDRLMX_IMPL "" VALUE 0x819CC7 KwUb 191.3 temp_ub_q0p75_o48 -48.00 143.3 FORMAT "%5.1" READ_ONLY /end CHARACTERISTIC
/begin CHARACTERISTIC TUPOTMN "Minimale Solltemperatur abhängig von Climatronic" CURVE 0x81ACC9 KlAUbSstUbWUb 191.3 temp_ub_q0p75_o48 -48.00 143.3 FORMAT "%5.1"
 /begin AXIS_DESCR STD_AXIS upotpwm spg_ub_b5 5 0.00 4.980 FORMAT "%5.3" DEPOSIT ABSOLUTE /end AXIS_DESCR
/end CHARACTERISTIC
/begin CHARACTERISTIC TUPOTMX "Maximale Solltemperatur abhängig von Climatronic" CURVE 0x81ACD4 KlAUbSstUbWUb 191.3 temp_ub_q0p75_o48 -48.00 143.3 FORMAT "%5.1"
 /begin AXIS_DESCR STD_AXIS upotpwm spg_ub_b5 5 0.00 4.980 FORMAT "%5.3" DEPOSIT ABSOLUTE /end AXIS_DESCR
/end CHARACTERISTIC
/begin CHARACTERISTIC TVDK "Verzögerungszeit nach Schließen der Drosselklappe" VALUE 0x8115E9 KwUb 5.100 t20msxs_ub_b5p1 0.00 5.100 FORMAT "%5.3" /end CHARACTERISTIC
/begin CHARACTERISTIC TVETREW "Ersatzwert Tastverhältnis Thermostat" VALUE 0x81ACDF KwUb 99.61 tv_ub_b100 0.00 99.61 FORMAT "%5.2" /end CHARACTERISTIC
/begin CHARACTERISTIC TVETRMN "Minimales Tastverhältnis Thermostat" VALUE 0x81ACE0 KwUb 99.61 tv_ub_b100 0.00 99.61 FORMAT "%5.2" /end CHARACTERISTIC
/begin CHARACTERISTIC TVETRMX "Maximales Tastverhältnis Thermostat" VALUE 0x81ACE1 KwUb 99.61 tv_ub_b100 0.00 99.61 FORMAT "%5.2" /end CHARACTERISTIC
/begin CHARACTERISTIC TVKLIHDV1 "Tastverhältnis für Lüfter schnell-Hochlauf" VALUE 0x81ACE2 KwUb 99.61 tv_ub_b100 0.00 99.61 FORMAT "%5.2" /end CHARACTERISTIC
/begin CHARACTERISTIC TVKLIHDV2 "Tastverhältnis für Lüfter schnell-Hochlauf" VALUE 0x81ACE3 KwUb 99.61 tv_ub_b100 0.00 99.61 FORMAT "%5.2" /end CHARACTERISTIC
/begin CHARACTERISTIC TVKOE1 "Verzögerungszeit für Kompressor EIN ( zur Momentreserve)" VALUE 0x8127B5 KwUb 5.100 t20msxs_ub_b5p1 0.00 5.100 FORMAT "%5.3" /end CHARACTERISTIC
/begin CHARACTERISTIC TVKOEOF "Verzögerungszeit für B_koe AUS" VALUE 0x8127B6 KwUb 5.100 t20msxs_ub_b5p1 0.00 5.100 FORMAT "%5.3" /end CHARACTERISTIC
/begin CHARACTERISTIC TVKOEP "Verzögerungszeit für Kompressor EIN ( zur Momentreserve)" CURVE 0x81A93D KlAUbSstUbWUb 5.100 t20msxs_ub_b5p1 0.00 5.100 FORMAT "%5.3"
 /begin AXIS_DESCR STD_AXIS pkodrc p_q0p2 8 0.00 51.00 FORMAT "%5.2" DEPOSIT ABSOLUTE /end AXIS_DESCR
/end CHARACTERISTIC
/begin CHARACTERISTIC TVKOEV "Verzögerungszeit für Kompressoreinschalten (totzeit)" VALUE 0x8127B7 KwUb 5.100 t20msxs_ub_b5p1 0.00 5.100 FORMAT "%5.3" /end CHARACTERISTIC
/begin CHARACTERISTIC TVKOGANDEL "Verzögerungszeit für Kompressor EIN ( zur Momentreserve)" VALUE 0x8127B8 KwUb 5.100 t20msxs_ub_b5p1 0.00 5.100 FORMAT "%5.3" /end CHARACTERISTIC
/begin CHARACTERISTIC TVKOSSIM "Verzögerungszeit für Simulation einer eingeschalteten Klimaanlage im Start" VALUE 0x81A94E KwUb 51.00 t200msxs_ub_b51 0.00 51.00 FORMAT "%5.2" /end CHARACTERISTIC
/begin CHARACTERISTIC TVKRSTAT "Verzögerungszeit KR stationär Betrieb" VALUE 0x81156E KwUb 25.50 t100msxs_ub_b25p5 0.00 25.50 FORMAT "%5.2" /end CHARACTERISTIC
/begin CHARACTERISTIC TVKUPPL "Verzögerungszeit für die Information des Kupplungsschalter" VALUE 0x8115EA KwUb 5.100 t20msxs_ub_b5p1 0.00 5.100 FORMAT "%5.3" /end CHARACTERISTIC
/begin CHARACTERISTIC TVLAMRLMN "Verzögerungszeit für Lambdasollvorsteuerung bei rl < RLLAMMN" CURVE 0x819244 GklWUb 25.50 t100msxs_ub_b25p5 0.00 25.50 FORMAT "%5.2"
 /begin AXIS_DESCR COM_AXIS nmot nmot_ub_q40 7 0.00 10200. AXIS_PTS_REF SNM07ESUB /end AXIS_DESCR
/end CHARACTERISTIC
/begin CHARACTERISTIC TVLDMN "Untere Tastverhältnisbegrenzung für LDR" VALUE 0x819D4A KwUb 99.61 tv_ub_b100 0.00 99.61 FORMAT "%5.2" /end CHARACTERISTIC
/begin CHARACTERISTIC TVLDMX "Obere Tastverhältnisbegrenzung für LDR" VALUE 0x81FB3E KwSw 327.6750 tv_sw_q0p005 -163.8400 163.8350 FORMAT "%8.4" /end CHARACTERISTIC
/begin CHARACTERISTIC TVLDOBSO "Verzögerungszeit für Abbruch Haltephase" VALUE 0x819CAA KwUb 12.75 t50msxs_ub_b12p75 0.00 12.75 FORMAT "%5.2" /end CHARACTERISTIC
/begin CHARACTERISTIC TVLLR "Einschaltverzögerung: B_llri bei Überdrehzahl" VALUE 0x8115EB KwUb 5.100 t20msxs_ub_b5p1 0.00 5.100 FORMAT "%5.3" /end CHARACTERISTIC
/begin CHARACTERISTIC TVLLRI_0_A "Verzögerungszeit für Freigabe I-Anteil nach Start" CURVE 0x8115EC KlAUbSstUbWUb 5.100 t20msxs_ub_b5p1 0.00 5.100 FORMAT "%5.3"
 /begin AXIS_DESCR STD_AXIS tmot temp_ub_q0p75_o48 6 -48.00 143.3 FORMAT "%5.1" DEPOSIT ABSOLUTE /end AXIS_DESCR
/end CHARACTERISTIC
/begin CHARACTERISTIC TVLLRI_1_A "Verzögerungszeit für Freigabe I-Anteil nach Start" CURVE 0x8115F9 KlAUbSstUbWUb 5.100 t20msxs_ub_b5p1 0.00 5.100 FORMAT "%5.3"
 /begin AXIS_DESCR STD_AXIS tmot temp_ub_q0p75_o48 6 -48.00 143.3 FORMAT "%5.1" DEPOSIT ABSOLUTE /end AXIS_DESCR
/end CHARACTERISTIC
/begin CHARACTERISTIC TVLLRPD "Maximale Verzögerungszeit für Freigabe PD-Anteil nach Start" CURVE 0x811606 KlAUbSstUbWUb 5.100 t20msxs_ub_b5p1 0.00 5.100 FORMAT "%5.3"
 /begin AXIS_DESCR STD_AXIS tmot temp_ub_q0p75_o48 6 -48.00 143.3 FORMAT "%5.1" DEPOSIT ABSOLUTE /end AXIS_DESCR
/end CHARACTERISTIC
/begin CHARACTERISTIC TVLLRSTE_0_A "Zwangsbedingung Leerlaufregelung nach B_stend" VALUE 0x81611A KwUb 5.100 t20msxs_ub_b5p1 0.00 5.100 FORMAT "%5.3" /end CHARACTERISTIC
/begin CHARACTERISTIC TVLLRSTE_1_A "Zwangsbedingung Leerlaufregelung nach B_stend" VALUE 0x81611B KwUb 5.100 t20msxs_ub_b5p1 0.00 5.100 FORMAT "%5.3" /end CHARACTERISTIC
/begin CHARACTERISTIC TVLU1MN "Festwert minimales Tastverhältnis Lüfter 1" VALUE 0x81ACE4 KwUb 99.61 tv_ub_b100 0.00 99.61 FORMAT "%5.2" /end CHARACTERISTIC
/begin CHARACTERISTIC TVLU1MX "Festwert Maximales Tastverhältnis Lüfter 1" VALUE 0x81ACE5 KwUb 99.61 tv_ub_b100 0.00 99.61 FORMAT "%5.2" /end CHARACTERISTIC
/begin CHARACTERISTIC TVLU2MN "Festwert minimales Tastverhältnis Lüfter 2" VALUE 0x81ACE6 KwUb 99.61 tv_ub_b100 0.00 99.61 FORMAT "%5.2" /end CHARACTERISTIC
/begin CHARACTERISTIC TVLU2MX "Festwert Maximales Tastverhältnis Lüfter 2" VALUE 0x81ACE7 KwUb 99.61 tv_ub_b100 0.00 99.61 FORMAT "%5.2" /end CHARACTERISTIC
/begin CHARACTERISTIC TVLUESETR "Tastverhältnis Ansteuerung elektr. Thermostatventil bei Lüfterausfall" VALUE 0x81ACE8 KwUb 99.61 tv_ub_b100 0.00 99.61 FORMAT "%5.2" /end CHARACTERISTIC
/begin CHARACTERISTIC TVLUESICEW "Ersatzwert Istzustand Lüfteransteuerung bei Endstufenfehler" VALUE 0x81ACE9 KwUb 99.61 tv_ub_b100 0.00 99.61 FORMAT "%5.2" /end CHARACTERISTIC
/begin CHARACTERISTIC TVLUESSEW "Ersatzwert Lüfteransteuerung bei schaltbaren Lüftern" VALUE 0x81ACEA KwUb 99.61 tv_ub_b100 0.00 99.61 FORMAT "%5.2" /end CHARACTERISTIC
/begin CHARACTERISTIC TVNL1OFF "Ansteuertastverhältnis Lüfter 1 bei Ende Nachlaufzeit KMTR" VALUE 0x81ACEB KwUb 99.61 tv_ub_b100 0.00 99.61 FORMAT "%5.2" /end CHARACTERISTIC
/begin CHARACTERISTIC TVNL2OFF "Ansteuertastverhältnis Lüfter 2 bei Ende Nachlaufzeit KMTR" VALUE 0x81ACEC KwUb 99.61 tv_ub_b100 0.00 99.61 FORMAT "%5.2" /end CHARACTERISTIC
/begin CHARACTERISTIC TVNLETR "Tastverhältnis Thermostat im Nachlauf" VALUE 0x81ACED KwUb 99.61 tv_ub_b100 0.00 99.61 FORMAT "%5.2" /end CHARACTERISTIC
/begin CHARACTERISTIC TVNLL1 "Tastverhältnis Lüfter 1 im Nachlauf (Initialiserung AccumulatorLimited_1)" VALUE 0x81ACEE KwUb 99.61 tv_ub_b100 0.00 99.61 FORMAT "%5.2" /end CHARACTERISTIC
/begin CHARACTERISTIC TVNLL2 "Tastverhältnis Lüfter 2 im Nachlauf (Initialisierung AccmulatorLimited)" VALUE 0x81ACEF KwUb 99.61 tv_ub_b100 0.00 99.61 FORMAT "%5.2" /end CHARACTERISTIC
/begin CHARACTERISTIC TVNLT1 "Ansteuerung Lüfter 1 im Nachlauf für Hauptrelaisprüfung" VALUE 0x81ACF0 KwUb 99.61 tv_ub_b100 0.00 99.61 FORMAT "%5.2" /end CHARACTERISTIC
/begin CHARACTERISTIC TVNLT2 "Ansteuerung Lüfter 2 im Nachlauf für Hauptrelaisprüfung" VALUE 0x81ACF1 KwUb 99.61 tv_ub_b100 0.00 99.61 FORMAT "%5.2" /end CHARACTERISTIC
/begin CHARACTERISTIC TVNLTETR "Ansteuerung elektr. Thermostatventil im Nachlauf für Hauptrelaisprüfung" VALUE 0x81ACF2 KwUb 99.61 tv_ub_b100 0.00 99.61 FORMAT "%5.2" /end CHARACTERISTIC
/begin CHARACTERISTIC TVSTETR "Tastverhältnis Thermostat im Startbereich" VALUE 0x81ACF3 KwUb 99.61 tv_ub_b100 0.00 99.61 FORMAT "%5.2" /end CHARACTERISTIC
/begin CHARACTERISTIC TVSTL1 "Festwert Tastverhältnis Lüfter 1 Zeitspanne nach Start" VALUE 0x81ACF4 KwUb 99.61 tv_ub_b100 0.00 99.61 FORMAT "%5.2" /end CHARACTERISTIC
/begin CHARACTERISTIC TVSTL2 "Festwert Tastverhältnis Lüfter 2 Zeitspanne nach Start" VALUE 0x81ACF5 KwUb 99.61 tv_ub_b100 0.00 99.61 FORMAT "%5.2" /end CHARACTERISTIC
/begin CHARACTERISTIC TZKNLL1 "Zeitkonstante Rampe Regelanteil Tastverhältnis Lüfter 1" VALUE 0x81ACF6 KwUb 99.61 tv_ub_b100 0.00 99.61 FORMAT "%5.2" /end CHARACTERISTIC
/begin CHARACTERISTIC TZKNLL2 "Zeitkonstante Rampe Regelanteil Tastverhältnis Lüfter 2" VALUE 0x81ACF7 KwUb 99.61 tv_ub_b100 0.00 99.61 FORMAT "%5.2" /end CHARACTERISTIC
/begin CHARACTERISTIC UMDYLDR "Umschaltschwelle Dynamik LDR" VALUE 0x819C58 KwSb 2550. p_sb_q10 -1280. 1270. FORMAT "%5.0" /end CHARACTERISTIC
/begin CHARACTERISTIC VFZGEW "KMTR-Ersatzwert f. Fahrzeuggeschwindigkeit" VALUE 0x81ACF8 KwUb 318.8 vfzg_ub_q1p25 0.00 318.8 FORMAT "%5.1" /end CHARACTERISTIC
/begin CHARACTERISTIC VKO "Geschwindigkeitsschwelle für AC-Steuerung" VALUE 0x8127B9 KwUb 318.8 vfzg_ub_q1p25 0.00 318.8 FORMAT "%5.1" /end CHARACTERISTIC
/begin CHARACTERISTIC VKOAO "Obere Geschwindigkeitsschwelle für Kompressorabschaltung" VALUE 0x8127BA KwUb 318.8 vfzg_ub_q1p25 0.00 318.8 FORMAT "%5.1" /end CHARACTERISTIC
/begin CHARACTERISTIC VKOB "Geschwindingkeitsschwelle für Ko-Steuerung in Beschleunigung" VALUE 0x8127BB KwUb 318.8 vfzg_ub_q1p25 0.00 318.8 FORMAT "%5.1" /end CHARACTERISTIC
/begin CHARACTERISTIC VLLR "Fahrzeuggeschwindigkeitsschwelle für Leerlaufregelung" VALUE 0x811613 KwUb 318.8 vfzg_ub_q1p25 0.00 318.8 FORMAT "%5.1" /end CHARACTERISTIC
/begin CHARACTERISTIC VNVKO "Gangerkennungsschwelle für KO-Ausschalten bei Vollast" VALUE 0x817A8A KwUw 511.9922 qnv_uw_b512 0.00 511.9922 FORMAT "%8.4" /end CHARACTERISTIC
/begin CHARACTERISTIC VNVKOB "Gangerkennungsschwelle für KO-Abschaltung bei Volllast" VALUE 0x817A8C KwUw 511.9922 qnv_uw_b512 0.00 511.9922 FORMAT "%8.4" /end CHARACTERISTIC
/begin CHARACTERISTIC WKRLZOF "Festwerteblock: ZW-Offset für geführte Zylinder" VAL_BLK 0x81156F KwbUb 191.3 zw_ub_qn0p75 -191.3 0.00 FORMAT "%5.1" NUMBER 8 /end CHARACTERISTIC
/begin CHARACTERISTIC WKRLZOFEKS "ZW-Offset für geführte Zylinder bei KS-Fehler" VALUE 0x811577 KwUb 191.3 zw_ub_qn0p75 -191.3 0.00 FORMAT "%5.1" /end CHARACTERISTIC
/begin CHARACTERISTIC WPEDKO "Pedalwinkelschwelle für KO-Ausschaltung" CURVE 0x8127BC GklWUb 99.61 rel_ub_b100 0.00 99.61 FORMAT "%5.2"
 /begin AXIS_DESCR COM_AXIS nmot nmot_ub_q40 8 0.00 10200. AXIS_PTS_REF SNM08KOUB /end AXIS_DESCR
/end CHARACTERISTIC
/begin CHARACTERISTIC ZDLBTS "Zeitkonstante Delta Lambda Bauteileschutz" VALUE 0x81DD30 KwUw 6553.4999985 zk100msxs_uw_b6553 0.10000152590 6553.6000000 FORMAT "%12.7" /end CHARACTERISTIC
/begin CHARACTERISTIC ZDRLKRA "Zeitkonstante für Tiefpass Lastgradient in KR" VALUE 0x815C7E KwUw 2.5499998474 zk10msxs_uw_b655 0.010000152590 2.5600000000 FORMAT "%12.10" /end CHARACTERISTIC
/begin CHARACTERISTIC ZFLASKH "Zeitkonstante für Übergang auf Lambda-Abgas-Vorgabe" VALUE 0x81975B KwUb 25.4996 zk100msxs_ub_b25p5 0.100392 25.6000 FORMAT "%7.4" /end CHARACTERISTIC
/begin CHARACTERISTIC ZKETR "Zeitkonstante I-Regler Thermostatregelung" VALUE 0x81ACF9 KwUb 254.996 zk1sxs_ub_b255 1.00392 256.000 FORMAT "%7.3" /end CHARACTERISTIC
/begin CHARACTERISTIC ZKLAMFAW "Zeitkonstante Filterung Anfettung durch Fahrerwunsch" VALUE 0x81DB7C KwUw 3276.7499992 zk50msxs_uw_b3276p8 0.050000762951 3276.8000000 FORMAT "%12.7" /end CHARACTERISTIC
/begin CHARACTERISTIC ZKLANSWL "Zeitkonstante Filterung lamnswl_w" VALUE 0x815A80 KwUw 655.34999985 zk10msxs_uw_b655 0.010000152590 655.36000000 FORMAT "%12.8" /end CHARACTERISTIC
/begin CHARACTERISTIC ZKNLST "Filterzeitkonstante Nachlaufzeitberechnung" VALUE 0x81ACFA KwUb 254.996 zk1sxs_ub_b255 1.00392 256.000 FORMAT "%7.3" /end CHARACTERISTIC
/begin CHARACTERISTIC ZKQMAXL1 "Zeitkonstante für Rampenabsteuerung Lüfter 1 im Nachlauf" VALUE 0x81ACFB KwUb 254.996 zk1sxs_ub_b255 1.00392 256.000 FORMAT "%7.3" /end CHARACTERISTIC
/begin CHARACTERISTIC ZKQMAXL2 "Zeitkonstante für Rampenabsteuerung Lüfter 2 im Nachlauf" VALUE 0x81ACFC KwUb 254.996 zk1sxs_ub_b255 1.00392 256.000 FORMAT "%7.3" /end CHARACTERISTIC
/begin CHARACTERISTIC ZKTMSN "Filterzeitkonstante Soll-Motortemperatur bei neg. Gradient" VALUE 0x81ACFD KwUb 254.996 zk1sxs_ub_b255 1.00392 256.000 FORMAT "%7.3" /end CHARACTERISTIC
/begin CHARACTERISTIC ZKTMSP "Filterzeitkonstante Soll-Motortemperatur bei pos. Gradient" VALUE 0x81ACFE KwUb 254.996 zk1sxs_ub_b255 1.00392 256.000 FORMAT "%7.3" /end CHARACTERISTIC
/begin CHARACTERISTIC ZKWLAFWL "Zeitkonstante Wichtung Offset Lambda-Motor-Soll" VALUE 0x81924B KwUb 25.4996 zk100msxs_ub_b25p5 0.100392 25.6000 FORMAT "%7.4" /end CHARACTERISTIC
/begin CHARACTERISTIC ZLBTS "Zeitkonstante Lambda Bauteileschutz" VALUE 0x81DD32 KwUw 6553.4999985 zk100msxs_uw_b6553 0.10000152590 6553.6000000 FORMAT "%12.7" /end CHARACTERISTIC
/begin CHARACTERISTIC ZNGKRA "Zeitkonstante für Tiefpaß Drehzahlgradient" VALUE 0x815C80 KwUw 2.5499998474 zk10msxs_uw_b655 0.010000152590 2.5600000000 FORMAT "%12.10" /end CHARACTERISTIC
/begin CHARACTERISTIC ZVSKS "Zeitkonstante Tiefpaßfilter für Kraftstoffverbrauch" VALUE 0x81ACFF KwUb 254.996 zk1sxs_ub_b255 1.00392 256.000 FORMAT "%7.3" /end CHARACTERISTIC
/begin CHARACTERISTIC ZYRKR "Zylinderzuordnung für maximale Referenzpegelbegrenzung Klopfregelung" VALUE 0x819961 KwUb 255.0 dez 0.00 255.0 FORMAT "%5.1" /end CHARACTERISTIC
/begin MEASUREMENT anztib0_w "ti-Einspritzzähler bis Startende Einspritzung" UWORD dez 1 100 0 65535 FORMAT "%8.2" ECU_ADDRESS 0x382100 /end MEASUREMENT
/begin MEASUREMENT anztib1_w "ti-Einspritzzähler ab Startende Einspritzung" UWORD dez 1 100 0 65535 FORMAT "%8.2" ECU_ADDRESS 0x382102 /end MEASUREMENT
/begin MEASUREMENT B_acres "Bedingung für Aufbau einer Drehmomentenreserve bei Klimabereitschaft" UWORD B_TRUE 1 100 0 1 BIT_MASK 0x800 FORMAT "%13.11" ECU_ADDRESS 0xFDA4 /end MEASUREMENT
/begin MEASUREMENT B_brlmx "Bedingung LDR Begrenzung der Maximalfuellung" UWORD B_TRUE 1 100 0 1 BIT_MASK 0x80 FORMAT "%13.11" ECU_ADDRESS 0xFD80 /end MEASUREMENT
/begin MEASUREMENT B_c95_g0 "Ansteuerung der Verstärkerstufe des CC195 (PIN G0)" UWORD B_TRUE 1 100 0 1 BIT_MASK 0x80 FORMAT "%13.11" ECU_ADDRESS 0xFD70 /end MEASUREMENT
/begin MEASUREMENT B_c95_g1 "Ansteuerung der Verstärkerstufe des CC195 (Pin G1)" UWORD B_TRUE 1 100 0 1 BIT_MASK 0x100 FORMAT "%13.11" ECU_ADDRESS 0xFD70 /end MEASUREMENT
/begin MEASUREMENT B_c95_g2 "Ansteuerung der Verstärkerstufe des CC195 (Pin G2)" UWORD B_TRUE 1 100 0 1 BIT_MASK 0x200 FORMAT "%13.11" ECU_ADDRESS 0xFD70 /end MEASUREMENT
/begin MEASUREMENT B_deaklue "Lüfterdeaktivierung beim Flash-Programmierung" UWORD B_TRUE 1 100 0 1 BIT_MASK 0x1 FORMAT "%13.11" ECU_ADDRESS 0xFDB0 /end MEASUREMENT
/begin MEASUREMENT B_deaklue1 "Deaktivierung Lüfter 1 beim Flash-Programmierung" UWORD B_TRUE 1 100 0 1 BIT_MASK 0x2 FORMAT "%13.11" ECU_ADDRESS 0xFDB0 /end MEASUREMENT
/begin MEASUREMENT B_deaklue2 "Deaktivierung Lüfter 2 beim Flash-Programmierung" UWORD B_TRUE 1 100 0 1 BIT_MASK 0x4 FORMAT "%13.11" ECU_ADDRESS 0xFDB0 /end MEASUREMENT
/begin MEASUREMENT B_drknv "handshake 10ms - KR.synchro" UWORD B_TRUE 1 100 0 1 BIT_MASK 0x4000 FORMAT "%13.11" ECU_ADDRESS 0xFD72 /end MEASUREMENT
/begin MEASUREMENT B_drlkrdy "Flag für n > NKRUM" UWORD B_TRUE 1 100 0 1 BIT_MASK 0x8000 FORMAT "%13.11" ECU_ADDRESS 0xFD72 /end MEASUREMENT
/begin MEASUREMENT B_dslafa "Anfoderung Kurztest oder Adaption in DSLSXXX" UBYTE B_TRUE 1 100 0 1 BIT_MASK 0x1 FORMAT "%13.11" ECU_ADDRESS 0x380A1B /end MEASUREMENT
/begin MEASUREMENT B_elues1 "Fehler Endstufe Motorlüfter 1" UWORD B_TRUE 1 100 0 1 BIT_MASK 0x8 FORMAT "%13.11" ECU_ADDRESS 0xFDB0 /end MEASUREMENT
/begin MEASUREMENT B_elues2 "Fehler Endstufe Motorlüfter 2" UWORD B_TRUE 1 100 0 1 BIT_MASK 0x10 FORMAT "%13.11" ECU_ADDRESS 0xFDB0 /end MEASUREMENT
/begin MEASUREMENT B_enllri "Freigabe Leerlaufregelung: I-Anteil" UWORD B_TRUE 1 100 0 1 BIT_MASK 0x2000 FORMAT "%13.11" ECU_ADDRESS 0xFD82 /end MEASUREMENT
/begin MEASUREMENT B_ensol "" UWORD B_TRUE 1 100 0 1 BIT_MASK 0x4000 FORMAT "%13.11" ECU_ADDRESS 0xFD82 /end MEASUREMENT
/begin MEASUREMENT B_fpwld_ok "Flashprogrammierungswunsch Lüfter deaktivieren durchgeführt" UWORD B_TRUE 1 100 0 1 BIT_MASK 0x20 FORMAT "%13.11" ECU_ADDRESS 0xFDB0 /end MEASUREMENT
/begin MEASUREMENT B_kl "Bedingung für erkannte Klopfer" UWORD B_TRUE 1 100 0 1 BIT_MASK 0x400 FORMAT "%13.11" ECU_ADDRESS 0xFD70 /end MEASUREMENT
/begin MEASUREMENT B_klahmx "Bedingung max. Kühlleistungsanhebung angefordert" UWORD B_TRUE 1 100 0 1 BIT_MASK 0x40 FORMAT "%13.11" ECU_ADDRESS 0xFDB0 /end MEASUREMENT
/begin MEASUREMENT B_kldynrm "Bedingung normales Klopfen bei adapt. Lastdynamik" UWORD B_TRUE 1 100 0 1 BIT_MASK 0x1 FORMAT "%13.11" ECU_ADDRESS 0xFD74 /end MEASUREMENT
/begin MEASUREMENT B_kldystk "Bedingung starkes Klopfen bei adapt. Lastdynamik" UWORD B_TRUE 1 100 0 1 BIT_MASK 0x2 FORMAT "%13.11" ECU_ADDRESS 0xFD74 /end MEASUREMENT
/begin MEASUREMENT B_klihdv "Bedingung schneller Lüfterhochlauf wegen Klima-Hochdruck" UWORD B_TRUE 1 100 0 1 BIT_MASK 0x80 FORMAT "%13.11" ECU_ADDRESS 0xFDB0 /end MEASUREMENT
/begin MEASUREMENT B_kmtre "Bedingung fehlerfreie KMTR Ansteuerung" UWORD B_TRUE 1 100 0 1 BIT_MASK 0x100 FORMAT "%13.11" ECU_ADDRESS 0xFDB0 /end MEASUREMENT
/begin MEASUREMENT B_ko "Bedingung Kompressor freigegeben" UWORD B_TRUE 1 100 0 1 BIT_MASK 0x1000 FORMAT "%13.11" ECU_ADDRESS 0xFDA4 /end MEASUREMENT
/begin MEASUREMENT B_koa "Bedingung für Kompressorausschalten" UWORD B_TRUE 1 100 0 1 BIT_MASK 0x2000 FORMAT "%13.11" ECU_ADDRESS 0xFDA4 /end MEASUREMENT
/begin MEASUREMENT B_kobaus "Bedingung für Kompressor bei Beschleunigung oder Last" UWORD B_TRUE 1 100 0 1 BIT_MASK 0x4000 FORMAT "%13.11" ECU_ADDRESS 0xFDA4 /end MEASUREMENT
/begin MEASUREMENT B_kobmnon "Minimale Einschaltzeit nach Ausschalten bei Beschleunigung oder Vollast" UWORD B_TRUE 1 100 0 1 BIT_MASK 0x8000 FORMAT "%13.11" ECU_ADDRESS 0xFDA4 /end MEASUREMENT
/begin MEASUREMENT B_kobped "Bedingung für Kompressor aus bei Beschleunigung über dwped" UWORD B_TRUE 1 100 0 1 BIT_MASK 0x1 FORMAT "%13.11" ECU_ADDRESS 0xFDA6 /end MEASUREMENT
/begin MEASUREMENT B_kobpedt "Bedingung für Kompressorausschalten über dwped nach timer" UWORD B_TRUE 1 100 0 1 BIT_MASK 0x2 FORMAT "%13.11" ECU_ADDRESS 0xFDA6 /end MEASUREMENT
/begin MEASUREMENT B_kobwped "Bedingung : für Kompressorausschalten über wped" UWORD B_TRUE 1 100 0 1 BIT_MASK 0x4 FORMAT "%13.11" ECU_ADDRESS 0xFDA6 /end MEASUREMENT
/begin MEASUREMENT B_kobwpedt "Bedingung: für Kompressorausschalten über wped nach timer" UWORD B_TRUE 1 100 0 1 BIT_MASK 0x8 FORMAT "%13.11" ECU_ADDRESS 0xFDA6 /end MEASUREMENT
/begin MEASUREMENT B_koe "Bedingung für Kompressoreinschalten" UWORD B_TRUE 1 100 0 1 BIT_MASK 0x10 FORMAT "%13.11" ECU_ADDRESS 0xFDA6 /end MEASUREMENT
/begin MEASUREMENT B_koena "Bedingung Kompressor freigegeben" UWORD B_TRUE 1 100 0 1 BIT_MASK 0x20 FORMAT "%13.11" ECU_ADDRESS 0xFDA6 /end MEASUREMENT
/begin MEASUREMENT B_koenat "Bedingung Kompressor freigegeben nach Timer" UWORD B_TRUE 1 100 0 1 BIT_MASK 0x40 FORMAT "%13.11" ECU_ADDRESS 0xFDA6 /end MEASUREMENT
/begin MEASUREMENT B_kogandel "Bedingung: Verzögerung des Kompressoreinschaltens nach Gangwechsel" UWORD B_TRUE 1 100 0 1 BIT_MASK 0x80 FORMAT "%13.11" ECU_ADDRESS 0xFDA6 /end MEASUREMENT
/begin MEASUREMENT B_koganped "Bedingung für Kompressorabschalten beim Gangwechsel" UWORD B_TRUE 1 100 0 1 BIT_MASK 0x100 FORMAT "%13.11" ECU_ADDRESS 0xFDA6 /end MEASUREMENT
/begin MEASUREMENT B_koint "Bedingung für Kompressorausschalten  aus  Motormanagement" UWORD B_TRUE 1 100 0 1 BIT_MASK 0x200 FORMAT "%13.11" ECU_ADDRESS 0xFDA6 /end MEASUREMENT
/begin MEASUREMENT B_komnoff "Bedingung Kompresszor-Mindestabschaltzeit abgelaufen" UWORD B_TRUE 1 100 0 1 BIT_MASK 0x400 FORMAT "%13.11" ECU_ADDRESS 0xFDA6 /end MEASUREMENT
/begin MEASUREMENT B_komnon "Bedingung Kompresszor-Mindesteinschaltzeit abgelaufen" UWORD B_TRUE 1 100 0 1 BIT_MASK 0x800 FORMAT "%13.11" ECU_ADDRESS 0xFDA6 /end MEASUREMENT
/begin MEASUREMENT B_komxoff "Bedingung Kompresszor-Höchstabschaltzeit abgelaufen" UWORD B_TRUE 1 100 0 1 BIT_MASK 0x1000 FORMAT "%13.11" ECU_ADDRESS 0xFDA6 /end MEASUREMENT
/begin MEASUREMENT B_kooff "Bedingung für hartes Kompressorabschalten" UWORD B_TRUE 1 100 0 1 BIT_MASK 0x2000 FORMAT "%13.11" ECU_ADDRESS 0xFDA6 /end MEASUREMENT
/begin MEASUREMENT B_koofft "Bedingung für hartes Kompressorabschalten nach Timer" UWORD B_TRUE 1 100 0 1 BIT_MASK 0x4000 FORMAT "%13.11" ECU_ADDRESS 0xFDA6 /end MEASUREMENT
/begin MEASUREMENT B_kosrc "Bedingung für Klimakompressors-Leistungsreduzierung" UWORD B_TRUE 1 100 0 1 BIT_MASK 0x8000 FORMAT "%13.11" ECU_ADDRESS 0xFDA6 /end MEASUREMENT
/begin MEASUREMENT B_kotmsk "Bedingung für Klimataste ein" UWORD B_TRUE 1 100 0 1 BIT_MASK 0x1 FORMAT "%13.11" ECU_ADDRESS 0xFDA8 /end MEASUREMENT
/begin MEASUREMENT B_kotmsko "Bedingung für Klimataste ein  nach Timer" UWORD B_TRUE 1 100 0 1 BIT_MASK 0x2 FORMAT "%13.11" ECU_ADDRESS 0xFDA8 /end MEASUREMENT
/begin MEASUREMENT B_kov "Bedingung Klimakompressor verboten" UWORD B_TRUE 1 100 0 1 BIT_MASK 0x4 FORMAT "%13.11" ECU_ADDRESS 0xFDA8 /end MEASUREMENT
/begin MEASUREMENT B_kovdown "Überwachungszeit  von  B_ko  nach Reset B_kov  zum B_kotmsko(bidirek. Schnitst.)" UWORD B_TRUE 1 100 0 1 BIT_MASK 0x8 FORMAT "%13.11" ECU_ADDRESS 0xFDA8 /end MEASUREMENT
/begin MEASUREMENT B_kow "Bedingung Kompressor freigegeben" UWORD B_TRUE 1 100 0 1 BIT_MASK 0x10 FORMAT "%13.11" ECU_ADDRESS 0xFDA8 /end MEASUREMENT
/begin MEASUREMENT B_kr "Bedingung Klopfregelung aktiv" UWORD B_TRUE 1 100 0 1 BIT_MASK 0x800 FORMAT "%13.11" ECU_ADDRESS 0xFD70 /end MEASUREMENT
/begin MEASUREMENT B_kra "Bedingung KR-Adaption aktiv" UWORD B_TRUE 1 100 0 1 BIT_MASK 0x1000 FORMAT "%13.11" ECU_ADDRESS 0xFD70 /end MEASUREMENT
/begin MEASUREMENT B_krafrz "Bedingung: KR-Adaption ist eingefroren" UWORD B_TRUE 1 100 0 1 BIT_MASK 0x2000 FORMAT "%13.11" ECU_ADDRESS 0xFD70 /end MEASUREMENT
/begin MEASUREMENT B_krdws "Bedingung Klopfregelung Sicherheitsspätverstellung" UWORD B_TRUE 1 100 0 1 BIT_MASK 0x4000 FORMAT "%13.11" ECU_ADDRESS 0xFD70 /end MEASUREMENT
/begin MEASUREMENT B_krfdks "Bedingung Freigabe Diagnose KS" UWORD B_TRUE 1 100 0 1 BIT_MASK 0x8000 FORMAT "%13.11" ECU_ADDRESS 0xFD70 /end MEASUREMENT
/begin MEASUREMENT B_krfrz "Bedingung: KR ist eingefroren" UWORD B_TRUE 1 100 0 1 BIT_MASK 0x1 FORMAT "%13.11" ECU_ADDRESS 0xFD72 /end MEASUREMENT
/begin MEASUREMENT B_krldy "Bedingung Lastdynamik für Klopferkennung aktiv" UWORD B_TRUE 1 100 0 1 BIT_MASK 0x4 FORMAT "%13.11" ECU_ADDRESS 0xFD74 /end MEASUREMENT
/begin MEASUREMENT B_krldya "Bedingung Lastdynamikvorhalt und -adaption aktiv" UWORD B_TRUE 1 100 0 1 BIT_MASK 0x8 FORMAT "%13.11" ECU_ADDRESS 0xFD74 /end MEASUREMENT
/begin MEASUREMENT B_krldyafok "" UWORD B_TRUE 1 100 0 1 BIT_MASK 0x10 FORMAT "%13.11" ECU_ADDRESS 0xFD74 /end MEASUREMENT
/begin MEASUREMENT B_krldyf "Bedingung Adaption Lastdynamikvorhalt nach früh freigegeben" UWORD B_TRUE 1 100 0 1 BIT_MASK 0x20 FORMAT "%13.11" ECU_ADDRESS 0xFD74 /end MEASUREMENT
/begin MEASUREMENT B_krldyn "Bedingung Lastdynamik für Stationäradaption aktiv" UWORD B_TRUE 1 100 0 1 BIT_MASK 0x40 FORMAT "%13.11" ECU_ADDRESS 0xFD74 /end MEASUREMENT
/begin MEASUREMENT B_krldyv "Bedingung Lastschwelle für Dynamikvorhalt überschritten" UWORD B_TRUE 1 100 0 1 BIT_MASK 0x80 FORMAT "%13.11" ECU_ADDRESS 0xFD74 /end MEASUREMENT
/begin MEASUREMENT B_krlz "KR-Leitzylinderfunktion aktiv" UWORD B_TRUE 1 100 0 1 BIT_MASK 0x2 FORMAT "%13.11" ECU_ADDRESS 0xFD72 /end MEASUREMENT
/begin MEASUREMENT B_krlzn "Drehzahlschwelle für KR-Leitzylinderfunktion überschritten" UWORD B_TRUE 1 100 0 1 BIT_MASK 0x3fc FORMAT "%13.11" ECU_ADDRESS 0xFD72 /end MEASUREMENT
/begin MEASUREMENT B_krndy "Bedingung Drehzahldynamik für Klopferkennung aktiv" UWORD B_TRUE 1 100 0 1 BIT_MASK 0x100 FORMAT "%13.11" ECU_ADDRESS 0xFD74 /end MEASUREMENT
/begin MEASUREMENT B_krndyn "Bedingung Drehzahldynamik für Stationäradaption aktiv" UWORD B_TRUE 1 100 0 1 BIT_MASK 0x200 FORMAT "%13.11" ECU_ADDRESS 0xFD74 /end MEASUREMENT
/begin MEASUREMENT B_krnl "Notlauf Klopferkennung bei Phasennotlauf und/oder Doppelzündung" UWORD B_TRUE 1 100 0 1 BIT_MASK 0x8 FORMAT "%13.11" ECU_ADDRESS 0xFD72 /end MEASUREMENT
/begin MEASUREMENT B_krnlr "Notlauf KR für V6, V8 mit 2 KS bei Fehler eines KS" UWORD B_TRUE 1 100 0 1 BIT_MASK 0x10 FORMAT "%13.11" ECU_ADDRESS 0xFD72 /end MEASUREMENT
/begin MEASUREMENT B_krstatb "Bedingung stationärer KR-Betrieb" UWORD B_TRUE 1 100 0 1 BIT_MASK 0x20 FORMAT "%13.11" ECU_ADDRESS 0xFD72 /end MEASUREMENT
/begin MEASUREMENT B_krvf "Bedingung für Abregelung der KR-ZW-Spätverstellung" UWORD B_TRUE 1 100 0 1 BIT_MASK 0x40 FORMAT "%13.11" ECU_ADDRESS 0xFD72 /end MEASUREMENT
/begin MEASUREMENT B_krwa "Klopfregelung am Anschlag" UWORD B_TRUE 1 100 0 1 BIT_MASK 0x80 FORMAT "%13.11" ECU_ADDRESS 0xFD72 /end MEASUREMENT
/begin MEASUREMENT B_kseb1 "Bedingung KS-Fehler Bank 1" UWORD B_TRUE 1 100 0 1 BIT_MASK 0x100 FORMAT "%13.11" ECU_ADDRESS 0xFD72 /end MEASUREMENT
/begin MEASUREMENT B_kseb2 "Bedingung KS-Fehler Bank 2" UWORD B_TRUE 1 100 0 1 BIT_MASK 0x200 FORMAT "%13.11" ECU_ADDRESS 0xFD72 /end MEASUREMENT
/begin MEASUREMENT B_kvakbi "Bedingung aufsummierter Kraftstoffverbrauch ist übergelaufen" UWORD B_TRUE 1 100 0 1 BIT_MASK 0x400 FORMAT "%13.11" ECU_ADDRESS 0xFDAE /end MEASUREMENT
/begin MEASUREMENT B_ladap "Bedingung Eintritt in Lastdynamikadaption" UWORD B_TRUE 1 100 0 1 BIT_MASK 0x400 FORMAT "%13.11" ECU_ADDRESS 0xFD74 /end MEASUREMENT
/begin MEASUREMENT B_lalgf "Bedingung Laufgrenze ""Lambda fett"" aktiv" UWORD B_TRUE 1 100 0 1 BIT_MASK 0x40 FORMAT "%13.11" ECU_ADDRESS 0xFD58 /end MEASUREMENT
/begin MEASUREMENT B_lambts "Lambda für Bauteileschutz ist aktiv" UWORD B_TRUE 1 100 0 1 BIT_MASK 0x80 FORMAT "%13.11" ECU_ADDRESS 0xFD58 /end MEASUREMENT
/begin MEASUREMENT B_lamdiag "Lambdasoll von Diagnosefunktionen angefordert" UWORD B_TRUE 1 100 0 1 BIT_MASK 0x100 FORMAT "%13.11" ECU_ADDRESS 0xFD58 /end MEASUREMENT
/begin MEASUREMENT B_lamfas "Verbot  für Lambda Fahrerwunsch Aktivierung" UBYTE B_TRUE 1 100 0 1 BIT_MASK 0x1 FORMAT "%13.11" ECU_ADDRESS 0x380A03 /end MEASUREMENT
/begin MEASUREMENT B_lamka "Lambda für Kat-Ausräumen aktiv" UWORD B_TRUE 1 100 0 1 BIT_MASK 0x200 FORMAT "%13.11" ECU_ADDRESS 0xFD58 /end MEASUREMENT
/begin MEASUREMENT B_lamkh "Bedingung Lambdasoll für Katheizen aktiv" UWORD B_TRUE 1 100 0 1 BIT_MASK 0x400 FORMAT "%13.11" ECU_ADDRESS 0xFD58 /end MEASUREMENT
/begin MEASUREMENT B_lamkhe "keine Lambdaanforderung seitens LAKH" UWORD B_TRUE 1 100 0 1 BIT_MASK 0x80 FORMAT "%13.11" ECU_ADDRESS 0xFD6E /end MEASUREMENT
/begin MEASUREMENT B_lamnse "Bedingung Ende lamns_w-Berechnung" UWORD B_TRUE 1 100 0 1 BIT_MASK 0x100 FORMAT "%13.11" ECU_ADDRESS 0xFD5C /end MEASUREMENT
/begin MEASUREMENT B_lamnswl "Lambda-Motor-Soll für Nachstart und Warmlauf aktiv" UWORD B_TRUE 1 100 0 1 BIT_MASK 0x800 FORMAT "%13.11" ECU_ADDRESS 0xFD58 /end MEASUREMENT
/begin MEASUREMENT B_lamsdef "Bedingung : definierte Soll-Lambda" UWORD B_TRUE 1 100 0 1 BIT_MASK 0x1000 FORMAT "%13.11" ECU_ADDRESS 0xFD58 /end MEASUREMENT
/begin MEASUREMENT B_lawlon "lamwl_w ist aktiv" UWORD B_TRUE 1 100 0 1 BIT_MASK 0x200 FORMAT "%13.11" ECU_ADDRESS 0xFD5C /end MEASUREMENT
/begin MEASUREMENT B_lddy "Flag für Bedingung LDR-Dynamikbetrieb" UWORD B_TRUE 1 100 0 1 BIT_MASK 0x4 FORMAT "%13.11" ECU_ADDRESS 0xFD7E /end MEASUREMENT
/begin MEASUREMENT B_ldef "Bedingung : definierte Soll-Lambda Bank1" UWORD B_TRUE 1 100 0 1 BIT_MASK 0x2000 FORMAT "%13.11" ECU_ADDRESS 0xFD58 /end MEASUREMENT
/begin MEASUREMENT B_ldeffw "Bedingung : definiertes Soll-Lambda Bank1 durch Fahrerwunsch" UWORD B_TRUE 1 100 0 1 BIT_MASK 0x1 FORMAT "%13.11" ECU_ADDRESS 0xFD60 /end MEASUREMENT
/begin MEASUREMENT B_ldimxa "Bedingung für Adaption Begrenzungswert I-Anteil LDR" UWORD B_TRUE 1 100 0 1 BIT_MASK 0x8 FORMAT "%13.11" ECU_ADDRESS 0xFD7E /end MEASUREMENT
/begin MEASUREMENT B_ldimxn "Bedingung für Negativ-Korrektur ldimxr" UWORD B_TRUE 1 100 0 1 BIT_MASK 0x10 FORMAT "%13.11" ECU_ADDRESS 0xFD7E /end MEASUREMENT
/begin MEASUREMENT B_ldimxp "Bedingung für Positiv-Korrektur ldimxr" UWORD B_TRUE 1 100 0 1 BIT_MASK 0x20 FORMAT "%13.11" ECU_ADDRESS 0xFD7E /end MEASUREMENT
/begin MEASUREMENT B_ldob "Bedingung: Overboost aktiv" UWORD B_TRUE 1 100 0 1 BIT_MASK 0x100 FORMAT "%13.11" ECU_ADDRESS 0xFD7E /end MEASUREMENT
/begin MEASUREMENT B_ldobsp "Bedingung LDR Overboost innerhalb Sperrzeit" UWORD B_TRUE 1 100 0 1 BIT_MASK 0x200 FORMAT "%13.11" ECU_ADDRESS 0xFD7E /end MEASUREMENT
/begin MEASUREMENT B_ldsua "Bedingung LDR Schubumluftventil aktiv (offen)" UWORD B_TRUE 1 100 0 1 BIT_MASK 0x100 FORMAT "%13.11" ECU_ADDRESS 0xFD7C /end MEASUREMENT
/begin MEASUREMENT B_ldsuad "Bedingung Turbo Umluftsteuerung dynamisch aktiv" UWORD B_TRUE 1 100 0 1 BIT_MASK 0x200 FORMAT "%13.11" ECU_ADDRESS 0xFD7C /end MEASUREMENT
/begin MEASUREMENT B_ldsuas "Bedingung Turbo Umluftsteuerung stationär aktiv" UWORD B_TRUE 1 100 0 1 BIT_MASK 0x400 FORMAT "%13.11" ECU_ADDRESS 0xFD7C /end MEASUREMENT
/begin MEASUREMENT B_ldvl "Bedingung für LDR-Vollast" UWORD B_TRUE 1 100 0 1 BIT_MASK 0x40 FORMAT "%13.11" ECU_ADDRESS 0xFD7E /end MEASUREMENT
/begin MEASUREMENT B_llr "Bedingung Leerlaufregelung" UWORD B_TRUE 1 100 0 1 BIT_MASK 0x8000 FORMAT "%13.11" ECU_ADDRESS 0xFD82 /end MEASUREMENT
/begin MEASUREMENT B_llrein "Bedingung LLR Betriebsbereit nach Start" UWORD B_TRUE 1 100 0 1 BIT_MASK 0x1 FORMAT "%13.11" ECU_ADDRESS 0xFD84 /end MEASUREMENT
/begin MEASUREMENT B_llri "Bedingung I-Anteil der LLR aktiv" UWORD B_TRUE 1 100 0 1 BIT_MASK 0x2 FORMAT "%13.11" ECU_ADDRESS 0xFD84 /end MEASUREMENT
/begin MEASUREMENT B_llrpd "Bedingung PD-Anteil der LLR aktiv" UWORD B_TRUE 1 100 0 1 BIT_MASK 0x4 FORMAT "%13.11" ECU_ADDRESS 0xFD84 /end MEASUREMENT
/begin MEASUREMENT B_motabw "Bedingung: Motor abgewürgt" UWORD B_TRUE 1 100 0 1 BIT_MASK 0x200 FORMAT "%13.11" ECU_ADDRESS 0xFDB0 /end MEASUREMENT
/begin MEASUREMENT B_nac "Bedingung für erhöhte LL-Drehzahl bei Klimaanlage" UWORD B_TRUE 1 100 0 1 BIT_MASK 0x20 FORMAT "%13.11" ECU_ADDRESS 0xFDA8 /end MEASUREMENT
/begin MEASUREMENT B_nlel "Bedingung Nachlauf Zusatz-Elektrolüfter" UWORD B_TRUE 1 100 0 1 BIT_MASK 0x400 FORMAT "%13.11" ECU_ADDRESS 0xFDB0 /end MEASUREMENT
/begin MEASUREMENT B_nlphase2 "Bedingung Nachlaufphase 2 aktiv" UBYTE B_TRUE 1 100 0 1 BIT_MASK 0x1 FORMAT "%13.11" ECU_ADDRESS 0x38402A /end MEASUREMENT
/begin MEASUREMENT B_nlsgls2 "Anforderung Lüfternachlaufsteuerung aktiv" UWORD B_TRUE 1 100 0 1 BIT_MASK 0x800 FORMAT "%13.11" ECU_ADDRESS 0xFDB0 /end MEASUREMENT
/begin MEASUREMENT B_nstu "Umschaltung Drehzahl von nstat auf nmot nach Start" UWORD B_TRUE 1 100 0 1 BIT_MASK 0x8 FORMAT "%13.11" ECU_ADDRESS 0xFD84 /end MEASUREMENT
/begin MEASUREMENT B_stldw "Bedingung Stützstellenwechsel LDR Adaption" UWORD B_TRUE 1 100 0 1 BIT_MASK 0x80 FORMAT "%13.11" ECU_ADDRESS 0xFD7E /end MEASUREMENT
/begin MEASUREMENT B_tabgbts "Bedingung Abgastemperatur für Bauteileschutz überschritten" UBYTE B_TRUE 1 100 0 1 BIT_MASK 0x1 FORMAT "%13.11" ECU_ADDRESS 0x380A0B /end MEASUREMENT
/begin MEASUREMENT B_tatmbts "Bedingung: Temperatur aus ATM für Bauteileschutz überschritten" UBYTE B_TRUE 1 100 0 1 BIT_MASK 0x10 FORMAT "%13.11" ECU_ADDRESS 0x380A0B /end MEASUREMENT
/begin MEASUREMENT B_tikatbts "Bedingung Temperatur im Kat für Bauteileschutz überschritten" UBYTE B_TRUE 1 100 0 1 BIT_MASK 0x8 FORMAT "%13.11" ECU_ADDRESS 0x380A0B /end MEASUREMENT
/begin MEASUREMENT B_tipin "Tip in erkannt" UWORD B_TRUE 1 100 0 1 BIT_MASK 0x800 FORMAT "%13.11" ECU_ADDRESS 0xFD74 /end MEASUREMENT
/begin MEASUREMENT B_tisum "Bedingung Reset Ti-Summenzähler" UWORD B_TRUE 1 100 0 1 BIT_MASK 0x800 FORMAT "%13.11" ECU_ADDRESS 0xFDAE /end MEASUREMENT
/begin MEASUREMENT B_tkatbts "Bedingung Katalysatortemperatur für Bauteileschutz überschritten" UBYTE B_TRUE 1 100 0 1 BIT_MASK 0x2 FORMAT "%13.11" ECU_ADDRESS 0x380A0B /end MEASUREMENT
/begin MEASUREMENT B_tmkmtr "Bedingung Wassertemperatur am Zylinderkopfaustritt verfügbar" UWORD B_TRUE 1 100 0 1 BIT_MASK 0x1000 FORMAT "%13.11" ECU_ADDRESS 0xFDB0 /end MEASUREMENT
/begin MEASUREMENT B_tmkr "Bedingung Temperatur (tmot) fuer KR aktiv erreicht" UWORD B_TRUE 1 100 0 1 BIT_MASK 0x400 FORMAT "%13.11" ECU_ADDRESS 0xFD72 /end MEASUREMENT
/begin MEASUREMENT B_tvkoe1w "" UWORD B_TRUE 1 100 0 1 BIT_MASK 0x40 FORMAT "%13.11" ECU_ADDRESS 0xFDA8 /end MEASUREMENT
/begin MEASUREMENT B_twilabts "Bedingung Ladertemperatur für Bauteileschutz überschritten" UBYTE B_TRUE 1 100 0 1 BIT_MASK 0x20 FORMAT "%13.11" ECU_ADDRESS 0x380A0B /end MEASUREMENT
/begin MEASUREMENT B_twistbts "Bedingung Stegtemperatur für Bauteileschutz überschritten" UBYTE B_TRUE 1 100 0 1 BIT_MASK 0x4 FORMAT "%13.11" ECU_ADDRESS 0x380A0B /end MEASUREMENT
/begin MEASUREMENT B_vllr "Bedingung Fahrzeug rollt mit eingelegtem Gang" UWORD B_TRUE 1 100 0 1 BIT_MASK 0x10 FORMAT "%13.11" ECU_ADDRESS 0xFD84 /end MEASUREMENT
/begin MEASUREMENT B_wkral "Bedingung wkr aus KR-Adaptionskennfeld einlesen" UWORD B_TRUE 1 100 0 1 BIT_MASK 0x800 FORMAT "%13.11" ECU_ADDRESS 0xFD72 /end MEASUREMENT
/begin MEASUREMENT B_zwkraa "Bedingung Zündwinkel der KR wird ausgegeben" UWORD B_TRUE 1 100 0 1 BIT_MASK 0x1000 FORMAT "%13.11" ECU_ADDRESS 0xFD72 /end MEASUREMENT
/begin MEASUREMENT B_zwkrum "Flag: schnelle Frühverstellung" UWORD B_TRUE 1 100 0 1 BIT_MASK 0x2000 FORMAT "%13.11" ECU_ADDRESS 0xFD72 /end MEASUREMENT
/begin MEASUREMENT B_zwp "Bedingung Zusatzwasserpumpe ein" UWORD B_TRUE 1 100 0 1 BIT_MASK 0x2000 FORMAT "%13.11" ECU_ADDRESS 0xFDB0 /end MEASUREMENT
/begin MEASUREMENT detazwbs "Delta ZW-Wirkungsgrad für Bauteileschutz" UBYTE rel_ub_b127p5 1 100 0 127.5 FORMAT "%5.1" ECU_ADDRESS 0x38489B /end MEASUREMENT
/begin MEASUREMENT dkmts "Delta Kühlmitteltemperatur" SBYTE temp_sb_q0p75 1 100 -96 95.25 FORMAT "%5.2" ECU_ADDRESS 0x384935 /end MEASUREMENT
/begin MEASUREMENT dlambts_w "Delta Lambda für Bauteileschutz" SWORD fak_sw_b8 1 100 -8 7.99976 FORMAT "%8.6" ECU_ADDRESS 0x384B74 /end MEASUREMENT
/begin MEASUREMENT dpskrav_w "aktueller Wert aus DPSKRAN" SWORD p_sw_q0p039 1 100 -1280 1279.96 FORMAT "%8.3" ECU_ADDRESS 0x382344 /end MEASUREMENT
/begin MEASUREMENT dpskrmx_w "max. Wert dpsfg_w  oder dpsmp_w" SWORD p_sw_q0p039 1 100 -1280 1279.96 FORMAT "%8.3" ECU_ADDRESS 0x382346 /end MEASUREMENT
/begin MEASUREMENT dpskrra_w "Lastgradient für Auslesen Stationäradaption" SWORD p_sw_q0p039 1 100 -1280 1279.96 FORMAT "%8.3" ECU_ADDRESS 0x382348 /end MEASUREMENT
/begin MEASUREMENT dqueber "Wärmeüberschuß" UBYTE temp_ub_q0p75_o48 1 100 -48 143.25 FORMAT "%5.1" ECU_ADDRESS 0x384936 /end MEASUREMENT
/begin MEASUREMENT drlmaxo "Delta Maximalfuellung bei Overboost" UBYTE rel_ub_q0p75 1 100 0 191.25 FORMAT "%5.1" ECU_ADDRESS 0x380A9B /end MEASUREMENT
/begin MEASUREMENT dtka "Differenz zwischen Soll- und Ist-Temperatur am Kühlwasserausgang" SBYTE temp_sb_q0p75 1 100 -96 95.25 FORMAT "%5.2" ECU_ADDRESS 0x384937 /end MEASUREMENT
/begin MEASUREMENT dtkaint "I-Anteil Delta-Temperatur Kühler aus Ist-Soll" SBYTE temp_sb_q0p75 1 100 -96 95.25 FORMAT "%5.2" ECU_ADDRESS 0x384938 /end MEASUREMENT
/begin MEASUREMENT dtmtka "Delta Kühlmitteltemperatur zu Kühleraustrittstemperatur" SBYTE temp_sb_q0p75 1 100 -96 95.25 FORMAT "%5.2" ECU_ADDRESS 0x384939 /end MEASUREMENT
/begin MEASUREMENT dwkr "zylinderindividuelle Zündwinkelspätverstellung KR" SBYTE zw_sb_q0p75 1 100 -96 95.25 FORMAT "%5.2" ECU_ADDRESS 0x380A58 /end MEASUREMENT
/begin MEASUREMENT dwkrmsw "aktueller Wert für Mittelwertbegrenzung der Spätverstellung" UBYTE zw_ub_qn0p75 1 100 -191.25 0 FORMAT "%5.1" ECU_ADDRESS 0x380A59 /end MEASUREMENT
/begin MEASUREMENT dwkrm_w "Differenz wkrm-wkrmstat" UWORD zw_q0p1875 1 100 0 12287.8 FORMAT "%8.2" ECU_ADDRESS 0x384BF6 /end MEASUREMENT
/begin MEASUREMENT dwkrz "zyl.ind. ZW-Spätverstellung inkl. Dyn.vorhalt" SBYTE zw_sb_q0p75 1 100 -96 95.25 FORMAT "%5.2" ARRAY_SIZE 8 ECU_ADDRESS 0x380A5A /end MEASUREMENT
/begin MEASUREMENT dyesv_w "aktueller Wert Lastdynamikerkennungsschwelle" SWORD p_sw_q0p039 1 100 -1280 1279.96 FORMAT "%8.3" ECU_ADDRESS 0x38234A /end MEASUREMENT
/begin MEASUREMENT dymntv "min. add. Dynamikvorhalt aus KL" UBYTE zw_ub_qn0p75 1 100 -191.25 0 FORMAT "%5.1" ECU_ADDRESS 0x380A7F /end MEASUREMENT
/begin MEASUREMENT dyrsofv_w "aktueller Wert Offset für Lastdynamikerkennungsschwelle" SWORD p_sw_q0p039 1 100 -1280 1279.96 FORMAT "%8.3" ECU_ADDRESS 0x38234C /end MEASUREMENT
/begin MEASUREMENT dyrsv_w "aktueller wert Lastdynamikerkennungsschwelle" SWORD p_sw_q0p039 1 100 -1280 1279.96 FORMAT "%8.3" ECU_ADDRESS 0x38234E /end MEASUREMENT
/begin MEASUREMENT dzwg "Delta Zündwinkel Grund-ZW zu Optimal-ZW" SBYTE zw_sb_q0p75 1 100 -96 95.25 FORMAT "%5.2" ECU_ADDRESS 0x38489C /end MEASUREMENT
/begin MEASUREMENT dzwlamfaw "Delta Zündwinkel bei KR-Eingriff oder Warmlauf für Anfettung über Lambda" UBYTE zw_ub_qn0p75 1 100 -191.25 0 FORMAT "%5.1" ECU_ADDRESS 0x38488D /end MEASUREMENT
/begin MEASUREMENT esst_sdz06gkub "" UWORD dez 1 100 0 65535 FORMAT "%8.2" ECU_ADDRESS 0x384B32 /end MEASUREMENT
/begin MEASUREMENT esst_snm08koub "" UWORD rel_ub_b99p6 1 100 0 25599.6 FORMAT "%8.2" ECU_ADDRESS 0x382C9A /end MEASUREMENT
/begin MEASUREMENT esst_snm16gkub "" UWORD dez 1 100 0 65535 FORMAT "%8.2" ECU_ADDRESS 0x384B76 /end MEASUREMENT
/begin MEASUREMENT esst_spl08lduw "" UWORD dez 1 100 0 65535 FORMAT "%8.2" ECU_ADDRESS 0x382432 /end MEASUREMENT
/begin MEASUREMENT esst_srl12gkuw "" UWORD dez 1 100 0 65535 FORMAT "%8.2" ECU_ADDRESS 0x384B78 /end MEASUREMENT
/begin MEASUREMENT esst_sta10ldub "" UWORD dez 1 100 0 65535 FORMAT "%8.2" ECU_ADDRESS 0x382480 /end MEASUREMENT
/begin MEASUREMENT esst_sts05dtka "" UWORD dez 1 100 0 65535 FORMAT "%8.2" ECU_ADDRESS 0x3853B8 /end MEASUREMENT
/begin MEASUREMENT esst_sts05dtts "" UWORD dez 1 100 0 65535 FORMAT "%8.2" ECU_ADDRESS 0x3853BA /end MEASUREMENT
/begin MEASUREMENT esst_stv10ldsw "" UWORD dez 1 100 0 65535 FORMAT "%8.2" ECU_ADDRESS 0x382434 /end MEASUREMENT
/begin MEASUREMENT esst_swk08lduw "" UWORD dez 1 100 0 65535 FORMAT "%8.2" ECU_ADDRESS 0x382482 /end MEASUREMENT
/begin MEASUREMENT esst_swk108lduw "" UWORD dez 1 100 0 65535 FORMAT "%8.2" ECU_ADDRESS 0x382484 /end MEASUREMENT
/begin MEASUREMENT esst_swk208lduw "" UWORD dez 1 100 0 65535 FORMAT "%8.2" ECU_ADDRESS 0x382486 /end MEASUREMENT
/begin MEASUREMENT etazwg "Wirkungsgrad beim Grundzündwinkel" UBYTE rel_ub_b127p5 1 100 0 127.5 FORMAT "%5.1" ECU_ADDRESS 0x38489D /end MEASUREMENT
/begin MEASUREMENT etazwim "Gemittelter Wirkungsgrad beim Ist-Zündwinkel" UBYTE rel_ub_b127p5 1 100 0 127.5 FORMAT "%5.1" ECU_ADDRESS 0x38489E /end MEASUREMENT
/begin MEASUREMENT flashzlr "Interner Zähler während Lüfterdeaktivierung (Flash-Programmierung)" UBYTE dez 1 100 0 255 FORMAT "%5.1" ECU_ADDRESS 0x38493A /end MEASUREMENT
/begin MEASUREMENT flaskh "Faktor Übergang zu Lambda-Abgas bei Sekundärluft" UBYTE fak_ub_b1 1 100 0 0.996094 ECU_ADDRESS 0x3848BD /end MEASUREMENT
/begin MEASUREMENT flbts_w "Faktor Lambda Bauteileschutz" UWORD fak_uw_b2 1 100 0 1.99997 FORMAT "%8.6" ECU_ADDRESS 0x384B80 /end MEASUREMENT
/begin MEASUREMENT fldrrx_w "Korrekturfaktor Maximalfuellung aus Klopfregelung" UWORD fak_uw_b2 1 100 0 1.99997 FORMAT "%8.6" ECU_ADDRESS 0x384BF8 /end MEASUREMENT
/begin MEASUREMENT fldrxk_w "Faktor zur LDR rlmax-Korrektur durch den Kurzzeitanteil" UWORD fak_uw_b2 1 100 0 1.99997 FORMAT "%8.6" ECU_ADDRESS 0x384BFA /end MEASUREMENT
/begin MEASUREMENT fldrxl_w "Faktor zur LDR rlmax-Korrektur durch den Langzeitanteil" UWORD fak_uw_b2 1 100 0 1.99997 FORMAT "%8.6" ECU_ADDRESS 0x384BFC /end MEASUREMENT
/begin MEASUREMENT fldrxo_w "Faktor zur Ladedruckabsenkung des Overboostwertes (drlmaxo)" UWORD fak_uw_b1 1 100 0 0.999985 FORMAT "%9.7" ECU_ADDRESS 0x384BFE /end MEASUREMENT
/begin MEASUREMENT flmsslkh "Faktor Lambda-Motor-Soll-Sekundärluftanteil, resultierend" UBYTE fak_ub_b1 1 100 0 0.996094 ECU_ADDRESS 0x3848BE /end MEASUREMENT
/begin MEASUREMENT fmvp_w "Faktor für Mittelwertbildung Solldruckverhältnis DK" UWORD fak_uw_b2 1 100 0 1.99997 FORMAT "%8.6" ECU_ADDRESS 0x38241A /end MEASUREMENT
/begin MEASUREMENT frxt "Faktor zur Korrektur rlmx als Funktion von Motor- und Öltemperatur" UBYTE fak_ub_b2 1 100 0 1.99219 FORMAT "%5.3" ECU_ADDRESS 0x3848D8 /end MEASUREMENT
/begin MEASUREMENT frxta_w "Faktor zur Korrektur rlmx als Funktion von tans" UWORD fak_uw_b2 1 100 0 1.99997 FORMAT "%8.6" ECU_ADDRESS 0x384C00 /end MEASUREMENT
/begin MEASUREMENT fslsdyn "Faktor Dynamikbeschreibung Sekundärluftsystem" UBYTE fak_ub_b1 1 100 0 0.996094 ECU_ADDRESS 0x3848BF /end MEASUREMENT
/begin MEASUREMENT ikrrkr_wert "" UBYTE dez 1 100 0 255 FORMAT "%5.1" ECU_ADDRESS 0x380A2F /end MEASUREMENT
/begin MEASUREMENT ikr_kek_wert "" UBYTE dez 1 100 0 255 FORMAT "%5.1" ECU_ADDRESS 0x380A30 /end MEASUREMENT
/begin MEASUREMENT int_ctr "" UBYTE dez 1 100 0 255 FORMAT "%5.1" ECU_ADDRESS 0x380B88 /end MEASUREMENT
/begin MEASUREMENT irbgof_w "Offset für I-Reglerbegrenzung LDRPID abhängig von Drehzahlgradient" SWORD tv_sw_q0p005 1 100 -163.84 163.835 FORMAT "%8.4" ECU_ADDRESS 0x382436 /end MEASUREMENT
/begin MEASUREMENT ke "Klopferkennungsschwelle aus Kennfeld" UBYTE fak_ub_b16 1 100 0 15.9375 FORMAT "%5.2" ARRAY_SIZE 8 ECU_ADDRESS 0x3848C0 /end MEASUREMENT
/begin MEASUREMENT kek "Klopferkennungsschwelle korrigiert" UBYTE fak_ub_b16 1 100 0 15.9375 FORMAT "%5.2" ARRAY_SIZE 8 ECU_ADDRESS 0x380A31 /end MEASUREMENT
/begin MEASUREMENT kek_tst "Klopferkennungsschwelle korrigiert rollierend mit Zyl.zähler" UBYTE fak_ub_b16 1 100 0 15.9375 FORMAT "%5.2" ECU_ADDRESS 0x380A39 /end MEASUREMENT
/begin MEASUREMENT klah "Kühlleistungsanhebung" UBYTE temp_ub_q0p75_o48 1 100 -48 143.25 FORMAT "%5.1" ECU_ADDRESS 0x38493B /end MEASUREMENT
/begin MEASUREMENT klahtmsmx "Kühlleistungsanhebung bei Überschreitung der Motortemperaturschwellen" UBYTE temp_ub_q0p75_o48 1 100 -48 143.25 FORMAT "%5.1" ECU_ADDRESS 0x38493C /end MEASUREMENT
/begin MEASUREMENT kral1w "aktueller Wert Last-Adaptionsbereich 1" UBYTE rel_ub_q0p75 1 100 0 191.25 FORMAT "%5.1" ECU_ADDRESS 0x3848CA /end MEASUREMENT
/begin MEASUREMENT kral2w "aktueller Wert Last-Adaptionsbereich 2" UBYTE rel_ub_q0p75 1 100 0 191.25 FORMAT "%5.1" ECU_ADDRESS 0x3848CB /end MEASUREMENT
/begin MEASUREMENT kral3w "aktueller Wert Last-Adaptionsbereich 3" UBYTE rel_ub_q0p75 1 100 0 191.25 FORMAT "%5.1" ECU_ADDRESS 0x3848CC /end MEASUREMENT
/begin MEASUREMENT krdwsw "aktueller KL-Wert der Sicherheitsspätverstellung" UBYTE zw_ub_qn0p75 1 100 -191.25 0 FORMAT "%5.1" ECU_ADDRESS 0x380A62 /end MEASUREMENT
/begin MEASUREMENT krfkw "Aktueller Wert aus KRFKN" UBYTE zw_ub_qn0p75 1 100 -191.25 0 FORMAT "%5.1" ECU_ADDRESS 0x380A63 /end MEASUREMENT
/begin MEASUREMENT krftpakt "aktuelles Tiefpaßverhalten" UBYTE dez 1 100 0 255 FORMAT "%5.1" ECU_ADDRESS 0x380A3A /end MEASUREMENT
/begin MEASUREMENT krlzn "Bitmuster: zylinderindividuelle Drehzahlschwelle für LZF überschritten" UBYTE dez 1 100 0 255 FORMAT "%5.1" ECU_ADDRESS 0x380A64 /end MEASUREMENT
/begin MEASUREMENT krmxw "aktueller Wert für Spätbegrenzung der Spätverstellung" UBYTE zw_ub_qn0p75 1 100 -191.25 0 FORMAT "%5.1" ECU_ADDRESS 0x380A65 /end MEASUREMENT
/begin MEASUREMENT krtmso "Gefilterte Klopfregeltiefe für Temperatur-Sollwertberechnung" UBYTE zw_ub_qn0p75 1 100 -191.25 0 FORMAT "%5.1" ECU_ADDRESS 0x38493D /end MEASUREMENT
/begin MEASUREMENT krvfsw "Initwert für schnelle Frühverstellung" UBYTE dez 1 100 0 255 FORMAT "%5.1" ECU_ADDRESS 0x380A66 /end MEASUREMENT
/begin MEASUREMENT krvfw "Initwert für normale Frühverstellung" UBYTE dez 1 100 0 255 FORMAT "%5.1" ECU_ADDRESS 0x380A67 /end MEASUREMENT
/begin MEASUREMENT kvakbi_w "aufsummierter Kraftstoffverbrauch für Kombiausgabe" UWORD dez 1 100 0 65535 FORMAT "%8.2" ECU_ADDRESS 0x382CC2 /end MEASUREMENT
/begin MEASUREMENT LAKHlokBits "" UBYTE dez 1 100 0 255 FORMAT "%5.1" ECU_ADDRESS 0x380A1B /end MEASUREMENT
/begin MEASUREMENT lambas "Basis-Lambda" UBYTE fak_ub_b2 1 100 0 1.99219 FORMAT "%5.3" ECU_ADDRESS 0x3809EE /end MEASUREMENT
/begin MEASUREMENT LAMBTSlokbits "" UBYTE dez 1 100 0 255 FORMAT "%5.1" ECU_ADDRESS 0x380A0B /end MEASUREMENT
/begin MEASUREMENT lambts_w "Lambda für Bauteileschutz" UWORD fak_uw_b16 1 100 0 15.9998 FORMAT "%8.5" ECU_ADDRESS 0x384B7A /end MEASUREMENT
/begin MEASUREMENT lamfawkr_w "Lambdasoll Fahrerwunsch bei Zündwinkelspätverstellung KR, WL" UWORD fak_uw_b16 1 100 0 15.9998 FORMAT "%8.5" ECU_ADDRESS 0x384B34 /end MEASUREMENT
/begin MEASUREMENT lamfaws_w "Lambdasoll Fahrerwunsch stationärer Anteil" UWORD fak_uw_b16 1 100 0 15.9998 FORMAT "%8.5" ECU_ADDRESS 0x384B36 /end MEASUREMENT
/begin MEASUREMENT lamfaw_w "Lambdasoll Fahrerwunsch Anteil aus Kennfeld LAMFA" UWORD fak_uw_b16 1 100 0 15.9998 FORMAT "%8.5" ECU_ADDRESS 0x384B38 /end MEASUREMENT
/begin MEASUREMENT lamfa_w "Lambdasoll Fahrerwunsch (word)" UWORD fak_uw_b16 1 100 0 15.9998 FORMAT "%8.5" ECU_ADDRESS 0x384B3A /end MEASUREMENT
/begin MEASUREMENT lamfwl_w "Offset Motor-Lambda-Soll im Warmlauf" UWORD fak_uw_b16 1 100 0 15.9998 FORMAT "%8.5" ECU_ADDRESS 0x384B3C /end MEASUREMENT
/begin MEASUREMENT lamkh2_w "Lambda-Motor-Soll bei Katheizen, Bank 2 (word)" UWORD fak_q0p000244 1 100 0 15.9998 FORMAT "%8.5" ECU_ADDRESS 0x3822FE /end MEASUREMENT
/begin MEASUREMENT lamkhe_w "Lambda-Motor-Soll bei Katheizen, effektiv" UWORD fak_uw_b16 1 100 0 15.9998 FORMAT "%8.5" ECU_ADDRESS 0x3820DA /end MEASUREMENT
/begin MEASUREMENT lamkhg_w "Lambda-Motor-Soll bei Katheizen (word) gewichtet mit flakh" UWORD fak_q0p000244 1 100 0 15.9998 FORMAT "%8.5" ECU_ADDRESS 0x382300 /end MEASUREMENT
/begin MEASUREMENT lamkhr_w "Lambda-Motor-Soll resultierend bei Katheizen (word)" UWORD fak_q0p000244 1 100 0 15.9998 FORMAT "%8.5" ECU_ADDRESS 0x384BCA /end MEASUREMENT
/begin MEASUREMENT lamkh_w "Lambda-Motor-Soll bei Katheizen (word)" UWORD fak_q0p000244 1 100 0 15.9998 FORMAT "%8.5" ECU_ADDRESS 0x382302 /end MEASUREMENT
/begin MEASUREMENT lamlgfmn "Lambda Motorlaufgrenze fett" UBYTE fak_ub_b2 1 100 0 1.99219 FORMAT "%5.3" ECU_ADDRESS 0x384888 /end MEASUREMENT
/begin MEASUREMENT lamlgm "Laufgrenze ""Lambda mager""" UBYTE fak_ub_b2 1 100 0 1.99219 FORMAT "%5.3" ECU_ADDRESS 0x384889 /end MEASUREMENT
/begin MEASUREMENT lamnswl_w "Lambda-Motor-Soll für Nachstart und Warmlauf" UWORD fak_uw_b16 1 100 0 15.9998 FORMAT "%8.5" ECU_ADDRESS 0x382104 /end MEASUREMENT
/begin MEASUREMENT lamns_w "Lambda-Motor-Soll für Nachstart" UWORD fak_uw_b16 1 100 0 15.9998 FORMAT "%8.5" ECU_ADDRESS 0x382106 /end MEASUREMENT
/begin MEASUREMENT lamrlmn_w "Lambdasollvorsteuerung zur Verbesserung der Brennbarkeit bei kleinem rl" UWORD fak_uw_b16 1 100 0 15.9998 FORMAT "%8.5" ECU_ADDRESS 0x384B3E /end MEASUREMENT
/begin MEASUREMENT lamsbg_w "Lambdasoll Begrenzung (word)" UWORD fak_uw_b16 1 100 0 15.9998 FORMAT "%8.5" ECU_ADDRESS 0x3820DC /end MEASUREMENT
/begin MEASUREMENT lamsons_w "Lambda-Sollwert bezogen auf Einbauort Lambda-Sensor" UWORD fak_uw_b16 1 100 0 15.9998 FORMAT "%8.5" ECU_ADDRESS 0x3820DE /end MEASUREMENT
/begin MEASUREMENT lamsos_w "Lambda-Sollwert bezogen auf Einbauort Lambda-Sensor" UWORD fak_uw_b16 1 100 0 15.9998 FORMAT "%8.5" ECU_ADDRESS 0x3820E0 /end MEASUREMENT
/begin MEASUREMENT lamsubg_w "Lambdasoll unbegrenzt (word)" UWORD fak_uw_b16 1 100 0 15.9998 FORMAT "%8.5" ECU_ADDRESS 0x3820E2 /end MEASUREMENT
/begin MEASUREMENT lams_w "Lambda-Sollwert" UWORD fak_uw_b16 1 100 0 15.9998 FORMAT "%8.5" ECU_ADDRESS 0x3820E4 /end MEASUREMENT
/begin MEASUREMENT lamvoa_w "Lambdavorsteuerung ohne additive Anteile" UWORD fak_uw_b16 1 100 0 15.9998 FORMAT "%8.5" ECU_ADDRESS 0x3820E6 /end MEASUREMENT
/begin MEASUREMENT lamwl_w "Lambda-Motor-Soll für Warmlauf" UWORD fak_uw_b16 1 100 0 15.9998 FORMAT "%8.5" ECU_ADDRESS 0x382108 /end MEASUREMENT
/begin MEASUREMENT lanskh_w "Lambda-Motor-Soll im Nachstart bei Katheizen" UWORD fak_q0p000244 1 100 0 15.9998 FORMAT "%8.5" ECU_ADDRESS 0x384BCC /end MEASUREMENT
/begin MEASUREMENT lasdslg_w "Lambda-Abgas-Soll für Sekundärluftdiagnose gewichtet mit flamsl" UWORD fak_q0p000244 1 100 0 15.9998 FORMAT "%8.5" ECU_ADDRESS 0x384BCE /end MEASUREMENT
/begin MEASUREMENT lasdsl_w "Lambda-Abgas-Soll für Sekundärluftdiagnose" UWORD fak_q0p000244 1 100 0 15.9998 FORMAT "%8.5" ECU_ADDRESS 0x384BD0 /end MEASUREMENT
/begin MEASUREMENT laskh_w "Lambda-Abgas-Soll bei Katheizen (word)" UWORD fak_q0p000244 1 100 0 15.9998 FORMAT "%8.5" ECU_ADDRESS 0x384BD2 /end MEASUREMENT
/begin MEASUREMENT lbts_w "Lambda für Bauteileschutz aus Stationärkennfeld" UWORD fak_uw_b16 1 100 0 15.9998 FORMAT "%8.5" ECU_ADDRESS 0x384B7C /end MEASUREMENT
/begin MEASUREMENT lde "LDR-Regelabweichung (Sollwert - Istwert)" SBYTE p_sb_q10 1 100 -1280 1270 FORMAT "%5.0" ECU_ADDRESS 0x380A99 /end MEASUREMENT
/begin MEASUREMENT ldebu "Regelabweichung LDR im back up Betrieb" SWORD rel_q1p5 1 100 -49152 49150.5 FORMAT "%8.2" ECU_ADDRESS 0x3824A0 /end MEASUREMENT
/begin MEASUREMENT ldimn_w "Aktueller Wert zur Minimalwertbegrenzung I-Anteil LDR" SWORD tv_sw_q0p005 1 100 -163.84 163.835 FORMAT "%8.4" ECU_ADDRESS 0x382438 /end MEASUREMENT
/begin MEASUREMENT ldimxa "Adaptive Korrektur der LDR I-Regler Maximalwertbegrenzung" SWORD tv_sw_q0p005 1 100 -163.84 163.835 FORMAT "%8.4" ARRAY_SIZE 5 ECU_ADDRESS 0x383CAC /end MEASUREMENT
/begin MEASUREMENT ldimxak_w "Aktueller korrigierter Begrenzungswert I-Anteil LDR" SWORD tv_sw_q0p005 1 100 -163.84 163.835 FORMAT "%8.4" ECU_ADDRESS 0x38243A /end MEASUREMENT
/begin MEASUREMENT ldimxrk_w "LDR I max. Begrenzungswert (korrigierter Referenzwert)" SWORD tv_sw_q0p005 1 100 -163.84 163.835 FORMAT "%8.4" ECU_ADDRESS 0x38243C /end MEASUREMENT
/begin MEASUREMENT ldimxr_w "Aktueller Referenzwert zur Maximalwertbegrenzung I-Anteil LDR" SWORD tv_sw_q0p005 1 100 -163.84 163.835 FORMAT "%8.4" ECU_ADDRESS 0x38243E /end MEASUREMENT
/begin MEASUREMENT ldimx_w "Aktueller Wert zur Maximalwertbegrenzung I-Anteil LDR" SWORD tv_sw_q0p005 1 100 -163.84 163.835 FORMAT "%8.4" ECU_ADDRESS 0x382440 /end MEASUREMENT
/begin MEASUREMENT lditv_w "LDR, Tastverhältnis vom I-Regler (word)" SWORD tv_sw_q0p005 1 100 -163.84 163.835 FORMAT "%8.4" ECU_ADDRESS 0x382442 /end MEASUREMENT
/begin MEASUREMENT ldptv "LDR, Tastverhältnis vom P-Regler" SWORD tv_sw_q0p005 1 100 -163.84 163.835 FORMAT "%8.4" ECU_ADDRESS 0x382444 /end MEASUREMENT
/begin MEASUREMENT ldrdtv "LDR Tastverhältnis vom D-Regler" SWORD tv_sw_q0p005 1 100 -163.84 163.835 FORMAT "%8.4" ECU_ADDRESS 0x382446 /end MEASUREMENT
/begin MEASUREMENT ldrkd_w "LDR-Reglerparameter für D-Anteil" UWORD rel_uw_b3276p75 1 100 0 3276.75 FORMAT "%8.3" ECU_ADDRESS 0x382448 /end MEASUREMENT
/begin MEASUREMENT ldrki_w "LDR-Reglerparameter für I-Anteil" UWORD rel_uw_b3276p75 1 100 0 3276.75 FORMAT "%8.3" ECU_ADDRESS 0x38244A /end MEASUREMENT
/begin MEASUREMENT ldrkp_w "LDR-Reglerparameter für P-Anteil" UWORD rel_uw_b3276p75 1 100 0 3276.75 FORMAT "%8.3" ECU_ADDRESS 0x38244C /end MEASUREMENT
/begin MEASUREMENT ldrlms_w "Begrenzungswert für maximale Füllung LDR für Motorschutz" UWORD rel_uw_q0p0234 1 100 0 1535.98 FORMAT "%8.3" ECU_ADDRESS 0x384C02 /end MEASUREMENT
/begin MEASUREMENT ldrlts_w "Begrenzungswert für maximale Füllung LDR für ATL-Schutz" UWORD rel_uw_q0p0234 1 100 0 1535.98 FORMAT "%8.3" ECU_ADDRESS 0x384C08 /end MEASUREMENT
/begin MEASUREMENT ldtv "LDR Tastverhältnis" SWORD tv_sw_q0p005 1 100 -163.84 163.835 FORMAT "%8.4" ECU_ADDRESS 0x382450 /end MEASUREMENT
/begin MEASUREMENT ldtvbu_w "LDR Tastverhältnis vom back up Regler" SWORD rel_sw_b50 1 100 -50 49.9985 FORMAT "%8.5" ECU_ADDRESS 0x3824A2 /end MEASUREMENT
/begin MEASUREMENT ldtvm "LDR Tastverhältnis , moduliert (Endergebnis)" UBYTE tv_ub_b100 1 100 0 99.6094 FORMAT "%5.2" ECU_ADDRESS 0x380A9F /end MEASUREMENT
/begin MEASUREMENT ldtvmd "LDR-Tastverhältnis aus Md-Koordination" SWORD tv_ub_b100 1 100 -12800 12799.6 FORMAT "%8.2" ECU_ADDRESS 0x3824A4 /end MEASUREMENT
/begin MEASUREMENT ldtvr_w "LDR Tastverhältnis vom Regler" SWORD tv_sw_q0p005 1 100 -163.84 163.835 FORMAT "%8.4" ECU_ADDRESS 0x382452 /end MEASUREMENT
/begin MEASUREMENT lkraw "aktueller Wert der Lastschwelle Klopfregel-Adaption" UBYTE rel_ub_q0p75 1 100 0 191.25 FORMAT "%5.1" ECU_ADDRESS 0x3848CD /end MEASUREMENT
/begin MEASUREMENT lkrw "aktueller Wert der Lastschwelle Klopfregelung" UBYTE rel_ub_q0p75 1 100 0 191.25 FORMAT "%5.1" ECU_ADDRESS 0x3848CE /end MEASUREMENT
/begin MEASUREMENT lmskh_w "Lambda-Motor-Soll bei katheizen (word)" UWORD fak_q0p000244 1 100 0 15.9998 FORMAT "%8.5" ECU_ADDRESS 0x384BD4 /end MEASUREMENT
/begin MEASUREMENT lmssl_w "Lambda-Motor-Soll wegen Sekundärluft bei Katheizen (word)" UWORD fak_q0p000244 1 100 0 15.9998 FORMAT "%8.5" ECU_ADDRESS 0x384BD6 /end MEASUREMENT
/begin MEASUREMENT luelogin "Login für Lüftersteuerung über VAG-Tester" UWORD dez 1 100 0 65535 FORMAT "%8.2" ECU_ADDRESS 0x3853BC /end MEASUREMENT
/begin MEASUREMENT lzist "Array: aktuelle Zuordnung führende - geführte Zylinder" UBYTE dez 1 100 0 255 FORMAT "%5.1" ARRAY_SIZE 8 ECU_ADDRESS 0x38333B /end MEASUREMENT
/begin MEASUREMENT ngkraf_w "gefilterter Drehzahlgradient" SWORD nmotg_sw_q0p39 1 100 -12800.2 12799.8 FORMAT "%8.2" ECU_ADDRESS 0x382350 /end MEASUREMENT
/begin MEASUREMENT ngkrav_w "aktueller Wert Drehzahldynamikschwelle" SWORD nmotg_sw_q0p39 1 100 -12800.2 12799.8 FORMAT "%8.2" ECU_ADDRESS 0x382352 /end MEASUREMENT
/begin MEASUREMENT ngkrv_w "aktueller Wert Drehzahldynamikschwelle" SWORD nmotg_sw_q0p39 1 100 -12800.2 12799.8 FORMAT "%8.2" ECU_ADDRESS 0x382354 /end MEASUREMENT
/begin MEASUREMENT nlue1 "Solldrehzahl Lüfter 1" UBYTE nmot_ub_q20 1 100 0 5100 FORMAT "%5.0" ECU_ADDRESS 0x38493E /end MEASUREMENT
/begin MEASUREMENT nlue1mn "Minimale Drehzahl Lüfter 1" UBYTE nmot_ub_q20 1 100 0 5100 FORMAT "%5.0" ECU_ADDRESS 0x38493F /end MEASUREMENT
/begin MEASUREMENT nlue2 "Solldrehzahl Lüfter 2" UBYTE nmot_ub_q20 1 100 0 5100 FORMAT "%5.0" ECU_ADDRESS 0x384940 /end MEASUREMENT
/begin MEASUREMENT nlue2mn "Minimale Drehzahl Lüfter 2" UBYTE nmot_ub_q20 1 100 0 5100 FORMAT "%5.0" ECU_ADDRESS 0x384941 /end MEASUREMENT
/begin MEASUREMENT nluez1 "Lüfterdrehzahl 1 aus NLUEZ1" UBYTE nmot_ub_q20 1 100 0 5100 FORMAT "%5.0" ECU_ADDRESS 0x384942 /end MEASUREMENT
/begin MEASUREMENT nluez2 "Lüfterdrehzahl 2 aus NLUEZ2" UBYTE nmot_ub_q20 1 100 0 5100 FORMAT "%5.0" ECU_ADDRESS 0x384943 /end MEASUREMENT
/begin MEASUREMENT pdpld "Prädizierter Delta Druck (Überschwinger Soll-Ist)" UBYTE p_ub_q10 1 100 0 2550 FORMAT "%5.0" ECU_ADDRESS 0x380A97 /end MEASUREMENT
/begin MEASUREMENT pdpld_w "Prädizierter Delta Druck (Überschwinger Soll-Ist) word" UWORD p_uw_q0p039 1 100 0 2559.96 FORMAT "%8.3" ECU_ADDRESS 0x3823F6 /end MEASUREMENT
/begin MEASUREMENT pklimakmtr "Druck Klimaanlage für KMTR" UBYTE p_q0p2 1 100 0 51 FORMAT "%5.2" ECU_ADDRESS 0x384944 /end MEASUREMENT
/begin MEASUREMENT plmaxa_w "Soll-Ladedruck nach max- Auswahl" UWORD p_uw_q0p039 1 100 0 2559.96 FORMAT "%8.3" ECU_ADDRESS 0x3823F8 /end MEASUREMENT
/begin MEASUREMENT plsolr_w "Relativer Solladedruck LDR" UWORD p_uw_q0p039 1 100 0 2559.96 FORMAT "%8.3" ECU_ADDRESS 0x382454 /end MEASUREMENT
/begin MEASUREMENT qkl1dtev "Klimaanforderung für Lüfter 1 während Tankentlüfungsdiagnose" UBYTE temp_ub_q0p75_o48 1 100 -48 143.25 FORMAT "%5.1" ECU_ADDRESS 0x384945 /end MEASUREMENT
/begin MEASUREMENT qkl2dtev "Klimaanforderung für Lüfter 2 während Tankentlüfungsdiagnose" UBYTE temp_ub_q0p75_o48 1 100 -48 143.25 FORMAT "%5.1" ECU_ADDRESS 0x384946 /end MEASUREMENT
/begin MEASUREMENT qklima "Wärmestrom des Klimakondensators" UBYTE temp_ub_q0p75_o48 1 100 -48 143.25 FORMAT "%5.1" ECU_ADDRESS 0x384947 /end MEASUREMENT
/begin MEASUREMENT qmax1dtev "abzuführender Wärmestrom von Lüfter 1 während der TEV-Diagnose" UBYTE temp_ub_q0p75_o48 1 100 -48 143.25 FORMAT "%5.1" ECU_ADDRESS 0x384948 /end MEASUREMENT
/begin MEASUREMENT qmax2dtev "abzuführender Wärmestrom von Lüfter 2 während der TEV-Diagnose" UBYTE temp_ub_q0p75_o48 1 100 -48 143.25 FORMAT "%5.1" ECU_ADDRESS 0x384949 /end MEASUREMENT
/begin MEASUREMENT qmaxdtev1 "abzuführender Wärmestrom von Lüfter 1" UBYTE temp_ub_q0p75_o48 1 100 -48 143.25 FORMAT "%5.1" ECU_ADDRESS 0x38494A /end MEASUREMENT
/begin MEASUREMENT qmaxdtev2 "abzuführender Wärmestrom von Lüfter 2" UBYTE temp_ub_q0p75_o48 1 100 -48 143.25 FORMAT "%5.1" ECU_ADDRESS 0x38494B /end MEASUREMENT
/begin MEASUREMENT qmaxl1 "abzuführender Wärmestrom von Lüfter 1" UBYTE temp_ub_q0p75_o48 1 100 -48 143.25 FORMAT "%5.1" ECU_ADDRESS 0x38494C /end MEASUREMENT
/begin MEASUREMENT qmaxl2 "abzuführender Wärmestrom von Lüfter 2" UBYTE temp_ub_q0p75_o48 1 100 -48 143.25 FORMAT "%5.1" ECU_ADDRESS 0x38494D /end MEASUREMENT
/begin MEASUREMENT qnvp1 "Benötigter Volumenstrom durch den Kühler, Lüfter1" UBYTE m_ub_b1020 1 100 0 1020 FORMAT "%5.0" ECU_ADDRESS 0x38494E /end MEASUREMENT
/begin MEASUREMENT qnvp2 "Benötigter Volumenstrom durch den Kühler, Lüfter 2" UBYTE m_ub_b1020 1 100 0 1020 FORMAT "%5.0" ECU_ADDRESS 0x38494F /end MEASUREMENT
/begin MEASUREMENT rkr "Referenzpegel Klopfregelung" UBYTE spg_ub_b5 1 100 0 4.98047 FORMAT "%5.3" ARRAY_SIZE 8 ECU_ADDRESS 0x380A3B /end MEASUREMENT
/begin MEASUREMENT rkrmx "nach oben begrenzter Referenzpegel" UBYTE spg_ub_b5 1 100 0 4.98047 FORMAT "%5.3" ECU_ADDRESS 0xF9D4 /end MEASUREMENT
/begin MEASUREMENT rkrmx1w "aktueller Wert der KL RKRMX1N" UBYTE spg_ub_b320 1 100 0 318.75 FORMAT "%5.1" ECU_ADDRESS 0x3848C8 /end MEASUREMENT
/begin MEASUREMENT rkrmx2w "aktueller Wert der KL RKRMX2N" UBYTE spg_ub_b320 1 100 0 318.75 FORMAT "%5.1" ECU_ADDRESS 0x3848C9 /end MEASUREMENT
/begin MEASUREMENT rkr_tst "Referenzpegel Klopfregelung rollierend mit Zyl.zähler" UBYTE spg_ub_b5 1 100 0 4.98047 FORMAT "%5.3" ECU_ADDRESS 0x380A43 /end MEASUREMENT
/begin MEASUREMENT rlmax_w "maximal erreichbare Füllung bei Turbo" UWORD rel_uw_q0p0234 1 100 0 1535.98 FORMAT "%8.3" ECU_ADDRESS 0x38248A /end MEASUREMENT
/begin MEASUREMENT rlmxko_w "Maximalfüllung korrigiert (ohne Begrenzungen)" UWORD rel_uw_q0p0234 1 100 0 1535.98 FORMAT "%8.3" ECU_ADDRESS 0x384C0A /end MEASUREMENT
/begin MEASUREMENT rlmx_w "Rohwert Maximalfuellung" UWORD rel_uw_q0p0234 1 100 0 1535.98 FORMAT "%8.3" ECU_ADDRESS 0x38248C /end MEASUREMENT
/begin MEASUREMENT rltmso1 "Motorsolltemperatur 1 betriebspunktabhängig" UBYTE rel_ub_q0p75 1 100 0 191.25 FORMAT "%5.1" ECU_ADDRESS 0x384950 /end MEASUREMENT
/begin MEASUREMENT stkrax "Index für KR-Adaptionskennfeld" UBYTE dez 1 100 0 255 FORMAT "%5.1" ECU_ADDRESS 0x380A68 /end MEASUREMENT
/begin MEASUREMENT stkrlx "Laststützstelle für die KR-Adaption" UBYTE dez 1 100 0 255 FORMAT "%5.1" ECU_ADDRESS 0x380A69 /end MEASUREMENT
/begin MEASUREMENT stkrnx "Drehzahlstützstelle für die KR-Adaption" UBYTE dez 1 100 0 255 FORMAT "%5.1" ECU_ADDRESS 0x380A6A /end MEASUREMENT
/begin MEASUREMENT stldia "Aktuelle Stützstelle für LDR Adaption" UBYTE DEZ 1 100 0 255 FORMAT "%5.1" ECU_ADDRESS 0x380A9A /end MEASUREMENT
/begin MEASUREMENT stuetz "Drehzahladaptionsbereich bei Auslösung der Lastdynamik" UBYTE dez 1 100 0 255 FORMAT "%5.1" ECU_ADDRESS 0x380A80 /end MEASUREMENT
/begin MEASUREMENT S_acw "Klima-Anforderung aktiv über Schalter oder CAN (nach Konfiguration)" UWORD B_TRUE 1 100 0 1 BIT_MASK 0x80 FORMAT "%13.11" ECU_ADDRESS 0xFDA8 /end MEASUREMENT
/begin MEASUREMENT tabgbts_w "Abgastemperatur für Bauteileschutz" UWORD temp_uw_q0p0195_o50 1 100 -50 1229.98 FORMAT "%8.3" ECU_ADDRESS 0x384B7E /end MEASUREMENT
/begin MEASUREMENT temp_b_wert "" UBYTE dez 1 100 0 255 FORMAT "%5.1" ECU_ADDRESS 0x380A44 /end MEASUREMENT
/begin MEASUREMENT tisum_w "Einspritzzeitsummierer" UWORD dez 1 100 0 65535 FORMAT "%8.2" ECU_ADDRESS 0x382CC4 /end MEASUREMENT
/begin MEASUREMENT tkakmtr "Temperatur Kühleraustritt in KMTR" UBYTE temp_ub_q0p75_o48 1 100 -48 143.25 FORMAT "%5.1" ECU_ADDRESS 0x384951 /end MEASUREMENT
/begin MEASUREMENT tkvad "" UBYTE dez 1 100 0 255 FORMAT "%5.1" ECU_ADDRESS 0x38492F /end MEASUREMENT
/begin MEASUREMENT tkvag_w "" UWORD dez 1 100 0 65535 FORMAT "%8.2" ECU_ADDRESS 0x3853B4 /end MEASUREMENT
/begin MEASUREMENT tkvar "" UBYTE dez 1 100 0 255 FORMAT "%5.1" ECU_ADDRESS 0x384930 /end MEASUREMENT
/begin MEASUREMENT tkva_h "" UWORD dez 1 100 0 65535 FORMAT "%8.2" ECU_ADDRESS 0x382CC6 /end MEASUREMENT
/begin MEASUREMENT tmotkmtr "Motottemperatur  in KMTR" UBYTE temp_ub_q0p75_o48 1 100 -48 143.25 FORMAT "%5.1" ECU_ADDRESS 0x384952 /end MEASUREMENT
/begin MEASUREMENT tmotldrlmx "Motortemperatur in LDRLMX nach Selektion (tmot/tmkic/tmki)" UBYTE temp_ub_q0p75_o48 1 100 -48 143.25 FORMAT "%5.1" ECU_ADDRESS 0x380A9C /end MEASUREMENT
/begin MEASUREMENT tmotnl2 "Motortemperatur im Nachlauf bei Nachtriggerung" UBYTE temp_ub_q0p75_o48 1 100 -48 143.25 FORMAT "%5.1" ECU_ADDRESS 0x38402B /end MEASUREMENT
/begin MEASUREMENT tmotsoll "Soll-Wassertemperatur für Kühlmitteltemperaturregelung" UBYTE temp_ub_q0p75_o48 1 100 -48 143.25 FORMAT "%5.1" ECU_ADDRESS 0x384953 /end MEASUREMENT
/begin MEASUREMENT tmso1 "Motor-Solltemperatur 1 (RL/VFZG-abhängig)" UBYTE temp_ub_q0p75_o48 1 100 -48 143.25 FORMAT "%5.1" ECU_ADDRESS 0x384954 /end MEASUREMENT
/begin MEASUREMENT tmso2 "Motor-Solltemperatur 2 (TUM / VFZG abhängig)" UBYTE temp_ub_q0p75_o48 1 100 -48 143.25 FORMAT "%5.1" ECU_ADDRESS 0x384955 /end MEASUREMENT
/begin MEASUREMENT tmso3 "Motor-Solltemperatur 3 (TOEL-abhängig)" UBYTE temp_ub_q0p75_o48 1 100 -48 143.25 FORMAT "%5.1" ECU_ADDRESS 0x384956 /end MEASUREMENT
/begin MEASUREMENT tmso4 "Motor-Solltemperatur 4 (abhängig v. Heizungsanforderung)" UBYTE temp_ub_q0p75_o48 1 100 -48 143.25 FORMAT "%5.1" ECU_ADDRESS 0x384957 /end MEASUREMENT
/begin MEASUREMENT tmso5 "Motor-Solltemperatur 5 (abhängig v.d. Klopfregeltiefe)" UBYTE temp_ub_q0p75_o48 1 100 -48 143.25 FORMAT "%5.1" ECU_ADDRESS 0x384958 /end MEASUREMENT
/begin MEASUREMENT tmso6 "Motor-Solltemperatur 6 (abhängig v. Heizungsanforderung)" UBYTE temp_ub_q0p75_o48 1 100 -48 143.25 FORMAT "%5.1" ECU_ADDRESS 0x384959 /end MEASUREMENT
/begin MEASUREMENT tnlkmtr_w "Nachlaufzeit aus KMTR 16-bit" UWORD t1sxs_uw_b65535 1 100 0 65535 FORMAT "%8.2" ECU_ADDRESS 0x384096 /end MEASUREMENT
/begin MEASUREMENT tnlst2kt_w "Nachlaufzeitverlängerung  nach  Wiederholprüfung" UWORD t1sxs_uw_b65535 1 100 0 65535 FORMAT "%8.2" ECU_ADDRESS 0x3853BE /end MEASUREMENT
/begin MEASUREMENT tnlstktr_w "Startwert Nachlaufzeit aus KMTR 16-bit" UWORD t1sxs_uw_b65535 1 100 0 65535 FORMAT "%8.2" ECU_ADDRESS 0x384098 /end MEASUREMENT
/begin MEASUREMENT toelkmtr "Ausgewählte Öltemperatur in der KMTR" UBYTE temp_ub_q1_o60 1 100 -60 195 FORMAT "%5.1" ECU_ADDRESS 0x38495A /end MEASUREMENT
/begin MEASUREMENT toelldrlmx "Öltemperatur in LDRLMX nach Selektion (tolc/toel/TOLEWRLMX)" UBYTE temp_ub_q1_o60 1 100 -60 195 FORMAT "%5.1" ECU_ADDRESS 0x380A9D /end MEASUREMENT
/begin MEASUREMENT tsel "Selektierte Temperatur (tans/tumc)" UBYTE temp_ub_q0p75_o48 1 100 -48 143.25 FORMAT "%5.1" ECU_ADDRESS 0x380A9E /end MEASUREMENT
/begin MEASUREMENT tume "Umgebungstemperatur aus Ersatzwert und Basiswert" UBYTE temp_ub_q0p75_o48 1 100 -48 143.25 FORMAT "%5.1" ECU_ADDRESS 0x38495B /end MEASUREMENT
/begin MEASUREMENT tumgkmtr "Umgebungstemperatur in KMTR" UBYTE temp_ub_q0p75_o48 1 100 -48 143.25 FORMAT "%5.1" ECU_ADDRESS 0x38495C /end MEASUREMENT
/begin MEASUREMENT tvetrint "I-Anteil- Tastverhältnis Thermostat" SBYTE rel_sb_q0p75 1 100 -96 95.25 FORMAT "%5.2" ECU_ADDRESS 0x38495D /end MEASUREMENT
/begin MEASUREMENT tvetrr "Tastverhältnis Thermostat P-Regler-Anteil" UBYTE tv_ub_b100 1 100 0 99.6094 FORMAT "%5.2" ECU_ADDRESS 0x38495E /end MEASUREMENT
/begin MEASUREMENT tvkmtr "Tastverhältnis elektrischer Thermostat" UBYTE tv_ub_b100 1 100 0 99.6094 FORMAT "%5.2" ECU_ADDRESS 0x38495F /end MEASUREMENT
/begin MEASUREMENT tvlu1r "Regelanteil Tastverhältnis Lüfter 1" UBYTE tv_ub_b100 1 100 0 99.6094 FORMAT "%5.2" ECU_ADDRESS 0x384960 /end MEASUREMENT
/begin MEASUREMENT tvlu2r "Regelanteil Tastverhältnis Lüfter 2" UBYTE tv_ub_b100 1 100 0 99.6094 FORMAT "%5.2" ECU_ADDRESS 0x384961 /end MEASUREMENT
/begin MEASUREMENT tvlues1 "Tastverhältnis Lüfter 1" UBYTE tv_ub_b100 1 100 0 99.6094 FORMAT "%5.2" ECU_ADDRESS 0x384962 /end MEASUREMENT
/begin MEASUREMENT tvlues1r "Res. Ansteuerungstastverhältnis Lüfter 1 nach max.  Kühlleistungsanhebung" UBYTE tv_ub_b100 1 100 0 99.6094 FORMAT "%5.2" ECU_ADDRESS 0x384963 /end MEASUREMENT
/begin MEASUREMENT tvlues2 "Tastverhältnis Lüfter 2" UBYTE tv_ub_b100 1 100 0 99.6094 FORMAT "%5.2" ECU_ADDRESS 0x384964 /end MEASUREMENT
/begin MEASUREMENT tvlues2r "Res. Ansteuerungstastverhältnis Lüfter 2 nach max. Kühlleistungsanhebung" UBYTE tv_ub_b100 1 100 0 99.6094 FORMAT "%5.2" ECU_ADDRESS 0x384965 /end MEASUREMENT
/begin MEASUREMENT tvluesfl "Tastverhältnis zu Deaktivierung der Lüfter vor Flash-Programmierung" UBYTE tv_ub_b100 1 100 0 99.6094 FORMAT "%5.2" ECU_ADDRESS 0x384966 /end MEASUREMENT
/begin MEASUREMENT tvluesic "Istzustand Lüfteransteuerung" UBYTE tv_ub_b100 1 100 0 99.6094 FORMAT "%5.2" ECU_ADDRESS 0x384967 /end MEASUREMENT
/begin MEASUREMENT tvluesicb "Basis Istzustand Lüftersteuerung" UBYTE tv_ub_b100 1 100 0 99.6094 FORMAT "%5.2" ECU_ADDRESS 0x384968 /end MEASUREMENT
/begin MEASUREMENT tvlueskmtr "Lüfteransteuerwert über CAN in der KMTR" UBYTE tv_ub_b100 1 100 0 99.6094 FORMAT "%5.2" ECU_ADDRESS 0x384969 /end MEASUREMENT
/begin MEASUREMENT tvnll1r "Regelanteil Tastverhältnis Lüfter 1 im Nachlauf über Rampe abgesteuert" UBYTE tv_ub_b100 1 100 0 99.6094 FORMAT "%5.2" ECU_ADDRESS 0x38496A /end MEASUREMENT
/begin MEASUREMENT tvnll2r "Regelanteil Tastverhältnis Lüfter 2 im Nachlauf über Rampe abgesteuert" UBYTE tv_ub_b100 1 100 0 99.6094 FORMAT "%5.2" ECU_ADDRESS 0x38496B /end MEASUREMENT
/begin MEASUREMENT vfzgkmtr "Resultierende Fahrzeuggeschwindigkeit in der KMTR" UBYTE vfzg_ub_q1p25 1 100 0 318.75 FORMAT "%5.1" ECU_ADDRESS 0x38496C /end MEASUREMENT
/begin MEASUREMENT virkr "Verhältnis Integrator / Referenzpegel Klopfregelung" UBYTE fak_ub_b16 1 100 0 15.9375 FORMAT "%5.2" ECU_ADDRESS 0xF9D5 /end MEASUREMENT
/begin MEASUREMENT vkr "Verstärkungsstufe für Eingangsverstärkung Klopf-IC" UBYTE dez 1 100 0 255 FORMAT "%5.1" ARRAY_SIZE 8 ECU_ADDRESS 0x380A45 /end MEASUREMENT
/begin MEASUREMENT vkr_tst "Verstärkungsstufe für Eingangsverstärkung Klopf-IC rollierend mit Zyl.zähler" UBYTE dez 1 100 0 255 FORMAT "%5.1" ECU_ADDRESS 0x380A4D /end MEASUREMENT
/begin MEASUREMENT vpssplg_w "Druckverhältnis Saugrohrsolldruck zu Grundladedruck" UWORD fak_uw_b4 1 100 0 3.99994 FORMAT "%8.6" ECU_ADDRESS 0x38241C /end MEASUREMENT
/begin MEASUREMENT vpsspls_w "Verhältnis Soll-Saugrohrdruck zu Druck Sollladedruck" UWORD fak_uw_b2 1 100 0 1.99997 FORMAT "%8.6" ECU_ADDRESS 0x38241E /end MEASUREMENT
/begin MEASUREMENT vpsspu_w "Solldruckverhältnis Umgebung/Saugrohr" UWORD fak_uw_b4 1 100 0 3.99994 FORMAT "%8.6" ECU_ADDRESS 0x382420 /end MEASUREMENT
/begin MEASUREMENT vsksmlf_w "Volumenstrom Kraftstoff in Milliliter gefiltert" UWORD volgrd_q5p96Em4 1 100 0 39.0619 FORMAT "%8.5" ECU_ADDRESS 0x3853C0 /end MEASUREMENT
/begin MEASUREMENT vszwm "Mittelwert der ZW-Verstellung über VS2x" SBYTE zw_sb_q0p75 1 100 -96 95.25 FORMAT "%5.2" ECU_ADDRESS 0x380A6B /end MEASUREMENT
/begin MEASUREMENT wkr "zylinderindividuelle Zündwinkelspätverstellung KR" UBYTE zw_ub_qn0p75 1 100 -191.25 0 FORMAT "%5.1" ARRAY_SIZE 4 ECU_ADDRESS 0xF9D6 /end MEASUREMENT
/begin MEASUREMENT wkra "last und drehzahlabh. Adaptionskennfeld für wkr" UBYTE zw_ub_qn0p75 1 100 -191.25 0 FORMAT "%5.1" ARRAY_SIZE 160 ECU_ADDRESS 0x383343 /end MEASUREMENT
/begin MEASUREMENT wkraa "Monitor der wkra des aktuellen Adaptionsbereiches, wkra_0, _1..." UBYTE zw_ub_qn0p75 1 100 -191.25 0 FORMAT "%5.1" ARRAY_SIZE 8 ECU_ADDRESS 0x380A6C /end MEASUREMENT
/begin MEASUREMENT wkratst "wkra mit Synchro-Raster rollierend" UBYTE zw_ub_qn0p75 1 100 -191.25 0 FORMAT "%5.1" ECU_ADDRESS 0x380A74 /end MEASUREMENT
/begin MEASUREMENT wkrdy "Zündwinkelspätverstellung bei KR-Dynamik" UBYTE zw_ub_qn0p75 1 100 -191.25 0 FORMAT "%5.1" ECU_ADDRESS 0xF9DC /end MEASUREMENT
/begin MEASUREMENT wkrdya "adaptierter Zündwinkel bei KR-Dynamik" UBYTE zw_ub_qn0p75 1 100 -191.25 0 FORMAT "%5.1" ARRAY_SIZE 5 ECU_ADDRESS 0x3833E3 /end MEASUREMENT
/begin MEASUREMENT wkrm "Mittelwert der zylinderindividuellen ZW-Spätverstellungen durch KR" UBYTE zw_ub_qn0p75 1 100 -191.25 0 FORMAT "%5.1" ECU_ADDRESS 0xF9DA /end MEASUREMENT
/begin MEASUREMENT wkrma "Mittelwert der ZW-Spätverstellungen KR, allgemein (im Notlauf mit Sicherheit)" UBYTE zw_ub_qn0p75 1 100 -191.25 0 FORMAT "%5.1" ECU_ADDRESS 0xF9DB /end MEASUREMENT
/begin MEASUREMENT wkrmdy_w "Dynamischer Mittelwert der zylinderindividuellen ZW Spätverstellungen" UWORD zw_q0p1875 1 100 0 12287.8 FORMAT "%8.2" ECU_ADDRESS 0x38248E /end MEASUREMENT
/begin MEASUREMENT wkrmstat_w "Quasistationärer Mittelwert der zylinderindividuellen ZW Spätverstellwerte" UWORD zw_q0p1875 1 100 0 12287.8 FORMAT "%8.2" ECU_ADDRESS 0x382490 /end MEASUREMENT
/begin MEASUREMENT wkrmsu_w "Summenwert aus dynamischem und statischem Mittelwert der KR Verstellwinkel" UWORD zw_q0p1875 1 100 0 12287.8 FORMAT "%8.2" ECU_ADDRESS 0x382492 /end MEASUREMENT
/begin MEASUREMENT wkr_tst "zyl.ind. ZW-Spätverstellung, rollierend" UBYTE zw_ub_qn0p75 1 100 -191.25 0 FORMAT "%5.1" ECU_ADDRESS 0x380A75 /end MEASUREMENT
/begin MEASUREMENT zaldy "Zündungszähler für Abregelung Lastdynamik" UBYTE dez 1 100 0 255 FORMAT "%5.1" ECU_ADDRESS 0x380A81 /end MEASUREMENT
/begin MEASUREMENT zkrstat "" UBYTE t100msxs_ub_b25p5 1 100 0 25.5 FORMAT "%5.2" ECU_ADDRESS 0x380A76 /end MEASUREMENT
/begin MEASUREMENT zkrvf "Zähler, bestimmt die Frequenz der zyl.-individuellen Zündwinkelfrühverstellung" UBYTE dez 1 100 0 255 FORMAT "%5.1" ARRAY_SIZE 8 ECU_ADDRESS 0x380A77 /end MEASUREMENT
/begin MEASUREMENT zldy "Zündungszähler für Lastdynamik" UBYTE dez 1 100 0 255 FORMAT "%5.1" ECU_ADDRESS 0xF9DD /end MEASUREMENT
/begin MEASUREMENT zldyke "Zündungszähler für Lastdynamik => Klopferkennung" UBYTE dez 1 100 0 255 FORMAT "%5.1" ECU_ADDRESS 0xF9DE /end MEASUREMENT
/begin MEASUREMENT zndy "Zündungszähler für Drehzahldynamik" UBYTE dez 1 100 0 255 FORMAT "%5.1" ECU_ADDRESS 0xF9DF /end MEASUREMENT
/begin MEASUREMENT zzwdykr_w "Zündungszähler bei gesetztem Bit B_zwkra=1 während der KR-Dynamik" UWORD dez 1 100 0 65535 FORMAT "%8.2" ECU_ADDRESS 0xF9E0 /end MEASUREMENT
/begin MEASUREMENT zzwdymd_w "Zündungszähler bei nicht gesetztem Bit B_zwkra=0 während der KR-Dynamik" UWORD dez 1 100 0 65535 FORMAT "%8.2" ECU_ADDRESS 0xF9E2 /end MEASUREMENT
/begin FUNCTION KMTR "3.290     Kühlmitteltemperaturregelung"
 /begin DEF_CHARACTERISTIC CWDEZWO CWKMTR CWLUEKO DKL1DTEV DKL2DTEV DMTSMN DMTSMX DQUEBERMN DQUEBERMX DQUEBMX ETRIMN ETRIMX FNLPRUEF KFANFPU KFDQTMTU KFDQUEBER KFKTRLN KFKTRV KFNL2TUM KFNLTKV KFNLTUM KFQNVP1 KFQNVP2 KFQVAC KFQVKOM KFTMOTKR KFTVETR KFTVLUE1 KFTVLUE2 KFVPNLU1 KFVPNLU2 KLAH1 KLAH2 KLAHEW KLAHTMSMX1 KLAHTMSMX2 KLAHTVLUE1 KLAHTVLUE2 KLANFVFZ KLFDQV KLFQKV KLLUESIC KLMLFT KLNLOEL KLNLSTP KLNLTUM KLQKLIMA KLQVHDS KLTMSKR KLTVLU1EW KLTVLU2EW LUEKO1 LUEKO2 LUEKO3 NM1MN1 NM1MN2 NM1MN3 NM1MX1 NM1MX2 NM1MX3 NM1VMN NM1VN NM1VP NM2MN1 NM2MN2 NM2MN3 NM2MX1 NM2MX2 NM2MX3 NM2VMN NM2VN NM2VP NSTNMKMTR PKLIHDV PKLIMA PKODR QKLIHDV QKLILU1 QKLILU2 QMAXL1INI QMAXL2INI STS05DTKA STS05DTTS TETRST TFLZLR TKATVLSMN TKATVLSMX TKLIHDV TLUEST TMEWKMTR TMOTDQMX TMOTDTEV TMOTKRMN TMOTKRMX TMSO5INI TMSOINI TMSOLLEW TMSOTOEL TNLARAMP TNLKMTRMN TNLSTMX TNLSTP TOLEWKMTR TUHEMN TUHEMX TUMEWKMTR TUMKLIHDV TUMLUESEW TUPOTMN TUPOTMX TVETREW TVETRMN TVETRMX TVKLIHDV1 TVKLIHDV2 TVLU1MN TVLU1MX TVLU2MN TVLU2MX TVLUESETR TVLUESICEW TVLUESSEW TVNL1OFF TVNL2OFF TVNLETR TVNLL1 TVNLL2 TVNLT1 TVNLT2 TVNLTETR TVSTETR TVSTL1 TVSTL2 TZKNLL1 TZKNLL2 VFZGEW ZKETR ZKNLST ZKQMAXL1 ZKQMAXL2 ZKTMSN ZKTMSP ZVSKS /end DEF_CHARACTERISTIC
 /begin REF_CHARACTERISTIC CWKVHR /end REF_CHARACTERISTIC
 /begin IN_MEASUREMENT B_ckien B_dtest B_fakmtr B_fpwld B_hlon B_kdhre B_kl15 B_klimex B_luef1 B_luef2 B_luef3 B_luesscb B_nlsgls B_nmot B_nukla B_pwf B_sacc B_skoc B_st B_stend klahc nmot pkodrc pu rl rlshk S_ac S_hds S_ko takols tka tmki tmot tnse_w toel tumg tvluessc uhepoti upotpwm vfzg vsksml_w wkrma /end IN_MEASUREMENT
 /begin OUT_MEASUREMENT B_fpwld_ok B_kmtre B_motabw B_nlel B_tmkmtr B_zwp dkmts dtmtka esst_sts05dtka esst_sts05dtts klah klahtmsmx tkakmtr tmotkmtr tvkmtr tvlues1 tvlues2 tvluesic tvlueskmtr vfzgkmtr /end OUT_MEASUREMENT
 /begin LOC_MEASUREMENT B_deaklue B_deaklue1 B_deaklue2 B_elues1 B_elues2 B_klahmx B_klihdv B_nlphase2 B_nlsgls2 dqueber dtka dtkaint flashzlr krtmso luelogin nlue1 nlue1mn nlue2 nlue2mn nluez1 nluez2 pklimakmtr qkl1dtev qkl2dtev qklima qmax1dtev qmax2dtev qmaxdtev1 qmaxdtev2 qmaxl1 qmaxl2 qnvp1 qnvp2 rltmso1 tmotnl2 tmotsoll tmso1 tmso2 tmso3 tmso4 tmso5 tmso6 tnlkmtr_w tnlst2kt_w tnlstktr_w toelkmtr tume tumgkmtr tvetrint tvetrr tvlu1r tvlu2r tvlues1r tvlues2r tvluesfl tvluesicb tvnll1r tvnll2r vsksmlf_w /end LOC_MEASUREMENT
 /begin SUB_FUNCTION /end SUB_FUNCTION
/end FUNCTION
/begin FUNCTION KOS "113.180   Klimakompressor - Steuerung"
 /begin DEF_CHARACTERISTIC CDWGANG_0_A CDWGANG_1_A CDWGANGB_0_A CDWGANGB_1_A CDWKOB_0_A CDWKOB_1_A CWKOC CWKOCAN CWKOR DWPEDKOB FHOKOB KFTNSTKO MDKOAB MDKOAN MDKOEN PKODRCMX SNM08KOUB TANSKOB TKOAMAD TKOAMNN TKOAMXN TKOBEMNN TKODPAMNN TKODPAMXN TKOEMNN TKOMBKOA TKOMBKOE TKOTMSK TKOVKO TKOWPAMNN TKOWPAMXN TMKOAO TMKOAU TMSTMAD TNSTKO TVKOE1 TVKOEOF TVKOEP TVKOEV TVKOGANDEL TVKOSSIM VKO VKOAO VKOB VNVKO VNVKOB WPEDKO /end DEF_CHARACTERISTIC
 /begin REF_CHARACTERISTIC /end REF_CHARACTERISTIC
 /begin IN_MEASUREMENT B_autget B_bkvkomab B_dknolu B_dkpu B_gekoa B_grdst B_gsch B_gwhs B_kooffc B_kuppl B_ll B_madfk B_madfs B_madko B_madll B_sa B_sacc B_skoc B_st B_stend dwped fho fho_w gangi mdko_w mifal_w nmot pkodrc S_ac S_ko tans tmki tmot tmst vfzg wped /end IN_MEASUREMENT
 /begin OUT_MEASUREMENT B_acres B_ko B_kobaus B_kobmnon B_koe B_kosrc B_kov B_nac /end OUT_MEASUREMENT
 /begin LOC_MEASUREMENT B_koa B_kobped B_kobpedt B_kobwped B_kobwpedt B_koena B_koenat B_kogandel B_koganped B_koint B_komnoff B_komnon B_komxoff B_kooff B_koofft B_kotmsk B_kotmsko B_kovdown B_kow B_tvkoe1w esst_snm08koub S_acw /end LOC_MEASUREMENT
 /begin SUB_FUNCTION /end SUB_FUNCTION
/end FUNCTION
/begin FUNCTION KRACT "" /begin DEF_CHARACTERISTIC /end DEF_CHARACTERISTIC
 /begin REF_CHARACTERISTIC AGR_AOG AGR_AUG CNSDEF CNS_AOG CNS_AUG CWTAF CWTAK CWTAS DZW_AOG DZW_AUG FBA_AOG FBA_AUG FLR_AOG FLR_AUG FNS_AOG FNS_AUG FRK_AOG FRK_AUG FST_AOG FST_AUG FVA_AOG FVA_AUG FWL_AOG FWL_AUG MDR_AOG MDR_AUG MWNTKB5 NLS_AOG NLS_AUG RLX_AOG RLX_AUG VVR_AOG VVR_AUG /end REF_CHARACTERISTIC
 /begin IN_MEASUREMENT B_ekpvl B_fa B_grdst B_kl15 B_kstebf B_stend nmot_w vstagr vstcns vstdzw vstfba vstfns vstfrk vstfst vstfva vstfwl vstlr vstmdr vstnls vstrlx vstvvr /end IN_MEASUREMENT
 /begin OUT_MEASUREMENT /end OUT_MEASUREMENT
 /begin LOC_MEASUREMENT /end LOC_MEASUREMENT
 /begin SUB_FUNCTION /end SUB_FUNCTION
/end FUNCTION
/begin FUNCTION KRDY "Klopfregelung Dynamik"
 /begin DEF_CHARACTERISTIC AZKELDYN AZKRLDYN AZKRNDYN CWKRDY CWTIPIN CWTIPIN_G DPSKRAN DYADMXN DYADS DYAFVS DYAMNV DYAVF DZWTIN FKELDYA KFDYESP KFDYMNT KFDYRSP KFDYRSPOF NGKRAWN NGKRWN PZWKRA TMDYNA ZDRLKRA ZNGKRA /end DEF_CHARACTERISTIC
 /begin REF_CHARACTERISTIC SNM16KRDYUB SNM16KRUB SRL06KRUB /end REF_CHARACTERISTIC
 /begin IN_MEASUREMENT B_adrkra B_kl B_kr B_krdws B_kuppl B_ll B_pwf B_tmkr B_vnull B_zwkraa dpsfg_w dpsmp_w drlp_w drl_w esst_snm16krdyub esst_snm16krub esst_srl06krub evtmod gangi kek krfkw ngas_w nmot rl rlp_w rl_w stkrnx tmot virkr zzylkr /end IN_MEASUREMENT
 /begin OUT_MEASUREMENT B_krldy B_krldya B_krldyn B_krndy B_krndyn dpskrav_w dymntv dyrsofv_w dyrsv_w ngkrav_w ngkrv_w wkrdy /end OUT_MEASUREMENT
 /begin LOC_MEASUREMENT B_drknv B_drlkrdy B_kldynrm B_kldystk B_krldyafok B_krldyf B_krldyv B_ladap B_tipin dpskrmx_w dpskrra_w dyesv_w ngkraf_w stuetz wkrdya zaldy zldy zldyke zndy zzwdykr_w zzwdymd_w /end LOC_MEASUREMENT
 /begin SUB_FUNCTION /end SUB_FUNCTION
/end FUNCTION
/begin FUNCTION KRKE "16.30     Klopferkennung"
 /begin DEF_CHARACTERISTIC CWKRREF CWREFI FKEFMC FKELDY FKENDY FKRFTPFMC KFKEF1 KFKEF2 KFKEF3 KFKEF4 KFKEF5 KFKEF6 KFKEF7 KFKEF8 KRFTP1 KRFTP2 KRFTP3 KRKFKS KRVST KSZA REFINI RKRMX1N RKRMX2N ZYRKR /end DEF_CHARACTERISTIC
 /begin REF_CHARACTERISTIC SNM16KRUB SRL03KRUB /end REF_CHARACTERISTIC
 /begin IN_MEASUREMENT B_c95ks3 B_dnt B_dntb B_dtp B_dtpb B_fmfkrc B_kr B_krldy B_krndy B_krnl B_st esst_snm16krub esst_srl03krub ikr ikrma ikrme nmot rl vske zzylkr /end IN_MEASUREMENT
 /begin OUT_MEASUREMENT B_c95_g0 B_c95_g1 B_c95_g2 B_kl ikrrkr_wert ikr_kek_wert ke kek kek_tst krftpakt rkr rkrmx rkrmx1w rkrmx2w rkr_tst temp_b_wert virkr vkr vkr_tst /end OUT_MEASUREMENT
 /begin LOC_MEASUREMENT /end LOC_MEASUREMENT
 /begin SUB_FUNCTION /end SUB_FUNCTION
/end FUNCTION
/begin FUNCTION KRRA "15.130    Klopfregelung mit Adaption der zylinderindividuellen Spätverstellung"
 /begin DEF_CHARACTERISTIC CWKRLZFK CWKRNLR CWKRRA DRLKRSTMX DWKRMSN KRAL1N KRAL2N KRAL3N KRALH KRAN1_0_A KRAN1_1_A KRAN2 KRAN3 KRAN4 KRANH KRDWA KRDWAA KRDWKLA KRDWSA KRDWSN KRFKLN KRFKN KRLVFN KRMXN KRNLZ KRVFN KRVFSN KRWKRAIN LKRAN LKRN LZB1 LZB2 LZFUER NGKRSTMX NKRAMAX NKRAMIN NKRF NKRMAX TMKR TMKRA TMKRAS TVKRSTAT WKRLZOF WKRLZOFEKS /end DEF_CHARACTERISTIC
 /begin REF_CHARACTERISTIC KSZA SENZZYL0 SNM16KRUB /end REF_CHARACTERISTIC
 /begin IN_MEASUREMENT B_adrkra B_asr B_kl B_krldy B_krldya B_krldyn B_krndy B_krndyn B_llr B_nldg B_nmax B_pwf B_stend B_synph B_vmax drl_w esst_snm16krub ngfil_w nmot rl tmot vszwkr zwkrafld zzylkr /end IN_MEASUREMENT
 /begin OUT_MEASUREMENT B_kr B_krdws B_krfdks B_krlz B_krnl B_krnlr B_krstatb B_krwa B_tmkr dwkr dwkrz lkraw lkrw stkrnx wkrma /end OUT_MEASUREMENT
 /begin LOC_MEASUREMENT B_kra B_krafrz B_krfrz B_krlzn B_krvf B_kseb1 B_kseb2 B_wkral B_zwkraa B_zwkrum dwkrmsw kral1w kral2w kral3w krdwsw krfkw krlzn krmxw krvfsw krvfw lzist stkrax stkrlx vszwm wkr wkra wkraa wkratst wkrm wkr_tst zkrstat zkrvf /end LOC_MEASUREMENT
 /begin SUB_FUNCTION /end SUB_FUNCTION
/end FUNCTION
/begin FUNCTION KVA "41.40     Ausgangssignal: Kraftstoff-Verbrauchs-Anzeige" /begin DEF_CHARACTERISTIC CWCKBI FKVA KD KVB /end DEF_CHARACTERISTIC /begin REF_CHARACTERISTIC KRKTE /end REF_CHARACTERISTIC /begin IN_MEASUREMENT B_sa rkte_w rk_w /end IN_MEASUREMENT /begin OUT_MEASUREMENT B_kvakbi int_ctr kvakbi_w tkvad tkvag_w tkvar tkva_h /end OUT_MEASUREMENT /begin LOC_MEASUREMENT B_tisum tisum_w /end LOC_MEASUREMENT /begin SUB_FUNCTION /end SUB_FUNCTION /end FUNCTION
/begin FUNCTION KWP2000F "" /begin DEF_CHARACTERISTIC /end DEF_CHARACTERISTIC /begin REF_CHARACTERISTIC /end REF_CHARACTERISTIC /begin IN_MEASUREMENT nmot /end IN_MEASUREMENT /begin OUT_MEASUREMENT /end OUT_MEASUREMENT /begin LOC_MEASUREMENT /end LOC_MEASUREMENT /begin SUB_FUNCTION /end SUB_FUNCTION /end FUNCTION
/begin FUNCTION KWPDATR "" /begin DEF_CHARACTERISTIC /end DEF_CHARACTERISTIC
 /begin REF_CHARACTERISTIC ADRONLOGIN GRAOFLOGIN GRAONLOGIN HLOFFLOGIN HLONLOGIN KLOGIN LUEN1LOGIN LUEN2LOGIN LUEN3LOGIN SLOGIN /end REF_CHARACTERISTIC
 /begin IN_MEASUREMENT B_acc B_accen B_fgrte B_hlon B_kl15 B_luef1 B_luef2 B_luef3 nmot_w /end IN_MEASUREMENT
 /begin OUT_MEASUREMENT /end OUT_MEASUREMENT
 /begin LOC_MEASUREMENT /end LOC_MEASUREMENT
 /begin SUB_FUNCTION /end SUB_FUNCTION
/end FUNCTION
/begin FUNCTION KWPDIAG "" /begin DEF_CHARACTERISTIC /end DEF_CHARACTERISTIC /begin REF_CHARACTERISTIC /end REF_CHARACTERISTIC /begin IN_MEASUREMENT /end IN_MEASUREMENT /begin OUT_MEASUREMENT /end OUT_MEASUREMENT /begin LOC_MEASUREMENT /end LOC_MEASUREMENT /begin SUB_FUNCTION /end SUB_FUNCTION /end FUNCTION
/begin FUNCTION KWPSTDA "" /begin DEF_CHARACTERISTIC /end DEF_CHARACTERISTIC /begin REF_CHARACTERISTIC /end REF_CHARACTERISTIC /begin IN_MEASUREMENT fcmEnd FCMTab ffzdfp /end IN_MEASUREMENT /begin OUT_MEASUREMENT /end OUT_MEASUREMENT /begin LOC_MEASUREMENT /end LOC_MEASUREMENT /begin SUB_FUNCTION /end SUB_FUNCTION /end FUNCTION
/begin FUNCTION KWPSTDAA "" /begin DEF_CHARACTERISTIC /end DEF_CHARACTERISTIC /begin REF_CHARACTERISTIC /end REF_CHARACTERISTIC /begin IN_MEASUREMENT B_kl15 /end IN_MEASUREMENT /begin OUT_MEASUREMENT /end OUT_MEASUREMENT /begin LOC_MEASUREMENT /end LOC_MEASUREMENT /begin SUB_FUNCTION /end SUB_FUNCTION /end FUNCTION
/begin FUNCTION LAKH "4.60      Lambda-Koordination bei Katheizen"
 /begin DEF_CHARACTERISTIC CWLAKH IMLLASKH_0_A IMLLASKH_1_A KFLANSKH KFLASKH_0_A KFLASKH_1_A KFLMSKH_0_A KFLMSKH_1_A KLLAKHFH LASDSLA LASTMOT LMSTMOT ZFLASKH /end DEF_CHARACTERISTIC
 /begin REF_CHARACTERISTIC /end REF_CHARACTERISTIC
 /begin IN_MEASUREMENT anztib_w B_dsla B_fasla B_kh fho_w flakh flamsl_w flmssl fmsldyn fslpdyn imlpr ml_w nmot_w rl_w tmot tmst /end IN_MEASUREMENT
 /begin OUT_MEASUREMENT B_lamkhe lamkh2_w lamkh_w /end OUT_MEASUREMENT
 /begin LOC_MEASUREMENT B_dslafa flaskh flmsslkh fslsdyn LAKHlokBits lamkhg_w lamkhr_w lanskh_w lasdslg_w lasdsl_w laskh_w lmskh_w lmssl_w /end LOC_MEASUREMENT
 /begin SUB_FUNCTION /end SUB_FUNCTION
/end FUNCTION
/begin FUNCTION LAMBTS "11.10     Lambda Bauteileschutz"
 /begin DEF_CHARACTERISTIC CWLAMBTS DTBTS FBSTABGM FBSTMOT KFDLBTS KFFDLBTS KFLBTS KFTVLBTS SNM16GKUB SRL12GKUW TABGBTS TDLAMBTS TIKATBTS TKATBTS ZDLBTS ZLBTS /end DEF_CHARACTERISTIC
 /begin REF_CHARACTERISTIC ETADZW /end REF_CHARACTERISTIC
 /begin IN_MEASUREMENT B_dash B_gsaf dzw_kge etazwist nmot rl rl_w tabgkrm_w tabgm_w tikatm_w tkatm_w tmot zwgru zwopt /end IN_MEASUREMENT
 /begin OUT_MEASUREMENT esst_snm16gkub esst_srl12gkuw lambts_w /end OUT_MEASUREMENT
 /begin LOC_MEASUREMENT B_tabgbts B_tatmbts B_tikatbts B_tkatbts B_twilabts B_twistbts detazwbs dlambts_w dzwg etazwg etazwim flbts_w LAMBTSlokbits lbts_w tabgbts_w /end LOC_MEASUREMENT
 /begin SUB_FUNCTION /end SUB_FUNCTION
/end FUNCTION
/begin FUNCTION LAMFAW "13.20     Lambda Fahrerwunsch"
 /begin DEF_CHARACTERISTIC CWLAMFAW DLAMFAW DLAMOB DLAMTANS KFLAFWL_0_A KFLAFWL_1_A KFLAMKR_0_A KFLAMKR_1_A KFLAMKRL KLSZKLAMFA KLTLAFA KLTLAFAKR KLWLAFWL_0_A KLWLAFWL_1_A KLZKLAMFAW LAMFA LAMRLMN RLLAMMN SDZ06GKUB TVLAMRLMN ZKLAMFAW ZKWLAFWL /end DEF_CHARACTERISTIC
 /begin REF_CHARACTERISTIC SNM06GKUB SNM07ESUB SRL06GKUB STM08GKUB /end REF_CHARACTERISTIC
 /begin IN_MEASUREMENT B_ba B_ldob B_sab B_stend B_vag dzwwl esst_snm06gkub esst_snm07esub esst_srl06gkub esst_stm08gkub mifafu_w milsol_w mrfa_w nmot rl tans tmot wkrma /end IN_MEASUREMENT
 /begin OUT_MEASUREMENT B_ldeffw esst_sdz06gkub lamfa_w /end OUT_MEASUREMENT
 /begin LOC_MEASUREMENT B_lamfas dzwlamfaw lamfawkr_w lamfaws_w lamfaw_w lamfwl_w lamrlmn_w /end LOC_MEASUREMENT
 /begin SUB_FUNCTION /end SUB_FUNCTION
/end FUNCTION
/begin FUNCTION LAMKO "9.90      Lambdakoordination"
 /begin DEF_CHARACTERISTIC CWLAMKH LAMFLGSL LAMLGFKT LAMLGFTM LAMLGMKT LAMLGMTM LAMSOSOF LAMSOSUF LASOAB /end DEF_CHARACTERISTIC
 /begin REF_CHARACTERISTIC STM12ESUB /end REF_CHARACTERISTIC
 /begin IN_MEASUREMENT B_bevab B_dsla B_fa B_falsh B_fasla B_kh B_lamdkt B_lamkhe B_lamlash B_lamnse B_ldeffw B_sls B_slsfz dlamatr_w esst_stm12esub flamkh flamsl_w imlatm lambts_w lamdkt_w lamelsh_w lamfa_w lamka_w lamkh_w lamlash_w lamnswl_w tmot /end IN_MEASUREMENT
 /begin OUT_MEASUREMENT B_lalgf B_lamdiag B_lamsdef lambas lamsbg_w lamsons_w lamvoa_w /end OUT_MEASUREMENT
 /begin LOC_MEASUREMENT B_lambts B_lamka B_lamkh B_lamnswl B_ldef lamkhe_w lamlgfmn lamlgm lamsos_w lamsubg_w lams_w /end LOC_MEASUREMENT
 /begin SUB_FUNCTION /end SUB_FUNCTION
/end FUNCTION
/begin FUNCTION LANSWL "2.20      Lambda Nachstart / Warmlauf"
 /begin DEF_CHARACTERISTIC ATISLATM ATIWKSTM CWWL DLAMNSWL KFLANS KFLASWLR_0_A KFLASWLR_1_A LASWLTM_0_A LASWLTM_1_A ZKLANSWL /end DEF_CHARACTERISTIC
 /begin REF_CHARACTERISTIC STM12ESUB STS12ESUB /end REF_CHARACTERISTIC
 /begin IN_MEASUREMENT anztib_w B_lrnda B_stendes B_wks esst_stm12esub esst_sts12esub tmot tmst /end IN_MEASUREMENT
 /begin OUT_MEASUREMENT B_lamnse lamnswl_w lamns_w /end OUT_MEASUREMENT
 /begin LOC_MEASUREMENT anztib0_w anztib1_w B_lawlon lamwl_w /end LOC_MEASUREMENT
 /begin SUB_FUNCTION /end SUB_FUNCTION
/end FUNCTION
/begin FUNCTION LDOB "31.30     LDR Overboost"
 /begin DEF_CHARACTERISTIC ELDOB FKLDOBG GWPLDOB KFLDRXO TABLDOBN TLDOBAN TLDOBN TSTLDOBA TVLDOBSO /end DEF_CHARACTERISTIC
 /begin REF_CHARACTERISTIC SNM08LDUB /end REF_CHARACTERISTIC
 /begin IN_MEASUREMENT B_kuppl B_ldr esst_snm08ldub gangi lde nmot tans wped /end IN_MEASUREMENT
 /begin OUT_MEASUREMENT B_ldob B_ldobsp drlmaxo /end OUT_MEASUREMENT
 /begin LOC_MEASUREMENT /end LOC_MEASUREMENT
 /begin SUB_FUNCTION /end SUB_FUNCTION
/end FUNCTION
/begin FUNCTION LDRLMX "3.110     Berechnung LDR Maximalfuellung rlmax"
 /begin DEF_CHARACTERISTIC CWRLMX FKRXTOL KFFKRXTM KFFLDEO KFFLLDE KFFSLDE KFFWLLDE KFLDHBN KFTARX KFTARXZK LDORXN LDPBN LDRXN LDRXNZK RLKRLDA STA10LDUB SWK08LDUW SWK108LDUW SWK208LDUW TLKRLDAB TLKRLDAU TMOTMX TOELMX TOLEWRLMX TSKRLDAB TSKRLDAU TUMMX_LDRLMX_IMPL /end DEF_CHARACTERISTIC
 /begin REF_CHARACTERISTIC SNM08LDUB SNM08LDUW SNM12LDUW STA08LDUB /end REF_CHARACTERISTIC
 /begin IN_MEASUREMENT B_atrf B_atsb B_ckien B_kfzk B_ll B_pwf B_tmkib B_tolcb B_tumcb drlmaxo esst_snm08ldub esst_snm08lduw esst_snm12lduw esst_sta08ldub fupsrl_w nmot nmot_w pirg_w pu rl tans tmki tmot tolc tumc vfzg vsrlmx vstrlx wkrma /end IN_MEASUREMENT
 /begin OUT_MEASUREMENT esst_sta10ldub rlmax_w rlmx_w tmotldrlmx toelldrlmx tsel wkrmdy_w wkrmstat_w wkrmsu_w /end OUT_MEASUREMENT
 /begin LOC_MEASUREMENT B_brlmx dwkrm_w esst_swk08lduw esst_swk108lduw esst_swk208lduw fldrrx_w fldrxk_w fldrxl_w fldrxo_w frxt frxta_w ldrlms_w ldrlts_w rlmxko_w /end LOC_MEASUREMENT
 /begin SUB_FUNCTION /end SUB_FUNCTION
/end FUNCTION
/begin FUNCTION LDRPID "25.10     LDR PID-Regler"
 /begin DEF_CHARACTERISTIC CWLDIMX FTLDIA FTLDIAP KFLDIMX KFLDIOPU KFLDIWL KFLDRL KFLDRQ0 KFLDRQ1 KFLDRQ2 KFRBGOF LDAMN LDDIAN LDDIAP LDDIMNN LDDIMXN LDEIAO LDEIAP LDEIAPS LDEIAU LDHIA LDIATA LDMXNN LDMXNP LDRQ0S LDRQ1ST LDRVL NLDIAPU SPL08LDUW STLDIA1 STLDIA2 STLDIA3 STLDIA4 STV10LDSW TLDIAN TLDIAPN TVLDMX UMDYLDR /end DEF_CHARACTERISTIC
 /begin REF_CHARACTERISTIC SLD04LDUB SNM08LDUB SNM08LDUW SNM16LDUB SNM16LDUW SPU08LDUB STA08LDUB /end REF_CHARACTERISTIC
 /begin IN_MEASUREMENT B_adrldra B_ldr B_pwf esst_sld04ldub esst_snm08ldub esst_snm08lduw esst_snm16ldub esst_snm16lduw esst_spu08ldub esst_sta08ldub imlatm ngfil nmot nmot_w plgrus_w plsol plsol_w pu pvdkds rlmax_w rlsol_w tans tmst /end IN_MEASUREMENT
 /begin OUT_MEASUREMENT esst_spl08lduw esst_stv10ldsw irbgof_w lde ldimxak_w ldtv /end OUT_MEASUREMENT
 /begin LOC_MEASUREMENT B_lddy B_ldimxa B_ldimxn B_ldimxp B_ldvl B_stldw ldimn_w ldimxa ldimxrk_w ldimxr_w ldimx_w lditv_w ldptv ldrdtv ldrkd_w ldrki_w ldrkp_w ldtvr_w plsolr_w stldia /end LOC_MEASUREMENT
 /begin SUB_FUNCTION /end SUB_FUNCTION
/end FUNCTION
/begin FUNCTION LDRPLS "2.50      Berechnung Soll-Ladedruck" /begin DEF_CHARACTERISTIC CWLDRPLS KFVPDKSD KFVPDKSE TDPDK /end DEF_CHARACTERISTIC /begin REF_CHARACTERISTIC SNM12LDUW SVP12LDUW /end REF_CHARACTERISTIC
 /begin IN_MEASUREMENT B_asr B_ldob B_ldobsp esst_snm12lduw esst_svp12lduw nmot_w plgrus_w pssol_w pu_w /end IN_MEASUREMENT
 /begin OUT_MEASUREMENT vpssplg_w vpsspls_w /end OUT_MEASUREMENT
 /begin LOC_MEASUREMENT fmvp_w vpsspu_w /end LOC_MEASUREMENT
 /begin SUB_FUNCTION /end SUB_FUNCTION
/end FUNCTION
/begin FUNCTION LDTVMA "21.10     Aufbereitung und Ausgabe Tastverhältnis" /begin DEF_CHARACTERISTIC KFLDRAPP KFTVLDRE LDRAPP LDRPBU TVLDMN /end DEF_CHARACTERISTIC /begin REF_CHARACTERISTIC TVLDMX /end REF_CHARACTERISTIC
 /begin IN_MEASUREMENT B_ldb B_ldrbu B_lds B_ldsafw B_ldsapp ldtv nmot plsol rl rlsol_w vsldtv wped /end IN_MEASUREMENT
 /begin OUT_MEASUREMENT ldtvm /end OUT_MEASUREMENT
 /begin LOC_MEASUREMENT ldebu ldtvbu_w ldtvmd /end LOC_MEASUREMENT
 /begin SUB_FUNCTION /end SUB_FUNCTION
/end FUNCTION
/begin FUNCTION LDUVST "2.90      LDR-Schubumluftventilsteuerung"
 /begin DEF_CHARACTERISTIC GWPLDU GWPLDUR HSLDSUA HSSLDSUA LDUVRS PIDLDSUA SDLDSUA SVDLDUVS TALDUVSE THLDUVD /end DEF_CHARACTERISTIC
 /begin REF_CHARACTERISTIC /end REF_CHARACTERISTIC
 /begin IN_MEASUREMENT B_ll B_stend dwped nmot plgrus_w plsol_w pu_w pvdkds_w /end IN_MEASUREMENT
 /begin OUT_MEASUREMENT B_ldsua pdpld pdpld_w /end OUT_MEASUREMENT
 /begin LOC_MEASUREMENT B_ldsuad B_ldsuas plmaxa_w /end LOC_MEASUREMENT
 /begin SUB_FUNCTION /end SUB_FUNCTION
/end FUNCTION
/begin FUNCTION LLRBB "505.10    Leerlaufregelung Betriebsbedingungen"
 /begin DEF_CHARACTERISTIC CNFKUPPL DNLLR TVDK TVKUPPL TVLLR TVLLRI_0_A TVLLRI_1_A TVLLRPD TVLLRSTE_0_A TVLLRSTE_1_A VLLR /end DEF_CHARACTERISTIC
 /begin REF_CHARACTERISTIC /end REF_CHARACTERISTIC
 /begin IN_MEASUREMENT B_dash B_fil B_fs B_kuppl B_ll B_mdein B_nmot B_sa B_sab B_stend dmllri_w dn gangi mill_w nmot nmotll nsol nstat tmot vfzg /end IN_MEASUREMENT
 /begin OUT_MEASUREMENT B_enllri B_ensol B_llr B_llrein B_llri B_llrpd B_nstu B_vllr /end OUT_MEASUREMENT
 /begin LOC_MEASUREMENT /end LOC_MEASUREMENT
 /begin SUB_FUNCTION /end SUB_FUNCTION
/end FUNCTION
/begin COMPU_METHOD B_TRUE "boolsche Zustände, positive Logik" TAB_VERB "%6.3" "" COMPU_TAB_REF B_TRUE /end COMPU_METHOD
/begin COMPU_VTAB B_TRUE "boolsche Zustände, positive Logik" TAB_VERB 2 0 "----" 1 "TRUE" /end COMPU_VTAB
/begin COMPU_METHOD DEZ "1 : 1 Umrechnug (dez/hex)" RAT_FUNC "%6.2" "" COEFFS 0 1 0 0 0 1 /end COMPU_METHOD
/begin COMPU_METHOD dez "1 : 1 Umrechnug (dez/hex)" RAT_FUNC "%6.2" "" COEFFS 0 1 0 0 0 1 /end COMPU_METHOD
/begin COMPU_METHOD fak_q0p000244 "" RAT_FUNC "%6.5" "-" COEFFS 0 65536 0 0 0 16 /end COMPU_METHOD
/begin COMPU_METHOD fak_sb_b1 "" RAT_FUNC "%6.4" "-" COEFFS 0 256 0 0 0 2 /end COMPU_METHOD
/begin COMPU_METHOD fak_sw_b8 "" RAT_FUNC "%6.5" "-" COEFFS 0 65536 0 0 0 16 /end COMPU_METHOD
/begin COMPU_METHOD fak_ub_b1 "" RAT_FUNC "%6.4" "-" COEFFS 0 256 0 0 0 1 /end COMPU_METHOD
/begin COMPU_METHOD fak_ub_b16 "" RAT_FUNC "%6.4" "-" COEFFS 0 256 0 0 0 16 /end COMPU_METHOD
/begin COMPU_METHOD fak_ub_b2 "" RAT_FUNC "%6.4" "-" COEFFS 0 256 0 0 0 2 /end COMPU_METHOD
/begin COMPU_METHOD fak_ub_b4 "" RAT_FUNC "%6.4" "-" COEFFS 0 256 0 0 0 4 /end COMPU_METHOD
/begin COMPU_METHOD fak_ub_b64 "" RAT_FUNC "%6.3" "-" COEFFS 0 256 0 0 0 64 /end COMPU_METHOD
/begin COMPU_METHOD fak_uw_b1 "" RAT_FUNC "%7.6" "-" COEFFS 0 65536 0 0 0 1 /end COMPU_METHOD
/begin COMPU_METHOD fak_uw_b16 "" RAT_FUNC "%6.5" "-" COEFFS 0 65536 0 0 0 16 /end COMPU_METHOD
/begin COMPU_METHOD fak_uw_b2 "" RAT_FUNC "%7.6" "-" COEFFS 0 65536 0 0 0 2 /end COMPU_METHOD
/begin COMPU_METHOD fak_uw_b4 "" RAT_FUNC "%7.6" "-" COEFFS 0 65536 0 0 0 4 /end COMPU_METHOD
/begin COMPU_METHOD m_ub_b1020 "" RAT_FUNC "%6.2" "kg/h" COEFFS 0 1 0 0 0 4 /end COMPU_METHOD
/begin COMPU_METHOD m_ub_b23p3 "" RAT_FUNC "%6.3" "kg" COEFFS 0 2812.5 0 0 0 256 /end COMPU_METHOD
/begin COMPU_METHOD m_ub_b780 "" RAT_FUNC "%6.2" "cm^3/min" COEFFS 0 256 0 0 0 780 /end COMPU_METHOD
/begin COMPU_METHOD m_uw_b6553p5 "" RAT_FUNC "%6.3" "kg/h" COEFFS 0 1 0 0 0 0.1 /end COMPU_METHOD
/begin COMPU_METHOD nmotg_sb_q100 "" RAT_FUNC "%6.0" "U/min/s" COEFFS 0 1 0 0 0 100 /end COMPU_METHOD
/begin COMPU_METHOD nmotg_sw_q0p39 "" RAT_FUNC "%6.3" "U/min/s" COEFFS 0 1 0 0 0 0.39063 /end COMPU_METHOD
/begin COMPU_METHOD nmot_ub_q10 "" RAT_FUNC "%6.1" "U/min" COEFFS 0 1 0 0 0 10 /end COMPU_METHOD
/begin COMPU_METHOD nmot_ub_q20 "" RAT_FUNC "%6.1" "U/min" COEFFS 0 1 0 0 0 20 /end COMPU_METHOD
/begin COMPU_METHOD nmot_ub_q40 "" RAT_FUNC "%6.1" "Upm" COEFFS 0 1 0 0 0 40 /end COMPU_METHOD
/begin COMPU_METHOD nmot_uw_q0p25 "" RAT_FUNC "%6.3" "U/min" COEFFS 0 1 0 0 0 0.25 /end COMPU_METHOD
/begin COMPU_METHOD p_q0p2 "" RAT_FUNC "%6.3" "bar" COEFFS 0 5 0 0 0 1 /end COMPU_METHOD
/begin COMPU_METHOD p_sb_q10 "" RAT_FUNC "%6.1" "hPa" COEFFS 0 1 0 0 0 10 /end COMPU_METHOD
/begin COMPU_METHOD p_sw_q0p039 "" RAT_FUNC "%6.4" "hPa" COEFFS 0 256 0 0 0 10 /end COMPU_METHOD
/begin COMPU_METHOD p_ub_q10 "" RAT_FUNC "%6.1" "hPa" COEFFS 0 1 0 0 0 10 /end COMPU_METHOD
/begin COMPU_METHOD p_ub_q5 "" RAT_FUNC "%6.2" "hPa" COEFFS 0 1 0 0 0 5 /end COMPU_METHOD
/begin COMPU_METHOD p_uw_q0p039 "" RAT_FUNC "%6.4" "hPa" COEFFS 0 256 0 0 0 10 /end COMPU_METHOD
/begin COMPU_METHOD qnv_uw_b512 "" RAT_FUNC "%6.4" "(U/min)/(km/h)" COEFFS 0 65536 0 0 0 512 /end COMPU_METHOD
/begin COMPU_METHOD relPED_ub_b100 "" RAT_FUNC "%6.3" "% PED" COEFFS 0 255 0 0 0 100 /end COMPU_METHOD
/begin COMPU_METHOD rel_q1p5 "" RAT_FUNC "%6.2" "%" COEFFS 0 1 0 0 0 1.5 /end COMPU_METHOD
/begin COMPU_METHOD rel_sb_b100 "" RAT_FUNC "%6.3" "%" COEFFS 0 128 0 0 0 100 /end COMPU_METHOD
/begin COMPU_METHOD rel_sb_q0p39 "" RAT_FUNC "%6.3" "%" COEFFS 0 1 0 0 0 0.3906 /end COMPU_METHOD
/begin COMPU_METHOD rel_sb_q0p75 "" RAT_FUNC "%6.3" "%" COEFFS 0 1 0 0 0 0.75 /end COMPU_METHOD
/begin COMPU_METHOD rel_sw_b50 "" RAT_FUNC "%6.4" "%" COEFFS 0 65536 0 0 0 100 /end COMPU_METHOD
/begin COMPU_METHOD rel_sw_q0p0234 "" RAT_FUNC "%6.4" "%/seg" COEFFS 0 32 0 0 0 0.75 /end COMPU_METHOD
/begin COMPU_METHOD rel_ub_b100 "" RAT_FUNC "%6.3" "%" COEFFS 0 256 0 0 0 100 /end COMPU_METHOD
/begin COMPU_METHOD rel_ub_b127p5 "" RAT_FUNC "%6.3" "%" COEFFS 0 2 0 0 0 1 /end COMPU_METHOD
/begin COMPU_METHOD rel_ub_b200 "" RAT_FUNC "%6.3" "%" COEFFS 0 256 0 0 0 200 /end COMPU_METHOD
/begin COMPU_METHOD rel_ub_b99p6 "" RAT_FUNC "%6.3" "%" COEFFS 0 256 0 0 0 100 /end COMPU_METHOD
/begin COMPU_METHOD rel_ub_q0p75 "" RAT_FUNC "%6.3" "%" COEFFS 0 1 0 0 0 0.75 /end COMPU_METHOD
/begin COMPU_METHOD rel_ub_q8 "" RAT_FUNC "%6.2" "%/s" COEFFS 0 1 0 0 0 8 /end COMPU_METHOD
/begin COMPU_METHOD rel_uw_b200 "" RAT_FUNC "%6.4" "%" COEFFS 0 65536 0 0 0 200 /end COMPU_METHOD
/begin COMPU_METHOD rel_uw_b3276p75 "" RAT_FUNC "%6.4" "%/100hPa" COEFFS 0 1 0 0 0 0.05 /end COMPU_METHOD
/begin COMPU_METHOD rel_uw_q0p0234 "" RAT_FUNC "%6.4" "%" COEFFS 0 32 0 0 0 0.75 /end COMPU_METHOD
/begin COMPU_METHOD spg_ub_b320 "" RAT_FUNC "%6.2" "V" COEFFS 0 1 0 0 0 1.25 /end COMPU_METHOD
/begin COMPU_METHOD spg_ub_b5 "" RAT_FUNC "%6.4" "V" COEFFS 0 256 0 0 0 5 /end COMPU_METHOD
/begin COMPU_METHOD t100msxs_ub_b25p5 "" RAT_FUNC "%6.3" "s" COEFFS 0 1 0 0 0 0.1 /end COMPU_METHOD
/begin COMPU_METHOD t100msxs_uw_b6553p5 "" RAT_FUNC "%6.3" "s" COEFFS 0 1 0 0 0 0.1 /end COMPU_METHOD
/begin COMPU_METHOD t1sxs_ub_b255 "" RAT_FUNC "%6.2" "s" COEFFS 0 1 0 0 0 1 /end COMPU_METHOD
/begin COMPU_METHOD t1sxs_uw_b65535 "" RAT_FUNC "%6.2" "s" COEFFS 0 1 0 0 0 1 /end COMPU_METHOD
/begin COMPU_METHOD t200msxs_ub_b51 "" RAT_FUNC "%6.3" "s" COEFFS 0 1 0 0 0 0.2 /end COMPU_METHOD
/begin COMPU_METHOD t20msxs_ub_b5p1 "" RAT_FUNC "%6.4" "s" COEFFS 0 1 0 0 0 0.02 /end COMPU_METHOD
/begin COMPU_METHOD t20msxs_uw_b1310 "" RAT_FUNC "%6.4" "s" COEFFS 0 1 0 0 0 0.02 /end COMPU_METHOD
/begin COMPU_METHOD t20msxs_uw_q0p02 "" RAT_FUNC "%6.4" "s" COEFFS 0 1 0 0 0 0.02 /end COMPU_METHOD
/begin COMPU_METHOD t50msxs_ub_b12p75 "" RAT_FUNC "%6.4" "s" COEFFS 0 1 0 0 0 0.05 /end COMPU_METHOD
/begin COMPU_METHOD t50msxs_uw_b3276p75 "" RAT_FUNC "%6.4" "s" COEFFS 0 1 0 0 0 0.05 /end COMPU_METHOD
/begin COMPU_METHOD temp_sb_q0p75 "" RAT_FUNC "%6.3" "Grad C" COEFFS 0 1 0 0 0 0.75 /end COMPU_METHOD
/begin COMPU_METHOD temp_ub_q0p75_o48 "" RAT_FUNC "%6.2" "Grad C" COEFFS 0 1 48 0 0 0.75 /end COMPU_METHOD
/begin COMPU_METHOD temp_ub_q1_o60 "" RAT_FUNC "%6.2" "Grad C" COEFFS 0 1 60 0 0 1 /end COMPU_METHOD
/begin COMPU_METHOD temp_uw_q0p0195 "" RAT_FUNC "%6.4" "Grad C" COEFFS 0 256 0 0 0 5 /end COMPU_METHOD
/begin COMPU_METHOD temp_uw_q0p0195_o50 "" RAT_FUNC "%6.2" "Grad C" COEFFS 0 256 12800 0 0 5 /end COMPU_METHOD
/begin COMPU_METHOD tv_q0p001028 "" RAT_FUNC "%6.4" "%" COEFFS 0 1 0 0 0 0.001028 /end COMPU_METHOD
/begin COMPU_METHOD tv_sw_q0p005 "" RAT_FUNC "%6.4" "%" COEFFS 0 1 0 0 0 0.005 /end COMPU_METHOD
/begin COMPU_METHOD tv_ub_b100 "" RAT_FUNC "%6.3" "%" COEFFS 0 256 0 0 0 100 /end COMPU_METHOD
/begin COMPU_METHOD tv_ub_q0p64 "" RAT_FUNC "%6.3" "%" COEFFS 0 100 0 0 0 64 /end COMPU_METHOD
/begin COMPU_METHOD tv_uw_q0p005 "" RAT_FUNC "%6.4" "%" COEFFS 0 1 0 0 0 0.005 /end COMPU_METHOD
/begin COMPU_METHOD vfzg_ub_q1p25 "" RAT_FUNC "%6.2" "km/h" COEFFS 0 1 0 0 0 1.25 /end COMPU_METHOD
/begin COMPU_METHOD volgrd_q5p96Em4 "" RAT_FUNC "%6.5" "mL/s" COEFFS 0 65536 0 0 0 39.0625 /end COMPU_METHOD
/begin COMPU_METHOD zk100msxs_ub_b25p5 "" RAT_FUNC "%6.3" "s" COEFFS 0 0 256 0 10 0 /end COMPU_METHOD
/begin COMPU_METHOD zk100msxs_uw_b6553 "" RAT_FUNC "%12.4" "s" COEFFS 0 0 65536 0 10 0 /end COMPU_METHOD
/begin COMPU_METHOD zk10msxs_uw_b655 "" RAT_FUNC "%12.5" "s" COEFFS 0 0 65536 0 100 0 /end COMPU_METHOD
/begin COMPU_METHOD zk1sxs_ub_b255 "" RAT_FUNC "%6.2" "s" COEFFS 0 0 256 0 1 0 /end COMPU_METHOD
/begin COMPU_METHOD zk50msxs_ub_b12p8 "" RAT_FUNC "%10.5" "s" COEFFS 0 0 128 0 10 0 /end COMPU_METHOD
/begin COMPU_METHOD zk50msxs_uw_b3276p8 "" RAT_FUNC "%12.4" "s" COEFFS 0 0 65536 0 20 0 /end COMPU_METHOD
/begin COMPU_METHOD zw_q0p1875 "" RAT_FUNC "%6.3" "Grad KW" COEFFS 0 1 0 0 0 0.1875 /end COMPU_METHOD
/begin COMPU_METHOD zw_sb_q0p75 "" RAT_FUNC "%6.3" "grad KW" COEFFS 0 255 0 0 0 191.25 /end COMPU_METHOD
/begin COMPU_METHOD zw_ub_q0p75 "" RAT_FUNC "%6.3" "Grad KW" COEFFS 0 255 0 0 0 191.25 /end COMPU_METHOD
/begin COMPU_METHOD zw_ub_qn0p75 "" RAT_FUNC "%6.4" "grad KW" COEFFS 0 1 0 0 0 -0.75 /end COMPU_METHOD
/begin RECORD_LAYOUT FklWUb FNC_VALUES 1 UBYTE COLUMN_DIR DIRECT /end RECORD_LAYOUT
/begin RECORD_LAYOUT FklWUw FNC_VALUES 1 UWORD COLUMN_DIR DIRECT /end RECORD_LAYOUT
/begin RECORD_LAYOUT GkfWSb FNC_VALUES 1 SBYTE COLUMN_DIR DIRECT /end RECORD_LAYOUT
/begin RECORD_LAYOUT GkfWSw FNC_VALUES 1 SWORD COLUMN_DIR DIRECT /end RECORD_LAYOUT
/begin RECORD_LAYOUT GkfWUb FNC_VALUES 1 UBYTE COLUMN_DIR DIRECT /end RECORD_LAYOUT
/begin RECORD_LAYOUT GkfWUw FNC_VALUES 1 UWORD COLUMN_DIR DIRECT /end RECORD_LAYOUT
/begin RECORD_LAYOUT GklWSb FNC_VALUES 1 SBYTE COLUMN_DIR DIRECT /end RECORD_LAYOUT
/begin RECORD_LAYOUT GklWSw FNC_VALUES 1 SWORD COLUMN_DIR DIRECT /end RECORD_LAYOUT
/begin RECORD_LAYOUT GklWUb FNC_VALUES 1 UBYTE COLUMN_DIR DIRECT /end RECORD_LAYOUT
/begin RECORD_LAYOUT GklWUw FNC_VALUES 1 UWORD COLUMN_DIR DIRECT /end RECORD_LAYOUT
/begin RECORD_LAYOUT KfAxUbAyUbSstxSbSstyUbWUb NO_AXIS_PTS_X 1 UBYTE NO_AXIS_PTS_Y 2 UBYTE AXIS_PTS_X 3 SBYTE INDEX_INCR DIRECT AXIS_PTS_Y 4 UBYTE INDEX_INCR DIRECT FNC_VALUES 5 UBYTE COLUMN_DIR DIRECT /end RECORD_LAYOUT
/begin RECORD_LAYOUT KfAxUbAyUbSstxSwSstyUbWSw NO_AXIS_PTS_X 1 UBYTE NO_AXIS_PTS_Y 2 UBYTE AXIS_PTS_X 3 SWORD INDEX_INCR DIRECT AXIS_PTS_Y 4 UBYTE INDEX_INCR DIRECT FNC_VALUES 5 SWORD COLUMN_DIR DIRECT /end RECORD_LAYOUT
/begin RECORD_LAYOUT KfAxUbAyUbSstxUbSstyUbWSb NO_AXIS_PTS_X 1 UBYTE NO_AXIS_PTS_Y 2 UBYTE AXIS_PTS_X 3 UBYTE INDEX_INCR DIRECT AXIS_PTS_Y 4 UBYTE INDEX_INCR DIRECT FNC_VALUES 5 SBYTE COLUMN_DIR DIRECT /end RECORD_LAYOUT
/begin RECORD_LAYOUT KfAxUbAyUbSstxUbSstyUbWUb NO_AXIS_PTS_X 1 UBYTE NO_AXIS_PTS_Y 2 UBYTE AXIS_PTS_X 3 UBYTE INDEX_INCR DIRECT AXIS_PTS_Y 4 UBYTE INDEX_INCR DIRECT FNC_VALUES 5 UBYTE COLUMN_DIR DIRECT /end RECORD_LAYOUT
/begin RECORD_LAYOUT KfAxUbAyUbSstxUbSstyUwWUb NO_AXIS_PTS_X 1 UBYTE NO_AXIS_PTS_Y 2 UBYTE AXIS_PTS_X 3 UBYTE INDEX_INCR DIRECT AXIS_PTS_Y 4 UWORD INDEX_INCR DIRECT FNC_VALUES 5 UBYTE COLUMN_DIR DIRECT /end RECORD_LAYOUT
/begin RECORD_LAYOUT KfAxUbAyUbSstxUbSstyUwWUw NO_AXIS_PTS_X 1 UBYTE NO_AXIS_PTS_Y 2 UBYTE AXIS_PTS_X 3 UBYTE INDEX_INCR DIRECT AXIS_PTS_Y 4 UWORD INDEX_INCR DIRECT FNC_VALUES 5 UWORD COLUMN_DIR DIRECT /end RECORD_LAYOUT
/begin RECORD_LAYOUT KfAxUbAyUbSstxUwSstyUbWUb NO_AXIS_PTS_X 1 UBYTE NO_AXIS_PTS_Y 2 UBYTE AXIS_PTS_X 3 UWORD INDEX_INCR DIRECT AXIS_PTS_Y 4 UBYTE INDEX_INCR DIRECT FNC_VALUES 5 UBYTE COLUMN_DIR DIRECT /end RECORD_LAYOUT
/begin RECORD_LAYOUT KfAxUwAyUwSstxUwSstyUwWUw NO_AXIS_PTS_X 1 UWORD NO_AXIS_PTS_Y 2 UWORD AXIS_PTS_X 3 UWORD INDEX_INCR DIRECT AXIS_PTS_Y 4 UWORD INDEX_INCR DIRECT FNC_VALUES 5 UWORD COLUMN_DIR DIRECT /end RECORD_LAYOUT
/begin RECORD_LAYOUT KlAUbSstUbWSb NO_AXIS_PTS_X 1 UBYTE AXIS_PTS_X 2 UBYTE INDEX_INCR DIRECT FNC_VALUES 3 SBYTE COLUMN_DIR DIRECT /end RECORD_LAYOUT
/begin RECORD_LAYOUT KlAUbSstUbWUb NO_AXIS_PTS_X 1 UBYTE AXIS_PTS_X 2 UBYTE INDEX_INCR DIRECT FNC_VALUES 3 UBYTE COLUMN_DIR DIRECT /end RECORD_LAYOUT
/begin RECORD_LAYOUT KlAUbSstUwWUw NO_AXIS_PTS_X 1 UWORD AXIS_PTS_X 2 UWORD INDEX_INCR DIRECT FNC_VALUES 3 UWORD COLUMN_DIR DIRECT /end RECORD_LAYOUT
/begin RECORD_LAYOUT KlAUwSstUwWUw NO_AXIS_PTS_X 1 UWORD AXIS_PTS_X 2 UWORD INDEX_INCR DIRECT FNC_VALUES 3 UWORD COLUMN_DIR DIRECT /end RECORD_LAYOUT
/begin RECORD_LAYOUT KwbUb FNC_VALUES 1 UBYTE COLUMN_DIR DIRECT /end RECORD_LAYOUT
/begin RECORD_LAYOUT KwSb FNC_VALUES 1 SBYTE COLUMN_DIR DIRECT /end RECORD_LAYOUT
/begin RECORD_LAYOUT KwSw FNC_VALUES 1 SWORD COLUMN_DIR DIRECT /end RECORD_LAYOUT
/begin RECORD_LAYOUT KwUb FNC_VALUES 1 UBYTE COLUMN_DIR DIRECT /end RECORD_LAYOUT
/begin RECORD_LAYOUT KwUw FNC_VALUES 1 UWORD COLUMN_DIR DIRECT /end RECORD_LAYOUT
/begin RECORD_LAYOUT SstAUbSstSb NO_AXIS_PTS_X 1 UBYTE AXIS_PTS_X 2 SBYTE INDEX_INCR DIRECT /end RECORD_LAYOUT
/begin RECORD_LAYOUT SstAUbSstSw NO_AXIS_PTS_X 1 SWORD AXIS_PTS_X 2 SWORD INDEX_INCR DIRECT /end RECORD_LAYOUT
/begin RECORD_LAYOUT SstAUbSstUb NO_AXIS_PTS_X 1 UBYTE AXIS_PTS_X 2 UBYTE INDEX_INCR DIRECT /end RECORD_LAYOUT
/begin RECORD_LAYOUT SstAUbSstUw NO_AXIS_PTS_X 1 UWORD AXIS_PTS_X 2 UWORD INDEX_INCR DIRECT /end RECORD_LAYOUT
/begin RECORD_LAYOUT SstAUwSstUw NO_AXIS_PTS_X 1 UWORD AXIS_PTS_X 2 UWORD INDEX_INCR DIRECT /end RECORD_LAYOUT
/end MODULE
/end PROJECT
