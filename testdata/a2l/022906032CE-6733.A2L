ASAP2_VERSION 1 3
/begin PROJECT S1103A_25G5_0 "S1103A"
/begin HEADER "" VERSION "S1103A_25G5_0" PROJECT_NO S1103A_25G5_0 /end HEADER
/begin MODULE DIM ""
/begin MOD_COMMON "" BYTE_ORDER MSB_LAST ALIGNMENT_BYTE 1 ALIGNMENT_WORD 2 ALIGNMENT_LONG 2 /end MOD_COMMON
/begin CHARACTERISTIC AAGOFLOGIN "" VALUE 0x8FE92A KwUw 65535.00 dez 0.00 65535.00 FORMAT "%8.2" /end CHARACTERISTIC
/begin CHARACTERISTIC AAGONLOGIN "" VALUE 0x8FE92C KwUw 65535.00 dez 0.00 65535.00 FORMAT "%8.2" /end CHARACTERISTIC
/begin CHARACTERISTIC ADRONLOGIN "" VALUE 0x8FE92E KwUw 65535.00 dez 0.00 65535.00 FORMAT "%8.2" /end CHARACTERISTIC
/begin CHARACTERISTIC AGR_AOG "" VALUE 0x8FD0D0 KwUb 1.992 fak_ub_b2 0.00 1.992 FORMAT "%5.3" /end CHARACTERISTIC
/begin CHARACTERISTIC AGR_AUG "" VALUE 0x8FD0D1 KwUb 1.992 fak_ub_b2 0.00 1.992 FORMAT "%5.3" /end CHARACTERISTIC
/begin CHARACTERISTIC ANRZUEMX "" VALUE 0x8FD010 KwUb 255.0 dez 0.00 255.0 FORMAT "%5.1" /end CHARACTERISTIC
/begin CHARACTERISTIC BGRA_T_UM "" VALUE 0x8FC007 KwUb 10.20 t_q0p04 0.00 10.20 FORMAT "%5.2" /end CHARACTERISTIC
/begin CHARACTERISTIC BRACC_T_UM "" VALUE 0x8FC008 KwUb 10.20 t_q0p04 0.00 10.20 FORMAT "%5.2" /end CHARACTERISTIC
/begin CHARACTERISTIC BREMS_T_UM "" VALUE 0x8FC009 KwUb 10.20 t_q0p04 0.00 10.20 FORMAT "%5.2" /end CHARACTERISTIC
/begin CHARACTERISTIC BRESP_T_UM "" VALUE 0x8FC00A KwUb 10.20 t_q0p04 0.00 10.20 FORMAT "%5.2" /end CHARACTERISTIC
/begin CHARACTERISTIC BZGRA_T_UM "" VALUE 0x8FC00B KwUb 10.20 t_q0p04 0.00 10.20 FORMAT "%5.2" /end CHARACTERISTIC
/begin CHARACTERISTIC BZMSR_T_UM "" VALUE 0x8FC07C KwUb 10200.0 t40ms_ub_b10200 0.00 10200.0 FORMAT "%7.1" /end CHARACTERISTIC
/begin CHARACTERISTIC CHKSFGR_UM "" VALUE 0x8FC00C KwUb 255.0 dez 0.00 255.0 FORMAT "%5.1" /end CHARACTERISTIC
/begin CHARACTERISTIC CNSDEF "" VALUE 0x8FD0D2 KwUb 255.0 dez 0.00 255.0 FORMAT "%5.1" /end CHARACTERISTIC
/begin CHARACTERISTIC CNS_AOG "" VALUE 0x8FD0D3 KwUb 255.0 dez 0.00 255.0 FORMAT "%5.1" /end CHARACTERISTIC
/begin CHARACTERISTIC CNS_AUG "" VALUE 0x8FD0D4 KwUb 255.0 dez 0.00 255.0 FORMAT "%5.1" /end CHARACTERISTIC
/begin CHARACTERISTIC CWAPPLTKAA "" VALUE 0x8E2840 KwUb 255.0 dez 0.00 255.0 FORMAT "%5.1" /end CHARACTERISTIC
/begin CHARACTERISTIC CWFA107 "" VALUE 0x8EC000 KwUw 65535.00 dez 0.00 65535.00 FORMAT "%8.2" /end CHARACTERISTIC
/begin CHARACTERISTIC CWFA107A "" VALUE 0x8EC002 KwUw 65535.00 dez 0.00 65535.00 FORMAT "%8.2" /end CHARACTERISTIC
/begin CHARACTERISTIC CWFA107B "" VALUE 0x8EC004 KwUw 65535.00 dez 0.00 65535.00 FORMAT "%8.2" /end CHARACTERISTIC
/begin CHARACTERISTIC CWFA108 "" VALUE 0x8EC006 KwUw 65535.00 dez 0.00 65535.00 FORMAT "%8.2" /end CHARACTERISTIC
/begin CHARACTERISTIC CWFA108A "" VALUE 0x8EC008 KwUw 65535.00 dez 0.00 65535.00 FORMAT "%8.2" /end CHARACTERISTIC
/begin CHARACTERISTIC CWFA108B "" VALUE 0x8EC00A KwUw 65535.00 dez 0.00 65535.00 FORMAT "%8.2" /end CHARACTERISTIC
/begin CHARACTERISTIC CWFA109 "" VALUE 0x8EC00C KwUw 65535.00 dez 0.00 65535.00 FORMAT "%8.2" /end CHARACTERISTIC
/begin CHARACTERISTIC CWFA109A "" VALUE 0x8EC00E KwUw 65535.00 dez 0.00 65535.00 FORMAT "%8.2" /end CHARACTERISTIC
/begin CHARACTERISTIC CWFA109B "" VALUE 0x8EC010 KwUw 65535.00 dez 0.00 65535.00 FORMAT "%8.2" /end CHARACTERISTIC
/begin CHARACTERISTIC CWFA130 "" VALUE 0x8EC012 KwUw 65535.00 dez 0.00 65535.00 FORMAT "%8.2" /end CHARACTERISTIC
/begin CHARACTERISTIC CWFA130A "" VALUE 0x8EC014 KwUw 65535.00 dez 0.00 65535.00 FORMAT "%8.2" /end CHARACTERISTIC
/begin CHARACTERISTIC CWFA130B "" VALUE 0x8EC016 KwUw 65535.00 dez 0.00 65535.00 FORMAT "%8.2" /end CHARACTERISTIC
/begin CHARACTERISTIC CWFA140 "" VALUE 0x8EC018 KwUw 65535.00 dez 0.00 65535.00 FORMAT "%8.2" /end CHARACTERISTIC
/begin CHARACTERISTIC CWFA140A "" VALUE 0x8EC01A KwUw 65535.00 dez 0.00 65535.00 FORMAT "%8.2" /end CHARACTERISTIC
/begin CHARACTERISTIC CWFA140B "" VALUE 0x8EC01C KwUw 65535.00 dez 0.00 65535.00 FORMAT "%8.2" /end CHARACTERISTIC
/begin CHARACTERISTIC CWFA145 "" VALUE 0x8EC01E KwUw 65535.00 dez 0.00 65535.00 FORMAT "%8.2" /end CHARACTERISTIC
/begin CHARACTERISTIC CWFA145A "" VALUE 0x8EC020 KwUw 65535.00 dez 0.00 65535.00 FORMAT "%8.2" /end CHARACTERISTIC
/begin CHARACTERISTIC CWFA145B "" VALUE 0x8EC022 KwUw 65535.00 dez 0.00 65535.00 FORMAT "%8.2" /end CHARACTERISTIC
/begin CHARACTERISTIC CWFA146 "" VALUE 0x8EC024 KwUw 65535.00 dez 0.00 65535.00 FORMAT "%8.2" /end CHARACTERISTIC
/begin CHARACTERISTIC CWFA146A "" VALUE 0x8EC026 KwUw 65535.00 dez 0.00 65535.00 FORMAT "%8.2" /end CHARACTERISTIC
/begin CHARACTERISTIC CWFA146B "" VALUE 0x8EC028 KwUw 65535.00 dez 0.00 65535.00 FORMAT "%8.2" /end CHARACTERISTIC
/begin CHARACTERISTIC CWFA147 "" VALUE 0x8EC02A KwUw 65535.00 dez 0.00 65535.00 FORMAT "%8.2" /end CHARACTERISTIC
/begin CHARACTERISTIC CWFA147A "" VALUE 0x8EC02C KwUw 65535.00 dez 0.00 65535.00 FORMAT "%8.2" /end CHARACTERISTIC
/begin CHARACTERISTIC CWFA147B "" VALUE 0x8EC02E KwUw 65535.00 dez 0.00 65535.00 FORMAT "%8.2" /end CHARACTERISTIC
/begin CHARACTERISTIC CWFA148 "" VALUE 0x8EC030 KwUw 65535.00 dez 0.00 65535.00 FORMAT "%8.2" /end CHARACTERISTIC
/begin CHARACTERISTIC CWFA148A "" VALUE 0x8EC032 KwUw 65535.00 dez 0.00 65535.00 FORMAT "%8.2" /end CHARACTERISTIC
/begin CHARACTERISTIC CWFA148B "" VALUE 0x8EC034 KwUw 65535.00 dez 0.00 65535.00 FORMAT "%8.2" /end CHARACTERISTIC
/begin CHARACTERISTIC CWFA149 "" VALUE 0x8EC036 KwUw 65535.00 dez 0.00 65535.00 FORMAT "%8.2" /end CHARACTERISTIC
/begin CHARACTERISTIC CWFA149A "" VALUE 0x8EC038 KwUw 65535.00 dez 0.00 65535.00 FORMAT "%8.2" /end CHARACTERISTIC
/begin CHARACTERISTIC CWFA149B "" VALUE 0x8EC03A KwUw 65535.00 dez 0.00 65535.00 FORMAT "%8.2" /end CHARACTERISTIC
/begin CHARACTERISTIC CWFA152 "" VALUE 0x8EC03C KwUw 65535.00 dez 0.00 65535.00 FORMAT "%8.2" /end CHARACTERISTIC
/begin CHARACTERISTIC CWFA152A "" VALUE 0x8EC03E KwUw 65535.00 dez 0.00 65535.00 FORMAT "%8.2" /end CHARACTERISTIC
/begin CHARACTERISTIC CWFA152B "" VALUE 0x8EC040 KwUw 65535.00 dez 0.00 65535.00 FORMAT "%8.2" /end CHARACTERISTIC
/begin CHARACTERISTIC CWFA162 "" VALUE 0x8EC042 KwUw 65535.00 dez 0.00 65535.00 FORMAT "%8.2" /end CHARACTERISTIC
/begin CHARACTERISTIC CWFA162A "" VALUE 0x8EC044 KwUw 65535.00 dez 0.00 65535.00 FORMAT "%8.2" /end CHARACTERISTIC
/begin CHARACTERISTIC CWFA162B "" VALUE 0x8EC046 KwUw 65535.00 dez 0.00 65535.00 FORMAT "%8.2" /end CHARACTERISTIC
/begin CHARACTERISTIC CWFA163 "" VALUE 0x8EC048 KwUw 65535.00 dez 0.00 65535.00 FORMAT "%8.2" /end CHARACTERISTIC
/begin CHARACTERISTIC CWFA163A "" VALUE 0x8EC04A KwUw 65535.00 dez 0.00 65535.00 FORMAT "%8.2" /end CHARACTERISTIC
/begin CHARACTERISTIC CWFA163B "" VALUE 0x8EC04C KwUw 65535.00 dez 0.00 65535.00 FORMAT "%8.2" /end CHARACTERISTIC
/begin CHARACTERISTIC CWFA166 "" VALUE 0x8EC04E KwUw 65535.00 dez 0.00 65535.00 FORMAT "%8.2" /end CHARACTERISTIC
/begin CHARACTERISTIC CWFA166A "" VALUE 0x8EC050 KwUw 65535.00 dez 0.00 65535.00 FORMAT "%8.2" /end CHARACTERISTIC
/begin CHARACTERISTIC CWFA166B "" VALUE 0x8EC052 KwUw 65535.00 dez 0.00 65535.00 FORMAT "%8.2" /end CHARACTERISTIC
/begin CHARACTERISTIC CWFA167 "" VALUE 0x8EC054 KwUw 65535.00 dez 0.00 65535.00 FORMAT "%8.2" /end CHARACTERISTIC
/begin CHARACTERISTIC CWFA167A "" VALUE 0x8EC056 KwUw 65535.00 dez 0.00 65535.00 FORMAT "%8.2" /end CHARACTERISTIC
/begin CHARACTERISTIC CWFA167B "" VALUE 0x8EC058 KwUw 65535.00 dez 0.00 65535.00 FORMAT "%8.2" /end CHARACTERISTIC
/begin CHARACTERISTIC CWFA168 "" VALUE 0x8EC05A KwUw 65535.00 dez 0.00 65535.00 FORMAT "%8.2" /end CHARACTERISTIC
/begin CHARACTERISTIC CWFA168A "" VALUE 0x8EC05C KwUw 65535.00 dez 0.00 65535.00 FORMAT "%8.2" /end CHARACTERISTIC
/begin CHARACTERISTIC CWFA168B "" VALUE 0x8EC05E KwUw 65535.00 dez 0.00 65535.00 FORMAT "%8.2" /end CHARACTERISTIC
/begin CHARACTERISTIC CWFA187 "" VALUE 0x8EC060 KwUw 65535.00 dez 0.00 65535.00 FORMAT "%8.2" /end CHARACTERISTIC
/begin CHARACTERISTIC CWFA187A "" VALUE 0x8EC062 KwUw 65535.00 dez 0.00 65535.00 FORMAT "%8.2" /end CHARACTERISTIC
/begin CHARACTERISTIC CWFA187B "" VALUE 0x8EC064 KwUw 65535.00 dez 0.00 65535.00 FORMAT "%8.2" /end CHARACTERISTIC
/begin CHARACTERISTIC CWFA188 "" VALUE 0x8EC066 KwUw 65535.00 dez 0.00 65535.00 FORMAT "%8.2" /end CHARACTERISTIC
/begin CHARACTERISTIC CWFA188A "" VALUE 0x8EC068 KwUw 65535.00 dez 0.00 65535.00 FORMAT "%8.2" /end CHARACTERISTIC
/begin CHARACTERISTIC CWFA188B "" VALUE 0x8EC06A KwUw 65535.00 dez 0.00 65535.00 FORMAT "%8.2" /end CHARACTERISTIC
/begin CHARACTERISTIC CWFA189 "" VALUE 0x8EC06C KwUw 65535.00 dez 0.00 65535.00 FORMAT "%8.2" /end CHARACTERISTIC
/begin CHARACTERISTIC CWFA189A "" VALUE 0x8EC06E KwUw 65535.00 dez 0.00 65535.00 FORMAT "%8.2" /end CHARACTERISTIC
/begin CHARACTERISTIC CWFA189B "" VALUE 0x8EC070 KwUw 65535.00 dez 0.00 65535.00 FORMAT "%8.2" /end CHARACTERISTIC
/begin CHARACTERISTIC CWFA190 "" VALUE 0x8EC072 KwUw 65535.00 dez 0.00 65535.00 FORMAT "%8.2" /end CHARACTERISTIC
/begin CHARACTERISTIC CWFA190A "" VALUE 0x8EC074 KwUw 65535.00 dez 0.00 65535.00 FORMAT "%8.2" /end CHARACTERISTIC
/begin CHARACTERISTIC CWFA190B "" VALUE 0x8EC076 KwUw 65535.00 dez 0.00 65535.00 FORMAT "%8.2" /end CHARACTERISTIC
/begin CHARACTERISTIC CWFA191 "" VALUE 0x8EC078 KwUw 65535.00 dez 0.00 65535.00 FORMAT "%8.2" /end CHARACTERISTIC
/begin CHARACTERISTIC CWFA191A "" VALUE 0x8EC07A KwUw 65535.00 dez 0.00 65535.00 FORMAT "%8.2" /end CHARACTERISTIC
/begin CHARACTERISTIC CWFA191B "" VALUE 0x8EC07C KwUw 65535.00 dez 0.00 65535.00 FORMAT "%8.2" /end CHARACTERISTIC
/begin CHARACTERISTIC CWFA192 "" VALUE 0x8EC07E KwUw 65535.00 dez 0.00 65535.00 FORMAT "%8.2" /end CHARACTERISTIC
/begin CHARACTERISTIC CWFA192A "" VALUE 0x8EC080 KwUw 65535.00 dez 0.00 65535.00 FORMAT "%8.2" /end CHARACTERISTIC
/begin CHARACTERISTIC CWFA192B "" VALUE 0x8EC082 KwUw 65535.00 dez 0.00 65535.00 FORMAT "%8.2" /end CHARACTERISTIC
/begin CHARACTERISTIC CWFA193 "" VALUE 0x8EC084 KwUw 65535.00 dez 0.00 65535.00 FORMAT "%8.2" /end CHARACTERISTIC
/begin CHARACTERISTIC CWFA193A "" VALUE 0x8EC086 KwUw 65535.00 dez 0.00 65535.00 FORMAT "%8.2" /end CHARACTERISTIC
/begin CHARACTERISTIC CWFA193B "" VALUE 0x8EC088 KwUw 65535.00 dez 0.00 65535.00 FORMAT "%8.2" /end CHARACTERISTIC
/begin CHARACTERISTIC CWFA194 "" VALUE 0x8EC08A KwUw 65535.00 dez 0.00 65535.00 FORMAT "%8.2" /end CHARACTERISTIC
/begin CHARACTERISTIC CWFA194A "" VALUE 0x8EC08C KwUw 65535.00 dez 0.00 65535.00 FORMAT "%8.2" /end CHARACTERISTIC
/begin CHARACTERISTIC CWFA194B "" VALUE 0x8EC08E KwUw 65535.00 dez 0.00 65535.00 FORMAT "%8.2" /end CHARACTERISTIC
/begin CHARACTERISTIC CWFA195 "" VALUE 0x8EC090 KwUw 65535.00 dez 0.00 65535.00 FORMAT "%8.2" /end CHARACTERISTIC
/begin CHARACTERISTIC CWFA195A "" VALUE 0x8EC092 KwUw 65535.00 dez 0.00 65535.00 FORMAT "%8.2" /end CHARACTERISTIC
/begin CHARACTERISTIC CWFA195B "" VALUE 0x8EC094 KwUw 65535.00 dez 0.00 65535.00 FORMAT "%8.2" /end CHARACTERISTIC
/begin CHARACTERISTIC CWFA196 "" VALUE 0x8EC096 KwUw 65535.00 dez 0.00 65535.00 FORMAT "%8.2" /end CHARACTERISTIC
/begin CHARACTERISTIC CWFA196A "" VALUE 0x8EC098 KwUw 65535.00 dez 0.00 65535.00 FORMAT "%8.2" /end CHARACTERISTIC
/begin CHARACTERISTIC CWFA196B "" VALUE 0x8EC09A KwUw 65535.00 dez 0.00 65535.00 FORMAT "%8.2" /end CHARACTERISTIC
/begin CHARACTERISTIC CWFA197 "" VALUE 0x8EC09C KwUw 65535.00 dez 0.00 65535.00 FORMAT "%8.2" /end CHARACTERISTIC
/begin CHARACTERISTIC CWFA197A "" VALUE 0x8EC09E KwUw 65535.00 dez 0.00 65535.00 FORMAT "%8.2" /end CHARACTERISTIC
/begin CHARACTERISTIC CWFA197B "" VALUE 0x8EC0A0 KwUw 65535.00 dez 0.00 65535.00 FORMAT "%8.2" /end CHARACTERISTIC
/begin CHARACTERISTIC CWFA198 "" VALUE 0x8EC0A2 KwUw 65535.00 dez 0.00 65535.00 FORMAT "%8.2" /end CHARACTERISTIC
/begin CHARACTERISTIC CWFA198A "" VALUE 0x8EC0A4 KwUw 65535.00 dez 0.00 65535.00 FORMAT "%8.2" /end CHARACTERISTIC
/begin CHARACTERISTIC CWFA198B "" VALUE 0x8EC0A6 KwUw 65535.00 dez 0.00 65535.00 FORMAT "%8.2" /end CHARACTERISTIC
/begin CHARACTERISTIC CWFA199 "" VALUE 0x8EC0A8 KwUw 65535.00 dez 0.00 65535.00 FORMAT "%8.2" /end CHARACTERISTIC
/begin CHARACTERISTIC CWFA199A "" VALUE 0x8EC0AA KwUw 65535.00 dez 0.00 65535.00 FORMAT "%8.2" /end CHARACTERISTIC
/begin CHARACTERISTIC CWFA199B "" VALUE 0x8EC0AC KwUw 65535.00 dez 0.00 65535.00 FORMAT "%8.2" /end CHARACTERISTIC
/begin CHARACTERISTIC CWFA201 "" VALUE 0x8EC0AE KwUw 65535.00 dez 0.00 65535.00 FORMAT "%8.2" /end CHARACTERISTIC
/begin CHARACTERISTIC CWFA201A "" VALUE 0x8EC0B0 KwUw 65535.00 dez 0.00 65535.00 FORMAT "%8.2" /end CHARACTERISTIC
/begin CHARACTERISTIC CWFA201B "" VALUE 0x8EC0B2 KwUw 65535.00 dez 0.00 65535.00 FORMAT "%8.2" /end CHARACTERISTIC
/begin CHARACTERISTIC CWFA202 "" VALUE 0x8EC0B4 KwUw 65535.00 dez 0.00 65535.00 FORMAT "%8.2" /end CHARACTERISTIC
/begin CHARACTERISTIC CWFA202A "" VALUE 0x8EC0B6 KwUw 65535.00 dez 0.00 65535.00 FORMAT "%8.2" /end CHARACTERISTIC
/begin CHARACTERISTIC CWFA202B "" VALUE 0x8EC0B8 KwUw 65535.00 dez 0.00 65535.00 FORMAT "%8.2" /end CHARACTERISTIC
/begin CHARACTERISTIC CWFA203 "" VALUE 0x8EC0BA KwUw 65535.00 dez 0.00 65535.00 FORMAT "%8.2" /end CHARACTERISTIC
/begin CHARACTERISTIC CWFA203A "" VALUE 0x8EC0BC KwUw 65535.00 dez 0.00 65535.00 FORMAT "%8.2" /end CHARACTERISTIC
/begin CHARACTERISTIC CWFA203B "" VALUE 0x8EC0BE KwUw 65535.00 dez 0.00 65535.00 FORMAT "%8.2" /end CHARACTERISTIC
/begin CHARACTERISTIC CWFA204 "" VALUE 0x8EC0C0 KwUw 65535.00 dez 0.00 65535.00 FORMAT "%8.2" /end CHARACTERISTIC
/begin CHARACTERISTIC CWFA204A "" VALUE 0x8EC0C2 KwUw 65535.00 dez 0.00 65535.00 FORMAT "%8.2" /end CHARACTERISTIC
/begin CHARACTERISTIC CWFA204B "" VALUE 0x8EC0C4 KwUw 65535.00 dez 0.00 65535.00 FORMAT "%8.2" /end CHARACTERISTIC
/begin CHARACTERISTIC CWFA205 "" VALUE 0x8EC0C6 KwUw 65535.00 dez 0.00 65535.00 FORMAT "%8.2" /end CHARACTERISTIC
/begin CHARACTERISTIC CWFA205A "" VALUE 0x8EC0C8 KwUw 65535.00 dez 0.00 65535.00 FORMAT "%8.2" /end CHARACTERISTIC
/begin CHARACTERISTIC CWFA205B "" VALUE 0x8EC0CA KwUw 65535.00 dez 0.00 65535.00 FORMAT "%8.2" /end CHARACTERISTIC
/begin CHARACTERISTIC CWFA206 "" VALUE 0x8EC0CC KwUw 65535.00 dez 0.00 65535.00 FORMAT "%8.2" /end CHARACTERISTIC
/begin CHARACTERISTIC CWFA206A "" VALUE 0x8EC0CE KwUw 65535.00 dez 0.00 65535.00 FORMAT "%8.2" /end CHARACTERISTIC
/begin CHARACTERISTIC CWFA206B "" VALUE 0x8EC0D0 KwUw 65535.00 dez 0.00 65535.00 FORMAT "%8.2" /end CHARACTERISTIC
/begin CHARACTERISTIC CWFA207 "" VALUE 0x8EC0D2 KwUw 65535.00 dez 0.00 65535.00 FORMAT "%8.2" /end CHARACTERISTIC
/begin CHARACTERISTIC CWFA207A "" VALUE 0x8EC0D4 KwUw 65535.00 dez 0.00 65535.00 FORMAT "%8.2" /end CHARACTERISTIC
/begin CHARACTERISTIC CWFA207B "" VALUE 0x8EC0D6 KwUw 65535.00 dez 0.00 65535.00 FORMAT "%8.2" /end CHARACTERISTIC
/begin CHARACTERISTIC CWFA208 "" VALUE 0x8EC0D8 KwUw 65535.00 dez 0.00 65535.00 FORMAT "%8.2" /end CHARACTERISTIC
/begin CHARACTERISTIC CWFA208A "" VALUE 0x8EC0DA KwUw 65535.00 dez 0.00 65535.00 FORMAT "%8.2" /end CHARACTERISTIC
/begin CHARACTERISTIC CWFA208B "" VALUE 0x8EC0DC KwUw 65535.00 dez 0.00 65535.00 FORMAT "%8.2" /end CHARACTERISTIC
/begin CHARACTERISTIC CWFA209 "" VALUE 0x8EC0DE KwUw 65535.00 dez 0.00 65535.00 FORMAT "%8.2" /end CHARACTERISTIC
/begin CHARACTERISTIC CWFA209A "" VALUE 0x8EC0E0 KwUw 65535.00 dez 0.00 65535.00 FORMAT "%8.2" /end CHARACTERISTIC
/begin CHARACTERISTIC CWFA209B "" VALUE 0x8EC0E2 KwUw 65535.00 dez 0.00 65535.00 FORMAT "%8.2" /end CHARACTERISTIC
/begin CHARACTERISTIC CWFA210 "" VALUE 0x8EC0E4 KwUw 65535.00 dez 0.00 65535.00 FORMAT "%8.2" /end CHARACTERISTIC
/begin CHARACTERISTIC CWFA210A "" VALUE 0x8EC0E6 KwUw 65535.00 dez 0.00 65535.00 FORMAT "%8.2" /end CHARACTERISTIC
/begin CHARACTERISTIC CWFA210B "" VALUE 0x8EC0E8 KwUw 65535.00 dez 0.00 65535.00 FORMAT "%8.2" /end CHARACTERISTIC
/begin CHARACTERISTIC CWFA211 "" VALUE 0x8EC0EA KwUw 65535.00 dez 0.00 65535.00 FORMAT "%8.2" /end CHARACTERISTIC
/begin CHARACTERISTIC CWFA211A "" VALUE 0x8EC0EC KwUw 65535.00 dez 0.00 65535.00 FORMAT "%8.2" /end CHARACTERISTIC
/begin CHARACTERISTIC CWFA211B "" VALUE 0x8EC0EE KwUw 65535.00 dez 0.00 65535.00 FORMAT "%8.2" /end CHARACTERISTIC
/begin CHARACTERISTIC CWFA212 "" VALUE 0x8EC0F0 KwUw 65535.00 dez 0.00 65535.00 FORMAT "%8.2" /end CHARACTERISTIC
/begin CHARACTERISTIC CWFA212A "" VALUE 0x8EC0F2 KwUw 65535.00 dez 0.00 65535.00 FORMAT "%8.2" /end CHARACTERISTIC
/begin CHARACTERISTIC CWFA212B "" VALUE 0x8EC0F4 KwUw 65535.00 dez 0.00 65535.00 FORMAT "%8.2" /end CHARACTERISTIC
/begin CHARACTERISTIC CWFA213 "" VALUE 0x8EC0F6 KwUw 65535.00 dez 0.00 65535.00 FORMAT "%8.2" /end CHARACTERISTIC
/begin CHARACTERISTIC CWFA213A "" VALUE 0x8EC0F8 KwUw 65535.00 dez 0.00 65535.00 FORMAT "%8.2" /end CHARACTERISTIC
/begin CHARACTERISTIC CWFA213B "" VALUE 0x8EC0FA KwUw 65535.00 dez 0.00 65535.00 FORMAT "%8.2" /end CHARACTERISTIC
/begin CHARACTERISTIC CWFA214 "" VALUE 0x8EC0FC KwUw 65535.00 dez 0.00 65535.00 FORMAT "%8.2" /end CHARACTERISTIC
/begin CHARACTERISTIC CWFA214A "" VALUE 0x8EC0FE KwUw 65535.00 dez 0.00 65535.00 FORMAT "%8.2" /end CHARACTERISTIC
/begin CHARACTERISTIC CWFA214B "" VALUE 0x8EC100 KwUw 65535.00 dez 0.00 65535.00 FORMAT "%8.2" /end CHARACTERISTIC
/begin CHARACTERISTIC CWFA215 "" VALUE 0x8EC102 KwUw 65535.00 dez 0.00 65535.00 FORMAT "%8.2" /end CHARACTERISTIC
/begin CHARACTERISTIC CWFA215A "" VALUE 0x8EC104 KwUw 65535.00 dez 0.00 65535.00 FORMAT "%8.2" /end CHARACTERISTIC
/begin CHARACTERISTIC CWFA215B "" VALUE 0x8EC106 KwUw 65535.00 dez 0.00 65535.00 FORMAT "%8.2" /end CHARACTERISTIC
/begin CHARACTERISTIC CWFA216 "" VALUE 0x8EC108 KwUw 65535.00 dez 0.00 65535.00 FORMAT "%8.2" /end CHARACTERISTIC
/begin CHARACTERISTIC CWFA216A "" VALUE 0x8EC10A KwUw 65535.00 dez 0.00 65535.00 FORMAT "%8.2" /end CHARACTERISTIC
/begin CHARACTERISTIC CWFA216B "" VALUE 0x8EC10C KwUw 65535.00 dez 0.00 65535.00 FORMAT "%8.2" /end CHARACTERISTIC
/begin CHARACTERISTIC CWFA217 "" VALUE 0x8EC10E KwUw 65535.00 dez 0.00 65535.00 FORMAT "%8.2" /end CHARACTERISTIC
/begin CHARACTERISTIC CWFA217A "" VALUE 0x8EC110 KwUw 65535.00 dez 0.00 65535.00 FORMAT "%8.2" /end CHARACTERISTIC
/begin CHARACTERISTIC CWFA217B "" VALUE 0x8EC112 KwUw 65535.00 dez 0.00 65535.00 FORMAT "%8.2" /end CHARACTERISTIC
/begin CHARACTERISTIC CWFA218 "" VALUE 0x8EC114 KwUw 65535.00 dez 0.00 65535.00 FORMAT "%8.2" /end CHARACTERISTIC
/begin CHARACTERISTIC CWFA218A "" VALUE 0x8EC116 KwUw 65535.00 dez 0.00 65535.00 FORMAT "%8.2" /end CHARACTERISTIC
/begin CHARACTERISTIC CWFA218B "" VALUE 0x8EC118 KwUw 65535.00 dez 0.00 65535.00 FORMAT "%8.2" /end CHARACTERISTIC
/begin CHARACTERISTIC CWFA219 "" VALUE 0x8EC11A KwUw 65535.00 dez 0.00 65535.00 FORMAT "%8.2" /end CHARACTERISTIC
/begin CHARACTERISTIC CWFA219A "" VALUE 0x8EC11C KwUw 65535.00 dez 0.00 65535.00 FORMAT "%8.2" /end CHARACTERISTIC
/begin CHARACTERISTIC CWFA219B "" VALUE 0x8EC11E KwUw 65535.00 dez 0.00 65535.00 FORMAT "%8.2" /end CHARACTERISTIC
/begin CHARACTERISTIC CWFA220 "" VALUE 0x8EC120 KwUw 65535.00 dez 0.00 65535.00 FORMAT "%8.2" /end CHARACTERISTIC
/begin CHARACTERISTIC CWFA220A "" VALUE 0x8EC122 KwUw 65535.00 dez 0.00 65535.00 FORMAT "%8.2" /end CHARACTERISTIC
/begin CHARACTERISTIC CWFA220B "" VALUE 0x8EC124 KwUw 65535.00 dez 0.00 65535.00 FORMAT "%8.2" /end CHARACTERISTIC
/begin CHARACTERISTIC CWFA221 "" VALUE 0x8EC126 KwUw 65535.00 dez 0.00 65535.00 FORMAT "%8.2" /end CHARACTERISTIC
/begin CHARACTERISTIC CWFA221A "" VALUE 0x8EC128 KwUw 65535.00 dez 0.00 65535.00 FORMAT "%8.2" /end CHARACTERISTIC
/begin CHARACTERISTIC CWFA221B "" VALUE 0x8EC12A KwUw 65535.00 dez 0.00 65535.00 FORMAT "%8.2" /end CHARACTERISTIC
/begin CHARACTERISTIC CWFA222 "" VALUE 0x8EC12C KwUw 65535.00 dez 0.00 65535.00 FORMAT "%8.2" /end CHARACTERISTIC
/begin CHARACTERISTIC CWFA222A "" VALUE 0x8EC12E KwUw 65535.00 dez 0.00 65535.00 FORMAT "%8.2" /end CHARACTERISTIC
/begin CHARACTERISTIC CWFA222B "" VALUE 0x8EC130 KwUw 65535.00 dez 0.00 65535.00 FORMAT "%8.2" /end CHARACTERISTIC
/begin CHARACTERISTIC CWFA223 "" VALUE 0x8EC132 KwUw 65535.00 dez 0.00 65535.00 FORMAT "%8.2" /end CHARACTERISTIC
/begin CHARACTERISTIC CWFA223A "" VALUE 0x8EC134 KwUw 65535.00 dez 0.00 65535.00 FORMAT "%8.2" /end CHARACTERISTIC
/begin CHARACTERISTIC CWFA223B "" VALUE 0x8EC136 KwUw 65535.00 dez 0.00 65535.00 FORMAT "%8.2" /end CHARACTERISTIC
/begin CHARACTERISTIC CWFA224 "" VALUE 0x8EC138 KwUw 65535.00 dez 0.00 65535.00 FORMAT "%8.2" /end CHARACTERISTIC
/begin CHARACTERISTIC CWFA224A "" VALUE 0x8EC13A KwUw 65535.00 dez 0.00 65535.00 FORMAT "%8.2" /end CHARACTERISTIC
/begin CHARACTERISTIC CWFA224B "" VALUE 0x8EC13C KwUw 65535.00 dez 0.00 65535.00 FORMAT "%8.2" /end CHARACTERISTIC
/begin CHARACTERISTIC CWFA225 "" VALUE 0x8EC13E KwUw 65535.00 dez 0.00 65535.00 FORMAT "%8.2" /end CHARACTERISTIC
/begin CHARACTERISTIC CWFA225A "" VALUE 0x8EC140 KwUw 65535.00 dez 0.00 65535.00 FORMAT "%8.2" /end CHARACTERISTIC
/begin CHARACTERISTIC CWFA225B "" VALUE 0x8EC142 KwUw 65535.00 dez 0.00 65535.00 FORMAT "%8.2" /end CHARACTERISTIC
/begin CHARACTERISTIC CWFA226 "" VALUE 0x8EC144 KwUw 65535.00 dez 0.00 65535.00 FORMAT "%8.2" /end CHARACTERISTIC
/begin CHARACTERISTIC CWFA226A "" VALUE 0x8EC146 KwUw 65535.00 dez 0.00 65535.00 FORMAT "%8.2" /end CHARACTERISTIC
/begin CHARACTERISTIC CWFA226B "" VALUE 0x8EC148 KwUw 65535.00 dez 0.00 65535.00 FORMAT "%8.2" /end CHARACTERISTIC
/begin CHARACTERISTIC CWFA227 "" VALUE 0x8EC14A KwUw 65535.00 dez 0.00 65535.00 FORMAT "%8.2" /end CHARACTERISTIC
/begin CHARACTERISTIC CWFA227A "" VALUE 0x8EC14C KwUw 65535.00 dez 0.00 65535.00 FORMAT "%8.2" /end CHARACTERISTIC
/begin CHARACTERISTIC CWFA227B "" VALUE 0x8EC14E KwUw 65535.00 dez 0.00 65535.00 FORMAT "%8.2" /end CHARACTERISTIC
/begin CHARACTERISTIC CWFA228 "" VALUE 0x8EC150 KwUw 65535.00 dez 0.00 65535.00 FORMAT "%8.2" /end CHARACTERISTIC
/begin CHARACTERISTIC CWFA228A "" VALUE 0x8EC152 KwUw 65535.00 dez 0.00 65535.00 FORMAT "%8.2" /end CHARACTERISTIC
/begin CHARACTERISTIC CWFA228B "" VALUE 0x8EC154 KwUw 65535.00 dez 0.00 65535.00 FORMAT "%8.2" /end CHARACTERISTIC
/begin CHARACTERISTIC CWFA229 "" VALUE 0x8EC156 KwUw 65535.00 dez 0.00 65535.00 FORMAT "%8.2" /end CHARACTERISTIC
/begin CHARACTERISTIC CWFA229A "" VALUE 0x8EC158 KwUw 65535.00 dez 0.00 65535.00 FORMAT "%8.2" /end CHARACTERISTIC
/begin CHARACTERISTIC CWFA229B "" VALUE 0x8EC15A KwUw 65535.00 dez 0.00 65535.00 FORMAT "%8.2" /end CHARACTERISTIC
/begin CHARACTERISTIC CWFA230 "" VALUE 0x8EC15C KwUw 65535.00 dez 0.00 65535.00 FORMAT "%8.2" /end CHARACTERISTIC
/begin CHARACTERISTIC CWFA230A "" VALUE 0x8EC15E KwUw 65535.00 dez 0.00 65535.00 FORMAT "%8.2" /end CHARACTERISTIC
/begin CHARACTERISTIC CWFA230B "" VALUE 0x8EC160 KwUw 65535.00 dez 0.00 65535.00 FORMAT "%8.2" /end CHARACTERISTIC
/begin CHARACTERISTIC CWFA231 "" VALUE 0x8EC162 KwUw 65535.00 dez 0.00 65535.00 FORMAT "%8.2" /end CHARACTERISTIC
/begin CHARACTERISTIC CWFA231A "" VALUE 0x8EC164 KwUw 65535.00 dez 0.00 65535.00 FORMAT "%8.2" /end CHARACTERISTIC
/begin CHARACTERISTIC CWFA231B "" VALUE 0x8EC166 KwUw 65535.00 dez 0.00 65535.00 FORMAT "%8.2" /end CHARACTERISTIC
/begin CHARACTERISTIC CWFA232 "" VALUE 0x8EC168 KwUw 65535.00 dez 0.00 65535.00 FORMAT "%8.2" /end CHARACTERISTIC
/begin CHARACTERISTIC CWFA232A "" VALUE 0x8EC16A KwUw 65535.00 dez 0.00 65535.00 FORMAT "%8.2" /end CHARACTERISTIC
/begin CHARACTERISTIC CWFA232B "" VALUE 0x8EC16C KwUw 65535.00 dez 0.00 65535.00 FORMAT "%8.2" /end CHARACTERISTIC
/begin CHARACTERISTIC CWFA233 "" VALUE 0x8EC16E KwUw 65535.00 dez 0.00 65535.00 FORMAT "%8.2" /end CHARACTERISTIC
/begin CHARACTERISTIC CWFA233A "" VALUE 0x8EC170 KwUw 65535.00 dez 0.00 65535.00 FORMAT "%8.2" /end CHARACTERISTIC
/begin CHARACTERISTIC CWFA233B "" VALUE 0x8EC172 KwUw 65535.00 dez 0.00 65535.00 FORMAT "%8.2" /end CHARACTERISTIC
/begin CHARACTERISTIC CWFA234 "" VALUE 0x8EC174 KwUw 65535.00 dez 0.00 65535.00 FORMAT "%8.2" /end CHARACTERISTIC
/begin CHARACTERISTIC CWFA234A "" VALUE 0x8EC176 KwUw 65535.00 dez 0.00 65535.00 FORMAT "%8.2" /end CHARACTERISTIC
/begin CHARACTERISTIC CWFA234B "" VALUE 0x8EC178 KwUw 65535.00 dez 0.00 65535.00 FORMAT "%8.2" /end CHARACTERISTIC
/begin CHARACTERISTIC CWFA235 "" VALUE 0x8EC17A KwUw 65535.00 dez 0.00 65535.00 FORMAT "%8.2" /end CHARACTERISTIC
/begin CHARACTERISTIC CWFA235A "" VALUE 0x8EC17C KwUw 65535.00 dez 0.00 65535.00 FORMAT "%8.2" /end CHARACTERISTIC
/begin CHARACTERISTIC CWFA235B "" VALUE 0x8EC17E KwUw 65535.00 dez 0.00 65535.00 FORMAT "%8.2" /end CHARACTERISTIC
/begin CHARACTERISTIC CWFA236 "" VALUE 0x8EC180 KwUw 65535.00 dez 0.00 65535.00 FORMAT "%8.2" /end CHARACTERISTIC
/begin CHARACTERISTIC CWFA236A "" VALUE 0x8EC182 KwUw 65535.00 dez 0.00 65535.00 FORMAT "%8.2" /end CHARACTERISTIC
/begin CHARACTERISTIC CWFA236B "" VALUE 0x8EC184 KwUw 65535.00 dez 0.00 65535.00 FORMAT "%8.2" /end CHARACTERISTIC
/begin CHARACTERISTIC CWFA237 "" VALUE 0x8EC186 KwUw 65535.00 dez 0.00 65535.00 FORMAT "%8.2" /end CHARACTERISTIC
/begin CHARACTERISTIC CWFA237A "" VALUE 0x8EC188 KwUw 65535.00 dez 0.00 65535.00 FORMAT "%8.2" /end CHARACTERISTIC
/begin CHARACTERISTIC CWFA237B "" VALUE 0x8EC18A KwUw 65535.00 dez 0.00 65535.00 FORMAT "%8.2" /end CHARACTERISTIC
/begin CHARACTERISTIC CWFA238 "" VALUE 0x8EC18C KwUw 65535.00 dez 0.00 65535.00 FORMAT "%8.2" /end CHARACTERISTIC
/begin CHARACTERISTIC CWFA238A "" VALUE 0x8EC18E KwUw 65535.00 dez 0.00 65535.00 FORMAT "%8.2" /end CHARACTERISTIC
/begin CHARACTERISTIC CWFA238B "" VALUE 0x8EC190 KwUw 65535.00 dez 0.00 65535.00 FORMAT "%8.2" /end CHARACTERISTIC
/begin CHARACTERISTIC CWFA239 "" VALUE 0x8EC192 KwUw 65535.00 dez 0.00 65535.00 FORMAT "%8.2" /end CHARACTERISTIC
/begin CHARACTERISTIC CWFA239A "" VALUE 0x8EC194 KwUw 65535.00 dez 0.00 65535.00 FORMAT "%8.2" /end CHARACTERISTIC
/begin CHARACTERISTIC CWFA239B "" VALUE 0x8EC196 KwUw 65535.00 dez 0.00 65535.00 FORMAT "%8.2" /end CHARACTERISTIC
/begin CHARACTERISTIC CWFA240 "" VALUE 0x8EC198 KwUw 65535.00 dez 0.00 65535.00 FORMAT "%8.2" /end CHARACTERISTIC
/begin CHARACTERISTIC CWFA240A "" VALUE 0x8EC19A KwUw 65535.00 dez 0.00 65535.00 FORMAT "%8.2" /end CHARACTERISTIC
/begin CHARACTERISTIC CWFA240B "" VALUE 0x8EC19C KwUw 65535.00 dez 0.00 65535.00 FORMAT "%8.2" /end CHARACTERISTIC
/begin CHARACTERISTIC CWFA241 "" VALUE 0x8EC19E KwUw 65535.00 dez 0.00 65535.00 FORMAT "%8.2" /end CHARACTERISTIC
/begin CHARACTERISTIC CWFA241A "" VALUE 0x8EC1A0 KwUw 65535.00 dez 0.00 65535.00 FORMAT "%8.2" /end CHARACTERISTIC
/begin CHARACTERISTIC CWFA241B "" VALUE 0x8EC1A2 KwUw 65535.00 dez 0.00 65535.00 FORMAT "%8.2" /end CHARACTERISTIC
/begin CHARACTERISTIC CWFA242 "" VALUE 0x8EC1A4 KwUw 65535.00 dez 0.00 65535.00 FORMAT "%8.2" /end CHARACTERISTIC
/begin CHARACTERISTIC CWFA242A "" VALUE 0x8EC1A6 KwUw 65535.00 dez 0.00 65535.00 FORMAT "%8.2" /end CHARACTERISTIC
/begin CHARACTERISTIC CWFA242B "" VALUE 0x8EC1A8 KwUw 65535.00 dez 0.00 65535.00 FORMAT "%8.2" /end CHARACTERISTIC
/begin CHARACTERISTIC CWFA243 "" VALUE 0x8EC1AA KwUw 65535.00 dez 0.00 65535.00 FORMAT "%8.2" /end CHARACTERISTIC
/begin CHARACTERISTIC CWFA243A "" VALUE 0x8EC1AC KwUw 65535.00 dez 0.00 65535.00 FORMAT "%8.2" /end CHARACTERISTIC
/begin CHARACTERISTIC CWFA243B "" VALUE 0x8EC1AE KwUw 65535.00 dez 0.00 65535.00 FORMAT "%8.2" /end CHARACTERISTIC
/begin CHARACTERISTIC CWFA244 "" VALUE 0x8EC1B0 KwUw 65535.00 dez 0.00 65535.00 FORMAT "%8.2" /end CHARACTERISTIC
/begin CHARACTERISTIC CWFA244A "" VALUE 0x8EC1B2 KwUw 65535.00 dez 0.00 65535.00 FORMAT "%8.2" /end CHARACTERISTIC
/begin CHARACTERISTIC CWFA244B "" VALUE 0x8EC1B4 KwUw 65535.00 dez 0.00 65535.00 FORMAT "%8.2" /end CHARACTERISTIC
/begin CHARACTERISTIC CWFA245 "" VALUE 0x8EC1B6 KwUw 65535.00 dez 0.00 65535.00 FORMAT "%8.2" /end CHARACTERISTIC
/begin CHARACTERISTIC CWFA245A "" VALUE 0x8EC1B8 KwUw 65535.00 dez 0.00 65535.00 FORMAT "%8.2" /end CHARACTERISTIC
/begin CHARACTERISTIC CWFA245B "" VALUE 0x8EC1BA KwUw 65535.00 dez 0.00 65535.00 FORMAT "%8.2" /end CHARACTERISTIC
/begin CHARACTERISTIC CWFA246 "" VALUE 0x8EC1BC KwUw 65535.00 dez 0.00 65535.00 FORMAT "%8.2" /end CHARACTERISTIC
/begin CHARACTERISTIC CWFA246A "" VALUE 0x8EC1BE KwUw 65535.00 dez 0.00 65535.00 FORMAT "%8.2" /end CHARACTERISTIC
/begin CHARACTERISTIC CWFA246B "" VALUE 0x8EC1C0 KwUw 65535.00 dez 0.00 65535.00 FORMAT "%8.2" /end CHARACTERISTIC
/begin CHARACTERISTIC CWFA247 "" VALUE 0x8EC1C2 KwUw 65535.00 dez 0.00 65535.00 FORMAT "%8.2" /end CHARACTERISTIC
/begin CHARACTERISTIC CWFA247A "" VALUE 0x8EC1C4 KwUw 65535.00 dez 0.00 65535.00 FORMAT "%8.2" /end CHARACTERISTIC
/begin CHARACTERISTIC CWFA247B "" VALUE 0x8EC1C6 KwUw 65535.00 dez 0.00 65535.00 FORMAT "%8.2" /end CHARACTERISTIC
/begin CHARACTERISTIC CWFA248 "" VALUE 0x8EC1C8 KwUw 65535.00 dez 0.00 65535.00 FORMAT "%8.2" /end CHARACTERISTIC
/begin CHARACTERISTIC CWFA248A "" VALUE 0x8EC1CA KwUw 65535.00 dez 0.00 65535.00 FORMAT "%8.2" /end CHARACTERISTIC
/begin CHARACTERISTIC CWFA248B "" VALUE 0x8EC1CC KwUw 65535.00 dez 0.00 65535.00 FORMAT "%8.2" /end CHARACTERISTIC
/begin CHARACTERISTIC CWFA249 "" VALUE 0x8EC1CE KwUw 65535.00 dez 0.00 65535.00 FORMAT "%8.2" /end CHARACTERISTIC
/begin CHARACTERISTIC CWFA249A "" VALUE 0x8EC1D0 KwUw 65535.00 dez 0.00 65535.00 FORMAT "%8.2" /end CHARACTERISTIC
/begin CHARACTERISTIC CWFA249B "" VALUE 0x8EC1D2 KwUw 65535.00 dez 0.00 65535.00 FORMAT "%8.2" /end CHARACTERISTIC
/begin CHARACTERISTIC CWFA250 "" VALUE 0x8EC1D4 KwUw 65535.00 dez 0.00 65535.00 FORMAT "%8.2" /end CHARACTERISTIC
/begin CHARACTERISTIC CWFA250A "" VALUE 0x8EC1D6 KwUw 65535.00 dez 0.00 65535.00 FORMAT "%8.2" /end CHARACTERISTIC
/begin CHARACTERISTIC CWFA250B "" VALUE 0x8EC1D8 KwUw 65535.00 dez 0.00 65535.00 FORMAT "%8.2" /end CHARACTERISTIC
/begin CHARACTERISTIC CWFA251 "" VALUE 0x8EC1DA KwUw 65535.00 dez 0.00 65535.00 FORMAT "%8.2" /end CHARACTERISTIC
/begin CHARACTERISTIC CWFA251A "" VALUE 0x8EC1DC KwUw 65535.00 dez 0.00 65535.00 FORMAT "%8.2" /end CHARACTERISTIC
/begin CHARACTERISTIC CWFA251B "" VALUE 0x8EC1DE KwUw 65535.00 dez 0.00 65535.00 FORMAT "%8.2" /end CHARACTERISTIC
/begin CHARACTERISTIC CWFA252 "" VALUE 0x8EC1E0 KwUw 65535.00 dez 0.00 65535.00 FORMAT "%8.2" /end CHARACTERISTIC
/begin CHARACTERISTIC CWFA252A "" VALUE 0x8EC1E2 KwUw 65535.00 dez 0.00 65535.00 FORMAT "%8.2" /end CHARACTERISTIC
/begin CHARACTERISTIC CWFA252B "" VALUE 0x8EC1E4 KwUw 65535.00 dez 0.00 65535.00 FORMAT "%8.2" /end CHARACTERISTIC
/begin CHARACTERISTIC CWFA253 "" VALUE 0x8EC1E6 KwUw 65535.00 dez 0.00 65535.00 FORMAT "%8.2" /end CHARACTERISTIC
/begin CHARACTERISTIC CWFA253A "" VALUE 0x8EC1E8 KwUw 65535.00 dez 0.00 65535.00 FORMAT "%8.2" /end CHARACTERISTIC
/begin CHARACTERISTIC CWFA253B "" VALUE 0x8EC1EA KwUw 65535.00 dez 0.00 65535.00 FORMAT "%8.2" /end CHARACTERISTIC
/begin CHARACTERISTIC CWFA254 "" VALUE 0x8EC1EC KwUw 65535.00 dez 0.00 65535.00 FORMAT "%8.2" /end CHARACTERISTIC
/begin CHARACTERISTIC CWFA254A "" VALUE 0x8EC1EE KwUw 65535.00 dez 0.00 65535.00 FORMAT "%8.2" /end CHARACTERISTIC
/begin CHARACTERISTIC CWFA254B "" VALUE 0x8EC1F0 KwUw 65535.00 dez 0.00 65535.00 FORMAT "%8.2" /end CHARACTERISTIC
/begin CHARACTERISTIC CWFA255 "" VALUE 0x8EC1F2 KwUw 65535.00 dez 0.00 65535.00 FORMAT "%8.2" /end CHARACTERISTIC
/begin CHARACTERISTIC CWFA255A "" VALUE 0x8EC1F4 KwUw 65535.00 dez 0.00 65535.00 FORMAT "%8.2" /end CHARACTERISTIC
/begin CHARACTERISTIC CWFA255B "" VALUE 0x8EC1F6 KwUw 65535.00 dez 0.00 65535.00 FORMAT "%8.2" /end CHARACTERISTIC
/begin CHARACTERISTIC CWFA28 "" VALUE 0x8EC1F8 KwUw 65535.00 dez 0.00 65535.00 FORMAT "%8.2" /end CHARACTERISTIC
/begin CHARACTERISTIC CWFA28A "" VALUE 0x8EC1FA KwUw 65535.00 dez 0.00 65535.00 FORMAT "%8.2" /end CHARACTERISTIC
/begin CHARACTERISTIC CWFA28B "" VALUE 0x8EC1FC KwUw 65535.00 dez 0.00 65535.00 FORMAT "%8.2" /end CHARACTERISTIC
/begin CHARACTERISTIC CWFA34 "" VALUE 0x8EC1FE KwUw 65535.00 dez 0.00 65535.00 FORMAT "%8.2" /end CHARACTERISTIC
/begin CHARACTERISTIC CWFA34A "" VALUE 0x8EC200 KwUw 65535.00 dez 0.00 65535.00 FORMAT "%8.2" /end CHARACTERISTIC
/begin CHARACTERISTIC CWFA34B "" VALUE 0x8EC202 KwUw 65535.00 dez 0.00 65535.00 FORMAT "%8.2" /end CHARACTERISTIC
/begin CHARACTERISTIC CWFA35 "" VALUE 0x8EC204 KwUw 65535.00 dez 0.00 65535.00 FORMAT "%8.2" /end CHARACTERISTIC
/begin CHARACTERISTIC CWFA35A "" VALUE 0x8EC206 KwUw 65535.00 dez 0.00 65535.00 FORMAT "%8.2" /end CHARACTERISTIC
/begin CHARACTERISTIC CWFA35B "" VALUE 0x8EC208 KwUw 65535.00 dez 0.00 65535.00 FORMAT "%8.2" /end CHARACTERISTIC
/begin CHARACTERISTIC CWFA36 "" VALUE 0x8EC20A KwUw 65535.00 dez 0.00 65535.00 FORMAT "%8.2" /end CHARACTERISTIC
/begin CHARACTERISTIC CWFA36A "" VALUE 0x8EC20C KwUw 65535.00 dez 0.00 65535.00 FORMAT "%8.2" /end CHARACTERISTIC
/begin CHARACTERISTIC CWFA36B "" VALUE 0x8EC20E KwUw 65535.00 dez 0.00 65535.00 FORMAT "%8.2" /end CHARACTERISTIC
/begin CHARACTERISTIC CWFA37 "" VALUE 0x8EC210 KwUw 65535.00 dez 0.00 65535.00 FORMAT "%8.2" /end CHARACTERISTIC
/begin CHARACTERISTIC CWFA37A "" VALUE 0x8EC212 KwUw 65535.00 dez 0.00 65535.00 FORMAT "%8.2" /end CHARACTERISTIC
/begin CHARACTERISTIC CWFA37B "" VALUE 0x8EC214 KwUw 65535.00 dez 0.00 65535.00 FORMAT "%8.2" /end CHARACTERISTIC
/begin CHARACTERISTIC CWFA38 "" VALUE 0x8EC216 KwUw 65535.00 dez 0.00 65535.00 FORMAT "%8.2" /end CHARACTERISTIC
/begin CHARACTERISTIC CWFA38A "" VALUE 0x8EC218 KwUw 65535.00 dez 0.00 65535.00 FORMAT "%8.2" /end CHARACTERISTIC
/begin CHARACTERISTIC CWFA38B "" VALUE 0x8EC21A KwUw 65535.00 dez 0.00 65535.00 FORMAT "%8.2" /end CHARACTERISTIC
/begin CHARACTERISTIC CWFA39 "" VALUE 0x8EC21C KwUw 65535.00 dez 0.00 65535.00 FORMAT "%8.2" /end CHARACTERISTIC
/begin CHARACTERISTIC CWFA39A "" VALUE 0x8EC21E KwUw 65535.00 dez 0.00 65535.00 FORMAT "%8.2" /end CHARACTERISTIC
/begin CHARACTERISTIC CWFA39B "" VALUE 0x8EC220 KwUw 65535.00 dez 0.00 65535.00 FORMAT "%8.2" /end CHARACTERISTIC
/begin CHARACTERISTIC CWFA43 "" VALUE 0x8EC222 KwUw 65535.00 dez 0.00 65535.00 FORMAT "%8.2" /end CHARACTERISTIC
/begin CHARACTERISTIC CWFA43A "" VALUE 0x8EC224 KwUw 65535.00 dez 0.00 65535.00 FORMAT "%8.2" /end CHARACTERISTIC
/begin CHARACTERISTIC CWFA43B "" VALUE 0x8EC226 KwUw 65535.00 dez 0.00 65535.00 FORMAT "%8.2" /end CHARACTERISTIC
/begin CHARACTERISTIC CWFA44 "" VALUE 0x8EC228 KwUw 65535.00 dez 0.00 65535.00 FORMAT "%8.2" /end CHARACTERISTIC
/begin CHARACTERISTIC CWFA44A "" VALUE 0x8EC22A KwUw 65535.00 dez 0.00 65535.00 FORMAT "%8.2" /end CHARACTERISTIC
/begin CHARACTERISTIC CWFA44B "" VALUE 0x8EC22C KwUw 65535.00 dez 0.00 65535.00 FORMAT "%8.2" /end CHARACTERISTIC
/begin CHARACTERISTIC CWFA46 "" VALUE 0x8EC22E KwUw 65535.00 dez 0.00 65535.00 FORMAT "%8.2" /end CHARACTERISTIC
/begin CHARACTERISTIC CWFA46A "" VALUE 0x8EC230 KwUw 65535.00 dez 0.00 65535.00 FORMAT "%8.2" /end CHARACTERISTIC
/begin CHARACTERISTIC CWFA46B "" VALUE 0x8EC232 KwUw 65535.00 dez 0.00 65535.00 FORMAT "%8.2" /end CHARACTERISTIC
/begin CHARACTERISTIC CWFA47 "" VALUE 0x8EC234 KwUw 65535.00 dez 0.00 65535.00 FORMAT "%8.2" /end CHARACTERISTIC
/begin CHARACTERISTIC CWFA47A "" VALUE 0x8EC236 KwUw 65535.00 dez 0.00 65535.00 FORMAT "%8.2" /end CHARACTERISTIC
/begin CHARACTERISTIC CWFA47B "" VALUE 0x8EC238 KwUw 65535.00 dez 0.00 65535.00 FORMAT "%8.2" /end CHARACTERISTIC
/begin CHARACTERISTIC CWFA48 "" VALUE 0x8EC23A KwUw 65535.00 dez 0.00 65535.00 FORMAT "%8.2" /end CHARACTERISTIC
/begin CHARACTERISTIC CWFA48A "" VALUE 0x8EC23C KwUw 65535.00 dez 0.00 65535.00 FORMAT "%8.2" /end CHARACTERISTIC
/begin CHARACTERISTIC CWFA48B "" VALUE 0x8EC23E KwUw 65535.00 dez 0.00 65535.00 FORMAT "%8.2" /end CHARACTERISTIC
/begin CHARACTERISTIC CWFA49 "" VALUE 0x8EC240 KwUw 65535.00 dez 0.00 65535.00 FORMAT "%8.2" /end CHARACTERISTIC
/begin CHARACTERISTIC CWFA49A "" VALUE 0x8EC242 KwUw 65535.00 dez 0.00 65535.00 FORMAT "%8.2" /end CHARACTERISTIC
/begin CHARACTERISTIC CWFA49B "" VALUE 0x8EC244 KwUw 65535.00 dez 0.00 65535.00 FORMAT "%8.2" /end CHARACTERISTIC
/begin CHARACTERISTIC CWFA70 "" VALUE 0x8EC246 KwUw 65535.00 dez 0.00 65535.00 FORMAT "%8.2" /end CHARACTERISTIC
/begin CHARACTERISTIC CWFA70A "" VALUE 0x8EC248 KwUw 65535.00 dez 0.00 65535.00 FORMAT "%8.2" /end CHARACTERISTIC
/begin CHARACTERISTIC CWFA70B "" VALUE 0x8EC24A KwUw 65535.00 dez 0.00 65535.00 FORMAT "%8.2" /end CHARACTERISTIC
/begin CHARACTERISTIC CWFA71 "" VALUE 0x8EC24C KwUw 65535.00 dez 0.00 65535.00 FORMAT "%8.2" /end CHARACTERISTIC
/begin CHARACTERISTIC CWFA71A "" VALUE 0x8EC24E KwUw 65535.00 dez 0.00 65535.00 FORMAT "%8.2" /end CHARACTERISTIC
/begin CHARACTERISTIC CWFA71B "" VALUE 0x8EC250 KwUw 65535.00 dez 0.00 65535.00 FORMAT "%8.2" /end CHARACTERISTIC
/begin CHARACTERISTIC CWFA72 "" VALUE 0x8EC252 KwUw 65535.00 dez 0.00 65535.00 FORMAT "%8.2" /end CHARACTERISTIC
/begin CHARACTERISTIC CWFA72A "" VALUE 0x8EC254 KwUw 65535.00 dez 0.00 65535.00 FORMAT "%8.2" /end CHARACTERISTIC
/begin CHARACTERISTIC CWFA72B "" VALUE 0x8EC256 KwUw 65535.00 dez 0.00 65535.00 FORMAT "%8.2" /end CHARACTERISTIC
/begin CHARACTERISTIC CWFA75 "" VALUE 0x8EC258 KwUw 65535.00 dez 0.00 65535.00 FORMAT "%8.2" /end CHARACTERISTIC
/begin CHARACTERISTIC CWFA75A "" VALUE 0x8EC25A KwUw 65535.00 dez 0.00 65535.00 FORMAT "%8.2" /end CHARACTERISTIC
/begin CHARACTERISTIC CWFA75B "" VALUE 0x8EC25C KwUw 65535.00 dez 0.00 65535.00 FORMAT "%8.2" /end CHARACTERISTIC
/begin CHARACTERISTIC CWFA77 "" VALUE 0x8EC25E KwUw 65535.00 dez 0.00 65535.00 FORMAT "%8.2" /end CHARACTERISTIC
/begin CHARACTERISTIC CWFA77A "" VALUE 0x8EC260 KwUw 65535.00 dez 0.00 65535.00 FORMAT "%8.2" /end CHARACTERISTIC
/begin CHARACTERISTIC CWFA77B "" VALUE 0x8EC262 KwUw 65535.00 dez 0.00 65535.00 FORMAT "%8.2" /end CHARACTERISTIC
/begin CHARACTERISTIC CWFA78 "" VALUE 0x8EC264 KwUw 65535.00 dez 0.00 65535.00 FORMAT "%8.2" /end CHARACTERISTIC
/begin CHARACTERISTIC CWFA78A "" VALUE 0x8EC266 KwUw 65535.00 dez 0.00 65535.00 FORMAT "%8.2" /end CHARACTERISTIC
/begin CHARACTERISTIC CWFA78B "" VALUE 0x8EC268 KwUw 65535.00 dez 0.00 65535.00 FORMAT "%8.2" /end CHARACTERISTIC
/begin CHARACTERISTIC CWFA94 "" VALUE 0x8EC26A KwUw 65535.00 dez 0.00 65535.00 FORMAT "%8.2" /end CHARACTERISTIC
/begin CHARACTERISTIC CWFA94A "" VALUE 0x8EC26C KwUw 65535.00 dez 0.00 65535.00 FORMAT "%8.2" /end CHARACTERISTIC
/begin CHARACTERISTIC CWFA94B "" VALUE 0x8EC26E KwUw 65535.00 dez 0.00 65535.00 FORMAT "%8.2" /end CHARACTERISTIC
/begin CHARACTERISTIC CWFA96 "" VALUE 0x8EC270 KwUw 65535.00 dez 0.00 65535.00 FORMAT "%8.2" /end CHARACTERISTIC
/begin CHARACTERISTIC CWFA96A "" VALUE 0x8EC272 KwUw 65535.00 dez 0.00 65535.00 FORMAT "%8.2" /end CHARACTERISTIC
/begin CHARACTERISTIC CWFA96B "" VALUE 0x8EC274 KwUw 65535.00 dez 0.00 65535.00 FORMAT "%8.2" /end CHARACTERISTIC
/begin CHARACTERISTIC CWKUEKD "" VALUE 0x8EBACA KwUw 65535.00 dez 0.00 65535.00 FORMAT "%8.2" /end CHARACTERISTIC
/begin CHARACTERISTIC CWM9CVNSUP "" VALUE 0x8FCDFE KwUb 255.0 dez 0.00 255.0 FORMAT "%5.1" /end CHARACTERISTIC
/begin CHARACTERISTIC CWNOSCAT "" VALUE 0x8E0085 KwUb 3.000 dez 0.00 3.000 FORMAT "%5.3" /end CHARACTERISTIC
/begin CHARACTERISTIC CWSTADAP "" VALUE 0x8FD011 KwUb 255.0 dez 0.00 255.0 FORMAT "%5.1" /end CHARACTERISTIC
/begin CHARACTERISTIC CWSTAKD "" VALUE 0x8EBACC KwUw 65535.00 dez 0.00 65535.00 FORMAT "%8.2" /end CHARACTERISTIC
/begin CHARACTERISTIC CWSTAKD2 "" VALUE 0x8EBACE KwUw 65535.00 dez 0.00 65535.00 FORMAT "%8.2" /end CHARACTERISTIC
/begin CHARACTERISTIC CWSTEVKD "" VALUE 0x8EBAD0 KwUw 65535.00 dez 0.00 65535.00 FORMAT "%8.2" /end CHARACTERISTIC
/begin CHARACTERISTIC CWSU "" VALUE 0x8FCFD1 KwUb 255.0 dez 0.00 255.0 FORMAT "%5.1" /end CHARACTERISTIC
/begin CHARACTERISTIC CWTAF "" VALUE 0x8EC276 KwUw 65535.00 dez 0.00 65535.00 FORMAT "%8.2" /end CHARACTERISTIC
/begin CHARACTERISTIC CWTAK "" VALUE 0x8EC278 KwUw 65535.00 dez 0.00 65535.00 FORMAT "%8.2" /end CHARACTERISTIC
/begin CHARACTERISTIC CWTAS "" VALUE 0x8EC27A KwUw 65535.00 dez 0.00 65535.00 FORMAT "%8.2" /end CHARACTERISTIC
/begin CHARACTERISTIC CWTEACFG "" VALUE 0x8E3712 KwUb 255.0 dez 0.00 255.0 FORMAT "%5.1" /end CHARACTERISTIC
/begin CHARACTERISTIC DBGRAMX_UM "" VALUE 0x8FC00D KwUb 255.0 dez 0.00 255.0 FORMAT "%5.1" /end CHARACTERISTIC
/begin CHARACTERISTIC DBGRA_T_UM "" VALUE 0x8FC00E KwUb 10.20 t_q0p04 0.00 10.20 FORMAT "%5.2" /end CHARACTERISTIC
/begin CHARACTERISTIC DBMSRMX_UM "" VALUE 0x8FC07D KwUb 255.0 dez 0.00 255.0 FORMAT "%5.1" /end CHARACTERISTIC
/begin CHARACTERISTIC DBMSR_T_UM "" VALUE 0x8FC07E KwUb 10200.0 t40ms_ub_b10200 0.00 10200.0 FORMAT "%7.1" /end CHARACTERISTIC
/begin CHARACTERISTIC DECKSTAI "" CURVE 0x8FD012 KlAUbSstUbWSb 1.000 fak_sb_b1 -1.000 0.00 FORMAT "%5.3"
 /begin AXIS_DESCR STD_AXIS tmadb dez 3 0.00 255.0 FORMAT "%5.1" DEPOSIT ABSOLUTE /end AXIS_DESCR
/end CHARACTERISTIC
/begin CHARACTERISTIC DFTEAHB "" VALUE 0x8E3715 KwSb 1.992 fak_sb_b1 -1.000 0.9922 FORMAT "%5.3" /end CHARACTERISTIC
/begin CHARACTERISTIC DMSTES "" CURVE 0x8EEBB2 KlAUwSstUwWUw 3276.800 m_uw_q3p2 0.00 3276.800 FORMAT "%8.3"
 /begin AXIS_DESCR STD_AXIS mstesoll_w m_uw_b25p6 6 0.00 25.59961 FORMAT "%8.5" DEPOSIT ABSOLUTE /end AXIS_DESCR
/end CHARACTERISTIC
/begin CHARACTERISTIC DNBURN0 "" CURVE 0x8EA824 KlAUwSstUwWUw 4112.000 nmot_uw_q0p25 0.00 4112.000 FORMAT "%8.3"
 /begin AXIS_DESCR STD_AXIS nmot_w nmot_uw_q0p25 12 0.00 16383.75 FORMAT "%8.2" DEPOSIT ABSOLUTE /end AXIS_DESCR
/end CHARACTERISTIC
/begin CHARACTERISTIC DNBURN1 "" CURVE 0x8EA856 KlAUwSstUwWUw 4112.000 nmot_uw_q0p25 0.00 4112.000 FORMAT "%8.3"
 /begin AXIS_DESCR STD_AXIS nmot_w nmot_uw_q0p25 12 0.00 16383.75 FORMAT "%8.2" DEPOSIT ABSOLUTE /end AXIS_DESCR
/end CHARACTERISTIC
/begin CHARACTERISTIC DNBURN2 "" CURVE 0x8EA888 KlAUwSstUwWUw 4112.000 nmot_uw_q0p25 0.00 4112.000 FORMAT "%8.3"
 /begin AXIS_DESCR STD_AXIS nmot_w nmot_uw_q0p25 12 0.00 16383.75 FORMAT "%8.2" DEPOSIT ABSOLUTE /end AXIS_DESCR
/end CHARACTERISTIC
/begin CHARACTERISTIC DSTEMIN "" VALUE 0x8FEF58 KwUw 0.9999695 fak_uw_b2 0.00 0.9999695 FORMAT "%9.7" /end CHARACTERISTIC
/begin CHARACTERISTIC DTMSRUHOT "" VALUE 0x8E1516 KwUb 191.3 temp_ub_q0p75 0.00 191.3 FORMAT "%5.1" /end CHARACTERISTIC
/begin CHARACTERISTIC DZW_AOG "" VALUE 0x8FD0D5 KwSb 191.3 zw_sb_q0p75 -96.00 95.25 FORMAT "%5.2" /end CHARACTERISTIC
/begin CHARACTERISTIC DZW_AUG "" VALUE 0x8FD0D6 KwSb 191.3 zw_sb_q0p75 -96.00 95.25 FORMAT "%5.2" /end CHARACTERISTIC
/begin CHARACTERISTIC ENSUKHG "" VALUE 0x8E1517 KwUb 255.0 dez 0.00 255.0 FORMAT "%5.1" /end CHARACTERISTIC
/begin CHARACTERISTIC FBA_AOG "" VALUE 0x8FD0D7 KwUb 1.992 fak_ub_b2 0.00 1.992 FORMAT "%5.3" /end CHARACTERISTIC
/begin CHARACTERISTIC FBA_AUG "" VALUE 0x8FD0D8 KwUb 1.992 fak_ub_b2 0.00 1.992 FORMAT "%5.3" /end CHARACTERISTIC
/begin CHARACTERISTIC FBTEB "" CURVE 0x8E3716 KlAUbSstUbWUb 0.9961 fak_ub_b1 0.00 0.9961
 /begin AXIS_DESCR STD_AXIS ftefvab fak_ub_b0p03125 6 0.00 0.03113 FORMAT "%7.5" DEPOSIT ABSOLUTE /end AXIS_DESCR
/end CHARACTERISTIC
/begin CHARACTERISTIC FBTEVA "" CURVE 0x8E3723 KlAUbSstUbWUb 0.9961 fak_ub_b1 0.00 0.9961 /begin AXIS_DESCR STD_AXIS ftefva fak_ub_b0p5 6 0.00 0.4980 DEPOSIT ABSOLUTE /end AXIS_DESCR /end CHARACTERISTIC
/begin CHARACTERISTIC FBZBTEML "" CURVE 0x8E3730 KlAUbSstUbWUb 0.9961 fak_ub_b1 0.00 0.9961
 /begin AXIS_DESCR STD_AXIS abo dez 5 0.00 255.0 FORMAT "%5.1" DEPOSIT ABSOLUTE /end AXIS_DESCR
/end CHARACTERISTIC
/begin CHARACTERISTIC FETATEBN "" CURVE 0x8E373B KlAUbSstUbWUb 0.9961 fak_ub_b1 0.00 0.9961
 /begin AXIS_DESCR STD_AXIS nmot nmot_ub_q40 5 0.00 10200. FORMAT "%5.0" DEPOSIT ABSOLUTE /end AXIS_DESCR
/end CHARACTERISTIC
/begin CHARACTERISTIC FKATEB "" CURVE 0x8E3746 KlAUbSstUbWUb 0.9961 fak_ub_b1 0.00 0.9961
 /begin AXIS_DESCR STD_AXIS qtetemin fak_ub_b4 5 0.00 3.984 FORMAT "%5.3" DEPOSIT ABSOLUTE /end AXIS_DESCR
/end CHARACTERISTIC
/begin CHARACTERISTIC FLR_AOG "" VALUE 0x8FD0D9 KwSb 2.550 t10msxs_sb_q0p01 -1.280 1.270 FORMAT "%5.3" /end CHARACTERISTIC
/begin CHARACTERISTIC FLR_AUG "" VALUE 0x8FD0DA KwSb 2.550 t10msxs_sb_q0p01 -1.280 1.270 FORMAT "%5.3" /end CHARACTERISTIC
/begin CHARACTERISTIC FNS_AOG "" VALUE 0x8FD0DB KwUb 1.992 fak_ub_b2 0.00 1.992 FORMAT "%5.3" /end CHARACTERISTIC
/begin CHARACTERISTIC FNS_AUG "" VALUE 0x8FD0DC KwUb 1.992 fak_ub_b2 0.00 1.992 FORMAT "%5.3" /end CHARACTERISTIC
/begin CHARACTERISTIC FQTEDL "" CURVE 0x8E3751 KlAUbSstUbWUb 1.992 fak_ub_b2 0.00 1.992 FORMAT "%5.3"
 /begin AXIS_DESCR STD_AXIS dmlftef fak_ub_b0p5 5 0.00 0.4980 DEPOSIT ABSOLUTE /end AXIS_DESCR
/end CHARACTERISTIC
/begin CHARACTERISTIC FQTEFR "" CURVE 0x8EEB42 KlAUbSstUbWSb 15.88 fak_sb_b16 0.00 15.88 FORMAT "%5.2"
 /begin AXIS_DESCR STD_AXIS frmxa fak_ub_b2 8 0.00 1.992 FORMAT "%5.3" DEPOSIT ABSOLUTE /end AXIS_DESCR
/end CHARACTERISTIC
/begin CHARACTERISTIC FQTEPT "" CURVE 0x8E375C KlAUbSstSbWSb 15.88 fak_sb_b16 0.00 15.88 FORMAT "%5.2"
 /begin AXIS_DESCR STD_AXIS pte p_sb_q0p25 6 -32.00 31.75 FORMAT "%5.2" DEPOSIT ABSOLUTE /end AXIS_DESCR
/end CHARACTERISTIC
/begin CHARACTERISTIC FQTEVA "" CURVE 0x8E3769 KlAUbSstUbWUb 15.94 fak_ub_b16 0.00 15.94 FORMAT "%5.2" /begin AXIS_DESCR STD_AXIS ftefva fak_ub_b0p5 6 0.00 0.4980 DEPOSIT ABSOLUTE /end AXIS_DESCR /end CHARACTERISTIC
/begin CHARACTERISTIC FRHB "" VALUE 0x8E3776 KwUb 1.992 fak_ub_b2 0.00 1.992 FORMAT "%5.3" /end CHARACTERISTIC
/begin CHARACTERISTIC FRK_AOG "" VALUE 0x8FD0DD KwUb 0.4980 fak_ub_b1p25_o0p75 0.7500 1.248 FORMAT "%5.3" /end CHARACTERISTIC
/begin CHARACTERISTIC FRK_AUG "" VALUE 0x8FD0DE KwUb 0.4980 fak_ub_b1p25_o0p75 0.7500 1.248 FORMAT "%5.3" /end CHARACTERISTIC
/begin CHARACTERISTIC FSRFTEF "" VALUE 0x8FD27B KwUb 59.75 fak_ub_b64 4.000 63.75 FORMAT "%5.2" /end CHARACTERISTIC
/begin CHARACTERISTIC FST_AOG "" VALUE 0x8FD0DF KwUb 1.992 fak_ub_b2 0.00 1.992 FORMAT "%5.3" /end CHARACTERISTIC
/begin CHARACTERISTIC FST_AUG "" VALUE 0x8FD0E0 KwUb 1.992 fak_ub_b2 0.00 1.992 FORMAT "%5.3" /end CHARACTERISTIC
/begin CHARACTERISTIC FTEADAB "" VALUE 0x8E3777 KwSb 127.5 fak_sb_b64 -64.00 63.50 FORMAT "%5.2" /end CHARACTERISTIC
/begin CHARACTERISTIC FTEADMX "" VALUE 0x8E3778 KwSb 127.5 fak_sb_b64 -64.00 63.50 FORMAT "%5.2" /end CHARACTERISTIC
/begin CHARACTERISTIC FTEFHB "" VALUE 0x8E3779 KwUb 0.4980 fak_ub_b0p5 0.00 0.4980 /end CHARACTERISTIC
/begin CHARACTERISTIC FTEHB "" VALUE 0x8E377A KwSb 127.5 fak_sb_b64 -64.00 63.50 FORMAT "%5.2" /end CHARACTERISTIC
/begin CHARACTERISTIC FTEINIX "" CURVE 0x8E377B KlAUbSstUbWUb 0.1992 fak_ub_b0p5 0.00 0.1992
 /begin AXIS_DESCR STD_AXIS imsteini m_ub_q0p0444 5 0.00 11.32 FORMAT "%5.2" DEPOSIT ABSOLUTE /end AXIS_DESCR
/end CHARACTERISTIC
/begin CHARACTERISTIC FUMRBRK "" VALUE 0x8E3786 KwUb 31.88 fak_ub_b32 0.00 31.88 FORMAT "%5.2" /end CHARACTERISTIC
/begin CHARACTERISTIC FVA_AOG "" VALUE 0x8FD0E1 KwUb 1.992 fak_ub_b2 0.00 1.992 FORMAT "%5.3" /end CHARACTERISTIC
/begin CHARACTERISTIC FVA_AUG "" VALUE 0x8FD0E2 KwUb 1.992 fak_ub_b2 0.00 1.992 FORMAT "%5.3" /end CHARACTERISTIC
/begin CHARACTERISTIC FVERMN "" CURVE 0x8E3881 KlAUbSstUbWUb 0.9961 fak_ub_b1 0.00 0.9961
 /begin AXIS_DESCR STD_AXIS nmot nmot_ub_q40 6 0.00 10200. FORMAT "%5.0" DEPOSIT ABSOLUTE /end AXIS_DESCR
/end CHARACTERISTIC
/begin CHARACTERISTIC FVERZDYN "" CURVE 0x8EEBCC GklWUw 0.003905886 t_min_q5p96em8 0.00 0.003905886 FORMAT "%11.9"
 /begin AXIS_DESCR COM_AXIS qmsdyn fak_ub_b16 5 0.00 15.94 FORMAT "%5.2" AXIS_PTS_REF SQM05TEUB /end AXIS_DESCR
/end CHARACTERISTIC
/begin CHARACTERISTIC FVRMDYN "" CURVE 0x8E388E GklWUb 7.969 fak_ub_b8 0.00 7.969 FORMAT "%5.3"
 /begin AXIS_DESCR COM_AXIS qmsdyn fak_ub_b16 5 0.00 15.94 FORMAT "%5.2" AXIS_PTS_REF SQM05TEUB /end AXIS_DESCR
/end CHARACTERISTIC
/begin CHARACTERISTIC FWL_AOG "" VALUE 0x8FD0E3 KwUb 1.992 fak_ub_b2 0.00 1.992 FORMAT "%5.3" /end CHARACTERISTIC
/begin CHARACTERISTIC FWL_AUG "" VALUE 0x8FD0E4 KwUb 1.992 fak_ub_b2 0.00 1.992 FORMAT "%5.3" /end CHARACTERISTIC
/begin CHARACTERISTIC GRAOFLOGIN "" VALUE 0x8FE930 KwUw 65535.00 dez 0.00 65535.00 FORMAT "%8.2" /end CHARACTERISTIC
/begin CHARACTERISTIC GRAONLOGIN "" VALUE 0x8FE932 KwUw 65535.00 dez 0.00 65535.00 FORMAT "%8.2" /end CHARACTERISTIC
/begin CHARACTERISTIC HLOFFLOGIN "" VALUE 0x8FE934 KwUw 65535.00 dez 0.00 65535.00 FORMAT "%8.2" /end CHARACTERISTIC
/begin CHARACTERISTIC HLONLOGIN "" VALUE 0x8FE936 KwUw 65535.00 dez 0.00 65535.00 FORMAT "%8.2" /end CHARACTERISTIC
/begin CHARACTERISTIC INCKSTAI "" CURVE 0x8FD019 KlAUbSstUbWSb 0.9922 fak_sb_b1 0.00 0.9922
 /begin AXIS_DESCR STD_AXIS tmadb dez 3 0.00 255.0 FORMAT "%5.1" DEPOSIT ABSOLUTE /end AXIS_DESCR
/end CHARACTERISTIC
/begin CHARACTERISTIC KFETATE "" MAP 0x8EEB54 KfAxUwAyUwSstxSwSstyUwWUw 50.00000 rel_q0p00195 50.00000 100.0000 FORMAT "%8.4"
 /begin AXIS_DESCR STD_AXIS fteadf_w fak_q0p00195 3 -64.00000 63.99805 FORMAT "%8.5" DEPOSIT ABSOLUTE /end AXIS_DESCR
 /begin AXIS_DESCR STD_AXIS mifa_w rel_uw_b100 5 0.00 99.99847 FORMAT "%8.5" DEPOSIT ABSOLUTE /end AXIS_DESCR
/end CHARACTERISTIC
/begin CHARACTERISTIC KFFTEAN "" MAP 0x8E3787 GkfWUb 0.1992 fak_ub_b0p5 0.00 0.1992
 /begin AXIS_DESCR COM_AXIS nmot nmot_ub_q40 10 0.00 10200. FORMAT "%5.0" AXIS_PTS_REF SNM10TEUB /end AXIS_DESCR
 /begin AXIS_DESCR COM_AXIS wdkba relDK_ub_b100 10 0.00 100.0 FORMAT "%5.1" AXIS_PTS_REF SDK10TEUB /end AXIS_DESCR
/end CHARACTERISTIC
/begin CHARACTERISTIC KFFTEAX "" MAP 0x8E37EB KfAxUbAyUbSstxUbSstyUbWUb 0.1992 fak_ub_b0p5 0.00 0.1992
 /begin AXIS_DESCR STD_AXIS ml m_ub_b1020 5 0.00 1020. FORMAT "%5.0" DEPOSIT ABSOLUTE /end AXIS_DESCR
 /begin AXIS_DESCR STD_AXIS tans temp_ub_q0p75_o48 4 -48.00 143.3 FORMAT "%5.1" DEPOSIT ABSOLUTE /end AXIS_DESCR
/end CHARACTERISTIC
/begin CHARACTERISTIC KFMI_UM "" MAP 0x8FC09C GkfWUb 99.61 rel_ub_b99p6 0.00 99.61 FORMAT "%5.2"
 /begin AXIS_DESCR COM_AXIS rl_um rel_ub_q0p75 8 0.00 191.3 FORMAT "%5.1" AXIS_PTS_REF RLV08_UM /end AXIS_DESCR
 /begin AXIS_DESCR COM_AXIS nmot_um nmot_ub_q40 8 0.00 10200. FORMAT "%5.0" AXIS_PTS_REF NMV08_UM /end AXIS_DESCR
/end CHARACTERISTIC
/begin CHARACTERISTIC KFNSTAMX "" MAP 0x8E1BC0 KfAxUbAyUbSstxUbSstyUbWUb 10200. nmot_ub_q40 0.00 10200. FORMAT "%5.0"
 /begin AXIS_DESCR STD_AXIS fho fak_ub_b4 4 0.00 3.984 FORMAT "%5.3" DEPOSIT ABSOLUTE /end AXIS_DESCR
 /begin AXIS_DESCR STD_AXIS nstat nmot_ub_q10 4 0.00 2550. FORMAT "%5.0" DEPOSIT ABSOLUTE /end AXIS_DESCR
/end CHARACTERISTIC
/begin CHARACTERISTIC KFQTE "" MAP 0x8E380A GkfWUb 0.0121593164 perio_ub_b0p012207 0.00 0.0121593164 FORMAT "%12.10"
 /begin AXIS_DESCR COM_AXIS ml m_ub_b1020 6 0.00 1020. FORMAT "%5.0" AXIS_PTS_REF SML06TEUB /end AXIS_DESCR
 /begin AXIS_DESCR COM_AXIS frmit fak_ub_b2 5 0.00 1.992 FORMAT "%5.3" AXIS_PTS_REF SFR05TEUB /end AXIS_DESCR
/end CHARACTERISTIC
/begin CHARACTERISTIC KFSU "" MAP 0x8E1518 KfAxUbAyUbSstxUbSstyUbWUb 2.000 dez 0.00 2.000 FORMAT "%5.3"
 /begin AXIS_DESCR STD_AXIS nmotsu nmot_ub_q40 12 0.00 10200. FORMAT "%5.0" DEPOSIT ABSOLUTE /end AXIS_DESCR
 /begin AXIS_DESCR STD_AXIS mrko rel_ub_b200 8 0.00 199.2 FORMAT "%5.1" DEPOSIT ABSOLUTE /end AXIS_DESCR
/end CHARACTERISTIC
/begin CHARACTERISTIC KFSUHOT "" MAP 0x8E158E KfAxUbAyUbSstxUbSstyUbWUb 2.000 dez 0.00 2.000 FORMAT "%5.3"
 /begin AXIS_DESCR STD_AXIS nmotsu nmot_ub_q40 12 0.00 10200. FORMAT "%5.0" DEPOSIT ABSOLUTE /end AXIS_DESCR
 /begin AXIS_DESCR STD_AXIS mrko rel_ub_b200 8 0.00 199.2 FORMAT "%5.1" DEPOSIT ABSOLUTE /end AXIS_DESCR
/end CHARACTERISTIC
/begin CHARACTERISTIC KFTADMS "" MAP 0x8EEBD6 KfAxUbAyUbSstxSbSstyUbWUb 1.992 fak_ub_b2 0.00 1.992 FORMAT "%5.3"
 /begin AXIS_DESCR STD_AXIS dmssginr fak_sb_b1 5 -1.000 0.9922 FORMAT "%5.3" DEPOSIT ABSOLUTE /end AXIS_DESCR
 /begin AXIS_DESCR STD_AXIS nmot nmot_ub_q40 4 0.00 10200. FORMAT "%5.0" DEPOSIT ABSOLUTE /end AXIS_DESCR
/end CHARACTERISTIC
/begin CHARACTERISTIC KFTATX "" MAP 0x8E3828 KfAxUbAyUbSstxUbSstyUbWUb 99.61 rel_ub_b99p6 0.00 99.61 FORMAT "%5.2"
 /begin AXIS_DESCR STD_AXIS nmot nmot_ub_q40 10 0.00 10200. FORMAT "%5.0" DEPOSIT ABSOLUTE /end AXIS_DESCR
 /begin AXIS_DESCR STD_AXIS pspu fak_ub_b2 6 0.00 1.992 FORMAT "%5.3" DEPOSIT ABSOLUTE /end AXIS_DESCR
/end CHARACTERISTIC
/begin CHARACTERISTIC KFTEKA "" MAP 0x8EEB86 KfAxUbAyUbSstxUbSstyUbWSb 0.9922 fak_sb_b1 0.00 0.9922
 /begin AXIS_DESCR STD_AXIS nmot nmot_ub_q40 5 0.00 10200. FORMAT "%5.0" DEPOSIT ABSOLUTE /end AXIS_DESCR
 /begin AXIS_DESCR STD_AXIS rl rel_ub_q0p75 5 0.00 191.3 FORMAT "%5.1" DEPOSIT ABSOLUTE /end AXIS_DESCR
/end CHARACTERISTIC
/begin CHARACTERISTIC KFZW_UM "" MAP 0x8FC0DC GkfWSb 191.3 zw_sb_q0p75 -96.00 95.25 FORMAT "%5.2"
 /begin AXIS_DESCR COM_AXIS rl_um rel_ub_q0p75 8 0.00 191.3 FORMAT "%5.1" AXIS_PTS_REF RLV08_UM /end AXIS_DESCR
 /begin AXIS_DESCR COM_AXIS nmot_um nmot_ub_q40 8 0.00 10200. FORMAT "%5.0" AXIS_PTS_REF NMV08_UM /end AXIS_DESCR
/end CHARACTERISTIC
/begin CHARACTERISTIC KHCTEAMX "" VALUE 0x8E3876 KwSb 3.984 fak_sb_b2 -2.000 1.984 FORMAT "%5.3" /end CHARACTERISTIC
/begin CHARACTERISTIC KHCTEMN "" VALUE 0x8E3877 KwSb 3.984 fak_sb_b2 -2.000 1.984 FORMAT "%5.3" /end CHARACTERISTIC
/begin CHARACTERISTIC KHCTEMX "" VALUE 0x8E3878 KwSb 3.984 fak_sb_b2 -2.000 1.984 FORMAT "%5.3" /end CHARACTERISTIC
/begin CHARACTERISTIC KLDNFHO "" CURVE 0x8E1BDA KlAUbSstUbWUb 1.992 fak_ub_b2 0.00 1.992 FORMAT "%5.3"
 /begin AXIS_DESCR STD_AXIS fho fak_ub_b4 4 0.00 3.984 FORMAT "%5.3" DEPOSIT ABSOLUTE /end AXIS_DESCR
/end CHARACTERISTIC
/begin CHARACTERISTIC KLDZWOM_UM "" CURVE 0x8FC11C KlAUbSstUbWUb 191.3 zw_ub_q0p75 0.00 191.3 FORMAT "%5.1"
 /begin AXIS_DESCR STD_AXIS tmnist_um temp_ub_q0p75_o48 8 -48.00 143.3 FORMAT "%5.1" DEPOSIT ABSOLUTE /end AXIS_DESCR
/end CHARACTERISTIC
/begin CHARACTERISTIC KLETAZW_UM "" CURVE 0x8FC12D KlAUbSstUbWUb 100.0 rel_ub_b127p5 0.00 100.0 FORMAT "%5.1"
 /begin AXIS_DESCR STD_AXIS dzw_um zw_ub_q0p75 8 0.00 191.3 FORMAT "%5.1" DEPOSIT ABSOLUTE /end AXIS_DESCR
/end CHARACTERISTIC
/begin CHARACTERISTIC KLFAKSP_UM "" CURVE 0x8FC13E GklWUb 100.0 rel_ub_b127p5 0.00 100.0 FORMAT "%5.1"
 /begin AXIS_DESCR COM_AXIS nmot_um nmot_ub_q40 8 0.00 10200. FORMAT "%5.0" AXIS_PTS_REF NMV08_UM /end AXIS_DESCR
/end CHARACTERISTIC
/begin CHARACTERISTIC KLOGIN "" VALUE 0x8FE938 KwUw 65535.00 dez 0.00 65535.00 FORMAT "%8.2" /end CHARACTERISTIC
/begin CHARACTERISTIC KLTKAADFP "" VAL_BLK 0x8E2841 KwbUb 192.000000000 dfp_verbal 0.00 192.000000000 FORMAT "%13.9" NUMBER 100 /end CHARACTERISTIC
/begin CHARACTERISTIC KLTKAATOZ "" CURVE 0x8E28A5 FklWUb 255.0 t_q1 0.00 255.0 FORMAT "%5.1"
 /begin AXIS_DESCR FIX_AXIS tkbloknr dez 100 0.00 99.00 FORMAT "%5.2" FIX_AXIS_PAR 0 0 100 /end AXIS_DESCR
/end CHARACTERISTIC
/begin CHARACTERISTIC KLTKKTA "" CURVE 0x8FD114 FklWUb 255.0 dez 0.00 255.0 FORMAT "%5.1"
 /begin AXIS_DESCR FIX_AXIS tkbloknr dez 100 0.00 99.00 FORMAT "%5.2" FIX_AXIS_PAR 0 0 100 /end AXIS_DESCR
/end CHARACTERISTIC
/begin CHARACTERISTIC KLZL1_UM "" CURVE 0x8FC146 KlAUbSstUbWUb 191.3 zw_ub_q0p75 0.00 191.3 FORMAT "%5.1"
 /begin AXIS_DESCR STD_AXIS lamb1_um rel_ub_q0p03125 8 0.00 7.969 FORMAT "%5.3" DEPOSIT ABSOLUTE /end AXIS_DESCR
/end CHARACTERISTIC
/begin CHARACTERISTIC KLZL2_UM "" CURVE 0x8FC157 KlAUbSstUbWUb 191.3 zw_ub_q0p75 0.00 191.3 FORMAT "%5.1"
 /begin AXIS_DESCR STD_AXIS lamb2_um rel_ub_q0p03125 8 0.00 7.969 FORMAT "%5.3" DEPOSIT ABSOLUTE /end AXIS_DESCR
/end CHARACTERISTIC
/begin CHARACTERISTIC KSTA0INI "" VALUE 0x8FD020 KwUb 1.992 fak_ub_b2 0.00 1.992 FORMAT "%5.3" /end CHARACTERISTIC
/begin CHARACTERISTIC KSTA1INI "" VALUE 0x8FD021 KwUb 1.992 fak_ub_b2 0.00 1.992 FORMAT "%5.3" /end CHARACTERISTIC
/begin CHARACTERISTIC KSTA2INI "" VALUE 0x8FD022 KwUb 1.992 fak_ub_b2 0.00 1.992 FORMAT "%5.3" /end CHARACTERISTIC
/begin CHARACTERISTIC KSTAI "" CURVE 0x8E1BE3 KlAUbSstUbWUb 255.0 dez 0.00 255.0 FORMAT "%5.1"
 /begin AXIS_DESCR STD_AXIS tmst temp_ub_q0p75_o48 12 -48.00 143.3 FORMAT "%5.1" DEPOSIT ABSOLUTE /end AXIS_DESCR
/end CHARACTERISTIC
/begin CHARACTERISTIC KSTAMN0 "" VALUE 0x8FD023 KwUb 1.992 fak_ub_b2 0.00 1.992 FORMAT "%5.3" /end CHARACTERISTIC
/begin CHARACTERISTIC KSTAMN1 "" VALUE 0x8FD024 KwUb 1.992 fak_ub_b2 0.00 1.992 FORMAT "%5.3" /end CHARACTERISTIC
/begin CHARACTERISTIC KSTAMN2 "" VALUE 0x8FD025 KwUb 1.992 fak_ub_b2 0.00 1.992 FORMAT "%5.3" /end CHARACTERISTIC
/begin CHARACTERISTIC KSTAMX0 "" VALUE 0x8FD026 KwUb 0.9922 fak_ub_b2 1.000 1.992 FORMAT "%5.3" /end CHARACTERISTIC
/begin CHARACTERISTIC KSTAMX1 "" VALUE 0x8FD027 KwUb 0.9922 fak_ub_b2 1.000 1.992 FORMAT "%5.3" /end CHARACTERISTIC
/begin CHARACTERISTIC KSTAMX2 "" VALUE 0x8FD028 KwUb 0.9922 fak_ub_b2 1.000 1.992 FORMAT "%5.3" /end CHARACTERISTIC
/begin CHARACTERISTIC KSTTOPMN "" VALUE 0x8FE6B8 KwUw 393210.0 t6minxmin_q6 0.00 393210.0 FORMAT "%8.1" /end CHARACTERISTIC
/begin CHARACTERISTIC KTMOTW "" VALUE 0x8E3FFC KwUw 1535.977 temp_q0p0234_o273 -273.1500 1262.827 FORMAT "%8.3" /end CHARACTERISTIC
/begin CHARACTERISTIC LAMTEMN "" VALUE 0x8EEB3C KwUw 15.99976 fak_uw_b16 0.00 15.99976 FORMAT "%8.5" /end CHARACTERISTIC
/begin CHARACTERISTIC LAMTEMX "" VALUE 0x8EEB3E KwUw 15.99976 fak_uw_b16 0.00 15.99976 FORMAT "%8.5" /end CHARACTERISTIC
/begin CHARACTERISTIC LFWOFLOGIN "" VALUE 0x8FE93A KwUw 65535.00 dez 0.00 65535.00 FORMAT "%8.2" /end CHARACTERISTIC
/begin CHARACTERISTIC LFWONLOGIN "" VALUE 0x8FE93C KwUw 65535.00 dez 0.00 65535.00 FORMAT "%8.2" /end CHARACTERISTIC
/begin CHARACTERISTIC LUEN1LOGIN "" VALUE 0x8FE93E KwUw 65535.00 dez 0.00 65535.00 FORMAT "%8.2" /end CHARACTERISTIC
/begin CHARACTERISTIC LUEN2LOGIN "" VALUE 0x8FE940 KwUw 65535.00 dez 0.00 65535.00 FORMAT "%8.2" /end CHARACTERISTIC
/begin CHARACTERISTIC LUEN3LOGIN "" VALUE 0x8FE942 KwUw 65535.00 dez 0.00 65535.00 FORMAT "%8.2" /end CHARACTERISTIC
/begin CHARACTERISTIC MDR_AOG "" VALUE 0x8FD0E5 KwUb 24.90 rel_ub_b25 0.00 24.90 FORMAT "%5.2" /end CHARACTERISTIC
/begin CHARACTERISTIC MDR_AUG "" VALUE 0x8FD0E6 KwUb 24.90 rel_ub_b25 0.00 24.90 FORMAT "%5.2" /end CHARACTERISTIC
/begin CHARACTERISTIC MRKOSRUHOT "" VALUE 0x8E1604 KwUb 199.2 rel_ub_b200 0.00 199.2 FORMAT "%5.1" /end CHARACTERISTIC
/begin CHARACTERISTIC MSDKLMMN "" VALUE 0x8FEF5A KwUw 6553.500 m_uw_b6553p5 0.00 6553.500 FORMAT "%8.3" /end CHARACTERISTIC
/begin CHARACTERISTIC MSRC_T_UM "" VALUE 0x8FC07F KwUb 10200.0 t40ms_ub_b10200 0.00 10200.0 FORMAT "%7.1" /end CHARACTERISTIC
/begin CHARACTERISTIC MWNTKB0 "" VAL_BLK 0x8EC27C KwbUw 65535.00 dez 0.00 65535.00 FORMAT "%8.2" NUMBER 36 /end CHARACTERISTIC
/begin CHARACTERISTIC MWNTKB1 "" VAL_BLK 0x8EC2C4 KwbUw 65535.00 dez 0.00 65535.00 FORMAT "%8.2" NUMBER 40 /end CHARACTERISTIC
/begin CHARACTERISTIC MWNTKB10 "" VAL_BLK 0x8EC314 KwbUw 65535.00 dez 0.00 65535.00 FORMAT "%8.2" NUMBER 40 /end CHARACTERISTIC
/begin CHARACTERISTIC MWNTKB11 "" VAL_BLK 0x8EC364 KwbUw 65535.00 dez 0.00 65535.00 FORMAT "%8.2" NUMBER 40 /end CHARACTERISTIC
/begin CHARACTERISTIC MWNTKB12 "" VAL_BLK 0x8EC3B4 KwbUw 65535.00 dez 0.00 65535.00 FORMAT "%8.2" NUMBER 40 /end CHARACTERISTIC
/begin CHARACTERISTIC MWNTKB13 "" VAL_BLK 0x8EC404 KwbUw 65535.00 dez 0.00 65535.00 FORMAT "%8.2" NUMBER 40 /end CHARACTERISTIC
/begin CHARACTERISTIC MWNTKB14 "" VAL_BLK 0x8EC454 KwbUw 65535.00 dez 0.00 65535.00 FORMAT "%8.2" NUMBER 40 /end CHARACTERISTIC
/begin CHARACTERISTIC MWNTKB15 "" VAL_BLK 0x8EC4A4 KwbUw 65535.00 dez 0.00 65535.00 FORMAT "%8.2" NUMBER 40 /end CHARACTERISTIC
/begin CHARACTERISTIC MWNTKB16 "" VAL_BLK 0x8EC4F4 KwbUw 65535.00 dez 0.00 65535.00 FORMAT "%8.2" NUMBER 40 /end CHARACTERISTIC
/begin CHARACTERISTIC MWNTKB17 "" VAL_BLK 0x8EC544 KwbUw 65535.00 dez 0.00 65535.00 FORMAT "%8.2" NUMBER 40 /end CHARACTERISTIC
/begin CHARACTERISTIC MWNTKB18 "" VAL_BLK 0x8EC594 KwbUw 65535.00 dez 0.00 65535.00 FORMAT "%8.2" NUMBER 40 /end CHARACTERISTIC
/begin CHARACTERISTIC MWNTKB19 "" VAL_BLK 0x8EC5E4 KwbUw 65535.00 dez 0.00 65535.00 FORMAT "%8.2" NUMBER 40 /end CHARACTERISTIC
/begin CHARACTERISTIC MWNTKB2 "" VAL_BLK 0x8EC634 KwbUw 65535.00 dez 0.00 65535.00 FORMAT "%8.2" NUMBER 40 /end CHARACTERISTIC
/begin CHARACTERISTIC MWNTKB20 "" VAL_BLK 0x8EC684 KwbUw 65535.00 dez 0.00 65535.00 FORMAT "%8.2" NUMBER 40 /end CHARACTERISTIC
/begin CHARACTERISTIC MWNTKB21 "" VAL_BLK 0x8EC6D4 KwbUw 65535.00 dez 0.00 65535.00 FORMAT "%8.2" NUMBER 40 /end CHARACTERISTIC
/begin CHARACTERISTIC MWNTKB22 "" VAL_BLK 0x8EC724 KwbUw 65535.00 dez 0.00 65535.00 FORMAT "%8.2" NUMBER 40 /end CHARACTERISTIC
/begin CHARACTERISTIC MWNTKB23 "" VAL_BLK 0x8EC774 KwbUw 65535.00 dez 0.00 65535.00 FORMAT "%8.2" NUMBER 40 /end CHARACTERISTIC
/begin CHARACTERISTIC MWNTKB24 "" VAL_BLK 0x8EC7C4 KwbUw 65535.00 dez 0.00 65535.00 FORMAT "%8.2" NUMBER 40 /end CHARACTERISTIC
/begin CHARACTERISTIC MWNTKB25 "" VAL_BLK 0x8EC814 KwbUw 65535.00 dez 0.00 65535.00 FORMAT "%8.2" NUMBER 24 /end CHARACTERISTIC
/begin CHARACTERISTIC MWNTKB3 "" VAL_BLK 0x8EC844 KwbUw 65535.00 dez 0.00 65535.00 FORMAT "%8.2" NUMBER 40 /end CHARACTERISTIC
/begin CHARACTERISTIC MWNTKB4 "" VAL_BLK 0x8EC894 KwbUw 65535.00 dez 0.00 65535.00 FORMAT "%8.2" NUMBER 40 /end CHARACTERISTIC
/begin CHARACTERISTIC MWNTKB5 "" VAL_BLK 0x8EC8E4 KwbUw 65535.00 dez 0.00 65535.00 FORMAT "%8.2" NUMBER 40 /end CHARACTERISTIC
/begin CHARACTERISTIC MWNTKB6 "" VAL_BLK 0x8EC934 KwbUw 65535.00 dez 0.00 65535.00 FORMAT "%8.2" NUMBER 40 /end CHARACTERISTIC
/begin CHARACTERISTIC MWNTKB7 "" VAL_BLK 0x8EC984 KwbUw 65535.00 dez 0.00 65535.00 FORMAT "%8.2" NUMBER 40 /end CHARACTERISTIC
/begin CHARACTERISTIC MWNTKB8 "" VAL_BLK 0x8EC9D4 KwbUw 65535.00 dez 0.00 65535.00 FORMAT "%8.2" NUMBER 40 /end CHARACTERISTIC
/begin CHARACTERISTIC MWNTKB9 "" VAL_BLK 0x8ECA24 KwbUw 65535.00 dez 0.00 65535.00 FORMAT "%8.2" NUMBER 40 /end CHARACTERISTIC
/begin CHARACTERISTIC NLS_AOG "" VALUE 0x8FD0E7 KwSb 2550. nmot_q10 -1280. 1270. FORMAT "%5.0" /end CHARACTERISTIC
/begin CHARACTERISTIC NLS_AUG "" VALUE 0x8FD0E8 KwSb 2550. nmot_q10 -1280. 1270. FORMAT "%5.0" /end CHARACTERISTIC
/begin CHARACTERISTIC NMAXOG "" VALUE 0x8FD8BC KwUw 16383.75 nmot_uw_q0p25 0.00 16383.75 FORMAT "%8.2" /end CHARACTERISTIC
/begin CHARACTERISTIC NMOTNGAS "" CURVE 0x8EA17E KlAUbSstSwWUw 1.000000 fak_ub_b2 0.9921875 1.992188 FORMAT "%8.6"
 /begin AXIS_DESCR STD_AXIS ngfilsu_w nmotg_sw_q0p39 6 -12800.16 12799.77 FORMAT "%8.2" DEPOSIT ABSOLUTE /end AXIS_DESCR
/end CHARACTERISTIC
/begin AXIS_PTS NMV08_UM "" 0x8FC081 nmot_um SstAUbSstUb 10200. nmot_ub_q40 8 0.00 10200. FORMAT "%5.0" DEPOSIT ABSOLUTE /end AXIS_PTS
/begin CHARACTERISTIC NOASR_UM "" VALUE 0x8FC080 KwUb 255.0 dez 0.00 255.0 FORMAT "%5.1" /end CHARACTERISTIC
/begin CHARACTERISTIC NSC_T2_UM "" VALUE 0x8FC3CC KwUw 2621.400 t40msxs_uw_q0p04 0.00 2621.400 FORMAT "%8.3" /end CHARACTERISTIC
/begin CHARACTERISTIC NSTAK "" VALUE 0x8FE6BA KwUw 16383.75 nmot_uw_q0p25 0.00 16383.75 FORMAT "%8.2" /end CHARACTERISTIC
/begin CHARACTERISTIC NVERZMN "" VALUE 0x8FEF5C KwUw 16383.75 nmot_uw_q0p25 0.00 16383.75 FORMAT "%8.2" /end CHARACTERISTIC
/begin CHARACTERISTIC RESETSTACK "" VALUE 0x8E004E KwUb 1.000 dez 0.00 1.000 FORMAT "%5.3" /end CHARACTERISTIC
/begin AXIS_PTS RLV08_UM "" 0x8FC08A rl_um SstAUbSstUb 191.3 rel_ub_q0p75 8 0.00 191.3 FORMAT "%5.1" DEPOSIT ABSOLUTE /end AXIS_PTS
/begin CHARACTERISTIC RLX_AOG "" VALUE 0x8FD0E9 KwUb 0.9961 fak_ub_b1 0.00 0.9961 /end CHARACTERISTIC
/begin CHARACTERISTIC RLX_AUG "" VALUE 0x8FD0EA KwUb 0.9961 fak_ub_b1 0.00 0.9961 /end CHARACTERISTIC
/begin AXIS_PTS SDK10TEUB "" 0x8E0089 wdkba SstAUbSstUb 100.0 relDK_ub_b100 10 0.00 100.0 FORMAT "%5.1" DEPOSIT ABSOLUTE /end AXIS_PTS
/begin AXIS_PTS SFR05TEUB "" 0x8E009B frmit SstAUbSstUb 1.992 fak_ub_b2 5 0.00 1.992 FORMAT "%5.3" DEPOSIT ABSOLUTE /end AXIS_PTS
/begin CHARACTERISTIC SGIDB1 "" ASCII 0x8FD0EB KwbUb 255.0 KennText 0.00 255.0 FORMAT "%5.1" NUMBER 12 /end CHARACTERISTIC
/begin CHARACTERISTIC SGIDB2 "" ASCII 0x8FD0F7 KwbUb 255.0 KennText 0.00 255.0 FORMAT "%5.1" NUMBER 20 /end CHARACTERISTIC
/begin CHARACTERISTIC SGIDB3 "" ASCII 0x8FD10B KwbUb 255.0 KennText 0.00 255.0 FORMAT "%5.1" NUMBER 4 /end CHARACTERISTIC
/begin CHARACTERISTIC SLOGIN "" VALUE 0x8FE944 KwUw 65535.00 dez 0.00 65535.00 FORMAT "%8.2" /end CHARACTERISTIC
/begin AXIS_PTS SMI03DM1UB "" 0x8E0436 midmd SstAUbSstUb 99.61 rel_ub_b99p6 3 0.00 99.61 FORMAT "%5.2" DEPOSIT ABSOLUTE /end AXIS_PTS
/begin AXIS_PTS SMI03DM2UB "" 0x8E043A midmd SstAUbSstUb 99.61 rel_ub_b99p6 3 0.00 99.61 FORMAT "%5.2" DEPOSIT ABSOLUTE /end AXIS_PTS
/begin AXIS_PTS SMI03DM3UB "" 0x8E043E midmd SstAUbSstUb 99.61 rel_ub_b99p6 3 0.00 99.61 FORMAT "%5.2" DEPOSIT ABSOLUTE /end AXIS_PTS
/begin AXIS_PTS SMI04DM1UB "" 0x8E0442 midmd SstAUbSstUb 99.61 rel_ub_b99p6 4 0.00 99.61 FORMAT "%5.2" DEPOSIT ABSOLUTE /end AXIS_PTS
/begin AXIS_PTS SMI04DM2UB "" 0x8E0447 midmd SstAUbSstUb 99.61 rel_ub_b99p6 4 0.00 99.61 FORMAT "%5.2" DEPOSIT ABSOLUTE /end AXIS_PTS
/begin AXIS_PTS SMI04DM3UB "" 0x8E044C midmd SstAUbSstUb 99.61 rel_ub_b99p6 4 0.00 99.61 FORMAT "%5.2" DEPOSIT ABSOLUTE /end AXIS_PTS
/begin AXIS_PTS SMI08DM1UB "" 0x8E0451 midmd SstAUbSstUb 99.61 rel_ub_b99p6 8 0.00 99.61 FORMAT "%5.2" DEPOSIT ABSOLUTE /end AXIS_PTS
/begin AXIS_PTS SMI08DMUB "" 0x8E045A midmd SstAUbSstUb 99.61 rel_ub_b99p6 8 0.00 99.61 FORMAT "%5.2" DEPOSIT ABSOLUTE /end AXIS_PTS
/begin AXIS_PTS SML06TEUB "" 0x8E00A7 ml SstAUbSstUb 1020. m_ub_b1020 6 0.00 1020. FORMAT "%5.0" DEPOSIT ABSOLUTE /end AXIS_PTS
/begin AXIS_PTS SNM04DM1UB "" 0x8E0463 nmot SstAUbSstUb 10200. nmot_ub_q40 4 0.00 10200. FORMAT "%5.0" DEPOSIT ABSOLUTE /end AXIS_PTS
/begin AXIS_PTS SNM04DM2UB "" 0x8E0468 nmot SstAUbSstUb 10200. nmot_ub_q40 4 0.00 10200. FORMAT "%5.0" DEPOSIT ABSOLUTE /end AXIS_PTS
/begin AXIS_PTS SNM04DM3UB "" 0x8E046D nmot SstAUbSstUb 10200. nmot_ub_q40 4 0.00 10200. FORMAT "%5.0" DEPOSIT ABSOLUTE /end AXIS_PTS
/begin AXIS_PTS SNM05DM1UB "" 0x8E0472 nmot SstAUbSstUb 10200. nmot_ub_q40 5 0.00 10200. FORMAT "%5.0" DEPOSIT ABSOLUTE /end AXIS_PTS
/begin AXIS_PTS SNM05DM2UB "" 0x8E0478 nmot SstAUbSstUb 10200. nmot_ub_q40 5 0.00 10200. FORMAT "%5.0" DEPOSIT ABSOLUTE /end AXIS_PTS
/begin AXIS_PTS SNM05DM3UB "" 0x8E047E nmot SstAUbSstUb 10200. nmot_ub_q40 5 0.00 10200. FORMAT "%5.0" DEPOSIT ABSOLUTE /end AXIS_PTS
/begin AXIS_PTS SNM05NAUW "" 0x8E5AAA nmot_w SstAUwSstUw 16383.75 nmot_uw_q0p25 5 0.00 16383.75 FORMAT "%8.2" DEPOSIT ABSOLUTE /end AXIS_PTS
/begin AXIS_PTS SNM05NEUW "" 0x8E5AB6 nmot_w SstAUwSstUw 16383.75 nmot_uw_q0p25 5 0.00 16383.75 FORMAT "%8.2" DEPOSIT ABSOLUTE /end AXIS_PTS
/begin AXIS_PTS SNM05NWUB "" 0x8E02AE nmot SstAUbSstUb 10200. nmot_ub_q40 5 0.00 10200. FORMAT "%5.0" DEPOSIT ABSOLUTE /end AXIS_PTS
/begin AXIS_PTS SNM05NWUW "" 0x8E5AC2 nmot_w SstAUwSstUw 16383.75 nmot_uw_q0p25 5 0.00 16383.75 FORMAT "%8.2" DEPOSIT ABSOLUTE /end AXIS_PTS
/begin AXIS_PTS SNM06NWUW "" 0x8E5ACE nmot_w SstAUwSstUw 16383.75 nmot_uw_q0p25 6 0.00 16383.75 FORMAT "%8.2" DEPOSIT ABSOLUTE /end AXIS_PTS
/begin AXIS_PTS SNM08DM1UB "" 0x8E0484 nmot SstAUbSstUb 10200. nmot_ub_q40 8 0.00 10200. FORMAT "%5.0" DEPOSIT ABSOLUTE /end AXIS_PTS
/begin AXIS_PTS SNM08DM2UB "" 0x8E048D nmot SstAUbSstUb 10200. nmot_ub_q40 8 0.00 10200. FORMAT "%5.0" DEPOSIT ABSOLUTE /end AXIS_PTS
/begin AXIS_PTS SNM08DM3UB "" 0x8E0496 nmot SstAUbSstUb 10200. nmot_ub_q40 8 0.00 10200. FORMAT "%5.0" DEPOSIT ABSOLUTE /end AXIS_PTS
/begin AXIS_PTS SNM08DM4UB "" 0x8E049F nmot SstAUbSstUb 10200. nmot_ub_q40 8 0.00 10200. FORMAT "%5.0" DEPOSIT ABSOLUTE /end AXIS_PTS
/begin AXIS_PTS SNM08DMUB "" 0x8E04A8 nmot SstAUbSstUb 10200. nmot_ub_q40 8 0.00 10200. FORMAT "%5.0" DEPOSIT ABSOLUTE /end AXIS_PTS
/begin AXIS_PTS SNM09DM1UB "" 0x8E04B1 nmot SstAUbSstUb 10200. nmot_ub_q40 9 0.00 10200. FORMAT "%5.0" DEPOSIT ABSOLUTE /end AXIS_PTS
/begin AXIS_PTS SNM09DM2UB "" 0x8E04BB nmot SstAUbSstUb 10200. nmot_ub_q40 9 0.00 10200. FORMAT "%5.0" DEPOSIT ABSOLUTE /end AXIS_PTS
/begin AXIS_PTS SNM09DM3UB "" 0x8E04C5 nmot SstAUbSstUb 10200. nmot_ub_q40 9 0.00 10200. FORMAT "%5.0" DEPOSIT ABSOLUTE /end AXIS_PTS
/begin AXIS_PTS SNM10TEUB "" 0x8E00EE nmot SstAUbSstUb 10200. nmot_ub_q40 10 0.00 10200. FORMAT "%5.0" DEPOSIT ABSOLUTE /end AXIS_PTS
/begin AXIS_PTS SNM16NAUW "" 0x8E5ADC nmot_w SstAUwSstUw 16383.75 nmot_uw_q0p25 16 0.00 16383.75 FORMAT "%8.2" DEPOSIT ABSOLUTE /end AXIS_PTS
/begin AXIS_PTS SNM16NEUW "" 0x8E5AFE nmot_w SstAUwSstUw 16383.75 nmot_uw_q0p25 16 0.00 16383.75 FORMAT "%8.2" DEPOSIT ABSOLUTE /end AXIS_PTS
/begin AXIS_PTS SPSNV08_UM "" 0x8FC093 spsn_um SstAUbSstUb 4.980 spg_ub_q0p019 8 0.00 4.980 FORMAT "%5.3" DEPOSIT ABSOLUTE /end AXIS_PTS
/begin AXIS_PTS SQM05TEUB "" 0x8E020E qmsdyn SstAUbSstUb 15.94 fak_ub_b16 5 0.00 15.94 FORMAT "%5.2" DEPOSIT ABSOLUTE /end AXIS_PTS
/begin AXIS_PTS SRL05NAUW "" 0x8E5B20 rlnw_w SstAUwSstUw 1535.977 rel_uw_q0p0234 5 0.00 1535.977 FORMAT "%8.3" DEPOSIT ABSOLUTE /end AXIS_PTS
/begin AXIS_PTS SRL05NEUW "" 0x8E5B2C rlnw_w SstAUwSstUw 1535.977 rel_uw_q0p0234 5 0.00 1535.977 FORMAT "%8.3" DEPOSIT ABSOLUTE /end AXIS_PTS
/begin AXIS_PTS SRL08NAUW "" 0x8E5B38 rlnw_w SstAUwSstUw 1535.977 rel_uw_q0p0234 8 0.00 1535.977 FORMAT "%8.3" DEPOSIT ABSOLUTE /end AXIS_PTS
/begin AXIS_PTS SRL08NEUW "" 0x8E5B4A rlnw_w SstAUwSstUw 1535.977 rel_uw_q0p0234 8 0.00 1535.977 FORMAT "%8.3" DEPOSIT ABSOLUTE /end AXIS_PTS
/begin AXIS_PTS SRL16NAUW "" 0x8E5B5C rlnw_w SstAUwSstUw 1535.977 rel_uw_q0p0234 16 0.00 1535.977 FORMAT "%8.3" DEPOSIT ABSOLUTE /end AXIS_PTS
/begin AXIS_PTS SRL16NEUW "" 0x8E5B7E rlnw_w SstAUwSstUw 1535.977 rel_uw_q0p0234 16 0.00 1535.977 FORMAT "%8.3" DEPOSIT ABSOLUTE /end AXIS_PTS
/begin AXIS_PTS STM05NWUB "" 0x8E02B4 tmot SstAUbSstUb 191.3 temp_ub_q0p75_o48 5 -48.00 143.3 FORMAT "%5.1" DEPOSIT ABSOLUTE /end AXIS_PTS
/begin AXIS_PTS STO06NWUW "" 0x8E5BA0 toelk_w SstAUwSstUw 1535.977 temp_q0p0234_o273 6 -273.1500 1262.827 FORMAT "%8.3" DEPOSIT ABSOLUTE /end AXIS_PTS
/begin CHARACTERISTIC SUAP "" VALUE 0x8E1605 KwUb 2.000 dez 0.00 2.000 FORMAT "%5.3" /end CHARACTERISTIC
/begin CHARACTERISTIC SUMODE0 "" VALUE 0x8E1606 KwUb 255.0 dez 0.00 255.0 FORMAT "%5.1" /end CHARACTERISTIC
/begin CHARACTERISTIC SUMODE1 "" VALUE 0x8E1607 KwUb 255.0 dez 0.00 255.0 FORMAT "%5.1" /end CHARACTERISTIC
/begin CHARACTERISTIC TASUS "" VALUE 0x8E1608 KwUb 191.3 temp_ub_q0p75_o48 -48.00 143.3 FORMAT "%5.1" /end CHARACTERISTIC
/begin CHARACTERISTIC TFTEINI "" VALUE 0x8FEF5E KwUw 6553.500 t100msxs_uw_b6553p5 0.00 6553.500 FORMAT "%8.3" /end CHARACTERISTIC
/begin CHARACTERISTIC TKATTKAMN "" VALUE 0x8E2909 KwUb 1275. temp_ub_q5_o50 -50.00 1225. FORMAT "%5.0" /end CHARACTERISTIC
/begin CHARACTERISTIC TKATTKAMX "" VALUE 0x8E290A KwUb 1275. temp_ub_q5_o50 -50.00 1225. FORMAT "%5.0" /end CHARACTERISTIC
/begin CHARACTERISTIC TKMWLMW "" VALUE 0x8FD10F KwUb 255.0 dez 0.00 255.0 FORMAT "%5.1" /end CHARACTERISTIC
/begin CHARACTERISTIC TKMWLNA "" VALUE 0x8FD110 KwUb 255.0 dez 0.00 255.0 FORMAT "%5.1" /end CHARACTERISTIC
/begin CHARACTERISTIC TKMWLNW "" VALUE 0x8FD111 KwUb 255.0 dez 0.00 255.0 FORMAT "%5.1" /end CHARACTERISTIC
/begin CHARACTERISTIC TMADB0 "" VALUE 0x8FD029 KwUb 255.0 dez 0.00 255.0 FORMAT "%5.1" /end CHARACTERISTIC
/begin CHARACTERISTIC TMADB1 "" VALUE 0x8FD02A KwUb 255.0 dez 0.00 255.0 FORMAT "%5.1" /end CHARACTERISTIC
/begin CHARACTERISTIC TMADB2 "" VALUE 0x8FD02B KwUb 255.0 dez 0.00 255.0 FORMAT "%5.1" /end CHARACTERISTIC
/begin CHARACTERISTIC TMISTMN_UM "" VALUE 0x8FC168 KwUb 191.3 temp_ub_q0p75_o48 -48.00 143.3 FORMAT "%5.1" /end CHARACTERISTIC
/begin CHARACTERISTIC TMLIM "" VALUE 0x8FD02C KwUb 191.3 temp_ub_q0p75_o48 -48.00 143.3 FORMAT "%5.1" /end CHARACTERISTIC
/begin CHARACTERISTIC TMOD8TE "" VALUE 0x8E76D8 KwUw 65535.00 t1sxs_uw_q1 0.00 65535.00 FORMAT "%8.2" /end CHARACTERISTIC
/begin CHARACTERISTIC TMOTTKAMN "" VALUE 0x8E290B KwUb 191.3 temp_ub_q0p75_o48 -48.00 143.3 FORMAT "%5.1" /end CHARACTERISTIC
/begin CHARACTERISTIC TMSRUHOT "" VALUE 0x8E1609 KwUb 191.3 temp_ub_q0p75_o48 -48.00 143.3 FORMAT "%5.1" /end CHARACTERISTIC
/begin CHARACTERISTIC TMSTTE "" VALUE 0x8E3713 KwUb 191.3 temp_ub_q0p75_o48 -48.00 143.3 FORMAT "%5.1" /end CHARACTERISTIC
/begin CHARACTERISTIC TMSUS "" VALUE 0x8E160A KwUb 191.3 temp_ub_q0p75_o48 -48.00 143.3 FORMAT "%5.1" /end CHARACTERISTIC
/begin CHARACTERISTIC TMSUSV "" VALUE 0x8E160B KwUb 191.3 temp_ub_q0p75_o48 -48.00 143.3 FORMAT "%5.1" /end CHARACTERISTIC
/begin CHARACTERISTIC TMTE "" VALUE 0x8E3714 KwUb 191.3 temp_ub_q0p75_o48 -48.00 143.3 FORMAT "%5.1" /end CHARACTERISTIC
/begin CHARACTERISTIC TQTEAB "" VALUE 0x8FD27C KwUb 81.28 t20msxs_ub_q0p32 0.3200 81.60 FORMAT "%5.2" /end CHARACTERISTIC
/begin CHARACTERISTIC TQTEDAB "" VALUE 0x8FD27D KwUb 81.28 t20msxs_ub_q0p32 0.3200 81.60 FORMAT "%5.2" /end CHARACTERISTIC
/begin CHARACTERISTIC TTEAUS "" VALUE 0x8EEB40 KwUw 195.0000 t100msxs_uw_q100 5.000000 200.0000 FORMAT "%8.4" /end CHARACTERISTIC
/begin CHARACTERISTIC TTVLU1MX "" VALUE 0x8FD0CE KwUb 25.50 t10msxs_ub_b25p5 0.00 25.50 FORMAT "%5.2" /end CHARACTERISTIC
/begin CHARACTERISTIC TTVLU2MX "" VALUE 0x8FD0CF KwUb 25.50 t10msxs_ub_b25p5 0.00 25.50 FORMAT "%5.2" /end CHARACTERISTIC
/begin CHARACTERISTIC TVAGRFTE "" VALUE 0x8E3879 KwUb 25.50 t100msxs_ub_b25p5 0.00 25.50 FORMAT "%5.2" /end CHARACTERISTIC
/begin CHARACTERISTIC TVLUFA107 "" VALUE 0x8E27D7 KwUb 99.61 tv_ub_b100 0.00 99.61 FORMAT "%5.2" /end CHARACTERISTIC
/begin CHARACTERISTIC TVLUFA108 "" VALUE 0x8E27D8 KwUb 99.61 tv_ub_b100 0.00 99.61 FORMAT "%5.2" /end CHARACTERISTIC
/begin CHARACTERISTIC TVLUFA109 "" VALUE 0x8E27D9 KwUb 99.61 tv_ub_b100 0.00 99.61 FORMAT "%5.2" /end CHARACTERISTIC
/begin CHARACTERISTIC TVLUFA130 "" VALUE 0x8E27DA KwUb 99.61 tv_ub_b100 0.00 99.61 FORMAT "%5.2" /end CHARACTERISTIC
/begin CHARACTERISTIC TVLUFA140 "" VALUE 0x8E27DB KwUb 99.61 tv_ub_b100 0.00 99.61 FORMAT "%5.2" /end CHARACTERISTIC
/begin CHARACTERISTIC TVLUFA145 "" VALUE 0x8E27DC KwUb 99.61 tv_ub_b100 0.00 99.61 FORMAT "%5.2" /end CHARACTERISTIC
/begin CHARACTERISTIC TVLUFA146 "" VALUE 0x8E27DD KwUb 99.61 tv_ub_b100 0.00 99.61 FORMAT "%5.2" /end CHARACTERISTIC
/begin CHARACTERISTIC TVLUFA147 "" VALUE 0x8E27DE KwUb 99.61 tv_ub_b100 0.00 99.61 FORMAT "%5.2" /end CHARACTERISTIC
/begin CHARACTERISTIC TVLUFA148 "" VALUE 0x8E27DF KwUb 99.61 tv_ub_b100 0.00 99.61 FORMAT "%5.2" /end CHARACTERISTIC
/begin CHARACTERISTIC TVLUFA149 "" VALUE 0x8E27E0 KwUb 99.61 tv_ub_b100 0.00 99.61 FORMAT "%5.2" /end CHARACTERISTIC
/begin CHARACTERISTIC TVLUFA152 "" VALUE 0x8E27E1 KwUb 99.61 tv_ub_b100 0.00 99.61 FORMAT "%5.2" /end CHARACTERISTIC
/begin CHARACTERISTIC TVLUFA162 "" VALUE 0x8E27E2 KwUb 99.61 tv_ub_b100 0.00 99.61 FORMAT "%5.2" /end CHARACTERISTIC
/begin CHARACTERISTIC TVLUFA163 "" VALUE 0x8E27E3 KwUb 99.61 tv_ub_b100 0.00 99.61 FORMAT "%5.2" /end CHARACTERISTIC
/begin CHARACTERISTIC TVLUFA166 "" VALUE 0x8E27E4 KwUb 99.61 tv_ub_b100 0.00 99.61 FORMAT "%5.2" /end CHARACTERISTIC
/begin CHARACTERISTIC TVLUFA167 "" VALUE 0x8E27E5 KwUb 99.61 tv_ub_b100 0.00 99.61 FORMAT "%5.2" /end CHARACTERISTIC
/begin CHARACTERISTIC TVLUFA168 "" VALUE 0x8E27E6 KwUb 99.61 tv_ub_b100 0.00 99.61 FORMAT "%5.2" /end CHARACTERISTIC
/begin CHARACTERISTIC TVLUFA187 "" VALUE 0x8E27E7 KwUb 99.61 tv_ub_b100 0.00 99.61 FORMAT "%5.2" /end CHARACTERISTIC
/begin CHARACTERISTIC TVLUFA188 "" VALUE 0x8E27E8 KwUb 99.61 tv_ub_b100 0.00 99.61 FORMAT "%5.2" /end CHARACTERISTIC
/begin CHARACTERISTIC TVLUFA189 "" VALUE 0x8E27E9 KwUb 99.61 tv_ub_b100 0.00 99.61 FORMAT "%5.2" /end CHARACTERISTIC
/begin CHARACTERISTIC TVLUFA190 "" VALUE 0x8E27EA KwUb 99.61 tv_ub_b100 0.00 99.61 FORMAT "%5.2" /end CHARACTERISTIC
/begin CHARACTERISTIC TVLUFA191 "" VALUE 0x8E27EB KwUb 99.61 tv_ub_b100 0.00 99.61 FORMAT "%5.2" /end CHARACTERISTIC
/begin CHARACTERISTIC TVLUFA192 "" VALUE 0x8E27EC KwUb 99.61 tv_ub_b100 0.00 99.61 FORMAT "%5.2" /end CHARACTERISTIC
/begin CHARACTERISTIC TVLUFA193 "" VALUE 0x8E27ED KwUb 99.61 tv_ub_b100 0.00 99.61 FORMAT "%5.2" /end CHARACTERISTIC
/begin CHARACTERISTIC TVLUFA194 "" VALUE 0x8E27EE KwUb 99.61 tv_ub_b100 0.00 99.61 FORMAT "%5.2" /end CHARACTERISTIC
/begin CHARACTERISTIC TVLUFA195 "" VALUE 0x8E27EF KwUb 99.61 tv_ub_b100 0.00 99.61 FORMAT "%5.2" /end CHARACTERISTIC
/begin CHARACTERISTIC TVLUFA196 "" VALUE 0x8E27F0 KwUb 99.61 tv_ub_b100 0.00 99.61 FORMAT "%5.2" /end CHARACTERISTIC
/begin CHARACTERISTIC TVLUFA197 "" VALUE 0x8E27F1 KwUb 99.61 tv_ub_b100 0.00 99.61 FORMAT "%5.2" /end CHARACTERISTIC
/begin CHARACTERISTIC TVLUFA198 "" VALUE 0x8E27F2 KwUb 99.61 tv_ub_b100 0.00 99.61 FORMAT "%5.2" /end CHARACTERISTIC
/begin CHARACTERISTIC TVLUFA199 "" VALUE 0x8E27F3 KwUb 99.61 tv_ub_b100 0.00 99.61 FORMAT "%5.2" /end CHARACTERISTIC
/begin CHARACTERISTIC TVLUFA201 "" VALUE 0x8E27F4 KwUb 99.61 tv_ub_b100 0.00 99.61 FORMAT "%5.2" /end CHARACTERISTIC
/begin CHARACTERISTIC TVLUFA202 "" VALUE 0x8E27F5 KwUb 99.61 tv_ub_b100 0.00 99.61 FORMAT "%5.2" /end CHARACTERISTIC
/begin CHARACTERISTIC TVLUFA203 "" VALUE 0x8E27F6 KwUb 99.61 tv_ub_b100 0.00 99.61 FORMAT "%5.2" /end CHARACTERISTIC
/begin CHARACTERISTIC TVLUFA204 "" VALUE 0x8E27F7 KwUb 99.61 tv_ub_b100 0.00 99.61 FORMAT "%5.2" /end CHARACTERISTIC
/begin CHARACTERISTIC TVLUFA205 "" VALUE 0x8E27F8 KwUb 99.61 tv_ub_b100 0.00 99.61 FORMAT "%5.2" /end CHARACTERISTIC
/begin CHARACTERISTIC TVLUFA206 "" VALUE 0x8E27F9 KwUb 99.61 tv_ub_b100 0.00 99.61 FORMAT "%5.2" /end CHARACTERISTIC
/begin CHARACTERISTIC TVLUFA207 "" VALUE 0x8E27FA KwUb 99.61 tv_ub_b100 0.00 99.61 FORMAT "%5.2" /end CHARACTERISTIC
/begin CHARACTERISTIC TVLUFA208 "" VALUE 0x8E27FB KwUb 99.61 tv_ub_b100 0.00 99.61 FORMAT "%5.2" /end CHARACTERISTIC
/begin CHARACTERISTIC TVLUFA209 "" VALUE 0x8E27FC KwUb 99.61 tv_ub_b100 0.00 99.61 FORMAT "%5.2" /end CHARACTERISTIC
/begin CHARACTERISTIC TVLUFA210 "" VALUE 0x8E27FD KwUb 99.61 tv_ub_b100 0.00 99.61 FORMAT "%5.2" /end CHARACTERISTIC
/begin CHARACTERISTIC TVLUFA211 "" VALUE 0x8E27FE KwUb 99.61 tv_ub_b100 0.00 99.61 FORMAT "%5.2" /end CHARACTERISTIC
/begin CHARACTERISTIC TVLUFA212 "" VALUE 0x8E27FF KwUb 99.61 tv_ub_b100 0.00 99.61 FORMAT "%5.2" /end CHARACTERISTIC
/begin CHARACTERISTIC TVLUFA213 "" VALUE 0x8E2800 KwUb 99.61 tv_ub_b100 0.00 99.61 FORMAT "%5.2" /end CHARACTERISTIC
/begin CHARACTERISTIC TVLUFA214 "" VALUE 0x8E2801 KwUb 99.61 tv_ub_b100 0.00 99.61 FORMAT "%5.2" /end CHARACTERISTIC
/begin CHARACTERISTIC TVLUFA215 "" VALUE 0x8E2802 KwUb 99.61 tv_ub_b100 0.00 99.61 FORMAT "%5.2" /end CHARACTERISTIC
/begin CHARACTERISTIC TVLUFA216 "" VALUE 0x8E2803 KwUb 99.61 tv_ub_b100 0.00 99.61 FORMAT "%5.2" /end CHARACTERISTIC
/begin CHARACTERISTIC TVLUFA217 "" VALUE 0x8E2804 KwUb 99.61 tv_ub_b100 0.00 99.61 FORMAT "%5.2" /end CHARACTERISTIC
/begin CHARACTERISTIC TVLUFA218 "" VALUE 0x8E2805 KwUb 99.61 tv_ub_b100 0.00 99.61 FORMAT "%5.2" /end CHARACTERISTIC
/begin CHARACTERISTIC TVLUFA219 "" VALUE 0x8E2806 KwUb 99.61 tv_ub_b100 0.00 99.61 FORMAT "%5.2" /end CHARACTERISTIC
/begin CHARACTERISTIC TVLUFA220 "" VALUE 0x8E2807 KwUb 99.61 tv_ub_b100 0.00 99.61 FORMAT "%5.2" /end CHARACTERISTIC
/begin CHARACTERISTIC TVLUFA221 "" VALUE 0x8E2808 KwUb 99.61 tv_ub_b100 0.00 99.61 FORMAT "%5.2" /end CHARACTERISTIC
/begin CHARACTERISTIC TVLUFA222 "" VALUE 0x8E2809 KwUb 99.61 tv_ub_b100 0.00 99.61 FORMAT "%5.2" /end CHARACTERISTIC
/begin CHARACTERISTIC TVLUFA223 "" VALUE 0x8E280A KwUb 99.61 tv_ub_b100 0.00 99.61 FORMAT "%5.2" /end CHARACTERISTIC
/begin CHARACTERISTIC TVLUFA224 "" VALUE 0x8E280B KwUb 99.61 tv_ub_b100 0.00 99.61 FORMAT "%5.2" /end CHARACTERISTIC
/begin CHARACTERISTIC TVLUFA225 "" VALUE 0x8E280C KwUb 99.61 tv_ub_b100 0.00 99.61 FORMAT "%5.2" /end CHARACTERISTIC
/begin CHARACTERISTIC TVLUFA226 "" VALUE 0x8E280D KwUb 99.61 tv_ub_b100 0.00 99.61 FORMAT "%5.2" /end CHARACTERISTIC
/begin CHARACTERISTIC TVLUFA227 "" VALUE 0x8E280E KwUb 99.61 tv_ub_b100 0.00 99.61 FORMAT "%5.2" /end CHARACTERISTIC
/begin CHARACTERISTIC TVLUFA228 "" VALUE 0x8E280F KwUb 99.61 tv_ub_b100 0.00 99.61 FORMAT "%5.2" /end CHARACTERISTIC
/begin CHARACTERISTIC TVLUFA229 "" VALUE 0x8E2810 KwUb 99.61 tv_ub_b100 0.00 99.61 FORMAT "%5.2" /end CHARACTERISTIC
/begin CHARACTERISTIC TVLUFA230 "" VALUE 0x8E2811 KwUb 99.61 tv_ub_b100 0.00 99.61 FORMAT "%5.2" /end CHARACTERISTIC
/begin CHARACTERISTIC TVLUFA231 "" VALUE 0x8E2812 KwUb 99.61 tv_ub_b100 0.00 99.61 FORMAT "%5.2" /end CHARACTERISTIC
/begin CHARACTERISTIC TVLUFA232 "" VALUE 0x8E2813 KwUb 99.61 tv_ub_b100 0.00 99.61 FORMAT "%5.2" /end CHARACTERISTIC
/begin CHARACTERISTIC TVLUFA233 "" VALUE 0x8E2814 KwUb 99.61 tv_ub_b100 0.00 99.61 FORMAT "%5.2" /end CHARACTERISTIC
/begin CHARACTERISTIC TVLUFA234 "" VALUE 0x8E2815 KwUb 99.61 tv_ub_b100 0.00 99.61 FORMAT "%5.2" /end CHARACTERISTIC
/begin CHARACTERISTIC TVLUFA235 "" VALUE 0x8E2816 KwUb 99.61 tv_ub_b100 0.00 99.61 FORMAT "%5.2" /end CHARACTERISTIC
/begin CHARACTERISTIC TVLUFA236 "" VALUE 0x8E2817 KwUb 99.61 tv_ub_b100 0.00 99.61 FORMAT "%5.2" /end CHARACTERISTIC
/begin CHARACTERISTIC TVLUFA237 "" VALUE 0x8E2818 KwUb 99.61 tv_ub_b100 0.00 99.61 FORMAT "%5.2" /end CHARACTERISTIC
/begin CHARACTERISTIC TVLUFA238 "" VALUE 0x8E2819 KwUb 99.61 tv_ub_b100 0.00 99.61 FORMAT "%5.2" /end CHARACTERISTIC
/begin CHARACTERISTIC TVLUFA239 "" VALUE 0x8E281A KwUb 99.61 tv_ub_b100 0.00 99.61 FORMAT "%5.2" /end CHARACTERISTIC
/begin CHARACTERISTIC TVLUFA240 "" VALUE 0x8E281B KwUb 99.61 tv_ub_b100 0.00 99.61 FORMAT "%5.2" /end CHARACTERISTIC
/begin CHARACTERISTIC TVLUFA241 "" VALUE 0x8E281C KwUb 99.61 tv_ub_b100 0.00 99.61 FORMAT "%5.2" /end CHARACTERISTIC
/begin CHARACTERISTIC TVLUFA242 "" VALUE 0x8E281D KwUb 99.61 tv_ub_b100 0.00 99.61 FORMAT "%5.2" /end CHARACTERISTIC
/begin CHARACTERISTIC TVLUFA243 "" VALUE 0x8E281E KwUb 99.61 tv_ub_b100 0.00 99.61 FORMAT "%5.2" /end CHARACTERISTIC
/begin CHARACTERISTIC TVLUFA244 "" VALUE 0x8E281F KwUb 99.61 tv_ub_b100 0.00 99.61 FORMAT "%5.2" /end CHARACTERISTIC
/begin CHARACTERISTIC TVLUFA245 "" VALUE 0x8E2820 KwUb 99.61 tv_ub_b100 0.00 99.61 FORMAT "%5.2" /end CHARACTERISTIC
/begin CHARACTERISTIC TVLUFA246 "" VALUE 0x8E2821 KwUb 99.61 tv_ub_b100 0.00 99.61 FORMAT "%5.2" /end CHARACTERISTIC
/begin CHARACTERISTIC TVLUFA247 "" VALUE 0x8E2822 KwUb 99.61 tv_ub_b100 0.00 99.61 FORMAT "%5.2" /end CHARACTERISTIC
/begin CHARACTERISTIC TVLUFA248 "" VALUE 0x8E2823 KwUb 99.61 tv_ub_b100 0.00 99.61 FORMAT "%5.2" /end CHARACTERISTIC
/begin CHARACTERISTIC TVLUFA249 "" VALUE 0x8E2824 KwUb 99.61 tv_ub_b100 0.00 99.61 FORMAT "%5.2" /end CHARACTERISTIC
/begin CHARACTERISTIC TVLUFA250 "" VALUE 0x8E2825 KwUb 99.61 tv_ub_b100 0.00 99.61 FORMAT "%5.2" /end CHARACTERISTIC
/begin CHARACTERISTIC TVLUFA251 "" VALUE 0x8E2826 KwUb 99.61 tv_ub_b100 0.00 99.61 FORMAT "%5.2" /end CHARACTERISTIC
/begin CHARACTERISTIC TVLUFA252 "" VALUE 0x8E2827 KwUb 99.61 tv_ub_b100 0.00 99.61 FORMAT "%5.2" /end CHARACTERISTIC
/begin CHARACTERISTIC TVLUFA253 "" VALUE 0x8E2828 KwUb 99.61 tv_ub_b100 0.00 99.61 FORMAT "%5.2" /end CHARACTERISTIC
/begin CHARACTERISTIC TVLUFA254 "" VALUE 0x8E2829 KwUb 99.61 tv_ub_b100 0.00 99.61 FORMAT "%5.2" /end CHARACTERISTIC
/begin CHARACTERISTIC TVLUFA255 "" VALUE 0x8E282A KwUb 99.61 tv_ub_b100 0.00 99.61 FORMAT "%5.2" /end CHARACTERISTIC
/begin CHARACTERISTIC TVLUFA28 "" VALUE 0x8E282B KwUb 99.61 tv_ub_b100 0.00 99.61 FORMAT "%5.2" /end CHARACTERISTIC
/begin CHARACTERISTIC TVLUFA34 "" VALUE 0x8E282C KwUb 99.61 tv_ub_b100 0.00 99.61 FORMAT "%5.2" /end CHARACTERISTIC
/begin CHARACTERISTIC TVLUFA35 "" VALUE 0x8E282D KwUb 99.61 tv_ub_b100 0.00 99.61 FORMAT "%5.2" /end CHARACTERISTIC
/begin CHARACTERISTIC TVLUFA36 "" VALUE 0x8E282E KwUb 99.61 tv_ub_b100 0.00 99.61 FORMAT "%5.2" /end CHARACTERISTIC
/begin CHARACTERISTIC TVLUFA37 "" VALUE 0x8E282F KwUb 99.61 tv_ub_b100 0.00 99.61 FORMAT "%5.2" /end CHARACTERISTIC
/begin CHARACTERISTIC TVLUFA38 "" VALUE 0x8E2830 KwUb 99.61 tv_ub_b100 0.00 99.61 FORMAT "%5.2" /end CHARACTERISTIC
/begin CHARACTERISTIC TVLUFA39 "" VALUE 0x8E2831 KwUb 99.61 tv_ub_b100 0.00 99.61 FORMAT "%5.2" /end CHARACTERISTIC
/begin CHARACTERISTIC TVLUFA43 "" VALUE 0x8E2832 KwUb 99.61 tv_ub_b100 0.00 99.61 FORMAT "%5.2" /end CHARACTERISTIC
/begin CHARACTERISTIC TVLUFA44 "" VALUE 0x8E2833 KwUb 99.61 tv_ub_b100 0.00 99.61 FORMAT "%5.2" /end CHARACTERISTIC
/begin CHARACTERISTIC TVLUFA46 "" VALUE 0x8E2834 KwUb 99.61 tv_ub_b100 0.00 99.61 FORMAT "%5.2" /end CHARACTERISTIC
/begin CHARACTERISTIC TVLUFA47 "" VALUE 0x8E2835 KwUb 99.61 tv_ub_b100 0.00 99.61 FORMAT "%5.2" /end CHARACTERISTIC
/begin CHARACTERISTIC TVLUFA48 "" VALUE 0x8E2836 KwUb 99.61 tv_ub_b100 0.00 99.61 FORMAT "%5.2" /end CHARACTERISTIC
/begin CHARACTERISTIC TVLUFA49 "" VALUE 0x8E2837 KwUb 99.61 tv_ub_b100 0.00 99.61 FORMAT "%5.2" /end CHARACTERISTIC
/begin CHARACTERISTIC TVLUFA70 "" VALUE 0x8E2838 KwUb 99.61 tv_ub_b100 0.00 99.61 FORMAT "%5.2" /end CHARACTERISTIC
/begin CHARACTERISTIC TVLUFA71 "" VALUE 0x8E2839 KwUb 99.61 tv_ub_b100 0.00 99.61 FORMAT "%5.2" /end CHARACTERISTIC
/begin CHARACTERISTIC TVLUFA72 "" VALUE 0x8E283A KwUb 99.61 tv_ub_b100 0.00 99.61 FORMAT "%5.2" /end CHARACTERISTIC
/begin CHARACTERISTIC TVLUFA75 "" VALUE 0x8E283B KwUb 99.61 tv_ub_b100 0.00 99.61 FORMAT "%5.2" /end CHARACTERISTIC
/begin CHARACTERISTIC TVLUFA77 "" VALUE 0x8E283C KwUb 99.61 tv_ub_b100 0.00 99.61 FORMAT "%5.2" /end CHARACTERISTIC
/begin CHARACTERISTIC TVLUFA78 "" VALUE 0x8E283D KwUb 99.61 tv_ub_b100 0.00 99.61 FORMAT "%5.2" /end CHARACTERISTIC
/begin CHARACTERISTIC TVLUFA94 "" VALUE 0x8E283E KwUb 99.61 tv_ub_b100 0.00 99.61 FORMAT "%5.2" /end CHARACTERISTIC
/begin CHARACTERISTIC TVLUFA96 "" VALUE 0x8E283F KwUb 99.61 tv_ub_b100 0.00 99.61 FORMAT "%5.2" /end CHARACTERISTIC
/begin CHARACTERISTIC TVSATEM "" CURVE 0x8E3893 KlAUbSstUbWUb 5.100 t20msxs_ub_b5p1 0.00 5.100 FORMAT "%5.3"
 /begin AXIS_DESCR STD_AXIS tmot temp_ub_q0p75_o48 6 -48.00 143.3 FORMAT "%5.1" DEPOSIT ABSOLUTE /end AXIS_DESCR
/end CHARACTERISTIC
/begin CHARACTERISTIC TVSU "" VALUE 0x8E160C KwUb 5.100 t20msxs_ub_b5p1 0.00 5.100 FORMAT "%5.3" /end CHARACTERISTIC
/begin CHARACTERISTIC TVSUAN "" VALUE 0x8E160D KwUb 12.75 t50msxs_q0p05 0.00 12.75 FORMAT "%5.2" /end CHARACTERISTIC
/begin CHARACTERISTIC TVSUM "" CURVE 0x8E160E KlAUbSstUbWUb 25.50 t100msxs_ub_b25p5 0.00 25.50 FORMAT "%5.2"
 /begin AXIS_DESCR STD_AXIS tmot temp_ub_q0p75_o48 6 -48.00 143.3 FORMAT "%5.1" DEPOSIT ABSOLUTE /end AXIS_DESCR
/end CHARACTERISTIC
/begin CHARACTERISTIC TVSUNA "" VALUE 0x8E161B KwUb 12.75 t50msxs_q0p05 0.00 12.75 FORMAT "%5.2" /end CHARACTERISTIC
/begin CHARACTERISTIC TVSUST "" VALUE 0x8EA198 KwUw 655.3500 t10msxs_uw_b655p35 0.00 655.3500 FORMAT "%8.4" /end CHARACTERISTIC
/begin CHARACTERISTIC UBKST "" VALUE 0x8FD02D KwUb 17.95 spg_ubatt 0.00 17.95 FORMAT "%5.2" /end CHARACTERISTIC
/begin CHARACTERISTIC UBKSTMX "" VALUE 0x8FD02E KwUb 255.0 dez 0.00 255.0 FORMAT "%5.1" /end CHARACTERISTIC
/begin CHARACTERISTIC VARDEF "" VALUE 0x8FE946 KwUw 32767.00 dez 0.00 32767.00 FORMAT "%8.2" /end CHARACTERISTIC
/begin CHARACTERISTIC VMINACC_UM "" VALUE 0x8FC3C8 KwUw 511.9922 vfzg_uw_b512 0.00 511.9922 FORMAT "%8.4" /end CHARACTERISTIC
/begin CHARACTERISTIC VMIN_UM "" VALUE 0x8FC3CA KwUw 511.9922 vfzg_uw_b512 0.00 511.9922 FORMAT "%8.4" /end CHARACTERISTIC
/begin CHARACTERISTIC VVR_AOG "" VALUE 0x8FD112 KwSb 255.0 vfzg_q1p0 -128.0 127.0 FORMAT "%5.1" /end CHARACTERISTIC
/begin CHARACTERISTIC VVR_AUG "" VALUE 0x8FD113 KwSb 255.0 vfzg_q1p0 -128.0 127.0 FORMAT "%5.1" /end CHARACTERISTIC
/begin CHARACTERISTIC WAD0T1 "" VALUE 0x8FD02F KwUb 15.94 fak_ub_b16 0.00 15.94 FORMAT "%5.2" /end CHARACTERISTIC
/begin CHARACTERISTIC WAD0T2 "" VALUE 0x8FD030 KwUb 15.94 fak_ub_b16 0.00 15.94 FORMAT "%5.2" /end CHARACTERISTIC
/begin CHARACTERISTIC WAD1T0 "" VALUE 0x8FD031 KwUb 15.94 fak_ub_b16 0.00 15.94 FORMAT "%5.2" /end CHARACTERISTIC
/begin CHARACTERISTIC WAD1T2 "" VALUE 0x8FD032 KwUb 15.94 fak_ub_b16 0.00 15.94 FORMAT "%5.2" /end CHARACTERISTIC
/begin CHARACTERISTIC WAD2T0 "" VALUE 0x8FD033 KwUb 15.94 fak_ub_b16 0.00 15.94 FORMAT "%5.2" /end CHARACTERISTIC
/begin CHARACTERISTIC WAD2T1 "" VALUE 0x8FD034 KwUb 15.94 fak_ub_b16 0.00 15.94 FORMAT "%5.2" /end CHARACTERISTIC
/begin CHARACTERISTIC ZBTEML "" CURVE 0x8E387A GklWUb 6.101 perio_ub_b6p125 0.00 6.101 FORMAT "%5.3"
 /begin AXIS_DESCR COM_AXIS ml m_ub_b1020 6 0.00 1020. FORMAT "%5.0" AXIS_PTS_REF SML06TEUB /end AXIS_DESCR
/end CHARACTERISTIC
/begin CHARACTERISTIC ZBURNABR "" VALUE 0x8FD035 KwUb 255.0 dez 0.00 255.0 FORMAT "%5.1" /end CHARACTERISTIC
/begin CHARACTERISTIC ZBURNDEC "" VALUE 0x8FD036 KwUb 255.0 dez 0.00 255.0 FORMAT "%5.1" /end CHARACTERISTIC
/begin CHARACTERISTIC ZBURNSOL "" VALUE 0x8FD037 KwUb 255.0 dez 0.00 255.0 FORMAT "%5.1" /end CHARACTERISTIC
/begin CHARACTERISTIC ZETATE "" VALUE 0x8EEBAC KwUw 1279.590 rgrad_uw_b1280 0.3906250 1279.980 FORMAT "%8.3" /end CHARACTERISTIC
/begin CHARACTERISTIC ZKFTEAD "" VALUE 0x8EEBAE KwUw 6553.4999985 zk100msxs_uw_b6553 0.10000152590 6553.6000000 FORMAT "%12.7" /end CHARACTERISTIC
/begin CHARACTERISTIC ZMLTE "" VALUE 0x8EEBB0 KwUw 6553.4999985 zk100msxs_uw_b655 0.10000152590 6553.6000000 FORMAT "%12.7" /end CHARACTERISTIC
/begin CHARACTERISTIC ZMSSGIN "" VALUE 0x8E3880 KwUb 25.4996 zk100msxs_ub_b25p5 0.100392 25.6000 FORMAT "%7.4" /end CHARACTERISTIC
/begin CHARACTERISTIC ZNGFILSU "" VALUE 0x8EA19A KwUw 1310.6999997 zk20msxs_uw_b1310 0.020000305180 1310.7200000 FORMAT "%12.7" /end CHARACTERISTIC
/begin CHARACTERISTIC ZSYNABR "" VALUE 0x8FD038 KwUb 255.0 dez 0.00 255.0 FORMAT "%5.1" /end CHARACTERISTIC
/begin CHARACTERISTIC ZSYNAUSW "" VALUE 0x8FD039 KwUb 255.0 dez 0.00 255.0 FORMAT "%5.1" /end CHARACTERISTIC
/begin CHARACTERISTIC ZSYNDEL "" VALUE 0x8FD03A KwUb 255.0 dez 0.00 255.0 FORMAT "%5.1" /end CHARACTERISTIC
/begin MEASUREMENT actuatorCtr "" UBYTE undefined 1 100 0.00 255.0 FORMAT "%5.1" ECU_ADDRESS 0xF0ACA /end MEASUREMENT
/begin MEASUREMENT actuatorTimeout_ctr "" UBYTE undefined 1 100 0.00 255.0 FORMAT "%5.1" ECU_ADDRESS 0xF0ACB /end MEASUREMENT
/begin MEASUREMENT adastep "" SBYTE fak_sb_b1 1 100 -1.000 0.9922 FORMAT "%5.3" ECU_ADDRESS 0xF08EE /end MEASUREMENT
/begin MEASUREMENT arqtgls2_w "" UWORD rel_uw_b100 1 100 0.00 99.99847 FORMAT "%8.5" ECU_ADDRESS 0xF472A /end MEASUREMENT
/begin MEASUREMENT arqtglst_w "" UWORD rel_uw_b100 1 100 0.00 99.99847 FORMAT "%8.5" ECU_ADDRESS 0xF472C /end MEASUREMENT
/begin MEASUREMENT arqtmos2_w "" UWORD rel_uw_b100 1 100 0.00 99.99847 FORMAT "%8.5" ECU_ADDRESS 0xF472E /end MEASUREMENT
/begin MEASUREMENT arqtmost_w "" UWORD rel_uw_b100 1 100 0.00 99.99847 FORMAT "%8.5" ECU_ADDRESS 0xF4730 /end MEASUREMENT
/begin MEASUREMENT b2gra_um "" UBYTE dez 1 100 0.00 255.0 FORMAT "%5.1" ECU_ADDRESS 0x38000D /end MEASUREMENT
/begin MEASUREMENT b3gra_um "" UBYTE dez 1 100 0.00 255.0 FORMAT "%5.1" ECU_ADDRESS 0x38000E /end MEASUREMENT
/begin MEASUREMENT bfgrsbr "" UBYTE bfgrsc_ub_q0p024_o3p984 1 100 -3.984 2.136 FORMAT "%5.3" ECU_ADDRESS 0xF05C9 /end MEASUREMENT
/begin MEASUREMENT bgCtr "" UWORD dez 1 100 0.00 65535.00 FORMAT "%8.2" ECU_ADDRESS 0xF41FA /end MEASUREMENT
/begin MEASUREMENT bgra_c_um "" UBYTE t_q0p04 1 100 0.00 10.20 FORMAT "%5.2" ECU_ADDRESS 0x38000F /end MEASUREMENT
/begin MEASUREMENT bracc_c_um "" UBYTE t_q0p04 1 100 0.00 10.20 FORMAT "%5.2" ECU_ADDRESS 0x380010 /end MEASUREMENT
/begin MEASUREMENT brems_c_um "" UBYTE t_q0p04 1 100 0.00 10.20 FORMAT "%5.2" ECU_ADDRESS 0x380011 /end MEASUREMENT
/begin MEASUREMENT bresp_c_um "" UBYTE t_q0p04 1 100 0.00 10.20 FORMAT "%5.2" ECU_ADDRESS 0x380012 /end MEASUREMENT
/begin MEASUREMENT bzgra_a_um "" UBYTE dez 1 100 0.00 255.0 FORMAT "%5.1" ECU_ADDRESS 0x380013 /end MEASUREMENT
/begin MEASUREMENT bzgra_c_um "" UBYTE t_q0p04 1 100 0.00 10.20 FORMAT "%5.2" ECU_ADDRESS 0x380014 /end MEASUREMENT
/begin MEASUREMENT bzmsr_a_um "" UBYTE dez 1 100 0.00 255.0 FORMAT "%5.1" ECU_ADDRESS 0x38003B /end MEASUREMENT
/begin MEASUREMENT bzmsr_c_um "" UBYTE t40ms_ub_b10200 1 100 0.00 10200.0 FORMAT "%7.1" ECU_ADDRESS 0x38003C /end MEASUREMENT
/begin MEASUREMENT B_aagsg "" UBYTE B_TRUE 1 100 0.00 1.00000000000 BIT_MASK 0x8 FORMAT "%13.11" ECU_ADDRESS 0x384026 /end MEASUREMENT
/begin MEASUREMENT B_acc "" UWORD B_TRUE 1 100 0.00 1.00000000000 BIT_MASK 0x1000 FORMAT "%13.11" ECU_ADDRESS 0xFD94 /end MEASUREMENT
/begin MEASUREMENT B_accen "" UWORD B_TRUE 1 100 0.00 1.00000000000 BIT_MASK 0x1000 FORMAT "%13.11" ECU_ADDRESS 0xFD98 /end MEASUREMENT
/begin MEASUREMENT b_actuator "" UBYTE undefined 1 100 0.00 255.0 FORMAT "%5.1" ECU_ADDRESS 0xF0ACC /end MEASUREMENT
/begin MEASUREMENT B_ad "" UWORD B_TRUE 1 100 0.00 1.00000000000 BIT_MASK 0x1 FORMAT "%13.11" ECU_ADDRESS 0xF4662 /end MEASUREMENT
/begin MEASUREMENT B_adb0 "" UWORD B_TRUE 1 100 0.00 1.00000000000 BIT_MASK 0x2 FORMAT "%13.11" ECU_ADDRESS 0xF4662 /end MEASUREMENT
/begin MEASUREMENT B_adb1 "" UWORD B_TRUE 1 100 0.00 1.00000000000 BIT_MASK 0x4 FORMAT "%13.11" ECU_ADDRESS 0xF4662 /end MEASUREMENT
/begin MEASUREMENT B_adb2 "" UWORD B_TRUE 1 100 0.00 1.00000000000 BIT_MASK 0x8 FORMAT "%13.11" ECU_ADDRESS 0xF4662 /end MEASUREMENT
/begin MEASUREMENT B_adlck "" UWORD B_TRUE 1 100 0.00 1.00000000000 BIT_MASK 0x10 FORMAT "%13.11" ECU_ADDRESS 0xF4662 /end MEASUREMENT
/begin MEASUREMENT B_agrlrasp "" UWORD B_TRUE 1 100 0.00 1.00000000000 BIT_MASK 0x8000 FORMAT "%13.11" ECU_ADDRESS 0xFD10 /end MEASUREMENT
/begin MEASUREMENT B_agrste "" UWORD B_TRUE 1 100 0.00 1.00000000000 BIT_MASK 0x4 FORMAT "%13.11" ECU_ADDRESS 0xFDBA /end MEASUREMENT
/begin MEASUREMENT B_asc_reg "" UWORD B_TRUE 1 100 0.00 1.00000000000 BIT_MASK 0x1 FORMAT "%13.11" ECU_ADDRESS 0xFD12 /end MEASUREMENT
/begin MEASUREMENT B_asm "" UWORD B_TRUE 1 100 0.00 1.00000000000 BIT_MASK 0x2 FORMAT "%13.11" ECU_ADDRESS 0xFD12 /end MEASUREMENT
/begin MEASUREMENT B_atmng "" UWORD B_TRUE 1 100 0.00 1.00000000000 BIT_MASK 0x4 FORMAT "%13.11" ECU_ADDRESS 0xFD12 /end MEASUREMENT
/begin MEASUREMENT B_ausw "" UWORD B_TRUE 1 100 0.00 1.00000000000 BIT_MASK 0x20 FORMAT "%13.11" ECU_ADDRESS 0xF4662 /end MEASUREMENT
/begin MEASUREMENT B_bgrae_um "" UWORD B_TRUE 1 100 0.00 1.00000000000 BIT_MASK 0x1000 FORMAT "%13.11" ECU_ADDRESS 0xFD08 /end MEASUREMENT
/begin MEASUREMENT B_blkfb "" UWORD B_TRUE 1 100 0.00 1.00000000000 BIT_MASK 0x8 FORMAT "%13.11" ECU_ADDRESS 0xFD12 /end MEASUREMENT
/begin MEASUREMENT B_burn "" UWORD B_TRUE 1 100 0.00 1.00000000000 BIT_MASK 0x40 FORMAT "%13.11" ECU_ADDRESS 0xFD76 /end MEASUREMENT
/begin MEASUREMENT B_bzsync "" UWORD B_TRUE 1 100 0.00 1.00000000000 BIT_MASK 0x200 FORMAT "%13.11" ECU_ADDRESS 0xFD0E /end MEASUREMENT
/begin MEASUREMENT B_craus "" UWORD B_TRUE 1 100 0.00 1.00000000000 BIT_MASK 0x2000 FORMAT "%13.11" ECU_ADDRESS 0xFD98 /end MEASUREMENT
/begin MEASUREMENT B_ddkds "" UWORD B_TRUE 1 100 0.00 1.00000000000 BIT_MASK 0x10 FORMAT "%13.11" ECU_ADDRESS 0xFD12 /end MEASUREMENT
/begin MEASUREMENT B_decr "" UWORD B_TRUE 1 100 0.00 1.00000000000 BIT_MASK 0x40 FORMAT "%13.11" ECU_ADDRESS 0xF4662 /end MEASUREMENT
/begin MEASUREMENT B_dktb "" UWORD B_TRUE 1 100 0.00 1.00000000000 BIT_MASK 0x20 FORMAT "%13.11" ECU_ADDRESS 0xFD12 /end MEASUREMENT
/begin MEASUREMENT B_dkuevab "" UWORD B_TRUE 1 100 0.00 1.00000000000 BIT_MASK 0x40 FORMAT "%13.11" ECU_ADDRESS 0xFD12 /end MEASUREMENT
/begin MEASUREMENT B_dldpte "" UWORD B_TRUE 1 100 0.00 1.00000000000 BIT_MASK 0x80 FORMAT "%13.11" ECU_ADDRESS 0xFD12 /end MEASUREMENT
/begin MEASUREMENT B_dmmtev "" UWORD B_TRUE 1 100 0.00 1.00000000000 BIT_MASK 0x100 FORMAT "%13.11" ECU_ADDRESS 0xFD12 /end MEASUREMENT
/begin MEASUREMENT B_dmtltz "" UWORD B_TRUE 1 100 0.00 1.00000000000 BIT_MASK 0x200 FORMAT "%13.11" ECU_ADDRESS 0xFD12 /end MEASUREMENT
/begin MEASUREMENT B_dteabum "" UWORD B_TRUE 1 100 0.00 1.00000000000 BIT_MASK 0x400 FORMAT "%13.11" ECU_ADDRESS 0xFD12 /end MEASUREMENT
/begin MEASUREMENT B_dteikanm "" UWORD B_TRUE 1 100 0.00 1.00000000000 BIT_MASK 0x800 FORMAT "%13.11" ECU_ADDRESS 0xFD12 /end MEASUREMENT
/begin MEASUREMENT B_dtevto "" UWORD B_TRUE 1 100 0.00 1.00000000000 BIT_MASK 0x1000 FORMAT "%13.11" ECU_ADDRESS 0xFD12 /end MEASUREMENT
/begin MEASUREMENT B_dtezamh "" UWORD B_TRUE 1 100 0.00 1.00000000000 BIT_MASK 0x2000 FORMAT "%13.11" ECU_ADDRESS 0xFD12 /end MEASUREMENT
/begin MEASUREMENT B_elsu "" UWORD B_TRUE 1 100 0.00 1.00000000000 BIT_MASK 0x4000 FORMAT "%13.11" ECU_ADDRESS 0xFD12 /end MEASUREMENT
/begin MEASUREMENT B_elsu2 "" UWORD B_TRUE 1 100 0.00 1.00000000000 BIT_MASK 0x8000 FORMAT "%13.11" ECU_ADDRESS 0xFD12 /end MEASUREMENT
/begin MEASUREMENT B_EV_Test "" UWORD B_TRUE 1 100 0.00 1.00000000000 BIT_MASK 0x200 FORMAT "%13.11" ECU_ADDRESS 0xFD94 /end MEASUREMENT
/begin MEASUREMENT B_fa "" UWORD B_TRUE 1 100 0.00 1.00000000000 BIT_MASK 0x2000 FORMAT "%13.11" ECU_ADDRESS 0xFD94 /end MEASUREMENT
/begin MEASUREMENT B_faa "" UWORD B_TRUE 1 100 0.00 1.00000000000 BIT_MASK 0x4000 FORMAT "%13.11" ECU_ADDRESS 0xFD98 /end MEASUREMENT
/begin MEASUREMENT B_faagr "" UWORD B_TRUE 1 100 0.00 1.00000000000 BIT_MASK 0x8000 FORMAT "%13.11" ECU_ADDRESS 0xFD98 /end MEASUREMENT
/begin MEASUREMENT B_faam "" UWORD B_TRUE 1 100 0.00 1.00000000000 BIT_MASK 0x1 FORMAT "%13.11" ECU_ADDRESS 0xFD9A /end MEASUREMENT
/begin MEASUREMENT B_faan "" UWORD B_TRUE 1 100 0.00 1.00000000000 BIT_MASK 0x2 FORMAT "%13.11" ECU_ADDRESS 0xFD9A /end MEASUREMENT
/begin MEASUREMENT B_faatm "" UWORD B_TRUE 1 100 0.00 1.00000000000 BIT_MASK 0x4 FORMAT "%13.11" ECU_ADDRESS 0xFD9A /end MEASUREMENT
/begin MEASUREMENT B_fabks "" UWORD B_TRUE 1 100 0.00 1.00000000000 BIT_MASK 0x4000 FORMAT "%13.11" ECU_ADDRESS 0xFD94 /end MEASUREMENT
/begin MEASUREMENT B_fabkv "" UWORD B_TRUE 1 100 0.00 1.00000000000 BIT_MASK 0x8 FORMAT "%13.11" ECU_ADDRESS 0xFD9A /end MEASUREMENT
/begin MEASUREMENT B_fadesu "" UWORD B_TRUE 1 100 0.00 1.00000000000 BIT_MASK 0x8000 FORMAT "%13.11" ECU_ADDRESS 0xFD94 /end MEASUREMENT
/begin MEASUREMENT B_fadylsu "" UWORD B_TRUE 1 100 0.00 1.00000000000 BIT_MASK 0x1 FORMAT "%13.11" ECU_ADDRESS 0xFD96 /end MEASUREMENT
/begin MEASUREMENT B_fadylsu2 "" UWORD B_TRUE 1 100 0.00 1.00000000000 BIT_MASK 0x2 FORMAT "%13.11" ECU_ADDRESS 0xFD96 /end MEASUREMENT
/begin MEASUREMENT B_faevz "" UWORD B_TRUE 1 100 0.00 1.00000000000 BIT_MASK 0x4 FORMAT "%13.11" ECU_ADDRESS 0xFD96 /end MEASUREMENT
/begin MEASUREMENT B_faezla "" UWORD B_TRUE 1 100 0.00 1.00000000000 BIT_MASK 0x10 FORMAT "%13.11" ECU_ADDRESS 0xFD9A /end MEASUREMENT
/begin MEASUREMENT B_fafrst "" UWORD B_TRUE 1 100 0.00 1.00000000000 BIT_MASK 0x8 FORMAT "%13.11" ECU_ADDRESS 0xFD96 /end MEASUREMENT
/begin MEASUREMENT B_fahsh "" UWORD B_TRUE 1 100 0.00 1.00000000000 BIT_MASK 0x10 FORMAT "%13.11" ECU_ADDRESS 0xFD96 /end MEASUREMENT
/begin MEASUREMENT B_faiumpr "" UWORD B_TRUE 1 100 0.00 1.00000000000 BIT_MASK 0x20 FORMAT "%13.11" ECU_ADDRESS 0xFD96 /end MEASUREMENT
/begin MEASUREMENT B_fakat "" UWORD B_TRUE 1 100 0.00 1.00000000000 BIT_MASK 0x20 FORMAT "%13.11" ECU_ADDRESS 0xFD9A /end MEASUREMENT
/begin MEASUREMENT B_fakat2 "" UWORD B_TRUE 1 100 0.00 1.00000000000 BIT_MASK 0x40 FORMAT "%13.11" ECU_ADDRESS 0xFD9A /end MEASUREMENT
/begin MEASUREMENT B_fakd "" UWORD B_TRUE 1 100 0.00 1.00000000000 BIT_MASK 0x80 FORMAT "%13.11" ECU_ADDRESS 0xFD9A /end MEASUREMENT
/begin MEASUREMENT B_fakmtr "" UWORD B_TRUE 1 100 0.00 1.00000000000 BIT_MASK 0x40 FORMAT "%13.11" ECU_ADDRESS 0xFD96 /end MEASUREMENT
/begin MEASUREMENT B_fakrs "" UWORD B_TRUE 1 100 0.00 1.00000000000 BIT_MASK 0x100 FORMAT "%13.11" ECU_ADDRESS 0xFD9A /end MEASUREMENT
/begin MEASUREMENT B_fakth "" UWORD B_TRUE 1 100 0.00 1.00000000000 BIT_MASK 0x80 FORMAT "%13.11" ECU_ADDRESS 0xFD96 /end MEASUREMENT
/begin MEASUREMENT B_fakth2 "" UWORD B_TRUE 1 100 0.00 1.00000000000 BIT_MASK 0x100 FORMAT "%13.11" ECU_ADDRESS 0xFD96 /end MEASUREMENT
/begin MEASUREMENT B_fakvs "" UWORD B_TRUE 1 100 0.00 1.00000000000 BIT_MASK 0x200 FORMAT "%13.11" ECU_ADDRESS 0xFD9A /end MEASUREMENT
/begin MEASUREMENT B_falbk "" UWORD B_TRUE 1 100 0.00 1.00000000000 BIT_MASK 0x400 FORMAT "%13.11" ECU_ADDRESS 0xFD9A /end MEASUREMENT
/begin MEASUREMENT B_faldp "" UWORD B_TRUE 1 100 0.00 1.00000000000 BIT_MASK 0x800 FORMAT "%13.11" ECU_ADDRESS 0xFD9A /end MEASUREMENT
/begin MEASUREMENT B_falr "" UWORD B_TRUE 1 100 0.00 1.00000000000 BIT_MASK 0x1000 FORMAT "%13.11" ECU_ADDRESS 0xFD9A /end MEASUREMENT
/begin MEASUREMENT B_falra "" UWORD B_TRUE 1 100 0.00 1.00000000000 BIT_MASK 0x200 FORMAT "%13.11" ECU_ADDRESS 0xFD96 /end MEASUREMENT
/begin MEASUREMENT B_falrsfk "" UWORD B_TRUE 1 100 0.00 1.00000000000 BIT_MASK 0x400 FORMAT "%13.11" ECU_ADDRESS 0xFD96 /end MEASUREMENT
/begin MEASUREMENT B_falrshk "" UWORD B_TRUE 1 100 0.00 1.00000000000 BIT_MASK 0x2000 FORMAT "%13.11" ECU_ADDRESS 0xFD9A /end MEASUREMENT
/begin MEASUREMENT B_falrshk2 "" UWORD B_TRUE 1 100 0.00 1.00000000000 BIT_MASK 0x4000 FORMAT "%13.11" ECU_ADDRESS 0xFD9A /end MEASUREMENT
/begin MEASUREMENT B_falsf "" UWORD B_TRUE 1 100 0.00 1.00000000000 BIT_MASK 0x800 FORMAT "%13.11" ECU_ADDRESS 0xFD96 /end MEASUREMENT
/begin MEASUREMENT B_falsf2 "" UWORD B_TRUE 1 100 0.00 1.00000000000 BIT_MASK 0x1000 FORMAT "%13.11" ECU_ADDRESS 0xFD96 /end MEASUREMENT
/begin MEASUREMENT B_falsfhv "" UWORD B_TRUE 1 100 0.00 1.00000000000 BIT_MASK 0x2000 FORMAT "%13.11" ECU_ADDRESS 0xFD96 /end MEASUREMENT
/begin MEASUREMENT B_falsfhv2 "" UWORD B_TRUE 1 100 0.00 1.00000000000 BIT_MASK 0x4000 FORMAT "%13.11" ECU_ADDRESS 0xFD96 /end MEASUREMENT
/begin MEASUREMENT B_falsh "" UWORD B_TRUE 1 100 0.00 1.00000000000 BIT_MASK 0x8000 FORMAT "%13.11" ECU_ADDRESS 0xFD9A /end MEASUREMENT
/begin MEASUREMENT B_falsh2 "" UWORD B_TRUE 1 100 0.00 1.00000000000 BIT_MASK 0x1 FORMAT "%13.11" ECU_ADDRESS 0xFD9C /end MEASUREMENT
/begin MEASUREMENT B_falshv "" UWORD B_TRUE 1 100 0.00 1.00000000000 BIT_MASK 0x2 FORMAT "%13.11" ECU_ADDRESS 0xFD9C /end MEASUREMENT
/begin MEASUREMENT B_falsv "" UWORD B_TRUE 1 100 0.00 1.00000000000 BIT_MASK 0x4 FORMAT "%13.11" ECU_ADDRESS 0xFD9C /end MEASUREMENT
/begin MEASUREMENT B_falsv2 "" UWORD B_TRUE 1 100 0.00 1.00000000000 BIT_MASK 0x8 FORMAT "%13.11" ECU_ADDRESS 0xFD9C /end MEASUREMENT
/begin MEASUREMENT B_falues "" UWORD B_TRUE 1 100 0.00 1.00000000000 BIT_MASK 0x8000 FORMAT "%13.11" ECU_ADDRESS 0xFD96 /end MEASUREMENT
/begin MEASUREMENT B_falzsr "" UWORD B_TRUE 1 100 0.00 1.00000000000 BIT_MASK 0x1 FORMAT "%13.11" ECU_ADDRESS 0xFD98 /end MEASUREMENT
/begin MEASUREMENT B_fan "" UWORD B_TRUE 1 100 0.00 1.00000000000 BIT_MASK 0x10 FORMAT "%13.11" ECU_ADDRESS 0xFD9C /end MEASUREMENT
/begin MEASUREMENT B_fanohk "" UWORD B_TRUE 1 100 0.00 1.00000000000 BIT_MASK 0x2 FORMAT "%13.11" ECU_ADDRESS 0xFD98 /end MEASUREMENT
/begin MEASUREMENT B_fanwkw "" UWORD B_TRUE 1 100 0.00 1.00000000000 BIT_MASK 0x4 FORMAT "%13.11" ECU_ADDRESS 0xFD98 /end MEASUREMENT
/begin MEASUREMENT B_fanwkwa "" UWORD B_TRUE 1 100 0.00 1.00000000000 BIT_MASK 0x8 FORMAT "%13.11" ECU_ADDRESS 0xFD98 /end MEASUREMENT
/begin MEASUREMENT B_fanwkwe "" UWORD B_TRUE 1 100 0.00 1.00000000000 BIT_MASK 0x20 FORMAT "%13.11" ECU_ADDRESS 0xFD9C /end MEASUREMENT
/begin MEASUREMENT B_fanws "" UWORD B_TRUE 1 100 0.00 1.00000000000 BIT_MASK 0x40 FORMAT "%13.11" ECU_ADDRESS 0xFD9C /end MEASUREMENT
/begin MEASUREMENT B_fanwsa "" UWORD B_TRUE 1 100 0.00 1.00000000000 BIT_MASK 0x80 FORMAT "%13.11" ECU_ADDRESS 0xFD9C /end MEASUREMENT
/begin MEASUREMENT B_fanwse "" UWORD B_TRUE 1 100 0.00 1.00000000000 BIT_MASK 0x100 FORMAT "%13.11" ECU_ADDRESS 0xFD9C /end MEASUREMENT
/begin MEASUREMENT B_fapllsu "" UWORD B_TRUE 1 100 0.00 1.00000000000 BIT_MASK 0x10 FORMAT "%13.11" ECU_ADDRESS 0xFD98 /end MEASUREMENT
/begin MEASUREMENT B_fapllsu2 "" UWORD B_TRUE 1 100 0.00 1.00000000000 BIT_MASK 0x20 FORMAT "%13.11" ECU_ADDRESS 0xFD98 /end MEASUREMENT
/begin MEASUREMENT B_fasalsu "" UWORD B_TRUE 1 100 0.00 1.00000000000 BIT_MASK 0x40 FORMAT "%13.11" ECU_ADDRESS 0xFD98 /end MEASUREMENT
/begin MEASUREMENT B_fasf "" UWORD B_TRUE 1 100 0.00 1.00000000000 BIT_MASK 0x80 FORMAT "%13.11" ECU_ADDRESS 0xFD98 /end MEASUREMENT
/begin MEASUREMENT B_fasf2 "" UWORD B_TRUE 1 100 0.00 1.00000000000 BIT_MASK 0x100 FORMAT "%13.11" ECU_ADDRESS 0xFD98 /end MEASUREMENT
/begin MEASUREMENT B_fash "" UWORD B_TRUE 1 100 0.00 1.00000000000 BIT_MASK 0x200 FORMAT "%13.11" ECU_ADDRESS 0xFD9C /end MEASUREMENT
/begin MEASUREMENT B_fash2 "" UWORD B_TRUE 1 100 0.00 1.00000000000 BIT_MASK 0x400 FORMAT "%13.11" ECU_ADDRESS 0xFD9C /end MEASUREMENT
/begin MEASUREMENT B_fasls "" UWORD B_TRUE 1 100 0.00 1.00000000000 BIT_MASK 0x800 FORMAT "%13.11" ECU_ADDRESS 0xFD9C /end MEASUREMENT
/begin MEASUREMENT B_fates "" UWORD B_TRUE 1 100 0.00 1.00000000000 BIT_MASK 0x1000 FORMAT "%13.11" ECU_ADDRESS 0xFD9C /end MEASUREMENT
/begin MEASUREMENT B_fatnv "" UWORD B_TRUE 1 100 0.00 1.00000000000 BIT_MASK 0x2000 FORMAT "%13.11" ECU_ADDRESS 0xFD9C /end MEASUREMENT
/begin MEASUREMENT B_fatnv2 "" UWORD B_TRUE 1 100 0.00 1.00000000000 BIT_MASK 0x4000 FORMAT "%13.11" ECU_ADDRESS 0xFD9C /end MEASUREMENT
/begin MEASUREMENT B_fatp "" UWORD B_TRUE 1 100 0.00 1.00000000000 BIT_MASK 0x8000 FORMAT "%13.11" ECU_ADDRESS 0xFD9C /end MEASUREMENT
/begin MEASUREMENT B_fatp2 "" UWORD B_TRUE 1 100 0.00 1.00000000000 BIT_MASK 0x1 FORMAT "%13.11" ECU_ADDRESS 0xFD9E /end MEASUREMENT
/begin MEASUREMENT B_fatv "" UWORD B_TRUE 1 100 0.00 1.00000000000 BIT_MASK 0x2 FORMAT "%13.11" ECU_ADDRESS 0xFD9E /end MEASUREMENT
/begin MEASUREMENT B_fatv2 "" UWORD B_TRUE 1 100 0.00 1.00000000000 BIT_MASK 0x4 FORMAT "%13.11" ECU_ADDRESS 0xFD9E /end MEASUREMENT
/begin MEASUREMENT B_fgrbr "" UWORD B_TRUE 1 100 0.00 1.00000000000 BIT_MASK 0x1 FORMAT "%13.11" ECU_ADDRESS 0xFD14 /end MEASUREMENT
/begin MEASUREMENT B_fgrte "" UWORD B_TRUE 1 100 0.00 1.00000000000 BIT_MASK 0x8 FORMAT "%13.11" ECU_ADDRESS 0xFD9E /end MEASUREMENT
/begin MEASUREMENT B_fgrteen "" UWORD B_TRUE 1 100 0.00 1.00000000000 BIT_MASK 0x200 FORMAT "%13.11" ECU_ADDRESS 0xFD98 /end MEASUREMENT
/begin MEASUREMENT B_fgr_um "" UWORD B_TRUE 1 100 0.00 1.00000000000 BIT_MASK 0x8 FORMAT "%13.11" ECU_ADDRESS 0xFD0C /end MEASUREMENT
/begin MEASUREMENT B_fhz "" UWORD B_TRUE 1 100 0.00 1.00000000000 BIT_MASK 0x2 FORMAT "%13.11" ECU_ADDRESS 0xFD14 /end MEASUREMENT
/begin MEASUREMENT B_firstSyn "" UWORD B_TRUE 1 100 0.00 1.00000000000 BIT_MASK 0x400 FORMAT "%13.11" ECU_ADDRESS 0xFD0E /end MEASUREMENT
/begin MEASUREMENT B_fonresz "" UWORD B_TRUE 1 100 0.00 1.00000000000 BIT_MASK 0x4 FORMAT "%13.11" ECU_ADDRESS 0xFD14 /end MEASUREMENT
/begin MEASUREMENT B_frini2 "" UWORD B_TRUE 1 100 0.00 1.00000000000 BIT_MASK 0x8 FORMAT "%13.11" ECU_ADDRESS 0xFD14 /end MEASUREMENT
/begin MEASUREMENT B_gang0 "" UWORD B_TRUE 1 100 0.00 1.00000000000 BIT_MASK 0x10 FORMAT "%13.11" ECU_ADDRESS 0xFD14 /end MEASUREMENT
/begin MEASUREMENT B_gang7 "" UWORD B_TRUE 1 100 0.00 1.00000000000 BIT_MASK 0x20 FORMAT "%13.11" ECU_ADDRESS 0xFD14 /end MEASUREMENT
/begin MEASUREMENT B_graat_um "" UBYTE B_TRUE 1 100 0.00 1.00000000000 BIT_MASK 0x2 FORMAT "%13.11" ECU_ADDRESS 0x38000D /end MEASUREMENT
/begin MEASUREMENT B_graen_um "" UWORD B_TRUE 1 100 0.00 1.00000000000 BIT_MASK 0x2000 FORMAT "%13.11" ECU_ADDRESS 0xFD08 /end MEASUREMENT
/begin MEASUREMENT B_grahe_um "" UBYTE B_TRUE 1 100 0.00 1.00000000000 BIT_MASK 0x40 FORMAT "%13.11" ECU_ADDRESS 0x38000D /end MEASUREMENT
/begin MEASUREMENT B_grahs_um "" UBYTE B_TRUE 1 100 0.00 1.00000000000 BIT_MASK 0x1 FORMAT "%13.11" ECU_ADDRESS 0x38000D /end MEASUREMENT
/begin MEASUREMENT B_grase_um "" UBYTE B_TRUE 1 100 0.00 1.00000000000 BIT_MASK 0x1 FORMAT "%13.11" ECU_ADDRESS 0x38000E /end MEASUREMENT
/begin MEASUREMENT B_gratd_um "" UBYTE B_TRUE 1 100 0.00 1.00000000000 BIT_MASK 0x4 FORMAT "%13.11" ECU_ADDRESS 0x38000D /end MEASUREMENT
/begin MEASUREMENT B_gratu_um "" UBYTE B_TRUE 1 100 0.00 1.00000000000 BIT_MASK 0x8 FORMAT "%13.11" ECU_ADDRESS 0x38000D /end MEASUREMENT
/begin MEASUREMENT B_grawa_um "" UBYTE B_TRUE 1 100 0.00 1.00000000000 BIT_MASK 0x2 FORMAT "%13.11" ECU_ADDRESS 0x38000E /end MEASUREMENT
/begin MEASUREMENT B_grdst "" UWORD B_TRUE 1 100 0.00 1.00000000000 BIT_MASK 0x400 FORMAT "%13.11" ECU_ADDRESS 0xFD98 /end MEASUREMENT
/begin MEASUREMENT B_gwrte "" UWORD B_TRUE 1 100 0.00 1.00000000000 BIT_MASK 0x8 FORMAT "%13.11" ECU_ADDRESS 0xFDBA /end MEASUREMENT
/begin MEASUREMENT B_heatf "" UWORD B_TRUE 1 100 0.00 1.00000000000 BIT_MASK 0x40 FORMAT "%13.11" ECU_ADDRESS 0xFD14 /end MEASUREMENT
/begin MEASUREMENT B_helsu "" UWORD B_TRUE 1 100 0.00 1.00000000000 BIT_MASK 0x80 FORMAT "%13.11" ECU_ADDRESS 0xFD14 /end MEASUREMENT
/begin MEASUREMENT B_hlon "" UWORD B_TRUE 1 100 0.00 1.00000000000 BIT_MASK 0x10 FORMAT "%13.11" ECU_ADDRESS 0xFD9E /end MEASUREMENT
/begin MEASUREMENT B_hsve "" UWORD B_TRUE 1 100 0.00 1.00000000000 BIT_MASK 0x100 FORMAT "%13.11" ECU_ADDRESS 0xFD14 /end MEASUREMENT
/begin MEASUREMENT B_hsve2 "" UWORD B_TRUE 1 100 0.00 1.00000000000 BIT_MASK 0x200 FORMAT "%13.11" ECU_ADDRESS 0xFD14 /end MEASUREMENT
/begin MEASUREMENT B_incr "" UWORD B_TRUE 1 100 0.00 1.00000000000 BIT_MASK 0x80 FORMAT "%13.11" ECU_ADDRESS 0xF4662 /end MEASUREMENT
/begin MEASUREMENT B_klimex "" UWORD B_TRUE 1 100 0.00 1.00000000000 BIT_MASK 0x400 FORMAT "%13.11" ECU_ADDRESS 0xFD14 /end MEASUREMENT
/begin MEASUREMENT B_kstai "" UWORD B_TRUE 1 100 0.00 1.00000000000 BIT_MASK 0x100 FORMAT "%13.11" ECU_ADDRESS 0xF4662 /end MEASUREMENT
/begin MEASUREMENT B_kstaue "" UWORD B_TRUE 1 100 0.00 1.00000000000 BIT_MASK 0x200 FORMAT "%13.11" ECU_ADDRESS 0xF4662 /end MEASUREMENT
/begin MEASUREMENT B_kstebf "" UWORD B_TRUE 1 100 0.00 1.00000000000 BIT_MASK 0x800 FORMAT "%13.11" ECU_ADDRESS 0xFD98 /end MEASUREMENT
/begin MEASUREMENT B_lamdkt "" UWORD B_TRUE 1 100 0.00 1.00000000000 BIT_MASK 0x800 FORMAT "%13.11" ECU_ADDRESS 0xFD14 /end MEASUREMENT
/begin MEASUREMENT B_lfw "" UBYTE B_TRUE 1 100 0.00 1.00000000000 BIT_MASK 0x10 FORMAT "%13.11" ECU_ADDRESS 0x384026 /end MEASUREMENT
/begin MEASUREMENT B_lrar "" UWORD B_TRUE 1 100 0.00 1.00000000000 BIT_MASK 0x10 FORMAT "%13.11" ECU_ADDRESS 0xFDBA /end MEASUREMENT
/begin MEASUREMENT B_lrasp "" UWORD B_TRUE 1 100 0.00 1.00000000000 BIT_MASK 0x1000 FORMAT "%13.11" ECU_ADDRESS 0xFD14 /end MEASUREMENT
/begin MEASUREMENT B_lrasp2 "" UWORD B_TRUE 1 100 0.00 1.00000000000 BIT_MASK 0x2000 FORMAT "%13.11" ECU_ADDRESS 0xFD14 /end MEASUREMENT
/begin MEASUREMENT B_lrndia "" UWORD B_TRUE 1 100 0.00 1.00000000000 BIT_MASK 0x20 FORMAT "%13.11" ECU_ADDRESS 0xFD9E /end MEASUREMENT
/begin MEASUREMENT B_lrndiaur "" UWORD B_TRUE 1 100 0.00 1.00000000000 BIT_MASK 0x40 FORMAT "%13.11" ECU_ADDRESS 0xFD9E /end MEASUREMENT
/begin MEASUREMENT B_lsurfc "" UBYTE B_TRUE 1 100 0.00 1.00000000000 BIT_MASK 0x2 FORMAT "%13.11" ECU_ADDRESS 0xF05CC /end MEASUREMENT
/begin MEASUREMENT B_lsvvsp "" UWORD B_TRUE 1 100 0.00 1.00000000000 BIT_MASK 0x4000 FORMAT "%13.11" ECU_ADDRESS 0xFD14 /end MEASUREMENT
/begin MEASUREMENT B_luef1 "" UBYTE B_TRUE 1 100 0.00 1.00000000000 BIT_MASK 0x1 FORMAT "%13.11" ECU_ADDRESS 0x384026 /end MEASUREMENT
/begin MEASUREMENT B_luef2 "" UBYTE B_TRUE 1 100 0.00 1.00000000000 BIT_MASK 0x2 FORMAT "%13.11" ECU_ADDRESS 0x384026 /end MEASUREMENT
/begin MEASUREMENT B_luef3 "" UBYTE B_TRUE 1 100 0.00 1.00000000000 BIT_MASK 0x4 FORMAT "%13.11" ECU_ADDRESS 0x384026 /end MEASUREMENT
/begin MEASUREMENT B_m9cvn "" UBYTE B_TRUE 1 100 0.00 1.00000000000 BIT_MASK 0x1 FORMAT "%13.11" ECU_ADDRESS 0xF06D4 /end MEASUREMENT
/begin MEASUREMENT B_m9cvnout "" UBYTE B_TRUE 1 100 0.00 1.00000000000 BIT_MASK 0x2 FORMAT "%13.11" ECU_ADDRESS 0xF06D4 /end MEASUREMENT
/begin MEASUREMENT B_milabg "" UWORD B_TRUE 1 100 0.00 1.00000000000 BIT_MASK 0x8000 FORMAT "%13.11" ECU_ADDRESS 0xFD14 /end MEASUREMENT
/begin MEASUREMENT B_milkat "" UWORD B_TRUE 1 100 0.00 1.00000000000 BIT_MASK 0x1 FORMAT "%13.11" ECU_ADDRESS 0xFD16 /end MEASUREMENT
/begin MEASUREMENT B_nmaxext "" UWORD B_TRUE 1 100 0.00 1.00000000000 BIT_MASK 0x2 FORMAT "%13.11" ECU_ADDRESS 0xFD16 /end MEASUREMENT
/begin MEASUREMENT B_nmaxred "" UWORD B_TRUE 1 100 0.00 1.00000000000 BIT_MASK 0x4 FORMAT "%13.11" ECU_ADDRESS 0xFD16 /end MEASUREMENT
/begin MEASUREMENT B_nmxozwe "" UWORD B_TRUE 1 100 0.00 1.00000000000 BIT_MASK 0x8 FORMAT "%13.11" ECU_ADDRESS 0xFD16 /end MEASUREMENT
/begin MEASUREMENT B_noacc_um "" UWORD B_TRUE 1 100 0.00 1.00000000000 BIT_MASK 0x800 FORMAT "%13.11" ECU_ADDRESS 0xFD08 /end MEASUREMENT
/begin MEASUREMENT B_nodec "" UWORD B_TRUE 1 100 0.00 1.00000000000 BIT_MASK 0x400 FORMAT "%13.11" ECU_ADDRESS 0xF4662 /end MEASUREMENT
/begin MEASUREMENT B_noinc "" UWORD B_TRUE 1 100 0.00 1.00000000000 BIT_MASK 0x800 FORMAT "%13.11" ECU_ADDRESS 0xF4662 /end MEASUREMENT
/begin MEASUREMENT B_nomsr_um "" UWORD B_TRUE 1 100 0.00 1.00000000000 BIT_MASK 0x40 FORMAT "%13.11" ECU_ADDRESS 0xFD0C /end MEASUREMENT
/begin MEASUREMENT B_npmsr_um "" UWORD B_TRUE 1 100 0.00 1.00000000000 BIT_MASK 0x80 FORMAT "%13.11" ECU_ADDRESS 0xFD0C /end MEASUREMENT
/begin MEASUREMENT B_phnegtiv "" UBYTE dez 1 100 0.00 255.0 FORMAT "%5.1" ECU_ADDRESS 0xF05CA /end MEASUREMENT
/begin MEASUREMENT B_pkndnmb "" UWORD B_TRUE 1 100 0.00 1.00000000000 BIT_MASK 0x10 FORMAT "%13.11" ECU_ADDRESS 0xFD16 /end MEASUREMENT
/begin MEASUREMENT B_pripv "" UWORD B_TRUE 1 100 0.00 1.00000000000 BIT_MASK 0x20 FORMAT "%13.11" ECU_ADDRESS 0xFD16 /end MEASUREMENT
/begin MEASUREMENT B_pripv2 "" UWORD B_TRUE 1 100 0.00 1.00000000000 BIT_MASK 0x40 FORMAT "%13.11" ECU_ADDRESS 0xFD16 /end MEASUREMENT
/begin MEASUREMENT B_pwofnwa "" UWORD B_TRUE 1 100 0.00 1.00000000000 BIT_MASK 0x80 FORMAT "%13.11" ECU_ADDRESS 0xFD16 /end MEASUREMENT
/begin MEASUREMENT B_pwofnwe "" UWORD B_TRUE 1 100 0.00 1.00000000000 BIT_MASK 0x100 FORMAT "%13.11" ECU_ADDRESS 0xFD16 /end MEASUREMENT
/begin MEASUREMENT B_qtedab "" UWORD B_TRUE 1 100 0.00 1.00000000000 BIT_MASK 0x2000 FORMAT "%13.11" ECU_ADDRESS 0xFDB8 /end MEASUREMENT
/begin MEASUREMENT B_rineza "" UWORD B_TRUE 1 100 0.00 1.00000000000 BIT_MASK 0x200 FORMAT "%13.11" ECU_ADDRESS 0xFD16 /end MEASUREMENT
/begin MEASUREMENT B_rineza2 "" UWORD B_TRUE 1 100 0.00 1.00000000000 BIT_MASK 0x400 FORMAT "%13.11" ECU_ADDRESS 0xFD16 /end MEASUREMENT
/begin MEASUREMENT B_rqtglst "" UBYTE B_TRUE 1 100 0.00 1.00000000000 BIT_MASK 0x1 FORMAT "%13.11" ECU_ADDRESS 0xF0ACD /end MEASUREMENT
/begin MEASUREMENT B_rqtmost "" UBYTE B_TRUE 1 100 0.00 1.00000000000 BIT_MASK 0x2 FORMAT "%13.11" ECU_ADDRESS 0xF0ACD /end MEASUREMENT
/begin MEASUREMENT B_savacc "" UWORD B_TRUE 1 100 0.00 1.00000000000 BIT_MASK 0x800 FORMAT "%13.11" ECU_ADDRESS 0xFD16 /end MEASUREMENT
/begin MEASUREMENT B_sersw "" UWORD B_TRUE 1 100 0.00 1.00000000000 BIT_MASK 0x8 FORMAT "%13.11" ECU_ADDRESS 0xFDB0 /end MEASUREMENT
/begin MEASUREMENT B_sl "" UWORD B_TRUE 1 100 0.00 1.00000000000 BIT_MASK 0x1000 FORMAT "%13.11" ECU_ADDRESS 0xFD16 /end MEASUREMENT
/begin MEASUREMENT B_staa "" UWORD B_TRUE 1 100 0.00 1.00000000000 BIT_MASK 0x80 FORMAT "%13.11" ECU_ADDRESS 0xFD76 /end MEASUREMENT
/begin MEASUREMENT B_start_kmtraction "" UWORD B_TRUE 1 100 0.00 1.00000000000 BIT_MASK 0x400 FORMAT "%13.11" ECU_ADDRESS 0xFD94 /end MEASUREMENT
/begin MEASUREMENT B_stdperr "" UWORD B_TRUE 1 100 0.00 1.00000000000 BIT_MASK 0x1000 FORMAT "%13.11" ECU_ADDRESS 0xF4662 /end MEASUREMENT
/begin MEASUREMENT B_stellad "" UBYTE B_TRUE 1 100 0.00 1.00000000000 BIT_MASK 0x1 FORMAT "%13.11" ECU_ADDRESS 0xF0ADD /end MEASUREMENT
/begin MEASUREMENT B_sttakt "" UWORD B_TRUE 1 100 0.00 1.00000000000 BIT_MASK 0x800 FORMAT "%13.11" ECU_ADDRESS 0xFD94 /end MEASUREMENT
/begin MEASUREMENT B_su "" UWORD B_TRUE 1 100 0.00 1.00000000000 BIT_MASK 0x80 FORMAT "%13.11" ECU_ADDRESS 0xFD6E /end MEASUREMENT
/begin MEASUREMENT B_su2 "" UWORD B_TRUE 1 100 0.00 1.00000000000 BIT_MASK 0x100 FORMAT "%13.11" ECU_ADDRESS 0xFD6E /end MEASUREMENT
/begin MEASUREMENT B_sukp "" UBYTE B_TRUE 1 100 0.00 1.00000000000 BIT_MASK 0x1 FORMAT "%13.11" ECU_ADDRESS 0xF08C5 /end MEASUREMENT
/begin MEASUREMENT B_tDelayEnd "" UWORD B_TRUE 1 100 0.00 1.00000000000 BIT_MASK 0x10 FORMAT "%13.11" ECU_ADDRESS 0xFDB0 /end MEASUREMENT
/begin MEASUREMENT B_te "" UWORD B_TRUE 1 100 0.00 1.00000000000 BIT_MASK 0x4000 FORMAT "%13.11" ECU_ADDRESS 0xFDB8 /end MEASUREMENT
/begin MEASUREMENT B_teabb "" UWORD B_TRUE 1 100 0.00 1.00000000000 BIT_MASK 0x20 FORMAT "%13.11" ECU_ADDRESS 0xFDBA /end MEASUREMENT
/begin MEASUREMENT B_teakt "" UWORD B_TRUE 1 100 0.00 1.00000000000 BIT_MASK 0x40 FORMAT "%13.11" ECU_ADDRESS 0xFDBA /end MEASUREMENT
/begin MEASUREMENT B_tef "" UWORD B_TRUE 1 100 0.00 1.00000000000 BIT_MASK 0x8000 FORMAT "%13.11" ECU_ADDRESS 0xFDB8 /end MEASUREMENT
/begin MEASUREMENT B_tehb "" UWORD B_TRUE 1 100 0.00 1.00000000000 BIT_MASK 0x80 FORMAT "%13.11" ECU_ADDRESS 0xFDBA /end MEASUREMENT
/begin MEASUREMENT B_tehbx "" UWORD B_TRUE 1 100 0.00 1.00000000000 BIT_MASK 0x100 FORMAT "%13.11" ECU_ADDRESS 0xFDBA /end MEASUREMENT
/begin MEASUREMENT B_tei "" UWORD B_TRUE 1 100 0.00 1.00000000000 BIT_MASK 0x1 FORMAT "%13.11" ECU_ADDRESS 0xFDBA /end MEASUREMENT
/begin MEASUREMENT B_ten "" UWORD B_TRUE 1 100 0.00 1.00000000000 BIT_MASK 0x2 FORMAT "%13.11" ECU_ADDRESS 0xFDBA /end MEASUREMENT
/begin MEASUREMENT B_tenmda "" UBYTE B_TRUE 1 100 0.00 1.00000000000 BIT_MASK 0x1 FORMAT "%13.11" ECU_ADDRESS 0xF416A /end MEASUREMENT
/begin MEASUREMENT B_teviog "" UWORD B_TRUE 1 100 0.00 1.00000000000 BIT_MASK 0x2000 FORMAT "%13.11" ECU_ADDRESS 0xFD16 /end MEASUREMENT
/begin MEASUREMENT B_teza "" UWORD B_TRUE 1 100 0.00 1.00000000000 BIT_MASK 0x4000 FORMAT "%13.11" ECU_ADDRESS 0xFD16 /end MEASUREMENT
/begin MEASUREMENT B_timfast "" UWORD B_TRUE 1 100 0.00 1.00000000000 BIT_MASK 0x80 FORMAT "%13.11" ECU_ADDRESS 0xFD66 /end MEASUREMENT
/begin MEASUREMENT B_trev_inc "" UWORD B_TRUE 1 100 0.00 1.00000000000 BIT_MASK 0x800 FORMAT "%13.11" ECU_ADDRESS 0xFD0E /end MEASUREMENT
/begin MEASUREMENT B_tuning "" UWORD B_TRUE 1 100 0.00 1.00000000000 BIT_MASK 0x20 FORMAT "%13.11" ECU_ADDRESS 0xFDB0 /end MEASUREMENT
/begin MEASUREMENT B_ubkst "" UWORD B_TRUE 1 100 0.00 1.00000000000 BIT_MASK 0x100 FORMAT "%13.11" ECU_ADDRESS 0xFD76 /end MEASUREMENT
/begin MEASUREMENT B_ugdnws "" UWORD B_TRUE 1 100 0.00 1.00000000000 BIT_MASK 0x8000 FORMAT "%13.11" ECU_ADDRESS 0xFD16 /end MEASUREMENT
/begin MEASUREMENT B_vhlsu "" UWORD B_TRUE 1 100 0.00 1.00000000000 BIT_MASK 0x1 FORMAT "%13.11" ECU_ADDRESS 0xFD18 /end MEASUREMENT
/begin MEASUREMENT B_vhlsu2 "" UWORD B_TRUE 1 100 0.00 1.00000000000 BIT_MASK 0x2 FORMAT "%13.11" ECU_ADDRESS 0xFD18 /end MEASUREMENT
/begin MEASUREMENT B_zwfsu "" UWORD B_TRUE 1 100 0.00 1.00000000000 BIT_MASK 0x4 FORMAT "%13.11" ECU_ADDRESS 0xFD18 /end MEASUREMENT
/begin MEASUREMENT ctr_hscmp "" UBYTE dez 1 100 0.00 255.0 FORMAT "%5.1" ECU_ADDRESS 0xF0B5C /end MEASUREMENT
/begin MEASUREMENT dbgra_c_um "" UBYTE t_q0p04 1 100 0.00 10.20 FORMAT "%5.2" ECU_ADDRESS 0x380015 /end MEASUREMENT
/begin MEASUREMENT dbmsr_c_um "" UBYTE t40ms_ub_b10200 1 100 0.00 10200.0 FORMAT "%7.1" ECU_ADDRESS 0x38003D /end MEASUREMENT
/begin MEASUREMENT devoff "" UBYTE dez 1 100 0.00 255.0 FORMAT "%5.1" ECU_ADDRESS 0xF05CB /end MEASUREMENT
/begin MEASUREMENT dftef_w "" SWORD perio_sw_b1p562 1 100 -1.562000 1.561952 FORMAT "%8.6" ECU_ADDRESS 0xF2A0A /end MEASUREMENT
/begin MEASUREMENT dkatefrg "" SBYTE fak_sb_b1 1 100 -1.000 0.9922 FORMAT "%5.3" ECU_ADDRESS 0xF0BA8 /end MEASUREMENT
/begin MEASUREMENT dkhc_w "" SWORD perio_sw_b6p125 1 100 -6.125000 6.124813 FORMAT "%8.6" ECU_ADDRESS 0xF4F04 /end MEASUREMENT
/begin MEASUREMENT dlahico2_w "" SWORD fak_sw_b1 1 100 -1.000000 0.9999695 FORMAT "%8.6" ECU_ADDRESS 0x382164 /end MEASUREMENT
/begin MEASUREMENT dlahico_w "" SWORD fak_sw_b1 1 100 -1.000000 0.9999695 FORMAT "%8.6" ECU_ADDRESS 0x382166 /end MEASUREMENT
/begin MEASUREMENT dlahpco2_w "" SWORD fak_sw_b1 1 100 -1.000000 0.9999695 FORMAT "%8.6" ECU_ADDRESS 0xF1326 /end MEASUREMENT
/begin MEASUREMENT dlahpco_w "" SWORD fak_sw_b1 1 100 -1.000000 0.9999695 FORMAT "%8.6" ECU_ADDRESS 0xF1328 /end MEASUREMENT
/begin MEASUREMENT dlatrmi2_w "" SWORD fak_sw_b1 1 100 -1.000000 0.9999695 FORMAT "%8.6" ECU_ADDRESS 0xF132A /end MEASUREMENT
/begin MEASUREMENT dlatrmi_w "" SWORD fak_sw_b1 1 100 -1.000000 0.9999695 FORMAT "%8.6" ECU_ADDRESS 0xF132C /end MEASUREMENT
/begin MEASUREMENT dlatrmp2_w "" SWORD fak_sw_b1 1 100 -1.000000 0.9999695 FORMAT "%8.6" ECU_ADDRESS 0xF132E /end MEASUREMENT
/begin MEASUREMENT dlatrmp_w "" SWORD fak_sw_b1 1 100 -1.000000 0.9999695 FORMAT "%8.6" ECU_ADDRESS 0xF1330 /end MEASUREMENT
/begin MEASUREMENT dmlftef "" UBYTE fak_ub_b0p5 1 100 0.00 0.4980 ECU_ADDRESS 0xF0BA9 /end MEASUREMENT
/begin MEASUREMENT dmssginr "" SBYTE fak_sb_b1 1 100 -1.000 0.9922 FORMAT "%5.3" ECU_ADDRESS 0xF0BAA /end MEASUREMENT
/begin MEASUREMENT dnburns_w "" SWORD nmot_sw_q0p25 1 100 -8192.000 8191.750 FORMAT "%8.3" ECU_ADDRESS 0xF1FAE /end MEASUREMENT
/begin MEASUREMENT dstert20_w "" UWORD fak_uw_b2 1 100 0.00 1.999969 FORMAT "%8.6" ECU_ADDRESS 0xF2A0C /end MEASUREMENT
/begin MEASUREMENT dtmabsta "" UBYTE dez 1 100 0.00 255.0 FORMAT "%5.1" ECU_ADDRESS 0xF4001 /end MEASUREMENT
/begin MEASUREMENT dulsuhe_w "" UWORD spg_uw_b5 1 100 0.00 319.9951 FORMAT "%8.4" ECU_ADDRESS 0xF1332 /end MEASUREMENT
/begin MEASUREMENT dynPeriod "" SWORD dez 1 100 -32768.00 32767.00 FORMAT "%8.2" ECU_ADDRESS 0xF0FFA /end MEASUREMENT
/begin MEASUREMENT dzlsu_w "" SWORD t_q0p01 1 100 -327.6800 327.6700 FORMAT "%8.4" ECU_ADDRESS 0xF1334 /end MEASUREMENT
/begin MEASUREMENT dzw1_um "" UBYTE zw_ub_q0p75 1 100 0.00 191.3 FORMAT "%5.1" ECU_ADDRESS 0xF0574 /end MEASUREMENT
/begin MEASUREMENT dzw2_um "" UBYTE zw_ub_q0p75 1 100 0.00 191.3 FORMAT "%5.1" ECU_ADDRESS 0xF0575 /end MEASUREMENT
/begin MEASUREMENT dzw_um "" UBYTE zw_ub_q0p75 1 100 0.00 191.3 FORMAT "%5.1" ECU_ADDRESS 0x380040 /end MEASUREMENT
/begin MEASUREMENT ei_msrc_um "" UWORD B_TRUE 1 100 0.00 1.00000000000 BIT_MASK 0x1000 FORMAT "%13.11" ECU_ADDRESS 0xFD0C /end MEASUREMENT
/begin MEASUREMENT emf "" UBYTE dez 1 100 0.00 255.0 FORMAT "%5.1" ECU_ADDRESS 0xF05B0 /end MEASUREMENT
/begin MEASUREMENT errorCntTcsort "" UBYTE dez 1 100 0.00 255.0 FORMAT "%5.1" ECU_ADDRESS 0xF404A /end MEASUREMENT
/begin MEASUREMENT esst_smi03dm1ub "" UWORD dez 1 100 0.00 65535.00 FORMAT "%8.2" ECU_ADDRESS 0xF43BE /end MEASUREMENT
/begin MEASUREMENT esst_smi03dm2ub "" UWORD dez 1 100 0.00 65535.00 FORMAT "%8.2" ECU_ADDRESS 0xF43C0 /end MEASUREMENT
/begin MEASUREMENT esst_smi03dm3ub "" UWORD dez 1 100 0.00 65535.00 FORMAT "%8.2" ECU_ADDRESS 0xF43C2 /end MEASUREMENT
/begin MEASUREMENT esst_smi04dm1ub "" UWORD dez 1 100 0.00 65535.00 FORMAT "%8.2" ECU_ADDRESS 0xF43C4 /end MEASUREMENT
/begin MEASUREMENT esst_smi04dm2ub "" UWORD dez 1 100 0.00 65535.00 FORMAT "%8.2" ECU_ADDRESS 0xF43C6 /end MEASUREMENT
/begin MEASUREMENT esst_smi04dm3ub "" UWORD dez 1 100 0.00 65535.00 FORMAT "%8.2" ECU_ADDRESS 0xF43C8 /end MEASUREMENT
/begin MEASUREMENT esst_smi08dm1ub "" UWORD dez 1 100 0.00 65535.00 FORMAT "%8.2" ECU_ADDRESS 0xF43CA /end MEASUREMENT
/begin MEASUREMENT esst_smi08dmub "" UWORD dez 1 100 0.00 65535.00 FORMAT "%8.2" ECU_ADDRESS 0xF43CC /end MEASUREMENT
/begin MEASUREMENT esst_snm04dm1ub "" UWORD dez 1 100 0.00 65535.00 FORMAT "%8.2" ECU_ADDRESS 0xF43CE /end MEASUREMENT
/begin MEASUREMENT esst_snm04dm2ub "" UWORD dez 1 100 0.00 65535.00 FORMAT "%8.2" ECU_ADDRESS 0xF43D0 /end MEASUREMENT
/begin MEASUREMENT esst_snm04dm3ub "" UWORD dez 1 100 0.00 65535.00 FORMAT "%8.2" ECU_ADDRESS 0xF43D2 /end MEASUREMENT
/begin MEASUREMENT esst_snm05dm1ub "" UWORD dez 1 100 0.00 65535.00 FORMAT "%8.2" ECU_ADDRESS 0xF43D4 /end MEASUREMENT
/begin MEASUREMENT esst_snm05dm2ub "" UWORD dez 1 100 0.00 65535.00 FORMAT "%8.2" ECU_ADDRESS 0xF43D6 /end MEASUREMENT
/begin MEASUREMENT esst_snm05dm3ub "" UWORD dez 1 100 0.00 65535.00 FORMAT "%8.2" ECU_ADDRESS 0xF43D8 /end MEASUREMENT
/begin MEASUREMENT esst_snm05nauw "" UWORD dez 1 100 0.00 65535.00 FORMAT "%8.2" ECU_ADDRESS 0xF42E4 /end MEASUREMENT
/begin MEASUREMENT esst_snm05neuw "" UWORD dez 1 100 0.00 65535.00 FORMAT "%8.2" ECU_ADDRESS 0xF42E6 /end MEASUREMENT
/begin MEASUREMENT esst_snm05nwub "" UWORD dez 1 100 0.00 65535.00 FORMAT "%8.2" ECU_ADDRESS 0xF1312 /end MEASUREMENT
/begin MEASUREMENT esst_snm05nwuw "" UWORD dez 1 100 0.00 65535.00 FORMAT "%8.2" ECU_ADDRESS 0xF42E8 /end MEASUREMENT
/begin MEASUREMENT esst_snm06nwuw "" UWORD dez 1 100 0.00 65535.00 FORMAT "%8.2" ECU_ADDRESS 0xF42EA /end MEASUREMENT
/begin MEASUREMENT esst_snm08dm1ub "" UWORD dez 1 100 0.00 65535.00 FORMAT "%8.2" ECU_ADDRESS 0xF43DA /end MEASUREMENT
/begin MEASUREMENT esst_snm08dm2ub "" UWORD dez 1 100 0.00 65535.00 FORMAT "%8.2" ECU_ADDRESS 0xF43DC /end MEASUREMENT
/begin MEASUREMENT esst_snm08dm3ub "" UWORD dez 1 100 0.00 65535.00 FORMAT "%8.2" ECU_ADDRESS 0xF43DE /end MEASUREMENT
/begin MEASUREMENT esst_snm08dm4ub "" UWORD dez 1 100 0.00 65535.00 FORMAT "%8.2" ECU_ADDRESS 0xF43E0 /end MEASUREMENT
/begin MEASUREMENT esst_snm08dmub "" UWORD dez 1 100 0.00 65535.00 FORMAT "%8.2" ECU_ADDRESS 0xF43E2 /end MEASUREMENT
/begin MEASUREMENT esst_snm09dm1ub "" UWORD dez 1 100 0.00 65535.00 FORMAT "%8.2" ECU_ADDRESS 0xF43E4 /end MEASUREMENT
/begin MEASUREMENT esst_snm09dm2ub "" UWORD dez 1 100 0.00 65535.00 FORMAT "%8.2" ECU_ADDRESS 0xF43E6 /end MEASUREMENT
/begin MEASUREMENT esst_snm09dm3ub "" UWORD dez 1 100 0.00 65535.00 FORMAT "%8.2" ECU_ADDRESS 0xF43E8 /end MEASUREMENT
/begin MEASUREMENT esst_snm16nauw "" UWORD dez 1 100 0.00 65535.00 FORMAT "%8.2" ECU_ADDRESS 0xF42EC /end MEASUREMENT
/begin MEASUREMENT esst_snm16neuw "" UWORD dez 1 100 0.00 65535.00 FORMAT "%8.2" ECU_ADDRESS 0xF42EE /end MEASUREMENT
/begin MEASUREMENT esst_srl05nauw "" UWORD dez 1 100 0.00 65535.00 FORMAT "%8.2" ECU_ADDRESS 0xF42F0 /end MEASUREMENT
/begin MEASUREMENT esst_srl05neuw "" UWORD dez 1 100 0.00 65535.00 FORMAT "%8.2" ECU_ADDRESS 0xF42F2 /end MEASUREMENT
/begin MEASUREMENT esst_srl08nauw "" UWORD dez 1 100 0.00 65535.00 FORMAT "%8.2" ECU_ADDRESS 0xF42F4 /end MEASUREMENT
/begin MEASUREMENT esst_srl08neuw "" UWORD dez 1 100 0.00 65535.00 FORMAT "%8.2" ECU_ADDRESS 0xF42F6 /end MEASUREMENT
/begin MEASUREMENT esst_srl16nauw "" UWORD dez 1 100 0.00 65535.00 FORMAT "%8.2" ECU_ADDRESS 0xF42F8 /end MEASUREMENT
/begin MEASUREMENT esst_srl16neuw "" UWORD dez 1 100 0.00 65535.00 FORMAT "%8.2" ECU_ADDRESS 0xF42FA /end MEASUREMENT
/begin MEASUREMENT esst_stm05nwub "" UWORD dez 1 100 0.00 65535.00 FORMAT "%8.2" ECU_ADDRESS 0xF1314 /end MEASUREMENT
/begin MEASUREMENT esst_sto06nwuw "" UWORD dez 1 100 0.00 65535.00 FORMAT "%8.2" ECU_ADDRESS 0xF42FC /end MEASUREMENT
/begin MEASUREMENT etafrks_um "" UBYTE rel_ub_b127p5 1 100 0.00 127.5 FORMAT "%5.1" ECU_ADDRESS 0xF0576 /end MEASUREMENT
/begin MEASUREMENT etate "" UBYTE rel_ub_b127p5 1 100 0.00 127.5 FORMAT "%5.1" ECU_ADDRESS 0xF416B /end MEASUREMENT
/begin MEASUREMENT etateint "" UBYTE rel_ub_b127p5 1 100 0.00 127.5 FORMAT "%5.1" ECU_ADDRESS 0xF416C /end MEASUREMENT
/begin MEASUREMENT etatesol "" UBYTE rel_ub_b127p5 1 100 0.00 127.5 FORMAT "%5.1" ECU_ADDRESS 0xF416D /end MEASUREMENT
/begin MEASUREMENT etazw_um "" UBYTE rel_ub_b127p5 1 100 0.00 127.5 FORMAT "%5.1" ECU_ADDRESS 0xF0577 /end MEASUREMENT
/begin MEASUREMENT facipkr_w "" SWORD fak_q0p0039 1 100 -128.0000 127.9961 FORMAT "%8.4" ECU_ADDRESS 0x382168 /end MEASUREMENT
/begin MEASUREMENT fbetate "" UBYTE fak_ub_b1 1 100 0.00 0.9961 ECU_ADDRESS 0xF416E /end MEASUREMENT
/begin MEASUREMENT fbkate "" UBYTE fak_ub_b1 1 100 0.00 0.9961 ECU_ADDRESS 0xF416F /end MEASUREMENT
/begin MEASUREMENT fcoschk "" UBYTE fak_ub_b2 1 100 0.00 1.992 FORMAT "%5.3" ECU_ADDRESS 0xF1324 /end MEASUREMENT
/begin MEASUREMENT fcoschk2 "" UBYTE fak_ub_b2 1 100 0.00 1.992 FORMAT "%5.3" ECU_ADDRESS 0xF1325 /end MEASUREMENT
/begin MEASUREMENT fgrablir "" UBYTE dez 1 100 0.00 255.0 FORMAT "%5.1" ECU_ADDRESS 0xF4002 /end MEASUREMENT
/begin MEASUREMENT fgrablr "" UBYTE dez 1 100 0.00 255.0 FORMAT "%5.1" ECU_ADDRESS 0xF4003 /end MEASUREMENT
/begin MEASUREMENT fgwrte "" SBYTE fak_sb_b16 1 100 -16.00 15.88 FORMAT "%5.2" ECU_ADDRESS 0xF4170 /end MEASUREMENT
/begin MEASUREMENT fkateapp "" SBYTE fak_sb_b1 1 100 -1.000 0.9922 FORMAT "%5.3" ECU_ADDRESS 0xF4171 /end MEASUREMENT
/begin MEASUREMENT fkatefrg "" SBYTE fak_sb_b1 1 100 -1.000 0.9922 FORMAT "%5.3" ECU_ADDRESS 0xF0BAB /end MEASUREMENT
/begin MEASUREMENT fkatei "" SBYTE fak_sb_b1 1 100 -1.000 0.9922 FORMAT "%5.3" ECU_ADDRESS 0xF0BAC /end MEASUREMENT
/begin MEASUREMENT fkates "" SBYTE fak_sb_b1 1 100 -1.000 0.9922 FORMAT "%5.3" ECU_ADDRESS 0xF4172 /end MEASUREMENT
/begin MEASUREMENT fngwrte "" SBYTE fak_sb_b16 1 100 -16.00 15.88 FORMAT "%5.2" ECU_ADDRESS 0xF0BAD /end MEASUREMENT
/begin MEASUREMENT fregfte "" SBYTE fak_sb_b16 1 100 -16.00 15.88 FORMAT "%5.2" ECU_ADDRESS 0xF0BAE /end MEASUREMENT
/begin MEASUREMENT frmit "" UBYTE fak_ub_b2 1 100 0.00 1.992 FORMAT "%5.3" ECU_ADDRESS 0xF0BAF /end MEASUREMENT
/begin MEASUREMENT frmit_w "" UWORD fak_uw_b2 1 100 0.00 1.999969 FORMAT "%8.6" ECU_ADDRESS 0xF2A0E /end MEASUREMENT
/begin MEASUREMENT frmxa "" UBYTE fak_ub_b2 1 100 0.00 1.992 FORMAT "%5.3" ECU_ADDRESS 0xF0BB0 /end MEASUREMENT
/begin MEASUREMENT frmxaold_w "" UWORD fak_uw_b2 1 100 0.00 1.999969 FORMAT "%8.6" ECU_ADDRESS 0xF2A10 /end MEASUREMENT
/begin MEASUREMENT frmxa_w "" UWORD fak_uw_b2 1 100 0.00 1.999969 FORMAT "%8.6" ECU_ADDRESS 0xF2A12 /end MEASUREMENT
/begin MEASUREMENT fsu_w "" UWORD fak_uw_b1 1 100 0.00 0.9999847 FORMAT "%9.7" ECU_ADDRESS 0xF1DD8 /end MEASUREMENT
/begin MEASUREMENT ftadmste "" UBYTE fak_ub_b2 1 100 0.00 1.992 FORMAT "%5.3" ECU_ADDRESS 0xF0BB1 /end MEASUREMENT
/begin MEASUREMENT fteadf "" SBYTE fak_sb_q0p5 1 100 -64.00 63.50 FORMAT "%5.2" ECU_ADDRESS 0xF4173 /end MEASUREMENT
/begin MEASUREMENT fteadf_w "" SWORD fak_q0p00195 1 100 -64.00000 63.99805 FORMAT "%8.5" ECU_ADDRESS 0xF4F06 /end MEASUREMENT
/begin MEASUREMENT ftead_w "" SWORD fak_sw_b64 1 100 -64.00000 63.99805 FORMAT "%8.5" ECU_ADDRESS 0xF4F08 /end MEASUREMENT
/begin MEASUREMENT ftefsold_w "" UWORD fak_uw_b0p5 1 100 0.00 0.4999924 FORMAT "%9.7" ECU_ADDRESS 0xF2A14 /end MEASUREMENT
/begin MEASUREMENT ftefsoll_w "" UWORD fak_uw_b0p5 1 100 0.00 0.4999924 FORMAT "%9.7" ECU_ADDRESS 0xF2A16 /end MEASUREMENT
/begin MEASUREMENT ftefva "" UBYTE fak_ub_b0p5 1 100 0.00 0.4980 ECU_ADDRESS 0xF0BB2 /end MEASUREMENT
/begin MEASUREMENT ftefvab "" UBYTE fak_ub_b0p03125 1 100 0.00 0.03113 FORMAT "%7.5" ECU_ADDRESS 0xF4174 /end MEASUREMENT
/begin MEASUREMENT ftefvamx_w "" UWORD fak_uw_b0p5 1 100 0.00 0.4999924 FORMAT "%9.7" ECU_ADDRESS 0xF2A18 /end MEASUREMENT
/begin MEASUREMENT ftefva_w "" UWORD fak_uw_b0p5 1 100 0.00 0.4999924 FORMAT "%9.7" ECU_ADDRESS 0xF2A1A /end MEASUREMENT
/begin MEASUREMENT fteml "" UBYTE perio_ub_b0p012207 1 100 0.00 0.0121593164 FORMAT "%12.10" ECU_ADDRESS 0xF4175 /end MEASUREMENT
/begin MEASUREMENT fvermte_w "" UWORD fak_uw_b1 1 100 0.00 0.9999847 FORMAT "%9.7" ECU_ADDRESS 0xF2A1C /end MEASUREMENT
/begin MEASUREMENT ikakdiff_w "" SWORD fak_q0p000488 1 100 -16.00000 15.99951 FORMAT "%8.5" ECU_ADDRESS 0xF4300 /end MEASUREMENT
/begin MEASUREMENT ikakormf_w "" UWORD fak_uw_b16 1 100 0.00 15.99976 FORMAT "%8.5" ECU_ADDRESS 0xF4302 /end MEASUREMENT
/begin MEASUREMENT ikakreff_w "" UWORD fak_uw_b16 1 100 0.00 15.99976 FORMAT "%8.5" ECU_ADDRESS 0xF4304 /end MEASUREMENT
/begin MEASUREMENT imsteini "" UBYTE m_ub_q0p0444 1 100 0.00 11.32 FORMAT "%5.2" ECU_ADDRESS 0xF4176 /end MEASUREMENT
/begin MEASUREMENT khc_w "" SWORD fak_sw_b2 1 100 -2.000000 1.999939 FORMAT "%8.6" ECU_ADDRESS 0xF4F0A /end MEASUREMENT
/begin MEASUREMENT ksta0 "" UBYTE fak_ub_b2 1 100 0.00 1.992 FORMAT "%5.3" ECU_ADDRESS 0x382062 /end MEASUREMENT
/begin MEASUREMENT ksta0w "" UBYTE fak_ub_b2 1 100 0.00 1.992 FORMAT "%5.3" ECU_ADDRESS 0xF08EF /end MEASUREMENT
/begin MEASUREMENT ksta1 "" UBYTE fak_ub_b2 1 100 0.00 1.992 FORMAT "%5.3" ECU_ADDRESS 0x382063 /end MEASUREMENT
/begin MEASUREMENT ksta1w "" UBYTE fak_ub_b2 1 100 0.00 1.992 FORMAT "%5.3" ECU_ADDRESS 0xF08F0 /end MEASUREMENT
/begin MEASUREMENT ksta2 "" UBYTE fak_ub_b2 1 100 0.00 1.992 FORMAT "%5.3" ECU_ADDRESS 0x382064 /end MEASUREMENT
/begin MEASUREMENT ksta2w "" UBYTE fak_ub_b2 1 100 0.00 1.992 FORMAT "%5.3" ECU_ADDRESS 0xF08F1 /end MEASUREMENT
/begin MEASUREMENT kstaa "" UBYTE fak_ub_b2 1 100 0.00 1.992 FORMAT "%5.3" ECU_ADDRESS 0xF08F2 /end MEASUREMENT
/begin MEASUREMENT kteev_w "" UWORD fak_uw_b1 1 100 0.00 0.9999847 FORMAT "%9.7" ECU_ADDRESS 0xF2A1E /end MEASUREMENT
/begin MEASUREMENT ktetevvz_w "" UWORD fak_uw_b1 1 100 0.00 0.9999847 FORMAT "%9.7" ECU_ADDRESS 0xF2A20 /end MEASUREMENT
/begin MEASUREMENT ktetev_w "" UWORD fak_uw_b1 1 100 0.00 0.9999847 FORMAT "%9.7" ECU_ADDRESS 0xF2A22 /end MEASUREMENT
/begin MEASUREMENT lokBits_Tebeb "" UBYTE dez 1 100 0.00 255.0 FORMAT "%5.1" ECU_ADDRESS 0xF416A /end MEASUREMENT
/begin MEASUREMENT mfgr_um "" UBYTE rel_ub_q0p3906 1 100 0.00 99.61 FORMAT "%5.2" ECU_ADDRESS 0x38003A /end MEASUREMENT
/begin MEASUREMENT mibgrbr_w "" UWORD dez 1 100 0.00 65535.00 FORMAT "%8.2" ECU_ADDRESS 0xF1336 /end MEASUREMENT
/begin MEASUREMENT mibgrtm_w "" UWORD dez 1 100 0.00 65535.00 FORMAT "%8.2" ECU_ADDRESS 0xF1338 /end MEASUREMENT
/begin MEASUREMENT midmd "" UBYTE rel_ub_b99p6 1 100 0.00 99.61 FORMAT "%5.2" ECU_ADDRESS 0xF06A0 /end MEASUREMENT
/begin MEASUREMENT midmd_w "" UWORD rel_uw_b100 1 100 0.00 99.99847 FORMAT "%8.5" ECU_ADDRESS 0xF1454 /end MEASUREMENT
/begin MEASUREMENT miopt_um "" UBYTE rel_ub_b99p6 1 100 0.00 99.61 FORMAT "%5.2" ECU_ADDRESS 0xF0578 /end MEASUREMENT
/begin MEASUREMENT mitebg_w "" UWORD rel_uw_b100 1 100 0.00 99.99847 FORMAT "%8.5" ECU_ADDRESS 0xF2A24 /end MEASUREMENT
/begin MEASUREMENT mi_um "" UBYTE rel_ub_b99p6 1 100 0.00 99.61 FORMAT "%5.2" ECU_ADDRESS 0x380041 /end MEASUREMENT
/begin MEASUREMENT mkbgr_w "" UWORD dez 1 100 0.00 65535.00 FORMAT "%8.2" ECU_ADDRESS 0xF133A /end MEASUREMENT
/begin MEASUREMENT mmsr_um "" UBYTE rel_ub_q0p3906 1 100 0.00 99.61 FORMAT "%5.2" ECU_ADDRESS 0x38003E /end MEASUREMENT
/begin MEASUREMENT mracc_w "" UWORD rel_uw_b200 1 100 0.00 199.9969 FORMAT "%8.4" ECU_ADDRESS 0xF133C /end MEASUREMENT
/begin MEASUREMENT msabiks2_w "" UWORD m_q2p777Em5 1 100 0.00 1.820417 FORMAT "%8.6" ECU_ADDRESS 0xF4306 /end MEASUREMENT
/begin MEASUREMENT msabiks_w "" UWORD m_q2p777Em5 1 100 0.00 1.820417 FORMAT "%8.6" ECU_ADDRESS 0xF4308 /end MEASUREMENT
/begin MEASUREMENT msrc_c_um "" UBYTE t40ms_ub_b10200 1 100 0.00 10200.0 FORMAT "%7.1" ECU_ADDRESS 0x38003F /end MEASUREMENT
/begin MEASUREMENT mssginmn_w "" UWORD m_uw_b6553p5 1 100 0.00 6553.500 FORMAT "%8.3" ECU_ADDRESS 0xF2A26 /end MEASUREMENT
/begin MEASUREMENT mssgin_w "" UWORD m_uw_b6553p5 1 100 0.00 6553.500 FORMAT "%8.3" ECU_ADDRESS 0xF2A28 /end MEASUREMENT
/begin MEASUREMENT msteev_w "" UWORD m_uw_b25p6 1 100 0.00 25.59961 FORMAT "%8.5" ECU_ADDRESS 0xF2A2A /end MEASUREMENT
/begin MEASUREMENT mstesmx_w "" UWORD m_uw_b25p6 1 100 0.00 25.59961 FORMAT "%8.5" ECU_ADDRESS 0xF2A2C /end MEASUREMENT
/begin MEASUREMENT mstesoll_w "" UWORD m_uw_b25p6 1 100 0.00 25.59961 FORMAT "%8.5" ECU_ADDRESS 0xF2A2E /end MEASUREMENT
/begin MEASUREMENT ngfilsu_w "" SWORD nmotg_sw_q0p39 1 100 -12800.16 12799.77 FORMAT "%8.2" ECU_ADDRESS 0xF1DDA /end MEASUREMENT
/begin MEASUREMENT nmaxext_w "" UWORD nmot_uw_q0p25 1 100 0.00 16383.75 FORMAT "%8.2" ECU_ADDRESS 0xF133E /end MEASUREMENT
/begin MEASUREMENT nmotsu "" UBYTE nmot_ub_q40 1 100 0.00 10200. FORMAT "%5.0" ECU_ADDRESS 0xF08C4 /end MEASUREMENT
/begin MEASUREMENT nmst08_um "" UWORD dez 1 100 0.00 65535.00 FORMAT "%8.2" ECU_ADDRESS 0x38006C /end MEASUREMENT
/begin MEASUREMENT nturbc_w "" UWORD dez 1 100 0.00 65535.00 FORMAT "%8.2" ECU_ADDRESS 0xF1340 /end MEASUREMENT
/begin MEASUREMENT ofmsndk_w "" SWORD m_sw_b3276p8 1 100 -3276.800 3276.700 FORMAT "%8.3" ECU_ADDRESS 0x38216A /end MEASUREMENT
/begin MEASUREMENT pbkv "" UBYTE p_ub_q5 1 100 0.00 1275. FORMAT "%5.0" ECU_ADDRESS 0xF05CD /end MEASUREMENT
/begin MEASUREMENT pbkv_w "" UWORD p_uw_q0p039 1 100 0.00 2559.961 FORMAT "%8.3" ECU_ADDRESS 0xF1342 /end MEASUREMENT
/begin MEASUREMENT psl "" UBYTE dez 1 100 0.00 255.0 FORMAT "%5.1" ECU_ADDRESS 0xF4004 /end MEASUREMENT
/begin MEASUREMENT pspu "" UBYTE fak_ub_b2 1 100 0.00 1.992 FORMAT "%5.3" ECU_ADDRESS 0xF0BB3 /end MEASUREMENT
/begin MEASUREMENT pte "" SBYTE p_sb_q0p25 1 100 -32.00 31.75 FORMAT "%5.2" ECU_ADDRESS 0xF05CE /end MEASUREMENT
/begin MEASUREMENT qmsdyn "" UBYTE fak_ub_b16 1 100 0.00 15.94 FORMAT "%5.2" ECU_ADDRESS 0xF0BB4 /end MEASUREMENT
/begin MEASUREMENT qtetemin "" UBYTE fak_ub_b4 1 100 0.00 3.984 FORMAT "%5.3" ECU_ADDRESS 0xF0BB5 /end MEASUREMENT
/begin MEASUREMENT r1000msCtr "" UWORD dez 1 100 0.00 65535.00 FORMAT "%8.2" ECU_ADDRESS 0xF41FC /end MEASUREMENT
/begin MEASUREMENT r1000msLossCtr "" UBYTE dez 1 100 0.00 255.0 FORMAT "%5.1" ECU_ADDRESS 0xF0552 /end MEASUREMENT
/begin MEASUREMENT r100msCtr "" UWORD dez 1 100 0.00 65535.00 FORMAT "%8.2" ECU_ADDRESS 0xF41FE /end MEASUREMENT
/begin MEASUREMENT r100msLossCtr "" UBYTE dez 1 100 0.00 255.0 FORMAT "%5.1" ECU_ADDRESS 0xF0553 /end MEASUREMENT
/begin MEASUREMENT r10msCtr "" UWORD dez 1 100 0.00 65535.00 FORMAT "%8.2" ECU_ADDRESS 0xF0FFC /end MEASUREMENT
/begin MEASUREMENT r10msLossCtr "" UBYTE dez 1 100 0.00 255.0 FORMAT "%5.1" ECU_ADDRESS 0xF0554 /end MEASUREMENT
/begin MEASUREMENT r1msCtr "" UWORD dez 1 100 0.00 65535.00 FORMAT "%8.2" ECU_ADDRESS 0xF0FFE /end MEASUREMENT
/begin MEASUREMENT r200msCtr "" UWORD dez 1 100 0.00 65535.00 FORMAT "%8.2" ECU_ADDRESS 0xF4200 /end MEASUREMENT
/begin MEASUREMENT r200msLossCtr "" UBYTE dez 1 100 0.00 255.0 FORMAT "%5.1" ECU_ADDRESS 0xF0555 /end MEASUREMENT
/begin MEASUREMENT r20msCtr "" UWORD dez 1 100 0.00 65535.00 FORMAT "%8.2" ECU_ADDRESS 0xF1000 /end MEASUREMENT
/begin MEASUREMENT r20msLossCtr "" UBYTE dez 1 100 0.00 255.0 FORMAT "%5.1" ECU_ADDRESS 0xF0556 /end MEASUREMENT
/begin MEASUREMENT r2msCtr "" UWORD dez 1 100 0.00 65535.00 FORMAT "%8.2" ECU_ADDRESS 0xF1002 /end MEASUREMENT
/begin MEASUREMENT r50msCtr "" UWORD dez 1 100 0.00 65535.00 FORMAT "%8.2" ECU_ADDRESS 0xF1004 /end MEASUREMENT
/begin MEASUREMENT r50msLossCtr "" UBYTE dez 1 100 0.00 255.0 FORMAT "%5.1" ECU_ADDRESS 0xF0557 /end MEASUREMENT
/begin MEASUREMENT r5msCtr "" UWORD dez 1 100 0.00 65535.00 FORMAT "%8.2" ECU_ADDRESS 0xF1006 /end MEASUREMENT
/begin MEASUREMENT r5msLossCtr "" UBYTE dez 1 100 0.00 255.0 FORMAT "%5.1" ECU_ADDRESS 0xF0558 /end MEASUREMENT
/begin MEASUREMENT rfinugds_w "" UWORD rel_uw_q0p0234 1 100 0.00 1535.977 FORMAT "%8.3" ECU_ADDRESS 0xF1344 /end MEASUREMENT
/begin MEASUREMENT rfrints_w "" UWORD rel_uw_q0p0234 1 100 0.00 1535.977 FORMAT "%8.3" ECU_ADDRESS 0xF1346 /end MEASUREMENT
/begin MEASUREMENT rkte_w "" SWORD rel_sw_q0p0468 1 100 -1536.000 1535.953 FORMAT "%8.3" ECU_ADDRESS 0xF2A30 /end MEASUREMENT
/begin MEASUREMENT rldte_w "" UWORD rel_q0p02344 1 100 0.00 1535.977 FORMAT "%8.3" ECU_ADDRESS 0xF430A /end MEASUREMENT
/begin MEASUREMENT rlst08_um "" UWORD dez 1 100 0.00 65535.00 FORMAT "%8.2" ECU_ADDRESS 0x38006E /end MEASUREMENT
/begin MEASUREMENT rlteev_w "" UWORD rel_uw_b192 1 100 0.00 191.9971 FORMAT "%8.4" ECU_ADDRESS 0xF2A32 /end MEASUREMENT
/begin MEASUREMENT rriext_w "" UWORD rel_uw_b100 1 100 0.00 99.99847 FORMAT "%8.5" ECU_ADDRESS 0xF1348 /end MEASUREMENT
/begin MEASUREMENT sdulsumx_w "" UWORD spg_uw_b5 1 100 0.00 319.9951 FORMAT "%8.4" ECU_ADDRESS 0xF134A /end MEASUREMENT
/begin MEASUREMENT spsnst08_um "" UWORD dez 1 100 0.00 65535.00 FORMAT "%8.2" ECU_ADDRESS 0x380070 /end MEASUREMENT
/begin MEASUREMENT stactr "" UBYTE dez 1 100 0.00 255.0 FORMAT "%5.1" ECU_ADDRESS 0xF08F3 /end MEASUREMENT
/begin MEASUREMENT STADAPlokBits "" UWORD dez 1 100 0.00 65535.00 FORMAT "%8.2" ECU_ADDRESS 0xF4662 /end MEASUREMENT
/begin MEASUREMENT sumode "" UBYTE dez 1 100 0.00 255.0 FORMAT "%5.1" ECU_ADDRESS 0xF08C6 /end MEASUREMENT
/begin MEASUREMENT synchroCtr "" UWORD dez 1 100 0.00 65535.00 FORMAT "%8.2" ECU_ADDRESS 0xF1008 /end MEASUREMENT
/begin MEASUREMENT synchroSCtr "" UWORD dez 1 100 0.00 65535.00 FORMAT "%8.2" ECU_ADDRESS 0xF100A /end MEASUREMENT
/begin MEASUREMENT synstate "" UBYTE dez 1 100 0.00 255.0 FORMAT "%5.1" ECU_ADDRESS 0xE08F /end MEASUREMENT
/begin MEASUREMENT synstate_o "" UBYTE dez 1 100 0.00 255.0 FORMAT "%5.1" ECU_ADDRESS 0xE090 /end MEASUREMENT
/begin MEASUREMENT systemStackUsage "" UWORD fak_uw_b1 1 100 0.00 0.9999847 FORMAT "%9.7" ECU_ADDRESS 0xF4202 /end MEASUREMENT
/begin MEASUREMENT systemStackUsageMax_w "" UWORD fak_uw_b1 1 100 0.00 0.9999847 FORMAT "%9.7" ECU_ADDRESS 0x384030 /end MEASUREMENT
/begin MEASUREMENT S_hds "" UWORD B_TRUE 1 100 0.00 1.00000000000 BIT_MASK 0x8 FORMAT "%13.11" ECU_ADDRESS 0xFD18 /end MEASUREMENT
/begin MEASUREMENT S_kd "" UWORD B_TRUE 1 100 0.00 1.00000000000 BIT_MASK 0x10 FORMAT "%13.11" ECU_ADDRESS 0xFD18 /end MEASUREMENT
/begin MEASUREMENT tahso2_w "" UWORD temp_q0p0234_o273 1 100 -273.1500 1262.827 FORMAT "%8.3" ECU_ADDRESS 0xF4546 /end MEASUREMENT
/begin MEASUREMENT tahsoab2_w "" UWORD temp_q0p0234_o273 1 100 -273.1500 1262.827 FORMAT "%8.3" ECU_ADDRESS 0xF4548 /end MEASUREMENT
/begin MEASUREMENT tahsoab_w "" UWORD temp_q0p0234_o273 1 100 -273.1500 1262.827 FORMAT "%8.3" ECU_ADDRESS 0xF454A /end MEASUREMENT
/begin MEASUREMENT tahsom2_w "" UWORD temp_q0p0234_o273 1 100 -273.1500 1262.827 FORMAT "%8.3" ECU_ADDRESS 0xF454C /end MEASUREMENT
/begin MEASUREMENT tahsom_w "" UWORD temp_q0p0234_o273 1 100 -273.1500 1262.827 FORMAT "%8.3" ECU_ADDRESS 0xF454E /end MEASUREMENT
/begin MEASUREMENT tahso_w "" UWORD temp_q0p0234_o273 1 100 -273.1500 1262.827 FORMAT "%8.3" ECU_ADDRESS 0xF4550 /end MEASUREMENT
/begin MEASUREMENT taikr2_w "" UWORD temp_q0p0234_o273 1 100 -273.1500 1262.827 FORMAT "%8.3" ECU_ADDRESS 0xF430C /end MEASUREMENT
/begin MEASUREMENT taikrm2_w "" UWORD temp_q0p0234_o273 1 100 -273.1500 1262.827 FORMAT "%8.3" ECU_ADDRESS 0xF4552 /end MEASUREMENT
/begin MEASUREMENT taikrm_w "" UWORD temp_q0p0234_o273 1 100 -273.1500 1262.827 FORMAT "%8.3" ECU_ADDRESS 0xF4554 /end MEASUREMENT
/begin MEASUREMENT taikr_w "" UWORD temp_q0p0234_o273 1 100 -273.1500 1262.827 FORMAT "%8.3" ECU_ADDRESS 0xF430E /end MEASUREMENT
/begin MEASUREMENT takols "" UBYTE dez 1 100 0.00 255.0 FORMAT "%5.1" ECU_ADDRESS 0xF4005 /end MEASUREMENT
/begin MEASUREMENT tanhkm2_w "" UWORD temp_q0p0234_o273 1 100 -273.1500 1262.827 FORMAT "%8.3" ECU_ADDRESS 0xF4556 /end MEASUREMENT
/begin MEASUREMENT tanhkm_w "" UWORD temp_q0p0234_o273 1 100 -273.1500 1262.827 FORMAT "%8.3" ECU_ADDRESS 0xF4558 /end MEASUREMENT
/begin MEASUREMENT tans_um "" UBYTE temp_ub_q0p75_o48 1 100 -48.00 143.3 FORMAT "%5.1" ECU_ADDRESS 0x38000B /end MEASUREMENT
/begin MEASUREMENT tanvk2_w "" UWORD temp_q0p0234_o273 1 100 -273.1500 1262.827 FORMAT "%8.3" ECU_ADDRESS 0xF455A /end MEASUREMENT
/begin MEASUREMENT tanvkm2_w "" UWORD temp_q0p0234_o273 1 100 -273.1500 1262.827 FORMAT "%8.3" ECU_ADDRESS 0xF455C /end MEASUREMENT
/begin MEASUREMENT tanvkm_w "" UWORD temp_q0p0234_o273 1 100 -273.1500 1262.827 FORMAT "%8.3" ECU_ADDRESS 0xF455E /end MEASUREMENT
/begin MEASUREMENT tanvk_w "" UWORD temp_q0p0234_o273 1 100 -273.1500 1262.827 FORMAT "%8.3" ECU_ADDRESS 0xF4560 /end MEASUREMENT
/begin MEASUREMENT tatuk "" UBYTE temp_q6_o273 1 100 -273.1 1257. FORMAT "%5.0" ECU_ADDRESS 0xF40A4 /end MEASUREMENT
/begin MEASUREMENT tatuk_w "" UWORD temp_q0p0234_o273 1 100 -273.1500 1256.850 FORMAT "%8.3" ECU_ADDRESS 0xF4562 /end MEASUREMENT
/begin MEASUREMENT tavhkm2_w "" UWORD temp_q0p0234_o273 1 100 -273.1500 1262.827 FORMAT "%8.3" ECU_ADDRESS 0xF4564 /end MEASUREMENT
/begin MEASUREMENT tavhkm_w "" UWORD temp_q0p0234_o273 1 100 -273.1500 1262.827 FORMAT "%8.3" ECU_ADDRESS 0xF4566 /end MEASUREMENT
/begin MEASUREMENT tavrom2_w "" UWORD temp_q0p0234_o273 1 100 -273.1500 1262.827 FORMAT "%8.3" ECU_ADDRESS 0xF4568 /end MEASUREMENT
/begin MEASUREMENT tavrom_w "" UWORD temp_q0p0234_o273 1 100 -273.1500 1262.827 FORMAT "%8.3" ECU_ADDRESS 0xF456A /end MEASUREMENT
/begin MEASUREMENT tavso2_w "" UWORD temp_q0p0234_o273 1 100 -273.1500 1262.827 FORMAT "%8.3" ECU_ADDRESS 0xF456C /end MEASUREMENT
/begin MEASUREMENT tavsoab2_w "" UWORD temp_q0p0234_o273 1 100 -273.1500 1262.827 FORMAT "%8.3" ECU_ADDRESS 0xF456E /end MEASUREMENT
/begin MEASUREMENT tavsoab_w "" UWORD temp_q0p0234_o273 1 100 -273.1500 1262.827 FORMAT "%8.3" ECU_ADDRESS 0xF4570 /end MEASUREMENT
/begin MEASUREMENT tavsom2_w "" UWORD temp_q0p0234_o273 1 100 -273.1500 1262.827 FORMAT "%8.3" ECU_ADDRESS 0xF4572 /end MEASUREMENT
/begin MEASUREMENT tavsom_w "" UWORD temp_q0p0234_o273 1 100 -273.1500 1262.827 FORMAT "%8.3" ECU_ADDRESS 0xF4574 /end MEASUREMENT
/begin MEASUREMENT tavso_w "" UWORD temp_q0p0234_o273 1 100 -273.1500 1262.827 FORMAT "%8.3" ECU_ADDRESS 0xF4576 /end MEASUREMENT
/begin MEASUREMENT tavvk2_w "" UWORD temp_q0p0234_o273 1 100 -273.1500 1262.827 FORMAT "%8.3" ECU_ADDRESS 0xF4310 /end MEASUREMENT
/begin MEASUREMENT tavvkm2_w "" UWORD temp_q0p0234_o273 1 100 -273.1500 1262.827 FORMAT "%8.3" ECU_ADDRESS 0xF4578 /end MEASUREMENT
/begin MEASUREMENT tavvkm_w "" UWORD temp_q0p0234_o273 1 100 -273.1500 1262.827 FORMAT "%8.3" ECU_ADDRESS 0xF457A /end MEASUREMENT
/begin MEASUREMENT tavvk_w "" UWORD temp_q0p0234_o273 1 100 -273.1500 1262.827 FORMAT "%8.3" ECU_ADDRESS 0xF4312 /end MEASUREMENT
/begin MEASUREMENT tef_w "" UWORD t16usxms_uw_b1048 1 100 0.00 1048.564 FORMAT "%8.3" ECU_ADDRESS 0xF134C /end MEASUREMENT
/begin MEASUREMENT tkaadfp "" UBYTE dez 1 100 0.00 255.0 FORMAT "%5.1" ECU_ADDRESS 0xF4142 /end MEASUREMENT
/begin MEASUREMENT tkaakts "" UBYTE dez 1 100 0.00 255.0 FORMAT "%5.1" ECU_ADDRESS 0xF4143 /end MEASUREMENT
/begin MEASUREMENT tkaaktt "" UWORD dez 1 100 0.00 65535.00 FORMAT "%8.2" ECU_ADDRESS 0xF4740 /end MEASUREMENT
/begin MEASUREMENT tkaaktz "" UBYTE dez 1 100 0.00 255.0 FORMAT "%5.1" ECU_ADDRESS 0xF4144 /end MEASUREMENT
/begin MEASUREMENT tkaaktzmax "" UBYTE dez 1 100 0.00 255.0 FORMAT "%5.1" ECU_ADDRESS 0xF4145 /end MEASUREMENT
/begin MEASUREMENT tkaatoz "" UBYTE dez 1 100 0.00 255.0 FORMAT "%5.1" ECU_ADDRESS 0xF4146 /end MEASUREMENT
/begin MEASUREMENT tkbloknr "" UBYTE dez 1 100 0.00 255.0 FORMAT "%5.1" ECU_ADDRESS 0xF4148 /end MEASUREMENT
/begin MEASUREMENT tkihkm2_w "" UWORD temp_q0p0234_o273 1 100 -273.1500 1262.827 FORMAT "%8.3" ECU_ADDRESS 0xF457C /end MEASUREMENT
/begin MEASUREMENT tkihkmm2_w "" UWORD temp_q0p0234_o273 1 100 -273.1500 1262.827 FORMAT "%8.3" ECU_ADDRESS 0xF4314 /end MEASUREMENT
/begin MEASUREMENT tkihkmm_w "" UWORD temp_q0p0234_o273 1 100 -273.1500 1262.827 FORMAT "%8.3" ECU_ADDRESS 0xF4316 /end MEASUREMENT
/begin MEASUREMENT tkihkm_w "" UWORD temp_q0p0234_o273 1 100 -273.1500 1262.827 FORMAT "%8.3" ECU_ADDRESS 0xF457E /end MEASUREMENT
/begin MEASUREMENT tkiuem2_w "" UWORD temp_q0p0234_o273 1 100 -273.1500 1262.827 FORMAT "%8.3" ECU_ADDRESS 0xF4580 /end MEASUREMENT
/begin MEASUREMENT tkiuem_w "" UWORD temp_q0p0234_o273 1 100 -273.1500 1262.827 FORMAT "%8.3" ECU_ADDRESS 0xF4582 /end MEASUREMENT
/begin MEASUREMENT tkivkm2_w "" UWORD temp_q0p0234_o273 1 100 -273.1500 1262.827 FORMAT "%8.3" ECU_ADDRESS 0xF4584 /end MEASUREMENT
/begin MEASUREMENT tkivkmm_w "" UWORD temp_q0p0234_o273 1 100 -273.1500 1262.827 FORMAT "%8.3" ECU_ADDRESS 0xF4318 /end MEASUREMENT
/begin MEASUREMENT tkivkm_w "" UWORD temp_q0p0234_o273 1 100 -273.1500 1262.827 FORMAT "%8.3" ECU_ADDRESS 0xF4586 /end MEASUREMENT
/begin MEASUREMENT tkkta "" UBYTE dez 1 100 0.00 255.0 FORMAT "%5.1" ECU_ADDRESS 0xF4149 /end MEASUREMENT
/begin MEASUREMENT tkktat "" UBYTE dez 1 100 0.00 255.0 FORMAT "%5.1" ECU_ADDRESS 0xF414A /end MEASUREMENT
/begin MEASUREMENT tmadb "" UBYTE dez 1 100 0.00 255.0 FORMAT "%5.1" ECU_ADDRESS 0xF08F4 /end MEASUREMENT
/begin MEASUREMENT tmnist_um "" UBYTE temp_ub_q0p75_o48 1 100 -48.00 143.3 FORMAT "%5.1" ECU_ADDRESS 0x380042 /end MEASUREMENT
/begin MEASUREMENT tmotk "" UBYTE temp_q6_o273 1 100 -273.1 1257. FORMAT "%5.0" ECU_ADDRESS 0xF40A5 /end MEASUREMENT
/begin MEASUREMENT tmotk_w "" UWORD temp_q0p0234_o273 1 100 -273.1500 1256.850 FORMAT "%8.3" ECU_ADDRESS 0xF4588 /end MEASUREMENT
/begin MEASUREMENT tmot_um "" UBYTE temp_ub_q0p75_o48 1 100 -48.00 143.3 FORMAT "%5.1" ECU_ADDRESS 0x38000C /end MEASUREMENT
/begin MEASUREMENT tmst_w "" UWORD temp_uw_q0p75_o48 1 100 -48.00000 49103.25 FORMAT "%8.2" ECU_ADDRESS 0xF431A /end MEASUREMENT
/begin MEASUREMENT tn2 "" UWORD tinjection_sy 1 100 0.00 209.7120 FORMAT "%8.4" ECU_ADDRESS 0xE15C /end MEASUREMENT
/begin MEASUREMENT trevovCtr "" UWORD dez 1 100 0.00 65535.00 FORMAT "%8.2" ECU_ADDRESS 0xE00A /end MEASUREMENT
/begin MEASUREMENT tr_zahn "" UWORD dez 1 100 0.00 65535.00 FORMAT "%8.2" ECU_ADDRESS 0xE002 /end MEASUREMENT
/begin MEASUREMENT tr_zahn2 "" UWORD dez 1 100 0.00 65535.00 FORMAT "%8.2" ECU_ADDRESS 0xE004 /end MEASUREMENT
/begin MEASUREMENT tr_zeit "" UWORD dez 1 100 0.00 65535.00 FORMAT "%8.2" ECU_ADDRESS 0xE006 /end MEASUREMENT
/begin MEASUREMENT tr_zeit2 "" UWORD dez 1 100 0.00 65535.00 FORMAT "%8.2" ECU_ADDRESS 0xE008 /end MEASUREMENT
/begin MEASUREMENT tr_zeit_msb "" UBYTE dez 1 100 0.00 255.0 FORMAT "%5.1" ECU_ADDRESS 0xE000 /end MEASUREMENT
/begin MEASUREMENT tsctr "" UBYTE dez 1 100 0.00 255.0 FORMAT "%5.1" ECU_ADDRESS 0xF05CF /end MEASUREMENT
/begin MEASUREMENT tun_det "" UBYTE dez 1 100 0.00 255.0 FORMAT "%5.1" ECU_ADDRESS 0xF0B5D /end MEASUREMENT
/begin MEASUREMENT tun_errcode "" UBYTE dez 1 100 0.00 255.0 FORMAT "%5.1" ECU_ADDRESS 0xF0B5E /end MEASUREMENT
/begin MEASUREMENT tvluesfa "" UBYTE tv_ub_b100 1 100 0.00 99.61 FORMAT "%5.2" ECU_ADDRESS 0xF4141 /end MEASUREMENT
/begin MEASUREMENT tvsuae "" UBYTE t50msxs_q0p05 1 100 0.00 12.75 FORMAT "%5.2" ECU_ADDRESS 0xF08C7 /end MEASUREMENT
/begin MEASUREMENT udsl_w "" UWORD spg_uw_q0p00488 1 100 0.00 319.9951 FORMAT "%8.4" ECU_ADDRESS 0xF134E /end MEASUREMENT
/begin MEASUREMENT udst_w "" UWORD spg_uw_q0p00488 1 100 0.00 319.9951 FORMAT "%8.4" ECU_ADDRESS 0xF1350 /end MEASUREMENT
/begin MEASUREMENT uhepoti "" UBYTE dez 1 100 0.00 255.0 FORMAT "%5.1" ECU_ADDRESS 0xF4006 /end MEASUREMENT
/begin MEASUREMENT uhsv "" UBYTE spg_ub_b5 1 100 0.00 4.980 FORMAT "%5.3" ECU_ADDRESS 0xF05D0 /end MEASUREMENT
/begin MEASUREMENT uhsv2 "" UBYTE spg_ub_b5 1 100 0.00 4.980 FORMAT "%5.3" ECU_ADDRESS 0xF05D1 /end MEASUREMENT
/begin MEASUREMENT upotpwm "" UBYTE dez 1 100 0.00 255.0 FORMAT "%5.1" ECU_ADDRESS 0xF4007 /end MEASUREMENT
/begin MEASUREMENT userStackUsage "" UWORD fak_uw_b1 1 100 0.00 0.9999847 FORMAT "%9.7" ECU_ADDRESS 0xF4204 /end MEASUREMENT
/begin MEASUREMENT userStackUsageMax_w "" UWORD fak_uw_b1 1 100 0.00 0.9999847 FORMAT "%9.7" ECU_ADDRESS 0x384032 /end MEASUREMENT
/begin MEASUREMENT usvk "" UBYTE spg_ub_q0p0052_o0p2 1 100 -0.2000 1.130 FORMAT "%5.3" ECU_ADDRESS 0xF4008 /end MEASUREMENT
/begin MEASUREMENT usvk2 "" UBYTE spg_ub_q0p0052_o0p2 1 100 -0.2000 1.130 FORMAT "%5.3" ECU_ADDRESS 0xF4009 /end MEASUREMENT
/begin MEASUREMENT usvkk2_w "" UWORD dez 1 100 0.00 65535.00 FORMAT "%8.2" ECU_ADDRESS 0xF1352 /end MEASUREMENT
/begin MEASUREMENT usvkk_w "" UWORD spg_uw_q0p00488 1 100 0.00 319.9951 FORMAT "%8.4" ECU_ADDRESS 0xF1354 /end MEASUREMENT
/begin MEASUREMENT vstagr "" UBYTE fak_ub_b2 1 100 0.00 1.992 FORMAT "%5.3" ECU_ADDRESS 0xF0ACF /end MEASUREMENT
/begin MEASUREMENT vstcns "" UBYTE dez 1 100 0.00 255.0 FORMAT "%5.1" ECU_ADDRESS 0xF0AD0 /end MEASUREMENT
/begin MEASUREMENT vstdzw "" SBYTE zw_sb_q0p75 1 100 -96.00 95.25 FORMAT "%5.2" ECU_ADDRESS 0xF0AD1 /end MEASUREMENT
/begin MEASUREMENT vstfba "" UBYTE fak_ub_b2 1 100 0.00 1.992 FORMAT "%5.3" ECU_ADDRESS 0xF0AD2 /end MEASUREMENT
/begin MEASUREMENT vstfns "" UBYTE fak_ub_b2 1 100 0.00 1.992 FORMAT "%5.3" ECU_ADDRESS 0xF0AD3 /end MEASUREMENT
/begin MEASUREMENT vstfrk "" UBYTE fak_ub_b1p25_o0p75 1 100 0.7500 1.248 FORMAT "%5.3" ECU_ADDRESS 0xF0AD4 /end MEASUREMENT
/begin MEASUREMENT vstfst "" UBYTE fak_ub_b2 1 100 0.00 1.992 FORMAT "%5.3" ECU_ADDRESS 0xF0AD5 /end MEASUREMENT
/begin MEASUREMENT vstfva "" UBYTE fak_ub_b2 1 100 0.00 1.992 FORMAT "%5.3" ECU_ADDRESS 0xF0AD6 /end MEASUREMENT
/begin MEASUREMENT vstfwl "" UBYTE fak_ub_b2 1 100 0.00 1.992 FORMAT "%5.3" ECU_ADDRESS 0xF0AD7 /end MEASUREMENT
/begin MEASUREMENT vstlr "" SBYTE t10msxs_sb_q0p01 1 100 -1.280 1.270 FORMAT "%5.3" ECU_ADDRESS 0xF0AD8 /end MEASUREMENT
/begin MEASUREMENT vstmdr "" UBYTE rel_ub_b25 1 100 0.00 24.90 FORMAT "%5.2" ECU_ADDRESS 0xF0AD9 /end MEASUREMENT
/begin MEASUREMENT vstnls "" SBYTE nmot_sb_q10 1 100 -1280. 1270. FORMAT "%5.0" ECU_ADDRESS 0xF0ADA /end MEASUREMENT
/begin MEASUREMENT vstrlx "" UBYTE fak_ub_b1 1 100 0.00 0.9961 ECU_ADDRESS 0xF0ADB /end MEASUREMENT
/begin MEASUREMENT vstvvr "" SBYTE vfzg_q1p0 1 100 -128.0 127.0 FORMAT "%5.1" ECU_ADDRESS 0xF0ADC /end MEASUREMENT
/begin MEASUREMENT wnwi2_w "" SWORD kw_sw_b128 1 100 -128.0000 127.9961 FORMAT "%8.4" ECU_ADDRESS 0xF431C /end MEASUREMENT
/begin MEASUREMENT wnwi_w "" SWORD kw_sw_b128 1 100 -128.0000 127.9961 FORMAT "%8.4" ECU_ADDRESS 0xF431E /end MEASUREMENT
/begin MEASUREMENT wtol "" UBYTE dez 1 100 0.00 255.0 FORMAT "%5.1" ECU_ADDRESS 0xF05D2 /end MEASUREMENT
/begin MEASUREMENT zburn "" UBYTE dez 1 100 0.00 255.0 FORMAT "%5.1" ECU_ADDRESS 0xF08F5 /end MEASUREMENT
/begin MEASUREMENT zburnsu "" UBYTE dez 1 100 0.00 255.0 FORMAT "%5.1" ECU_ADDRESS 0xF08F6 /end MEASUREMENT
/begin MEASUREMENT zsynchro "" UBYTE dez 1 100 0.00 255.0 FORMAT "%5.1" ECU_ADDRESS 0xF08F7 /end MEASUREMENT
/begin MEASUREMENT zsyndelc "" UBYTE dez 1 100 0.00 255.0 FORMAT "%5.1" ECU_ADDRESS 0xF08F8 /end MEASUREMENT
/begin MEASUREMENT zsynsu "" UBYTE dez 1 100 0.00 255.0 FORMAT "%5.1" ECU_ADDRESS 0xF08F9 /end MEASUREMENT
/begin MEASUREMENT zubkst "" UBYTE dez 1 100 0.00 255.0 FORMAT "%5.1" ECU_ADDRESS 0xF08FA /end MEASUREMENT
/begin MEASUREMENT zwopt_um "" SBYTE zw_sb_q0p75 1 100 -96.00 95.25 FORMAT "%5.2" ECU_ADDRESS 0xF0579 /end MEASUREMENT
/begin MEASUREMENT zwout_um "" SBYTE zw_sb_q0p75 1 100 -96.00 95.25 FORMAT "%5.2" ECU_ADDRESS 0xF057A /end MEASUREMENT
/begin MEASUREMENT zzylzue "" UBYTE dez 1 100 0.00 255.0 FORMAT "%5.1" ECU_ADDRESS 0xF05C3 /end MEASUREMENT
/begin FUNCTION SSTDMD "1.10"
 /begin DEF_CHARACTERISTIC SMI03DM1UB SMI03DM2UB SMI03DM3UB SMI04DM1UB SMI04DM2UB SMI04DM3UB SMI08DM1UB SMI08DMUB SNM04DM1UB SNM04DM2UB SNM04DM3UB SNM05DM1UB SNM05DM2UB SNM05DM3UB SNM08DM1UB SNM08DM2UB SNM08DM3UB SNM08DM4UB SNM08DMUB SNM09DM1UB SNM09DM2UB SNM09DM3UB /end DEF_CHARACTERISTIC
 /begin IN_MEASUREMENT B_autget B_cvt B_mdzgstp miautget_w nmot /end IN_MEASUREMENT
 /begin OUT_MEASUREMENT esst_smi03dm1ub esst_smi03dm2ub esst_smi03dm3ub esst_smi04dm1ub esst_smi04dm2ub esst_smi04dm3ub esst_smi08dm1ub esst_smi08dmub esst_snm04dm1ub esst_snm04dm2ub esst_snm04dm3ub esst_snm05dm1ub esst_snm05dm2ub esst_snm05dm3ub esst_snm08dm1ub esst_snm08dm2ub esst_snm08dm3ub esst_snm08dm4ub esst_snm08dmub esst_snm09dm1ub esst_snm09dm2ub esst_snm09dm3ub midmd midmd_w /end OUT_MEASUREMENT
/end FUNCTION
/begin FUNCTION SSTNW "3.20"
 /begin DEF_CHARACTERISTIC SNM05NAUW SNM05NEUW SNM05NWUB SNM05NWUW SNM06NWUW SNM16NAUW SNM16NEUW SRL05NAUW SRL05NEUW SRL08NAUW SRL08NEUW SRL16NAUW SRL16NEUW STM05NWUB STO06NWUW /end DEF_CHARACTERISTIC
 /begin IN_MEASUREMENT nmot nmot_w rlnw_w tmot toelk_w /end IN_MEASUREMENT
 /begin OUT_MEASUREMENT esst_snm05nauw esst_snm05neuw esst_snm05nwub esst_snm05nwuw esst_snm06nwuw esst_snm16nauw esst_snm16neuw esst_srl05nauw esst_srl05neuw esst_srl08nauw esst_srl08neuw esst_srl16nauw esst_srl16neuw esst_stm05nwub esst_sto06nwuw /end OUT_MEASUREMENT
/end FUNCTION
/begin FUNCTION STACKMON "" /begin DEF_CHARACTERISTIC RESETSTACK /end DEF_CHARACTERISTIC
 /begin OUT_MEASUREMENT systemStackUsage systemStackUsageMax_w userStackUsage userStackUsageMax_w /end OUT_MEASUREMENT
/end FUNCTION
/begin FUNCTION STADAP "6.80"
 /begin DEF_CHARACTERISTIC ANRZUEMX CWSTADAP DECKSTAI DNBURN0 DNBURN1 DNBURN2 INCKSTAI KFNSTAMX KLDNFHO KSTA0INI KSTA1INI KSTA2INI KSTAI KSTAMN0 KSTAMN1 KSTAMN2 KSTAMX0 KSTAMX1 KSTAMX2 KSTTOPMN NSTAK TMADB0 TMADB1 TMADB2 TMLIM UBKST UBKSTMX WAD0T1 WAD0T2 WAD1T0 WAD1T2 WAD2T0 WAD2T1 ZBURNABR ZBURNDEC ZBURNSOL ZSYNABR ZSYNAUSW ZSYNDEL /end DEF_CHARACTERISTIC
 /begin IN_MEASUREMENT B_adrsta B_nmin B_pwf B_stend B_umsync B_vbemg B_wks dnmot_w E_ev1 E_ev2 E_ev3 E_ev4 E_ev5 E_ev6 E_frao E_frao2 E_frau E_frau2 E_n E_ph E_rkat E_rkat2 E_tankl E_tm E_ub fho nmot nmot_w nstat tmot tmst top_w ub vfzg /end IN_MEASUREMENT
 /begin OUT_MEASUREMENT B_staa kstaa /end OUT_MEASUREMENT
 /begin LOC_MEASUREMENT adastep B_ad B_adb0 B_adb1 B_adb2 B_adlck B_ausw B_burn B_decr B_incr B_kstai B_kstaue B_nodec B_noinc B_stdperr B_ubkst dnburns_w ksta0 ksta0w ksta1 ksta1w ksta2 ksta2w stactr STADAPlokBits tmadb zburn zburnsu zsynchro zsyndelc zsynsu zubkst /end LOC_MEASUREMENT
/end FUNCTION
/begin FUNCTION STUP "4.21" /begin IN_MEASUREMENT B_pwf pdck_state romRstC_um /end IN_MEASUREMENT /end FUNCTION
/begin FUNCTION SU "77.20"
 /begin DEF_CHARACTERISTIC CWSU DTMSRUHOT ENSUKHG KFSU KFSUHOT MRKOSRUHOT NMOTNGAS SUAP SUMODE0 SUMODE1 TASUS TMSRUHOT TMSUS TMSUSV TVSU TVSUAN TVSUM TVSUNA TVSUST ZNGFILSU /end DEF_CHARACTERISTIC
 /begin IN_MEASUREMENT B_ll gangi mrko ngas_w nmot tans tmot tnst_w /end IN_MEASUREMENT
 /begin OUT_MEASUREMENT B_su B_su2 B_sukp fsu_w nmotsu sumode tvsuae /end OUT_MEASUREMENT
 /begin LOC_MEASUREMENT ngfilsu_w /end LOC_MEASUREMENT
/end FUNCTION
/begin FUNCTION SWADP "" /begin DEF_CHARACTERISTIC KTMOTW NMAXOG /end DEF_CHARACTERISTIC
 /begin IN_MEASUREMENT avkatf avkatf2 B_acc B_frini B_iclsabg B_iclsabg2 B_kow B_lrhkp B_lrhkp2 B_nmin B_stend B_vlsunp B_vlsunp2 dlahi2_w dlahi_w dlahp2_w dlahp_w msndko_w nmot_w taikrm2_w taikrm_w tavvkm2_w tavvkm_w tmst tumg uulsuv2_w uulsuv_w vfzg_w /end IN_MEASUREMENT
 /begin OUT_MEASUREMENT bfgrsbr B_agrlrasp B_asc_reg B_asm B_atmng B_blkfb B_ddkds B_dktb B_dkuevab B_dldpte B_dmmtev B_dmtltz B_dteabum B_dteikanm B_dtevto B_dtezamh B_elsu B_elsu2 B_fgrbr B_fhz B_fonresz B_frini2 B_gang0 B_gang7 B_heatf B_helsu B_hsve B_hsve2 B_klimex B_lamdkt B_lrasp B_lrasp2 B_lsurfc B_lsvvsp B_milabg B_milkat B_nmaxext B_nmaxred B_nmxozwe B_phnegtiv B_pkndnmb B_pripv B_pripv2 B_pwofnwa B_pwofnwe B_rineza B_rineza2 B_savacc B_sl B_teviog B_teza B_ugdnws B_vhlsu B_vhlsu2 B_zwfsu devoff dlahico2_w dlahico_w dlahpco2_w dlahpco_w dlatrmi2_w dlatrmi_w dlatrmp2_w dlatrmp_w dtmabsta dulsuhe_w dzlsu_w facipkr_w fcoschk fcoschk2 fgrablir fgrablr ikakdiff_w ikakormf_w ikakreff_w mibgrbr_w mibgrtm_w mkbgr_w mracc_w msabiks2_w msabiks_w nmaxext_w nturbc_w ofmsndk_w pbkv pbkv_w psl pte rfinugds_w rfrints_w rldte_w rriext_w sdulsumx_w S_hds S_kd taikr2_w taikr_w takols tavvk2_w tavvk_w tef_w tkihkmm2_w tkihkmm_w tkivkmm_w tmst_w tsctr udsl_w udst_w uhepoti uhsv uhsv2 upotpwm usvk usvk2 usvkk2_w usvkk_w wnwi2_w wnwi_w wtol /end OUT_MEASUREMENT
/end FUNCTION
/begin FUNCTION SYK051 "" /end FUNCTION
/begin FUNCTION SYNC71 "" /begin IN_MEASUREMENT B_nosynph /end IN_MEASUREMENT
 /begin OUT_MEASUREMENT B_bzsync B_firstSyn tr_zahn tr_zahn2 tr_zeit tr_zeit2 tr_zeit_msb zzylzue /end OUT_MEASUREMENT
/end FUNCTION
/begin FUNCTION SYSYNC "3.20" /begin OUT_MEASUREMENT synstate synstate_o /end OUT_MEASUREMENT /end FUNCTION
/begin FUNCTION SY_DFPM3 "" /end FUNCTION
/begin FUNCTION T2KWP "" /end FUNCTION
/begin FUNCTION T2MBA "1.10" /begin OUT_MEASUREMENT emf /end OUT_MEASUREMENT /end FUNCTION
/begin FUNCTION T2REID "" /end FUNCTION
/begin FUNCTION TC1MOD "20.140" /begin REF_CHARACTERISTIC CWOBD /end REF_CHARACTERISTIC
 /begin IN_MEASUREMENT B_cdkvs B_cdmd B_kmmilsct B_lsh B_lsh2 B_milstat B_sls B_slsfz evsup1 flglrs flglrs2 fr2_w fra2_w fra_w fr_w iplsuvj2_w iplsuvj_w kmstmil_w lalsuvj2_w lalsuvj_w mshfm_w nmot_w ready rml tanslin tmotlin udkp1_w ushkj ushkj2 vfzg zwzyl1 /end IN_MEASUREMENT
/end FUNCTION
/begin FUNCTION TC2MOD "20.71" /begin IN_MEASUREMENT ffzdfp /end IN_MEASUREMENT /end FUNCTION
/begin FUNCTION TC5MOD "20.30"
 /begin REF_CHARACTERISTIC DLAHISATO DLAHISATU DYNLSUTO DYNLSUTU LAMSSAMN LAMSSAMX USMNSHMN USMNSHMX USMXSHMN USMXSHMX USRHKSHJ /end REF_CHARACTERISTIC
 /begin IN_MEASUREMENT B_lsh B_lsh2 B_lsv B_lsv2 dlahisa dlahisa2 dynlsusa dynlsusa2 lamsisa lamsisa2 lamsosa lamsosa2 usmnshn usmnshn2 usmxshn usmxshn2 /end IN_MEASUREMENT
/end FUNCTION
/begin FUNCTION TC6MOD "20.100"
 /begin IN_MEASUREMENT B_cdkat B_cdsls B_cdtes B_cwdslt m6cmsl m6cmsl2 m6cmslv m6cmslv2 m6smsl2_w m6smslv2_w m6smslv_w m6smsl_w m6wmsl2_w m6wmslv2_w m6wmslv_w m6wmsl_w tc6katc tc6katc2 tc6kats tc6kats2 tc6katw tc6katw2 tc6tesc tc6tess tc6tesw /end IN_MEASUREMENT
/end FUNCTION
/begin FUNCTION TC8MOD "21.50" /begin DEF_CHARACTERISTIC TMOD8TE /end DEF_CHARACTERISTIC /begin IN_MEASUREMENT B_ll B_m8te /end IN_MEASUREMENT /end FUNCTION
/begin FUNCTION TC9MOD "8.20" /begin DEF_CHARACTERISTIC CWM9CVNSUP /end DEF_CHARACTERISTIC /begin REF_CHARACTERISTIC SGIDB1 SGIDB3 /end REF_CHARACTERISTIC /begin IN_MEASUREMENT B_cksbrdy cvnh_w cvnl_w nmot_w /end IN_MEASUREMENT /begin OUT_MEASUREMENT B_m9cvn B_m9cvnout /end OUT_MEASUREMENT /end FUNCTION
/begin FUNCTION TCKOMUE "2.10" /begin DEF_CHARACTERISTIC CWNOSCAT /end DEF_CHARACTERISTIC /end FUNCTION
/begin FUNCTION TCSORT "3.30" /begin IN_MEASUREMENT cw_erfil fcmEnd FCMTab ffzdfp /end IN_MEASUREMENT /begin OUT_MEASUREMENT errorCntTcsort /end OUT_MEASUREMENT /end FUNCTION
/begin FUNCTION TEB "95.120"
 /begin DEF_CHARACTERISTIC DFTEAHB DMSTES DSTEMIN FBTEB FBTEVA FBZBTEML FETATEBN FKATEB FQTEDL FQTEFR FQTEPT FQTEVA FRHB FSRFTEF FTEADAB FTEADMX FTEFHB FTEHB FTEINIX FUMRBRK FVERMN FVERZDYN FVRMDYN KFETATE KFFTEAN KFFTEAX KFQTE KFTADMS KFTATX KFTEKA KHCTEAMX KHCTEMN KHCTEMX MSDKLMMN NVERZMN TFTEINI TQTEAB TQTEDAB TVAGRFTE TVSATEM ZBTEML ZETATE ZKFTEAD ZMLTE ZMSSGIN /end DEF_CHARACTERISTIC
 /begin REF_CHARACTERISTIC SDK10TEUB SFR05TEUB SML06TEUB SNM10TEUB SQM05TEUB TEMIN /end REF_CHARACTERISTIC
 /begin IN_MEASUREMENT abo B_abor B_evloc B_frmax B_frmax2 B_frmin B_frmin2 B_lr B_lr2 B_lrasp B_lrasp2 B_nmot B_nswo1 B_qtedab B_sab B_te B_tef B_tei B_ten B_tep esst_sdk10teub esst_sfr05teub esst_sml06teub esst_snm10teub esst_sqm05teub frm2_w frm_w mifa_w miopt_w ml mlsol_w ml_w msdkalm_w mste mstedte_w msteo_w mste_w nmot nmot_w ps_w pte pu rl tans te2_w te_w tmot umsrln_w wdkba /end IN_MEASUREMENT
 /begin OUT_MEASUREMENT B_agrste B_lrar B_teabb B_tehb B_tehbx etate fkatei frmit_w frmxa fteadf ftead_w ftefsoll_w ftefva_w imsteini mitebg_w mstesoll_w rkte_w /end OUT_MEASUREMENT
 /begin LOC_MEASUREMENT B_gwrte B_teakt dftef_w dkatefrg dkhc_w dmlftef dmssginr dstert20_w etateint etatesol fbetate fbkate fgwrte fkateapp fkatefrg fkates fngwrte fregfte frmit frmxaold_w frmxa_w ftadmste fteadf_w ftefsold_w ftefva ftefvab ftefvamx_w fteml fvermte_w khc_w kteev_w ktetevvz_w ktetev_w mssginmn_w mssgin_w msteev_w mstesmx_w pspu qmsdyn qtetemin rlteev_w /end LOC_MEASUREMENT
/end FUNCTION
/begin FUNCTION TEBEB "4.140" /begin DEF_CHARACTERISTIC CWTEACFG LAMTEMN LAMTEMX TMSTTE TMTE TTEAUS /end DEF_CHARACTERISTIC
 /begin IN_MEASUREMENT B_atmtpa B_dldpte B_dllra B_dsls B_dteaa B_eobdlr B_fraoan B_ftedab B_lamka B_lamka2 B_lamsdef B_lr B_lr2 B_lrasp B_lrasp2 B_lrssa B_lrssa2 B_m8te B_mdarv B_mlrsa B_sbbvk B_sbbvk2 B_sls B_stend B_tep lamsons_w tateist_w tmot tmst /end IN_MEASUREMENT
 /begin OUT_MEASUREMENT B_qtedab B_te B_tef B_tei B_ten /end OUT_MEASUREMENT
 /begin LOC_MEASUREMENT B_tenmda lokBits_Tebeb /end LOC_MEASUREMENT
/end FUNCTION
/begin FUNCTION TEMPKON "4.40"
 /begin IN_MEASUREMENT tabgm2_w tabgmab tabgmab2 tabgm_w tatu tikatm2_w tikatm_w tkatm2_w tkatmab tkatmab2 tkatm_w tmot /end IN_MEASUREMENT
 /begin OUT_MEASUREMENT tahso2_w tahsoab2_w tahsoab_w tahsom2_w tahsom_w tahso_w taikrm2_w taikrm_w tanhkm2_w tanhkm_w tanvk2_w tanvkm2_w tanvkm_w tanvk_w tatuk tatuk_w tavhkm2_w tavhkm_w tavrom2_w tavrom_w tavso2_w tavsoab2_w tavsoab_w tavsom2_w tavsom_w tavso_w tavvkm2_w tavvkm_w tkihkm2_w tkihkm_w tkiuem2_w tkiuem_w tkivkm2_w tkivkm_w tmotk tmotk_w /end OUT_MEASUREMENT
/end FUNCTION
/begin FUNCTION TIMETAB "" /begin IN_MEASUREMENT B_nachl nmot /end IN_MEASUREMENT
 /begin OUT_MEASUREMENT bgCtr dynPeriod r1000msCtr r1000msLossCtr r100msCtr r100msLossCtr r10msCtr r10msLossCtr r1msCtr r200msCtr r200msLossCtr r20msCtr r20msLossCtr r2msCtr r50msCtr r50msLossCtr r5msCtr r5msLossCtr synchroCtr synchroSCtr /end OUT_MEASUREMENT
/end FUNCTION
/begin FUNCTION TIMU "1.20"
 /begin IN_MEASUREMENT B_stend B_ti_cha0 B_ti_cha1 B_ti_cha2 B_ti_cha3 B_ti_cha4 B_ti_cha5 B_ti_out0 B_ti_out1 B_ti_out2 B_ti_out3 B_ti_out4 B_ti_out5 B_ti_wai0 B_ti_wai1 B_ti_wai2 B_ti_wai3 B_ti_wai4 B_ti_wai5 cc_cha_0 cc_cha_1 cc_cha_2 cc_cha_3 cc_cha_4 cc_cha_5 ti_ev0 ti_ev1 ti_ev2 ti_ev3 ti_ev4 ti_ev5 tseghi tseg_w /end IN_MEASUREMENT
 /begin OUT_MEASUREMENT B_timfast tn2 /end OUT_MEASUREMENT
/end FUNCTION
/begin FUNCTION TKAA "1.70"
 /begin DEF_CHARACTERISTIC CWAPPLTKAA KLTKAADFP KLTKAATOZ KLTKKTA TKATTKAMN TKATTKAMX TMOTTKAMN /end DEF_CHARACTERISTIC
 /begin IN_MEASUREMENT B_autget B_faa B_fanfg B_fs B_lrnws B_sbbhk B_sbbhk2 B_sbbvk B_sbbvk2 B_syserrk tkatm tkatm2 tmot vfzg /end IN_MEASUREMENT
 /begin OUT_MEASUREMENT B_stellad tkaakts tkaaktz tkkta tkktat /end OUT_MEASUREMENT
 /begin LOC_MEASUREMENT tkaadfp tkaaktt tkaaktzmax tkaatoz tkbloknr /end LOC_MEASUREMENT
/end FUNCTION
/begin FUNCTION TKMWL "22.720"
 /begin DEF_CHARACTERISTIC AAGOFLOGIN AAGONLOGIN ADRONLOGIN AGR_AOG AGR_AUG CNSDEF CNS_AOG CNS_AUG CWFA107 CWFA107A CWFA107B CWFA108 CWFA108A CWFA108B CWFA109 CWFA109A CWFA109B CWFA130 CWFA130A CWFA130B CWFA140 CWFA140A CWFA140B CWFA145 CWFA145A CWFA145B CWFA146 CWFA146A CWFA146B CWFA147 CWFA147A CWFA147B CWFA148 CWFA148A CWFA148B CWFA149 CWFA149A CWFA149B CWFA152 CWFA152A CWFA152B CWFA162 CWFA162A CWFA162B CWFA163 CWFA163A CWFA163B CWFA166 CWFA166A CWFA166B CWFA167 CWFA167A CWFA167B CWFA168 CWFA168A CWFA168B CWFA187 CWFA187A CWFA187B CWFA188 CWFA188A CWFA188B CWFA189 CWFA189A CWFA189B CWFA190 CWFA190A CWFA190B CWFA191 CWFA191A CWFA191B CWFA192 CWFA192A CWFA192B CWFA193 CWFA193A CWFA193B CWFA194 CWFA194A CWFA194B CWFA195 CWFA195A CWFA195B CWFA196 CWFA196A CWFA196B CWFA197 CWFA197A CWFA197B CWFA198 CWFA198A CWFA198B CWFA199 CWFA199A CWFA199B CWFA201 CWFA201A CWFA201B CWFA202 CWFA202A CWFA202B CWFA203 CWFA203A CWFA203B CWFA204 CWFA204A CWFA204B CWFA205 CWFA205A CWFA205B CWFA206 CWFA206A CWFA206B CWFA207 CWFA207A CWFA207B CWFA208 CWFA208A CWFA208B CWFA209 CWFA209A CWFA209B CWFA210 CWFA210A CWFA210B CWFA211 CWFA211A CWFA211B CWFA212 CWFA212A CWFA212B CWFA213 CWFA213A CWFA213B CWFA214 CWFA214A CWFA214B CWFA215 CWFA215A CWFA215B CWFA216 CWFA216A CWFA216B CWFA217 CWFA217A CWFA217B CWFA218 CWFA218A CWFA218B CWFA219 CWFA219A CWFA219B CWFA220 CWFA220A CWFA220B CWFA221 CWFA221A CWFA221B CWFA222 CWFA222A CWFA222B CWFA223 CWFA223A CWFA223B CWFA224 CWFA224A CWFA224B CWFA225 CWFA225A CWFA225B CWFA226 CWFA226A CWFA226B CWFA227 CWFA227A CWFA227B CWFA228 CWFA228A CWFA228B CWFA229 CWFA229A CWFA229B CWFA230 CWFA230A CWFA230B CWFA231 CWFA231A CWFA231B CWFA232 CWFA232A CWFA232B CWFA233 CWFA233A CWFA233B CWFA234 CWFA234A CWFA234B CWFA235 CWFA235A CWFA235B CWFA236 CWFA236A CWFA236B CWFA237 CWFA237A CWFA237B CWFA238 CWFA238A CWFA238B CWFA239 CWFA239A CWFA239B CWFA240 CWFA240A CWFA240B CWFA241 CWFA241A CWFA241B CWFA242 CWFA242A CWFA242B CWFA243 CWFA243A CWFA243B CWFA244 CWFA244A CWFA244B CWFA245 CWFA245A CWFA245B CWFA246 CWFA246A CWFA246B CWFA247 CWFA247A CWFA247B CWFA248 CWFA248A CWFA248B CWFA249 CWFA249A CWFA249B CWFA250 CWFA250A CWFA250B CWFA251 CWFA251A CWFA251B CWFA252 CWFA252A CWFA252B CWFA253 CWFA253A CWFA253B CWFA254 CWFA254A CWFA254B CWFA255 CWFA255A CWFA255B CWFA28 CWFA28A CWFA28B CWFA34 CWFA34A CWFA34B CWFA35 CWFA35A CWFA35B CWFA36 CWFA36A CWFA36B CWFA37 CWFA37A CWFA37B CWFA38 CWFA38A CWFA38B CWFA39 CWFA39A CWFA39B CWFA43 CWFA43A CWFA43B CWFA44 CWFA44A CWFA44B CWFA46 CWFA46A CWFA46B CWFA47 CWFA47A CWFA47B CWFA48 CWFA48A CWFA48B CWFA49 CWFA49A CWFA49B CWFA70 CWFA70A CWFA70B CWFA71 CWFA71A CWFA71B CWFA72 CWFA72A CWFA72B CWFA75 CWFA75A CWFA75B CWFA77 CWFA77A CWFA77B CWFA78 CWFA78A CWFA78B CWFA94 CWFA94A CWFA94B CWFA96 CWFA96A CWFA96B CWTAF CWTAK CWTAS DZW_AOG DZW_AUG FBA_AOG FBA_AUG FLR_AOG FLR_AUG FNS_AOG FNS_AUG FRK_AOG FRK_AUG FST_AOG FST_AUG FVA_AOG FVA_AUG FWL_AOG FWL_AUG GRAOFLOGIN GRAONLOGIN HLOFFLOGIN HLONLOGIN KLOGIN LFWOFLOGIN LFWONLOGIN LUEN1LOGIN LUEN2LOGIN LUEN3LOGIN MDR_AOG MDR_AUG MWNTKB0 MWNTKB1 MWNTKB10 MWNTKB11 MWNTKB12 MWNTKB13 MWNTKB14 MWNTKB15 MWNTKB16 MWNTKB17 MWNTKB18 MWNTKB19 MWNTKB2 MWNTKB20 MWNTKB21 MWNTKB22 MWNTKB23 MWNTKB24 MWNTKB25 MWNTKB3 MWNTKB4 MWNTKB5 MWNTKB6 MWNTKB7 MWNTKB8 MWNTKB9 NLS_AOG NLS_AUG RLX_AOG RLX_AUG SGIDB1 SGIDB2 SGIDB3 SLOGIN TKMWLMW TKMWLNA TKMWLNW TVLUFA107 TVLUFA108 TVLUFA109 TVLUFA130 TVLUFA140 TVLUFA145 TVLUFA146 TVLUFA147 TVLUFA148 TVLUFA149 TVLUFA152 TVLUFA162 TVLUFA163 TVLUFA166 TVLUFA167 TVLUFA168 TVLUFA187 TVLUFA188 TVLUFA189 TVLUFA190 TVLUFA191 TVLUFA192 TVLUFA193 TVLUFA194 TVLUFA195 TVLUFA196 TVLUFA197 TVLUFA198 TVLUFA199 TVLUFA201 TVLUFA202 TVLUFA203 TVLUFA204 TVLUFA205 TVLUFA206 TVLUFA207 TVLUFA208 TVLUFA209 TVLUFA210 TVLUFA211 TVLUFA212 TVLUFA213 TVLUFA214 TVLUFA215 TVLUFA216 TVLUFA217 TVLUFA218 TVLUFA219 TVLUFA220 TVLUFA221 TVLUFA222 TVLUFA223 TVLUFA224 TVLUFA225 TVLUFA226 TVLUFA227 TVLUFA228 TVLUFA229 TVLUFA230 TVLUFA231 TVLUFA232 TVLUFA233 TVLUFA234 TVLUFA235 TVLUFA236 TVLUFA237 TVLUFA238 TVLUFA239 TVLUFA240 TVLUFA241 TVLUFA242 TVLUFA243 TVLUFA244 TVLUFA245 TVLUFA246 TVLUFA247 TVLUFA248 TVLUFA249 TVLUFA250 TVLUFA251 TVLUFA252 TVLUFA253 TVLUFA254 TVLUFA255 TVLUFA28 TVLUFA34 TVLUFA35 TVLUFA36 TVLUFA37 TVLUFA38 TVLUFA39 TVLUFA43 TVLUFA44 TVLUFA46 TVLUFA47 TVLUFA48 TVLUFA49 TVLUFA70 TVLUFA71 TVLUFA72 TVLUFA75 TVLUFA77 TVLUFA78 TVLUFA94 TVLUFA96 VARDEF VVR_AOG VVR_AUG /end DEF_CHARACTERISTIC
 /begin REF_CHARACTERISTIC CWBGELSV CWCANKBI CWCS_0_A CWCS_1_A CWDEZWO CWGGFGRH CWGRABH CW_CAN_R_0___A CW_CAN_R_1___A CW_CAN_R_2___A CW_CAN_R_3___A CW_CAN_R_4___A CW_CAN_R_5___A CW_CAN_R_6___A CW_CAN_R_7___A CW_CAN_RA KVNPZ LRNVB_T MDNORM TVETRMN TVLU1MN TVLU2MN /end REF_CHARACTERISTIC
 /begin IN_MEASUREMENT abo aebkvpl_w aeqkv_w afmimn afmimx afnmn afnmx ahkat ahkat2 ahkatn ahkatn2 ahktki2_w ahktki_w ahktnk ahktnk2 akatbn akatbn2 anzdyn anzdyn2 anzmsls_w apedkt apedkt2 avdtev bbdcy bbwuc B_abgle B_abkl B_adshs B_afklt B_afwrm B_airbag B_airbz B_aircan B_atmtpa B_atmtpa2 B_atmtpk B_atmtpk2 B_autget B_ba B_bela B_bevab B_bevab2 B_bkvp B_bl B_bm B_br B_br2k B_brems B_bztafx B_cankbi B_cdbkvp B_cddsbkv B_crcan B_ddylash B_dfrmoff B_dfrmoff2 B_dknolu B_dktakt B_dktakt2 B_dktb B_dktnr B_dktsb B_dktsb2 B_dktsp B_dktsp2 B_dkvsf B_dlahieg B_dlahieg2 B_dlash B_dlash2 B_dllr B_dnws B_dnwsa B_dnwse B_ds B_dshen B_dshen2 B_dsl B_dsl1 B_dsl2 B_dsl3 B_dsl4 B_dsl5 B_dslerr B_dslmab B_dslme B_dslmes B_dslo B_dsloab B_dsloe B_dsls B_dslset B_dsltab B_dteaa B_dteaab B_dteaam B_dteabu B_dteabum B_dteanfl B_dteendl B_dteenf B_dteikanm B_dtelbm B_dtelnm B_dtephm B_dtepm B_dteres B_dternm B_dtes B_dtest B_dtevto B_dtezam B_dtezamh B_dushsch B_dylash B_dylsu B_dylsuav B_dylsuav2 B_edkvs B_edkvs2 B_ehfs B_ekp B_elaof B_elaof2 B_elsu B_elsu2 B_elsuwi B_enlash B_entest B_epwmcs B_errofs B_eshlsu B_eshlsu2 B_etafix B_evloc B_fasla B_faslarq B_fempos B_fempus B_fgratc B_fgren B_fgrhsc B_fgrsec B_fgrtdc B_fgrtuc B_fgrwac B_fkmsmn B_fkmsmx B_fkpvdk B_fkpvmn B_fkpvmx B_fofr1 B_fofrun B_fofstp B_fonstp B_for B_for00 B_for01 B_for02 B_for03 B_for04 B_for05 B_for06 B_for07 B_for08 B_for09 B_for10 B_for11 B_for12 B_for13 B_for14 B_for15 B_for16 B_for17 B_for18 B_for19 B_for20 B_for21 B_for22 B_for23 B_forn B_forn01 B_forn02 B_forn03 B_forn04 B_forn05 B_forn06 B_forn07 B_forn08 B_fprakt B_fproe B_fprook B_fprordy B_fprovb B_fprrdy B_fprzab B_fprze B_fprzok B_fprzvb B_frao B_frau B_fraur B_frmax B_frmax2 B_frmin B_frmin2 B_fs B_furena B_fztafx B_gae B_gaefra B_gaeing B_gafraos B_gafraus B_gap B_gasp B_heatf B_helsu B_helsuf B_henrin B_henrin2 B_heulsu B_hfm B_hlanws B_hlenws B_hlsumx B_hlsumx2 B_hpllsue B_hpllsue2 B_hrlsaus B_hrlsunp B_hrlsunp2 B_hshe B_hshe2 B_hstlsua B_hsv B_hsv2 B_hsve B_hsve2 B_hztanl B_kd B_kfzk B_kh B_khab B_khll B_khoab B_kmtre B_koe B_kosrc B_kpl B_kr B_krdws B_krldy B_krndy B_kuppl B_lalgf B_lambts B_lambts2 B_lamfas B_lamka B_lamka2 B_lamlash B_lamlash2 B_lamlshv B_lamlshv2 B_lamnswl B_lamverg B_ll B_llhzta B_lr B_lr2 B_lra B_lra2 B_lrar B_lrhk B_lrhk2 B_lrhkp B_lrhkp2 B_lrka B_lrka2 B_lrnakt B_lrnerf B_lrnrdy B_lrnvb B_lrnws B_lrs B_lrs2 B_lsahksp B_lshkpft B_lshkpft2 B_lshkpmr B_lshkpmr2 B_lshswok B_lshswok2 B_lsufta B_lsufta2 B_lsuftb B_lsuftb2 B_lsuiamn B_lsuiamx B_lsulone B_lsulone2 B_lsumra B_lsumra2 B_lsumrb B_lsumrb2 B_lsuna B_lsuna2 B_lsupft B_lsupft2 B_lsupmr B_lsupmr2 B_lsurfc B_lsuunmn B_lsuunmx B_lsuvmmn B_lsuvmmx B_luft B_luft2 B_lustop B_madfk B_madfs B_madko B_madll B_mdarv B_mdkat B_mdstop B_mibeg B_mil B_milabg B_milkat B_milstp B_mldyn B_mlustest B_mnslspr B_mnslspr2 B_mslmin B_mslmin2 B_msloff B_mslon B_mxslvpr B_mxslvpr2 B_nac B_negat B_nldtafx B_nlpe B_nlperf B_nlsgls B_nmot B_nowuc B_nphsv B_nplflsh B_nplflsh2 B_nplsv B_npsna B_npsna2 B_nwflada B_nwflade B_nwrposa B_nwrpose B_nws B_phad B_phad2 B_phada B_phade B_plenvh B_plenvh2 B_plra B_pwf B_rengat B_ricalf B_ricalf2 B_rineza B_rineza2 B_rinh B_rinh2 B_rinnp B_rinnp2 B_risigh B_risigh2 B_rkam B_rkat B_rkatr B_rkaz B_rmsval B_sa B_sacc B_sbbhk B_sbbhk2 B_sbblsu B_sbbvk B_sbbvk2 B_sfsc B_sigflsh B_sigflsh2 B_skoc B_sksc B_sla B_slar B_slas B_slkhof B_slpena B_slpoff B_slpofst B_slsinhi B_slsoab B_slsoff B_spsa B_spsa2 B_stellad B_su B_synph B_syserrk B_tabgbts B_tahrmn B_tahrmn2 B_tahrmx B_tahrmx2 B_tal B_talval B_te B_tehb B_telshv B_telshv2 B_teslash B_teviog B_teviol B_teviop B_tevior B_tevnio B_tkatbts B_trfash B_trfash2 B_trip B_trkh B_trsah B_ttbmhh B_uhsig B_umae B_umauab B_ushkf B_ushkf2 B_ushkm B_ushkm2 B_ushsch B_vekat B_vekat2 B_vhlsu B_vhlsu2 B_vl B_wk B_wkauf B_wkr B_wnws0a B_wnws0e B_ztafix B_zwp cmibeg_w cserk ctrerf1 ctrzyf0 ctrzyf1 ctr_phada ctr_phade dcycnt dfrmoff2_w dfrmoff_w dfse dfseresz dgafram_w dkatakt2_w dkatakt_w dkmts dlahi2_w dlahico2_w dlahico_w dlahi_w dlahp2_w dlahpco2_w dlahpco_w dlahp_w dlashkm_w dmletanf_w dmletan_w dmllri_w dmllr_w dmrlash_w dmvadfk_w dmvadfs_w dmvadko_w dmvadll_w dmvad_w drlfue_w dtmabsta dtmtka dulsuhe_w dwkrz dwnwfde_w dwnwsp2_w dwnwsp_w dwped dynlsu2_w dynlsu_w dzlsu_w etazwbm facipkr_w fcmEnd fdmd fgrablir fgrablr fho fkatei fkmsdks_w fkmsdk_w fkpvdkg_w fkpvdk_w flakh flmx_w flutskzy_w fmdkh fmsla fmsla2 fofresz fprstep_c fprtim_c fpvdk fr2_w fra2_w frao2_w frao_w frau2_w frau_w fra_w frm2_w frmfdif_w frmfref_w frmitf_w frm_w fr_w fseof1 fseof2 fseof3 fseof4 fseof5 ftead_w ftefsoll_w ftefva_w fukabak_w fukabaw_w fukavak_w fukavaw_w fzabgs_w fzabg_w fzmd gangi ikakdiff_w ikakormf_w ikakreff_w imlatm_w imlbbo imlkvs_w imllaka_w imlplhe_w imlpr ivzabg_w katbf katbf2 katbfi2_w katbfi_w katbfs katbfs2 katbshd2_w katbshd_w kldfpwm kmdp1km_w kmstand_w kmstmil_w kmst_w krivk2_w krivk_w ksta0 ksta1 ksta2 kstaa kusvk2_w kusvkft2_w kusvkft_w kusvk_w kvakbi_w ladiff2_w ladiff_w lambts_w lamelsh2_w lamelsh_w lamfa_w lamlash2_w lamlash_w lamsbg2_w lamsbg_w lamsoni2_w lamsoni_w lamsons2_w lamsons_w lamzak_w lbz lrnstat lrnstep_c lrntim_c lrnvb_c luar_w lws_w m6smsl_w m6wmslv_w m6wmsl_w mds_w mdverb mdverl_w miasrl_w miasrs_w miext_w mifab_w mifafu_w mifa_w miges_w migs_w miist_w milsol_w mimax_w mimin_w misol_w miszul_w mizsol_w mkllsc mkolsc ml mldmn_w mldmx_w mldyn_w mlhfmm_w ml_w mrfa_w mrfgr_w mrped_w msabg2_w msabg_w msdk_w mshfm_w msl mslift mslift2 mslt2_w mslt_w mslv2_w mslvt2_w mslvt_w mslv_w msndko_w mspcv mstedtef_w nllkh nlp1tim nmot nmotll nmot_w nsol o2vk_w ofmsndk_w olfst1_w palsu_w pbkv pbkvmod_w pbkv_w perfmax_w phlsnh phlsnh2 pkodrc prhlsub2_w prhlsub_w prhrlsu2_w prhrlsu_w ps_w pukorf_w pu_w pvdk pvdkds_w pvdks_w ready rinh2_w rinh_w rinlsu2_w rinlsu_w rinsh2_w rinsh_w rk2_w rkat2_w rkat_w rkaz2_w rkaz_w rkrn_w rkte_w rk_w rl rlossCtr_w rlp rlsol_w rl_w rmsl rmsl2 rmslf rmslf2 rmslt rmslt2 rmstevuf_w rmstev_w sdulsumx_w statgra sumode swolfst_w systemStackUsage S_fgrat S_fgrhs S_fgrsv S_fgrwb tabgbts_w tabgm tabgm2 tabst_w tadtea tahrlsu2_w tahrlsu_w tahsomf2_w tahsomf_w tahsom_w tahso_w tamax tamin tans tanslin tanvk_w tanwra tanwre tateist tateout tatesoll tavvkm2_w tavvkm_w tavvk_w tbdbkvp_w te2_w tephc te_w tikatm2_w tikatm_w ti_b1 ti_b2 tka tkaakts tkaaktz tkalin tkatm tkatm2 tkerdcmn_w tkerlsu_w tkihkm2_w tkihkm_w tkivkm2_w tkivkm_w tkkta tkktat tlrs_w tmadb tmew tmkic tmot tmotlin tmotsoll tmrw tmrwend tmst tnlkmtr_w tnse_w tnst_w tolc top_w tumc tumg tvkmtr tvlues1 tvlues2 tvluesic tvluessc ua10mo_w ub ubrsq ubsq udknlp1r udknlp2r udkp1asr_w udkp1a_w udkp1_w udkp2asr_w udkp2a_w udkp2_w udsl_w udst_w udsu_w uhepoti uhfm_w uhsv uhsv2 upwg1_w upwg2_w upwkd_w userStackUsage ushdktp ushdktp2 ushfmxstg ushfmxstg2 ushk ushk2 ushkmxstg ushkmxstg2 ushksteig usvkk_w uulsuv2_w uulsuv_w vfil_w vfzg vfzroh_w vziel_w wdk1 wdk2 wdk3 wdkada_w wdkba wdks wkrdya wkrm wkrma wnwadmna_w wnwadmne_w wnwadmxe_w wnwass wnwa_w wnweos wnwe_w wnwi2_w wnwim_w wnwisa_w wnwise_w wnwi_ad_w wnwi_w wnwkor_w wnwkwas2_w wnwkwas_w wnwsa_w wnwsenp_w wnwse_w wnwsfaa_w wnwsfae_w wnwsp2_w wnwsp_w wped_w wtans wtmot_w wtol wub wubr wuccnt zbeztafix zfzptafx zlash2_w zlash_w zlkd zllptafx zlrs_w zlshver_w zlshvok_w znldtafx_w zwbas zwdynsh zwdynsh2 zwist zwout zwsol zzuend /end IN_MEASUREMENT
 /begin OUT_MEASUREMENT B_aagsg B_acc B_accen B_craus B_fa B_faa B_faagr B_faam B_faan B_faatm B_fabks B_fabkv B_fadesu B_fadylsu B_fadylsu2 B_faevz B_faezla B_fafrst B_fahsh B_faiumpr B_fakat B_fakat2 B_fakd B_fakmtr B_fakrs B_fakth B_fakth2 B_fakvs B_falbk B_faldp B_falr B_falra B_falrsfk B_falrshk B_falrshk2 B_falsf B_falsf2 B_falsfhv B_falsfhv2 B_falsh B_falsh2 B_falshv B_falsv B_falsv2 B_falues B_falzsr B_fan B_fanohk B_fanwkw B_fanwkwa B_fanwkwe B_fanws B_fanwsa B_fanwse B_fapllsu B_fapllsu2 B_fasalsu B_fasf B_fasf2 B_fash B_fash2 B_fasls B_fates B_fatnv B_fatnv2 B_fatp B_fatp2 B_fatv B_fatv2 B_fgrte B_fgrteen B_grdst B_hlon B_kstebf B_lfw B_lrndia B_lrndiaur B_luef1 B_luef2 B_luef3 tvluesfa vstagr vstcns vstdzw vstfba vstfns vstfrk vstfst vstfva vstfwl vstlr vstmdr vstnls vstrlx vstvvr /end OUT_MEASUREMENT
/end FUNCTION
/begin FUNCTION TKSTA "3.290" /begin DEF_CHARACTERISTIC CWKUEKD CWSTAKD CWSTAKD2 CWSTEVKD TTVLU1MX TTVLU2MX /end DEF_CHARACTERISTIC /begin IN_MEASUREMENT B_cdbkvp B_hlon B_slsfz nmot_w /end IN_MEASUREMENT
 /begin OUT_MEASUREMENT actuatorCtr actuatorTimeout_ctr arqtgls2_w arqtglst_w arqtmos2_w arqtmost_w b_actuator B_EV_Test B_rqtglst B_rqtmost B_start_kmtraction B_sttakt /end OUT_MEASUREMENT
/end FUNCTION
/begin FUNCTION TP_CAN "20.20" /end FUNCTION
/begin FUNCTION TREV_OV "" /begin OUT_MEASUREMENT B_trev_inc trevovCtr /end OUT_MEASUREMENT /end FUNCTION
/begin FUNCTION TUNING "" /begin REF_CHARACTERISTIC SGIDB5 /end REF_CHARACTERISTIC /begin IN_MEASUREMENT B_pwf /end IN_MEASUREMENT /begin LOC_MEASUREMENT B_sersw B_tDelayEnd B_tuning ctr_hscmp tun_det tun_errcode /end LOC_MEASUREMENT /end FUNCTION
/begin FUNCTION UFACCC "7.10" /begin OUT_MEASUREMENT B_noacc_um /end OUT_MEASUREMENT /end FUNCTION
/begin FUNCTION UFEING "14.30" /begin IN_MEASUREMENT B_dknolu B_dkpu B_ub_ok tans tmot /end IN_MEASUREMENT /begin OUT_MEASUREMENT tans_um tmot_um /end OUT_MEASUREMENT /end FUNCTION
/begin FUNCTION UFEINS "" /begin DEF_CHARACTERISTIC NMV08_UM RLV08_UM SPSNV08_UM /end DEF_CHARACTERISTIC /begin IN_MEASUREMENT nmot_um rl_um spsn_um /end IN_MEASUREMENT /begin OUT_MEASUREMENT nmst08_um rlst08_um spsnst08_um /end OUT_MEASUREMENT /end FUNCTION
/begin FUNCTION UFFGRC "19.20" /begin DEF_CHARACTERISTIC VMINACC_UM VMIN_UM /end DEF_CHARACTERISTIC /begin IN_MEASUREMENT B_fgr mifa vfzg_w /end IN_MEASUREMENT /begin OUT_MEASUREMENT B_fgr_um mfgr_um /end OUT_MEASUREMENT /end FUNCTION
/begin FUNCTION UFFGRE "14.40"
 /begin DEF_CHARACTERISTIC BGRA_T_UM BRACC_T_UM BREMS_T_UM BRESP_T_UM BZGRA_T_UM CHKSFGR_UM DBGRAMX_UM DBGRA_T_UM /end DEF_CHARACTERISTIC
 /begin REF_CHARACTERISTIC CWGRABH /end REF_CHARACTERISTIC
 /begin IN_MEASUREMENT B_acc B_bkva B_bkvv B_fabr B_fgrab S_bls S_brs S_fgrat S_fgrhs S_fgrsv S_fgrwb /end IN_MEASUREMENT
 /begin LOC_MEASUREMENT b2gra_um b3gra_um bgra_c_um bracc_c_um brems_c_um bresp_c_um bzgra_a_um bzgra_c_um B_bgrae_um B_graat_um B_graen_um B_grahe_um B_grahs_um B_grase_um B_gratd_um B_gratu_um B_grawa_um dbgra_c_um /end LOC_MEASUREMENT
/end FUNCTION
/begin FUNCTION UFMIST "19.20"
 /begin DEF_CHARACTERISTIC KFMI_UM KFZW_UM KLDZWOM_UM KLETAZW_UM KLFAKSP_UM KLZL1_UM KLZL2_UM NSC_T2_UM TMISTMN_UM /end DEF_CHARACTERISTIC
 /begin REF_CHARACTERISTIC NMV08_UM RLV08_UM /end REF_CHARACTERISTIC
 /begin IN_MEASUREMENT frksch_um lamb1_um lamb2_um nmot_um nmst08_um nsc_c_um rlst08_um rl_um tmot_um zw1_um zw2_um /end IN_MEASUREMENT
 /begin OUT_MEASUREMENT mi_um /end OUT_MEASUREMENT
 /begin LOC_MEASUREMENT dzw1_um dzw2_um dzw_um etafrks_um etazw_um miopt_um tmnist_um zwopt_um zwout_um /end LOC_MEASUREMENT
/end FUNCTION
/begin FUNCTION UFMSRC "29.40" /begin DEF_CHARACTERISTIC BZMSR_T_UM DBMSRMX_UM DBMSR_T_UM MSRC_T_UM NOASR_UM /end DEF_CHARACTERISTIC /begin IN_MEASUREMENT B_nomsr_fr /end IN_MEASUREMENT /begin OUT_MEASUREMENT B_nomsr_um B_npmsr_um ei_msrc_um mmsr_um /end OUT_MEASUREMENT /begin LOC_MEASUREMENT bzmsr_a_um bzmsr_c_um dbmsr_c_um msrc_c_um /end LOC_MEASUREMENT /end FUNCTION
/begin COMPU_METHOD bfgrsc_ub_q0p024_o3p984 "" RAT_FUNC "%6.3" "m/(s^2)" COEFFS 0 1 3.984 0 0 0.024 /end COMPU_METHOD
/begin COMPU_METHOD B_TRUE "" TAB_VERB "%6.3" "" COMPU_TAB_REF B_TRUE /end COMPU_METHOD
/begin COMPU_VTAB B_TRUE "" TAB_VERB 2 0 "----" 1 "TRUE" /end COMPU_VTAB
/begin COMPU_METHOD dez "" RAT_FUNC "%6.2" "" COEFFS 0 1 0 0 0 1 /end COMPU_METHOD
/begin COMPU_METHOD dfp_verbal "" TAB_VERB "%6.3" "" COMPU_TAB_REF dfp_verbal /end COMPU_METHOD
/begin COMPU_VTAB dfp_verbal "" TAB_VERB 193 0 "DFP_AAA" 1 "DFP_AATUN" 2 "DFP_AKRE" 3 "DFP_ANWS" 4 "DFP_ANWSE" 5 "DFP_ASGNPL" 6 "DFP_BKVP" 7 "DFP_BKVPE" 8 "DFP_BM" 9 "DFP_BREMS" 10 "DFP_BZNPL" 11 "DFP_CAIR" 12 "DFP_CAIRP" 13 "DFP_CAS" 14 "DFP_CAT" 15 "DFP_CBR2" 16 "DFP_CBSG" 17 "DFP_CGAT" 18 "DFP_CGE" 19 "DFP_CGRA" 20 "DFP_CIF" 21 "DFP_CINS" 22 "DFP_CKLA" 23 "DFP_CLWS" 24 "DFP_CTOG" 25 "DFP_CZAS" 26 "DFP_DK" 27 "DFP_DK1P" 28 "DFP_DK2P" 29 "DFP_DPL" 30 "DFP_DSBKV" 31 "DFP_DSU" 32 "DFP_DVEE" 33 "DFP_DVEF" 34 "DFP_DVEFO" 35 "DFP_DVEL" 36 "DFP_DVEN" 37 "DFP_DVER" 38 "DFP_DVET" 39 "DFP_DVEU" 40 "DFP_DVEUB" 41 "DFP_DVEUW" 42 "DFP_DVEV" 43 "DFP_DYLSU" 44 "DFP_DYLSU2" 45 "DFP_EGFE" 46 "DFP_EGSBGR" 47 "DFP_ENWS" 48 "DFP_ENWSE" 49 "DFP_EPCLE" 50 "DFP_EV1" 51 "DFP_EV2" 52 "DFP_EV3" 53 "DFP_EV4" 54 "DFP_EV5" 55 "DFP_EV6" 56 "DFP_FKU" 57 "DFP_FP1P" 58 "DFP_FP2P" 59 "DFP_FRAO" 60 "DFP_FRAO2" 61 "DFP_FRAU" 62 "DFP_FRAU2" 63 "DFP_FRST" 64 "DFP_FRST2" 65 "DFP_GECOD" 66 "DFP_GRBH" 67 "DFP_HELSU" 68 "DFP_HELSU2" 69 "DFP_HRE" 70 "DFP_HSH" 71 "DFP_HSH2" 72 "DFP_HSHE" 73 "DFP_HSHE2" 74 "DFP_HSV" 75 "DFP_HSV2" 76 "DFP_HSVE" 77 "DFP_HSVE2" 78 "DFP_ICLSU" 79 "DFP_ICLSU2" 80 "DFP_KAT" 81 "DFP_KAT2" 82 "DFP_KPE" 83 "DFP_KRA01" 84 "DFP_KRA02" 85 "DFP_KRA03" 86 "DFP_KRA04" 87 "DFP_KRA05" 88 "DFP_KRA06" 89 "DFP_KRNT" 90 "DFP_KROF" 91 "DFP_KRTP" 92 "DFP_KS1" 93 "DFP_KS2" 94 "DFP_KS3" 95 "DFP_KS4" 96 "DFP_KUPPL" 97 "DFP_LASH" 98 "DFP_LASH2" 99 "DFP_LAVH" 100 "DFP_LAVH2" 101 "DFP_LDPE" 102 "DFP_LLR" 103 "DFP_LM" 104 "DFP_LSH" 105 "DFP_LSH2" 106 "DFP_LSHV" 107 "DFP_LSUIA" 108 "DFP_LSUIA2" 109 "DFP_LSUIP" 110 "DFP_LSUIP2" 111 "DFP_LSUKS" 112 "DFP_LSUKS2" 113 "DFP_LSUUN" 114 "DFP_LSUUN2" 115 "DFP_LSUVM" 116 "DFP_LSUVM2" 117 "DFP_LSV" 118 "DFP_LSV2" 119 "DFP_LSVV" 120 "DFP_LUE1" 121 "DFP_LUES1E" 122 "DFP_MA" 123 "DFP_MD" 124 "DFP_MD00" 125 "DFP_MD01" 126 "DFP_MD02" 127 "DFP_MD03" 128 "DFP_MD04" 129 "DFP_MD05" 130 "DFP_MDB" 131 "DFP_MFA" 132 "DFP_N" 133 "DFP_NWKW" 134 "DFP_NWKW2" 135 "DFP_NX" 136 "DFP_PH" 137 "DFP_PH2" 138 "DFP_PLLSU" 139 "DFP_PLLSU2" 140 "DFP_PWGDE" 141 "DFP_RKAT" 142 "DFP_RKAT2" 143 "DFP_RKAZ" 144 "DFP_RKAZ2" 145 "DFP_SCR" 146 "DFP_SGEEP" 147 "DFP_SGEEW" 148 "DFP_SLPE" 149 "DFP_SLS" 150 "DFP_SLS2" 151 "DFP_SLV" 152 "DFP_SLV2" 153 "DFP_SLVE" 154 "DFP_SUE" 155 "DFP_SWE" 156 "DFP_TA" 157 "DFP_TANKL" 158 "DFP_TES" 159 "DFP_TESF" 160 "DFP_TESG" 161 "DFP_TEVE" 162 "DFP_TEVE2" 163 "DFP_TKA" 164 "DFP_TM" 165 "DFP_TMKI" 166 "DFP_TOL" 167 "DFP_TUM" 168 "DFP_UB" 169 "DFP_UBR" 170 "DFP_UFMV" 171 "DFP_UFNC" 172 "DFP_UFRLIP" 173 "DFP_UFSGA" 174 "DFP_UFSGB" 175 "DFP_UFSKA" 176 "DFP_UFSPSC" 177 "DFP_ULSU" 178 "DFP_ULSU2" 179 "DFP_URRAM" 180 "DFP_URROM" 181 "DFP_URRST" 182 "DFP_VFZ" 183 "DFP_WFS" 184 "DFP_WFSRC" 185 "DFP_ZET1" 186 "DFP_ZET2" 187 "DFP_ZET3" 188 "DFP_ZET4" 189 "DFP_ZET5" 190 "DFP_ZET6" 191 "DFP_ZWPE" 192 "DFP_ZZZ" /end COMPU_VTAB
/begin COMPU_METHOD fak_q0p000488 "" RAT_FUNC "%6.5" "-" COEFFS 0 65536 0 0 0 32 /end COMPU_METHOD
/begin COMPU_METHOD fak_q0p00195 "" RAT_FUNC "%6.4" "-" COEFFS 0 65536 0 0 0 128 /end COMPU_METHOD
/begin COMPU_METHOD fak_q0p0039 "" RAT_FUNC "%6.4" "-" COEFFS 0 256 0 0 0 1 /end COMPU_METHOD
/begin COMPU_METHOD fak_sb_b1 "" RAT_FUNC "%6.4" "-" COEFFS 0 256 0 0 0 2 /end COMPU_METHOD
/begin COMPU_METHOD fak_sb_b16 "" RAT_FUNC "%6.3" "-" COEFFS 0 256 0 0 0 32 /end COMPU_METHOD
/begin COMPU_METHOD fak_sb_b2 "" RAT_FUNC "%6.4" "-" COEFFS 0 256 0 0 0 4 /end COMPU_METHOD
/begin COMPU_METHOD fak_sb_b64 "" RAT_FUNC "%6.3" "-" COEFFS 0 256 0 0 0 128 /end COMPU_METHOD
/begin COMPU_METHOD fak_sb_q0p5 "" RAT_FUNC "%6.3" "-" COEFFS 0 256 0 0 0 128 /end COMPU_METHOD
/begin COMPU_METHOD fak_sw_b1 "" RAT_FUNC "%7.6" "-" COEFFS 0 65536 0 0 0 2 /end COMPU_METHOD
/begin COMPU_METHOD fak_sw_b2 "" RAT_FUNC "%7.6" "-" COEFFS 0 65536 0 0 0 4 /end COMPU_METHOD
/begin COMPU_METHOD fak_sw_b64 "" RAT_FUNC "%6.4" "-" COEFFS 0 65536 0 0 0 128 /end COMPU_METHOD
/begin COMPU_METHOD fak_ub_b0p03125 "" RAT_FUNC "%6.5" "-" COEFFS 0 256 0 0 0 0.03125 /end COMPU_METHOD
/begin COMPU_METHOD fak_ub_b0p5 "" RAT_FUNC "%6.4" "-" COEFFS 0 256 0 0 0 0.5 /end COMPU_METHOD
/begin COMPU_METHOD fak_ub_b1 "" RAT_FUNC "%6.4" "-" COEFFS 0 256 0 0 0 1 /end COMPU_METHOD
/begin COMPU_METHOD fak_ub_b16 "" RAT_FUNC "%6.4" "-" COEFFS 0 256 0 0 0 16 /end COMPU_METHOD
/begin COMPU_METHOD fak_ub_b1p25_o0p75 "" RAT_FUNC "%6.3" "-" COEFFS 0 1 -0.75 0 0 0.00195313 /end COMPU_METHOD
/begin COMPU_METHOD fak_ub_b2 "" RAT_FUNC "%6.4" "-" COEFFS 0 256 0 0 0 2 /end COMPU_METHOD
/begin COMPU_METHOD fak_ub_b32 "" RAT_FUNC "%6.3" "-" COEFFS 0 256 0 0 0 32 /end COMPU_METHOD
/begin COMPU_METHOD fak_ub_b4 "" RAT_FUNC "%6.4" "-" COEFFS 0 256 0 0 0 4 /end COMPU_METHOD
/begin COMPU_METHOD fak_ub_b64 "" RAT_FUNC "%6.3" "-" COEFFS 0 256 0 0 0 64 /end COMPU_METHOD
/begin COMPU_METHOD fak_ub_b8 "" RAT_FUNC "%6.4" "-" COEFFS 0 256 0 0 0 8 /end COMPU_METHOD
/begin COMPU_METHOD fak_uw_b0p5 "" RAT_FUNC "%8.7" "-" COEFFS 0 65536 0 0 0 0.5 /end COMPU_METHOD
/begin COMPU_METHOD fak_uw_b1 "" RAT_FUNC "%7.6" "-" COEFFS 0 65536 0 0 0 1 /end COMPU_METHOD
/begin COMPU_METHOD fak_uw_b16 "" RAT_FUNC "%6.5" "-" COEFFS 0 65536 0 0 0 16 /end COMPU_METHOD
/begin COMPU_METHOD fak_uw_b2 "" RAT_FUNC "%7.6" "-" COEFFS 0 65536 0 0 0 2 /end COMPU_METHOD
/begin COMPU_METHOD KennText "" RAT_FUNC "%6.2" "" COEFFS 0 1 0 0 0 1 /end COMPU_METHOD
/begin COMPU_METHOD kw_sw_b128 "" RAT_FUNC "%6.4" "Grad KW" COEFFS 0 65536 0 0 0 256 /end COMPU_METHOD
/begin COMPU_METHOD m_q2p777Em5 "" RAT_FUNC "%7.6" "kg/s" COEFFS 0 3600 0 0 0 0.1 /end COMPU_METHOD
/begin COMPU_METHOD m_sw_b3276p8 "" RAT_FUNC "%6.3" "kg/h" COEFFS 0 1 0 0 0 0.1 /end COMPU_METHOD
/begin COMPU_METHOD m_ub_b1020 "" RAT_FUNC "%6.2" "kg/h" COEFFS 0 1 0 0 0 4 /end COMPU_METHOD
/begin COMPU_METHOD m_ub_q0p0444 "" RAT_FUNC "%6.4" "g" COEFFS 0 1 0 0 0 0.0444 /end COMPU_METHOD
/begin COMPU_METHOD m_uw_b25p6 "" RAT_FUNC "%6.5" "kg/h" COEFFS 0 65536 0 0 0 25.6 /end COMPU_METHOD
/begin COMPU_METHOD m_uw_b6553p5 "" RAT_FUNC "%6.3" "kg/h" COEFFS 0 1 0 0 0 0.1 /end COMPU_METHOD
/begin COMPU_METHOD m_uw_q3p2 "" RAT_FUNC "%6.2" "kg/h" COEFFS 0 1 0 0 0 3.2 /end COMPU_METHOD
/begin COMPU_METHOD nmotg_sw_q0p39 "" RAT_FUNC "%6.3" "1/min/s" COEFFS 0 1 0 0 0 0.39063 /end COMPU_METHOD
/begin COMPU_METHOD nmot_q10 "" RAT_FUNC "%6.1" "1/min" COEFFS 0 1 0 0 0 10 /end COMPU_METHOD
/begin COMPU_METHOD nmot_sb_q10 "" RAT_FUNC "%6.1" "1/min" COEFFS 0 1 0 0 0 10 /end COMPU_METHOD
/begin COMPU_METHOD nmot_sw_q0p25 "" RAT_FUNC "%6.3" "1/min" COEFFS 0 1 0 0 0 0.25 /end COMPU_METHOD
/begin COMPU_METHOD nmot_ub_q10 "" RAT_FUNC "%6.1" "1/min" COEFFS 0 1 0 0 0 10 /end COMPU_METHOD
/begin COMPU_METHOD nmot_ub_q40 "" RAT_FUNC "%6.1" "1/min" COEFFS 0 1 0 0 0 40 /end COMPU_METHOD
/begin COMPU_METHOD nmot_uw_q0p25 "" RAT_FUNC "%6.3" "1/min" COEFFS 0 1 0 0 0 0.25 /end COMPU_METHOD
/begin COMPU_METHOD perio_sw_b1p562 "" RAT_FUNC "%7.6" "1/s" COEFFS 0 65536 0 0 0 3.124 /end COMPU_METHOD
/begin COMPU_METHOD perio_sw_b6p125 "" RAT_FUNC "%6.5" "1/s" COEFFS 0 65536 0 0 0 12.25 /end COMPU_METHOD
/begin COMPU_METHOD perio_ub_b0p012207 "" RAT_FUNC "%10.8" "1/s" COEFFS 0 256 0 0 0 0.012207 /end COMPU_METHOD
/begin COMPU_METHOD perio_ub_b6p125 "" RAT_FUNC "%6.4" "1/s" COEFFS 0 256 0 0 0 6.125 /end COMPU_METHOD
/begin COMPU_METHOD p_sb_q0p25 "" RAT_FUNC "%6.3" "hPa" COEFFS 0 1 0 0 0 0.25 /end COMPU_METHOD
/begin COMPU_METHOD p_ub_q5 "" RAT_FUNC "%6.2" "hPa" COEFFS 0 1 0 0 0 5 /end COMPU_METHOD
/begin COMPU_METHOD p_uw_q0p039 "" RAT_FUNC "%6.4" "hPa" COEFFS 0 256 0 0 0 10 /end COMPU_METHOD
/begin COMPU_METHOD relDK_ub_b100 "" RAT_FUNC "%6.3" "%DK" COEFFS 0 255 0 0 0 100 /end COMPU_METHOD
/begin COMPU_METHOD rel_q0p00195 "" RAT_FUNC "%6.4" "%" COEFFS 0 65536 0 0 0 128 /end COMPU_METHOD
/begin COMPU_METHOD rel_q0p02344 "" RAT_FUNC "%6.4" "%" COEFFS 0 32 0 0 0 0.75 /end COMPU_METHOD
/begin COMPU_METHOD rel_sw_q0p0468 "" RAT_FUNC "%6.4" "%" COEFFS 0 65536 0 0 0 3072 /end COMPU_METHOD
/begin COMPU_METHOD rel_ub_b127p5 "" RAT_FUNC "%6.3" "%" COEFFS 0 2 0 0 0 1 /end COMPU_METHOD
/begin COMPU_METHOD rel_ub_b200 "" RAT_FUNC "%6.3" "%" COEFFS 0 256 0 0 0 200 /end COMPU_METHOD
/begin COMPU_METHOD rel_ub_b25 "" RAT_FUNC "%6.3" "%" COEFFS 0 256 0 0 0 25 /end COMPU_METHOD
/begin COMPU_METHOD rel_ub_b99p6 "" RAT_FUNC "%6.3" "%" COEFFS 0 256 0 0 0 100 /end COMPU_METHOD
/begin COMPU_METHOD rel_ub_q0p03125 "" RAT_FUNC "%6.4" "%" COEFFS 0 256 0 0 0 8 /end COMPU_METHOD
/begin COMPU_METHOD rel_ub_q0p3906 "" RAT_FUNC "%6.3" "%" COEFFS 0 256 0 0 0 100 /end COMPU_METHOD
/begin COMPU_METHOD rel_ub_q0p75 "" RAT_FUNC "%6.3" "%" COEFFS 0 1 0 0 0 0.75 /end COMPU_METHOD
/begin COMPU_METHOD rel_uw_b100 "" RAT_FUNC "%6.4" "%" COEFFS 0 65536 0 0 0 100 /end COMPU_METHOD
/begin COMPU_METHOD rel_uw_b192 "" RAT_FUNC "%6.4" "%" COEFFS 0 65536 0 0 0 192 /end COMPU_METHOD
/begin COMPU_METHOD rel_uw_b200 "" RAT_FUNC "%6.4" "%" COEFFS 0 65536 0 0 0 200 /end COMPU_METHOD
/begin COMPU_METHOD rel_uw_q0p0234 "" RAT_FUNC "%6.4" "%" COEFFS 0 32 0 0 0 0.75 /end COMPU_METHOD
/begin COMPU_METHOD rgrad_uw_b1280 "" RAT_FUNC "%6.4" "%/s" COEFFS 0 65536 0 0 0 1280 /end COMPU_METHOD
/begin COMPU_METHOD spg_ubatt "" RAT_FUNC "%6.4" "V" COEFFS 0 1 0 0 0 0.0704 /end COMPU_METHOD
/begin COMPU_METHOD spg_ub_b5 "" RAT_FUNC "%6.4" "V" COEFFS 0 256 0 0 0 5 /end COMPU_METHOD
/begin COMPU_METHOD spg_ub_q0p0052_o0p2 "" RAT_FUNC "%6.3" "V" COEFFS 0 255 51 0 0 1.33 /end COMPU_METHOD
/begin COMPU_METHOD spg_ub_q0p019 "" RAT_FUNC "%6.4" "V" COEFFS 0 256 0 0 0 5 /end COMPU_METHOD
/begin COMPU_METHOD spg_uw_b5 "" RAT_FUNC "%6.4" "V" COEFFS 0 1024 0 0 0 5 /end COMPU_METHOD
/begin COMPU_METHOD spg_uw_q0p00488 "" RAT_FUNC "%6.4" "V" COEFFS 0 1024 0 0 0 5 /end COMPU_METHOD
/begin COMPU_METHOD t100msxs_ub_b25p5 "" RAT_FUNC "%6.3" "s" COEFFS 0 1 0 0 0 0.1 /end COMPU_METHOD
/begin COMPU_METHOD t100msxs_uw_b6553p5 "" RAT_FUNC "%6.3" "s" COEFFS 0 1 0 0 0 0.1 /end COMPU_METHOD
/begin COMPU_METHOD t100msxs_uw_q100 "" RAT_FUNC "%6.3" "s" COEFFS 0 1 0 0 0 0.1 /end COMPU_METHOD
/begin COMPU_METHOD t10msxs_sb_q0p01 "" RAT_FUNC "%6.4" "s" COEFFS 0 1 0 0 0 0.01 /end COMPU_METHOD
/begin COMPU_METHOD t10msxs_ub_b25p5 "" RAT_FUNC "%6.3" "s" COEFFS 0 1 0 0 0 0.1 /end COMPU_METHOD
/begin COMPU_METHOD t10msxs_uw_b655p35 "" RAT_FUNC "%6.4" "s" COEFFS 0 1 0 0 0 0.01 /end COMPU_METHOD
/begin COMPU_METHOD t16usxms_uw_b1048 "" RAT_FUNC "%6.4" "ms" COEFFS 0 65536 0 0 0 1048.58 /end COMPU_METHOD
/begin COMPU_METHOD t1sxs_uw_q1 "" RAT_FUNC "%6.2" "s" COEFFS 0 1 0 0 0 1 /end COMPU_METHOD
/begin COMPU_METHOD t20msxs_ub_b5p1 "" RAT_FUNC "%6.4" "s" COEFFS 0 1 0 0 0 0.02 /end COMPU_METHOD
/begin COMPU_METHOD t20msxs_ub_q0p32 "" RAT_FUNC "%6.3" "s" COEFFS 0 256 0 0 0 81.92 /end COMPU_METHOD
/begin COMPU_METHOD t40msxs_uw_q0p04 "" RAT_FUNC "%6.4" "s" COEFFS 0 1 0 0 0 0.04 /end COMPU_METHOD
/begin COMPU_METHOD t40ms_ub_b10200 "" RAT_FUNC "%7.2" "ms" COEFFS 0 1 0 0 0 40 /end COMPU_METHOD
/begin COMPU_METHOD t50msxs_q0p05 "" RAT_FUNC "%6.4" "s" COEFFS 0 1 0 0 0 0.05 /end COMPU_METHOD
/begin COMPU_METHOD t6minxmin_q6 "" RAT_FUNC "%6.2" "min" COEFFS 0 1 0 0 0 6 /end COMPU_METHOD
/begin COMPU_METHOD temp_q0p0234_o273 "" RAT_FUNC "%6.1" "Grad C" COEFFS 0 1 273.15 0 0 0.0234375 /end COMPU_METHOD
/begin COMPU_METHOD temp_q6_o273 "" RAT_FUNC "%6.1" "Grad C" COEFFS 0 1 273.15 0 0 6 /end COMPU_METHOD
/begin COMPU_METHOD temp_ub_q0p75 "" RAT_FUNC "%6.3" "Grad C" COEFFS 0 1 0 0 0 0.75 /end COMPU_METHOD
/begin COMPU_METHOD temp_ub_q0p75_o48 "" RAT_FUNC "%6.2" "Grad C" COEFFS 0 1 48 0 0 0.75 /end COMPU_METHOD
/begin COMPU_METHOD temp_ub_q5_o50 "" RAT_FUNC "%6.2" "Grad C" COEFFS 0 1 50 0 0 5 /end COMPU_METHOD
/begin COMPU_METHOD temp_uw_q0p75_o48 "" RAT_FUNC "%6.2" "Grad C" COEFFS 0 1 48 0 0 0.75 /end COMPU_METHOD
/begin COMPU_METHOD tinjection_sy "" RAT_FUNC "%6.4" "ms" COEFFS 0 312.5 0 0 0 1 /end COMPU_METHOD
/begin COMPU_METHOD tv_ub_b100 "" RAT_FUNC "%6.3" "%TV" COEFFS 0 256 0 0 0 100 /end COMPU_METHOD
/begin COMPU_METHOD t_min_q5p96em8 "" RAT_FUNC "%10.9" "min" COEFFS 0 1 0 0 0 5.96e-008 /end COMPU_METHOD
/begin COMPU_METHOD t_q0p01 "" RAT_FUNC "%6.4" "s" COEFFS 0 100 0 0 0 1 /end COMPU_METHOD
/begin COMPU_METHOD t_q0p04 "" RAT_FUNC "%6.4" "s" COEFFS 0 100 0 0 0 4 /end COMPU_METHOD
/begin COMPU_METHOD t_q1 "" RAT_FUNC "%6.2" "s" COEFFS 0 1 0 0 0 1 /end COMPU_METHOD
/begin COMPU_METHOD undefined "" RAT_FUNC "%6.2" "" COEFFS 0 1 0 0 0 1 /end COMPU_METHOD
/begin COMPU_METHOD vfzg_q1p0 "" RAT_FUNC "%6.2" "km/h" COEFFS 0 1 0 0 0 1 /end COMPU_METHOD
/begin COMPU_METHOD vfzg_uw_b512 "" RAT_FUNC "%6.4" "km/h" COEFFS 0 65536 0 0 0 512 /end COMPU_METHOD
/begin COMPU_METHOD zk100msxs_ub_b25p5 "" RAT_FUNC "%6.3" "s" COEFFS 0 0 256 0 10 0 /end COMPU_METHOD
/begin COMPU_METHOD zk100msxs_uw_b655 "" RAT_FUNC "%6.1" "s" COEFFS 0 0 65536 0 10 0 /end COMPU_METHOD
/begin COMPU_METHOD zk100msxs_uw_b6553 "" RAT_FUNC "%6.1" "s" COEFFS 0 0 65536 0 10 0 /end COMPU_METHOD
/begin COMPU_METHOD zk20msxs_uw_b1310 "" RAT_FUNC "%12.4" "s" COEFFS 0 0 65536 0 50 0 /end COMPU_METHOD
/begin COMPU_METHOD zw_sb_q0p75 "" RAT_FUNC "%6.3" "Grad KW" COEFFS 0 255 0 0 0 191.25 /end COMPU_METHOD
/begin COMPU_METHOD zw_ub_q0p75 "" RAT_FUNC "%6.3" "Grad KW" COEFFS 0 255 0 0 0 191.25 /end COMPU_METHOD
/begin RECORD_LAYOUT FklWUb FNC_VALUES 1 UBYTE COLUMN_DIR DIRECT /end RECORD_LAYOUT
/begin RECORD_LAYOUT GkfWSb FNC_VALUES 1 SBYTE COLUMN_DIR DIRECT /end RECORD_LAYOUT
/begin RECORD_LAYOUT GkfWUb FNC_VALUES 1 UBYTE COLUMN_DIR DIRECT /end RECORD_LAYOUT
/begin RECORD_LAYOUT GklWUb FNC_VALUES 1 UBYTE COLUMN_DIR DIRECT /end RECORD_LAYOUT
/begin RECORD_LAYOUT GklWUw FNC_VALUES 1 UWORD COLUMN_DIR DIRECT /end RECORD_LAYOUT
/begin RECORD_LAYOUT KfAxUbAyUbSstxSbSstyUbWUb NO_AXIS_PTS_X 1 UBYTE NO_AXIS_PTS_Y 2 UBYTE AXIS_PTS_X 3 SBYTE INDEX_INCR DIRECT AXIS_PTS_Y 4 UBYTE INDEX_INCR DIRECT FNC_VALUES 5 UBYTE COLUMN_DIR DIRECT /end RECORD_LAYOUT
/begin RECORD_LAYOUT KfAxUbAyUbSstxUbSstyUbWSb NO_AXIS_PTS_X 1 UBYTE NO_AXIS_PTS_Y 2 UBYTE AXIS_PTS_X 3 UBYTE INDEX_INCR DIRECT AXIS_PTS_Y 4 UBYTE INDEX_INCR DIRECT FNC_VALUES 5 SBYTE COLUMN_DIR DIRECT /end RECORD_LAYOUT
/begin RECORD_LAYOUT KfAxUbAyUbSstxUbSstyUbWUb NO_AXIS_PTS_X 1 UBYTE NO_AXIS_PTS_Y 2 UBYTE AXIS_PTS_X 3 UBYTE INDEX_INCR DIRECT AXIS_PTS_Y 4 UBYTE INDEX_INCR DIRECT FNC_VALUES 5 UBYTE COLUMN_DIR DIRECT /end RECORD_LAYOUT
/begin RECORD_LAYOUT KfAxUwAyUwSstxSwSstyUwWUw NO_AXIS_PTS_X 1 UWORD NO_AXIS_PTS_Y 2 UWORD AXIS_PTS_X 3 SWORD INDEX_INCR DIRECT AXIS_PTS_Y 4 UWORD INDEX_INCR DIRECT FNC_VALUES 5 UWORD COLUMN_DIR DIRECT /end RECORD_LAYOUT
/begin RECORD_LAYOUT KlAUbSstSbWSb NO_AXIS_PTS_X 1 UBYTE AXIS_PTS_X 2 SBYTE INDEX_INCR DIRECT FNC_VALUES 3 SBYTE COLUMN_DIR DIRECT /end RECORD_LAYOUT
/begin RECORD_LAYOUT KlAUbSstSwWUw NO_AXIS_PTS_X 1 UWORD AXIS_PTS_X 2 SWORD INDEX_INCR DIRECT FNC_VALUES 3 UWORD COLUMN_DIR DIRECT /end RECORD_LAYOUT
/begin RECORD_LAYOUT KlAUbSstUbWSb NO_AXIS_PTS_X 1 UBYTE AXIS_PTS_X 2 UBYTE INDEX_INCR DIRECT FNC_VALUES 3 SBYTE COLUMN_DIR DIRECT /end RECORD_LAYOUT
/begin RECORD_LAYOUT KlAUbSstUbWUb NO_AXIS_PTS_X 1 UBYTE AXIS_PTS_X 2 UBYTE INDEX_INCR DIRECT FNC_VALUES 3 UBYTE COLUMN_DIR DIRECT /end RECORD_LAYOUT
/begin RECORD_LAYOUT KlAUwSstUwWUw NO_AXIS_PTS_X 1 UWORD AXIS_PTS_X 2 UWORD INDEX_INCR DIRECT FNC_VALUES 3 UWORD COLUMN_DIR DIRECT /end RECORD_LAYOUT
/begin RECORD_LAYOUT KwbUb FNC_VALUES 1 UBYTE COLUMN_DIR DIRECT /end RECORD_LAYOUT
/begin RECORD_LAYOUT KwbUw FNC_VALUES 1 UWORD COLUMN_DIR DIRECT /end RECORD_LAYOUT
/begin RECORD_LAYOUT KwSb FNC_VALUES 1 SBYTE COLUMN_DIR DIRECT /end RECORD_LAYOUT
/begin RECORD_LAYOUT KwUb FNC_VALUES 1 UBYTE COLUMN_DIR DIRECT /end RECORD_LAYOUT
/begin RECORD_LAYOUT KwUw FNC_VALUES 1 UWORD COLUMN_DIR DIRECT /end RECORD_LAYOUT
/begin RECORD_LAYOUT SstAUbSstUb NO_AXIS_PTS_X 1 UBYTE AXIS_PTS_X 2 UBYTE INDEX_INCR DIRECT /end RECORD_LAYOUT
/begin RECORD_LAYOUT SstAUwSstUw NO_AXIS_PTS_X 1 UWORD AXIS_PTS_X 2 UWORD INDEX_INCR DIRECT /end RECORD_LAYOUT
/end MODULE
/end PROJECT
