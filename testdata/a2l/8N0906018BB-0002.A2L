ASAP2_VERSION 1 3
/begin PROJECT X505R_24d1_0 "4019.XX"
/begin HEADER "" VERSION "X505R_24d1_0" PROJECT_NO X505R_24d1_0 /end HEADER
/begin MODULE DIM ""
/begin MOD_COMMON "" BYTE_ORDER MSB_LAST ALIGNMENT_BYTE 1 ALIGNMENT_WORD 2 ALIGNMENT_LONG 2 /end MOD_COMMON
/begin CHARACTERISTIC AFZBKLH "Anzahl Fahrzyklen mit Bed. Kühlleistung hoch für Stuck-Check TMOT" VALUE 0x8194C1 KwUb 255.0 dez 0.00 255.0 FORMAT "%5.1" /end CHARACTERISTIC
/begin CHARACTERISTIC AFZBKLN "Anzahl Fahrzyklen mit Bed. Kühlleistung niedrig für Stuck-Check TMOT" VALUE 0x8194C2 KwUb 255.0 dez 0.00 255.0 FORMAT "%5.1" /end CHARACTERISTIC
/begin CHARACTERISTIC AFZPTAFX "Anzahl Fahrzyklen für Plausibilitäts-Check fixiertes TANS-Signal" VALUE 0x819476 KwUb 255.0 dez 0.00 255.0 FORMAT "%5.1" /end CHARACTERISTIC
/begin CHARACTERISTIC AIMVM_0_A "Anzahl Geschwindigkeitsimpulse pro m für Normierung v-Signal" VALUE 0x814416 KwUw 9.999000 fak_uw_q0p001 0.001000000 10.00000 FORMAT "%8.5" /end CHARACTERISTIC
/begin CHARACTERISTIC AIMVM_1_A "Anzahl Geschwindigkeitsimpulse pro m für Normierung v-Signal" VALUE 0x814418 KwUw 9.999000 fak_uw_q0p001 0.001000000 10.00000 FORMAT "%8.5" /end CHARACTERISTIC
/begin CHARACTERISTIC AIMVM_2_A "Anzahl Geschwindigkeitsimpulse pro m für Normierung v-Signal" VALUE 0x81441A KwUw 9.999000 fak_uw_q0p001 0.001000000 10.00000 FORMAT "%8.5" /end CHARACTERISTIC
/begin CHARACTERISTIC AIMVM_3_A "Anzahl Geschwindigkeitsimpulse pro m für Normierung v-Signal" VALUE 0x81441C KwUw 9.999000 fak_uw_q0p001 0.001000000 10.00000 FORMAT "%8.5" /end CHARACTERISTIC
/begin CHARACTERISTIC ALLPTAFX "Anzahl Leerlaufzyklen für Plausibilitäts-Check fixiertes TANS-Signal" VALUE 0x819477 KwUb 255.0 dez 0.00 255.0 FORMAT "%5.1" /end CHARACTERISTIC
/begin CHARACTERISTIC ANZRIBEH "Anzahl der Ri-Berechnungen hinter KAT" VALUE 0x810A2E KwUb 255.0 dez 0.00 255.0 FORMAT "%5.1" /end CHARACTERISTIC
/begin CHARACTERISTIC AZKELDYN "Zündungen pro Zylinder bei KR-Lastdynamik => Klopferkennung" CURVE 0x819917 GklWUb 254.0 dez 1.000 255.0 FORMAT "%5.1"
 /begin AXIS_DESCR COM_AXIS nmot nmot_ub_q40 16 0.00 10200. AXIS_PTS_REF SNM16KRUB /end AXIS_DESCR
/end CHARACTERISTIC
/begin CHARACTERISTIC AZKRLDYN "Anzahl Zündungen pro Zyl. bei KR-Lastdynamik" CURVE 0x819927 GklWUb 254.0 dez 1.000 255.0 FORMAT "%5.1"
 /begin AXIS_DESCR COM_AXIS nmot nmot_ub_q40 16 0.00 10200. AXIS_PTS_REF SNM16KRUB /end AXIS_DESCR
/end CHARACTERISTIC
/begin CHARACTERISTIC AZKRNDYN "Anzahl Zündungen für KR-Drehzahldynamik" CURVE 0x819937 GklWUb 254.0 dez 1.000 255.0 FORMAT "%5.1"
 /begin AXIS_DESCR COM_AXIS nmot nmot_ub_q40 16 0.00 10200. AXIS_PTS_REF SNM16KRUB /end AXIS_DESCR
/end CHARACTERISTIC
/begin CHARACTERISTIC CDWGANG "Gangerkennung für Kompressorabschalten bei Vollgas" VALUE 0x8123B0 KwUb 255.0 dez 0.00 255.0 FORMAT "%5.1" /end CHARACTERISTIC
/begin CHARACTERISTIC CDWGANGB "Gangerkennung bei Beschleunigung" VALUE 0x8123B1 KwUb 255.0 dez 0.00 255.0 FORMAT "%5.1" /end CHARACTERISTIC
/begin CHARACTERISTIC CDWKOB "Codewort : Auswahl zur Gangerkennung für KO-Auschalten ( gangi oder nmot/vfzw)" VALUE 0x8123B2 KwUb 255.0 dez 0.00 255.0 FORMAT "%5.1" /end CHARACTERISTIC
/begin CHARACTERISTIC CWBWEEN "Codewort zur Deaktivierung der Bewegungserkennung" VALUE 0x810A51 KwUb 255.0 dez 0.00 255.0 FORMAT "%5.1" /end CHARACTERISTIC
/begin CHARACTERISTIC CWGGLSH "Codeword für Ri-Auswertung für Sonde hinter KAT" VALUE 0x818778 KwUb 255.0 dez 0.00 255.0 FORMAT "%5.1" /end CHARACTERISTIC
/begin CHARACTERISTIC CWGGLSU "Codewort für GGLSU" VALUE 0x810A38 KwUb 255.0 dez 0.00 255.0 FORMAT "%5.1" /end CHARACTERISTIC
/begin CHARACTERISTIC CWGGPBKV "Codewort für Bremskraftverstärker Funktion GGPBKV" VALUE 0x812430 KwUb 255.0 dez 0.00 255.0 FORMAT "%5.1" /end CHARACTERISTIC
/begin CHARACTERISTIC CWGGVFZG "Codewort für %GGVFZG" VALUE 0x810A46 KwUb 255.0 dez 0.00 255.0 FORMAT "%5.1" /end CHARACTERISTIC
/begin CHARACTERISTIC CWKHMD "Codewort für Drehmomentenreserve bei Katheizen" VALUE 0x819600 KwUb 255.0 dez 0.00 255.0 FORMAT "%5.1" /end CHARACTERISTIC
/begin CHARACTERISTIC CWKOC "Codewort: Konfiguration der Klimakompressorsteuerung" VALUE 0x8123B3 KwUb 255.0 dez 0.00 255.0 FORMAT "%5.1" /end CHARACTERISTIC
/begin CHARACTERISTIC CWKOCAN "Konfiguration für CAN und Klimakompressor" VALUE 0x8123B4 KwUb 255.0 dez 0.00 255.0 FORMAT "%5.1" /end CHARACTERISTIC
/begin CHARACTERISTIC CWKONDTFA "Codewort Konfiguration Diagnose Ansauglufttemperatur-Fühler" VALUE 0x819478 KwUb 255.0 dez 0.00 255.0 FORMAT "%5.1" /end CHARACTERISTIC
/begin CHARACTERISTIC CWKONGTM "Codewort für Konfiguration Größe Temperatur Motor TMOT" VALUE 0x8194C3 KwUb 255.0 dez 0.00 255.0 FORMAT "%5.1" /end CHARACTERISTIC
/begin CHARACTERISTIC CWKR "Codewort Klopfregelung" VALUE 0x819947 KwUb 1.000 dez 0.00 1.000 FORMAT "%5.3" /end CHARACTERISTIC
/begin CHARACTERISTIC CWKVHR "Codewort für Komponenten-Versorgungsspannung über Hauptrelais" VALUE 0x81BEFA KwUw 65535.00 dez 0.00 65535.00 FORMAT "%8.2" /end CHARACTERISTIC
/begin CHARACTERISTIC CWTIPIN "Codewort für Tip in - Funktion" VALUE 0x819948 KwUb 255.0 dez 0.00 255.0 FORMAT "%5.1" /end CHARACTERISTIC
/begin CHARACTERISTIC CWUM_ZDG "" VALUE 0x819598 KwUb 20.00 dez 0.00 20.00 FORMAT "%5.2" /end CHARACTERISTIC
/begin CHARACTERISTIC CW_TABST "" VALUE 0x8194C4 KwUb 255.0 dez 0.00 255.0 FORMAT "%5.1" /end CHARACTERISTIC
/begin CHARACTERISTIC DPBKVBBG "Faktor Druckgradient am Beginn einer Bremsung" VALUE 0x82991A KwUw 7.999878 fak_uw_b8 0.00 7.999878 FORMAT "%8.6" /end CHARACTERISTIC
/begin CHARACTERISTIC DPBKVBSGV0 "Faktor Druckgradient während Bremsung bei v=0" VALUE 0x82991C KwUw 7.999878 fak_uw_b8 0.00 7.999878 FORMAT "%8.6" /end CHARACTERISTIC
/begin CHARACTERISTIC DPBKVBSGVS "Faktor Druckgradient während Bremsung bei v>Schwelle" VALUE 0x82991E KwUw 7.999878 fak_uw_b8 0.00 7.999878 FORMAT "%8.6" /end CHARACTERISTIC
/begin CHARACTERISTIC DPBKVEBG "Faktor Druckgradient am Ende einer Bremsung" VALUE 0x829920 KwUw 7.999878 fak_uw_b8 0.00 7.999878 FORMAT "%8.6" /end CHARACTERISTIC
/begin CHARACTERISTIC DPBKVEBGVS "Faktor Druckgradient am Ende einer Bremsung bei vfzg>Schwelle" VALUE 0x829922 KwUw 7.999878 fak_uw_b8 0.00 7.999878 FORMAT "%8.6" /end CHARACTERISTIC
/begin CHARACTERISTIC DPBKVEVK "Faktor Druckgradient während Evakuierung des Bremskraftverstärkers" VALUE 0x829924 KwUw 15.99976 fak_uw_b16 0.00 15.99976 FORMAT "%8.5" /end CHARACTERISTIC
/begin CHARACTERISTIC DPBKVEVKEP "Fak. Druckgrad. während Evakuierung des Bremskraftverstärkers durch el. Pumpe" VALUE 0x829926 KwUw 15.99976 fak_uw_b16 0.00 15.99976 FORMAT "%8.5" /end CHARACTERISTIC
/begin CHARACTERISTIC DPBKVEVKSP "Fak. Druckgrad. während Evakuierung des BKV durch Saugstrahlpumpe" VALUE 0x829928 KwUw 15.99976 fak_uw_b16 0.00 15.99976 FORMAT "%8.5" /end CHARACTERISTIC
/begin CHARACTERISTIC DPBKVSTG "Faktor Druckgradient durch Undichtigkeit des Bremskraftverstärkers" VALUE 0x82992A KwUw 7.999878 fak_uw_b8 0.00 7.999878 FORMAT "%8.6" /end CHARACTERISTIC
/begin CHARACTERISTIC DRLKRAN "Erkennungsschwelle Lastdynamik für Stationäradaption" CURVE 0x81DE40 GklWUw 767.9766 rel_uw_q0p0234 0.00 767.9766 FORMAT "%8.4"
 /begin AXIS_DESCR COM_AXIS nmot nmot_ub_q40 16 0.00 10200. AXIS_PTS_REF SNM16KRUB /end AXIS_DESCR
/end CHARACTERISTIC
/begin CHARACTERISTIC DSBGRAD "Gradient für Drucksensor Bremskraftverstärker" VALUE 0x82992C KwUw 1023.984 fak_uw_b1024 0.00 1023.984 FORMAT "%8.3" /end CHARACTERISTIC
/begin CHARACTERISTIC DSBOFS "Offset Drucksensor Bremskraftverstärker" VALUE 0x82992E KwSw 2559.961 p_sw_q0p039 -1280.000 1279.961 FORMAT "%8.3" /end CHARACTERISTIC
/begin CHARACTERISTIC DTAFIX "Delta TANS- Schwelle für unplausibel fixiertes Signal" VALUE 0x819479 KwUb 191.3 temp_ub_b191p25 0.00 191.3 FORMAT "%5.1" /end CHARACTERISTIC
/begin CHARACTERISTIC DTMABDTMN "Min. Differenz Motortemperatur zwischen Abstellen und Neustart für Diagnose TMOT" VALUE 0x8194C5 KwUb 191.3 temp_ub_b191p25 0.00 191.3 FORMAT "%5.1" /end CHARACTERISTIC
/begin CHARACTERISTIC DTMABSDTA "Schwelle Motortemperaturdiff. zw. Abstellen u. Start des Motors für TANS-Diagn." VALUE 0x81947A KwUb 191.3 temp_ub_b191p25 0.00 191.3 FORMAT "%5.1" /end CHARACTERISTIC
/begin CHARACTERISTIC DTMDMA "Abstand Motortemperaturmodell zur Starttemperatur" VALUE 0x8194C6 KwUb 191.3 temp_ub_b191p25 0.00 191.3 FORMAT "%5.1" /end CHARACTERISTIC
/begin CHARACTERISTIC DTMDNPO "Abstand Motortemperaturmodell zur oberen Unplausibilitätsschwelle" VALUE 0x8194C7 KwUb 191.3 temp_ub_b191p25 0.00 191.3 FORMAT "%5.1" /end CHARACTERISTIC
/begin CHARACTERISTIC DTMDZG "Schwelle Motortemperatur-Differenz für Erkennung Delta zu groß zw. Messwerten" VALUE 0x8194C8 KwUb 191.3 temp_ub_b191p25 0.00 191.3 FORMAT "%5.1" /end CHARACTERISTIC
/begin CHARACTERISTIC DTMPTA "Vergleichsschwelle Motortemperatur - Ansauglufttemperatur" VALUE 0x81947B KwUb 191.3 temp_ub_b191p25 0.00 191.3 FORMAT "%5.1" /end CHARACTERISTIC
/begin CHARACTERISTIC DTMRESDZG "Schwelle Motortemperatursignal-Differenz für Rücksetzen Bed. Delta zu groß" VALUE 0x8194C9 KwUb 191.3 temp_ub_b191p25 0.00 191.3 FORMAT "%5.1" /end CHARACTERISTIC
/begin CHARACTERISTIC DTMSRT "Delta Motortemp.zu Starttemp. f.Retrigg. Modelle (Blockheater-Erkennung)" VALUE 0x8194CA KwUb 191.3 temp_ub_b191p25 0.00 191.3 FORMAT "%5.1" /end CHARACTERISTIC
/begin CHARACTERISTIC DUPW12 "Zulässige Spannungsabweichung zwischen PWG-Poti 1 und 2" VALUE 0x810A52 KwUb 4.980 spg_ub_b5 0.00 4.980 FORMAT "%5.3" /end CHARACTERISTIC
/begin CHARACTERISTIC DUPW12BE "notweniger Spannungsweg von Poti 2 zur Bewegungserkennung" VALUE 0x8144BE KwUw 4.995117 spg_uw_q0p00488 0.00 4.995117 FORMAT "%8.6" /end CHARACTERISTIC
/begin CHARACTERISTIC DUPW12TG "Zulässige Spannungsabweichung zwischen PWG Poti 1 und  2 im Teilgasbereich" VALUE 0x810A53 KwUb 4.980 spg_ub_b5 0.00 4.980 FORMAT "%5.3" /end CHARACTERISTIC
/begin CHARACTERISTIC DUPW12VG "Zulässige Spannungsabweichung zwischen PWG-Poti 1 und 2 im Vollgasbereich" VALUE 0x810A54 KwUb 4.980 spg_ub_b5 0.00 4.980 FORMAT "%5.3" /end CHARACTERISTIC
/begin CHARACTERISTIC DUPWGHY "Spannungshysterese bei Entjitterung der PWG-Spannung" VALUE 0x8144C0 KwUw 4.995117 spg_uw_q0p00488 0.00 4.995117 FORMAT "%8.6" /end CHARACTERISTIC
/begin CHARACTERISTIC DUSRIH "Delta Sondenspannung hinter Kat zwischen Neu-und Altwert  für Ri-Messung" VALUE 0x8142E6 KwSw 319.9951 spg_sw_q0p00488 -160.0000 159.9951 FORMAT "%8.4" /end CHARACTERISTIC
/begin CHARACTERISTIC DUSSPH "Delta Sondensp. hinter Kat zwischen Neu-und 2 Altwerten für Sonden Sprungmessung" VALUE 0x8142E8 KwSw 319.9951 spg_sw_q0p00488 -160.0000 159.9951 FORMAT "%8.4" /end CHARACTERISTIC
/begin CHARACTERISTIC DVFZBEG "Delta-Geschwindigkeit für Änderungsbegrenzung" VALUE 0x81440E KwUw 511.9922 vfzg_uw_b512 0.00 511.9922 FORMAT "%8.4" /end CHARACTERISTIC
/begin CHARACTERISTIC DWPEDKOB "Gradient des norm. Fahrpedalwinkels für KOS-Auschalten" VALUE 0x8123B5 KwSb 99.60 rel_sb_q0p39 -50.00 49.61 FORMAT "%5.2" /end CHARACTERISTIC
/begin CHARACTERISTIC DWPMXNB "Maximal zulässige Pedalwerterhöhung pro Rechenschritt nach Bremsbetätigung" VALUE 0x8144C2 KwUw 100.0000 relPED_uw_b100 0.00 100.0000 FORMAT "%8.4" /end CHARACTERISTIC
/begin CHARACTERISTIC DWPMXNOT "Maximal zulässige Pedalwerterhöhung pro Rechenschritt im PWG-Ersatzbetrieb" VALUE 0x8144C4 KwUw 100.0000 relPED_uw_b100 0.00 100.0000 FORMAT "%8.4" /end CHARACTERISTIC
/begin CHARACTERISTIC DWPOPBP "Pedalgradient zur Deaktivierung der PWG/Brems-Plaus." VALUE 0x8144C6 KwUw 100.0000 relPED_uw_b100 0.00 100.0000 FORMAT "%8.4" /end CHARACTERISTIC
/begin CHARACTERISTIC DWPPBP "Pedalwerterniedrigung pro Rechenschritt bei Plausibilität Bremse/PWG" VALUE 0x8144C8 KwUw 100.0000 relPED_uw_b100 0.00 100.0000 FORMAT "%8.4" /end CHARACTERISTIC
/begin CHARACTERISTIC DYADMXN "Max. Wert des add. Dynamikvorhalts" CURVE 0x81585E FklWUw 49151.25 zw_uw_qn0p75 -49151.25 0.00 FORMAT "%8.2"
 /begin AXIS_DESCR FIX_AXIS stuetz dez 5 0.00 4.000 FORMAT "%5.3" FIX_AXIS_PAR 0 0 5 /end AXIS_DESCR
/end CHARACTERISTIC
/begin CHARACTERISTIC DYADS "Add. Spätverstellung pro Zyk. durch lern. Dyn." VALUE 0x8111F1 KwUb 24.00 zw_ub_qn0p75 -24.00 0.00 FORMAT "%5.2" /end CHARACTERISTIC
/begin CHARACTERISTIC DYAFVS "Stufenhöhe für Abregelung des Dynamikvorhalts" VALUE 0x8111F2 KwUb 20.25 zw_ub_q0p75 0.00 20.25 FORMAT "%5.2" /end CHARACTERISTIC
/begin CHARACTERISTIC DYAMNV "Min. Wert des add. Dynamikvorhalts" VALUE 0x8111F3 KwUb 24.00 zw_ub_qn0p75 -24.00 0.00 FORMAT "%5.2" /end CHARACTERISTIC
/begin CHARACTERISTIC DYAVF "Abregelkonstante für Dynamikvorhalt" VALUE 0x8111F4 KwUb 254.0 dez 1.000 255.0 FORMAT "%5.1" /end CHARACTERISTIC
/begin CHARACTERISTIC DZWTIN "delta-Zündwinkel bei Tip in" CURVE 0x815868 KlAUwSstSwWUw 20.25000 zw_uw_qn0p75 -20.25000 0.00 FORMAT "%8.5"
 /begin AXIS_DESCR STD_AXIS nmot nmot_ub_q40 16 -1310720. 1310680. FORMAT "%8.0" DEPOSIT ABSOLUTE /end AXIS_DESCR
/end CHARACTERISTIC
/begin CHARACTERISTIC FABSTT "Faktor Abstellzeit für Modelltemparatur" CURVE 0x81D478 KlAUwSstUwWUw 1.999969 fak_uw_b2 0.00 1.999969 FORMAT "%8.6"
 /begin AXIS_DESCR STD_AXIS tabst_w t1sxs_uw_q1 5 0.00 65535.00 FORMAT "%8.2" DEPOSIT ABSOLUTE /end AXIS_DESCR
/end CHARACTERISTIC
/begin CHARACTERISTIC FBKVP "Faktor zur Berechnung des min. Pumpdrucks abhängig von Umgebungsdruck" VALUE 0x829930 KwUw 1.999969 fak_uw_b2 0.00 1.999969 FORMAT "%8.6" /end CHARACTERISTIC
/begin CHARACTERISTIC FHOKOB "Höhenschwelle für Kompressorabschaltung bei Beschleunigung" VALUE 0x8123B6 KwUb 3.984 fak_ub_b4 0.00 3.984 FORMAT "%5.3" /end CHARACTERISTIC
/begin CHARACTERISTIC FKELDYA "Korrekturfaktor für Klopferkennungsschwelle bei Lastdynamikadaption" VALUE 0x8111F5 KwUb 0.6250 fak_ub_b16 0.6250 1.250 FORMAT "%5.3" /end CHARACTERISTIC
/begin CHARACTERISTIC FLAMPA "Druck-Korrekturfaktor für Lambda" CURVE 0x81430C KlAUwSstUwWUw 1.999969 fak_uw_b2 0.00 1.999969 FORMAT "%8.6"
 /begin AXIS_DESCR STD_AXIS palsu_w p_uw_q0p039 10 0.00 2559.961 FORMAT "%8.3" DEPOSIT ABSOLUTE /end AXIS_DESCR
/end CHARACTERISTIC
/begin CHARACTERISTIC FLSUIP "Faktor für Umrechnung Spannung in Pumpstrom" VALUE 0x814336 KwUw 204.7969 leit_q3p125Em6 0.00 204.7969 FORMAT "%8.4" /end CHARACTERISTIC
/begin CHARACTERISTIC FMDKHFH "Höhenkorrektur Drehmomentenreserve für Katheizen" CURVE 0x81D82E KlAUwSstUwWUw 1.999969 fak_uw_b2 0.00 1.999969 FORMAT "%8.6"
 /begin AXIS_DESCR STD_AXIS fho_w fak_uw_b4 4 0.00 3.999939 FORMAT "%8.6" DEPOSIT ABSOLUTE /end AXIS_DESCR
/end CHARACTERISTIC
/begin CHARACTERISTIC FMDKHTMST "tmst-Korrektur Drehmomentenresrve für Katheizen" CURVE 0x819601 KlAUbSstUbWUb 1.992 fak_ub_b2 0.00 1.992 FORMAT "%5.3"
 /begin AXIS_DESCR STD_AXIS tmst temp_ub_q0p75_o48 8 -48.00 143.3 FORMAT "%5.1" DEPOSIT ABSOLUTE /end AXIS_DESCR
/end CHARACTERISTIC
/begin CHARACTERISTIC FMDPUBKV "Abregelungsfaktor für Momentenreserve bei Katheizen und leeren BKV" CURVE 0x81D840 KlAUwSstUwWUb 0.9961 fak_ub_b1 0.00 0.9961
 /begin AXIS_DESCR STD_AXIS pubkv_w p_uw_q0p039 6 0.00 2559.961 FORMAT "%8.3" DEPOSIT ABSOLUTE /end AXIS_DESCR
/end CHARACTERISTIC
/begin CHARACTERISTIC FRINOF "Faktor für Bewertung alter Ri-Wert ohne Filter" VALUE 0x810A2F KwUb 15.94 fak_ub_b16 0.00 15.94 FORMAT "%5.2" /end CHARACTERISTIC
/begin CHARACTERISTIC HLSUKORMX "Maximalwert des Korrekturfaktors für die  LSU-Heizleistung" VALUE 0x819F88 KwUb 1.992 fak_ub_b2 0.00 1.992 FORMAT "%5.3" /end CHARACTERISTIC
/begin CHARACTERISTIC KAFPBKVPU "Korrektur Ausfluß abh. von pbkvmod_w/pubkv_w" CURVE 0x829932 KlAUwSstUwWUw 1.999969 fak_uw_b2 0.00 1.999969 FORMAT "%8.6"
 /begin AXIS_DESCR STD_AXIS pbkvmpu_w fak_uw_b2 4 0.00 1.999969 FORMAT "%8.6" DEPOSIT ABSOLUTE /end AXIS_DESCR
/end CHARACTERISTIC
/begin CHARACTERISTIC KEDNEG "Wert für die Reduzierung der Einschaltdauer LSU-Heizung nach Start" VALUE 0x811C18 KwUb 99.22 tgrad_ub_b99p6 0.3906 99.61 FORMAT "%5.2" /end CHARACTERISTIC
/begin CHARACTERISTIC KEDPOS "Wert für die Vergrößerung der Einschaltdauer LSU-Heizung nach Start" VALUE 0x811C19 KwUb 99.22 tgrad_ub_b99p6 0.3906 99.61 FORMAT "%5.2" /end CHARACTERISTIC
/begin CHARACTERISTIC KFBBLSU "Kennfeld für B_sbblsu" MAP 0x814338 KfAxUbAyUbSstxUbSstyUwWUb 25.50 t100msxs_ub_b25p5 0.00 25.50 FORMAT "%5.2"
 /begin AXIS_DESCR STD_AXIS ub spg_ubatt 4 0.00 17.95 FORMAT "%5.2" DEPOSIT ABSOLUTE /end AXIS_DESCR
 /begin AXIS_DESCR STD_AXIS lamsons_w fak_uw_b16 5 0.00 15.99976 FORMAT "%8.5" DEPOSIT ABSOLUTE /end AXIS_DESCR
/end CHARACTERISTIC
/begin CHARACTERISTIC KFDTMRS "Kennfeld Motortemperatur-Gradient im Schub für Referenzmodell" MAP 0x81D48E KfAxUbAyUbSstxUbSstyUbWSb 0.1868 temp_sb_b0p093 -0.09375 0.09302 FORMAT "%7.5"
 /begin AXIS_DESCR STD_AXIS mll1 m_ub_b1020 5 0.00 1020. FORMAT "%5.0" DEPOSIT ABSOLUTE /end AXIS_DESCR
 /begin AXIS_DESCR STD_AXIS tmrw temp_ub_q0p75_o48 4 -48.00 143.3 FORMAT "%5.1" DEPOSIT ABSOLUTE /end AXIS_DESCR
/end CHARACTERISTIC
/begin CHARACTERISTIC KFDTMTE "Kennfeld Motortemperaturgradient für Ersatztemperatur" MAP 0x81D4AE KfAxUbAyUbSstxUbSstyUbWSb 0.1868 temp_sb_b0p093 -0.09375 0.09302 FORMAT "%7.5"
 /begin AXIS_DESCR STD_AXIS mll1 m_ub_b1020 5 0.00 1020. FORMAT "%5.0" DEPOSIT ABSOLUTE /end AXIS_DESCR
 /begin AXIS_DESCR STD_AXIS tmew temp_ub_q0p75_o48 4 -48.00 143.3 FORMAT "%5.1" DEPOSIT ABSOLUTE /end AXIS_DESCR
/end CHARACTERISTIC
/begin CHARACTERISTIC KFDTMTR "Kennfeld Motortemperaturgradient für Referenztemperatur" MAP 0x81D4CE KfAxUbAyUbSstxUbSstyUbWSb 0.1868 temp_sb_b0p093 -0.09375 0.09302 FORMAT "%7.5"
 /begin AXIS_DESCR STD_AXIS mll1 m_ub_b1020 5 0.00 1020. FORMAT "%5.0" DEPOSIT ABSOLUTE /end AXIS_DESCR
 /begin AXIS_DESCR STD_AXIS tmrw temp_ub_q0p75_o48 4 -48.00 143.3 FORMAT "%5.1" DEPOSIT ABSOLUTE /end AXIS_DESCR
/end CHARACTERISTIC
/begin CHARACTERISTIC KFDTMTU "Kennfeld Korrekturgradient Motortemperatur bei geringer Erwärmung" MAP 0x81D4EE KfAxUbAyUbSstxUbSstyUbWSb 0.1868 temp_sb_b0p093 -0.09375 0.09302 FORMAT "%7.5"
 /begin AXIS_DESCR STD_AXIS mll1 m_ub_b1020 5 0.00 1020. FORMAT "%5.0" DEPOSIT ABSOLUTE /end AXIS_DESCR
 /begin AXIS_DESCR STD_AXIS tumginp temp_ub_q0p75_o48 4 -48.00 143.3 FORMAT "%5.1" DEPOSIT ABSOLUTE /end AXIS_DESCR
/end CHARACTERISTIC
/begin CHARACTERISTIC KFDYES "Lastdynamikerkennungsschwelle" MAP 0x81DE60 GkfWSw 1535.977 rel_sw_q0p0234 -768.0000 767.9766 FORMAT "%8.4"
 /begin AXIS_DESCR COM_AXIS nmot nmot_ub_q40 16 0.00 10200. AXIS_PTS_REF SNM16KRDYUB /end AXIS_DESCR
 /begin AXIS_DESCR COM_AXIS rl rel_ub_q0p75 6 0.00 191.3 AXIS_PTS_REF SRL06KRUB /end AXIS_DESCR
/end CHARACTERISTIC
/begin CHARACTERISTIC KFDYMNT "vorgesteuerter Dynamikvorhalt" MAP 0x8158AA KfAxUbAyUbSstxUbSstyUwWUw 49151.25 zw_uw_qn0p75 -49151.25 0.00 FORMAT "%8.2"
 /begin AXIS_DESCR STD_AXIS evtmod temp_ub_q0p75_o48 16 -48.00 143.3 FORMAT "%5.1" DEPOSIT ABSOLUTE /end AXIS_DESCR
 /begin AXIS_DESCR STD_AXIS nmot nmot_ub_q40 8 0.00 2621400. FORMAT "%8.0" DEPOSIT ABSOLUTE /end AXIS_DESCR
/end CHARACTERISTIC
/begin CHARACTERISTIC KFDYRS "Dynamikvorhalt Erkennungsschwelle" MAP 0x81DF20 GkfWSw 1535.977 rel_sw_q0p0234 -768.0000 767.9766 FORMAT "%8.4"
 /begin AXIS_DESCR COM_AXIS nmot nmot_ub_q40 16 0.00 10200. AXIS_PTS_REF SNM16KRDYUB /end AXIS_DESCR
 /begin AXIS_DESCR COM_AXIS rl rel_ub_q0p75 6 0.00 191.3 AXIS_PTS_REF SRL06KRUB /end AXIS_DESCR
/end CHARACTERISTIC
/begin CHARACTERISTIC KFDYRSOF "Dynamikvorhalt Offsetschwelle" MAP 0x81DFE0 GkfWSw 1535.977 rel_sw_q0p0234 -768.0000 767.9766 FORMAT "%8.4"
 /begin AXIS_DESCR COM_AXIS nmot nmot_ub_q40 16 0.00 10200. AXIS_PTS_REF SNM16KRDYUB /end AXIS_DESCR
 /begin AXIS_DESCR COM_AXIS rl rel_ub_q0p75 6 0.00 191.3 AXIS_PTS_REF SRL06KRUB /end AXIS_DESCR
/end CHARACTERISTIC
/begin CHARACTERISTIC KFKWTMP "Kennfeld Drehmomentenreserve für Kat warmhalten, zeitweise" MAP 0x81D854 KfAxUwAyUwSstxUwSstyUwWUw 99.99847 rel_uw_b100 0.00 99.99847 FORMAT "%8.5"
 /begin AXIS_DESCR STD_AXIS nmot_w nmot_uw_q0p25 4 0.00 16383.75 FORMAT "%8.2" DEPOSIT ABSOLUTE /end AXIS_DESCR
 /begin AXIS_DESCR STD_AXIS mifakh_w rel_uw_b100 4 0.00 99.99847 FORMAT "%8.5" DEPOSIT ABSOLUTE /end AXIS_DESCR
/end CHARACTERISTIC
/begin CHARACTERISTIC KFLAMSLS "Kennfeld Lambda-Korrektur bei Sekundärluft" MAP 0x818788 KfAxUbAyUbSstxUbSstyUbWUb 0.4980 fak_ub_b1p25_o0p75 0.7500 1.248 FORMAT "%5.3"
 /begin AXIS_DESCR STD_AXIS nmot nmot_ub_q40 8 0.00 10200. FORMAT "%5.0" DEPOSIT ABSOLUTE /end AXIS_DESCR
 /begin AXIS_DESCR STD_AXIS rl rel_ub_q0p75 8 0.00 191.3 FORMAT "%5.1" DEPOSIT ABSOLUTE /end AXIS_DESCR
/end CHARACTERISTIC
/begin CHARACTERISTIC KFLSUED_0_A "Kennfeld für die Einschaltdauer der LSU-Heizung abh. von Abgastemperatur und ml" MAP 0x819F89 KfAxUbAyUbSstxUbSstyUbWUb 2.550 t10msxs_ub_b2p55 0.00 2.550 FORMAT "%5.3"
 /begin AXIS_DESCR STD_AXIS tabgm temp_ub_q5_o50 7 -50.00 1225. FORMAT "%5.0" DEPOSIT ABSOLUTE /end AXIS_DESCR
 /begin AXIS_DESCR STD_AXIS msabg m_ub_b1020 5 0.00 1020. FORMAT "%5.0" DEPOSIT ABSOLUTE /end AXIS_DESCR
/end CHARACTERISTIC
/begin CHARACTERISTIC KFLSUED_1_A "Kennfeld für die Einschaltdauer der LSU-Heizung abh. von Abgastemperatur und ml" MAP 0x819FBA KfAxUbAyUbSstxUbSstyUbWUb 2.550 t10msxs_ub_b2p55 0.00 2.550 FORMAT "%5.3"
 /begin AXIS_DESCR STD_AXIS tabgm temp_ub_q5_o50 7 -50.00 1225. FORMAT "%5.0" DEPOSIT ABSOLUTE /end AXIS_DESCR
 /begin AXIS_DESCR STD_AXIS msabg m_ub_b1020 5 0.00 1020. FORMAT "%5.0" DEPOSIT ABSOLUTE /end AXIS_DESCR
/end CHARACTERISTIC
/begin CHARACTERISTIC KFMDDSLAD "Kennfeld Drehmomentenreserve bei Aktivdiagnose-Sekundärluft" MAP 0x81D888 KfAxUwAyUwSstxUwSstyUwWUw 99.99847 rel_uw_b100 0.00 99.99847 FORMAT "%8.5"
 /begin AXIS_DESCR STD_AXIS mifakh_w rel_uw_b100 4 0.00 99.99847 FORMAT "%8.5" DEPOSIT ABSOLUTE /end AXIS_DESCR
 /begin AXIS_DESCR STD_AXIS nmot_w nmot_uw_q0p25 4 0.00 16383.75 FORMAT "%8.2" DEPOSIT ABSOLUTE /end AXIS_DESCR
/end CHARACTERISTIC
/begin CHARACTERISTIC KFMDDSLFA "Kennfeld Drehmomentenreserve bei Testereingriff Sekundärluftdiagnose" MAP 0x81D8BC KfAxUwAyUwSstxUwSstyUwWUw 99.99847 rel_uw_b100 0.00 99.99847 FORMAT "%8.5"
 /begin AXIS_DESCR STD_AXIS nmot_w nmot_uw_q0p25 4 0.00 16383.75 FORMAT "%8.2" DEPOSIT ABSOLUTE /end AXIS_DESCR
 /begin AXIS_DESCR STD_AXIS mifakh_w rel_uw_b100 4 0.00 99.99847 FORMAT "%8.5" DEPOSIT ABSOLUTE /end AXIS_DESCR
/end CHARACTERISTIC
/begin CHARACTERISTIC KFMDKH_0_A "Kennfeld Drehmomentenreserve für Katheizen" MAP 0x81D8F0 KfAxUwAyUwSstxUwSstyUwWUw 99.99847 rel_uw_b100 0.00 99.99847 FORMAT "%8.5"
 /begin AXIS_DESCR STD_AXIS nmot_w nmot_uw_q0p25 8 0.00 16383.75 FORMAT "%8.2" DEPOSIT ABSOLUTE /end AXIS_DESCR
 /begin AXIS_DESCR STD_AXIS mifakh_w rel_uw_b100 8 0.00 99.99847 FORMAT "%8.5" DEPOSIT ABSOLUTE /end AXIS_DESCR
/end CHARACTERISTIC
/begin CHARACTERISTIC KFMDKH_1_A "Kennfeld Drehmomentenreserve für Katheizen" MAP 0x81D994 KfAxUwAyUwSstxUwSstyUwWUw 99.99847 rel_uw_b100 0.00 99.99847 FORMAT "%8.5"
 /begin AXIS_DESCR STD_AXIS nmot_w nmot_uw_q0p25 8 0.00 16383.75 FORMAT "%8.2" DEPOSIT ABSOLUTE /end AXIS_DESCR
 /begin AXIS_DESCR STD_AXIS mifakh_w rel_uw_b100 8 0.00 99.99847 FORMAT "%8.5" DEPOSIT ABSOLUTE /end AXIS_DESCR
/end CHARACTERISTIC
/begin CHARACTERISTIC KFMDKHLL_0_A "Kennfeld Drehmomentenreserve für Katheizen bei LL" MAP 0x81DA38 KfAxUwAyUwSstxUwSstyUwWUw 99.99847 rel_uw_b100 0.00 99.99847 FORMAT "%8.5"
 /begin AXIS_DESCR STD_AXIS nmot_w nmot_uw_q0p25 8 0.00 16383.75 FORMAT "%8.2" DEPOSIT ABSOLUTE /end AXIS_DESCR
 /begin AXIS_DESCR STD_AXIS mifakh_w rel_uw_b100 8 0.00 99.99847 FORMAT "%8.5" DEPOSIT ABSOLUTE /end AXIS_DESCR
/end CHARACTERISTIC
/begin CHARACTERISTIC KFMDKHLL_1_A "Kennfeld Drehmomentenreserve für Katheizen bei LL" MAP 0x81DADC KfAxUwAyUwSstxUwSstyUwWUw 99.99847 rel_uw_b100 0.00 99.99847 FORMAT "%8.5"
 /begin AXIS_DESCR STD_AXIS nmot_w nmot_uw_q0p25 8 0.00 16383.75 FORMAT "%8.2" DEPOSIT ABSOLUTE /end AXIS_DESCR
 /begin AXIS_DESCR STD_AXIS mifakh_w rel_uw_b100 8 0.00 99.99847 FORMAT "%8.5" DEPOSIT ABSOLUTE /end AXIS_DESCR
/end CHARACTERISTIC
/begin CHARACTERISTIC KFTNSTKO "Kennfeld Unterdrückungszeit des Kompressors nach dem Start" MAP 0x8298E6 KfAxUbAyUbSstxUwSstyUbWUb 51.00 t200msxs_ub_b51 0.00 51.00 FORMAT "%5.2"
 /begin AXIS_DESCR STD_AXIS fho_w fak_uw_b4 2 0.00 3.999939 FORMAT "%8.6" DEPOSIT ABSOLUTE /end AXIS_DESCR
 /begin AXIS_DESCR STD_AXIS tmst temp_ub_q0p75_o48 2 -48.00 143.3 FORMAT "%5.1" DEPOSIT ABSOLUTE /end AXIS_DESCR
/end CHARACTERISTIC
/begin CHARACTERISTIC KLDTMFXTM "Kennlinie Delta TMOT- Schwelle für unplausibel fixiertes Signal" CURVE 0x8194CB KlAUbSstUbWUb 191.3 temp_ub_b191p25 0.00 191.3 FORMAT "%5.1"
 /begin AXIS_DESCR STD_AXIS tmotlinlp temp_ub_q0p75_o48 8 -48.00 143.3 FORMAT "%5.1" DEPOSIT ABSOLUTE /end AXIS_DESCR
/end CHARACTERISTIC
/begin CHARACTERISTIC KLITHMS "Kennlinie integrierte Luftmassenschwelle für Thermostat-Monitoring THM" CURVE 0x8194DC KlAUbSstUbWUb 23.21 m_ub_b23p3 0.00 23.21 FORMAT "%5.2"
 /begin AXIS_DESCR STD_AXIS tmotlinst temp_ub_q0p75_o48 4 -48.00 143.3 FORMAT "%5.1" DEPOSIT ABSOLUTE /end AXIS_DESCR
/end CHARACTERISTIC
/begin CHARACTERISTIC KLTHMDTMS "Delta Motorstart-Temperatur für Verifikation/Heilung Thermostatdiagnose" CURVE 0x8194E5 KlAUbSstUbWUb 191.3 temp_ub_b191p25 0.00 191.3 FORMAT "%5.1"
 /begin AXIS_DESCR STD_AXIS tmotlinst temp_ub_q0p75_o48 5 -48.00 143.3 FORMAT "%5.1" DEPOSIT ABSOLUTE /end AXIS_DESCR
/end CHARACTERISTIC
/begin CHARACTERISTIC LALIUS "Lambdalinearisierung, LSU-Sonde vor Katalysator" CURVE 0x81435C KlAUwSstUwWUw 15.99976 fak_uw_b16 0.00 15.99976 FORMAT "%8.5"
 /begin AXIS_DESCR STD_AXIS usvkk_w spg_uw_q0p00488 22 0.00 319.9951 FORMAT "%8.4" DEPOSIT ABSOLUTE /end AXIS_DESCR
/end CHARACTERISTIC
/begin CHARACTERISTIC MDKOAB "Drehmomentschwelle um den Kompressor in Beschleunigung abzuschalten" CURVE 0x8123B7 GklWUb 199.2 rel_ub_b200 0.00 199.2 FORMAT "%5.1"
 /begin AXIS_DESCR COM_AXIS nmot nmot_ub_q40 8 0.00 10200. AXIS_PTS_REF SNM08KOUB /end AXIS_DESCR
/end CHARACTERISTIC
/begin CHARACTERISTIC MDKOAN "Drehmomentschwelle um den Klimakompressor abzuschalten" CURVE 0x8123BF GklWUb 199.2 rel_ub_b200 0.00 199.2 FORMAT "%5.1"
 /begin AXIS_DESCR COM_AXIS nmot nmot_ub_q40 8 0.00 10200. AXIS_PTS_REF SNM08KOUB /end AXIS_DESCR
/end CHARACTERISTIC
/begin CHARACTERISTIC MDKOEN "Drehmomentschwelle um den Klimakompressor einzuschalten" CURVE 0x8123C7 GklWUb 199.2 rel_ub_b200 0.00 199.2 FORMAT "%5.1"
 /begin AXIS_DESCR COM_AXIS nmot nmot_ub_q40 8 0.00 10200. AXIS_PTS_REF SNM08KOUB /end AXIS_DESCR
/end CHARACTERISTIC
/begin CHARACTERISTIC MIFAMXNOT "maximales indiziertes Moment im PWG-Ersatzbetrieb" CURVE 0x8188E3 KlAUbSstUbWUb 99.61 rel_ub_b99p6 0.00 99.61 FORMAT "%5.2"
 /begin AXIS_DESCR STD_AXIS nmot nmot_ub_q40 8 0.00 10200. FORMAT "%5.0" DEPOSIT ABSOLUTE /end AXIS_DESCR
/end CHARACTERISTIC
/begin CHARACTERISTIC MLDTAMN "Min.-Schwelle Motorluftmassendurchsatz für Plaus.-Check Ansauglufttemp. TANS" VALUE 0x81947C KwUb 1020. m_ub_b1020 0.00 1020. FORMAT "%5.0" /end CHARACTERISTIC
/begin CHARACTERISTIC MLDTAMX "Max.-Schwelle Motorluftmassendurchsatz für Plaus.-Check Ansauglufttemp. TANS" VALUE 0x81947D KwUb 1020. m_ub_b1020 0.00 1020. FORMAT "%5.0" /end CHARACTERISTIC
/begin CHARACTERISTIC MLOBKLHV "Max. Luftmassendurchsatz für Bedingung Kühlleistung hoch" CURVE 0x8194F0 KlAUbSstUbWUb 1020. m_ub_b1020 0.00 1020. FORMAT "%5.0"
 /begin AXIS_DESCR STD_AXIS vfzg vfzg_ub_q1p25 5 0.00 318.8 FORMAT "%5.1" DEPOSIT ABSOLUTE /end AXIS_DESCR
/end CHARACTERISTIC
/begin CHARACTERISTIC MLOBKLNV "Max. Luftmassendurchsatz für Bedingung Kühlleistung niedrig" CURVE 0x8194FB KlAUbSstUbWUb 1020. m_ub_b1020 0.00 1020. FORMAT "%5.0"
 /begin AXIS_DESCR STD_AXIS vfzg vfzg_ub_q1p25 5 0.00 318.8 FORMAT "%5.1" DEPOSIT ABSOLUTE /end AXIS_DESCR
/end CHARACTERISTIC
/begin CHARACTERISTIC MLPTAFXO "oberes Limit für Motorluftmassendurchsatz bei Check Ansauglufttemp. TANS fixiert" VALUE 0x81947E KwUb 1020. m_ub_b1020 0.00 1020. FORMAT "%5.0" /end CHARACTERISTIC
/begin CHARACTERISTIC MLPTAFXU "unteres Limit f. Motorluftmassendurchsatz bei Check Ansauglufttemp. TANS fixiert" VALUE 0x81947F KwUb 1020. m_ub_b1020 0.00 1020. FORMAT "%5.0" /end CHARACTERISTIC
/begin CHARACTERISTIC MLUBKLHV "Min. Luftmassendurchsatz für Bedingung Kühlleistung hoch" CURVE 0x819506 KlAUbSstUbWUb 1020. m_ub_b1020 0.00 1020. FORMAT "%5.0"
 /begin AXIS_DESCR STD_AXIS vfzg vfzg_ub_q1p25 5 0.00 318.8 FORMAT "%5.1" DEPOSIT ABSOLUTE /end AXIS_DESCR
/end CHARACTERISTIC
/begin CHARACTERISTIC MLUBKLNV "Min. Luftmassendurchsatz für Bedingung Kühlleistung niedrig" CURVE 0x819511 KlAUbSstUbWUb 1020. m_ub_b1020 0.00 1020. FORMAT "%5.0"
 /begin AXIS_DESCR STD_AXIS vfzg vfzg_ub_q1p25 5 0.00 318.8 FORMAT "%5.1" DEPOSIT ABSOLUTE /end AXIS_DESCR
/end CHARACTERISTIC
/begin CHARACTERISTIC NGKRAWN "Schwellwert Drehzahlgradient für Dynamikerkennung KRRA" CURVE 0x81E0A0 GklWSw 12799.77 nmotg_sw_q0p39 0.00 12799.77 FORMAT "%8.2"
 /begin AXIS_DESCR COM_AXIS nmot nmot_ub_q40 16 0.00 10200. AXIS_PTS_REF SNM16KRUB /end AXIS_DESCR
/end CHARACTERISTIC
/begin CHARACTERISTIC NGKRWN "Schwellwert Drehzahlgradient für Dynamikerkennung" CURVE 0x81E0C0 GklWSw 12799.77 nmotg_sw_q0p39 0.00 12799.77 FORMAT "%8.2"
 /begin AXIS_DESCR COM_AXIS nmot nmot_ub_q40 16 0.00 10200. AXIS_PTS_REF SNM16KRUB /end AXIS_DESCR
/end CHARACTERISTIC
/begin CHARACTERISTIC NKRUM "Drehzahlschwelle Umschalten Delta-Lastsignal für Lastdynamik" VALUE 0x819949 KwUb 10200. nmot_ub_q40 0.00 10200. FORMAT "%5.0" /end CHARACTERISTIC
/begin CHARACTERISTIC NWPMBBR "Mindestdrehzahl für Pedalwertbegrenzung bei betätigter Bremse" VALUE 0x810A55 KwUb 10200. nmot_ub_q40 0.00 10200. FORMAT "%5.0" /end CHARACTERISTIC
/begin CHARACTERISTIC PADMSA "Abgasgegendruck am Sondeneinbauort LSU" CURVE 0x81BDF2 KlAUwSstUwWUw 2559.961 p_uw_q0p039 0.00 2559.961 FORMAT "%8.3"
 /begin AXIS_DESCR STD_AXIS msabg_w m_uw_b6553p5 6 0.00 6553.500 FORMAT "%8.3" DEPOSIT ABSOLUTE /end AXIS_DESCR
/end CHARACTERISTIC
/begin CHARACTERISTIC PBKVVSTGPV "Unterdruckverstärkung durch Saugstrahleffekt" CURVE 0x829944 KlAUwSstUwWUw 2559.961 p_uw_q0p039 0.00 2559.961 FORMAT "%8.3"
 /begin AXIS_DESCR STD_AXIS dpspvdkd_w p_uw_q0p039 6 0.00 2559.961 FORMAT "%8.3" DEPOSIT ABSOLUTE /end AXIS_DESCR
/end CHARACTERISTIC
/begin CHARACTERISTIC PHLSNHMN "Heizleistung für ausreichende Sondenheizung" VALUE 0x8188BF KwUb 2.550 fak_ub_q0p01 0.00 2.550 FORMAT "%5.3" /end CHARACTERISTIC
/begin CHARACTERISTIC PHNMO "Drehzahlschwelle für Umschaltung auf 1 Phasenflanke" VALUE 0x8184B0 KwUb 10200. nmot_ub_q40 0.00 10200. FORMAT "%5.0" /end CHARACTERISTIC
/begin CHARACTERISTIC PHNMU "Drehzahlschwelle für Umschaltung auf 2 Phasenflanken" VALUE 0x8184B1 KwUb 10200. nmot_ub_q40 0.00 10200. FORMAT "%5.0" /end CHARACTERISTIC
/begin CHARACTERISTIC PUEBKV "Ersatzwert für Umgebungsdruck für BKV" VALUE 0x82995E KwUw 1279.961 p_uw_q0p039 0.00 1279.961 FORMAT "%8.3" /end CHARACTERISTIC
/begin CHARACTERISTIC PUELSU "Ersatzwert für Umgebungsdruck" VALUE 0x81BE0C KwUw 2559.961 p_uw_q0p039 0.00 2559.961 FORMAT "%8.3" /end CHARACTERISTIC
/begin CHARACTERISTIC PZWKRA "Prozentuale Häufigkeit der ZW-Ausgabe durch die KR während Dynamikadaption" VALUE 0x8111F6 KwUb 99.61 rel_ub_b99p6 0.00 99.61 FORMAT "%5.2" /end CHARACTERISTIC
/begin CHARACTERISTIC RBEL "Belastungswiderstand für Pumpstrom-Erzeugung" VALUE 0x8142EA KwUw 131070.0 r_uw_q2 0.00 131070.0 FORMAT "%8.1" /end CHARACTERISTIC
/begin CHARACTERISTIC RINHMX "Innenwiderstand Ri der Nernstsonde hinter KAT auf Maximalwert begrenzen" VALUE 0x8142EC KwUw 131070.0 r_uw_q2 0.00 131070.0 FORMAT "%8.1" /end CHARACTERISTIC
/begin CHARACTERISTIC RKSP "Widerstand zwischen kongurierende Spannung und Sondensignal" VALUE 0x8142EE KwUw 131070.0 r_uw_q2 0.00 131070.0 FORMAT "%8.1" /end CHARACTERISTIC
/begin CHARACTERISTIC SDLAA "Schwelle delta Lambda für LSU Abgleich" VALUE 0x8143B6 KwSw 15.99976 fak_sw_b8 -8.000000 7.999756 FORMAT "%8.6" /end CHARACTERISTIC
/begin CHARACTERISTIC SDLAB "Schwelle delta Lambda für Erkennung Betriebsbereitschaft LSU" VALUE 0x8143B8 KwSw 15.99976 fak_sw_b8 -8.000000 7.999756 FORMAT "%8.6" /end CHARACTERISTIC
/begin CHARACTERISTIC SGIDB4 "Fertigungsdatum" ASCII 0x8183D4 KtxC 255.0 defaultAscii 0.00 255.0 NUMBER 10 /end CHARACTERISTIC
/begin CHARACTERISTIC SGIDB5 "BOSCH-Software-Teilenummer = Typ-Teile-Nummer des Master EPROMs" ASCII 0x8183DF KtxC 255.0 defaultAscii 0.00 255.0 NUMBER 10 /end CHARACTERISTIC
/begin CHARACTERISTIC SGIDB6 "Nummer Teilsoftware" ASCII 0x8183EA KtxC 255.0 defaultAscii 0.00 255.0 NUMBER 7 /end CHARACTERISTIC
/begin CHARACTERISTIC SGIDB7 "Hardware Teilenummer" ASCII 0x8183F2 KtxC 255.0 defaultAscii 0.00 255.0 NUMBER 11 /end CHARACTERISTIC
/begin CHARACTERISTIC SGIDK1_DAT "Diagnose-Nummer" ASCII 0x8183FE KtxC 255.0 defaultAscii 0.00 255.0 NUMBER 5 /end CHARACTERISTIC
/begin AXIS_PTS SNM08KOUB "Stützstellenverteilung für Klimakompressorsteuerung  8  nmot" 0x8123CF nmot SstAUbSstUb 10200. nmot_ub_q40 8 0.00 10200. FORMAT "%5.0" DEPOSIT ABSOLUTE /end AXIS_PTS
/begin AXIS_PTS SNM16KRDYUB "" 0x81825B nmot SstAUbSstUb 10200. nmot_ub_q40 16 0.00 10200. FORMAT "%5.0" DEPOSIT ABSOLUTE /end AXIS_PTS
/begin AXIS_PTS SNM16KRUB "Stützstellenverteilung Drehzahl, 16 Sst." 0x81826C nmot SstAUbSstUb 10200. nmot_ub_q40 16 0.00 10200. FORMAT "%5.0" DEPOSIT ABSOLUTE /end AXIS_PTS
/begin AXIS_PTS SRL06KRUB "" 0x81828D rl SstAUbSstUb 191.3 rel_ub_q0p75 6 0.00 191.3 FORMAT "%5.1" DEPOSIT ABSOLUTE /end AXIS_PTS
/begin CHARACTERISTIC TABGL "Zeit für LSU-Abgleich" VALUE 0x810A39 KwUb 2.550 t10msxs_ub_b2p55 0.00 2.550 FORMAT "%5.3" /end CHARACTERISTIC
/begin CHARACTERISTIC TABGMHS_0_A "Abgastemperaturschwelle für die Sondenheizung LSU" VALUE 0x816B72 KwUb 1275. temp_ub_q5_o50 -50.00 1225. FORMAT "%5.0" /end CHARACTERISTIC
/begin CHARACTERISTIC TABGMHS_1_A "Abgastemperaturschwelle für die Sondenheizung LSU" VALUE 0x816B73 KwUb 1275. temp_ub_q5_o50 -50.00 1225. FORMAT "%5.0" /end CHARACTERISTIC
/begin CHARACTERISTIC TABGS "Zeit nach Start für LSU-Abgleich" VALUE 0x810A3A KwUb 25.50 t100msxs_ub_b25p5 0.00 25.50 FORMAT "%5.2" /end CHARACTERISTIC
/begin CHARACTERISTIC TABSMADTM "Abstellzeit bis Abkühlung Motor für Diagnose TMOT" VALUE 0x81D50E KwUw 65535.00 t1sxs_uw_q1 0.00 65535.00 FORMAT "%8.2" /end CHARACTERISTIC
/begin CHARACTERISTIC TABSTHLSU "Mindestabstellzeit für Wiederholstart Heizung LSU" VALUE 0x81FBD4 KwUw 65535.00 t1sxs_uw_q1 0.00 65535.00 FORMAT "%8.2" /end CHARACTERISTIC
/begin CHARACTERISTIC TADE "Ersatzgröße Lufttemperatur im Fehlerfall" VALUE 0x819480 KwUb 191.3 temp_ub_q0p75_o48 -48.00 143.3 FORMAT "%5.1" /end CHARACTERISTIC
/begin CHARACTERISTIC TADMM "1. Stufenbreite (Zeit) für Motortemperaturmodell" VALUE 0x81D510 KwUw 6553.500 t100msxs_uw_b6553p5 0.00 6553.500 FORMAT "%8.3" /end CHARACTERISTIC
/begin CHARACTERISTIC TADMN "Ansauglufttemperatur min." VALUE 0x819481 KwUb 191.3 temp_ub_q0p75_o48 -48.00 143.3 FORMAT "%5.1" /end CHARACTERISTIC
/begin CHARACTERISTIC TADMX "Ansauglufttemperatur max." VALUE 0x819482 KwUb 191.3 temp_ub_q0p75_o48 -48.00 143.3 FORMAT "%5.1" /end CHARACTERISTIC
/begin CHARACTERISTIC TADPLMX "oberes Limit für plausibles Ansauglufttemp.-Signal TANS" VALUE 0x819483 KwUb 191.3 temp_ub_q0p75_o48 -48.00 143.3 FORMAT "%5.1" /end CHARACTERISTIC
/begin CHARACTERISTIC TANDT1 "Delta Temperatur Ansaugluft für Heißstart" CURVE 0x81951C KlAUbSstUbWUb 191.3 temp_ub_b191p25 0.00 191.3 FORMAT "%5.1"
 /begin AXIS_DESCR STD_AXIS tansab temp_ub_q0p75_o48 8 -48.00 143.3 FORMAT "%5.1" DEPOSIT ABSOLUTE /end AXIS_DESCR
/end CHARACTERISTIC
/begin CHARACTERISTIC TANH1 "Ansauglufttemperatur - Schwelle Heißstart" VALUE 0x81952D KwUb 191.3 temp_ub_q0p75_o48 -48.00 143.3 FORMAT "%5.1" /end CHARACTERISTIC
/begin CHARACTERISTIC TANHKMMN "Kat-Temperatur für ausreichende Sondenheizung" VALUE 0x81BEBE KwUw 1535.977 temp_q0p0234_o273 -273.1500 1262.827 FORMAT "%8.3" /end CHARACTERISTIC
/begin CHARACTERISTIC TANSELI "Temperatur Ansaugluft-Erfassung u. Linearisierung, Inverskennlinie" CURVE 0x819484 KlAUbSstUbWUb 191.3 temp_ub_q0p75_o48 -48.00 143.3 FORMAT "%5.1"
 /begin AXIS_DESCR STD_AXIS wtans spg_ub_b5 20 0.00 4.980 FORMAT "%5.3" DEPOSIT ABSOLUTE /end AXIS_DESCR
/end CHARACTERISTIC
/begin CHARACTERISTIC TANSKOB "Ansauglufttemperaturschwelle für Kompressorabschaltung" VALUE 0x8123D8 KwUb 191.3 temp_ub_q0p75_o48 -48.00 143.3 FORMAT "%5.1" /end CHARACTERISTIC
/begin CHARACTERISTIC TBKVP "Evakuierzeit der BKV-Pumpe" VALUE 0x81A6CC KwUb 12.7498039 zk50msxs_ub_b12p8 0.0501960784 12.8000000 FORMAT "%10.7" /end CHARACTERISTIC
/begin CHARACTERISTIC TDAPTUBR "Wartezeit für UBR-Fehler bei Abschaltpfadtest" VALUE 0x8188CF KwUb 25.50 t100msxs_ub_b25p5 0.00 25.50 FORMAT "%5.2" /end CHARACTERISTIC
/begin CHARACTERISTIC TDBKLOFF "Abschaltzeit für Bed. Kühlleistung nach ununterbrochenem Verlassen des Bereichs" VALUE 0x81952E KwUb 25.40 t100msxs_ub_b25p5 0.1000 25.50 FORMAT "%5.2" /end CHARACTERISTIC
/begin CHARACTERISTIC TDFZTAFX "Entprellzeit Fahrzyklus für Plausibilitäts-Check fixiertes TANS-Signal" VALUE 0x8194AD KwUb 255.0 t1sxs_ub_b255 0.00 255.0 FORMAT "%5.1" /end CHARACTERISTIC
/begin CHARACTERISTIC TDHREVAB "Entprellzeit für EV-Abschaltung bei Hauptrelais- bzw. -Kontakt-Fehler" VALUE 0x8188D0 KwUb 25.50 t100msxs_ub_b25p5 0.00 25.50 FORMAT "%5.2" /end CHARACTERISTIC
/begin CHARACTERISTIC TDLLTAFX "Entprellzeit Leerlauf für Plausibilitäts-Check fixiertes TANS-Signal" VALUE 0x8194AE KwUb 255.0 t1sxs_ub_b255 0.00 255.0 FORMAT "%5.1" /end CHARACTERISTIC
/begin CHARACTERISTIC TDNSTA "Auspufferwärmzeit ab Start, für TANS - Diagnose" VALUE 0x8194AF KwUb 255.0 t1sxs_ub_b255 0.00 255.0 FORMAT "%5.1" /end CHARACTERISTIC
/begin CHARACTERISTIC TDNSUB "Batterie - Erholzeit ab Start, für UBATT - Diagnose" VALUE 0x810A3F KwUb 255.0 t100msxs_ub_b255 0.00 255.0 FORMAT "%5.1" /end CHARACTERISTIC
/begin CHARACTERISTIC TDPLTAO "Entprellzeit für oberen Plausibilitätscheck des Ansauglufttemp.-Signals TANS" VALUE 0x8194B0 KwUb 255.0 t1sxs_ub_b255 0.00 255.0 FORMAT "%5.1" /end CHARACTERISTIC
/begin CHARACTERISTIC TDRFZTAFX "Entprellzeit f. Reset Fahrzyklus für Plausibilitäts-Check fixiertes TANS-Signal" VALUE 0x8194B1 KwUb 255.0 t1sxs_ub_b255 0.00 255.0 FORMAT "%5.1" /end CHARACTERISTIC
/begin CHARACTERISTIC TDRNLUBR "Entprellzeit Rücksetzen Nachlauf-Anforderung von GGUBR" VALUE 0x8188D1 KwUb 25.50 t100msxs_ub_b25p5 0.00 25.50 FORMAT "%5.2" /end CHARACTERISTIC
/begin CHARACTERISTIC TDTA "Entprellzeit Fehlererkennung TANS" VALUE 0x8194B2 KwUb 25.50 t100msxs_ub_b25p5 0.00 25.50 FORMAT "%5.2" /end CHARACTERISTIC
/begin CHARACTERISTIC TDTAL "TANS Fehlererkennung / Zeitsperre ab B_LL = 1" VALUE 0x8194B3 KwUb 255.0 t1sxs_ub_b255 0.00 255.0 FORMAT "%5.1" /end CHARACTERISTIC
/begin CHARACTERISTIC TDTAPL "Entprellzeit für Plausibilitätscheck Ansauglufttemperatur TANS" VALUE 0x8194B4 KwUb 255.0 t1sxs_ub_b255 0.00 255.0 FORMAT "%5.1" /end CHARACTERISTIC
/begin CHARACTERISTIC TDTM "Entprellzeit Fehlererkennung TMOT" VALUE 0x81D512 KwUw 6553.500 t100msxs_uw_b6553p5 0.00 6553.500 FORMAT "%8.3" /end CHARACTERISTIC
/begin CHARACTERISTIC TDTMMA "Verzögerungszeit Anfangswert Motortemperaturmodell" VALUE 0x81D514 KwUw 6553.500 t100msxs_uw_b6553p5 0.00 6553.500 FORMAT "%8.3" /end CHARACTERISTIC
/begin CHARACTERISTIC TDTMNP "Entprellzeit Fehlererkennung Unplausibilität Signal TMOT" VALUE 0x81D516 KwUw 6553.500 t100msxs_uw_b6553p5 0.00 6553.500 FORMAT "%8.3" /end CHARACTERISTIC
/begin CHARACTERISTIC TDTMNPO "Entprellzeit Fehlererkennung Unplausibilität oben TMOT" VALUE 0x81952F KwUb 25.50 t100msxs_ub_b25p5 0.00 25.50 FORMAT "%5.2" /end CHARACTERISTIC
/begin CHARACTERISTIC TDTMPOG "Entprellzeit Prüfung obere Unplausibilität gültig TMOT" VALUE 0x819530 KwUb 25.50 t100msxs_ub_b25p5 0.00 25.50 FORMAT "%5.2" /end CHARACTERISTIC
/begin CHARACTERISTIC TDUB "Wartezeit für UBATT-Diagnose" VALUE 0x810A40 KwUb 25.50 t100msxs_ub_b25p5 0.00 25.50 FORMAT "%5.2" /end CHARACTERISTIC
/begin CHARACTERISTIC TDUBR "Entprellzeit für Diagnose UBR" VALUE 0x8188D2 KwUb 25.50 t100msxs_ub_b25p5 0.00 25.50 FORMAT "%5.2" /end CHARACTERISTIC
/begin CHARACTERISTIC TDUBRNL "Entprellzeit für Diagnose UBR im Nachlauf" VALUE 0x8188D3 KwUb 25.40 t100msxs_ub_b25p5 0.1000 25.50 FORMAT "%5.2" /end CHARACTERISTIC
/begin CHARACTERISTIC TDVTAPL "Wartezeit nach Fz-Geschwindigk.-Schwelle f.Plaus-Check Ansauglufttemperatur TANS" VALUE 0x8194B5 KwUb 255.0 t1sxs_ub_b255 0.00 255.0 FORMAT "%5.1" /end CHARACTERISTIC
/begin CHARACTERISTIC TDWPOPBP "Entprellzeit zur Deaktivierung der PWG/Brems-Plaus. über Pedalgradient" VALUE 0x810A56 KwUb 2.550 t10msxs_ub_b2p55 0.00 2.550 FORMAT "%5.3" /end CHARACTERISTIC
/begin CHARACTERISTIC TEBBREMS "Entprellzeit von B_brems" VALUE 0x81A6CD KwUb 0.5000 t50msxs_q0p05 0.00 0.5000 /end CHARACTERISTIC
/begin CHARACTERISTIC TEDTP "Einschaltdauer der LSU-Heizung während Kondenswasserphase" VALUE 0x811C1A KwUb 2.550 t10msxs_ub_b2p55 0.00 2.550 FORMAT "%5.3" /end CHARACTERISTIC
/begin CHARACTERISTIC TFGRVRAB "FGR: Zeit für Geschwindigkeitsabschaltung über vroh =0" VALUE 0x810A47 KwUb 5.100 t20msxs_ub_b5p1 0.00 5.100 FORMAT "%5.3" /end CHARACTERISTIC
/begin CHARACTERISTIC TFPWG2 "Filterzeit zur Filterung von Poti 2 bei der Bewegungserkennung" VALUE 0x8144CA KwUw 655.34999985 zk10msxs_uw_b655 0.010000152590 655.36000000 FORMAT "%12.8" /end CHARACTERISTIC
/begin CHARACTERISTIC TGGLS "Zeitdauer für ADC nach Interrupt im Funktionsrechner (Asic)" VALUE 0x810A30 KwUb 2.000 t1msxms_q1 3.000 5.000 FORMAT "%5.3" /end CHARACTERISTIC
/begin CHARACTERISTIC THHA "Auszeit für Reduzierung der Heizleistung Sonde hinter Kat bei 13V" VALUE 0x8188C0 KwUb 2.550 t10msxs_q0p01_o0p05 -0.05000 2.500 FORMAT "%5.3" /end CHARACTERISTIC
/begin CHARACTERISTIC THHAWU "Ausschaltzeit während Leistungsreduzierung Sondenheizung hinter Kat" VALUE 0x8188C1 KwUb 2.550 t10msxs_ub_b2p55 0.00 2.550 FORMAT "%5.3" /end CHARACTERISTIC
/begin CHARACTERISTIC THOPP1 "Fehlerzeit bei Hochohmigkeitsprüfung Poti 1" VALUE 0x810A57 KwUb 2.550 t10msxs_ub_b2p55 0.00 2.550 FORMAT "%5.3" /end CHARACTERISTIC
/begin CHARACTERISTIC THOPP2 "Fehlerzeit bei Hochohmigkeitsprüfung Poti 2" VALUE 0x810A58 KwUb 2.550 t10msxs_ub_b2p55 0.00 2.550 FORMAT "%5.3" /end CHARACTERISTIC
/begin CHARACTERISTIC THSHA "Verzögerungszeit für Sonde ausreichend beheizt" VALUE 0x8188C2 KwUb 25.50 t100msxs_ub_b25p5 0.00 25.50 FORMAT "%5.2" /end CHARACTERISTIC
/begin CHARACTERISTIC THSHKTK_0_A "Kennlinie für die Ausschaltdauer der Sondenheizung abh. v.d. Abgastemp. h.Kat" CURVE 0x81BEC0 KlAUbSstUwWUb 2.550 t10msxs_q0p01_o0p05 -0.05000 2.500 FORMAT "%5.3"
 /begin AXIS_DESCR STD_AXIS tanhkm_w temp_q0p0234_o273 8 -273.1500 1262.827 FORMAT "%8.3" DEPOSIT ABSOLUTE /end AXIS_DESCR
/end CHARACTERISTIC
/begin CHARACTERISTIC THSHKTK_1_A "Kennlinie für die Ausschaltdauer der Sondenheizung abh. v.d. Abgastemp. h.Kat" CURVE 0x81BEDA KlAUbSstUwWUb 2.550 t10msxs_q0p01_o0p05 -0.05000 2.500 FORMAT "%5.3"
 /begin AXIS_DESCR STD_AXIS tanhkm_w temp_q0p0234_o273 8 -273.1500 1262.827 FORMAT "%8.3" DEPOSIT ABSOLUTE /end AXIS_DESCR
/end CHARACTERISTIC
/begin CHARACTERISTIC THSRIH "Zeitverzög. Bereitschaft der Ri-Messung nach eingesch. Sondenheizung hinter KAT" VALUE 0x8142F0 KwUw 655.3500 t10msxs_uw_b655p35 0.00 655.3500 FORMAT "%8.4" /end CHARACTERISTIC
/begin CHARACTERISTIC TIDLEMAX "" VALUE 0x819951 KwUb 0.00 t100msxs_ub_b25p5 10.00 10.00 FORMAT "%5.2" /end CHARACTERISTIC
/begin CHARACTERISTIC TIDLEMIN "" VALUE 0x819952 KwUb 0.00 t100msxs_ub_b25p5 2.300 2.300 FORMAT "%5.3" /end CHARACTERISTIC
/begin CHARACTERISTIC TKOAMAD "Kompressorsperrzeit für Bedarfsadaption" VALUE 0x8123D9 KwUb 51.00 t200msxs_ub_b51 0.00 51.00 FORMAT "%5.2" /end CHARACTERISTIC
/begin CHARACTERISTIC TKOAMNN "Minimale Abschaltzeit des Klimakompressors" CURVE 0x81744E GklWUw 1310.700 t20msxs_uw_b1310 0.00 1310.700 FORMAT "%8.3"
 /begin AXIS_DESCR COM_AXIS nmot nmot_ub_q40 8 0.00 10200. AXIS_PTS_REF SNM08KOUB /end AXIS_DESCR
/end CHARACTERISTIC
/begin CHARACTERISTIC TKOAMXN "Maximale Abschaltzeit des Klimakompressors" CURVE 0x8123DA GklWUb 51.00 t200msxs_ub_b51 0.00 51.00 FORMAT "%5.2"
 /begin AXIS_DESCR COM_AXIS nmot nmot_ub_q40 8 0.00 10200. AXIS_PTS_REF SNM08KOUB /end AXIS_DESCR
/end CHARACTERISTIC
/begin CHARACTERISTIC TKOBEMNN "Minimale Einschaltzeit des Kompres. nach Auslösung über B_kobped oder B_kobwped" CURVE 0x8123E2 GklWUb 51.00 t200msxs_ub_b51 0.00 51.00 FORMAT "%5.2"
 /begin AXIS_DESCR COM_AXIS nmot nmot_ub_q40 8 0.00 10200. AXIS_PTS_REF SNM08KOUB /end AXIS_DESCR
/end CHARACTERISTIC
/begin CHARACTERISTIC TKODPAMNN "minimale Abschaltzeit des Klimakompressors  bei Beschleunigung ( dwped )" CURVE 0x8123EA GklWUb 51.00 t200msxs_ub_b51 0.00 51.00 FORMAT "%5.2"
 /begin AXIS_DESCR COM_AXIS nmot nmot_ub_q40 8 0.00 10200. AXIS_PTS_REF SNM08KOUB /end AXIS_DESCR
/end CHARACTERISTIC
/begin CHARACTERISTIC TKODPAMXN "Maximale Ausschaltzeit bei Kompressorausschalten  über dwped" CURVE 0x8123F2 GklWUb 51.00 t200msxs_ub_b51 0.00 51.00 FORMAT "%5.2"
 /begin AXIS_DESCR COM_AXIS nmot nmot_ub_q40 8 0.00 10200. AXIS_PTS_REF SNM08KOUB /end AXIS_DESCR
/end CHARACTERISTIC
/begin CHARACTERISTIC TKOEMNN "Minimale Einschaltzeit des Klimakompressors" CURVE 0x8123FA GklWUb 51.00 t200msxs_ub_b51 0.00 51.00 FORMAT "%5.2"
 /begin AXIS_DESCR COM_AXIS nmot nmot_ub_q40 8 0.00 10200. AXIS_PTS_REF SNM08KOUB /end AXIS_DESCR
/end CHARACTERISTIC
/begin CHARACTERISTIC TKOMBKOA "Motortemperaturschwelle aus Kombiinstrument für Kompressorabschaltung" VALUE 0x812402 KwUb 191.3 temp_ub_q0p75_o48 -48.00 143.3 FORMAT "%5.1" /end CHARACTERISTIC
/begin CHARACTERISTIC TKOMBKOE "Motortemperaturschwelle aus Kombiinstrument für Kompressoreinschaltung" VALUE 0x812403 KwUb 191.3 temp_ub_q0p75_o48 -48.00 143.3 FORMAT "%5.1" /end CHARACTERISTIC
/begin CHARACTERISTIC TKOTMSK "Minimale Abschaltzeit des Klimakompressors nach Klima aus" VALUE 0x8298F2 KwUw 1310.700 t20msxs_uw_q0p02 0.00 1310.700 FORMAT "%8.3" /end CHARACTERISTIC
/begin CHARACTERISTIC TKOVKO "Überwachungzeit  zur Klimatasteerken. nach Reset von B_kov (bidrekt. Schnittst.)" VALUE 0x812404 KwUb 5.100 t20msxs_ub_b5p1 0.00 5.100 FORMAT "%5.3" /end CHARACTERISTIC
/begin CHARACTERISTIC TKOWPAMNN "Minimale Abschaltzeit bei Vollast (über wped)" CURVE 0x812405 GklWUb 51.00 t200msxs_ub_b51 0.00 51.00 FORMAT "%5.2"
 /begin AXIS_DESCR COM_AXIS nmot nmot_ub_q40 8 0.00 10200. AXIS_PTS_REF SNM08KOUB /end AXIS_DESCR
/end CHARACTERISTIC
/begin CHARACTERISTIC TKOWPAMXN "maximale Ausschaltzeit bei Vollast (über wped)" CURVE 0x81240D GklWUb 51.00 t200msxs_ub_b51 0.00 51.00 FORMAT "%5.2"
 /begin AXIS_DESCR COM_AXIS nmot nmot_ub_q40 8 0.00 10200. AXIS_PTS_REF SNM08KOUB /end AXIS_DESCR
/end CHARACTERISTIC
/begin CHARACTERISTIC TKWFS "" VALUE 0x819599 KwUb 14.00 fak_q0p0625 1.000 15.00 FORMAT "%5.2" /end CHARACTERISTIC
/begin CHARACTERISTIC TLSUTA "Kennlinie für die Einschaltdauer der LSU-Heizung nach Start" CURVE 0x819FEB KlAUbSstUbWUb 2.550 t10msxs_ub_b2p55 0.00 2.550 FORMAT "%5.3"
 /begin AXIS_DESCR STD_AXIS tans temp_ub_q0p75_o48 4 -48.00 143.3 FORMAT "%5.1" DEPOSIT ABSOLUTE /end AXIS_DESCR
/end CHARACTERISTIC
/begin CHARACTERISTIC TLSUVH "Zeit für LSU vorheizen" VALUE 0x811C1B KwUb 25.50 t100msxs_ub_b25p5 0.00 25.50 FORMAT "%5.2" /end CHARACTERISTIC
/begin CHARACTERISTIC TMABDTA1MN "Minimalschwelle der Motorabstelltemperatur für Stuck-Signal-Check TANS" VALUE 0x8194B6 KwUb 191.3 temp_ub_q0p75_o48 -48.00 143.3 FORMAT "%5.1" /end CHARACTERISTIC
/begin CHARACTERISTIC TMABDTAMN "Minimalschwelle der Motorabstelltemperatur für Plausibitätscheck TANS" VALUE 0x8194B7 KwUb 191.3 temp_ub_q0p75_o48 -48.00 143.3 FORMAT "%5.1" /end CHARACTERISTIC
/begin CHARACTERISTIC TMABDTMN "Minimalschwelle der Motorabstelltemperatur für Diagnose TMOT" VALUE 0x819531 KwUb 103.5 temp_ub_q0p75_o48 39.75 143.3 FORMAT "%5.1" /end CHARACTERISTIC
/begin CHARACTERISTIC TMBVH "Verzögerungszeit für Aktivierung Mißbrauchsverhinderung" VALUE 0x81BF02 KwUw 6553.500 t100msxs_uw_b6553p5 0.00 6553.500 FORMAT "%8.3" /end CHARACTERISTIC
/begin CHARACTERISTIC TMDMMA "Anfangstemperatur für Motortemperaturmodell" VALUE 0x819532 KwUb 191.3 temp_ub_q0p75_o48 -48.00 143.3 FORMAT "%5.1" /end CHARACTERISTIC
/begin CHARACTERISTIC TMDMMAT "Ersatztemperatur abh. Abstellzeit während TDTMMA" CURVE 0x81D518 KlAUwSstUwWUw 191.2500 temp_ub_q0p75_o48 -48.00000 143.2500 FORMAT "%8.4"
 /begin AXIS_DESCR STD_AXIS tabst_w t1sxs_uw_q1 3 0.00 65535.00 FORMAT "%8.2" DEPOSIT ABSOLUTE /end AXIS_DESCR
/end CHARACTERISTIC
/begin CHARACTERISTIC TMDMMAU "Unterster Anfangswert aus tans für Motortemperaturmodell" VALUE 0x819533 KwUb 191.3 temp_ub_q0p75_o48 -48.00 143.3 FORMAT "%5.1" /end CHARACTERISTIC
/begin CHARACTERISTIC TMDMMEE "Endtemperatur für Ersatzwert Motortemperatur" VALUE 0x819534 KwUb 191.3 temp_ub_q0p75_o48 -48.00 143.3 FORMAT "%5.1" /end CHARACTERISTIC
/begin CHARACTERISTIC TMDMMER "Endtemperatur für Referenzwert Motortemperatur" VALUE 0x819535 KwUb 191.3 temp_ub_q0p75_o48 -48.00 143.3 FORMAT "%5.1" /end CHARACTERISTIC
/begin CHARACTERISTIC TMDMN "Motortemperatur min." VALUE 0x819536 KwUb 191.3 temp_ub_q0p75_o48 -48.00 143.3 FORMAT "%5.1" /end CHARACTERISTIC
/begin CHARACTERISTIC TMDMX "Motortemperatur max." VALUE 0x819537 KwUb 191.3 temp_ub_q0p75_o48 -48.00 143.3 FORMAT "%5.1" /end CHARACTERISTIC
/begin CHARACTERISTIC TMDYNA "TMOT - Schwelle für Lastdynamikadaption aktiv" VALUE 0x8111F7 KwUb 191.3 temp_ub_q0p75_o48 -48.00 143.3 FORMAT "%5.1" /end CHARACTERISTIC
/begin CHARACTERISTIC TMDZGMN "Mindest-Motortemperatur für Freigabe Gradienteerkennung (Delta zu groß)" VALUE 0x819538 KwUb 191.3 temp_ub_q0p75_o48 -48.00 143.3 FORMAT "%5.1" /end CHARACTERISTIC
/begin CHARACTERISTIC TMELIPU1 "Motor-Temperatur: Erfassung u. Linearisierung, Inverskennlinie 1, pullup aktiv" CURVE 0x81D526 KlAUwSstUwWUw 191.9971 temp_uw_q0p0029_o48 -48.00000 143.9971 FORMAT "%8.4"
 /begin AXIS_DESCR STD_AXIS wtmot_w spg_uw_q0p00488 20 0.00 319.9951 FORMAT "%8.4" DEPOSIT ABSOLUTE /end AXIS_DESCR
/end CHARACTERISTIC
/begin CHARACTERISTIC TMESSCMN "Min.-Schwelle Ersatz-Motortemperatur für Stuck-Signal Check" VALUE 0x819539 KwUb 191.3 temp_ub_q0p75_o48 -48.00 143.3 FORMAT "%5.1" /end CHARACTERISTIC
/begin CHARACTERISTIC TMKOAO "Obere Motortemperaturschwelle für Kompressorabschaltung" VALUE 0x812415 KwUb 191.3 temp_ub_q0p75_o48 -48.00 143.3 FORMAT "%5.1" /end CHARACTERISTIC
/begin CHARACTERISTIC TMKOAU "Untere Motortemperaturschwelle für Kompressorabschaltung" VALUE 0x812416 KwUb 191.3 temp_ub_q0p75_o48 -48.00 143.3 FORMAT "%5.1" /end CHARACTERISTIC
/begin CHARACTERISTIC TMMXRT "max. Motortemperatur f. Retrigg. Modelle (Blockheater-Erkennung)" VALUE 0x81953A KwUb 191.3 temp_ub_q0p75_o48 -48.00 143.3 FORMAT "%5.1" /end CHARACTERISTIC
/begin CHARACTERISTIC TMOTELI "Temperatur Motor Erfassung u. Linearisierung, Inverskennlinie" CURVE 0x81D578 KlAUwSstUwWUw 191.9971 temp_uw_q0p0029_o48 -48.00000 143.9971 FORMAT "%8.4"
 /begin AXIS_DESCR STD_AXIS wtmot_w spg_uw_q0p00488 20 0.00 319.9951 FORMAT "%8.4" DEPOSIT ABSOLUTE /end AXIS_DESCR
/end CHARACTERISTIC
/begin CHARACTERISTIC TMOTSH "Motortemperaturschwelle für die Sondenheizung LSU" VALUE 0x811C1C KwUb 191.3 temp_ub_q0p75_o48 -48.00 143.3 FORMAT "%5.1" /end CHARACTERISTIC
/begin CHARACTERISTIC TMPTAFXMN "Mindest-Motortemperaturschwelle für Plausibilitäts-Check fixiertes TANS Signal" VALUE 0x8194B8 KwUb 191.3 temp_ub_q0p75_o48 -48.00 143.3 FORMAT "%5.1" /end CHARACTERISTIC
/begin CHARACTERISTIC TMPTAFXU "untere Motortemperaturschwelle für Plausibilitäts-Check fixiertes TANS Signal" VALUE 0x8194B9 KwUb 191.3 temp_ub_q0p75_o48 -48.00 143.3 FORMAT "%5.1" /end CHARACTERISTIC
/begin CHARACTERISTIC TMPUPOFF "untere Motortemperaturschwelle für pullup-Abschaltung" VALUE 0x81953B KwUb 191.3 temp_ub_q0p75_o48 -48.00 143.3 FORMAT "%5.1" /end CHARACTERISTIC
/begin CHARACTERISTIC TMPUPON "obere Motortemperaturschwelle für pullup-Zuschaltung" VALUE 0x81953C KwUb 191.3 temp_ub_q0p75_o48 -48.00 143.3 FORMAT "%5.1" /end CHARACTERISTIC
/begin CHARACTERISTIC TMSDTAO "obere Motorstart-Temp.-Schwelle für Plausibititätscheck Ansauglufttemp. TANS" VALUE 0x8194BA KwUb 191.3 temp_ub_q0p75_o48 -48.00 143.3 FORMAT "%5.1" /end CHARACTERISTIC
/begin CHARACTERISTIC TMSDTAU "untere Motorstart-Temp.-Schwelle für Plausibititätscheck Ansauglufttemp. TANS" VALUE 0x8194BB KwUb 191.3 temp_ub_q0p75_o48 -48.00 143.3 FORMAT "%5.1" /end CHARACTERISTIC
/begin CHARACTERISTIC TMSPTAFX "Motorstarttemperaturschwelle für Plausibilitäts-Check fixiertes TANS Signal" VALUE 0x8194BC KwUb 191.3 temp_ub_q0p75_o48 -48.00 143.3 FORMAT "%5.1" /end CHARACTERISTIC
/begin CHARACTERISTIC TMSSSCO "obere Motorstart-Temp.-Schwelle für Stuck-Signal Check" VALUE 0x81953D KwUb 191.3 temp_ub_q0p75_o48 -48.00 143.3 FORMAT "%5.1" /end CHARACTERISTIC
/begin CHARACTERISTIC TMSSSCU "untere Motorstart-Temp.-Schwelle für Stuck-Signal Check" VALUE 0x81953E KwUb 191.3 temp_ub_q0p75_o48 -48.00 143.3 FORMAT "%5.1" /end CHARACTERISTIC
/begin CHARACTERISTIC TMSTMAD "Schwelle für tmot im Start für Bedarfsadaption" VALUE 0x812417 KwUb 191.3 temp_ub_q0p75_o48 -48.00 143.3 FORMAT "%5.1" /end CHARACTERISTIC
/begin CHARACTERISTIC TMSUPTAFX "untere Motorstarttemperaturschwelle für Plaus.-Check fixiertes TANS Signal" VALUE 0x8194BD KwUb 191.3 temp_ub_q0p75_o48 -48.00 143.3 FORMAT "%5.1" /end CHARACTERISTIC
/begin CHARACTERISTIC TNLETM "Nachlaufzeitverlaengerung fuer E_tm" VALUE 0x81D5CA KwUw 65535.00 t1sxs_uw_q1 0.00 65535.00 FORMAT "%8.2" /end CHARACTERISTIC
/begin CHARACTERISTIC TNSRT "Max.-Zeit ab Start für Retriggerung Berechnung Motortemperaturmodell" VALUE 0x81953F KwUb 255.0 t1sxs_ub_b255 0.00 255.0 FORMAT "%5.1" /end CHARACTERISTIC
/begin CHARACTERISTIC TNSTKO "Unterdrückungszeit des Kompressors nach dem Start" VALUE 0x812418 KwUb 51.00 t200msxs_ub_b51 0.00 51.00 FORMAT "%5.2" /end CHARACTERISTIC
/begin CHARACTERISTIC TPNSE1 "Prüfzeit nach Startende für PWG-Diagnose" VALUE 0x8188F4 KwUb 12.70 t50msxs_ub_b12p75 0.05000 12.75 FORMAT "%5.2" /end CHARACTERISTIC
/begin CHARACTERISTIC TRETRY "" VALUE 0x81959A KwUb 255.0 t1sxs_ub_b255 0.00 255.0 FORMAT "%5.1" /end CHARACTERISTIC
/begin CHARACTERISTIC TRIAKTH "Zeitdauer für Ri-Berechnung aktuell hinter KAT" VALUE 0x8142F2 KwUw 6553.500 t100msxs_uw_b6553p5 0.00 6553.500 FORMAT "%8.3" /end CHARACTERISTIC
/begin CHARACTERISTIC TRIIMPH "Zeitdauer für Pumpimpuls für beide Bänke hinter KAT" VALUE 0x8142F4 KwUw 655.3500 t10msxs_uw_b655p35 0.00 655.3500 FORMAT "%8.4" /end CHARACTERISTIC
/begin CHARACTERISTIC TSTBB "Störunterdrückungszeit für Erkennung Betriebsbereitschaft LSU" VALUE 0x810A3B KwUb 2.550 t10msxs_ub_b2p55 0.00 2.550 FORMAT "%5.3" /end CHARACTERISTIC
/begin CHARACTERISTIC TTAPLC "Frist für Plausibilitätscheck der Ansauglufttemperatur" VALUE 0x81D470 KwUw 6553.500 t100msxs_uw_b6553p5 0.00 6553.500 FORMAT "%8.3" /end CHARACTERISTIC
/begin CHARACTERISTIC TUBKL15 "Filterzeit für redundante KL15-Erfassung" VALUE 0x819F7E KwUb 2.550 t10msxs_ub_b2p55 0.00 2.550 FORMAT "%5.3" /end CHARACTERISTIC
/begin CHARACTERISTIC TUMDETM "Umgebungslufttemperatur-Ersatzwert für Motortemperatur-Modell" VALUE 0x819540 KwUb 191.3 temp_ub_q0p75_o48 -48.00 143.3 FORMAT "%5.1" /end CHARACTERISTIC
/begin CHARACTERISTIC TUPWBWV "Zeitverzögerung zum Einspeichern eines neuen Poti 2 Wertes" VALUE 0x810A59 KwUb 2.550 t10msxs_ub_b2p55 0.00 2.550 FORMAT "%5.3" /end CHARACTERISTIC
/begin CHARACTERISTIC TUPWG12 "Fehlerzeit bei Vergleich von PWG-Poti 1 und 2" VALUE 0x810A5A KwUb 2.550 t10msxs_ub_b2p55 0.00 2.550 FORMAT "%5.3" /end CHARACTERISTIC
/begin CHARACTERISTIC TUPWG1O "Fehlerzeit bei Bereichsverletzung von PWG-Poti 1 nach oben" VALUE 0x810A5B KwUb 2.550 t10msxs_ub_b2p55 0.00 2.550 FORMAT "%5.3" /end CHARACTERISTIC
/begin CHARACTERISTIC TUPWG1U "Fehlerzeit bei Bereichsverletzung von PWG-Poti 1 nach unten" VALUE 0x810A5C KwUb 2.550 t10msxs_ub_b2p55 0.00 2.550 FORMAT "%5.3" /end CHARACTERISTIC
/begin CHARACTERISTIC TUPWG2O "Fehlerzeit bei Bereichsverletzung von PWG-Poti 2 nach oben" VALUE 0x810A5D KwUb 2.550 t10msxs_ub_b2p55 0.00 2.550 FORMAT "%5.3" /end CHARACTERISTIC
/begin CHARACTERISTIC TUPWG2U "Fehlerzeit bei Bereichsverletzung von PWG-Poti 2 nach unten" VALUE 0x810A5E KwUb 2.550 t10msxs_ub_b2p55 0.00 2.550 FORMAT "%5.3" /end CHARACTERISTIC
/begin CHARACTERISTIC TUPWLLU "Entprellzeit zur Fehlererkennung ""unerwartete Leerlaufspannungen""" VALUE 0x810A5F KwUb 2.550 t10msxs_ub_b2p55 0.00 2.550 FORMAT "%5.3" /end CHARACTERISTIC
/begin CHARACTERISTIC TUSBELH "Zeit für Festhaltung der Sondenspannung nach Impulsbelastung  hinter KAT" VALUE 0x810A31 KwUb 2.550 t10msxs_ub_b2p55 0.00 2.550 FORMAT "%5.3" /end CHARACTERISTIC
/begin CHARACTERISTIC TUSRIBERH "Zeitverzög. der Ri-Messung nach Verlassen des Kabelbruchbandes hinter KAT" VALUE 0x8142F6 KwUw 655.3500 t10msxs_uw_b655p35 0.00 655.3500 FORMAT "%8.4" /end CHARACTERISTIC
/begin CHARACTERISTIC TVHSH "Einschaltverzögerung der Sondenheizung hinter Kat" VALUE 0x8188C3 KwUb 25.50 t100msxs_ub_b25p5 0.00 25.50 FORMAT "%5.2" /end CHARACTERISTIC
/begin CHARACTERISTIC TVKOE1 "Verzögerungszeit für Kompressor EIN ( zur Momentreserve)" VALUE 0x812419 KwUb 5.100 t20msxs_ub_b5p1 0.00 5.100 FORMAT "%5.3" /end CHARACTERISTIC
/begin CHARACTERISTIC TVKOEOF "Verzögerungszeit für B_koe AUS" VALUE 0x81241A KwUb 5.100 t20msxs_ub_b5p1 0.00 5.100 FORMAT "%5.3" /end CHARACTERISTIC
/begin CHARACTERISTIC TVKOEP "Verzögerungszeit für Kompressor EIN ( zur Momentreserve)" CURVE 0x81A6A7 KlAUbSstUbWUb 5.100 t20msxs_ub_b5p1 0.00 5.100 FORMAT "%5.3"
 /begin AXIS_DESCR STD_AXIS pkodrc p_q0p2 8 0.00 51.00 FORMAT "%5.2" DEPOSIT ABSOLUTE /end AXIS_DESCR
/end CHARACTERISTIC
/begin CHARACTERISTIC TVKOEV "Verzögerungszeit für Kompressoreinschalten (totzeit)" VALUE 0x81241B KwUb 5.100 t20msxs_ub_b5p1 0.00 5.100 FORMAT "%5.3" /end CHARACTERISTIC
/begin CHARACTERISTIC TVKOGANDEL "Verzögerungszeit für Kompressor EIN ( zur Momentreserve)" VALUE 0x81241C KwUb 5.100 t20msxs_ub_b5p1 0.00 5.100 FORMAT "%5.3" /end CHARACTERISTIC
/begin CHARACTERISTIC TVKOSSIM "Verzögerungszeit für Simulation einer eingeschalteten Klimaanlage im Start" VALUE 0x81A6B8 KwUb 51.00 t200msxs_ub_b51 0.00 51.00 FORMAT "%5.2" /end CHARACTERISTIC
/begin CHARACTERISTIC TVLENA "Verzögerungszeit für Lambdakorrektur" VALUE 0x810A3C KwUb 2.550 t10msxs_ub_b2p55 0.00 2.550 FORMAT "%5.3" /end CHARACTERISTIC
/begin CHARACTERISTIC TVLSUWU "maximale Zeit für ""warm up"" stetige Lambdasonde LSU" VALUE 0x811C1D KwUb 25.50 t100msxs_ub_b25p5 0.00 25.50 FORMAT "%5.2" /end CHARACTERISTIC
/begin CHARACTERISTIC TWBKLHOF "akkumulierte Zeit außerhalb Bereichsgrenzen für Rücksetz. Bed. Kühlleistung hoch" VALUE 0x81D5CC KwUw 6553.400 t100msxs_uw_b6553p5 0.1000000 6553.500 FORMAT "%8.3" /end CHARACTERISTIC
/begin CHARACTERISTIC TWBKLHON "Wartezeit innerhalb Bereichsgrenzen für Bed. Kühlleistung hoch" VALUE 0x81D5CE KwUw 6553.400 t100msxs_uw_b6553p5 0.1000000 6553.500 FORMAT "%8.3" /end CHARACTERISTIC
/begin CHARACTERISTIC TWBKLNOF "akkumulierte Zeit außerh. Bereichsgrenzen für Rücksetz. Bed. Kühlleistung niedri" VALUE 0x81D5D0 KwUw 6553.400 t100msxs_uw_b6553p5 0.1000000 6553.500 FORMAT "%8.3" /end CHARACTERISTIC
/begin CHARACTERISTIC TWBKLNON "Wartezeit innerhalb Bereichsgrenzen für Bed. Kühlleistung niedrig" VALUE 0x81D5D2 KwUw 6553.400 t100msxs_uw_b6553p5 0.1000000 6553.500 FORMAT "%8.3" /end CHARACTERISTIC
/begin CHARACTERISTIC TWDUBRNL "Wartezeit für Diagnose UBR im Nachlauf bis Ausschalten Komponenten" VALUE 0x8188D4 KwUb 25.40 t100msxs_ub_b25p5 0.1000 25.50 FORMAT "%5.2" /end CHARACTERISTIC
/begin CHARACTERISTIC TWNLPTAMN "Mindest-Wartezeit im Nachlauf für Stuck-Signal-Check TANS" VALUE 0x81D472 KwUw 6553.500 t100msxs_uw_b6553p5 0.00 6553.500 FORMAT "%8.3" /end CHARACTERISTIC
/begin CHARACTERISTIC TWPLK "Entprellzeit für Rücknahme der LL-Vorgabe bei Lebendkennung" VALUE 0x8188F5 KwUb 25.50 t100msxs_ub_b25p5 0.00 25.50 FORMAT "%5.2" /end CHARACTERISTIC
/begin CHARACTERISTIC TWPMBBR "Verzögerungszeit für Pedalwertbegrenzung bei betätigter Bremse" VALUE 0x810A60 KwUb 2.550 t10msxs_ub_b2p55 0.00 2.550 FORMAT "%5.3" /end CHARACTERISTIC
/begin CHARACTERISTIC TWRDZGMX "Max. Wartezeit bis Rücksetzen Bedingung TMOT- Delta zu groß" VALUE 0x819541 KwUb 25.40 t100msxs_ub_b25p5 0.1000 25.50 FORMAT "%5.2" /end CHARACTERISTIC
/begin CHARACTERISTIC TWSSCTM "Wartezeit bis Freigabe Min/Max-Monitor Stuck-Signal-Check Motortemperatursignal" VALUE 0x819542 KwUb 25.50 t100msxs_ub_b25p5 0.00 25.50 FORMAT "%5.2" /end CHARACTERISTIC
/begin CHARACTERISTIC TWTMNHST "Wartezeit für tmot-Max-Diagnose nach Heißstart" VALUE 0x819543 KwUb 255.0 t1sxs_ub_b255 0.00 255.0 FORMAT "%5.1" /end CHARACTERISTIC
/begin CHARACTERISTIC TWTMNTAFX "Mindest-Wartezeit nach Erreichen Mot.-Temp.-Schwelle für Wärmeübergang auf TANS" VALUE 0x81D474 KwUw 6553.500 t100msxs_uw_b6553p5 0.00 6553.500 FORMAT "%8.3" /end CHARACTERISTIC
/begin CHARACTERISTIC UBDE "Ubatt - Ersatzwert bei defektem AD - Kanal" VALUE 0x81440A KwUw 1153.416 spg_ubatt_w 0.00 1153.416 FORMAT "%8.3" /end CHARACTERISTIC
/begin CHARACTERISTIC UBDMN1 "Batteriespannung min. (Netz)" VALUE 0x810A41 KwUb 17.95 spg_ubatt 0.00 17.95 FORMAT "%5.2" /end CHARACTERISTIC
/begin CHARACTERISTIC UBDMN2 "Batteriespannung min. (ADC)" VALUE 0x810A42 KwUb 17.95 spg_ubatt 0.00 17.95 FORMAT "%5.2" /end CHARACTERISTIC
/begin CHARACTERISTIC UBDMN3 "Batteriespannung, untere Schwelle für Umschaltung auf Nachlaufwertübernahme" VALUE 0x810A43 KwUb 17.95 spg_ubatt 0.00 17.95 FORMAT "%5.2" /end CHARACTERISTIC
/begin CHARACTERISTIC UBDMX "Batteriespannung max." VALUE 0x810A44 KwUb 17.95 spg_ubatt 0.00 17.95 FORMAT "%5.2" /end CHARACTERISTIC
/begin CHARACTERISTIC UBGGLSU "Batteriespannungsschwelle zur Freigabe B_sbbvk LSU" VALUE 0x8187DA KwUb 17.95 spg_ubatt 0.00 17.95 FORMAT "%5.2" /end CHARACTERISTIC
/begin CHARACTERISTIC UBHS "Batteriespannungsschwelle für Abschalten der Sondenheizung" VALUE 0x8188C4 KwUb 17.95 spg_ubatt 0.00 17.95 FORMAT "%5.2" /end CHARACTERISTIC
/begin CHARACTERISTIC UBKL15 "Ub-Schwelle für redundaten KL15-Erfassung" VALUE 0x819F7F KwUb 4.998 spg_ubatt 0.00 4.998 FORMAT "%5.3" /end CHARACTERISTIC
/begin CHARACTERISTIC UBMNPUP "Mindest-Bordspannung für pullup-Ansteuerung" VALUE 0x819544 KwUb 25.50 spg_q0p1 0.00 25.50 FORMAT "%5.2" /end CHARACTERISTIC
/begin CHARACTERISTIC UBNACHL "Ub-Ersatzwert im Nachlauf" VALUE 0x81440C KwUw 1153.416 spg_ubatt_w 0.00 1153.416 FORMAT "%8.3" /end CHARACTERISTIC
/begin CHARACTERISTIC UBRDMN1 "untere Grenze Bordnetzspannung über Hauptrelais, Erkennung Lastabfall" VALUE 0x8188D5 KwUb 25.50 spg_q0p1 0.00 25.50 FORMAT "%5.2" /end CHARACTERISTIC
/begin CHARACTERISTIC UBRDMN2 "untere Grenze Bordnetzspannung über Hauptrelais" VALUE 0x8188D6 KwUb 25.50 spg_q0p1 0.00 25.50 FORMAT "%5.2" /end CHARACTERISTIC
/begin CHARACTERISTIC UBRDMX "obere Grenze Bordnetzspannung über Hauptrelais" VALUE 0x8188D7 KwUb 28.38 spg_ub_b28p5 0.00 28.38 FORMAT "%5.2" /end CHARACTERISTIC
/begin CHARACTERISTIC UBRDUNL "Schwellwert für Unplausibilität der Bordnetzspannung über Hauptrelais (im Nachl)" VALUE 0x8188D8 KwUb 25.50 spg_q0p1 0.00 25.50 FORMAT "%5.2" /end CHARACTERISTIC
/begin CHARACTERISTIC UHSN "Nennspannung für die Sondenheizung" VALUE 0x8188C5 KwUb 17.95 spg_ubatt 0.00 17.95 FORMAT "%5.2" /end CHARACTERISTIC
/begin CHARACTERISTIC ULSUAMN "Minimale Spannung der LSU während Abgleich" VALUE 0x8143BA KwUw 319.9951 spg_uw_q0p00488 0.00 319.9951 FORMAT "%8.4" /end CHARACTERISTIC
/begin CHARACTERISTIC ULSUAMX "Maximale Spannung der LSU während Abgleich" VALUE 0x8143BC KwUw 319.9951 spg_uw_q0p00488 0.00 319.9951 FORMAT "%8.4" /end CHARACTERISTIC
/begin CHARACTERISTIC UPW1BE "Spannung PWG-Poti 1 für Durchführung der Bewegungserkennung" VALUE 0x810A61 KwUb 4.980 spg_ub_b5 0.00 4.980 FORMAT "%5.3" /end CHARACTERISTIC
/begin CHARACTERISTIC UPW1LLMX "Maximale Spannung von Poti 1 im Leergaspunkt" VALUE 0x810A62 KwUb 4.980 spg_ub_b5 0.00 4.980 FORMAT "%5.3" /end CHARACTERISTIC
/begin CHARACTERISTIC UPWG12U "Untere Begrenzung PWG-Poti-Spannung vor Vergleich Poti 1 und 2" VALUE 0x810A63 KwUb 4.980 spg_ub_b5 0.00 4.980 FORMAT "%5.3" /end CHARACTERISTIC
/begin CHARACTERISTIC UPWG1O "Obere Schranke für PWG-Poti-1-Spannung" VALUE 0x810A64 KwUb 4.980 spg_ub_b5 0.00 4.980 FORMAT "%5.3" /end CHARACTERISTIC
/begin CHARACTERISTIC UPWG1U "Untere Schranke für PWG-Poti-1-Spannung" VALUE 0x810A65 KwUb 4.980 spg_ub_b5 0.00 4.980 FORMAT "%5.3" /end CHARACTERISTIC
/begin CHARACTERISTIC UPWG2O "Obere Schranke für PWG-Poti-2-Spannung" VALUE 0x810A66 KwUb 4.980 spg_ub_b5 0.00 4.980 FORMAT "%5.3" /end CHARACTERISTIC
/begin CHARACTERISTIC UPWG2U "Untere Schranke für PWG-Poti-2-Spannung" VALUE 0x810A67 KwUb 4.980 spg_ub_b5 0.00 4.980 FORMAT "%5.3" /end CHARACTERISTIC
/begin CHARACTERISTIC UPWGO "Oberer PWG-Spannungswert für Umnormierung auf Pedalwert" VALUE 0x810A68 KwUb 4.980 spg_ub_b5 0.00 4.980 FORMAT "%5.3" /end CHARACTERISTIC
/begin CHARACTERISTIC UPWGTG "PWG-Spannungsschwelle für Teilgasbereich" VALUE 0x810A69 KwUb 4.980 spg_ub_b5 0.00 4.980 FORMAT "%5.3" /end CHARACTERISTIC
/begin CHARACTERISTIC UPWGTL "Teillastschwelle der PWG-Spannung in Hochohmigkeitsprüfung" VALUE 0x810A6A KwUb 4.980 spg_ub_b5 0.00 4.980 FORMAT "%5.3" /end CHARACTERISTIC
/begin CHARACTERISTIC UPWGU "Unterer PWG-Spannungswert für Umnormierung auf Pedalwert" VALUE 0x810A6B KwUb 4.980 spg_ub_b5 0.00 4.980 FORMAT "%5.3" /end CHARACTERISTIC
/begin CHARACTERISTIC UPWGUBF "Unterer Spannungswert zur Umnormierung bei erkanntem Bewegungsfehler" VALUE 0x810A6C KwUb 4.980 spg_ub_b5 0.00 4.980 FORMAT "%5.3" /end CHARACTERISTIC
/begin CHARACTERISTIC UPWGUR "Reduzierter unterer PWG-Spannungswert für Umnormierung auf Pedalwert" VALUE 0x810A6D KwUb 4.980 spg_ub_b5 0.00 4.980 FORMAT "%5.3" /end CHARACTERISTIC
/begin CHARACTERISTIC UPWGVG "PWG-Spannungsschwelle für Vollgasbereich" VALUE 0x810A6E KwUb 4.980 spg_ub_b5 0.00 4.980 FORMAT "%5.3" /end CHARACTERISTIC
/begin CHARACTERISTIC USABGL "LSU-Spannung bei Pumpstrom Null" VALUE 0x8143BE KwUw 319.9951 spg_uw_q0p00488 0.00 319.9951 FORMAT "%8.4" /end CHARACTERISTIC
/begin CHARACTERISTIC USRIMINH "Mindest Spannungs-Schwelle für Ri-Messung der Sonde hinter KAT" VALUE 0x8142F8 KwUw 319.9951 spg_uw_q0p00488_o1 -1.000000 318.9951 FORMAT "%8.4" /end CHARACTERISTIC
/begin CHARACTERISTIC USRIOH "Obere Spannungs-Schwelle für Ri-Messung der Sonde hinter KAT" VALUE 0x8142FA KwUw 319.9951 spg_uw_q0p00488_o1 -1.000000 318.9951 FORMAT "%8.4" /end CHARACTERISTIC
/begin CHARACTERISTIC USRIUH "Untere Spannungs-Schwelle für Ri-Messung der Sonde hinter KAT" VALUE 0x8142FC KwUw 319.9951 spg_uw_q0p00488_o1 -1.000000 318.9951 FORMAT "%8.4" /end CHARACTERISTIC
/begin CHARACTERISTIC VBKLHO "obere Fz-Geschwindigkeitsschwelle für Bedingung Kühlleistung hoch" VALUE 0x819545 KwUb 318.8 vfzg_ub_q1p25 0.00 318.8 FORMAT "%5.1" /end CHARACTERISTIC
/begin CHARACTERISTIC VBKLHU "untere Fz-Geschwindigkeitsschwelle für Bedingung Kühlleistung hoch" VALUE 0x819546 KwUb 318.8 vfzg_ub_q1p25 0.00 318.8 FORMAT "%5.1" /end CHARACTERISTIC
/begin CHARACTERISTIC VBKLNO "obere Fz-Geschwindigkeitsschwelle für Bedingung Kühlleistung niedrig" VALUE 0x819547 KwUb 318.8 vfzg_ub_q1p25 0.00 318.8 FORMAT "%5.1" /end CHARACTERISTIC
/begin CHARACTERISTIC VBKLNU "untere Fz-Geschwindigkeitsschwelle für Bedingung Kühlleistung niedrig" VALUE 0x819548 KwUb 318.8 vfzg_ub_q1p25 0.00 318.8 FORMAT "%5.1" /end CHARACTERISTIC
/begin CHARACTERISTIC VFZGSCH "Schwelle für Fahrzeuggeschwindigkeit" VALUE 0x829960 KwUw 511.9922 vfzg_uw_q0p00781 0.00 511.9922 FORMAT "%8.4" /end CHARACTERISTIC
/begin CHARACTERISTIC VFZMN "Erkennen Fahren-Stehen" VALUE 0x814410 KwUw 511.9922 vfzg_uw_b512 0.00 511.9922 FORMAT "%8.4" /end CHARACTERISTIC
/begin CHARACTERISTIC VFZR1O_0_A "Schwelle vfzroh_w für Umschaltung zfcnt von 1 auf ZFCNT1" VALUE 0x81441E KwUw 511.9922 vfzg_uw_b512 0.00 511.9922 FORMAT "%8.4" /end CHARACTERISTIC
/begin CHARACTERISTIC VFZR1O_1_A "Schwelle vfzroh_w für Umschaltung zfcnt von 1 auf ZFCNT1" VALUE 0x814420 KwUw 511.9922 vfzg_uw_b512 0.00 511.9922 FORMAT "%8.4" /end CHARACTERISTIC
/begin CHARACTERISTIC VFZR1O_2_A "Schwelle vfzroh_w für Umschaltung zfcnt von 1 auf ZFCNT1" VALUE 0x814422 KwUw 511.9922 vfzg_uw_b512 0.00 511.9922 FORMAT "%8.4" /end CHARACTERISTIC
/begin CHARACTERISTIC VFZR1O_3_A "Schwelle vfzroh_w für Umschaltung zfcnt von 1 auf ZFCNT1" VALUE 0x814424 KwUw 511.9922 vfzg_uw_b512 0.00 511.9922 FORMAT "%8.4" /end CHARACTERISTIC
/begin CHARACTERISTIC VFZR1U_0_A "Schwelle vfzroh_w für Umschaltung zfcnt von ZFCNT1 auf 1" VALUE 0x814426 KwUw 511.9922 vfzg_uw_b512 0.00 511.9922 FORMAT "%8.4" /end CHARACTERISTIC
/begin CHARACTERISTIC VFZR1U_1_A "Schwelle vfzroh_w für Umschaltung zfcnt von ZFCNT1 auf 1" VALUE 0x814428 KwUw 511.9922 vfzg_uw_b512 0.00 511.9922 FORMAT "%8.4" /end CHARACTERISTIC
/begin CHARACTERISTIC VFZR1U_2_A "Schwelle vfzroh_w für Umschaltung zfcnt von ZFCNT1 auf 1" VALUE 0x81442A KwUw 511.9922 vfzg_uw_b512 0.00 511.9922 FORMAT "%8.4" /end CHARACTERISTIC
/begin CHARACTERISTIC VFZR1U_3_A "Schwelle vfzroh_w für Umschaltung zfcnt von ZFCNT1 auf 1" VALUE 0x81442C KwUw 511.9922 vfzg_uw_b512 0.00 511.9922 FORMAT "%8.4" /end CHARACTERISTIC
/begin CHARACTERISTIC VFZR2O_0_A "Schwelle vfzroh_w für Umschaltung zfcnt von ZFCNT1 auf ZFCNT2" VALUE 0x81442E KwUw 511.9922 vfzg_uw_b512 0.00 511.9922 FORMAT "%8.4" /end CHARACTERISTIC
/begin CHARACTERISTIC VFZR2O_1_A "Schwelle vfzroh_w für Umschaltung zfcnt von ZFCNT1 auf ZFCNT2" VALUE 0x814430 KwUw 511.9922 vfzg_uw_b512 0.00 511.9922 FORMAT "%8.4" /end CHARACTERISTIC
/begin CHARACTERISTIC VFZR2O_2_A "Schwelle vfzroh_w für Umschaltung zfcnt von ZFCNT1 auf ZFCNT2" VALUE 0x814432 KwUw 511.9922 vfzg_uw_b512 0.00 511.9922 FORMAT "%8.4" /end CHARACTERISTIC
/begin CHARACTERISTIC VFZR2O_3_A "Schwelle vfzroh_w für Umschaltung zfcnt von ZFCNT1 auf ZFCNT2" VALUE 0x814434 KwUw 511.9922 vfzg_uw_b512 0.00 511.9922 FORMAT "%8.4" /end CHARACTERISTIC
/begin CHARACTERISTIC VFZR2U_0_A "Schwelle vfzroh_w für Umschaltung zfcnt von ZFCNT2 auf ZFCNT1" VALUE 0x814436 KwUw 511.9922 vfzg_uw_b512 0.00 511.9922 FORMAT "%8.4" /end CHARACTERISTIC
/begin CHARACTERISTIC VFZR2U_1_A "Schwelle vfzroh_w für Umschaltung zfcnt von ZFCNT2 auf ZFCNT1" VALUE 0x814438 KwUw 511.9922 vfzg_uw_b512 0.00 511.9922 FORMAT "%8.4" /end CHARACTERISTIC
/begin CHARACTERISTIC VFZR2U_2_A "Schwelle vfzroh_w für Umschaltung zfcnt von ZFCNT2 auf ZFCNT1" VALUE 0x81443A KwUw 511.9922 vfzg_uw_b512 0.00 511.9922 FORMAT "%8.4" /end CHARACTERISTIC
/begin CHARACTERISTIC VFZR2U_3_A "Schwelle vfzroh_w für Umschaltung zfcnt von ZFCNT2 auf ZFCNT1" VALUE 0x81443C KwUw 511.9922 vfzg_uw_b512 0.00 511.9922 FORMAT "%8.4" /end CHARACTERISTIC
/begin CHARACTERISTIC VKO "Geschwindigkeitsschwelle für AC-Steuerung" VALUE 0x81241D KwUb 318.8 vfzg_ub_q1p25 0.00 318.8 FORMAT "%5.1" /end CHARACTERISTIC
/begin CHARACTERISTIC VKOAO "Obere Geschwindigkeitsschwelle für Kompressorabschaltung" VALUE 0x81241E KwUb 318.8 vfzg_ub_q1p25 0.00 318.8 FORMAT "%5.1" /end CHARACTERISTIC
/begin CHARACTERISTIC VKOB "Geschwindingkeitsschwelle für Ko-Steuerung in Beschleunigung" VALUE 0x81241F KwUb 318.8 vfzg_ub_q1p25 0.00 318.8 FORMAT "%5.1" /end CHARACTERISTIC
/begin CHARACTERISTIC VMDUB "Geschwindigkeitsschwelle min. für Batteriespannungs-Diagnose" VALUE 0x810A45 KwUb 318.8 vfzg_ub_q1p25 0.00 318.8 FORMAT "%5.1" /end CHARACTERISTIC
/begin CHARACTERISTIC VNVKO "Gangerkennungschwelle für KO-Auschalten bei Vollast" VALUE 0x81745E KwUw 511.9922 qnv_uw_b512 0.00 511.9922 FORMAT "%8.4" /end CHARACTERISTIC
/begin CHARACTERISTIC VNVKOB "Gangerkennungschwelle für KO-Abschaltung bei Vollast" VALUE 0x817460 KwUw 511.9922 qnv_uw_b512 0.00 511.9922 FORMAT "%8.4" /end CHARACTERISTIC
/begin CHARACTERISTIC VPTAFXO "0bere Fahrzgeschwindigk.-Schwelle für Plausibilitäts-Check fixiertes TANS Signal" VALUE 0x8194BE KwUb 318.8 vfzg_ub_q1p25 0.00 318.8 FORMAT "%5.1" /end CHARACTERISTIC
/begin CHARACTERISTIC VPTAFXU "untere Fahrzgeschwindigk.Schwelle für Plausibilitäts-Check fixiertes TANS Signal" VALUE 0x8194BF KwUb 318.8 vfzg_ub_q1p25 0.00 318.8 FORMAT "%5.1" /end CHARACTERISTIC
/begin CHARACTERISTIC VRFGRMN "Untere Schwelle vroh_w für FGR-Abschaltung über vfzg_w = 0" VALUE 0x814412 KwUw 511.9922 vfzg_uw_b512 0.00 511.9922 FORMAT "%8.4" /end CHARACTERISTIC
/begin CHARACTERISTIC VTAPLC "Geschwindigkeitsschwelle für Plausibilitätscheck der Ansauglufttemperatur" VALUE 0x8194C0 KwUb 318.8 vfzg_ub_q1p25 0.00 318.8 FORMAT "%5.1" /end CHARACTERISTIC
/begin CHARACTERISTIC VWPMBBR "Mindestgeschwindigkeit für Pedalwertbegrenzung bei betätigter Bremse" VALUE 0x810A6F KwUb 318.8 vfzg_ub_q1p25 0.00 318.8 FORMAT "%5.1" /end CHARACTERISTIC
/begin CHARACTERISTIC WHLSUKOR "Korrekturwert für die  LSU-Heizleistung" VALUE 0x819FF4 KwUb 1.992 fak_ub_b2 0.00 1.992 FORMAT "%5.3" /end CHARACTERISTIC
/begin CHARACTERISTIC WNWAFMX "Begrenzung Adaption Spätanschlag nach 'früh'" VALUE 0x8109C5 KwSb 128.0 kw_q1 -128.0 0.00 FORMAT "%5.1" /end CHARACTERISTIC
/begin CHARACTERISTIC WNWASMX "Obere Begrenzung Adaption NW-Spätanschlag (Richtung spät)" VALUE 0x8109C6 KwSb 127.0 kw_q1 0.00 127.0 FORMAT "%5.1" /end CHARACTERISTIC
/begin CHARACTERISTIC WNWKM "Korrekturwinkel Nockenwelle über Motortemperatur" CURVE 0x81BAF4 KlAUbSstUbWSb 7.969 kw_q0p03125 -4.000 3.969 FORMAT "%5.3"
 /begin AXIS_DESCR STD_AXIS tmot temp_ub_q0p75_o48 5 -48.00 143.3 FORMAT "%5.1" DEPOSIT ABSOLUTE /end AXIS_DESCR
/end CHARACTERISTIC
/begin CHARACTERISTIC WNWKN "Korrekturwinkel Nockenwelle über Drehzahl" CURVE 0x81BB00 KlAUbSstUbWSb 7.969 kw_q0p03125 -4.000 3.969 FORMAT "%5.3"
 /begin AXIS_DESCR STD_AXIS nmot nmot_ub_q40 6 0.00 10200. FORMAT "%5.0" DEPOSIT ABSOLUTE /end AXIS_DESCR
/end CHARACTERISTIC
/begin CHARACTERISTIC WNWRPS "Sollwinkel der Phasengeberflanken in Referenzposition, Nockenwelle 1" VAL_BLK 0x813FB2 KwbUw 1023.984 kw_q0p0156 0.00 1023.984 FORMAT "%8.3" NUMBER 4 /end CHARACTERISTIC
/begin CHARACTERISTIC WPEDKO "Pedalwinkelschwelle für KO-Ausschaltung" CURVE 0x812420 GklWUb 99.61 rel_ub_b100 0.00 99.61 FORMAT "%5.2"
 /begin AXIS_DESCR COM_AXIS nmot nmot_ub_q40 8 0.00 10200. AXIS_PTS_REF SNM08KOUB /end AXIS_DESCR
/end CHARACTERISTIC
/begin CHARACTERISTIC WPMXBR "Maximal zulässiger Pedalwert bei betätigter Bremse (vor Erkennung wped = 0)" VALUE 0x8144CC KwUw 100.0000 relPED_uw_b100 0.00 100.0000 FORMAT "%8.4" /end CHARACTERISTIC
/begin CHARACTERISTIC WPMXNOT "Maximal zulässiger Fahrpedalwert im PWG-Notfahren" VALUE 0x810A70 KwUb 100.0 relPED_ub_b100 0.00 100.0 FORMAT "%5.1" /end CHARACTERISTIC
/begin CHARACTERISTIC WPRMBVH "Pedalwertgrenze zur Rücknahme der Mißbrauchsverhinderung" VALUE 0x8188F6 KwUb 100.0 relPED_ub_b100 0.00 100.0 FORMAT "%5.1" /end CHARACTERISTIC
/begin CHARACTERISTIC ZBWF "Zählerstand für Fehlereintrag Bewegungserkennung" VALUE 0x810A71 KwUb 255.0 dez 0.00 255.0 FORMAT "%5.1" /end CHARACTERISTIC
/begin CHARACTERISTIC ZDRLKRA "Zeitkonstante für Tiefpass Lastgradient in KR" VALUE 0x8159CC KwUw 655.34999985 zk10msxs_uw_b655 0.010000152590 655.36000000 FORMAT "%12.8" /end CHARACTERISTIC
/begin CHARACTERISTIC ZFBFZGL "Filterzeitkonstante für 16-bit-Beschleunigungssignal" VALUE 0x814414 KwUw 1310.6999997 zk20msxs_uw_b1310 0.020000305180 1310.7200000 FORMAT "%12.7" /end CHARACTERISTIC
/begin CHARACTERISTIC ZFCNT1_0_A "Anzahl Zahnflanken im mittleren Geschwindigkeitsbereich" VALUE 0x81443E KwUw 65535.00 dez 0.00 65535.00 FORMAT "%8.2" /end CHARACTERISTIC
/begin CHARACTERISTIC ZFCNT1_1_A "Anzahl Zahnflanken im mittleren Geschwindigkeitsbereich" VALUE 0x814440 KwUw 65535.00 dez 0.00 65535.00 FORMAT "%8.2" /end CHARACTERISTIC
/begin CHARACTERISTIC ZFCNT1_2_A "Anzahl Zahnflanken im mittleren Geschwindigkeitsbereich" VALUE 0x814442 KwUw 65535.00 dez 0.00 65535.00 FORMAT "%8.2" /end CHARACTERISTIC
/begin CHARACTERISTIC ZFCNT1_3_A "Anzahl Zahnflanken im mittleren Geschwindigkeitsbereich" VALUE 0x814444 KwUw 65535.00 dez 0.00 65535.00 FORMAT "%8.2" /end CHARACTERISTIC
/begin CHARACTERISTIC ZFCNT2_0_A "Anzahl Zahnflanken im oberen Geschwindigkeitsbereich" VALUE 0x814446 KwUw 65535.00 dez 0.00 65535.00 FORMAT "%8.2" /end CHARACTERISTIC
/begin CHARACTERISTIC ZFCNT2_1_A "Anzahl Zahnflanken im oberen Geschwindigkeitsbereich" VALUE 0x814448 KwUw 65535.00 dez 0.00 65535.00 FORMAT "%8.2" /end CHARACTERISTIC
/begin CHARACTERISTIC ZFCNT2_2_A "Anzahl Zahnflanken im oberen Geschwindigkeitsbereich" VALUE 0x81444A KwUw 65535.00 dez 0.00 65535.00 FORMAT "%8.2" /end CHARACTERISTIC
/begin CHARACTERISTIC ZFCNT2_3_A "Anzahl Zahnflanken im oberen Geschwindigkeitsbereich" VALUE 0x81444C KwUw 65535.00 dez 0.00 65535.00 FORMAT "%8.2" /end CHARACTERISTIC
/begin CHARACTERISTIC ZFDUSVK "Filterzeitkonstante für LSU-Spannungsabgleich vor Kat" VALUE 0x8143C0 KwUw 655.34999985 zk10msxs_uw_b655 0.010000152590 655.36000000 FORMAT "%12.8" /end CHARACTERISTIC
/begin CHARACTERISTIC ZFRIH "Abschwächungsfaktor für Innenwiderstand Ri-Nernst-Filter hinter KAT" VALUE 0x8142FE KwUw 0.9999847 fak_uw_b1 0.00 0.9999847 FORMAT "%9.7" /end CHARACTERISTIC
/begin CHARACTERISTIC ZFTANS "Zeitkonstante Tiefpaßfilter Ansauglufttemperatur" VALUE 0x81D476 KwUw 6553.4999985 zk100msxs_uw_b6553 0.10000152590 6553.6000000 FORMAT "%12.7" /end CHARACTERISTIC
/begin CHARACTERISTIC ZFUULSU "Filterzeitkonstante für Lambda" VALUE 0x8143C2 KwUw 655.34999985 zk10msxs_uw_b655 0.010000152590 655.36000000 FORMAT "%12.8" /end CHARACTERISTIC
/begin CHARACTERISTIC ZFV_0_A "Zeitkonstante für Filterung des Geschwindigkeitssignals" VALUE 0x81444E KwUw 1310.6999997 zk20msxs_uw_b1310 0.020000305180 1310.7200000 FORMAT "%12.7" /end CHARACTERISTIC
/begin CHARACTERISTIC ZFV_1_A "Zeitkonstante für Filterung des Geschwindigkeitssignals" VALUE 0x814450 KwUw 1310.6999997 zk20msxs_uw_b1310 0.020000305180 1310.7200000 FORMAT "%12.7" /end CHARACTERISTIC
/begin CHARACTERISTIC ZFV_2_A "Zeitkonstante für Filterung des Geschwindigkeitssignals" VALUE 0x814452 KwUw 1310.6999997 zk20msxs_uw_b1310 0.020000305180 1310.7200000 FORMAT "%12.7" /end CHARACTERISTIC
/begin CHARACTERISTIC ZFV_3_A "Zeitkonstante für Filterung des Geschwindigkeitssignals" VALUE 0x814454 KwUw 1310.6999997 zk20msxs_uw_b1310 0.020000305180 1310.7200000 FORMAT "%12.7" /end CHARACTERISTIC
/begin CHARACTERISTIC ZKBKVAB "Zeitkonstante Absteuerung Momentenreserve Katheizen für BKV" VALUE 0x819612 KwUb 25.4996 zk100msxs_ub_b25p5 0.100392 25.6000 FORMAT "%7.4" /end CHARACTERISTIC
/begin CHARACTERISTIC ZKMDKH "Filterzeitkonstante bei Wechsel von Teillast nach LL und umgekehrt" VALUE 0x819613 KwUb 25.4996 zk100msxs_ub_b25p5 0.100392 25.6000 FORMAT "%7.4" /end CHARACTERISTIC
/begin CHARACTERISTIC ZKTMLINSS "Zeitkonstante für Tiefpassfilter tmotlin-Eingang Stuck-Signal-Check" VALUE 0x81D5D4 KwUw 6553.4999985 zk100msxs_uw_b6553 0.10000152590 6553.6000000 FORMAT "%12.7" /end CHARACTERISTIC
/begin CHARACTERISTIC ZNGKRA "Zeitkonstante für Tiefpaß Drehzahlgradient" VALUE 0x8159CE KwUw 655.34999985 zk10msxs_uw_b655 0.010000152590 655.36000000 FORMAT "%12.8" /end CHARACTERISTIC
/begin CHARACTERISTIC ZNWSP "Zeitkonstante für Adaption-Spätanschlagposition" VALUE 0x8109C7 KwUb 99.61 rel_ub_b99p6 0.00 99.61 FORMAT "%5.2" /end CHARACTERISTIC
/begin MEASUREMENT bfzgl_b "Fahrzeuglängsbeschleunigung" SBYTE bfzg_sb_q0p217 1 100 -27.776 27.559 FORMAT "%5.2" ECU_ADDRESS 0x3809B3 /end MEASUREMENT
/begin MEASUREMENT bfzgl_w "Fahrzeugbeschleunigung in Längsrichtung" SWORD bfzg_sw_q4p239Em4 1 100 -13.8904 13.8899 ECU_ADDRESS 0x381C86 /end MEASUREMENT
/begin MEASUREMENT B_0101_ack "" UBYTE B_TRUE 1 100 0 1 BIT_MASK 0x2 FORMAT "%13.11" ECU_ADDRESS 0x380ADF /end MEASUREMENT
/begin MEASUREMENT B_0101_ident "" UBYTE B_TRUE 1 100 0 1 BIT_MASK 0x1 FORMAT "%13.11" ECU_ADDRESS 0x380ADF /end MEASUREMENT
/begin MEASUREMENT B_0101_notadr "" UBYTE B_TRUE 1 100 0 1 BIT_MASK 0x8 FORMAT "%13.11" ECU_ADDRESS 0x380ADF /end MEASUREMENT
/begin MEASUREMENT B_0101_switch "" UBYTE B_TRUE 1 100 0 1 BIT_MASK 0x4 FORMAT "%13.11" ECU_ADDRESS 0x380ADF /end MEASUREMENT
/begin MEASUREMENT B_abll "Bedingung Abgleich im Leerlauf" UBYTE B_TRUE 1 100 0 1 BIT_MASK 0x1 FORMAT "%13.11" ECU_ADDRESS 0x380994 /end MEASUREMENT
/begin MEASUREMENT B_acres "Bedingung für Aufbau einer Drehmomentenreserve bei Klimabereitschaft" UWORD B_TRUE 1 100 0 1 BIT_MASK 0x1 FORMAT "%13.11" ECU_ADDRESS 0xFDA6 /end MEASUREMENT
/begin MEASUREMENT B_bwf "Bedingung: Bewegungserkennung hat Fehler erkannt" UWORD B_TRUE 1 100 0 1 BIT_MASK 0x1 FORMAT "%13.11" ECU_ADDRESS 0x381CB8 /end MEASUREMENT
/begin MEASUREMENT B_bwunpl "Bedingung Unplausibilität bei Bewegungserkennung" UWORD B_TRUE 1 100 0 1 BIT_MASK 0x2 FORMAT "%13.11" ECU_ADDRESS 0x381CB8 /end MEASUREMENT
/begin MEASUREMENT B_bztafx "Bedingung Betriebszyklus-Bedingungen im Normalbetrieb f.TANS-Sensor-FixPrüfung" UBYTE B_TRUE 1 100 0 1 BIT_MASK 0x1 FORMAT "%13.11" ECU_ADDRESS 0x380A64 /end MEASUREMENT
/begin MEASUREMENT B_dnlubr "Bedingung Diagnoseprüfung im Steuergerätenachlauf für UBR durchgeführt" UBYTE B_TRUE 1 100 0 1 BIT_MASK 0x8 FORMAT "%13.11" ECU_ADDRESS 0x3809A9 /end MEASUREMENT
/begin MEASUREMENT B_drlkrdy "Flag für n > NKRUM" UWORD B_TRUE 1 100 0 1 BIT_MASK 0x4 FORMAT "%13.11" ECU_ADDRESS 0xFD74 /end MEASUREMENT
/begin MEASUREMENT B_dubre "Bedingung Freigabe Diagnoseprüfung für UBR-Eingang (Versorgung über Hauptrelais)" UBYTE B_TRUE 1 100 0 1 BIT_MASK 0x1 FORMAT "%13.11" ECU_ADDRESS 0x3809A9 /end MEASUREMENT
/begin MEASUREMENT B_dupw "Bedingung Abweichung zwischen Poti 1 und 2 zu groß" UWORD B_TRUE 1 100 0 1 BIT_MASK 0x4 FORMAT "%13.11" ECU_ADDRESS 0x381CB8 /end MEASUREMENT
/begin MEASUREMENT B_dupw12 "Bedingung zulässige Abweichung zwischen PWG-Poti 1 und 2 überschritten" UWORD B_TRUE 1 100 0 1 BIT_MASK 0x8 FORMAT "%13.11" ECU_ADDRESS 0x381CB8 /end MEASUREMENT
/begin MEASUREMENT B_dveeson "Bedingung: DV-E-Endstufe ist eingeschaltet = P_dveeson" UWORD B_TRUE 1 100 0 1 BIT_MASK 0x4000 FORMAT "%13.11" ECU_ADDRESS 0xFD6A /end MEASUREMENT
/begin MEASUREMENT B_enhlshk "Bedingung Freigabe Heizung Lambdasonde hinter Katalysator" UWORD B_TRUE 1 100 0 1 BIT_MASK 0x4000 FORMAT "%13.11" ECU_ADDRESS 0xFD3C /end MEASUREMENT
/begin MEASUREMENT B_enhlsu "Bedingung Freigabe Heizung LSU" UWORD B_TRUE 1 100 0 1 BIT_MASK 0x200 FORMAT "%13.11" ECU_ADDRESS 0xFD96 /end MEASUREMENT
/begin MEASUREMENT B_enrinh "Bedingung enable für Ri-Nernst mit Filter hinter KAT" UWORD B_TRUE 1 100 0 1 BIT_MASK 0x200 FORMAT "%13.11" ECU_ADDRESS 0xFD34 /end MEASUREMENT
/begin MEASUREMENT B_erinofh "Bedingung enable für Ri-Nernst ohne Filter hinter KAT" UWORD B_TRUE 1 100 0 1 BIT_MASK 0x400 FORMAT "%13.11" ECU_ADDRESS 0xFD34 /end MEASUREMENT
/begin MEASUREMENT B_etafix "Bedingung Unplausibilität fixierter Meßwert für tans diagnostiziert" UBYTE B_TRUE 1 100 0 1 BIT_MASK 0x8 FORMAT "%13.11" ECU_ADDRESS 0x380A64 /end MEASUREMENT
/begin MEASUREMENT B_fztafx "Bedingung Fahrzyklus für Check Ansauglufttemperatursignal TANS fixiert" UBYTE B_TRUE 1 100 0 1 BIT_MASK 0x10 FORMAT "%13.11" ECU_ADDRESS 0x380A64 /end MEASUREMENT
/begin MEASUREMENT B_glf "Bedingung Gleichlauf zwischen Poti 1 und Poti 2 verletzt" UWORD B_TRUE 1 100 0 1 BIT_MASK 0x80 FORMAT "%13.11" ECU_ADDRESS 0xFD40 /end MEASUREMENT
/begin MEASUREMENT B_hmx "Bedingung LSU maximal beheizt" UWORD B_TRUE 1 100 0 1 BIT_MASK 0x400 FORMAT "%13.11" ECU_ADDRESS 0xFD96 /end MEASUREMENT
/begin MEASUREMENT B_holp1 "Bedingung Hochohmigkeit im Leerlauf an PWG-Poti 1 erkannt" UWORD B_TRUE 1 100 0 1 BIT_MASK 0x10 FORMAT "%13.11" ECU_ADDRESS 0x381CB8 /end MEASUREMENT
/begin MEASUREMENT B_holp1a "Bedingung Hochohmigkeit im Leerlauf an PWG-Poti 1 im aktuellen Fahrzyklus" UWORD B_TRUE 1 100 0 1 BIT_MASK 0x20 FORMAT "%13.11" ECU_ADDRESS 0x381CB8 /end MEASUREMENT
/begin MEASUREMENT B_holp1l "Bedingung Hochohmigkeit im Leerlauf an PWG-Poti 1 im letzten Fahrzyklus" UBYTE B_TRUE 1 100 0 1 BIT_MASK 0x1 FORMAT "%13.11" ECU_ADDRESS 0x38312D /end MEASUREMENT
/begin MEASUREMENT B_holp2 "Bedingung Hochohmigkeit im Leerlauf an PWG-Poti 2 erkannt" UWORD B_TRUE 1 100 0 1 BIT_MASK 0x40 FORMAT "%13.11" ECU_ADDRESS 0x381CB8 /end MEASUREMENT
/begin MEASUREMENT B_holp2a "Bedingung Hochohmigkeit im Leerlauf an PWG-Poti 2 im aktuellen Fahrzyklus" UWORD B_TRUE 1 100 0 1 BIT_MASK 0x80 FORMAT "%13.11" ECU_ADDRESS 0x381CB8 /end MEASUREMENT
/begin MEASUREMENT B_holp2l "Bedingung Hochohmigkeit im Leerlauf an PWG-Poti 2 im letzten Fahrzyklus" UBYTE B_TRUE 1 100 0 1 BIT_MASK 0x2 FORMAT "%13.11" ECU_ADDRESS 0x38312D /end MEASUREMENT
/begin MEASUREMENT B_hop1mn "Bedingung Bereichsverletzung nach unten an Poti 1 in Hochohmigkeitsprüfung" UWORD B_TRUE 1 100 0 1 BIT_MASK 0x100 FORMAT "%13.11" ECU_ADDRESS 0x381CB8 /end MEASUREMENT
/begin MEASUREMENT B_hop2mn "Bedingung Bereichsverletzung nach unten an Poti 2 in Hochohmigkeitsprüfung" UWORD B_TRUE 1 100 0 1 BIT_MASK 0x200 FORMAT "%13.11" ECU_ADDRESS 0x381CB8 /end MEASUREMENT
/begin MEASUREMENT B_hopakt "Bedingung Hochohmigkeitsprüfung aktiv" UWORD B_TRUE 1 100 0 1 BIT_MASK 0x400 FORMAT "%13.11" ECU_ADDRESS 0x381CB8 /end MEASUREMENT
/begin MEASUREMENT B_hrevab "Anforderung Ev-Abschaltung bei Hauptrelaisfehler" UBYTE B_TRUE 1 100 0 1 BIT_MASK 0x4 FORMAT "%13.11" ECU_ADDRESS 0x3809A9 /end MEASUREMENT
/begin MEASUREMENT B_hrkng "Bedingung Hauptrelaiskontakt nicht geschlossen" UBYTE B_TRUE 1 100 0 1 BIT_MASK 0x10 FORMAT "%13.11" ECU_ADDRESS 0x3809A9 /end MEASUREMENT
/begin MEASUREMENT B_hrkzlg "Bedingung Hauptrelaiskontakt zu langsam geschlossen" UBYTE B_TRUE 1 100 0 1 BIT_MASK 0x20 FORMAT "%13.11" ECU_ADDRESS 0x3809A9 /end MEASUREMENT
/begin MEASUREMENT B_hsha "Bedingung Sonde hinter Kat ausreichend beheizt" UWORD B_TRUE 1 100 0 1 BIT_MASK 0x8000 FORMAT "%13.11" ECU_ADDRESS 0xFD3C /end MEASUREMENT
/begin MEASUREMENT B_hshe "Bedingung Endstufe Sondenheizung hinter Kat angesteuert" UWORD B_TRUE 1 100 0 1 BIT_MASK 0x1 FORMAT "%13.11" ECU_ADDRESS 0xFD3E /end MEASUREMENT
/begin MEASUREMENT B_hsttwt "Bedingung Wartezeit Max-Fehlererkennung nach Heißstart" UBYTE B_TRUE 1 100 0 1 BIT_MASK 0x1 FORMAT "%13.11" ECU_ADDRESS 0x380A66 /end MEASUREMENT
/begin MEASUREMENT B_hsv "Bedingung Heizung Sonde vor Kat einschaltbereit" UWORD B_TRUE 1 100 0 1 BIT_MASK 0x800 FORMAT "%13.11" ECU_ADDRESS 0xFD96 /end MEASUREMENT
/begin MEASUREMENT B_hsve "Bedingung Endstufe Sondenheizung vor Kat angesteuert" UWORD B_TRUE 1 100 0 1 BIT_MASK 0x1000 FORMAT "%13.11" ECU_ADDRESS 0xFD96 /end MEASUREMENT
/begin MEASUREMENT B_hztanl "Bedingung TANS-Sensor  im Nachlauf aufgeheizt" UBYTE B_TRUE 1 100 0 1 BIT_MASK 0x2 FORMAT "%13.11" ECU_ADDRESS 0x380A64 /end MEASUREMENT
/begin MEASUREMENT B_kdhre "Bedingung Komponenten an Hauptrelais zur Diagnose UBR einschalten" UBYTE B_TRUE 1 100 0 1 BIT_MASK 0x2 FORMAT "%13.11" ECU_ADDRESS 0x3809A9 /end MEASUREMENT
/begin MEASUREMENT B_kl15 "Bedingung Klemme 15" UWORD B_TRUE 1 100 0 1 BIT_MASK 0x2 FORMAT "%13.11" ECU_ADDRESS 0xFD90 /end MEASUREMENT
/begin MEASUREMENT B_kldynrm "Bedingung normales Klopfen bei adapt. Lastdynamik" UWORD B_TRUE 1 100 0 1 BIT_MASK 0x8 FORMAT "%13.11" ECU_ADDRESS 0xFD74 /end MEASUREMENT
/begin MEASUREMENT B_kldystk "Bedingung starkes Klopfen bei adapt. Lastdynamik" UWORD B_TRUE 1 100 0 1 BIT_MASK 0x10 FORMAT "%13.11" ECU_ADDRESS 0xFD74 /end MEASUREMENT
/begin MEASUREMENT B_klh "Bedingung Kühlleistung hoch" UBYTE B_TRUE 1 100 0 1 BIT_MASK 0x10 FORMAT "%13.11" ECU_ADDRESS 0x380A65 /end MEASUREMENT
/begin MEASUREMENT B_kln "Bedingung Kühlleistung niedrig" UBYTE B_TRUE 1 100 0 1 BIT_MASK 0x20 FORMAT "%13.11" ECU_ADDRESS 0x380A65 /end MEASUREMENT
/begin MEASUREMENT B_ko "Bedingung Kompressor freigegeben" UWORD B_TRUE 1 100 0 1 BIT_MASK 0x2 FORMAT "%13.11" ECU_ADDRESS 0xFDA6 /end MEASUREMENT
/begin MEASUREMENT B_koa "Bedingung für Kompressorausschalten" UWORD B_TRUE 1 100 0 1 BIT_MASK 0x4 FORMAT "%13.11" ECU_ADDRESS 0xFDA6 /end MEASUREMENT
/begin MEASUREMENT B_kobaus "Bedingung für Kompressor bei Beschleunigung oder Last" UWORD B_TRUE 1 100 0 1 BIT_MASK 0x8 FORMAT "%13.11" ECU_ADDRESS 0xFDA6 /end MEASUREMENT
/begin MEASUREMENT B_kobmnon "Minimale Einschaltzeit nach Ausschalten bei Beschleunigung oder Vollast" UWORD B_TRUE 1 100 0 1 BIT_MASK 0x10 FORMAT "%13.11" ECU_ADDRESS 0xFDA6 /end MEASUREMENT
/begin MEASUREMENT B_kobped "Bedingung für Kompressor aus bei Beschleunigung über dwped" UWORD B_TRUE 1 100 0 1 BIT_MASK 0x20 FORMAT "%13.11" ECU_ADDRESS 0xFDA6 /end MEASUREMENT
/begin MEASUREMENT B_kobpedt "Bedingung für Kompressorausschalten über dwped nach timer" UWORD B_TRUE 1 100 0 1 BIT_MASK 0x40 FORMAT "%13.11" ECU_ADDRESS 0xFDA6 /end MEASUREMENT
/begin MEASUREMENT B_kobwped "Bedingung : für Kompressorausschalten über wped" UWORD B_TRUE 1 100 0 1 BIT_MASK 0x80 FORMAT "%13.11" ECU_ADDRESS 0xFDA6 /end MEASUREMENT
/begin MEASUREMENT B_kobwpedt "Bedingung : für Kompressorausschalten über wped  nach  timer" UWORD B_TRUE 1 100 0 1 BIT_MASK 0x100 FORMAT "%13.11" ECU_ADDRESS 0xFDA6 /end MEASUREMENT
/begin MEASUREMENT B_koe "Bedingung für Kompressoreinschalten" UWORD B_TRUE 1 100 0 1 BIT_MASK 0x200 FORMAT "%13.11" ECU_ADDRESS 0xFDA6 /end MEASUREMENT
/begin MEASUREMENT B_koena "Bedingung Kompressor freigegeben" UWORD B_TRUE 1 100 0 1 BIT_MASK 0x400 FORMAT "%13.11" ECU_ADDRESS 0xFDA6 /end MEASUREMENT
/begin MEASUREMENT B_koenat "Bedingung Kompressor freigegeben nach Timer" UWORD B_TRUE 1 100 0 1 BIT_MASK 0x800 FORMAT "%13.11" ECU_ADDRESS 0xFDA6 /end MEASUREMENT
/begin MEASUREMENT B_kogandel "Bedingung: verzögerung des  Kompressoreinschaltens  nach Gangwechsel" UWORD B_TRUE 1 100 0 1 BIT_MASK 0x1000 FORMAT "%13.11" ECU_ADDRESS 0xFDA6 /end MEASUREMENT
/begin MEASUREMENT B_koganped "Bedingung für Kompressorabschalten beim Gangwechsel" UWORD B_TRUE 1 100 0 1 BIT_MASK 0x2000 FORMAT "%13.11" ECU_ADDRESS 0xFDA6 /end MEASUREMENT
/begin MEASUREMENT B_koint "Bedingung für Kompressorausschalten  aus  Motormanagement" UWORD B_TRUE 1 100 0 1 BIT_MASK 0x4000 FORMAT "%13.11" ECU_ADDRESS 0xFDA6 /end MEASUREMENT
/begin MEASUREMENT B_komnoff "Bedingung Kompresszor-Mindestabschaltzeit abgelaufen" UWORD B_TRUE 1 100 0 1 BIT_MASK 0x8000 FORMAT "%13.11" ECU_ADDRESS 0xFDA6 /end MEASUREMENT
/begin MEASUREMENT B_komnon "Bedingung Kompresszor-Mindesteinschaltzeit abgelaufen" UWORD B_TRUE 1 100 0 1 BIT_MASK 0x1 FORMAT "%13.11" ECU_ADDRESS 0xFDA8 /end MEASUREMENT
/begin MEASUREMENT B_komxoff "Bedingung Kompresszor-Höchstabschaltzeit abgelaufen" UWORD B_TRUE 1 100 0 1 BIT_MASK 0x2 FORMAT "%13.11" ECU_ADDRESS 0xFDA8 /end MEASUREMENT
/begin MEASUREMENT B_kooff "Bedingung für hartes Kompressorabschalten" UWORD B_TRUE 1 100 0 1 BIT_MASK 0x4 FORMAT "%13.11" ECU_ADDRESS 0xFDA8 /end MEASUREMENT
/begin MEASUREMENT B_koofft "Bedingung für hartes Kompressorabschalten nach Timer" UWORD B_TRUE 1 100 0 1 BIT_MASK 0x8 FORMAT "%13.11" ECU_ADDRESS 0xFDA8 /end MEASUREMENT
/begin MEASUREMENT B_kotmsk "Bedingung für Klimataste ein" UWORD B_TRUE 1 100 0 1 BIT_MASK 0x10 FORMAT "%13.11" ECU_ADDRESS 0xFDA8 /end MEASUREMENT
/begin MEASUREMENT B_kotmsko "Bedingung für Klimataste ein  nach Timer" UWORD B_TRUE 1 100 0 1 BIT_MASK 0x20 FORMAT "%13.11" ECU_ADDRESS 0xFDA8 /end MEASUREMENT
/begin MEASUREMENT B_kov "Bedingung Klimakompressor verboten" UWORD B_TRUE 1 100 0 1 BIT_MASK 0x40 FORMAT "%13.11" ECU_ADDRESS 0xFDA8 /end MEASUREMENT
/begin MEASUREMENT B_kovdown "Überwachungszeit  von  B_ko  nach Reset B_kov  zum B_kotmsko(bidirek. Schnitst.)" UWORD B_TRUE 1 100 0 1 BIT_MASK 0x80 FORMAT "%13.11" ECU_ADDRESS 0xFDA8 /end MEASUREMENT
/begin MEASUREMENT B_kow "Bedingung Kompressor freigegeben" UWORD B_TRUE 1 100 0 1 BIT_MASK 0x100 FORMAT "%13.11" ECU_ADDRESS 0xFDA8 /end MEASUREMENT
/begin MEASUREMENT B_kpl "Bedingung keine Unplausibilität erkannt" UWORD B_TRUE 1 100 0 1 BIT_MASK 0x80 FORMAT "%13.11" ECU_ADDRESS 0xFD6A /end MEASUREMENT
/begin MEASUREMENT B_krldy "Bedingung Lastdynamik für Klopferkennung aktiv" UWORD B_TRUE 1 100 0 1 BIT_MASK 0x20 FORMAT "%13.11" ECU_ADDRESS 0xFD74 /end MEASUREMENT
/begin MEASUREMENT B_krldya "Bedingung Lastdynamikvorhalt und -adaption aktiv" UWORD B_TRUE 1 100 0 1 BIT_MASK 0x40 FORMAT "%13.11" ECU_ADDRESS 0xFD74 /end MEASUREMENT
/begin MEASUREMENT B_krldyf "Bedingung Adaption Lastdynamikvorhalt nach früh freigegeben" UWORD B_TRUE 1 100 0 1 BIT_MASK 0x80 FORMAT "%13.11" ECU_ADDRESS 0xFD74 /end MEASUREMENT
/begin MEASUREMENT B_krldyn "Bedingung Lastdynamik für Stationäradaption aktiv" UWORD B_TRUE 1 100 0 1 BIT_MASK 0x100 FORMAT "%13.11" ECU_ADDRESS 0xFD74 /end MEASUREMENT
/begin MEASUREMENT B_krldyv "Bedingung Lastschwelle für Dynamikvorhalt überschritten" UWORD B_TRUE 1 100 0 1 BIT_MASK 0x200 FORMAT "%13.11" ECU_ADDRESS 0xFD74 /end MEASUREMENT
/begin MEASUREMENT B_krndy "Bedingung Drehzahldynamik für Klopferkennung aktiv" UWORD B_TRUE 1 100 0 1 BIT_MASK 0x400 FORMAT "%13.11" ECU_ADDRESS 0xFD74 /end MEASUREMENT
/begin MEASUREMENT B_krndyn "Bedingung Drehzahldynamik für Stationäradaption aktiv" UWORD B_TRUE 1 100 0 1 BIT_MASK 0x800 FORMAT "%13.11" ECU_ADDRESS 0xFD74 /end MEASUREMENT
/begin MEASUREMENT B_ldpi "Bedingung Reed-Kontakt Leckdiagnosepumpe" UWORD B_TRUE 1 100 0 1 BIT_MASK 0x8000 FORMAT "%13.11" ECU_ADDRESS 0xFD6A /end MEASUREMENT
/begin MEASUREMENT B_llhzta "Bedingung TANS-Sensor  wird im Leerlauf aufgeheizt" UBYTE B_TRUE 1 100 0 1 BIT_MASK 0x4 FORMAT "%13.11" ECU_ADDRESS 0x380A64 /end MEASUREMENT
/begin MEASUREMENT B_lltafx "Bedingung Leerlaufzyklus für Check Ansauglufttemperatursignal TANS fixiert" UBYTE B_TRUE 1 100 0 1 BIT_MASK 0x20 FORMAT "%13.11" ECU_ADDRESS 0x380A64 /end MEASUREMENT
/begin MEASUREMENT B_lsuab "Bedingung Abgleich stetige Lambda-Sonde LSU" UWORD B_TRUE 1 100 0 1 BIT_MASK 0x20 FORMAT "%13.11" ECU_ADDRESS 0xFD3A /end MEASUREMENT
/begin MEASUREMENT B_luv "" UWORD B_TRUE 1 100 0 1 BIT_MASK 0x1 FORMAT "%13.11" ECU_ADDRESS 0xFD6C /end MEASUREMENT
/begin MEASUREMENT B_mbvh "Bedingung Mißbrauchsverhinderung" UWORD B_TRUE 1 100 0 1 BIT_MASK 0x100 FORMAT "%13.11" ECU_ADDRESS 0xFD40 /end MEASUREMENT
/begin MEASUREMENT B_measure "Bedingung Timer TGGLS wird nicht berechnet," UWORD B_TRUE 1 100 0 1 BIT_MASK 0x800 FORMAT "%13.11" ECU_ADDRESS 0xFD34 /end MEASUREMENT
/begin MEASUREMENT B_nac "Bedingung für erhöhte LL-Drehzahl bei Klimaanlage" UWORD B_TRUE 1 100 0 1 BIT_MASK 0x200 FORMAT "%13.11" ECU_ADDRESS 0xFDA8 /end MEASUREMENT
/begin MEASUREMENT B_nputm "Bedingung: Motortemperatursignal im unteren Bereich nicht plausibel ggü. Modell" UBYTE B_TRUE 1 100 0 1 BIT_MASK 0x2 FORMAT "%13.11" ECU_ADDRESS 0x380A65 /end MEASUREMENT
/begin MEASUREMENT B_nwflad "Bedingung Flankenadaption Geber 1 angefordert" UBYTE B_TRUE 1 100 0 1 BIT_MASK 0x1 FORMAT "%13.11" ECU_ADDRESS 0x38096D /end MEASUREMENT
/begin MEASUREMENT B_nwie "Auszuwertender Einlaß-NW-Interrupt liegt vor (Einlaß)" UBYTE B_TRUE 1 100 0 1 BIT_MASK 0x8 FORMAT "%13.11" ECU_ADDRESS 0x383117 /end MEASUREMENT
/begin MEASUREMENT B_pbpabr "Bedingung: Plausibilitätbegrenzung ""Bremse/PWG"" aktivieren über Bremse" UWORD B_TRUE 1 100 0 1 BIT_MASK 0x200 FORMAT "%13.11" ECU_ADDRESS 0xFD40 /end MEASUREMENT
/begin MEASUREMENT B_phad "Adaption Kurbel/Nockenwelle erfolgt" UBYTE B_TRUE 1 100 0 1 BIT_MASK 0x10 FORMAT "%13.11" ECU_ADDRESS 0x383117 /end MEASUREMENT
/begin MEASUREMENT B_phade "Adaption Kurbel/Einlaßnockenwelle erfolgt" UBYTE B_TRUE 1 100 0 1 BIT_MASK 0x80 FORMAT "%13.11" ECU_ADDRESS 0x383117 /end MEASUREMENT
/begin MEASUREMENT B_phgefl "Bedingung, dass Phasenflanke ausgewertet wird" UBYTE B_TRUE 1 100 0 1 BIT_MASK 0x1 FORMAT "%13.11" ECU_ADDRESS 0x38096C /end MEASUREMENT
/begin MEASUREMENT B_phnmo "Bedingung für Umschaltung auf Auswertung von einer Phasenflanke" UBYTE B_TRUE 1 100 0 1 BIT_MASK 0x4 FORMAT "%13.11" ECU_ADDRESS 0x38096C /end MEASUREMENT
/begin MEASUREMENT B_phnmu "Bedingung für Umschaltung auf Auswertung von 2 Phasenflanken" UBYTE B_TRUE 1 100 0 1 BIT_MASK 0x8 FORMAT "%13.11" ECU_ADDRESS 0x38096C /end MEASUREMENT
/begin MEASUREMENT B_plaus "Fehlertyp 'Wert unplausibel' erkannt" UWORD B_TRUE 1 100 0 1 BIT_MASK 0x100 FORMAT "%13.11" ECU_ADDRESS 0xFD6A /end MEASUREMENT
/begin MEASUREMENT B_priph "Bedingung Port schalten für Pumpimpuls hinter KAT" UWORD B_TRUE 1 100 0 1 BIT_MASK 0x1000 FORMAT "%13.11" ECU_ADDRESS 0xFD34 /end MEASUREMENT
/begin MEASUREMENT B_pullup "Bedingung Pullup-Widerstand für NTC zugeschaltet" UBYTE B_TRUE 1 100 0 1 BIT_MASK 0x1 FORMAT "%13.11" ECU_ADDRESS 0x380A65 /end MEASUREMENT
/begin MEASUREMENT B_pullupsw "" UBYTE B_TRUE 1 100 0 1 BIT_MASK 0x80 FORMAT "%13.11" ECU_ADDRESS 0x380A65 /end MEASUREMENT
/begin MEASUREMENT B_pump "Bedingung Starten des Timers TTGLS" UWORD B_TRUE 1 100 0 1 BIT_MASK 0x2000 FORMAT "%13.11" ECU_ADDRESS 0xFD34 /end MEASUREMENT
/begin MEASUREMENT B_pwgbwf "Bedingung PWG-Bewegungsfehler" UBYTE B_TRUE 1 100 0 1 BIT_MASK 0x80 FORMAT "%13.11" ECU_ADDRESS 0x3809C1 /end MEASUREMENT
/begin MEASUREMENT B_pwglk "Bedingung Lebenderkennung PWG" UWORD B_TRUE 1 100 0 1 BIT_MASK 0x2000 FORMAT "%13.11" ECU_ADDRESS 0x381CB8 /end MEASUREMENT
/begin MEASUREMENT B_pwgnotfr "FR-Fehlerreaktion PWG-Notfahren" UWORD B_TRUE 1 100 0 1 BIT_MASK 0x400 FORMAT "%13.11" ECU_ADDRESS 0xFD40 /end MEASUREMENT
/begin MEASUREMENT B_rehs "Restart Sondenheizung" UWORD B_TRUE 1 100 0 1 BIT_MASK 0x2 FORMAT "%13.11" ECU_ADDRESS 0xFD3E /end MEASUREMENT
/begin MEASUREMENT B_riakh "Bedingung für Strom-Pumpen aktualisiert hinter KAT" UWORD B_TRUE 1 100 0 1 BIT_MASK 0x4000 FORMAT "%13.11" ECU_ADDRESS 0xFD34 /end MEASUREMENT
/begin MEASUREMENT B_ribeh "Bedingung Innenwiderstand Ri berechnen für Sonde hinter KAT" UWORD B_TRUE 1 100 0 1 BIT_MASK 0x8000 FORMAT "%13.11" ECU_ADDRESS 0xFD34 /end MEASUREMENT
/begin MEASUREMENT B_riibh "Bedingung Sondenspannung im zulässigen Band für Strompumpen hinter KAT" UWORD B_TRUE 1 100 0 1 BIT_MASK 0x1 FORMAT "%13.11" ECU_ADDRESS 0xFD36 /end MEASUREMENT
/begin MEASUREMENT B_riimph "Bedingung Impuls für Strom-Pumpen hinter KAT" UWORD B_TRUE 1 100 0 1 BIT_MASK 0x2 FORMAT "%13.11" ECU_ADDRESS 0xFD36 /end MEASUREMENT
/begin MEASUREMENT B_rimh "Bedingung (ADC-Trigger) für Messen belastete Sondenspannung hinter KAT" UWORD B_TRUE 1 100 0 1 BIT_MASK 0x4 FORMAT "%13.11" ECU_ADDRESS 0xFD36 /end MEASUREMENT
/begin MEASUREMENT B_rinh "Bedingung Innenwiderstand Ri-Messung der Nernstsonde aktiv hinter Kat" UWORD B_TRUE 1 100 0 1 BIT_MASK 0x8 FORMAT "%13.11" ECU_ADDRESS 0xFD36 /end MEASUREMENT
/begin MEASUREMENT B_ripuh "Bedingung Strom-Pumpen für Sonde hinter KAT" UWORD B_TRUE 1 100 0 1 BIT_MASK 0x10 FORMAT "%13.11" ECU_ADDRESS 0xFD36 /end MEASUREMENT
/begin MEASUREMENT B_rireh "Bedingung Resultat für Innenwiderstand Ri für Sonde hinter KAT" UWORD B_TRUE 1 100 0 1 BIT_MASK 0x20 FORMAT "%13.11" ECU_ADDRESS 0xFD36 /end MEASUREMENT
/begin MEASUREMENT B_risph "Bedingung Sondensprung hinter KAT" UWORD B_TRUE 1 100 0 1 BIT_MASK 0x40 FORMAT "%13.11" ECU_ADDRESS 0xFD36 /end MEASUREMENT
/begin MEASUREMENT B_sbblsu "Bedingung LSU betriebsbereit vor Kat f(lamsons_w)" UWORD B_TRUE 1 100 0 1 BIT_MASK 0x40 FORMAT "%13.11" ECU_ADDRESS 0xFD3A /end MEASUREMENT
/begin MEASUREMENT B_sbbvk "Bedingung Sonde betriebsbereit vor Kat" UWORD B_TRUE 1 100 0 1 BIT_MASK 0x80 FORMAT "%13.11" ECU_ADDRESS 0xFD3A /end MEASUREMENT
/begin MEASUREMENT B_shuerf "Bedingung Sondenspannung hinter KAT erfassen" UWORD B_TRUE 1 100 0 1 BIT_MASK 0x80 FORMAT "%13.11" ECU_ADDRESS 0xFD36 /end MEASUREMENT
/begin MEASUREMENT B_sp1s "Mitteilung an SR: SP1S ist Führungsgröße." UWORD B_TRUE 1 100 0 1 BIT_MASK 0x800 FORMAT "%13.11" ECU_ADDRESS 0xFD40 /end MEASUREMENT
/begin MEASUREMENT B_sp2s "Mitteilung an SR:Poti2 SP2S Führungsgröße,Poti1 Ober-oder Untergrenze überschr." UWORD B_TRUE 1 100 0 1 BIT_MASK 0x1000 FORMAT "%13.11" ECU_ADDRESS 0xFD40 /end MEASUREMENT
/begin MEASUREMENT B_spsa "Bedingung Winkeladaption Kurbel- zu Nockenwelle zulässig" UBYTE B_TRUE 1 100 0 1 BIT_MASK 0x10 FORMAT "%13.11" ECU_ADDRESS 0x38096C /end MEASUREMENT
/begin MEASUREMENT B_spsmin "Mitteilung an SR: '1'= PWG-Notfahren mit SPSMIN" UWORD B_TRUE 1 100 0 1 BIT_MASK 0x2000 FORMAT "%13.11" ECU_ADDRESS 0xFD40 /end MEASUREMENT
/begin MEASUREMENT B_tabgs "Bedingung Abgleich stetige Lambda-Sonde LSU nach Start" UBYTE B_TRUE 1 100 0 1 BIT_MASK 0x4 FORMAT "%13.11" ECU_ADDRESS 0x380994 /end MEASUREMENT
/begin MEASUREMENT B_tevtini "TEV timer wurde neu initialisiert" UWORD B_TRUE 1 100 0 1 BIT_MASK 0x8 FORMAT "%13.11" ECU_ADDRESS 0xFD9E /end MEASUREMENT
/begin MEASUREMENT B_tipin "Tip in erkannt" UWORD B_TRUE 1 100 0 1 BIT_MASK 0x1000 FORMAT "%13.11" ECU_ADDRESS 0xFD74 /end MEASUREMENT
/begin MEASUREMENT B_tmdzg "Bedingung Motortemperatur Signal-Delta zu groß (Gradient)" UBYTE B_TRUE 1 100 0 1 BIT_MASK 0x40 FORMAT "%13.11" ECU_ADDRESS 0x380A65 /end MEASUREMENT
/begin MEASUREMENT B_tmmn "Bedingung: Blockheater erkannt" UWORD B_TRUE 1 100 0 1 BIT_MASK 0x200 FORMAT "%13.11" ECU_ADDRESS 0xFD6A /end MEASUREMENT
/begin MEASUREMENT B_tmsrt "Bedingung Retriggerung Motortemperaturmodell nach Start" UWORD B_TRUE 1 100 0 1 BIT_MASK 0x400 FORMAT "%13.11" ECU_ADDRESS 0xFD6A /end MEASUREMENT
/begin MEASUREMENT B_tvkoe1w "" UWORD B_TRUE 1 100 0 1 BIT_MASK 0x400 FORMAT "%13.11" ECU_ADDRESS 0xFDA8 /end MEASUREMENT
/begin MEASUREMENT B_ubrdmn1 "Bedingung Bordnetzspannung über Hauptrelais kleiner UBRDMN1" UWORD B_TRUE 1 100 0 1 BIT_MASK 0x4 FORMAT "%13.11" ECU_ADDRESS 0xFD3E /end MEASUREMENT
/begin MEASUREMENT B_ubrdmn2 "Bedingung Bordnetzspannung über Hauptrelais größer UBRDMN2" UWORD B_TRUE 1 100 0 1 BIT_MASK 0x8 FORMAT "%13.11" ECU_ADDRESS 0xFD3E /end MEASUREMENT
/begin MEASUREMENT B_ubrk "Bedingung Hauptrelais Kontaktfehler" UWORD B_TRUE 1 100 0 1 BIT_MASK 0x10 FORMAT "%13.11" ECU_ADDRESS 0xFD3E /end MEASUREMENT
/begin MEASUREMENT B_ubrmax "Bedingung Bordnetzspannung über Hauptrelais höher als UBRDMX" UWORD B_TRUE 1 100 0 1 BIT_MASK 0x20 FORMAT "%13.11" ECU_ADDRESS 0xFD3E /end MEASUREMENT
/begin MEASUREMENT B_ubru "Bedingung Unterbrechung zur Bordnetzversorgung über Hauptrelais" UBYTE B_TRUE 1 100 0 1 BIT_MASK 0x1 FORMAT "%13.11" ECU_ADDRESS 0x38312B /end MEASUREMENT
/begin MEASUREMENT B_up2bwf "Bewegungsfehler an Poti 2 bei Abschluß der Bewegungserkennung" UWORD B_TRUE 1 100 0 1 BIT_MASK 0x4000 FORMAT "%13.11" ECU_ADDRESS 0x381CB8 /end MEASUREMENT
/begin MEASUREMENT B_upw12e "Bedingung: Fehler bei Vergleich der beiden normierten PWG-Poti-Spannungen" UBYTE B_TRUE 1 100 0 1 BIT_MASK 0x4 FORMAT "%13.11" ECU_ADDRESS 0x3809C1 /end MEASUREMENT
/begin MEASUREMENT B_upw1mn "Bedingung: Spannung PWG-Poti 1 unterhalb Minimalwert" UBYTE B_TRUE 1 100 0 1 BIT_MASK 0x8 FORMAT "%13.11" ECU_ADDRESS 0x3809C1 /end MEASUREMENT
/begin MEASUREMENT B_upw1mx "Bedingung: Spannung PWG-Poti 1 oberhalb Maximalwert" UBYTE B_TRUE 1 100 0 1 BIT_MASK 0x10 FORMAT "%13.11" ECU_ADDRESS 0x3809C1 /end MEASUREMENT
/begin MEASUREMENT B_upw2mn "Bedingung: Spannung PWG-Poti 2 unterhalb Minimalwert" UBYTE B_TRUE 1 100 0 1 BIT_MASK 0x20 FORMAT "%13.11" ECU_ADDRESS 0x3809C1 /end MEASUREMENT
/begin MEASUREMENT B_upw2mx "Bedingung: Spannung PWG-Poti 2 oberhalb Maximalwert" UBYTE B_TRUE 1 100 0 1 BIT_MASK 0x40 FORMAT "%13.11" ECU_ADDRESS 0x3809C1 /end MEASUREMENT
/begin MEASUREMENT B_upwbwf "Bewegungserkennung hat im aktuellen Fahrzyklus einen Fehler erkannt" UWORD B_TRUE 1 100 0 1 BIT_MASK 0x4000 FORMAT "%13.11" ECU_ADDRESS 0xFD40 /end MEASUREMENT
/begin MEASUREMENT B_upwg1o "Bedingung Bereichsverletzung an PWG-Poti 1 nach oben" UWORD B_TRUE 1 100 0 1 BIT_MASK 0x800 FORMAT "%13.11" ECU_ADDRESS 0x381CB8 /end MEASUREMENT
/begin MEASUREMENT B_upwg1u "Bedingung Bereichsverletzung an PWG-Poti 1 nach unten" UWORD B_TRUE 1 100 0 1 BIT_MASK 0x1000 FORMAT "%13.11" ECU_ADDRESS 0x381CB8 /end MEASUREMENT
/begin MEASUREMENT B_upwg2o "Bedingung Bereichsverletzung an PWG-Poti 2 nach oben" UBYTE B_TRUE 1 100 0 1 BIT_MASK 0x1 FORMAT "%13.11" ECU_ADDRESS 0x3809C1 /end MEASUREMENT
/begin MEASUREMENT B_upwg2u "Bedingung Bereichsverletzung an PWG-Poti 2 nach unten" UBYTE B_TRUE 1 100 0 1 BIT_MASK 0x2 FORMAT "%13.11" ECU_ADDRESS 0x3809C1 /end MEASUREMENT
/begin MEASUREMENT B_usbeh "Bedingung für Zeitzähler zur Ausblendung der Sondenbelastung hinter KAT" UWORD B_TRUE 1 100 0 1 BIT_MASK 0x100 FORMAT "%13.11" ECU_ADDRESS 0xFD36 /end MEASUREMENT
/begin MEASUREMENT B_vnull "Bedingung Fahrzeug steht" UWORD B_TRUE 1 100 0 1 BIT_MASK 0x400 FORMAT "%13.11" ECU_ADDRESS 0xFD3E /end MEASUREMENT
/begin MEASUREMENT B_vpwgerr "Bedingung: Verdacht auf PWG-Fehler" UWORD B_TRUE 1 100 0 1 BIT_MASK 0x8000 FORMAT "%13.11" ECU_ADDRESS 0xFD40 /end MEASUREMENT
/begin MEASUREMENT B_wnwiout "Bedingung: Winkeldifferenz wnwi_ad_w nicht plausibel" UBYTE B_TRUE 1 100 0 1 BIT_MASK 0x40 FORMAT "%13.11" ECU_ADDRESS 0x38096C /end MEASUREMENT
/begin MEASUREMENT B_wpabnb "Bedingung Änderungsbegrenzung des Pedalwerts nach Bremsbetätigung" UWORD B_TRUE 1 100 0 1 BIT_MASK 0x1 FORMAT "%13.11" ECU_ADDRESS 0xFD42 /end MEASUREMENT
/begin MEASUREMENT B_wpmbbr "Bedingung Maximalbegrenzung des Pedalwerts bei Bremsbetätigung" UWORD B_TRUE 1 100 0 1 BIT_MASK 0x2 FORMAT "%13.11" ECU_ADDRESS 0xFD42 /end MEASUREMENT
/begin MEASUREMENT B_wu "Flagge Verzögerungszeit TVLSUWU abgelaufen" UWORD B_TRUE 1 100 0 1 BIT_MASK 0x2000 FORMAT "%13.11" ECU_ADDRESS 0xFD96 /end MEASUREMENT
/begin MEASUREMENT B_znptm "Bedingung: Zyklusflag-Freigabe von Unplausibilitätsprüfung TMOT-Signal" UBYTE B_TRUE 1 100 0 1 BIT_MASK 0x4 FORMAT "%13.11" ECU_ADDRESS 0x380A65 /end MEASUREMENT
/begin MEASUREMENT B_zsitm "Bedingung: Zyklusflag-Freigabe von Signalfehlerprüfung TMOT-Signal" UBYTE B_TRUE 1 100 0 1 BIT_MASK 0x8 FORMAT "%13.11" ECU_ADDRESS 0x380A65 /end MEASUREMENT
/begin MEASUREMENT B_ztafix "Bedingung Unplausibilitätsprüfung für fixiertes tans-Meßwert erfüllt" UBYTE B_TRUE 1 100 0 1 BIT_MASK 0x40 FORMAT "%13.11" ECU_ADDRESS 0x380A64 /end MEASUREMENT
/begin MEASUREMENT ctrbwf "Fehlerzähler Bewegungserkennung" UBYTE dez 1 100 0 255 FORMAT "%5.1" ECU_ADDRESS 0x3809BF /end MEASUREMENT
/begin MEASUREMENT ctr_MD5Block "" UWORD dez 1 100 0 65535 FORMAT "%8.2" ECU_ADDRESS 0x382722 /end MEASUREMENT
/begin MEASUREMENT dist_w "Zurückgelegte Strecke" UWORD dist_uw_q0p1 1 100 0 6553.5 FORMAT "%8.3" ECU_ADDRESS 0x381C88 /end MEASUREMENT
/begin MEASUREMENT dlam_w "delta Lambda, Abweichung von Lambda 1" SWORD fak_sw_b8 1 100 -8 7.99976 FORMAT "%8.6" ECU_ADDRESS 0x381B9C /end MEASUREMENT
/begin MEASUREMENT dmnpbkv_w "Delta um das modellierter Bremskraftverstärkerdruck minimiert wird" SWORD pgrad_q0p15625 1 100 -5120 5119.84 FORMAT "%8.3" ECU_ADDRESS 0x3853FE /end MEASUREMENT
/begin MEASUREMENT dmrdsls_w "Momentenreserve für Diagnose Sekundärluft" UWORD rel_uw_b100 1 100 0 99.9985 FORMAT "%8.5" ECU_ADDRESS 0x384BC2 /end MEASUREMENT
/begin MEASUREMENT dmrkh "Momenten-Reserve für Katheizen" UBYTE rel_ub_b99p6 1 100 0 99.6094 FORMAT "%5.2" ECU_ADDRESS 0x3848BA /end MEASUREMENT
/begin MEASUREMENT dmrkhz_w "Momentenreserve für Katheizen" UWORD rel_uw_b100 1 100 0 99.9985 FORMAT "%8.5" ECU_ADDRESS 0x384BC4 /end MEASUREMENT
/begin MEASUREMENT dmrkh_w "Momentenreserve für Katheizen" UWORD rel_uw_b100 1 100 0 99.9985 FORMAT "%8.5" ECU_ADDRESS 0x384BC6 /end MEASUREMENT
/begin MEASUREMENT dmxpbkv_w "Delta um das modellierter Bremskraftverstärkerdruck vergrößert wird" UWORD pgrad_q0p15625 1 100 0 10239.8 FORMAT "%8.2" ECU_ADDRESS 0x385400 /end MEASUREMENT
/begin MEASUREMENT dpbkvep_w "Druckgradient während Evakuierung des BKV durch el. Pumpe" SWORD pgrad_q0p039 1 100 -1280 1279.96 FORMAT "%8.3" ECU_ADDRESS 0x385402 /end MEASUREMENT
/begin MEASUREMENT dpbkvmx_w "Faktor Druckgradient für Berechnung von dmxpbkv_w" UWORD fak_uw_b8 1 100 0 7.99988 FORMAT "%8.6" ECU_ADDRESS 0x385404 /end MEASUREMENT
/begin MEASUREMENT dpbkvps_w "Druckgradient während Evakuierung des BKV durch ps" SWORD pgrad_q0p039 1 100 -1280 1279.96 FORMAT "%8.3" ECU_ADDRESS 0x385406 /end MEASUREMENT
/begin MEASUREMENT dpbkvsp_w "Druckgradient während Evakuierung des BKV durch Saugstrahlpumpe" SWORD pgrad_q0p039 1 100 -1280 1279.96 FORMAT "%8.3" ECU_ADDRESS 0x385408 /end MEASUREMENT
/begin MEASUREMENT dpbkvu_w "Differenz zwischen Bremskraftverstärker-Druck und Umgebungsdruck" UWORD p_uw_q0p039 1 100 0 2559.96 FORMAT "%8.3" ECU_ADDRESS 0x38540A /end MEASUREMENT
/begin MEASUREMENT dpspvdkd_w "Delta zwischen Saugrohrdruck und Druck vor Drosselklappe" UWORD p_uw_q0p039 1 100 0 2559.96 FORMAT "%8.3" ECU_ADDRESS 0x38540C /end MEASUREMENT
/begin MEASUREMENT drkwtmp_w "Momentenreserve für Kat warmhalten, zeitweise" UWORD rel_uw_b100 1 100 0 99.9985 FORMAT "%8.5" ECU_ADDRESS 0x384BC8 /end MEASUREMENT
/begin MEASUREMENT drlkrav "aktueller Wert aus DRLKRAN" SWORD rel_sw_q0p0234 1 100 -768 767.977 FORMAT "%8.4" ECU_ADDRESS 0x38230C /end MEASUREMENT
/begin MEASUREMENT drlkrdy "Lastgradient für Auslösung KR-Lastdynamik" SWORD rel_sw_q0p0234 1 100 -768 767.977 FORMAT "%8.4" ECU_ADDRESS 0x38230E /end MEASUREMENT
/begin MEASUREMENT drlkrra "Lastgradient für Auslesen Stationäradaption" SWORD rel_sw_q0p0234 1 100 -768 767.977 FORMAT "%8.4" ECU_ADDRESS 0x382310 /end MEASUREMENT
/begin MEASUREMENT dtmabsta "Delta Motortemperatur zwischen letztem Abstellen und aktuellem Start" UBYTE temp_ub_b191p25 1 100 0 191.25 FORMAT "%5.1" ECU_ADDRESS 0x384896 /end MEASUREMENT
/begin MEASUREMENT dwped "Gradient des normierten Fahrpedalwinkels" SBYTE rel_sb_q0p39 1 100 -49.9968 49.6062 FORMAT "%5.2" ECU_ADDRESS 0x3809C0 /end MEASUREMENT
/begin MEASUREMENT dwped_w "Gradient des normierten Fahrpedalwinkels" SWORD rel_sw_b50 1 100 -50 49.9985 FORMAT "%8.5" ECU_ADDRESS 0x381CB6 /end MEASUREMENT
/begin MEASUREMENT dyesv "aktueller Wert Lastdynamikerkennungsschwelle" SWORD rel_sw_q0p0234 1 100 -768 767.977 FORMAT "%8.4" ECU_ADDRESS 0x382312 /end MEASUREMENT
/begin MEASUREMENT dymntv "min. add. Dynamikvorhalt aus KL" UBYTE zw_ub_qn0p75 1 100 -191.25 0 FORMAT "%5.1" ECU_ADDRESS 0x380AD6 /end MEASUREMENT
/begin MEASUREMENT dyrsofv "aktueller Wert Offset für Lastdynamikerkennungsschwelle" SWORD rel_sw_q0p0234 1 100 -768 767.977 FORMAT "%8.4" ECU_ADDRESS 0x382314 /end MEASUREMENT
/begin MEASUREMENT dyrsv "aktueller wert Lastdynamikerkennungsschwelle" SWORD rel_sw_q0p0234 1 100 -768 767.977 FORMAT "%8.4" ECU_ADDRESS 0x382316 /end MEASUREMENT
/begin MEASUREMENT esst_snm08koub "" UWORD rel_ub_b99p6 1 100 0 25599.6 FORMAT "%8.2" ECU_ADDRESS 0x382C48 /end MEASUREMENT
/begin MEASUREMENT flamsls "Faktor Lambdaänderung durch Sekundärluft" UBYTE fak_ub_b1p25_o0p75 1 100 0.75 1.24805 FORMAT "%5.3" ECU_ADDRESS 0x380993 /end MEASUREMENT
/begin MEASUREMENT fmkhfho_w "Höhenkorrektur der Drehmomentenreserve bei Katheizen" UWORD fak_uw_b2 1 100 0 1.99997 FORMAT "%8.6" ECU_ADDRESS 0x384BCA /end MEASUREMENT
/begin MEASUREMENT fmkhtmst "tmst-Korrektur der Drehmomentreserve bei Katheizen" UBYTE fak_ub_b2 1 100 0 1.99219 FORMAT "%5.3" ECU_ADDRESS 0x3848BB /end MEASUREMENT
/begin MEASUREMENT fvst_w "Faktor Vorsteuerung" UWORD fak_uw_b64 1 100 0 63.999 FORMAT "%8.5" ECU_ADDRESS 0x382024 /end MEASUREMENT
/begin MEASUREMENT GGLSUBits "" UBYTE dez 1 100 0 255 FORMAT "%5.1" ECU_ADDRESS 0x380994 /end MEASUREMENT
/begin MEASUREMENT GGPEDlokbits "" UWORD dez 1 100 0 65535 FORMAT "%8.2" ECU_ADDRESS 0x381CB8 /end MEASUREMENT
/begin MEASUREMENT GGPEDlokbits2 "" UBYTE dez 1 100 0 255 FORMAT "%5.1" ECU_ADDRESS 0x3809C1 /end MEASUREMENT
/begin MEASUREMENT GGPEDnonVolbits "" UBYTE dez 1 100 0 255 FORMAT "%5.1" ECU_ADDRESS 0x38312D /end MEASUREMENT
/begin MEASUREMENT GGUBRausbits "" UBYTE dez 1 100 0 255 FORMAT "%5.1" ECU_ADDRESS 0x3809A9 /end MEASUREMENT
/begin MEASUREMENT GGUBRausbitsNOV1 "" UBYTE dez 1 100 0 255 FORMAT "%5.1" ECU_ADDRESS 0x38312B /end MEASUREMENT
/begin MEASUREMENT hlsukor "Korrekturfaktor für die LSU-Heizung" UBYTE fak_ub_b2 1 100 0 1.99219 FORMAT "%5.3" ECU_ADDRESS 0x384015 /end MEASUREMENT
/begin MEASUREMENT iplsuvj_w "Pumpstrom IP LSU" UWORD dez 1 100 0 65535 FORMAT "%8.2" ECU_ADDRESS 0x384A64 /end MEASUREMENT
/begin MEASUREMENT iplsu_w "Pumpstrom IP LSU" SWORD i_q0p0039_mA 1 100 -128 127.996 FORMAT "%8.4" ECU_ADDRESS 0x384A66 /end MEASUREMENT
/begin MEASUREMENT korrfak "" UBYTE fak_ub_b2 1 100 0 1.99219 FORMAT "%5.3" ECU_ADDRESS 0x38489C /end MEASUREMENT
/begin MEASUREMENT kusvk_w "Korrekturwert der LSU-Spannung vor Kat" SWORD spg_sw_q0p00488 1 100 -160 159.995 FORMAT "%8.4" ECU_ADDRESS 0x383A4A /end MEASUREMENT
/begin MEASUREMENT kwp71_bits "" UBYTE dez 1 100 0 255 FORMAT "%5.1" ECU_ADDRESS 0x380ADF /end MEASUREMENT
/begin MEASUREMENT lalsuvj_w "Lambda-Istwert" UWORD fak_uw_b2 1 100 0 1.99997 FORMAT "%8.6" ECU_ADDRESS 0x384A68 /end MEASUREMENT
/begin MEASUREMENT lamsonb_w "Basis-Lambda Istwert" UWORD fak_uw_b16 1 100 0 15.9998 FORMAT "%8.5" ECU_ADDRESS 0x381B9E /end MEASUREMENT
/begin MEASUREMENT lamsoni_w "Lambda-Istwert" UWORD fak_uw_b16 1 100 0 15.9998 FORMAT "%8.5" ECU_ADDRESS 0x381BA0 /end MEASUREMENT
/begin MEASUREMENT lkrnew "Lastwert Zeitpunkt t" SWORD rel_sw_q0p0234 1 100 -768 767.977 FORMAT "%8.4" ECU_ADDRESS 0x382318 /end MEASUREMENT
/begin MEASUREMENT lkrold "Lastwert Zeitpunkt t-dt" SWORD rel_sw_q0p0234 1 100 -768 767.977 FORMAT "%8.4" ECU_ADDRESS 0x38231A /end MEASUREMENT
/begin MEASUREMENT mifakh_w "indiziertes Motormoment für Katheizen" UWORD rel_uw_b100 1 100 0 99.9985 FORMAT "%8.5" ECU_ADDRESS 0x384BCC /end MEASUREMENT
/begin MEASUREMENT mifamx_w "maximales indiziertes Motormoment Fahrerwunsch im PWG-Notfahren" UWORD rel_uw_b100 1 100 0 99.9985 FORMAT "%8.5" ECU_ADDRESS 0x384A98 /end MEASUREMENT
/begin MEASUREMENT mkfamx_w "maximales Kupplungsmoment Fahrerwunsch im PWG-Notfahren" UWORD rel_uw_b100 1 100 0 99.9985 FORMAT "%8.5" ECU_ADDRESS 0x384A9A /end MEASUREMENT
/begin MEASUREMENT mll1 "Luftmassenfluß bezogen auf lambda=1" UBYTE m_ub_b1020 1 100 0 1020 FORMAT "%5.0" ECU_ADDRESS 0x38489D /end MEASUREMENT
/begin MEASUREMENT mulres_w "Korrekturfaktor für Umgebungsdruck und Starttemperatur" UWORD fak_uw_b4 1 100 0 3.99994 FORMAT "%8.6" ECU_ADDRESS 0x384BCE /end MEASUREMENT
/begin MEASUREMENT ngkraf_w "gefilterter Drehzahlgradient" SWORD nmotg_sw_q0p39 1 100 -12800.2 12799.8 FORMAT "%8.2" ECU_ADDRESS 0x38231C /end MEASUREMENT
/begin MEASUREMENT ngkrav_w "aktueller Wert Drehzahldynamikschwelle" SWORD nmotg_sw_q0p39 1 100 -12800.2 12799.8 FORMAT "%8.2" ECU_ADDRESS 0x38231E /end MEASUREMENT
/begin MEASUREMENT ngkrv_w "aktueller Wert Drehzahldynamikschwelle" SWORD nmotg_sw_q0p39 1 100 -12800.2 12799.8 FORMAT "%8.2" ECU_ADDRESS 0x382320 /end MEASUREMENT
/begin MEASUREMENT padlsu_w "Abgasgegendruck (Differenz gg. Umgebung)" UWORD p_uw_q0p039 1 100 0 2559.96 FORMAT "%8.3" ECU_ADDRESS 0x384A6A /end MEASUREMENT
/begin MEASUREMENT palsu_w "Absolutdruck Abgassystem" UWORD p_uw_q0p039 1 100 0 2559.96 FORMAT "%8.3" ECU_ADDRESS 0x384A6C /end MEASUREMENT
/begin MEASUREMENT pbkv "Bremskraftverstärker-Druck von DS" UBYTE p_ub_q5 1 100 0 1275 FORMAT "%5.0" ECU_ADDRESS 0x380BED /end MEASUREMENT
/begin MEASUREMENT pbkvmod_w "Bremskraftverstärkerdruck modelliert" UWORD p_uw_q0p039 1 100 0 2559.96 FORMAT "%8.3" ECU_ADDRESS 0x38540E /end MEASUREMENT
/begin MEASUREMENT pbkvmpu_w "Druckverhältnis pbkvmod_w/pubkv_w" UWORD fak_uw_b2 1 100 0 1.99997 FORMAT "%8.6" ECU_ADDRESS 0x385410 /end MEASUREMENT
/begin MEASUREMENT pbkvpmn_w "min. Druck druch elektrische Bremskraftverstärkerpumpe" UWORD p_uw_q0p039 1 100 0 2559.96 FORMAT "%8.3" ECU_ADDRESS 0x385412 /end MEASUREMENT
/begin MEASUREMENT pbkv_w "Bremskraftverstärker-Druck von DS" UWORD p_uw_q0p039 1 100 0 2559.96 FORMAT "%8.3" ECU_ADDRESS 0x382CB0 /end MEASUREMENT
/begin MEASUREMENT phlsnh "normierte Heizleistung der Lambdasonde hinter Kat" UBYTE fak_ub_q0p01 1 100 0 2.55 FORMAT "%5.3" ECU_ADDRESS 0x38484E /end MEASUREMENT
/begin MEASUREMENT psspbkv_w "Druck Saugstrahlpumpe von Bremskraftverstärker" UWORD p_uw_q0p039 1 100 0 2559.96 FORMAT "%8.3" ECU_ADDRESS 0x385414 /end MEASUREMENT
/begin MEASUREMENT pubkv_w "Umgebungsdruck für Bremskraftver. (im Fehlerfall Umgebungsd. anderer Ersatzwert)" UWORD p_uw_q0p039 1 100 0 2559.96 FORMAT "%8.3" ECU_ADDRESS 0x385416 /end MEASUREMENT
/begin MEASUREMENT P_ats "Port Abgastemperatursensor" UWORD B_TRUE 1 100 0 1 BIT_MASK 0x2 FORMAT "%13.11" ECU_ADDRESS 0xFD6C /end MEASUREMENT
/begin MEASUREMENT P_crsh "Signalport vom AD- Wandler" UWORD B_TRUE 1 100 0 1 BIT_MASK 0x4 FORMAT "%13.11" ECU_ADDRESS 0xFD6C /end MEASUREMENT
/begin MEASUREMENT P_swe "Port ABS-Schlechtwegsignal" UWORD B_TRUE 1 100 0 1 BIT_MASK 0x8 FORMAT "%13.11" ECU_ADDRESS 0xFD6C /end MEASUREMENT
/begin MEASUREMENT rinh_w "Istwert (word) Innenwiderstand Ri-Nernstzelle der Lambdasonde hinter KAT" UWORD r_uw_q2 1 100 0 131070 FORMAT "%8.1" ECU_ADDRESS 0x381B24 /end MEASUREMENT
/begin MEASUREMENT rinofha_w "Innenwiderstand (word) Ri Nernst (alter Wert) ohne Filterung hinter KAT" UWORD r_uw_q2 1 100 0 131070 FORMAT "%8.1" ECU_ADDRESS 0x381B26 /end MEASUREMENT
/begin MEASUREMENT rinofh_w "Innenwiderstand (word) Ri Nernst ohne Filterung hinter KAT" UWORD r_uw_q2 1 100 0 131070 FORMAT "%8.1" ECU_ADDRESS 0x381B28 /end MEASUREMENT
/begin MEASUREMENT rk_w "relative Kraftstoffmasse" UWORD rel_uw_b3072 1 100 0 3071.95 FORMAT "%8.3" ECU_ADDRESS 0x382026 /end MEASUREMENT
/begin MEASUREMENT stuetz "Drehzahladaptionsbereich bei Auslösung der Lastdynamik" UBYTE dez 1 100 0 255 FORMAT "%5.1" ECU_ADDRESS 0x380AD7 /end MEASUREMENT
/begin MEASUREMENT S_ac "Klima-Anforderung aktiv" UWORD B_TRUE 1 100 0 1 BIT_MASK 0x10 FORMAT "%13.11" ECU_ADDRESS 0xFD6C /end MEASUREMENT
/begin MEASUREMENT S_acw "Klima-Anforderung aktiv   über Schalter oder CAN ( nach Konfiguration)" UWORD B_TRUE 1 100 0 1 BIT_MASK 0x800 FORMAT "%13.11" ECU_ADDRESS 0xFDA8 /end MEASUREMENT
/begin MEASUREMENT S_brs "Schalter Bremstest" UWORD B_TRUE 1 100 0 1 BIT_MASK 0x20 FORMAT "%13.11" ECU_ADDRESS 0xFD6C /end MEASUREMENT
/begin MEASUREMENT S_fgrsv "Schalter Setzen/Verzögern am FGR-Bedienhebel" UWORD B_TRUE 1 100 0 1 BIT_MASK 0x40 FORMAT "%13.11" ECU_ADDRESS 0xFD6C /end MEASUREMENT
/begin MEASUREMENT S_fgrwb "Schalter Wiederaufnahme/Beschleunigen am FGR-Bedienhebel" UWORD B_TRUE 1 100 0 1 BIT_MASK 0x80 FORMAT "%13.11" ECU_ADDRESS 0xFD6C /end MEASUREMENT
/begin MEASUREMENT S_kl15 "Schalter Klemme 15" UWORD B_TRUE 1 100 0 1 BIT_MASK 0x100 FORMAT "%13.11" ECU_ADDRESS 0xFD6C /end MEASUREMENT
/begin MEASUREMENT S_ko "Kompressoranforderung aktiv" UWORD B_TRUE 1 100 0 1 BIT_MASK 0x200 FORMAT "%13.11" ECU_ADDRESS 0xFD6C /end MEASUREMENT
/begin MEASUREMENT S_kupp "Schalter Kupplung" UWORD B_TRUE 1 100 0 1 BIT_MASK 0x400 FORMAT "%13.11" ECU_ADDRESS 0xFD6C /end MEASUREMENT
/begin MEASUREMENT S_tal "Schalter Tank leer bzw. Reserve" UWORD B_TRUE 1 100 0 1 BIT_MASK 0x800 FORMAT "%13.11" ECU_ADDRESS 0xFD6C /end MEASUREMENT
/begin MEASUREMENT tamax "maximal aufgetretene Ansauglufttemperatur" UBYTE temp_ub_q0p75_o48 1 100 -48 143.25 FORMAT "%5.1" ECU_ADDRESS 0x384897 /end MEASUREMENT
/begin MEASUREMENT tamin "minimal aufgetretene Ansauglauftemperatur" UBYTE temp_ub_q0p75_o48 1 100 -48 143.25 FORMAT "%5.1" ECU_ADDRESS 0x384898 /end MEASUREMENT
/begin MEASUREMENT tans "Ansaugluft - Temperatur" UBYTE temp_ub_q0p75_o48 1 100 -48 143.25 FORMAT "%5.1" ECU_ADDRESS 0xF9D2 /end MEASUREMENT
/begin MEASUREMENT tansab "Ansauglufttemperatur beim Abstellen" UBYTE temp_ub_q0p75_o48 1 100 -48 143.25 FORMAT "%5.1" ECU_ADDRESS 0x383139 /end MEASUREMENT
/begin MEASUREMENT tansabk_w "Ansauglufttemperatur beim Abstellen intern in Kelvin" UWORD temp_q0p0234_o273 1 100 -273.15 1262.83 FORMAT "%8.3" ECU_ADDRESS 0x383A8C /end MEASUREMENT
/begin MEASUREMENT tansk_w "Ansaugluft - Temperatur in GrdC,  intern in Kelvin gerechnet" UWORD temp_q0p0234_o273 1 100 -273.15 1262.83 FORMAT "%8.3" ECU_ADDRESS 0x384BAE /end MEASUREMENT
/begin MEASUREMENT tanslin "Ansauglufttemperatur, linearisiert und umgerechnet" UBYTE temp_ub_q0p75_o48 1 100 -48 143.25 FORMAT "%5.1" ECU_ADDRESS 0x384899 /end MEASUREMENT
/begin MEASUREMENT tedi "Istwert der Einschaltdauer der LSU-Heizung nach Start" UBYTE t10msxs_ub_b2p55 1 100 0 2.55 FORMAT "%5.3" ECU_ADDRESS 0x380B77 /end MEASUREMENT
/begin MEASUREMENT tedst "Einschaltdauer der LSU-Heizung nach Start" UBYTE t10msxs_ub_b2p55 1 100 0 2.55 FORMAT "%5.3" ECU_ADDRESS 0x380B78 /end MEASUREMENT
/begin MEASUREMENT tedtml "Einschaltdauer der LSU-Heizung abhängig von der Abgastemperatur und ml" UBYTE t10msxs_ub_b2p55 1 100 0 2.55 FORMAT "%5.3" ECU_ADDRESS 0x380B79 /end MEASUREMENT
/begin MEASUREMENT tedub "korrigierte Einschaltdauer der LSU-Heizung" UBYTE t10msxs_ub_b2p55 1 100 0 2.55 FORMAT "%5.3" ECU_ADDRESS 0x380B7A /end MEASUREMENT
/begin MEASUREMENT thhaist "Auszeit für Sondenheizung hinter Kat" UBYTE t10msxs_ub_b2p55 1 100 0 2.55 FORMAT "%5.3" ECU_ADDRESS 0x38484F /end MEASUREMENT
/begin MEASUREMENT thhat "unkorrigierte Ausschaltzeit der Sondenheizung hinter Kat" UBYTE t10msxs_q0p01_o0p05 1 100 -0.05 2.5 FORMAT "%5.3" ECU_ADDRESS 0x384850 /end MEASUREMENT
/begin MEASUREMENT tmew "Motortemperatur-Ersatzwert aus Modell" UBYTE temp_ub_q0p75_o48 1 100 -48 143.25 FORMAT "%5.1" ECU_ADDRESS 0x38489E /end MEASUREMENT
/begin MEASUREMENT tmewab "Motortemperatur-Ersatzwert aus Modell beim Abstellen" UBYTE temp_ub_q0p75_o48 1 100 -48 143.25 FORMAT "%5.1" ECU_ADDRESS 0x38313A /end MEASUREMENT
/begin MEASUREMENT tmlinmax "maximal aufgetretene Motortemperatur-Meßwert" UBYTE temp_ub_q0p75_o48 1 100 -48 143.25 FORMAT "%5.1" ECU_ADDRESS 0x38489F /end MEASUREMENT
/begin MEASUREMENT tmlinmin "minimal aufgetretene Motortemperatur-Meßwert" UBYTE temp_ub_q0p75_o48 1 100 -48 143.25 FORMAT "%5.1" ECU_ADDRESS 0x3848A0 /end MEASUREMENT
/begin MEASUREMENT tmlinvdzg "letzter Motortemperatur-Meßwert vor Erkennung zu großes Delta" UBYTE temp_ub_q0p75_o48 1 100 -48 143.25 FORMAT "%5.1" ECU_ADDRESS 0x3848A1 /end MEASUREMENT
/begin MEASUREMENT tmot "Motor-Temperatur" UBYTE temp_ub_q0p75_o48 1 100 -48 143.25 FORMAT "%5.1" ECU_ADDRESS 0xF9D4 /end MEASUREMENT
/begin MEASUREMENT tmotab "Motortemperatur beim Abstellen" UBYTE temp_ub_q0p75_o48 1 100 -48 143.25 FORMAT "%5.1" ECU_ADDRESS 0x38313B /end MEASUREMENT
/begin MEASUREMENT tmotlin "Motortemperatur, linearisiert und umgerechnet" UBYTE temp_ub_q0p75_o48 1 100 -48 143.25 FORMAT "%5.1" ECU_ADDRESS 0x3848A2 /end MEASUREMENT
/begin MEASUREMENT tmotlinab "gemessene Motor-Abstelltemperatur, linearisiert und umgerechnet" UBYTE temp_ub_q0p75_o48 1 100 -48 143.25 FORMAT "%5.1" ECU_ADDRESS 0x38400D /end MEASUREMENT
/begin MEASUREMENT tmotlinlp "" UBYTE temp_ub_q0p75_o48 1 100 -48 143.25 FORMAT "%5.1" ECU_ADDRESS 0x3848A3 /end MEASUREMENT
/begin MEASUREMENT tmotlinst "gemessene Motortemperatur im Start, linearisiert und umgerechnet" UBYTE temp_ub_q0p75_o48 1 100 -48 143.25 FORMAT "%5.1" ECU_ADDRESS 0x3848A4 /end MEASUREMENT
/begin MEASUREMENT tmotlin_w "Motortemperatur, linearisiert und umgerechnet, 16Bit-Wort" UWORD temp_uw_q0p0029_o48 1 100 -48 143.997 FORMAT "%8.4" ECU_ADDRESS 0x384BB0 /end MEASUREMENT
/begin MEASUREMENT tmotvt "Motortemperatur vor Tiefpaßfilter" UBYTE temp_ub_q0p75_o48 1 100 -48 143.25 FORMAT "%5.1" ECU_ADDRESS 0x3848A5 /end MEASUREMENT
/begin MEASUREMENT tmrw "Motortemperatur-Referenzwert aus Modell" UBYTE temp_ub_q0p75_o48 1 100 -48 143.25 FORMAT "%5.1" ECU_ADDRESS 0x3848A6 /end MEASUREMENT
/begin MEASUREMENT tmrwend "Endwert für Referenzwert Motortemperatur-Modell" UBYTE temp_ub_q0p75_o48 1 100 -48 143.25 FORMAT "%5.1" ECU_ADDRESS 0x3848A7 /end MEASUREMENT
/begin MEASUREMENT tmsnp "Motor-Starttemperatur des Betriebszyklus' mit erstmaliger tmot-Unplausibilität" UBYTE temp_ub_q0p75_o48 1 100 -48 143.25 FORMAT "%5.1" ECU_ADDRESS 0x38400E /end MEASUREMENT
/begin MEASUREMENT tmst "Motorstarttemperatur" UBYTE temp_ub_q0p75_o48 1 100 -48 143.25 FORMAT "%5.1" ECU_ADDRESS 0x3848A8 /end MEASUREMENT
/begin MEASUREMENT tumginp "Umgebungstemperatur als Eingangsgröße für Kennfeld KFDTMTU" UBYTE temp_ub_q0p75_o48 1 100 -48 143.25 FORMAT "%5.1" ECU_ADDRESS 0x3848A9 /end MEASUREMENT
/begin MEASUREMENT t_idle_ctr "" UBYTE dez 1 100 0 255 FORMAT "%5.1" ECU_ADDRESS 0x3848D6 /end MEASUREMENT
/begin MEASUREMENT ub "Batteriespannung" UBYTE spg_ubatt 1 100 0 17.952 FORMAT "%5.2" ECU_ADDRESS 0x3809AE /end MEASUREMENT
/begin MEASUREMENT ubrsq "Bordnetzspannung über Hauptrelais, Standard-Quantisierung" UBYTE spg_q0p1 1 100 0 25.5 FORMAT "%5.2" ECU_ADDRESS 0x3809AA /end MEASUREMENT
/begin MEASUREMENT ubrsqf "" UBYTE spg_q0p1 1 100 0 25.5 FORMAT "%5.2" ECU_ADDRESS 0x3809AB /end MEASUREMENT
/begin MEASUREMENT ubrsqf_w "" UWORD spg_q0p00039 1 100 0 25.5996 FORMAT "%8.5" ECU_ADDRESS 0x381C58 /end MEASUREMENT
/begin MEASUREMENT ubrsqka "Bordnetzspannung über HR, standardquantisiert, bei ausgeschalteten Komponenten" UBYTE spg_q0p1 1 100 0 25.5 FORMAT "%5.2" ECU_ADDRESS 0x3809AC /end MEASUREMENT
/begin MEASUREMENT ubrsqke "Bordnetzspannung über HR, standardquantisiert, bei eingeschalteten Komponenten" UBYTE spg_q0p1 1 100 0 25.5 FORMAT "%5.2" ECU_ADDRESS 0x3809AD /end MEASUREMENT
/begin MEASUREMENT ubrsq_w "Bordnetzspannung über Hauptrelais (word), Standard-Quantisierung" UWORD spg_q0p00039 1 100 0 25.5996 FORMAT "%8.5" ECU_ADDRESS 0x381C5A /end MEASUREMENT
/begin MEASUREMENT ubsq "Bordnetzspannung, umgerechnet in Standard-Quantisierung" UBYTE spg_q0p1 1 100 0 25.5 FORMAT "%5.2" ECU_ADDRESS 0x3809AF /end MEASUREMENT
/begin MEASUREMENT ubsqf "Bordnetzspannung, umgerechnet in Standard-Quantisierung und gefiltert" UBYTE spg_q0p1 1 100 0 25.5 FORMAT "%5.2" ECU_ADDRESS 0x3809B0 /end MEASUREMENT
/begin MEASUREMENT ubsqf_w "Bordnetzspannung, umgerechnet in Standard-Quantisierung und gefiltert" UWORD spg_q0p00039 1 100 0 25.5996 FORMAT "%8.5" ECU_ADDRESS 0x381C6C /end MEASUREMENT
/begin MEASUREMENT ubsq_w "Bordnetzspannung, umgerechnet in Standard-Quantisierung" UWORD spg_q0p00039 1 100 0 25.5996 FORMAT "%8.5" ECU_ADDRESS 0x381C6E /end MEASUREMENT
/begin MEASUREMENT upw2ll_w "Spannungswert von PWG-Poti 2 vor der Bewegung" UWORD spg_uw_q0p00488 1 100 0 319.995 FORMAT "%8.4" ECU_ADDRESS 0x383A52 /end MEASUREMENT
/begin MEASUREMENT upwg2d_w "Verdoppelte PWG-Poti-2-Spannung (Word)" UWORD spg_uw_q0p00488 1 100 0 319.995 FORMAT "%8.4" ECU_ADDRESS 0x381CBA /end MEASUREMENT
/begin MEASUREMENT upwg2fil_w "Gefilterte Poti 2 Spannung" UWORD spg_uw_q0p00488 1 100 0 319.995 FORMAT "%8.4" ECU_ADDRESS 0x381CBC /end MEASUREMENT
/begin MEASUREMENT upwgej_w "Entjitterte PWG-Poti-Spannung" UWORD spg_uw_q0p00488 1 100 0 319.995 FORMAT "%8.4" ECU_ADDRESS 0x381CBE /end MEASUREMENT
/begin MEASUREMENT upwg_w "Resultierende PWG-Poti-Spannung nach Plausibilitätsprüfung" UWORD spg_uw_q0p00488 1 100 0 319.995 FORMAT "%8.4" ECU_ADDRESS 0x381CC0 /end MEASUREMENT
/begin MEASUREMENT usbeh_w "Spannung (word) Lambdasonde mit Widerstand belastet hinter KAT" UWORD spg_uw_q0p00488_o1 1 100 -1 318.995 FORMAT "%8.4" ECU_ADDRESS 0x381B2A /end MEASUREMENT
/begin MEASUREMENT ushb_w "Spannung (word) Lambdasonde mit Widerstand belastet hinter KAT" UWORD spg_uw_q0p00488_o1 1 100 -1 318.995 FORMAT "%8.4" ECU_ADDRESS 0x381B2C /end MEASUREMENT
/begin MEASUREMENT ushk "Spannung Lambdasonde hinter Katalysator" UBYTE spg_ub_q0p0052_o0p2 1 100 -0.2 1.13 FORMAT "%5.3" ECU_ADDRESS 0x38098D /end MEASUREMENT
/begin MEASUREMENT ushkr_w "Spannung (word) Lambdasonde Rohwert hinter KAT" UWORD spg_uw_q0p00488_o1 1 100 -1 318.995 FORMAT "%8.4" ECU_ADDRESS 0x381B2E /end MEASUREMENT
/begin MEASUREMENT ushk_w "Spannung Lambdasonde (4.88mV/LSB) hinter Katalysator" UWORD spg_uw_q0p00488_o1 1 100 -1 318.995 FORMAT "%8.4" ECU_ADDRESS 0x381B30 /end MEASUREMENT
/begin MEASUREMENT ushmb_w "Spannung (word, 10 ms-Raster) Lambdasonde mit Widerstand belastet hinter KAT" UWORD spg_uw_q0p00488_o1 1 100 -1 318.995 FORMAT "%8.4" ECU_ADDRESS 0x381B32 /end MEASUREMENT
/begin MEASUREMENT ushob_w "Spannung (word, 10 ms-Raster) Lambdasonde ohne Belastung hinter KAT" UWORD spg_uw_q0p00488_o1 1 100 -1 318.995 FORMAT "%8.4" ECU_ADDRESS 0x381B34 /end MEASUREMENT
/begin MEASUREMENT usobh_w "Spannung (word) Lambdasonde ohne Belastung hinter KAT" UWORD spg_uw_q0p00488_o1 1 100 -1 318.995 FORMAT "%8.4" ECU_ADDRESS 0x381B36 /end MEASUREMENT
/begin MEASUREMENT usvkk_w "LSU-Spannung vor Kat, korrigiert" UWORD spg_uw_q0p00488 1 100 0 319.995 FORMAT "%8.4" ECU_ADDRESS 0x381BA2 /end MEASUREMENT
/begin MEASUREMENT uulsuf_w "gefilterte Sondenspannung vor Kat einer Breitbandlambdasonde" UWORD spg_uw_q0p00488 1 100 0 319.995 FORMAT "%8.4" ECU_ADDRESS 0x381BA4 /end MEASUREMENT
/begin MEASUREMENT uushmb_w "Spannung (word, 1 ms-Raster) Lambdasonde mit Widerstand belastet hinter KAT" UWORD spg_uw_q0p00488 1 100 0 319.995 FORMAT "%8.4" ECU_ADDRESS 0xF926 /end MEASUREMENT
/begin MEASUREMENT uushob_w "ADC-Spannung (word, 1 ms-Raster) Sonde ohne Belastung hinter Katalysator" UWORD spg_uw_q0p00488 1 100 0 319.995 FORMAT "%8.4" ECU_ADDRESS 0xF928 /end MEASUREMENT
/begin MEASUREMENT vfgr_w "Fahrzeug-Ist-Geschwindigkeit für FGR" UWORD vfzg_uw_b512 1 100 0 511.992 FORMAT "%8.4" ECU_ADDRESS 0x381C8A /end MEASUREMENT
/begin MEASUREMENT vfil_w "gefilterte Geschwindigkeit (16-Bit)" UWORD vfzg_uw_b512 1 100 0 511.992 FORMAT "%8.4" ECU_ADDRESS 0x381C8C /end MEASUREMENT
/begin MEASUREMENT vfzg "Fahrzeuggeschwindigkeit" UBYTE vfzg_ub_q1p25 1 100 0 318.75 FORMAT "%5.1" ECU_ADDRESS 0x384857 /end MEASUREMENT
/begin MEASUREMENT vfzg_w "Fahrzeuggeschwindigkeit" UWORD vfzg_uw_b512 1 100 0 511.992 FORMAT "%8.4" ECU_ADDRESS 0x381C8E /end MEASUREMENT
/begin MEASUREMENT vfzroh_w "Fahrzeuggeschwindigkeit Ausgabewert an SCAN-Tool" UWORD vfzg_uw_b512 1 100 0 511.992 FORMAT "%8.4" ECU_ADDRESS 0x381C90 /end MEASUREMENT
/begin MEASUREMENT vroh_w "Fahrzeuggeschwindigkeit ungefiltert" UWORD vfzg_uw_b512 1 100 0 511.992 FORMAT "%8.4" ECU_ADDRESS 0x381C92 /end MEASUREMENT
/begin MEASUREMENT wkrdy "Zündwinkelspätverstellung bei KR-Dynamik" UBYTE zw_ub_qn0p75 1 100 -191.25 0 FORMAT "%5.1" ECU_ADDRESS 0xF9E2 /end MEASUREMENT
/begin MEASUREMENT wkrdya "adaptierter Zündwinkel bei KR-Dynamik" UBYTE zw_ub_qn0p75 1 100 -191.25 0 FORMAT "%5.1" ARRAY_SIZE 5 ECU_ADDRESS 0x3831E8 /end MEASUREMENT
/begin MEASUREMENT wnweoas_w "Winkeldifferenz zwischen adaptierter und aktueller Phasenflanke bez. auf EO / AS" SWORD kw_q0p0078 1 100 -256 255.992 FORMAT "%8.4" ECU_ADDRESS 0x381A58 /end MEASUREMENT
/begin MEASUREMENT wnwe_w "Winkel Einlassventil oeffnet bezogen auf LWOT" SWORD kw_q0p0078 1 100 -256 255.992 FORMAT "%8.4" ECU_ADDRESS 0x381A5A /end MEASUREMENT
/begin MEASUREMENT wnwim_w "Mittelwert Abweichung Adaption Nocken-/Kurbelwelle" UWORD kw_q0p0039 1 100 0 255.996 FORMAT "%8.4" ECU_ADDRESS 0x383A3A /end MEASUREMENT
/begin MEASUREMENT wnwi_ad_w "Winkeldifferenz zwischen adaptierter und aktueller Phasenflanke (word)" SWORD kw_q0p0039 1 100 -128 127.996 FORMAT "%8.4" ECU_ADDRESS 0x381A5C /end MEASUREMENT
/begin MEASUREMENT wnwkor_w "Aktueller Korrekturwert für NW-Signal" SWORD kw_q0p0156 1 100 -512 511.984 FORMAT "%8.4" ECU_ADDRESS 0x384A32 /end MEASUREMENT
/begin MEASUREMENT wnwkwas_w "Winkel Nockenwelle zur Kurbelwelle im Arbeitsspiel" UWORD kw_q0p0156 1 100 0 1023.98 FORMAT "%8.3" ECU_ADDRESS 0x381A5E /end MEASUREMENT
/begin MEASUREMENT wnwspas_w "Adaptionswinkel der Nockenwellenflanken im Arbeitsspiel (Referenzposition)" UWORD kw_q0p0156 1 100 0 1023.98 FORMAT "%8.3" ECU_ADDRESS 0x381A60 /end MEASUREMENT
/begin MEASUREMENT wnwsp_w "Adaptionswinkel Nockenwelle (Spätanschlag)" UWORD kw_q0p0156 1 100 0 1023.98 FORMAT "%8.3" ARRAY_SIZE 4 ECU_ADDRESS 0x383A3C /end MEASUREMENT
/begin MEASUREMENT wped "Normierter Fahrpedalwinkel" UBYTE relPED_ub_b100 1 100 0 100 FORMAT "%5.1" ECU_ADDRESS 0x3809C2 /end MEASUREMENT
/begin MEASUREMENT wpedt_w "Pedalwert (temporär) bei 2 ME-Steuergeräten" UWORD relPED_uw_b100 1 100 0 100 FORMAT "%8.4" ECU_ADDRESS 0x381CC2 /end MEASUREMENT
/begin MEASUREMENT wpedv_w "Normierter Fahrpedalwinkel vor Berücksichtigung der Begrenzungen im Notfahren" UWORD relPED_uw_b100 1 100 0 100 FORMAT "%8.4" ECU_ADDRESS 0x381CC4 /end MEASUREMENT
/begin MEASUREMENT wped_w "normierter Fahrpedalwinkel" UWORD relPED_uw_b100 1 100 0 100 FORMAT "%8.4" ECU_ADDRESS 0x381CC6 /end MEASUREMENT
/begin MEASUREMENT zaldy "Zündungszähler für Abregelung Lastdynamik" UBYTE dez 1 100 0 255 FORMAT "%5.1" ECU_ADDRESS 0x380AD8 /end MEASUREMENT
/begin MEASUREMENT zbeztafix "Zähler für Bedingungen Check Ansauglufttemperatursignal TANS fixiert" UBYTE dez 1 100 0 255 FORMAT "%5.1" ECU_ADDRESS 0x38400C /end MEASUREMENT
/begin MEASUREMENT zfcnt "Zähler Zahnflanken zur Messung der Fahrzeuggeschwindigkeit" UBYTE dez 1 100 0 255 FORMAT "%5.1" ECU_ADDRESS 0x3809B4 /end MEASUREMENT
/begin MEASUREMENT zfzptafx "Zählerstand Fahrzyklen für Check Ansauglufttemperatursignal TANS fixiert" UBYTE dez 1 100 0 255 FORMAT "%5.1" ECU_ADDRESS 0x38489A /end MEASUREMENT
/begin MEASUREMENT zldy "Zündungszähler für Lastdynamik" UBYTE dez 1 100 0 255 FORMAT "%5.1" ECU_ADDRESS 0xF9E3 /end MEASUREMENT
/begin MEASUREMENT zldyke "Zündungszähler für Lastdynamik => Klopferkennung" UBYTE dez 1 100 0 255 FORMAT "%5.1" ECU_ADDRESS 0xF9E4 /end MEASUREMENT
/begin MEASUREMENT zllptafx "Zählerstand Lerrlaufzyklen für Check Ansauglufttemperatursignal TANS fixiert" UBYTE dez 1 100 0 255 FORMAT "%5.1" ECU_ADDRESS 0x38489B /end MEASUREMENT
/begin MEASUREMENT zndy "Zündungszähler für Drehzahldynamik" UBYTE dez 1 100 0 255 FORMAT "%5.1" ECU_ADDRESS 0xF9E5 /end MEASUREMENT
/begin MEASUREMENT zphfl "Zähler äquidistante Phasenflanken" UBYTE dez 1 100 0 255 FORMAT "%5.1" ECU_ADDRESS 0x38096E /end MEASUREMENT
/begin MEASUREMENT zriberh "Ri-Berechnungszähler nach Start hinter KAT" UBYTE dez 1 100 0 255 FORMAT "%5.1" ECU_ADDRESS 0x38098E /end MEASUREMENT
/begin MEASUREMENT zrinh_w "Zeitzähler zur Bereitstellung der aktuellen Bedingung Ri-Nernst hinter KAT" UWORD t100msxs_uw_b6553p5 1 100 0 6553.5 FORMAT "%8.3" ECU_ADDRESS 0x381B38 /end MEASUREMENT
/begin MEASUREMENT zzwdykr "Zündungszähler bei gesetztem Bit B_zwkra=1 während der KR-Dynamik" UWORD dez 1 100 0 65535 FORMAT "%8.2" ECU_ADDRESS 0xF9E6 /end MEASUREMENT
/begin MEASUREMENT zzwdymd "Zündungszähler bei nicht gesetztem Bit B_zwkra=0 während der KR-Dynamik" UWORD dez 1 100 0 65535 FORMAT "%8.2" ECU_ADDRESS 0xF9E8 /end MEASUREMENT
/begin FUNCTION GGLSH "3.40      Gebergröße Lambdasondensignal (Nernst-Type) hinter Kat"
 /begin DEF_CHARACTERISTIC ANZRIBEH CWGGLSH DUSRIH DUSSPH FRINOF RBEL RINHMX RKSP TGGLS THSRIH TRIAKTH TRIIMPH TUSBELH TUSRIBERH USRIMINH USRIOH USRIUH ZFRIH /end DEF_CHARACTERISTIC
 /begin REF_CHARACTERISTIC /end REF_CHARACTERISTIC
 /begin IN_MEASUREMENT B_lsh B_lsv B_ripuv B_sa B_svuerf B_ttbmhh uushk_w /end IN_MEASUREMENT
 /begin OUT_MEASUREMENT B_priph B_pump B_rinh B_shuerf rinh_w ushk ushk_w /end OUT_MEASUREMENT
 /begin LOC_MEASUREMENT B_enrinh B_erinofh B_measure B_riakh B_ribeh B_riibh B_riimph B_rimh B_ripuh B_rireh B_risph B_usbeh rinofha_w rinofh_w usbeh_w ushb_w ushkr_w ushmb_w ushob_w usobh_w uushmb_w uushob_w zriberh zrinh_w /end LOC_MEASUREMENT
 /begin SUB_FUNCTION /end SUB_FUNCTION
/end FUNCTION
/begin FUNCTION GGLSU "5.30      Gebersignal LSU"
 /begin DEF_CHARACTERISTIC CWGGLSU FLAMPA FLSUIP KFBBLSU KFLAMSLS LALIUS PADMSA PUELSU SDLAA SDLAB TABGL TABGS TSTBB TVLENA UBGGLSU ULSUAMN ULSUAMX USABGL ZFDUSVK ZFUULSU /end DEF_CHARACTERISTIC
 /begin REF_CHARACTERISTIC /end REF_CHARACTERISTIC
 /begin IN_MEASUREMENT B_ehlsu B_elsu B_hag B_hsv B_ll B_pwf B_sls B_st B_stend lamsons_w msabg_w nmot pu_w rl ub uulsuv_w /end IN_MEASUREMENT
 /begin OUT_MEASUREMENT B_lsuab B_sbblsu B_sbbvk iplsuvj_w kusvk_w lalsuvj_w lamsoni_w usvkk_w /end OUT_MEASUREMENT
 /begin LOC_MEASUREMENT B_abll B_tabgs dlam_w flamsls GGLSUBits iplsu_w lamsonb_w padlsu_w palsu_w uulsuf_w /end LOC_MEASUREMENT
 /begin SUB_FUNCTION /end SUB_FUNCTION
/end FUNCTION
/begin FUNCTION GGNW "1.20      Winkeladaption der Nockenwelle zur Kurbelwelle" /begin DEF_CHARACTERISTIC PHNMO PHNMU WNWAFMX WNWASMX WNWKM WNWKN WNWRPS ZNWSP /end DEF_CHARACTERISTIC /begin REF_CHARACTERISTIC WNWREO /end REF_CHARACTERISTIC
 /begin IN_MEASUREMENT B_bm B_luecke B_nldg B_nwflade B_pwf B_syn B_synnldg B_zztab gaptooth nmot synstate tmot wkwsyn_w wkw_w zphflsyn zzseg zztab zzyl /end IN_MEASUREMENT
 /begin OUT_MEASUREMENT B_nwie B_phad B_phade wnweoas_w wnwe_w wnwkwas_w wnwspas_w /end OUT_MEASUREMENT
 /begin LOC_MEASUREMENT B_nwflad B_phgefl B_phnmo B_phnmu B_spsa B_wnwiout wnwim_w wnwi_ad_w wnwkor_w wnwsp_w zphfl /end LOC_MEASUREMENT
 /begin SUB_FUNCTION /end SUB_FUNCTION
/end FUNCTION
/begin FUNCTION GGPBKV "2.60      Gebergröße Druck für Bremskraftverstärker"
 /begin DEF_CHARACTERISTIC CWGGPBKV DPBKVBBG DPBKVBSGV0 DPBKVBSGVS DPBKVEBG DPBKVEBGVS DPBKVEVK DPBKVEVKEP DPBKVEVKSP DPBKVSTG DSBGRAD DSBOFS FBKVP KAFPBKVPU PBKVVSTGPV PUEBKV TBKVP TEBBREMS VFZGSCH /end DEF_CHARACTERISTIC
 /begin REF_CHARACTERISTIC /end REF_CHARACTERISTIC
 /begin IN_MEASUREMENT B_bkvp B_brems B_cddsbkv ps_w pu_w pvdkds_w udsbkv_w vfzg_w /end IN_MEASUREMENT
 /begin OUT_MEASUREMENT dpbkvu_w pbkv pbkvpmn_w pbkv_w psspbkv_w pubkv_w /end OUT_MEASUREMENT
 /begin LOC_MEASUREMENT dmnpbkv_w dmxpbkv_w dpbkvep_w dpbkvmx_w dpbkvps_w dpbkvsp_w dpspvdkd_w pbkvmod_w pbkvmpu_w /end LOC_MEASUREMENT
 /begin SUB_FUNCTION /end SUB_FUNCTION
/end FUNCTION
/begin FUNCTION GGPED "8.70      Gebergröße Fahrpedal"
 /begin DEF_CHARACTERISTIC CWBWEEN DUPW12 DUPW12BE DUPW12TG DUPW12VG DUPWGHY DWPMXNB DWPMXNOT DWPOPBP DWPPBP MIFAMXNOT NWPMBBR TDWPOPBP TFPWG2 THOPP1 THOPP2 TMBVH TPNSE1 TUPWBWV TUPWG12 TUPWG1O TUPWG1U TUPWG2O TUPWG2U TUPWLLU TWPLK TWPMBBR UPW1BE UPW1LLMX UPWG12U UPWG1O UPWG1U UPWG2O UPWG2U UPWGO UPWGTG UPWGTL UPWGU UPWGUBF UPWGUR UPWGVG VWPMBBR WPMXBR WPMXNOT WPRMBVH ZBWF /end DEF_CHARACTERISTIC
 /begin REF_CHARACTERISTIC /end REF_CHARACTERISTIC
 /begin IN_MEASUREMENT B_bkva B_bkvv B_bl B_br B_br2k B_brems B_dknot B_dksbeg B_fabr B_nmax B_pwf B_pwgnotum B_stend B_ubpvg nmot upwg1_w upwg2_w vfzg /end IN_MEASUREMENT
 /begin OUT_MEASUREMENT B_pwgnotfr B_upwbwf dwped dwped_w mifamx_w mkfamx_w wped wped_w /end OUT_MEASUREMENT
 /begin LOC_MEASUREMENT B_bwf B_bwunpl B_dupw B_dupw12 B_glf B_holp1 B_holp1a B_holp1l B_holp2 B_holp2a B_holp2l B_hop1mn B_hop2mn B_hopakt B_mbvh B_pbpabr B_pwgbwf B_pwglk B_sp1s B_sp2s B_spsmin B_up2bwf B_upw12e B_upw1mn B_upw1mx B_upw2mn B_upw2mx B_upwg1o B_upwg1u B_upwg2o B_upwg2u B_vpwgerr B_wpabnb B_wpmbbr ctrbwf GGPEDlokbits GGPEDlokbits2 GGPEDnonVolbits upw2ll_w upwg2d_w upwg2fil_w upwgej_w upwg_w wpedt_w wpedv_w /end LOC_MEASUREMENT
 /begin SUB_FUNCTION /end SUB_FUNCTION
/end FUNCTION
/begin FUNCTION GGTFA "18.80     Gebergröße TFA Temperaturfühler Ansaugluft"
 /begin DEF_CHARACTERISTIC AFZPTAFX ALLPTAFX CWKONDTFA DTAFIX DTMABSDTA DTMPTA MLDTAMN MLDTAMX MLPTAFXO MLPTAFXU TADE TADMN TADMX TADPLMX TANSELI TDFZTAFX TDLLTAFX TDNSTA TDPLTAO TDRFZTAFX TDTA TDTAL TDTAPL TDVTAPL TMABDTA1MN TMABDTAMN TMPTAFXMN TMPTAFXU TMSDTAO TMSDTAU TMSPTAFX TMSUPTAFX TTAPLC TWNLPTAMN TWTMNTAFX VPTAFXO VPTAFXU VTAPLC ZFTANS /end DEF_CHARACTERISTIC
 /begin REF_CHARACTERISTIC TNSRT /end REF_CHARACTERISTIC
 /begin IN_MEASUREMENT B_ll B_nldtafx B_nmot B_pwf B_sa B_stend B_tmsrt ml tmot tmotab tmst tnachl_w tnse_w vfzg wtans /end IN_MEASUREMENT
 /begin OUT_MEASUREMENT B_fztafx B_lltafx tans tansab tansabk_w tansk_w tanslin zbeztafix /end OUT_MEASUREMENT
 /begin LOC_MEASUREMENT B_bztafx B_etafix B_hztanl B_kpl B_llhzta B_plaus B_ztafix dtmabsta tamax tamin zfzptafx zllptafx /end LOC_MEASUREMENT
 /begin SUB_FUNCTION /end SUB_FUNCTION
/end FUNCTION
/begin FUNCTION GGTFM "46.60     Gebergröße TFM Temperaturfühler Motor (/-Kühlmittel)"
 /begin DEF_CHARACTERISTIC AFZBKLH AFZBKLN CWKONGTM CW_TABST DTMABDTMN DTMDMA DTMDNPO DTMDZG DTMRESDZG DTMSRT FABSTT KFDTMRS KFDTMTE KFDTMTR KFDTMTU KLDTMFXTM KLITHMS KLTHMDTMS MLOBKLHV MLOBKLNV MLUBKLHV MLUBKLNV TABSMADTM TADMM TANDT1 TANH1 TDBKLOFF TDTM TDTMMA TDTMNP TDTMNPO TDTMPOG TMABDTMN TMDMMA TMDMMAT TMDMMAU TMDMMEE TMDMMER TMDMN TMDMX TMDZGMN TMELIPU1 TMESSCMN TMMXRT TMOTELI TMPUPOFF TMPUPON TMSSSCO TMSSSCU TNLETM TNSRT TUMDETM TWBKLHOF TWBKLHON TWBKLNOF TWBKLNON TWRDZGMX TWSSCTM TWTMNHST UBMNPUP VBKLHO VBKLHU VBKLNO VBKLNU ZKTMLINSS /end DEF_CHARACTERISTIC
 /begin REF_CHARACTERISTIC CWDTHM /end REF_CHARACTERISTIC
 /begin IN_MEASUREMENT B_abstgp B_abstnlgp B_hst B_kl15 B_nletm B_nmin B_nmot B_pwf B_sa B_st B_stend imlatm ml tabst_w tans tansab tmki ubsq vfzg wtmot_w /end IN_MEASUREMENT
 /begin OUT_MEASUREMENT B_tmmn B_tmsrt korrfak tmew tmewab tmlinmax tmlinmin tmlinvdzg tmot tmotab tmotlin tmotlinab tmotlinlp tmotlinst tmotlin_w tmotvt tmrw tmrwend tmsnp tmst tumginp /end OUT_MEASUREMENT
 /begin LOC_MEASUREMENT B_hsttwt B_klh B_kln B_nputm B_pullup B_pullupsw B_tmdzg B_znptm B_zsitm mll1 /end LOC_MEASUREMENT
 /begin SUB_FUNCTION /end SUB_FUNCTION
/end FUNCTION
/begin FUNCTION GGUB "11.30     Gebergröße Batteriespannung, inkl.Diagnose" /begin DEF_CHARACTERISTIC TDNSUB TDUB UBDE UBDMN1 UBDMN2 UBDMN3 UBDMX UBNACHL VMDUB /end DEF_CHARACTERISTIC /begin REF_CHARACTERISTIC /end REF_CHARACTERISTIC /begin IN_MEASUREMENT B_stend B_ubrk ubrsq_w vfzg wub wub_w /end IN_MEASUREMENT /begin OUT_MEASUREMENT ub ubsq ubsqf ubsqf_w ubsq_w /end OUT_MEASUREMENT /begin LOC_MEASUREMENT /end LOC_MEASUREMENT /begin SUB_FUNCTION /end SUB_FUNCTION /end FUNCTION
/begin FUNCTION GGUBR "1.70      Gebergröße und Diagnose Bordnetzspannung über Hauptrelais"
 /begin DEF_CHARACTERISTIC CWKVHR TDAPTUBR TDHREVAB TDRNLUBR TDUBR TDUBRNL TWDUBRNL UBRDMN1 UBRDMN2 UBRDMX UBRDUNL /end DEF_CHARACTERISTIC
 /begin REF_CHARACTERISTIC /end REF_CHARACTERISTIC
 /begin IN_MEASUREMENT B_nldve B_nlsgls B_nlubr B_nmin B_stend ei_ubr_um wubr wubr_w /end IN_MEASUREMENT
 /begin OUT_MEASUREMENT B_dnlubr B_dubre B_hrevab B_hrkng B_hrkzlg B_kdhre B_ubrdmn1 B_ubrdmn2 B_ubrk B_ubrmax B_ubru GGUBRausbits GGUBRausbitsNOV1 ubrsq ubrsqf ubrsqf_w ubrsqka ubrsqke ubrsq_w /end OUT_MEASUREMENT
 /begin LOC_MEASUREMENT /end LOC_MEASUREMENT
 /begin SUB_FUNCTION /end SUB_FUNCTION
/end FUNCTION
/begin FUNCTION GGVFZG "14.70     Gebergröße Fahrzeuggeschwindigkeit"
 /begin DEF_CHARACTERISTIC AIMVM_0_A AIMVM_1_A AIMVM_2_A AIMVM_3_A CWGGVFZG DVFZBEG TFGRVRAB VFZMN VFZR1O_0_A VFZR1O_1_A VFZR1O_2_A VFZR1O_3_A VFZR1U_0_A VFZR1U_1_A VFZR1U_2_A VFZR1U_3_A VFZR2O_0_A VFZR2O_1_A VFZR2O_2_A VFZR2O_3_A VFZR2U_0_A VFZR2U_1_A VFZR2U_2_A VFZR2U_3_A VRFGRMN ZFBFZGL ZFCNT1_0_A ZFCNT1_1_A ZFCNT1_2_A ZFCNT1_3_A ZFCNT2_0_A ZFCNT2_1_A ZFCNT2_2_A ZFCNT2_3_A ZFV_0_A ZFV_1_A ZFV_2_A ZFV_3_A /end DEF_CHARACTERISTIC
 /begin REF_CHARACTERISTIC /end REF_CHARACTERISTIC
 /begin IN_MEASUREMENT B_cankbi vamsr_w vfzgkb_w /end IN_MEASUREMENT
 /begin OUT_MEASUREMENT bfzgl_b bfzgl_w B_vnull dist_w vfgr_w vfzg vfzg_w vfzroh_w zfcnt /end OUT_MEASUREMENT
 /begin LOC_MEASUREMENT vfil_w vroh_w /end LOC_MEASUREMENT
 /begin SUB_FUNCTION /end SUB_FUNCTION
/end FUNCTION
/begin FUNCTION GGZDGON "1.30      Gebergröße Klemme 15" /begin DEF_CHARACTERISTIC TUBKL15 UBKL15 /end DEF_CHARACTERISTIC /begin REF_CHARACTERISTIC /end REF_CHARACTERISTIC /begin IN_MEASUREMENT S_kl15 wub /end IN_MEASUREMENT /begin OUT_MEASUREMENT B_kl15 /end OUT_MEASUREMENT /begin LOC_MEASUREMENT /end LOC_MEASUREMENT /begin SUB_FUNCTION /end SUB_FUNCTION /end FUNCTION
/begin FUNCTION GK "2.80      Gemischkontrolle" /begin DEF_CHARACTERISTIC /end DEF_CHARACTERISTIC /begin REF_CHARACTERISTIC CWWL /end REF_CHARACTERISTIC
 /begin IN_MEASUREMENT fgru fnswl_w fra_w fr_w fst_w fwe lamns_w lamsbg_w nmot rka_w rkte_w rkukg_w rl rlp_w /end IN_MEASUREMENT
 /begin OUT_MEASUREMENT rk_w /end OUT_MEASUREMENT
 /begin LOC_MEASUREMENT fvst_w /end LOC_MEASUREMENT
 /begin SUB_FUNCTION /end SUB_FUNCTION
/end FUNCTION
/begin FUNCTION Hash "" /begin DEF_CHARACTERISTIC /end DEF_CHARACTERISTIC /begin REF_CHARACTERISTIC /end REF_CHARACTERISTIC /begin IN_MEASUREMENT /end IN_MEASUREMENT /begin OUT_MEASUREMENT /end OUT_MEASUREMENT /begin LOC_MEASUREMENT ctr_MD5Block /end LOC_MEASUREMENT /begin SUB_FUNCTION /end SUB_FUNCTION /end FUNCTION
/begin FUNCTION HLSHK "3.30      Sondenheizung hinter Kat"
 /begin DEF_CHARACTERISTIC PHLSNHMN TANHKMMN THHA THHAWU THSHA THSHKTK_0_A THSHKTK_1_A TVHSH UBHS UHSN /end DEF_CHARACTERISTIC
 /begin REF_CHARACTERISTIC /end REF_CHARACTERISTIC
 /begin IN_MEASUREMENT B_atmtpk B_atmtpl B_stend tanhkm_w ub /end IN_MEASUREMENT
 /begin OUT_MEASUREMENT B_hsha B_hshe phlsnh /end OUT_MEASUREMENT
 /begin LOC_MEASUREMENT B_enhlshk B_rehs thhaist thhat /end LOC_MEASUREMENT
 /begin SUB_FUNCTION /end SUB_FUNCTION
/end FUNCTION
/begin FUNCTION HLSU "3.80      Heizung stetige Lambdasonde LSU"
 /begin DEF_CHARACTERISTIC HLSUKORMX KEDNEG KEDPOS KFLSUED_0_A KFLSUED_1_A TABGMHS_0_A TABGMHS_1_A TABSTHLSU TEDTP TLSUTA TLSUVH TMOTSH TVLSUWU WHLSUKOR /end DEF_CHARACTERISTIC
 /begin REF_CHARACTERISTIC UBHS /end REF_CHARACTERISTIC
 /begin IN_MEASUREMENT B_atmtpa B_nmot B_nplsusa B_pwf B_sbbvk B_trkh msabg tabgm tabst_w tans tmot ub /end IN_MEASUREMENT
 /begin OUT_MEASUREMENT B_hsv B_hsve /end OUT_MEASUREMENT
 /begin LOC_MEASUREMENT B_enhlsu B_hmx B_wu hlsukor tedi tedst tedtml tedub /end LOC_MEASUREMENT
 /begin SUB_FUNCTION /end SUB_FUNCTION
/end FUNCTION
/begin FUNCTION HWDIG75 "" /begin DEF_CHARACTERISTIC CWUM_ZDG /end DEF_CHARACTERISTIC /begin REF_CHARACTERISTIC CWKRAPP /end REF_CHARACTERISTIC
 /begin IN_MEASUREMENT B_aav B_bkvp B_ekp B_epcl B_hshe B_hsve B_kov B_ldp B_ldpe B_ldsua B_lsuab B_mil B_nachl B_nwse B_priph B_slp B_slv ldtvm swOffDlBits /end IN_MEASUREMENT
 /begin OUT_MEASUREMENT B_dveeson B_ldpi B_luv P_ats P_crsh P_swe S_ac S_brs S_fgrsv S_fgrwb S_kl15 S_ko S_kupp S_tal /end OUT_MEASUREMENT
 /begin LOC_MEASUREMENT /end LOC_MEASUREMENT
 /begin SUB_FUNCTION /end SUB_FUNCTION
/end FUNCTION
/begin FUNCTION HWTEV "Komponententreiber für Tankentlüftungsventil (TEV)" /begin DEF_CHARACTERISTIC /end DEF_CHARACTERISTIC /begin REF_CHARACTERISTIC /end REF_CHARACTERISTIC /begin IN_MEASUREMENT B_tevtstp tateout tevper /end IN_MEASUREMENT /begin OUT_MEASUREMENT B_tevtini /end OUT_MEASUREMENT /begin LOC_MEASUREMENT /end LOC_MEASUREMENT /begin SUB_FUNCTION /end SUB_FUNCTION /end FUNCTION
/begin FUNCTION ims_501 "" /begin DEF_CHARACTERISTIC TKWFS TRETRY /end DEF_CHARACTERISTIC /begin REF_CHARACTERISTIC /end REF_CHARACTERISTIC /begin IN_MEASUREMENT B_ecudev B_nachl B_nlwfs B_pwf nmot_w swOffDlBits /end IN_MEASUREMENT /begin OUT_MEASUREMENT /end OUT_MEASUREMENT /begin LOC_MEASUREMENT /end LOC_MEASUREMENT /begin SUB_FUNCTION /end SUB_FUNCTION /end FUNCTION
/begin FUNCTION INDEX_BGRBS "" /begin DEF_CHARACTERISTIC /end DEF_CHARACTERISTIC /begin REF_CHARACTERISTIC /end REF_CHARACTERISTIC /begin IN_MEASUREMENT /end IN_MEASUREMENT /begin OUT_MEASUREMENT /end OUT_MEASUREMENT /begin LOC_MEASUREMENT /end LOC_MEASUREMENT /begin SUB_FUNCTION /end SUB_FUNCTION /end FUNCTION
/begin FUNCTION INDEX_CAIR "" /begin DEF_CHARACTERISTIC /end DEF_CHARACTERISTIC /begin REF_CHARACTERISTIC /end REF_CHARACTERISTIC /begin IN_MEASUREMENT /end IN_MEASUREMENT /begin OUT_MEASUREMENT /end OUT_MEASUREMENT /begin LOC_MEASUREMENT /end LOC_MEASUREMENT /begin SUB_FUNCTION /end SUB_FUNCTION /end FUNCTION
/begin FUNCTION INDEX_CALL "" /begin DEF_CHARACTERISTIC /end DEF_CHARACTERISTIC /begin REF_CHARACTERISTIC /end REF_CHARACTERISTIC /begin IN_MEASUREMENT /end IN_MEASUREMENT /begin OUT_MEASUREMENT /end OUT_MEASUREMENT /begin LOC_MEASUREMENT /end LOC_MEASUREMENT /begin SUB_FUNCTION /end SUB_FUNCTION /end FUNCTION
/begin FUNCTION INDEX_CAS "" /begin DEF_CHARACTERISTIC /end DEF_CHARACTERISTIC /begin REF_CHARACTERISTIC /end REF_CHARACTERISTIC /begin IN_MEASUREMENT /end IN_MEASUREMENT /begin OUT_MEASUREMENT /end OUT_MEASUREMENT /begin LOC_MEASUREMENT /end LOC_MEASUREMENT /begin SUB_FUNCTION /end SUB_FUNCTION /end FUNCTION
/begin FUNCTION INDEX_CAT "" /begin DEF_CHARACTERISTIC /end DEF_CHARACTERISTIC /begin REF_CHARACTERISTIC /end REF_CHARACTERISTIC /begin IN_MEASUREMENT /end IN_MEASUREMENT /begin OUT_MEASUREMENT /end OUT_MEASUREMENT /begin LOC_MEASUREMENT /end LOC_MEASUREMENT /begin SUB_FUNCTION /end SUB_FUNCTION /end FUNCTION
/begin FUNCTION INDEX_CBSG "" /begin DEF_CHARACTERISTIC /end DEF_CHARACTERISTIC /begin REF_CHARACTERISTIC /end REF_CHARACTERISTIC /begin IN_MEASUREMENT /end IN_MEASUREMENT /begin OUT_MEASUREMENT /end OUT_MEASUREMENT /begin LOC_MEASUREMENT /end LOC_MEASUREMENT /begin SUB_FUNCTION /end SUB_FUNCTION /end FUNCTION
/begin FUNCTION INDEX_CGE "" /begin DEF_CHARACTERISTIC /end DEF_CHARACTERISTIC /begin REF_CHARACTERISTIC /end REF_CHARACTERISTIC /begin IN_MEASUREMENT /end IN_MEASUREMENT /begin OUT_MEASUREMENT /end OUT_MEASUREMENT /begin LOC_MEASUREMENT /end LOC_MEASUREMENT /begin SUB_FUNCTION /end SUB_FUNCTION /end FUNCTION
/begin FUNCTION INDEX_CGRA "" /begin DEF_CHARACTERISTIC /end DEF_CHARACTERISTIC /begin REF_CHARACTERISTIC /end REF_CHARACTERISTIC /begin IN_MEASUREMENT /end IN_MEASUREMENT /begin OUT_MEASUREMENT /end OUT_MEASUREMENT /begin LOC_MEASUREMENT /end LOC_MEASUREMENT /begin SUB_FUNCTION /end SUB_FUNCTION /end FUNCTION
/begin FUNCTION INDEX_CIF "" /begin DEF_CHARACTERISTIC /end DEF_CHARACTERISTIC /begin REF_CHARACTERISTIC /end REF_CHARACTERISTIC /begin IN_MEASUREMENT /end IN_MEASUREMENT /begin OUT_MEASUREMENT /end OUT_MEASUREMENT /begin LOC_MEASUREMENT /end LOC_MEASUREMENT /begin SUB_FUNCTION /end SUB_FUNCTION /end FUNCTION
/begin FUNCTION INDEX_CINS "" /begin DEF_CHARACTERISTIC /end DEF_CHARACTERISTIC /begin REF_CHARACTERISTIC /end REF_CHARACTERISTIC /begin IN_MEASUREMENT /end IN_MEASUREMENT /begin OUT_MEASUREMENT /end OUT_MEASUREMENT /begin LOC_MEASUREMENT /end LOC_MEASUREMENT /begin SUB_FUNCTION /end SUB_FUNCTION /end FUNCTION
/begin FUNCTION INDEX_CKLA "" /begin DEF_CHARACTERISTIC /end DEF_CHARACTERISTIC /begin REF_CHARACTERISTIC /end REF_CHARACTERISTIC /begin IN_MEASUREMENT /end IN_MEASUREMENT /begin OUT_MEASUREMENT /end OUT_MEASUREMENT /begin LOC_MEASUREMENT /end LOC_MEASUREMENT /begin SUB_FUNCTION /end SUB_FUNCTION /end FUNCTION
/begin FUNCTION INDEX_CLWS "" /begin DEF_CHARACTERISTIC /end DEF_CHARACTERISTIC /begin REF_CHARACTERISTIC /end REF_CHARACTERISTIC /begin IN_MEASUREMENT /end IN_MEASUREMENT /begin OUT_MEASUREMENT /end OUT_MEASUREMENT /begin LOC_MEASUREMENT /end LOC_MEASUREMENT /begin SUB_FUNCTION /end SUB_FUNCTION /end FUNCTION
/begin FUNCTION INDEX_CNIV "" /begin DEF_CHARACTERISTIC /end DEF_CHARACTERISTIC /begin REF_CHARACTERISTIC /end REF_CHARACTERISTIC /begin IN_MEASUREMENT /end IN_MEASUREMENT /begin OUT_MEASUREMENT /end OUT_MEASUREMENT /begin LOC_MEASUREMENT /end LOC_MEASUREMENT /begin SUB_FUNCTION /end SUB_FUNCTION /end FUNCTION
/begin FUNCTION INDEX_CZAS "" /begin DEF_CHARACTERISTIC /end DEF_CHARACTERISTIC /begin REF_CHARACTERISTIC /end REF_CHARACTERISTIC /begin IN_MEASUREMENT /end IN_MEASUREMENT /begin OUT_MEASUREMENT /end OUT_MEASUREMENT /begin LOC_MEASUREMENT /end LOC_MEASUREMENT /begin SUB_FUNCTION /end SUB_FUNCTION /end FUNCTION
/begin FUNCTION INDEX_DAAV "" /begin DEF_CHARACTERISTIC /end DEF_CHARACTERISTIC /begin REF_CHARACTERISTIC /end REF_CHARACTERISTIC /begin IN_MEASUREMENT /end IN_MEASUREMENT /begin OUT_MEASUREMENT /end OUT_MEASUREMENT /begin LOC_MEASUREMENT /end LOC_MEASUREMENT /begin SUB_FUNCTION /end SUB_FUNCTION /end FUNCTION
/begin FUNCTION INDEX_DATR "" /begin DEF_CHARACTERISTIC /end DEF_CHARACTERISTIC /begin REF_CHARACTERISTIC /end REF_CHARACTERISTIC /begin IN_MEASUREMENT /end IN_MEASUREMENT /begin OUT_MEASUREMENT /end OUT_MEASUREMENT /begin LOC_MEASUREMENT /end LOC_MEASUREMENT /begin SUB_FUNCTION /end SUB_FUNCTION /end FUNCTION
/begin FUNCTION INDEX_DATS "" /begin DEF_CHARACTERISTIC /end DEF_CHARACTERISTIC /begin REF_CHARACTERISTIC /end REF_CHARACTERISTIC /begin IN_MEASUREMENT /end IN_MEASUREMENT /begin OUT_MEASUREMENT /end OUT_MEASUREMENT /begin LOC_MEASUREMENT /end LOC_MEASUREMENT /begin SUB_FUNCTION /end SUB_FUNCTION /end FUNCTION
/begin FUNCTION INDEX_DBKVP "" /begin DEF_CHARACTERISTIC /end DEF_CHARACTERISTIC /begin REF_CHARACTERISTIC /end REF_CHARACTERISTIC /begin IN_MEASUREMENT /end IN_MEASUREMENT /begin OUT_MEASUREMENT /end OUT_MEASUREMENT /begin LOC_MEASUREMENT /end LOC_MEASUREMENT /begin SUB_FUNCTION /end SUB_FUNCTION /end FUNCTION
/begin FUNCTION INDEX_DCV "" /begin DEF_CHARACTERISTIC /end DEF_CHARACTERISTIC /begin REF_CHARACTERISTIC /end REF_CHARACTERISTIC /begin IN_MEASUREMENT /end IN_MEASUREMENT /begin OUT_MEASUREMENT /end OUT_MEASUREMENT /begin LOC_MEASUREMENT /end LOC_MEASUREMENT /begin SUB_FUNCTION /end SUB_FUNCTION /end FUNCTION
/begin FUNCTION INDEX_DDG "" /begin DEF_CHARACTERISTIC /end DEF_CHARACTERISTIC /begin REF_CHARACTERISTIC /end REF_CHARACTERISTIC /begin IN_MEASUREMENT /end IN_MEASUREMENT /begin OUT_MEASUREMENT /end OUT_MEASUREMENT /begin LOC_MEASUREMENT /end LOC_MEASUREMENT /begin SUB_FUNCTION /end SUB_FUNCTION /end FUNCTION
/begin FUNCTION INDEX_DDVE "" /begin DEF_CHARACTERISTIC /end DEF_CHARACTERISTIC /begin REF_CHARACTERISTIC /end REF_CHARACTERISTIC /begin IN_MEASUREMENT /end IN_MEASUREMENT /begin OUT_MEASUREMENT /end OUT_MEASUREMENT /begin LOC_MEASUREMENT /end LOC_MEASUREMENT /begin SUB_FUNCTION /end SUB_FUNCTION /end FUNCTION
/begin FUNCTION INDEX_DEKON "" /begin DEF_CHARACTERISTIC /end DEF_CHARACTERISTIC /begin REF_CHARACTERISTIC /end REF_CHARACTERISTIC /begin IN_MEASUREMENT /end IN_MEASUREMENT /begin OUT_MEASUREMENT /end OUT_MEASUREMENT /begin LOC_MEASUREMENT /end LOC_MEASUREMENT /begin SUB_FUNCTION /end SUB_FUNCTION /end FUNCTION
/begin FUNCTION INDEX_DENWS "" /begin DEF_CHARACTERISTIC /end DEF_CHARACTERISTIC /begin REF_CHARACTERISTIC /end REF_CHARACTERISTIC /begin IN_MEASUREMENT /end IN_MEASUREMENT /begin OUT_MEASUREMENT /end OUT_MEASUREMENT /begin LOC_MEASUREMENT /end LOC_MEASUREMENT /begin SUB_FUNCTION /end SUB_FUNCTION /end FUNCTION
/begin FUNCTION INDEX_DFPM "" /begin DEF_CHARACTERISTIC /end DEF_CHARACTERISTIC /begin REF_CHARACTERISTIC /end REF_CHARACTERISTIC /begin IN_MEASUREMENT /end IN_MEASUREMENT /begin OUT_MEASUREMENT /end OUT_MEASUREMENT /begin LOC_MEASUREMENT /end LOC_MEASUREMENT /begin SUB_FUNCTION /end SUB_FUNCTION /end FUNCTION
/begin FUNCTION INDEX_DHFM "" /begin DEF_CHARACTERISTIC /end DEF_CHARACTERISTIC /begin REF_CHARACTERISTIC /end REF_CHARACTERISTIC /begin IN_MEASUREMENT /end IN_MEASUREMENT /begin OUT_MEASUREMENT /end OUT_MEASUREMENT /begin LOC_MEASUREMENT /end LOC_MEASUREMENT /begin SUB_FUNCTION /end SUB_FUNCTION /end FUNCTION
/begin FUNCTION INDEX_DHLSHK "" /begin DEF_CHARACTERISTIC /end DEF_CHARACTERISTIC /begin REF_CHARACTERISTIC /end REF_CHARACTERISTIC /begin IN_MEASUREMENT /end IN_MEASUREMENT /begin OUT_MEASUREMENT /end OUT_MEASUREMENT /begin LOC_MEASUREMENT /end LOC_MEASUREMENT /begin SUB_FUNCTION /end SUB_FUNCTION /end FUNCTION
/begin FUNCTION INDEX_DHLSU "" /begin DEF_CHARACTERISTIC /end DEF_CHARACTERISTIC /begin REF_CHARACTERISTIC /end REF_CHARACTERISTIC /begin IN_MEASUREMENT /end IN_MEASUREMENT /begin OUT_MEASUREMENT /end OUT_MEASUREMENT /begin LOC_MEASUREMENT /end LOC_MEASUREMENT /begin SUB_FUNCTION /end SUB_FUNCTION /end FUNCTION
/begin FUNCTION INDEX_DKAT "" /begin DEF_CHARACTERISTIC /end DEF_CHARACTERISTIC /begin REF_CHARACTERISTIC /end REF_CHARACTERISTIC /begin IN_MEASUREMENT /end IN_MEASUREMENT /begin OUT_MEASUREMENT /end OUT_MEASUREMENT /begin LOC_MEASUREMENT /end LOC_MEASUREMENT /begin SUB_FUNCTION /end SUB_FUNCTION /end FUNCTION
/begin FUNCTION INDEX_DKRA "" /begin DEF_CHARACTERISTIC /end DEF_CHARACTERISTIC /begin REF_CHARACTERISTIC /end REF_CHARACTERISTIC /begin IN_MEASUREMENT /end IN_MEASUREMENT /begin OUT_MEASUREMENT /end OUT_MEASUREMENT /begin LOC_MEASUREMENT /end LOC_MEASUREMENT /begin SUB_FUNCTION /end SUB_FUNCTION /end FUNCTION
/begin FUNCTION INDEX_DKRNT "" /begin DEF_CHARACTERISTIC /end DEF_CHARACTERISTIC /begin REF_CHARACTERISTIC /end REF_CHARACTERISTIC /begin IN_MEASUREMENT /end IN_MEASUREMENT /begin OUT_MEASUREMENT /end OUT_MEASUREMENT /begin LOC_MEASUREMENT /end LOC_MEASUREMENT /begin SUB_FUNCTION /end SUB_FUNCTION /end FUNCTION
/begin FUNCTION INDEX_DKRS "" /begin DEF_CHARACTERISTIC /end DEF_CHARACTERISTIC /begin REF_CHARACTERISTIC /end REF_CHARACTERISTIC /begin IN_MEASUREMENT /end IN_MEASUREMENT /begin OUT_MEASUREMENT /end OUT_MEASUREMENT /begin LOC_MEASUREMENT /end LOC_MEASUREMENT /begin SUB_FUNCTION /end SUB_FUNCTION /end FUNCTION
/begin FUNCTION INDEX_DKRTP "" /begin DEF_CHARACTERISTIC /end DEF_CHARACTERISTIC /begin REF_CHARACTERISTIC /end REF_CHARACTERISTIC /begin IN_MEASUREMENT /end IN_MEASUREMENT /begin OUT_MEASUREMENT /end OUT_MEASUREMENT /begin LOC_MEASUREMENT /end LOC_MEASUREMENT /begin SUB_FUNCTION /end SUB_FUNCTION /end FUNCTION
/begin FUNCTION INDEX_DKUPPL "" /begin DEF_CHARACTERISTIC /end DEF_CHARACTERISTIC /begin REF_CHARACTERISTIC /end REF_CHARACTERISTIC /begin IN_MEASUREMENT /end IN_MEASUREMENT /begin OUT_MEASUREMENT /end OUT_MEASUREMENT /begin LOC_MEASUREMENT /end LOC_MEASUREMENT /begin SUB_FUNCTION /end SUB_FUNCTION /end FUNCTION
/begin FUNCTION INDEX_DKVS "" /begin DEF_CHARACTERISTIC /end DEF_CHARACTERISTIC /begin REF_CHARACTERISTIC /end REF_CHARACTERISTIC /begin IN_MEASUREMENT /end IN_MEASUREMENT /begin OUT_MEASUREMENT /end OUT_MEASUREMENT /begin LOC_MEASUREMENT /end LOC_MEASUREMENT /begin SUB_FUNCTION /end SUB_FUNCTION /end FUNCTION
/begin FUNCTION INDEX_DLDP "" /begin DEF_CHARACTERISTIC /end DEF_CHARACTERISTIC /begin REF_CHARACTERISTIC /end REF_CHARACTERISTIC /begin IN_MEASUREMENT /end IN_MEASUREMENT /begin OUT_MEASUREMENT /end OUT_MEASUREMENT /begin LOC_MEASUREMENT /end LOC_MEASUREMENT /begin SUB_FUNCTION /end SUB_FUNCTION /end FUNCTION
/begin FUNCTION INDEX_DLDR "" /begin DEF_CHARACTERISTIC /end DEF_CHARACTERISTIC /begin REF_CHARACTERISTIC /end REF_CHARACTERISTIC /begin IN_MEASUREMENT /end IN_MEASUREMENT /begin OUT_MEASUREMENT /end OUT_MEASUREMENT /begin LOC_MEASUREMENT /end LOC_MEASUREMENT /begin SUB_FUNCTION /end SUB_FUNCTION /end FUNCTION
/begin FUNCTION INDEX_DLDUV "" /begin DEF_CHARACTERISTIC /end DEF_CHARACTERISTIC /begin REF_CHARACTERISTIC /end REF_CHARACTERISTIC /begin IN_MEASUREMENT /end IN_MEASUREMENT /begin OUT_MEASUREMENT /end OUT_MEASUREMENT /begin LOC_MEASUREMENT /end LOC_MEASUREMENT /begin SUB_FUNCTION /end SUB_FUNCTION /end FUNCTION
/begin FUNCTION INDEX_DLLR "" /begin DEF_CHARACTERISTIC /end DEF_CHARACTERISTIC /begin REF_CHARACTERISTIC /end REF_CHARACTERISTIC /begin IN_MEASUREMENT /end IN_MEASUREMENT /begin OUT_MEASUREMENT /end OUT_MEASUREMENT /begin LOC_MEASUREMENT /end LOC_MEASUREMENT /begin SUB_FUNCTION /end SUB_FUNCTION /end FUNCTION
/begin FUNCTION INDEX_DLSAHK "" /begin DEF_CHARACTERISTIC /end DEF_CHARACTERISTIC /begin REF_CHARACTERISTIC /end REF_CHARACTERISTIC /begin IN_MEASUREMENT /end IN_MEASUREMENT /begin OUT_MEASUREMENT /end OUT_MEASUREMENT /begin LOC_MEASUREMENT /end LOC_MEASUREMENT /begin SUB_FUNCTION /end SUB_FUNCTION /end FUNCTION
/begin FUNCTION INDEX_DLSH "" /begin DEF_CHARACTERISTIC /end DEF_CHARACTERISTIC /begin REF_CHARACTERISTIC /end REF_CHARACTERISTIC /begin IN_MEASUREMENT /end IN_MEASUREMENT /begin OUT_MEASUREMENT /end OUT_MEASUREMENT /begin LOC_MEASUREMENT /end LOC_MEASUREMENT /begin SUB_FUNCTION /end SUB_FUNCTION /end FUNCTION
/begin FUNCTION INDEX_DLSU "" /begin DEF_CHARACTERISTIC /end DEF_CHARACTERISTIC /begin REF_CHARACTERISTIC /end REF_CHARACTERISTIC /begin IN_MEASUREMENT /end IN_MEASUREMENT /begin OUT_MEASUREMENT /end OUT_MEASUREMENT /begin LOC_MEASUREMENT /end LOC_MEASUREMENT /begin SUB_FUNCTION /end SUB_FUNCTION /end FUNCTION
/begin FUNCTION INDEX_DMDMIL "" /begin DEF_CHARACTERISTIC /end DEF_CHARACTERISTIC /begin REF_CHARACTERISTIC /end REF_CHARACTERISTIC /begin IN_MEASUREMENT /end IN_MEASUREMENT /begin OUT_MEASUREMENT /end OUT_MEASUREMENT /begin LOC_MEASUREMENT /end LOC_MEASUREMENT /begin SUB_FUNCTION /end SUB_FUNCTION /end FUNCTION
/begin FUNCTION INDEX_DMFB "" /begin DEF_CHARACTERISTIC /end DEF_CHARACTERISTIC /begin REF_CHARACTERISTIC /end REF_CHARACTERISTIC /begin IN_MEASUREMENT /end IN_MEASUREMENT /begin OUT_MEASUREMENT /end OUT_MEASUREMENT /begin LOC_MEASUREMENT /end LOC_MEASUREMENT /begin SUB_FUNCTION /end SUB_FUNCTION /end FUNCTION
/begin FUNCTION INDEX_DNMAX "" /begin DEF_CHARACTERISTIC /end DEF_CHARACTERISTIC /begin REF_CHARACTERISTIC /end REF_CHARACTERISTIC /begin IN_MEASUREMENT /end IN_MEASUREMENT /begin OUT_MEASUREMENT /end OUT_MEASUREMENT /begin LOC_MEASUREMENT /end LOC_MEASUREMENT /begin SUB_FUNCTION /end SUB_FUNCTION /end FUNCTION
/begin FUNCTION INDEX_DNWKW "" /begin DEF_CHARACTERISTIC /end DEF_CHARACTERISTIC /begin REF_CHARACTERISTIC /end REF_CHARACTERISTIC /begin IN_MEASUREMENT /end IN_MEASUREMENT /begin OUT_MEASUREMENT /end OUT_MEASUREMENT /begin LOC_MEASUREMENT /end LOC_MEASUREMENT /begin SUB_FUNCTION /end SUB_FUNCTION /end FUNCTION
/begin FUNCTION INDEX_DPH "" /begin DEF_CHARACTERISTIC /end DEF_CHARACTERISTIC /begin REF_CHARACTERISTIC /end REF_CHARACTERISTIC /begin IN_MEASUREMENT /end IN_MEASUREMENT /begin OUT_MEASUREMENT /end OUT_MEASUREMENT /begin LOC_MEASUREMENT /end LOC_MEASUREMENT /begin SUB_FUNCTION /end SUB_FUNCTION /end FUNCTION
/begin FUNCTION INDEX_DPL "" /begin DEF_CHARACTERISTIC /end DEF_CHARACTERISTIC /begin REF_CHARACTERISTIC /end REF_CHARACTERISTIC /begin IN_MEASUREMENT /end IN_MEASUREMENT /begin OUT_MEASUREMENT /end OUT_MEASUREMENT /begin LOC_MEASUREMENT /end LOC_MEASUREMENT /begin SUB_FUNCTION /end SUB_FUNCTION /end FUNCTION
/begin FUNCTION INDEX_DSBKV "" /begin DEF_CHARACTERISTIC /end DEF_CHARACTERISTIC /begin REF_CHARACTERISTIC /end REF_CHARACTERISTIC /begin IN_MEASUREMENT /end IN_MEASUREMENT /begin OUT_MEASUREMENT /end OUT_MEASUREMENT /begin LOC_MEASUREMENT /end LOC_MEASUREMENT /begin SUB_FUNCTION /end SUB_FUNCTION /end FUNCTION
/begin FUNCTION INDEX_DSGEEP "" /begin DEF_CHARACTERISTIC /end DEF_CHARACTERISTIC /begin REF_CHARACTERISTIC /end REF_CHARACTERISTIC /begin IN_MEASUREMENT /end IN_MEASUREMENT /begin OUT_MEASUREMENT /end OUT_MEASUREMENT /begin LOC_MEASUREMENT /end LOC_MEASUREMENT /begin SUB_FUNCTION /end SUB_FUNCTION /end FUNCTION
/begin FUNCTION INDEX_DSLSLRS "" /begin DEF_CHARACTERISTIC /end DEF_CHARACTERISTIC /begin REF_CHARACTERISTIC /end REF_CHARACTERISTIC /begin IN_MEASUREMENT /end IN_MEASUREMENT /begin OUT_MEASUREMENT /end OUT_MEASUREMENT /begin LOC_MEASUREMENT /end LOC_MEASUREMENT /begin SUB_FUNCTION /end SUB_FUNCTION /end FUNCTION
/begin FUNCTION INDEX_DTANKL "" /begin DEF_CHARACTERISTIC /end DEF_CHARACTERISTIC /begin REF_CHARACTERISTIC /end REF_CHARACTERISTIC /begin IN_MEASUREMENT /end IN_MEASUREMENT /begin OUT_MEASUREMENT /end OUT_MEASUREMENT /begin LOC_MEASUREMENT /end LOC_MEASUREMENT /begin SUB_FUNCTION /end SUB_FUNCTION /end FUNCTION
/begin FUNCTION INDEX_DTEV "" /begin DEF_CHARACTERISTIC /end DEF_CHARACTERISTIC /begin REF_CHARACTERISTIC /end REF_CHARACTERISTIC /begin IN_MEASUREMENT /end IN_MEASUREMENT /begin OUT_MEASUREMENT /end OUT_MEASUREMENT /begin LOC_MEASUREMENT /end LOC_MEASUREMENT /begin SUB_FUNCTION /end SUB_FUNCTION /end FUNCTION
/begin FUNCTION INDEX_DTHM "" /begin DEF_CHARACTERISTIC /end DEF_CHARACTERISTIC /begin REF_CHARACTERISTIC /end REF_CHARACTERISTIC /begin IN_MEASUREMENT /end IN_MEASUREMENT /begin OUT_MEASUREMENT /end OUT_MEASUREMENT /begin LOC_MEASUREMENT /end LOC_MEASUREMENT /begin SUB_FUNCTION /end SUB_FUNCTION /end FUNCTION
/begin FUNCTION INDEX_DUF "" /begin DEF_CHARACTERISTIC /end DEF_CHARACTERISTIC /begin REF_CHARACTERISTIC /end REF_CHARACTERISTIC /begin IN_MEASUREMENT /end IN_MEASUREMENT /begin OUT_MEASUREMENT /end OUT_MEASUREMENT /begin LOC_MEASUREMENT /end LOC_MEASUREMENT /begin SUB_FUNCTION /end SUB_FUNCTION /end FUNCTION
/begin FUNCTION INDEX_DUMMY_D "" /begin DEF_CHARACTERISTIC /end DEF_CHARACTERISTIC /begin REF_CHARACTERISTIC /end REF_CHARACTERISTIC /begin IN_MEASUREMENT /end IN_MEASUREMENT /begin OUT_MEASUREMENT /end OUT_MEASUREMENT /begin LOC_MEASUREMENT /end LOC_MEASUREMENT /begin SUB_FUNCTION /end SUB_FUNCTION /end FUNCTION
/begin FUNCTION INDEX_DUR "" /begin DEF_CHARACTERISTIC /end DEF_CHARACTERISTIC /begin REF_CHARACTERISTIC /end REF_CHARACTERISTIC /begin IN_MEASUREMENT /end IN_MEASUREMENT /begin OUT_MEASUREMENT /end OUT_MEASUREMENT /begin LOC_MEASUREMENT /end LOC_MEASUREMENT /begin SUB_FUNCTION /end SUB_FUNCTION /end FUNCTION
/begin FUNCTION INDEX_DVFZ "" /begin DEF_CHARACTERISTIC /end DEF_CHARACTERISTIC /begin REF_CHARACTERISTIC /end REF_CHARACTERISTIC /begin IN_MEASUREMENT /end IN_MEASUREMENT /begin OUT_MEASUREMENT /end OUT_MEASUREMENT /begin LOC_MEASUREMENT /end LOC_MEASUREMENT /begin SUB_FUNCTION /end SUB_FUNCTION /end FUNCTION
/begin FUNCTION INDEX_EGFE "" /begin DEF_CHARACTERISTIC /end DEF_CHARACTERISTIC /begin REF_CHARACTERISTIC /end REF_CHARACTERISTIC /begin IN_MEASUREMENT /end IN_MEASUREMENT /begin OUT_MEASUREMENT /end OUT_MEASUREMENT /begin LOC_MEASUREMENT /end LOC_MEASUREMENT /begin SUB_FUNCTION /end SUB_FUNCTION /end FUNCTION
/begin FUNCTION INDEX_GECOD "" /begin DEF_CHARACTERISTIC /end DEF_CHARACTERISTIC /begin REF_CHARACTERISTIC /end REF_CHARACTERISTIC /begin IN_MEASUREMENT /end IN_MEASUREMENT /begin OUT_MEASUREMENT /end OUT_MEASUREMENT /begin LOC_MEASUREMENT /end LOC_MEASUREMENT /begin SUB_FUNCTION /end SUB_FUNCTION /end FUNCTION
/begin FUNCTION INDEX_GGCS "" /begin DEF_CHARACTERISTIC /end DEF_CHARACTERISTIC /begin REF_CHARACTERISTIC /end REF_CHARACTERISTIC /begin IN_MEASUREMENT /end IN_MEASUREMENT /begin OUT_MEASUREMENT /end OUT_MEASUREMENT /begin LOC_MEASUREMENT /end LOC_MEASUREMENT /begin SUB_FUNCTION /end SUB_FUNCTION /end FUNCTION
/begin FUNCTION INDEX_GGDSAS "" /begin DEF_CHARACTERISTIC /end DEF_CHARACTERISTIC /begin REF_CHARACTERISTIC /end REF_CHARACTERISTIC /begin IN_MEASUREMENT /end IN_MEASUREMENT /begin OUT_MEASUREMENT /end OUT_MEASUREMENT /begin LOC_MEASUREMENT /end LOC_MEASUREMENT /begin SUB_FUNCTION /end SUB_FUNCTION /end FUNCTION
/begin FUNCTION INDEX_GGEGAS "" /begin DEF_CHARACTERISTIC /end DEF_CHARACTERISTIC /begin REF_CHARACTERISTIC /end REF_CHARACTERISTIC /begin IN_MEASUREMENT /end IN_MEASUREMENT /begin OUT_MEASUREMENT /end OUT_MEASUREMENT /begin LOC_MEASUREMENT /end LOC_MEASUREMENT /begin SUB_FUNCTION /end SUB_FUNCTION /end FUNCTION
/begin FUNCTION INDEX_GGFGRH "" /begin DEF_CHARACTERISTIC /end DEF_CHARACTERISTIC /begin REF_CHARACTERISTIC /end REF_CHARACTERISTIC /begin IN_MEASUREMENT /end IN_MEASUREMENT /begin OUT_MEASUREMENT /end OUT_MEASUREMENT /begin LOC_MEASUREMENT /end LOC_MEASUREMENT /begin SUB_FUNCTION /end SUB_FUNCTION /end FUNCTION
/begin FUNCTION INDEX_GGGTS "" /begin DEF_CHARACTERISTIC /end DEF_CHARACTERISTIC /begin REF_CHARACTERISTIC /end REF_CHARACTERISTIC /begin IN_MEASUREMENT /end IN_MEASUREMENT /begin OUT_MEASUREMENT /end OUT_MEASUREMENT /begin LOC_MEASUREMENT /end LOC_MEASUREMENT /begin SUB_FUNCTION /end SUB_FUNCTION /end FUNCTION
/begin FUNCTION INDEX_GGPED "" /begin DEF_CHARACTERISTIC /end DEF_CHARACTERISTIC /begin REF_CHARACTERISTIC /end REF_CHARACTERISTIC /begin IN_MEASUREMENT /end IN_MEASUREMENT /begin OUT_MEASUREMENT /end OUT_MEASUREMENT /begin LOC_MEASUREMENT /end LOC_MEASUREMENT /begin SUB_FUNCTION /end SUB_FUNCTION /end FUNCTION
/begin FUNCTION INDEX_GGTFA "" /begin DEF_CHARACTERISTIC /end DEF_CHARACTERISTIC /begin REF_CHARACTERISTIC /end REF_CHARACTERISTIC /begin IN_MEASUREMENT /end IN_MEASUREMENT /begin OUT_MEASUREMENT /end OUT_MEASUREMENT /begin LOC_MEASUREMENT /end LOC_MEASUREMENT /begin SUB_FUNCTION /end SUB_FUNCTION /end FUNCTION
/begin FUNCTION INDEX_GGTFM "" /begin DEF_CHARACTERISTIC /end DEF_CHARACTERISTIC /begin REF_CHARACTERISTIC /end REF_CHARACTERISTIC /begin IN_MEASUREMENT /end IN_MEASUREMENT /begin OUT_MEASUREMENT /end OUT_MEASUREMENT /begin LOC_MEASUREMENT /end LOC_MEASUREMENT /begin SUB_FUNCTION /end SUB_FUNCTION /end FUNCTION
/begin FUNCTION INDEX_GGUB "" /begin DEF_CHARACTERISTIC /end DEF_CHARACTERISTIC /begin REF_CHARACTERISTIC /end REF_CHARACTERISTIC /begin IN_MEASUREMENT /end IN_MEASUREMENT /begin OUT_MEASUREMENT /end OUT_MEASUREMENT /begin LOC_MEASUREMENT /end LOC_MEASUREMENT /begin SUB_FUNCTION /end SUB_FUNCTION /end FUNCTION
/begin FUNCTION INDEX_GGUBR "" /begin DEF_CHARACTERISTIC /end DEF_CHARACTERISTIC /begin REF_CHARACTERISTIC /end REF_CHARACTERISTIC /begin IN_MEASUREMENT /end IN_MEASUREMENT /begin OUT_MEASUREMENT /end OUT_MEASUREMENT /begin LOC_MEASUREMENT /end LOC_MEASUREMENT /begin SUB_FUNCTION /end SUB_FUNCTION /end FUNCTION
/begin FUNCTION INDEX_HRE "" /begin DEF_CHARACTERISTIC /end DEF_CHARACTERISTIC /begin REF_CHARACTERISTIC /end REF_CHARACTERISTIC /begin IN_MEASUREMENT /end IN_MEASUREMENT /begin OUT_MEASUREMENT /end OUT_MEASUREMENT /begin LOC_MEASUREMENT /end LOC_MEASUREMENT /begin SUB_FUNCTION /end SUB_FUNCTION /end FUNCTION
/begin FUNCTION INDEX_IMS "" /begin DEF_CHARACTERISTIC /end DEF_CHARACTERISTIC /begin REF_CHARACTERISTIC /end REF_CHARACTERISTIC /begin IN_MEASUREMENT /end IN_MEASUREMENT /begin OUT_MEASUREMENT /end OUT_MEASUREMENT /begin LOC_MEASUREMENT /end LOC_MEASUREMENT /begin SUB_FUNCTION /end SUB_FUNCTION /end FUNCTION
/begin FUNCTION INDEX_LDPE "" /begin DEF_CHARACTERISTIC /end DEF_CHARACTERISTIC /begin REF_CHARACTERISTIC /end REF_CHARACTERISTIC /begin IN_MEASUREMENT /end IN_MEASUREMENT /begin OUT_MEASUREMENT /end OUT_MEASUREMENT /begin LOC_MEASUREMENT /end LOC_MEASUREMENT /begin SUB_FUNCTION /end SUB_FUNCTION /end FUNCTION
/begin FUNCTION INDEX_MDKOG "" /begin DEF_CHARACTERISTIC /end DEF_CHARACTERISTIC /begin REF_CHARACTERISTIC /end REF_CHARACTERISTIC /begin IN_MEASUREMENT /end IN_MEASUREMENT /begin OUT_MEASUREMENT /end OUT_MEASUREMENT /begin LOC_MEASUREMENT /end LOC_MEASUREMENT /begin SUB_FUNCTION /end SUB_FUNCTION /end FUNCTION
/begin FUNCTION INDEX_TUNING "" /begin DEF_CHARACTERISTIC /end DEF_CHARACTERISTIC /begin REF_CHARACTERISTIC /end REF_CHARACTERISTIC /begin IN_MEASUREMENT /end IN_MEASUREMENT /begin OUT_MEASUREMENT /end OUT_MEASUREMENT /begin LOC_MEASUREMENT /end LOC_MEASUREMENT /begin SUB_FUNCTION /end SUB_FUNCTION /end FUNCTION
/begin FUNCTION K71EXT "" /begin DEF_CHARACTERISTIC /end DEF_CHARACTERISTIC /begin REF_CHARACTERISTIC /end REF_CHARACTERISTIC /begin IN_MEASUREMENT fcmEnd /end IN_MEASUREMENT /begin OUT_MEASUREMENT /end OUT_MEASUREMENT /begin LOC_MEASUREMENT /end LOC_MEASUREMENT /begin SUB_FUNCTION /end SUB_FUNCTION /end FUNCTION
/begin FUNCTION K71MN "" /begin DEF_CHARACTERISTIC TIDLEMAX TIDLEMIN /end DEF_CHARACTERISTIC /begin REF_CHARACTERISTIC /end REF_CHARACTERISTIC /begin IN_MEASUREMENT B_fa B_fgrte B_grdst B_kstebf B_lrndia B_stend nmot_w /end IN_MEASUREMENT
 /begin OUT_MEASUREMENT B_0101_ack B_0101_ident B_0101_notadr B_0101_switch kwp71_bits /end OUT_MEASUREMENT
 /begin LOC_MEASUREMENT t_idle_ctr /end LOC_MEASUREMENT
 /begin SUB_FUNCTION /end SUB_FUNCTION
/end FUNCTION
/begin FUNCTION K71SR "" /begin DEF_CHARACTERISTIC /end DEF_CHARACTERISTIC
 /begin REF_CHARACTERISTIC ADRONLOGIN GRAOFLOGIN GRAONLOGIN HLOFFLOGIN HLONLOGIN KLOGIN LUEN1LOGIN LUEN2LOGIN LUEN3LOGIN SGIDB1 SGIDB2 SGIDB3 SLOGIN VARDEF /end REF_CHARACTERISTIC
 /begin IN_MEASUREMENT B_0101_ack B_0101_ident B_0101_switch B_acc B_accen B_fgrte B_hlon B_luef1 B_luef2 B_luef3 kwp71_bits nmot_w /end IN_MEASUREMENT
 /begin OUT_MEASUREMENT /end OUT_MEASUREMENT
 /begin LOC_MEASUREMENT /end LOC_MEASUREMENT
 /begin SUB_FUNCTION /end SUB_FUNCTION
/end FUNCTION
/begin FUNCTION KDIAG "" /begin DEF_CHARACTERISTIC SGIDB4 SGIDB5 SGIDB6 SGIDB7 SGIDK1_DAT /end DEF_CHARACTERISTIC
 /begin REF_CHARACTERISTIC ADRONLOGIN GRAOFLOGIN GRAONLOGIN KLOGIN SGIDB1 SGIDB2 SGIDB3 SLOGIN VARDEF /end REF_CHARACTERISTIC
 /begin IN_MEASUREMENT B_acc B_accen B_fgrte B_pwf nmot_w /end IN_MEASUREMENT
 /begin OUT_MEASUREMENT /end OUT_MEASUREMENT
 /begin LOC_MEASUREMENT /end LOC_MEASUREMENT
 /begin SUB_FUNCTION /end SUB_FUNCTION
/end FUNCTION
/begin FUNCTION keycheck "" /begin DEF_CHARACTERISTIC /end DEF_CHARACTERISTIC /begin REF_CHARACTERISTIC /end REF_CHARACTERISTIC /begin IN_MEASUREMENT /end IN_MEASUREMENT /begin OUT_MEASUREMENT /end OUT_MEASUREMENT /begin LOC_MEASUREMENT /end LOC_MEASUREMENT /begin SUB_FUNCTION /end SUB_FUNCTION /end FUNCTION
/begin FUNCTION KHMD "1.100     Berechnung Reservemoment für Katheizen"
 /begin DEF_CHARACTERISTIC CWKHMD FMDKHFH FMDKHTMST FMDPUBKV KFKWTMP KFMDDSLAD KFMDDSLFA KFMDKH_0_A KFMDKH_1_A KFMDKHLL_0_A KFMDKHLL_1_A ZKBKVAB ZKMDKH /end DEF_CHARACTERISTIC
 /begin REF_CHARACTERISTIC /end REF_CHARACTERISTIC
 /begin IN_MEASUREMENT B_bkvleer B_dsl4 B_fasla B_kh B_kw B_ll dmllri_w fho_w fmdkh mifa_w nmot_w pubkv_w tmst /end IN_MEASUREMENT
 /begin OUT_MEASUREMENT dmrdsls_w dmrkh dmrkh_w /end OUT_MEASUREMENT
 /begin LOC_MEASUREMENT dmrkhz_w drkwtmp_w fmkhfho_w fmkhtmst mifakh_w mulres_w /end LOC_MEASUREMENT
 /begin SUB_FUNCTION /end SUB_FUNCTION
/end FUNCTION
/begin FUNCTION KOS "113.160   Klimakompressor - Steuerung"
 /begin DEF_CHARACTERISTIC CDWGANG CDWGANGB CDWKOB CWKOC CWKOCAN DWPEDKOB FHOKOB KFTNSTKO MDKOAB MDKOAN MDKOEN SNM08KOUB TANSKOB TKOAMAD TKOAMNN TKOAMXN TKOBEMNN TKODPAMNN TKODPAMXN TKOEMNN TKOMBKOA TKOMBKOE TKOTMSK TKOVKO TKOWPAMNN TKOWPAMXN TMKOAO TMKOAU TMSTMAD TNSTKO TVKOE1 TVKOEOF TVKOEP TVKOEV TVKOGANDEL TVKOSSIM VKO VKOAO VKOB VNVKO VNVKOB WPEDKO /end DEF_CHARACTERISTIC
 /begin REF_CHARACTERISTIC /end REF_CHARACTERISTIC
 /begin IN_MEASUREMENT B_autget B_bkvkomab B_dknolu B_dkpu B_gekoa B_grdst B_gsch B_gwhs B_kh B_kooffc B_kuppl B_ll B_madfk B_madfs B_madko B_madll B_sa B_sacc B_skoc B_st B_stend dwped fho fho_w gangi mdko mifal_w nmot pkodrc S_ac S_ko tans tmki tmot tmst vfzg wped /end IN_MEASUREMENT
 /begin OUT_MEASUREMENT B_acres B_ko B_kobaus B_kobmnon B_koe B_kov B_nac /end OUT_MEASUREMENT
 /begin LOC_MEASUREMENT B_koa B_kobped B_kobpedt B_kobwped B_kobwpedt B_koena B_koenat B_kogandel B_koganped B_koint B_komnoff B_komnon B_komxoff B_kooff B_koofft B_kotmsk B_kotmsko B_kovdown B_kow B_tvkoe1w esst_snm08koub S_acw /end LOC_MEASUREMENT
 /begin SUB_FUNCTION /end SUB_FUNCTION
/end FUNCTION
/begin FUNCTION KRACT "" /begin DEF_CHARACTERISTIC /end DEF_CHARACTERISTIC
 /begin REF_CHARACTERISTIC AGR_AOG AGR_AUG CNSDEF CNS_AOG CNS_AUG CWTAF CWTAK CWTAS DZW_AOG DZW_AUG FBA_AOG FBA_AUG FLR_AOG FLR_AUG FNS_AOG FNS_AUG FRK_AOG FRK_AUG FST_AOG FST_AUG FVA_AOG FVA_AUG FWL_AOG FWL_AUG MDR_AOG MDR_AUG MWNTKB5 NLS_AOG NLS_AUG RLX_AOG RLX_AUG VVR_AOG VVR_AUG /end REF_CHARACTERISTIC
 /begin IN_MEASUREMENT B_fa B_grdst B_stend nmot_w vstagr vstcns vstdzw vstfba vstfns vstfrk vstfst vstfva vstfwl vstlr vstmdr vstnls vstrlx vstvvr /end IN_MEASUREMENT
 /begin OUT_MEASUREMENT /end OUT_MEASUREMENT
 /begin LOC_MEASUREMENT /end LOC_MEASUREMENT
 /begin SUB_FUNCTION /end SUB_FUNCTION
/end FUNCTION
/begin FUNCTION KRDY "17.120    Klopfregelung Dynamik"
 /begin DEF_CHARACTERISTIC AZKELDYN AZKRLDYN AZKRNDYN CWKR CWTIPIN DRLKRAN DYADMXN DYADS DYAFVS DYAMNV DYAVF DZWTIN FKELDYA KFDYES KFDYMNT KFDYRS KFDYRSOF NGKRAWN NGKRWN NKRUM PZWKRA TMDYNA ZDRLKRA ZNGKRA /end DEF_CHARACTERISTIC
 /begin REF_CHARACTERISTIC SNM16KRDYUB SNM16KRUB SRL06KRUB /end REF_CHARACTERISTIC
 /begin IN_MEASUREMENT B_kl B_kr B_krdws B_kuppl B_ll B_pwf B_tmkr B_vnull B_zwkraa drlp_w drl_w esst_snm16krdyub esst_snm16krub esst_srl06krub evtmod gangi kek krfkw ngas_w nmot rl rlp_w rl_w stkrnx tmot virkr zzylkr /end IN_MEASUREMENT
 /begin OUT_MEASUREMENT B_krldy B_krldya B_krldyf B_krldyn B_krldyv B_krndy B_krndyn B_tipin drlkrdy ngkrv_w stuetz wkrdy zaldy zldy zldyke zndy zzwdykr zzwdymd /end OUT_MEASUREMENT
 /begin LOC_MEASUREMENT B_drlkrdy B_kldynrm B_kldystk drlkrav drlkrra dyesv dymntv dyrsofv dyrsv lkrnew lkrold ngkraf_w ngkrav_w wkrdya /end LOC_MEASUREMENT
 /begin SUB_FUNCTION /end SUB_FUNCTION
/end FUNCTION
/begin COMPU_METHOD bfzg_sb_q0p217 "" RAT_FUNC "%6.3" "m/s^2" COEFFS 0 1 0 0 0 0.217 /end COMPU_METHOD
/begin COMPU_METHOD bfzg_sw_q4p239Em4 "" RAT_FUNC "%10.7" "m/s^2" COEFFS 0 1 0 0 0 0.0004239 /end COMPU_METHOD
/begin COMPU_METHOD B_TRUE "boolsche Zustände, positive Logik" TAB_VERB "%6.3" "" COMPU_TAB_REF B_TRUE /end COMPU_METHOD
/begin COMPU_VTAB B_TRUE "boolsche Zustände, positive Logik" TAB_VERB 2 0 "----" 1 "TRUE" /end COMPU_VTAB
/begin COMPU_METHOD dez "1 : 1 Umrechnug (dez/hex)" RAT_FUNC "%6.2" "" COEFFS 0 1 0 0 0 1 /end COMPU_METHOD
/begin COMPU_METHOD dist_uw_q0p1 "" RAT_FUNC "%6.3" "-" COEFFS 0 10 0 0 0 1 /end COMPU_METHOD
/begin COMPU_METHOD fak_q0p0625 "" RAT_FUNC "%6.4" "-" COEFFS 0 16 0 0 0 1 /end COMPU_METHOD
/begin COMPU_METHOD fak_sw_b8 "" RAT_FUNC "%6.5" "-" COEFFS 0 65536 0 0 0 16 /end COMPU_METHOD
/begin COMPU_METHOD fak_ub_b1 "" RAT_FUNC "%6.4" "-" COEFFS 0 256 0 0 0 1 /end COMPU_METHOD
/begin COMPU_METHOD fak_ub_b16 "" RAT_FUNC "%6.4" "-" COEFFS 0 256 0 0 0 16 /end COMPU_METHOD
/begin COMPU_METHOD fak_ub_b1p25_o0p75 "" RAT_FUNC "%6.3" "-" COEFFS 0 1 -0.75 0 0 0.00195313 /end COMPU_METHOD
/begin COMPU_METHOD fak_ub_b2 "" RAT_FUNC "%6.4" "-" COEFFS 0 256 0 0 0 2 /end COMPU_METHOD
/begin COMPU_METHOD fak_ub_b4 "" RAT_FUNC "%6.4" "-" COEFFS 0 256 0 0 0 4 /end COMPU_METHOD
/begin COMPU_METHOD fak_ub_q0p01 "" RAT_FUNC "%6.4" "-" COEFFS 0 1 0 0 0 0.01 /end COMPU_METHOD
/begin COMPU_METHOD fak_uw_b1 "" RAT_FUNC "%7.6" "-" COEFFS 0 65536 0 0 0 1 /end COMPU_METHOD
/begin COMPU_METHOD fak_uw_b1024 "" RAT_FUNC "%6.4" "-" COEFFS 0 65536 0 0 0 1024 /end COMPU_METHOD
/begin COMPU_METHOD fak_uw_b16 "" RAT_FUNC "%6.5" "-" COEFFS 0 65536 0 0 0 16 /end COMPU_METHOD
/begin COMPU_METHOD fak_uw_b2 "" RAT_FUNC "%7.6" "-" COEFFS 0 65536 0 0 0 2 /end COMPU_METHOD
/begin COMPU_METHOD fak_uw_b4 "" RAT_FUNC "%7.6" "-" COEFFS 0 65536 0 0 0 4 /end COMPU_METHOD
/begin COMPU_METHOD fak_uw_b64 "" RAT_FUNC "%6.5" "-" COEFFS 0 65536 0 0 0 64 /end COMPU_METHOD
/begin COMPU_METHOD fak_uw_b8 "" RAT_FUNC "%6.5" "-" COEFFS 0 65536 0 0 0 8 /end COMPU_METHOD
/begin COMPU_METHOD fak_uw_q0p001 "" RAT_FUNC "%6.5" "" COEFFS 0 65536 0 0 0 65.536 /end COMPU_METHOD
/begin COMPU_METHOD i_q0p0039_mA "" RAT_FUNC "%6.4" "mA" COEFFS 0 65536 0 0 0 256 /end COMPU_METHOD
/begin COMPU_METHOD kw_q0p0039 "" RAT_FUNC "%6.4" "°KW" COEFFS 0 256 0 0 0 1 /end COMPU_METHOD
/begin COMPU_METHOD kw_q0p0078 "" RAT_FUNC "%6.4" "°KW" COEFFS 0 256 0 0 0 2 /end COMPU_METHOD
/begin COMPU_METHOD kw_q0p0156 "" RAT_FUNC "%6.4" "°KW" COEFFS 0 64 0 0 0 1 /end COMPU_METHOD
/begin COMPU_METHOD kw_q0p03125 "" RAT_FUNC "%6.4" "°KW" COEFFS 0 32 0 0 0 1 /end COMPU_METHOD
/begin COMPU_METHOD kw_q1 "" RAT_FUNC "%6.2" "°KW" COEFFS 0 1 0 0 0 1 /end COMPU_METHOD
/begin COMPU_METHOD leit_q3p125Em6 "" RAT_FUNC "%6.4" "mS [mSiemens]" COEFFS 0 65536 0 0 0 204.8 /end COMPU_METHOD
/begin COMPU_METHOD m_ub_b1020 "" RAT_FUNC "%6.2" "kg/h" COEFFS 0 1 0 0 0 4 /end COMPU_METHOD
/begin COMPU_METHOD m_ub_b23p3 "" RAT_FUNC "%6.3" "kg" COEFFS 0 2812.5 0 0 0 256 /end COMPU_METHOD
/begin COMPU_METHOD m_uw_b6553p5 "" RAT_FUNC "%6.3" "kg/h" COEFFS 0 1 0 0 0 0.1 /end COMPU_METHOD
/begin COMPU_METHOD nmotg_sw_q0p39 "" RAT_FUNC "%6.3" "U/min/s" COEFFS 0 1 0 0 0 0.39063 /end COMPU_METHOD
/begin COMPU_METHOD nmot_ub_q40 "" RAT_FUNC "%6.1" "Upm" COEFFS 0 1 0 0 0 40 /end COMPU_METHOD
/begin COMPU_METHOD nmot_uw_q0p25 "" RAT_FUNC "%6.3" "U/min" COEFFS 0 1 0 0 0 0.25 /end COMPU_METHOD
/begin COMPU_METHOD pgrad_q0p039 "" RAT_FUNC "%6.4" "hPa/s" COEFFS 0 128 0 0 0 5 /end COMPU_METHOD
/begin COMPU_METHOD pgrad_q0p15625 "" RAT_FUNC "%6.3" "hPa/s" COEFFS 0 32 0 0 0 5 /end COMPU_METHOD
/begin COMPU_METHOD p_q0p2 "" RAT_FUNC "%6.3" "bar" COEFFS 0 5 0 0 0 1 /end COMPU_METHOD
/begin COMPU_METHOD p_sw_q0p039 "" RAT_FUNC "%6.4" "hPa" COEFFS 0 256 0 0 0 10 /end COMPU_METHOD
/begin COMPU_METHOD p_ub_q5 "" RAT_FUNC "%6.2" "hPa" COEFFS 0 1 0 0 0 5 /end COMPU_METHOD
/begin COMPU_METHOD p_uw_q0p039 "" RAT_FUNC "%6.4" "hPa" COEFFS 0 256 0 0 0 10 /end COMPU_METHOD
/begin COMPU_METHOD qnv_uw_b512 "" RAT_FUNC "%6.4" "(U/min)/(km/h)" COEFFS 0 65536 0 0 0 512 /end COMPU_METHOD
/begin COMPU_METHOD relPED_ub_b100 "" RAT_FUNC "%6.3" "% PED" COEFFS 0 255 0 0 0 100 /end COMPU_METHOD
/begin COMPU_METHOD relPED_uw_b100 "" RAT_FUNC "%6.4" "% PED" COEFFS 0 65535 0 0 0 100 /end COMPU_METHOD
/begin COMPU_METHOD rel_sb_q0p39 "" RAT_FUNC "%6.3" "%" COEFFS 0 1 0 0 0 0.3906 /end COMPU_METHOD
/begin COMPU_METHOD rel_sw_b50 "" RAT_FUNC "%6.4" "%" COEFFS 0 65536 0 0 0 100 /end COMPU_METHOD
/begin COMPU_METHOD rel_sw_q0p0234 "" RAT_FUNC "%6.4" "%/seg" COEFFS 0 32 0 0 0 0.75 /end COMPU_METHOD
/begin COMPU_METHOD rel_ub_b100 "" RAT_FUNC "%6.3" "%" COEFFS 0 256 0 0 0 100 /end COMPU_METHOD
/begin COMPU_METHOD rel_ub_b200 "" RAT_FUNC "%6.3" "%" COEFFS 0 256 0 0 0 200 /end COMPU_METHOD
/begin COMPU_METHOD rel_ub_b99p6 "" RAT_FUNC "%6.3" "%" COEFFS 0 256 0 0 0 100 /end COMPU_METHOD
/begin COMPU_METHOD rel_ub_q0p75 "" RAT_FUNC "%6.3" "%" COEFFS 0 1 0 0 0 0.75 /end COMPU_METHOD
/begin COMPU_METHOD rel_uw_b100 "" RAT_FUNC "%6.4" "%" COEFFS 0 65536 0 0 0 100 /end COMPU_METHOD
/begin COMPU_METHOD rel_uw_b3072 "" RAT_FUNC "%6.4" "%" COEFFS 0 65536 0 0 0 3072 /end COMPU_METHOD
/begin COMPU_METHOD rel_uw_q0p0234 "" RAT_FUNC "%6.4" "%" COEFFS 0 32 0 0 0 0.75 /end COMPU_METHOD
/begin COMPU_METHOD r_uw_q2 "" RAT_FUNC "%6.2" "Ohm" COEFFS 0 1 0 0 0 2 /end COMPU_METHOD
/begin COMPU_METHOD spg_q0p00039 "" RAT_FUNC "%6.5" "V" COEFFS 0 1 0 0 0 0.000390625 /end COMPU_METHOD
/begin COMPU_METHOD spg_q0p1 "" RAT_FUNC "%6.3" "V" COEFFS 0 1 0 0 0 0.1 /end COMPU_METHOD
/begin COMPU_METHOD spg_sw_q0p00488 "" RAT_FUNC "%6.4" "V" COEFFS 0 1024 0 0 0 5 /end COMPU_METHOD
/begin COMPU_METHOD spg_ubatt "" RAT_FUNC "%6.4" "V" COEFFS 0 1 0 0 0 0.0704 /end COMPU_METHOD
/begin COMPU_METHOD spg_ubatt_w "" RAT_FUNC "%6.4" "V" COEFFS 0 1 0 0 0 0.0176 /end COMPU_METHOD
/begin COMPU_METHOD spg_ub_b28p5 "" RAT_FUNC "%6.3" "V" COEFFS 0 1 0 0 0 0.1113 /end COMPU_METHOD
/begin COMPU_METHOD spg_ub_b5 "" RAT_FUNC "%6.4" "V" COEFFS 0 256 0 0 0 5 /end COMPU_METHOD
/begin COMPU_METHOD spg_ub_q0p0052_o0p2 "" RAT_FUNC "%6.3" "V" COEFFS 0 255 51 0 0 1.33 /end COMPU_METHOD
/begin COMPU_METHOD spg_uw_q0p00488 "" RAT_FUNC "%6.4" "V" COEFFS 0 1024 0 0 0 5 /end COMPU_METHOD
/begin COMPU_METHOD spg_uw_q0p00488_o1 "" RAT_FUNC "%6.3" "V" COEFFS 0 1024 1024 0 0 5 /end COMPU_METHOD
/begin COMPU_METHOD t100msxs_ub_b255 "" RAT_FUNC "%6.2" "s" COEFFS 0 1 0 0 0 1 /end COMPU_METHOD
/begin COMPU_METHOD t100msxs_ub_b25p5 "" RAT_FUNC "%6.3" "s" COEFFS 0 1 0 0 0 0.1 /end COMPU_METHOD
/begin COMPU_METHOD t100msxs_uw_b6553p5 "" RAT_FUNC "%6.3" "s" COEFFS 0 1 0 0 0 0.1 /end COMPU_METHOD
/begin COMPU_METHOD t10msxs_q0p01_o0p05 "" RAT_FUNC "%6.4" "s" COEFFS 0 1 0.05 0 0 0.01 /end COMPU_METHOD
/begin COMPU_METHOD t10msxs_ub_b2p55 "" RAT_FUNC "%6.4" "s" COEFFS 0 1 0 0 0 0.01 /end COMPU_METHOD
/begin COMPU_METHOD t10msxs_uw_b655p35 "" RAT_FUNC "%6.4" "s" COEFFS 0 1 0 0 0 0.01 /end COMPU_METHOD
/begin COMPU_METHOD t1msxms_q1 "" RAT_FUNC "%6.2" "ms" COEFFS 0 1 0 0 0 1 /end COMPU_METHOD
/begin COMPU_METHOD t1sxs_ub_b255 "" RAT_FUNC "%6.2" "s" COEFFS 0 1 0 0 0 1 /end COMPU_METHOD
/begin COMPU_METHOD t1sxs_uw_q1 "" RAT_FUNC "%6.2" "s" COEFFS 0 1 0 0 0 1 /end COMPU_METHOD
/begin COMPU_METHOD t200msxs_ub_b51 "" RAT_FUNC "%6.3" "s" COEFFS 0 1 0 0 0 0.2 /end COMPU_METHOD
/begin COMPU_METHOD t20msxs_ub_b5p1 "" RAT_FUNC "%6.4" "s" COEFFS 0 1 0 0 0 0.02 /end COMPU_METHOD
/begin COMPU_METHOD t20msxs_uw_b1310 "" RAT_FUNC "%6.4" "s" COEFFS 0 1 0 0 0 0.02 /end COMPU_METHOD
/begin COMPU_METHOD t20msxs_uw_q0p02 "" RAT_FUNC "%6.4" "s" COEFFS 0 1 0 0 0 0.02 /end COMPU_METHOD
/begin COMPU_METHOD t50msxs_q0p05 "" RAT_FUNC "%6.4" "s" COEFFS 0 1 0 0 0 0.05 /end COMPU_METHOD
/begin COMPU_METHOD t50msxs_ub_b12p75 "" RAT_FUNC "%6.4" "s" COEFFS 0 1 0 0 0 0.05 /end COMPU_METHOD
/begin COMPU_METHOD temp_q0p0234_o273 "" RAT_FUNC "%6.1" "Grad C" COEFFS 0 1 273.15 0 0 0.0234375 /end COMPU_METHOD
/begin COMPU_METHOD temp_sb_b0p093 "" RAT_FUNC "%6.5" "Grad C" COEFFS 0 512 0 0 0 0.375 /end COMPU_METHOD
/begin COMPU_METHOD temp_ub_b191p25 "" RAT_FUNC "%6.3" "Grad C" COEFFS 0 1 0 0 0 0.75 /end COMPU_METHOD
/begin COMPU_METHOD temp_ub_q0p75_o48 "" RAT_FUNC "%6.2" "Grad C" COEFFS 0 1 48 0 0 0.75 /end COMPU_METHOD
/begin COMPU_METHOD temp_ub_q5_o50 "" RAT_FUNC "%6.2" "Grad C" COEFFS 0 1 50 0 0 5 /end COMPU_METHOD
/begin COMPU_METHOD temp_uw_q0p0029_o48 "" RAT_FUNC "%6.2" "Grad C" COEFFS 0 256 12288 0 0 0.75 /end COMPU_METHOD
/begin COMPU_METHOD tgrad_ub_b99p6 "" RAT_FUNC "%6.3" "ms/s" COEFFS 0 1 0 0 0 0.390625 /end COMPU_METHOD
/begin COMPU_METHOD vfzg_ub_q1p25 "" RAT_FUNC "%6.2" "km/h" COEFFS 0 1 0 0 0 1.25 /end COMPU_METHOD
/begin COMPU_METHOD vfzg_uw_b512 "" RAT_FUNC "%6.4" "km/h" COEFFS 0 65536 0 0 0 512 /end COMPU_METHOD
/begin COMPU_METHOD vfzg_uw_q0p00781 "" RAT_FUNC "%6.4" "km/h" COEFFS 0 1 0 0 0 0.0078125 /end COMPU_METHOD
/begin COMPU_METHOD zk100msxs_ub_b25p5 "" RAT_FUNC "%6.3" "s" COEFFS 0 0 256 0 10 0 /end COMPU_METHOD
/begin COMPU_METHOD zk100msxs_uw_b6553 "" RAT_FUNC "%12.4" "s" COEFFS 0 0 65536 0 10 0 /end COMPU_METHOD
/begin COMPU_METHOD zk10msxs_uw_b655 "" RAT_FUNC "%12.5" "s" COEFFS 0 0 65536 0 100 0 /end COMPU_METHOD
/begin COMPU_METHOD zk20msxs_uw_b1310 "" RAT_FUNC "%12.4" "s" COEFFS 0 0 65536 0 50 0 /end COMPU_METHOD
/begin COMPU_METHOD zk50msxs_ub_b12p8 "" RAT_FUNC "%10.5" "s" COEFFS 0 0 128 0 10 0 /end COMPU_METHOD
/begin COMPU_METHOD zw_ub_q0p75 "" RAT_FUNC "%6.3" "Grad KW" COEFFS 0 255 0 0 0 191.25 /end COMPU_METHOD
/begin COMPU_METHOD zw_ub_qn0p75 "" RAT_FUNC "%6.4" "grad KW" COEFFS 0 1 0 0 0 -0.75 /end COMPU_METHOD
/begin COMPU_METHOD zw_uw_qn0p75 "" RAT_FUNC "%6.4" "grad KW" COEFFS 0 1 0 0 0 -0.75 /end COMPU_METHOD
/begin COMPU_METHOD defaultAscii "" RAT_FUNC "%6.2" "" COEFFS 0 1 0 0 0 1 /end COMPU_METHOD
/begin RECORD_LAYOUT FklWUw FNC_VALUES 1 UWORD COLUMN_DIR DIRECT /end RECORD_LAYOUT
/begin RECORD_LAYOUT GkfWSw FNC_VALUES 1 SWORD COLUMN_DIR DIRECT /end RECORD_LAYOUT
/begin RECORD_LAYOUT GklWSw FNC_VALUES 1 SWORD COLUMN_DIR DIRECT /end RECORD_LAYOUT
/begin RECORD_LAYOUT GklWUb FNC_VALUES 1 UBYTE COLUMN_DIR DIRECT /end RECORD_LAYOUT
/begin RECORD_LAYOUT GklWUw FNC_VALUES 1 UWORD COLUMN_DIR DIRECT /end RECORD_LAYOUT
/begin RECORD_LAYOUT KfAxUbAyUbSstxUbSstyUbWSb NO_AXIS_PTS_X 1 UBYTE NO_AXIS_PTS_Y 2 UBYTE AXIS_PTS_X 3 UBYTE INDEX_INCR DIRECT AXIS_PTS_Y 4 UBYTE INDEX_INCR DIRECT FNC_VALUES 5 SBYTE COLUMN_DIR DIRECT /end RECORD_LAYOUT
/begin RECORD_LAYOUT KfAxUbAyUbSstxUbSstyUbWUb NO_AXIS_PTS_X 1 UBYTE NO_AXIS_PTS_Y 2 UBYTE AXIS_PTS_X 3 UBYTE INDEX_INCR DIRECT AXIS_PTS_Y 4 UBYTE INDEX_INCR DIRECT FNC_VALUES 5 UBYTE COLUMN_DIR DIRECT /end RECORD_LAYOUT
/begin RECORD_LAYOUT KfAxUbAyUbSstxUbSstyUwWUb NO_AXIS_PTS_X 1 UBYTE NO_AXIS_PTS_Y 2 UBYTE AXIS_PTS_X 3 UBYTE INDEX_INCR DIRECT AXIS_PTS_Y 4 UWORD INDEX_INCR DIRECT FNC_VALUES 5 UBYTE COLUMN_DIR DIRECT /end RECORD_LAYOUT
/begin RECORD_LAYOUT KfAxUbAyUbSstxUbSstyUwWUw NO_AXIS_PTS_X 1 UBYTE NO_AXIS_PTS_Y 2 UBYTE AXIS_PTS_X 3 UBYTE INDEX_INCR DIRECT AXIS_PTS_Y 4 UWORD INDEX_INCR DIRECT FNC_VALUES 5 UWORD COLUMN_DIR DIRECT /end RECORD_LAYOUT
/begin RECORD_LAYOUT KfAxUbAyUbSstxUwSstyUbWUb NO_AXIS_PTS_X 1 UBYTE NO_AXIS_PTS_Y 2 UBYTE AXIS_PTS_X 3 UWORD INDEX_INCR DIRECT AXIS_PTS_Y 4 UBYTE INDEX_INCR DIRECT FNC_VALUES 5 UBYTE COLUMN_DIR DIRECT /end RECORD_LAYOUT
/begin RECORD_LAYOUT KfAxUwAyUwSstxUwSstyUwWUw NO_AXIS_PTS_X 1 UWORD NO_AXIS_PTS_Y 2 UWORD AXIS_PTS_X 3 UWORD INDEX_INCR DIRECT AXIS_PTS_Y 4 UWORD INDEX_INCR DIRECT FNC_VALUES 5 UWORD COLUMN_DIR DIRECT /end RECORD_LAYOUT
/begin RECORD_LAYOUT KlAUbSstUbWSb NO_AXIS_PTS_X 1 UBYTE AXIS_PTS_X 2 UBYTE INDEX_INCR DIRECT FNC_VALUES 3 SBYTE COLUMN_DIR DIRECT /end RECORD_LAYOUT
/begin RECORD_LAYOUT KlAUbSstUbWUb NO_AXIS_PTS_X 1 UBYTE AXIS_PTS_X 2 UBYTE INDEX_INCR DIRECT FNC_VALUES 3 UBYTE COLUMN_DIR DIRECT /end RECORD_LAYOUT
/begin RECORD_LAYOUT KlAUbSstUwWUb NO_AXIS_PTS_X 1 UWORD AXIS_PTS_X 2 UWORD INDEX_INCR DIRECT FNC_VALUES 3 UBYTE COLUMN_DIR DIRECT /end RECORD_LAYOUT
/begin RECORD_LAYOUT KlAUwSstSwWUw NO_AXIS_PTS_X 1 UWORD AXIS_PTS_X 2 SWORD INDEX_INCR DIRECT FNC_VALUES 3 UWORD COLUMN_DIR DIRECT /end RECORD_LAYOUT
/begin RECORD_LAYOUT KlAUwSstUwWUb NO_AXIS_PTS_X 1 UWORD AXIS_PTS_X 2 UWORD INDEX_INCR DIRECT FNC_VALUES 3 UBYTE COLUMN_DIR DIRECT /end RECORD_LAYOUT
/begin RECORD_LAYOUT KlAUwSstUwWUw NO_AXIS_PTS_X 1 UWORD AXIS_PTS_X 2 UWORD INDEX_INCR DIRECT FNC_VALUES 3 UWORD COLUMN_DIR DIRECT /end RECORD_LAYOUT
/begin RECORD_LAYOUT KtxC FNC_VALUES 1 UBYTE COLUMN_DIR DIRECT /end RECORD_LAYOUT
/begin RECORD_LAYOUT KwbUw FNC_VALUES 1 UWORD COLUMN_DIR DIRECT /end RECORD_LAYOUT
/begin RECORD_LAYOUT KwSb FNC_VALUES 1 SBYTE COLUMN_DIR DIRECT /end RECORD_LAYOUT
/begin RECORD_LAYOUT KwSw FNC_VALUES 1 SWORD COLUMN_DIR DIRECT /end RECORD_LAYOUT
/begin RECORD_LAYOUT KwUb FNC_VALUES 1 UBYTE COLUMN_DIR DIRECT /end RECORD_LAYOUT
/begin RECORD_LAYOUT KwUw FNC_VALUES 1 UWORD COLUMN_DIR DIRECT /end RECORD_LAYOUT
/begin RECORD_LAYOUT SstAUbSstUb NO_AXIS_PTS_X 1 UBYTE AXIS_PTS_X 2 UBYTE INDEX_INCR DIRECT /end RECORD_LAYOUT
/end MODULE
/end PROJECT
