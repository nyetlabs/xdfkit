/begin PROJECT X505S24EX "4016.32"
/begin HEADER "" VERSION "X505S24EX" PROJECT_NO X505S24EX /end HEADER
/begin MODULE DIM ""
/begin MOD_COMMON "" BYTE_ORDER BIG_ENDIAN S_REC_LAYOUT DAMOS /end MOD_COMMON
/begin CHARACTERISTIC CLACLWS "Fehlerklasse: CAN-Schnittstelle, Timeout Botschaft Lenkwinkelsensor" VALUE 0x810D74 KwUb 255.0 dez 0.00 255.0 FUNCTION_LIST DFPM_CLWS IF_DATA DIM_X DIRECT 0x810D74 /end CHARACTERISTIC
/begin CHARACTERISTIC CLADPL "Fehlerklasse: Dauerplus" VALUE 0x810D79 KwUb 255.0 dez 0.00 255.0 FUNCTION_LIST DFPM_DPL IF_DATA DIM_X DIRECT 0x810D79 /end CHARACTERISTIC
/begin CHARACTERISTIC CLADSBKV "Fehlerklasse: BKV" VALUE 0x810D7A KwUb 255.0 dez 0.00 255.0 FUNCTION_LIST DFPM_DSBKV IF_DATA DIM_X DIRECT 0x810D7A /end CHARACTERISTIC
/begin CHARACTERISTIC CLADSL "Fehlerklasse: Druchsensor Ladedruck" VALUE 0x810D7B KwUb 255.0 dez 0.00 255.0 FUNCTION_LIST DFPM_GGDSAS IF_DATA DIM_X DIRECT 0x810D7B /end CHARACTERISTIC
/begin CHARACTERISTIC CLADSU "Fehlerklasse: Umgebungsdrucksensor" VALUE 0x810D7C KwUb 255.0 dez 0.00 255.0 FUNCTION_LIST DFPM_GGDSAS IF_DATA DIM_X DIRECT 0x810D7C /end CHARACTERISTIC
/begin CHARACTERISTIC CLADSVLU "Fehlerklasse: Drucksensorsignalvergleich (DS-L DS-U)" VALUE 0x810D7D KwUb 255.0 dez 0.00 255.0 FUNCTION_LIST DFPM_GGDSAS IF_DATA DIM_X DIRECT 0x810D7D /end CHARACTERISTIC
/begin CHARACTERISTIC CLADVEE "Fehlerklasse: DV-E Endstufe" VALUE 0x810D7E KwUb 255.0 dez 0.00 255.0 FUNCTION_LIST DFPM_DDVE IF_DATA DIM_X DIRECT 0x810D7E /end CHARACTERISTIC
/begin CHARACTERISTIC CLADVEF "Fehlerklasse: DV-E Fehler bei Federprüfung" VALUE 0x810D7F KwUb 255.0 dez 0.00 255.0 FUNCTION_LIST DFPM_DDVE IF_DATA DIM_X DIRECT 0x810D7F /end CHARACTERISTIC
/begin CHARACTERISTIC CLADVEFO "" VALUE 0x810D80 KwUb 255.0 dez 0.00 255.0 FUNCTION_LIST DFPM_DDVE IF_DATA DIM_X DIRECT 0x810D80 /end CHARACTERISTIC
/begin CHARACTERISTIC CLADVEL "Fehlerklasse: DV-E Lageabweichung" VALUE 0x810D81 KwUb 255.0 dez 0.00 255.0 FUNCTION_LIST DFPM_DDVE IF_DATA DIM_X DIRECT 0x810D81 /end CHARACTERISTIC
/begin CHARACTERISTIC CLADVEN "Fehlerklasse: DV-E Fehler bei Prüfung Notluftposition" VALUE 0x810D82 KwUb 255.0 dez 0.00 255.0 FUNCTION_LIST DFPM_DDVE IF_DATA DIM_X DIRECT 0x810D82 /end CHARACTERISTIC
/begin CHARACTERISTIC CLADVER "Fehlerklasse: DV-E Regelbereich" VALUE 0x810D83 KwUb 255.0 dez 0.00 255.0 FUNCTION_LIST DFPM_DDVE IF_DATA DIM_X DIRECT 0x810D83 /end CHARACTERISTIC
/begin CHARACTERISTIC CLADVET "" VALUE 0x810D84 KwUb 255.0 dez 0.00 255.0 FUNCTION_LIST DFPM_DDVE IF_DATA DIM_X DIRECT 0x810D84 /end CHARACTERISTIC
/begin CHARACTERISTIC CLADVEU "Fehlerklasse: DV-E Fehler beim UMA-Lernen" VALUE 0x810D85 KwUb 255.0 dez 0.00 255.0 FUNCTION_LIST DFPM_DDVE IF_DATA DIM_X DIRECT 0x810D85 /end CHARACTERISTIC
/begin CHARACTERISTIC CLADVEUB "" VALUE 0x810D86 KwUb 255.0 dez 0.00 255.0 FUNCTION_LIST DFPM_DDVE IF_DATA DIM_X DIRECT 0x810D86 /end CHARACTERISTIC
/begin CHARACTERISTIC CLADVEV "Fehlerklasse: DV-E Fehler bei Verstärkerabgleich" VALUE 0x810D88 KwUb 255.0 dez 0.00 255.0 FUNCTION_LIST DFPM_DDVE IF_DATA DIM_X DIRECT 0x810D88 /end CHARACTERISTIC
/begin CHARACTERISTIC CLAEGFE "Fehlerklasse: Lasterfassung" VALUE 0x810D89 KwUb 255.0 dez 0.00 255.0 FUNCTION_LIST DFPM_DEGFE IF_DATA DIM_X DIRECT 0x810D89 /end CHARACTERISTIC
/begin CHARACTERISTIC CLAENWS "Fehlerklasse: Nockenwellensteuerung Einlass Nockenwelle" VALUE 0x810D8A KwUb 255.0 dez 0.00 255.0 FUNCTION_LIST DFPM_DENWS IF_DATA DIM_X DIRECT 0x810D8A /end CHARACTERISTIC
/begin CHARACTERISTIC CLAENWSE "Fehlerklasse: Einlaßnockenwelle- Endstufe" VALUE 0x810D8B KwUb 255.0 dez 0.00 255.0 FUNCTION_LIST DFPM_DEKON IF_DATA DIM_X DIRECT 0x810D8B /end CHARACTERISTIC
/begin CHARACTERISTIC CLAGRBH "Fehlerklasse: GRA- Bedienhebel" VALUE 0x810D98 KwUb 255.0 dez 0.00 255.0 FUNCTION_LIST DFPM_GGFGRH IF_DATA DIM_X DIRECT 0x810D98 /end CHARACTERISTIC
/begin CHARACTERISTIC CLAHLA "Fehlerklasse: Heizleistungsanforderung" VALUE 0x810D99 KwUb 255.0 dez 0.00 255.0 FUNCTION_LIST DFPM_GGHLA IF_DATA DIM_X DIRECT 0x810D99 /end CHARACTERISTIC
/begin CHARACTERISTIC CLAHRE "" VALUE 0x810D9A KwUb 255.0 dez 0.00 255.0 FUNCTION_LIST DFPM_HRE IF_DATA DIM_X DIRECT 0x810D9A /end CHARACTERISTIC
/begin CHARACTERISTIC CLAHSH "Fehlerklasse: Heizung Lambdasonde hinter Kat" VALUE 0x810D9B KwUb 255.0 dez 0.00 255.0 FUNCTION_LIST DFPM_DHLSHK IF_DATA DIM_X DIRECT 0x810D9B /end CHARACTERISTIC
/begin CHARACTERISTIC CLAHSH2 "Fehlerklasse: Heizung Lambdasonde 2 hinter Kat" VALUE 0x810D9C KwUb 255.0 dez 0.00 255.0 FUNCTION_LIST DFPM_DHLSHK IF_DATA DIM_X DIRECT 0x810D9C /end CHARACTERISTIC
/begin CHARACTERISTIC CLAHSHE "Fehlerklasse: Endstufe Heizung Lambdasonde hinter Kat" VALUE 0x810D9D KwUb 255.0 dez 0.00 255.0 FUNCTION_LIST DFPM_DEKON IF_DATA DIM_X DIRECT 0x810D9D /end CHARACTERISTIC
/begin CHARACTERISTIC CLAHSV "Fehlerklasse: Heizung Lambdasonde vor Kat" VALUE 0x810D9E KwUb 255.0 dez 0.00 255.0 FUNCTION_LIST DFPM_DHLSU IF_DATA DIM_X DIRECT 0x810D9E /end CHARACTERISTIC
/begin CHARACTERISTIC CLAHSV2 "Fehlerklasse: Heizung Lambdasonde 2 vor Kat" VALUE 0x810D9F KwUb 255.0 dez 0.00 255.0 FUNCTION_LIST DFPM_DHLSU IF_DATA DIM_X DIRECT 0x810D9F /end CHARACTERISTIC
/begin CHARACTERISTIC CLAHSVSA "Fehlerklasse: Heizung Lambdasonde vor Kat" VALUE 0x810DA0 KwUb 255.0 dez 0.00 255.0 FUNCTION_LIST DFPM_DHLSU IF_DATA DIM_X DIRECT 0x810DA0 /end CHARACTERISTIC
/begin CHARACTERISTIC CLAHSVSA2 "Fehlerklasse: Heizung Lambdasonde 2 vor Kat" VALUE 0x810DA1 KwUb 255.0 dez 0.00 255.0 FUNCTION_LIST DFPM_DHLSU IF_DATA DIM_X DIRECT 0x810DA1 /end CHARACTERISTIC
/begin CHARACTERISTIC CLAKAT "Fehlerklasse: Katalysator" VALUE 0x810DA2 KwUb 255.0 dez 0.00 255.0 FUNCTION_LIST DFPM_DKATSP IF_DATA DIM_X DIRECT 0x810DA2 /end CHARACTERISTIC
/begin CHARACTERISTIC CLAKPE "Fehlerklasse: EKP-Relais Endstufe" VALUE 0x810DA3 KwUb 255.0 dez 0.00 255.0 FUNCTION_LIST DFPM_DEKON IF_DATA DIM_X DIRECT 0x810DA3 /end CHARACTERISTIC
/begin CHARACTERISTIC CLAKRA01 "Fehlerklasse: Klopfregelanschlag Zylinder 1" VALUE 0x810DA4 KwUb 255.0 dez 0.00 255.0 FUNCTION_LIST DFPM_DKRA IF_DATA DIM_X DIRECT 0x810DA4 /end CHARACTERISTIC
/begin CHARACTERISTIC CLAKRA02 "Fehlerklasse: Klopfregelanschlag Zylinder 2" VALUE 0x810DA5 KwUb 255.0 dez 0.00 255.0 FUNCTION_LIST DFPM_DKRA IF_DATA DIM_X DIRECT 0x810DA5 /end CHARACTERISTIC
/begin CHARACTERISTIC CLAKRA03 "Fehlerklasse: Klopfregelanschlag Zylinder 3" VALUE 0x810DA6 KwUb 255.0 dez 0.00 255.0 FUNCTION_LIST DFPM_DKRA IF_DATA DIM_X DIRECT 0x810DA6 /end CHARACTERISTIC
/begin CHARACTERISTIC CLAKRA04 "Fehlerklasse: Klopfregelanschlag Zylinder 4" VALUE 0x810DA7 KwUb 255.0 dez 0.00 255.0 FUNCTION_LIST DFPM_DKRA IF_DATA DIM_X DIRECT 0x810DA7 /end CHARACTERISTIC
/begin CHARACTERISTIC CLAKRNT "Fehlerklasse: Klopfregelung Nulltest" VALUE 0x810DA8 KwUb 255.0 dez 0.00 255.0 FUNCTION_LIST DFPM_DKRNT IF_DATA DIM_X DIRECT 0x810DA8 /end CHARACTERISTIC
/begin CHARACTERISTIC CLAKROF "Fehlerklasse: Klopfreglung Offset" VALUE 0x810DA9 KwUb 255.0 dez 0.00 255.0 FUNCTION_LIST DFPM_DKRNT IF_DATA DIM_X DIRECT 0x810DA9 /end CHARACTERISTIC
/begin CHARACTERISTIC CLAKRTP "Fehlerklasse: Klopfregelung Testimpuls" VALUE 0x810DAA KwUb 255.0 dez 0.00 255.0 FUNCTION_LIST DFPM_DKRTP IF_DATA DIM_X DIRECT 0x810DAA /end CHARACTERISTIC
/begin CHARACTERISTIC CLAKS1 "Fehlerklasse: Klopfsensor 1" VALUE 0x810DAB KwUb 255.0 dez 0.00 255.0 FUNCTION_LIST DFPM_DKRS IF_DATA DIM_X DIRECT 0x810DAB /end CHARACTERISTIC
/begin CHARACTERISTIC CLAKS2 "Fehlerklasse: Klopfsensor 2" VALUE 0x810DAC KwUb 255.0 dez 0.00 255.0 FUNCTION_LIST DFPM_DKRS IF_DATA DIM_X DIRECT 0x810DAC /end CHARACTERISTIC
/begin CHARACTERISTIC CLAKS3 "Fehlerklasse: Klopfsensor 3" VALUE 0x810DAD KwUb 255.0 dez 0.00 255.0 FUNCTION_LIST DFPM_DKRS IF_DATA DIM_X DIRECT 0x810DAD /end CHARACTERISTIC
/begin CHARACTERISTIC CLAKS4 "Fehlerklasse: Klopfsensor 4" VALUE 0x810DAE KwUb 255.0 dez 0.00 255.0 FUNCTION_LIST DFPM_DKRS IF_DATA DIM_X DIRECT 0x810DAE /end CHARACTERISTIC
/begin CHARACTERISTIC CLAKUPPL "Fehlerklasse: Pedalwertgeber Kupplung" VALUE 0x810DAF KwUb 255.0 dez 0.00 255.0 FUNCTION_LIST DFPM_DKUPPL IF_DATA DIM_X DIRECT 0x810DAF /end CHARACTERISTIC
/begin CHARACTERISTIC CLALASH "Fehlerklasse: Lambdasondenalterung hinter Kat" VALUE 0x810DB0 KwUb 255.0 dez 0.00 255.0 FUNCTION_LIST DFPM_DLSAHK IF_DATA DIM_X DIRECT 0x810DB0 /end CHARACTERISTIC
/begin CHARACTERISTIC CLALDE "Fehlerklasse: LDR-Taktventil Endstufe" VALUE 0x810DB1 KwUb 255.0 dez 0.00 255.0 FUNCTION_LIST DFPM_DEKON IF_DATA DIM_X DIRECT 0x810DB1 /end CHARACTERISTIC
/begin CHARACTERISTIC CLALDO "Fehlerklasse: LDR Überladefehler" VALUE 0x810DB2 KwUb 255.0 dez 0.00 255.0 FUNCTION_LIST DFPM_DLDR IF_DATA DIM_X DIRECT 0x810DB2 /end CHARACTERISTIC
/begin CHARACTERISTIC CLALDP "Fehlerklasse: Leckdiagnosepumpe" VALUE 0x810DB3 KwUb 255.0 dez 0.00 255.0 FUNCTION_LIST DFPM_DLDP IF_DATA DIM_X DIRECT 0x810DB3 /end CHARACTERISTIC
/begin CHARACTERISTIC CLALDPE "Fehlerklasse: LDP  Endstufe" VALUE 0x810DB4 KwUb 255.0 dez 0.00 255.0 FUNCTION_LIST DFPM_LDPE IF_DATA DIM_X DIRECT 0x810DB4 /end CHARACTERISTIC
/begin CHARACTERISTIC CLALDRA "Fehlerklasse: LDR Regelabweichungsfehler" VALUE 0x810DB5 KwUb 255.0 dez 0.00 255.0 FUNCTION_LIST DFPM_DLDR IF_DATA DIM_X DIRECT 0x810DB5 /end CHARACTERISTIC
/begin CHARACTERISTIC CLALDUV "Fehlerklasse: Schubumluftventil-Endstufe" VALUE 0x810DB6 KwUb 255.0 dez 0.00 255.0 FUNCTION_LIST DFPM_DLDUV IF_DATA DIM_X DIRECT 0x810DB6 /end CHARACTERISTIC
/begin CHARACTERISTIC CLALKVDK "Fehlerklasse: Leck vor Drosselklappe" VALUE 0x810DB7 KwUb 255.0 dez 0.00 255.0 FUNCTION_LIST DFPM_DLDR IF_DATA DIM_X DIRECT 0x810DB7 /end CHARACTERISTIC
/begin CHARACTERISTIC CLALLR "Fehlerklasse: Leerlaufregelung" VALUE 0x810DB8 KwUb 255.0 dez 0.00 255.0 FUNCTION_LIST DFPM_DLLR IF_DATA DIM_X DIRECT 0x810DB8 /end CHARACTERISTIC
/begin CHARACTERISTIC CLALM "Fehlerklasse: Hauptfüllungssignal" VALUE 0x810DB9 KwUb 255.0 dez 0.00 255.0 FUNCTION_LIST DFPM_DSELHFS IF_DATA DIM_X DIRECT 0x810DB9 /end CHARACTERISTIC
/begin CHARACTERISTIC CLALSH "Fehlerklasse: Lambdasonde hinter Kat" VALUE 0x810DBA KwUb 255.0 dez 0.00 255.0 FUNCTION_LIST DFPM_DLSH IF_DATA DIM_X DIRECT 0x810DBA /end CHARACTERISTIC
/begin CHARACTERISTIC CLALSV "Fehlerklasse: Lambdasonde vor Kat" VALUE 0x810DBB KwUb 255.0 dez 0.00 255.0 FUNCTION_LIST DFPM_DLSU IF_DATA DIM_X DIRECT 0x810DBB /end CHARACTERISTIC
/begin CHARACTERISTIC CLALUE1 "" VALUE 0x810DBC KwUb 255.0 DEZ 0.00 255.0 FUNCTION_LIST DFPM_dkmtr IF_DATA DIM_X DIRECT 0x810DBC /end CHARACTERISTIC
/begin CHARACTERISTIC CLALUES1E "Fehlerklasse: Endstufe Lüftersteuerung 1" VALUE 0x810DBD KwUb 255.0 dez 0.00 255.0 FUNCTION_LIST DFPM_DEKON IF_DATA DIM_X DIRECT 0x810DBD /end CHARACTERISTIC
/begin CHARACTERISTIC CLAMD "Fehlerklasse:  Aussetzer, Summenfehler (multiple)" VALUE 0x810DBE KwUb 255.0 dez 0.00 255.0 FUNCTION_LIST DFPM_DMDMIL IF_DATA DIM_X DIRECT 0x810DBE /end CHARACTERISTIC
/begin CHARACTERISTIC CLAMD00 "Fehlerklasse:  Aussetzer Zyl. 0" VALUE 0x810DBF KwUb 255.0 dez 0.00 255.0 FUNCTION_LIST DFPM_DMDMIL IF_DATA DIM_X DIRECT 0x810DBF /end CHARACTERISTIC
/begin CHARACTERISTIC CLAMD01 "Fehlerklasse:  Aussetzer Zyl. 1" VALUE 0x810DC0 KwUb 255.0 dez 0.00 255.0 FUNCTION_LIST DFPM_DMDMIL IF_DATA DIM_X DIRECT 0x810DC0 /end CHARACTERISTIC
/begin CHARACTERISTIC CLAMD02 "Fehlerklasse:  Aussetzer Zylinder 2" VALUE 0x810DC1 KwUb 255.0 dez 0.00 255.0 FUNCTION_LIST DFPM_DMDMIL IF_DATA DIM_X DIRECT 0x810DC1 /end CHARACTERISTIC
/begin CHARACTERISTIC CLAMD03 "Fehlerklasse:  Aussetzer Zylinder 3" VALUE 0x810DC2 KwUb 255.0 dez 0.00 255.0 FUNCTION_LIST DFPM_DMDMIL IF_DATA DIM_X DIRECT 0x810DC2 /end CHARACTERISTIC
/begin CHARACTERISTIC CLAMDB "Fehlerklasse: Momentbgrenzung Sollmoment" VALUE 0x810DC3 KwUb 255.0 dez 0.00 255.0 FUNCTION_LIST DFPM_MDKOG IF_DATA DIM_X DIRECT 0x810DC3 /end CHARACTERISTIC
/begin CHARACTERISTIC CLAMFA "Fehlerklasse: MIL-fremdbestimmt" VALUE 0x810DC4 KwUb 255.0 dez 0.00 255.0 FUNCTION_LIST DFPM_DMFB IF_DATA DIM_X DIRECT 0x810DC4 /end CHARACTERISTIC
/begin CHARACTERISTIC CLAN "Fehlerklasse: Drehzahlgeber" VALUE 0x810DC5 KwUb 255.0 dez 0.00 255.0 FUNCTION_LIST DFPM_DDG IF_DATA DIM_X DIRECT 0x810DC5 /end CHARACTERISTIC
/begin CHARACTERISTIC CLANWKW "Fehlerklasse: Zuordnung Nockenwelle zu Kurbelwelle" VALUE 0x810DC6 KwUb 255.0 dez 0.00 255.0 FUNCTION_LIST DFPM_DNWKW IF_DATA DIM_X DIRECT 0x810DC6 /end CHARACTERISTIC
/begin CHARACTERISTIC CLANWSE "Fehlerklasse: Nockenwellensteuerungsventil Endstufe" VALUE 0x810DC7 KwUb 255.0 dez 0.00 255.0 FUNCTION_LIST DFPM_DEKON IF_DATA DIM_X DIRECT 0x810DC7 /end CHARACTERISTIC
/begin CHARACTERISTIC CLANX "Fehlerklasse: ^NMAX- Überschreitung" VALUE 0x810DC8 KwUb 255.0 dez 0.00 255.0 FUNCTION_LIST DFPM_DNMAX IF_DATA DIM_X DIRECT 0x810DC8 /end CHARACTERISTIC
/begin CHARACTERISTIC CLAPWM "" VALUE 0x810DC9 KwUb 255.0 dez 0.00 255.0 FUNCTION_LIST DFPM_DSWEA IF_DATA DIM_X DIRECT 0x810DC9 /end CHARACTERISTIC
/begin CHARACTERISTIC CLARKAT "Fehlerklasse: LR-Adaption additiver Bereich pro Zeit" VALUE 0x810DCA KwUb 255.0 dez 0.00 255.0 FUNCTION_LIST DFPM_DKVS IF_DATA DIM_X DIRECT 0x810DCA /end CHARACTERISTIC
/begin CHARACTERISTIC CLARKAZ "Fehlerklasse: LR-Adaption additiver Bereich pro Zündung" VALUE 0x810DCB KwUb 255.0 dez 0.00 255.0 FUNCTION_LIST DFPM_DKVS IF_DATA DIM_X DIRECT 0x810DCB /end CHARACTERISTIC
/begin CHARACTERISTIC CLASCR "Fehlerklasse: Überwachung Crashsignal" VALUE 0x810DCC KwUb 255.0 dez 0.00 255.0 FUNCTION_LIST DFPM_GGCS IF_DATA DIM_X DIRECT 0x810DCC /end CHARACTERISTIC
/begin CHARACTERISTIC CLASGEEP "Fehlerklasse: SG defekt (EEPROM)" VALUE 0x810DCD KwUb 255.0 dez 0.00 255.0 FUNCTION_LIST DFPM_DSGEEP IF_DATA DIM_X DIRECT 0x810DCD /end CHARACTERISTIC
/begin CHARACTERISTIC CLASGEEW "Fehlerklasse: SG defekt (EEPROM WFS- Bereich)" VALUE 0x810DCE KwUb 255.0 dez 0.00 255.0 FUNCTION_LIST DFPM_IMS IF_DATA DIM_X DIRECT 0x810DCE /end CHARACTERISTIC
/begin CHARACTERISTIC CLASLPE "Fehlerklasse: Sekundärluftpumpe Endstufe" VALUE 0x810DCF KwUb 255.0 dez 0.00 255.0 FUNCTION_LIST DFPM_DEKON IF_DATA DIM_X DIRECT 0x810DCF /end CHARACTERISTIC
/begin CHARACTERISTIC CLASLS "Fehlerklasse: Sekundärluftsystem" VALUE 0x810DD0 KwUb 255.0 dez 0.00 255.0 FUNCTION_LIST DFPM_DSLSLRS IF_DATA DIM_X DIRECT 0x810DD0 /end CHARACTERISTIC
/begin CHARACTERISTIC CLASWE "Fehlerklasse: Beschleunigungssensor der Schlechtwegerkennung" VALUE 0x810DD3 KwUb 255.0 dez 0.00 255.0 FUNCTION_LIST DFPM_DSWEA IF_DATA DIM_X DIRECT 0x810DD3 /end CHARACTERISTIC
/begin CHARACTERISTIC CLAT2STC "" VALUE 0x810DD4 KwUb 255.0 dez 0.00 255.0 FUNCTION_LIST DFPM_DT2STC IF_DATA DIM_X DIRECT 0x810DD4 /end CHARACTERISTIC
/begin CHARACTERISTIC CLATA "Fehlerklasse: Ansauglufttemperatur TANS (/Ladeluft-)" VALUE 0x810DD5 KwUb 255.0 dez 0.00 255.0 FUNCTION_LIST DFPM_GGTFA IF_DATA DIM_X DIRECT 0x810DD5 /end CHARACTERISTIC
/begin CHARACTERISTIC CLATANKL "Fehlerklasse : tankl (Tank leer)" VALUE 0x810DD6 KwUb 255.0 dez 0.00 255.0 FUNCTION_LIST DFPM_DTANKL IF_DATA DIM_X DIRECT 0x810DD6 /end CHARACTERISTIC
/begin CHARACTERISTIC CLATES "Fehlerklasse: Tankdiagnose, TEV offen" VALUE 0x810DD7 KwUb 255.0 dez 0.00 255.0 FUNCTION_LIST DFPM_DTEV IF_DATA DIM_X DIRECT 0x810DD7 /end CHARACTERISTIC
/begin CHARACTERISTIC CLATESF "Fehlerklasse: Tankdiagnose, Feinleck" VALUE 0x810DD8 KwUb 255.0 dez 0.00 255.0 FUNCTION_LIST DFPM_DLDP IF_DATA DIM_X DIRECT 0x810DD8 /end CHARACTERISTIC
/begin CHARACTERISTIC CLATESG "Fehlerklasse: Tankdiagnose, Grobleck" VALUE 0x810DD9 KwUb 255.0 dez 0.00 255.0 FUNCTION_LIST DFPM_DLDP IF_DATA DIM_X DIRECT 0x810DD9 /end CHARACTERISTIC
/begin CHARACTERISTIC CLATEVE "Fehlerklasse: Tankentlüftungsventil Endstufe" VALUE 0x810DDA KwUb 255.0 dez 0.00 255.0 FUNCTION_LIST DFPM_DEKON IF_DATA DIM_X DIRECT 0x810DDA /end CHARACTERISTIC
/begin CHARACTERISTIC CLATEVE2 "Fehlerklasse: Tankentlüftungsventil Endstufe Bank 2" VALUE 0x810DDB KwUb 255.0 dez 0.00 255.0 FUNCTION_LIST DFPM_DUMMY_D IF_DATA DIM_X DIRECT 0x810DDB /end CHARACTERISTIC
/begin CHARACTERISTIC CLATHM "Fehlerklasse: Thermostat-Diagnose THM" VALUE 0x810DDC KwUb 255.0 dez 0.00 255.0 FUNCTION_LIST DFPM_DTHM IF_DATA DIM_X DIRECT 0x810DDC /end CHARACTERISTIC
/begin CHARACTERISTIC CLATKA "Fehlerklasse: Temperatur Kühlerausgang" VALUE 0x810DDD KwUb 255.0 dez 0.00 255.0 FUNCTION_LIST DFPM_GGTKA IF_DATA DIM_X DIRECT 0x810DDD /end CHARACTERISTIC
/begin CHARACTERISTIC CLATM "Fehlerklasse: Motortemperatur TMOT" VALUE 0x810DDE KwUb 255.0 dez 0.00 255.0 FUNCTION_LIST DFPM_GGTFM IF_DATA DIM_X DIRECT 0x810DDE /end CHARACTERISTIC
/begin CHARACTERISTIC CLATMKI "Fehlerklasse: Motortemperatur aus Kombiinstrument TMKI" VALUE 0x810DDF KwUb 255.0 dez 0.00 255.0 FUNCTION_LIST DFPM_GGGTS IF_DATA DIM_X DIRECT 0x810DDF /end CHARACTERISTIC
/begin CHARACTERISTIC CLATOL "Fehlerklasse: (Motor-) Oeltemperatur TOL" VALUE 0x810DE0 KwUb 255.0 dez 0.00 255.0 FUNCTION_LIST DFPM_BGTOL IF_DATA DIM_X DIRECT 0x810DE0 /end CHARACTERISTIC
/begin CHARACTERISTIC CLATUM "Fehlerklasse: Umgebungstemperatur TUM" VALUE 0x810DE1 KwUb 255.0 dez 0.00 255.0 FUNCTION_LIST DFPM_BGTUMG IF_DATA DIM_X DIRECT 0x810DE1 /end CHARACTERISTIC
/begin CHARACTERISTIC CLAUB "Fehlerklasse: Batteriespannung UB (Bordnetz)" VALUE 0x810DE2 KwUb 255.0 dez 0.00 255.0 FUNCTION_LIST DFPM_GGUB IF_DATA DIM_X DIRECT 0x810DE2 /end CHARACTERISTIC
/begin CHARACTERISTIC CLAUBR "Fehlerklasse: UBR Bordnetzspannung über Hauptrelais" VALUE 0x810DE3 KwUb 255.0 dez 0.00 255.0 FUNCTION_LIST DFPM_GGUBR IF_DATA DIM_X DIRECT 0x810DE3 /end CHARACTERISTIC
/begin CHARACTERISTIC CLAUFMV "Fehlerklasse: Funktionsüberwachung: Momentenvergleich" VALUE 0x810DE4 KwUb 255.0 dez 0.00 255.0 FUNCTION_LIST DFPM_DUF IF_DATA DIM_X DIRECT 0x810DE4 /end CHARACTERISTIC
/begin CHARACTERISTIC CLAUFSKA "Fehlerklasse: Funktionsüberwachung: Sicherheits-Kraftstoff-Abschaltung" VALUE 0x810DE5 KwUb 255.0 dez 0.00 255.0 FUNCTION_LIST DFPM_DUF IF_DATA DIM_X DIRECT 0x810DE5 /end CHARACTERISTIC
/begin CHARACTERISTIC CLAURRAM "Fehlerklasse: Rechnerüberwachung: RAM" VALUE 0x810DE6 KwUb 255.0 dez 0.00 255.0 FUNCTION_LIST DFPM_DUR IF_DATA DIM_X DIRECT 0x810DE6 /end CHARACTERISTIC
/begin CHARACTERISTIC CLAURROM "Fehlerklasse: Rechnerüberwachung: ROM" VALUE 0x810DE7 KwUb 255.0 dez 0.00 255.0 FUNCTION_LIST DFPM_DUR IF_DATA DIM_X DIRECT 0x810DE7 /end CHARACTERISTIC
/begin CHARACTERISTIC CLAURRST "Fehlerklasse: Rechnerüberwachung: Reset" VALUE 0x810DE8 KwUb 255.0 dez 0.00 255.0 FUNCTION_LIST DFPM_DUR IF_DATA DIM_X DIRECT 0x810DE8 /end CHARACTERISTIC
/begin CHARACTERISTIC CLAUVSE "Fehlerklasse: Endstufe Umluftventil Turbo" VALUE 0x810DE9 KwUb 255.0 dez 0.00 255.0 FUNCTION_LIST DFPM_DEKON IF_DATA DIM_X DIRECT 0x810DE9 /end CHARACTERISTIC
/begin CHARACTERISTIC CLAVFZ "Fehlerklasse: Geschwindigkeitssignal" VALUE 0x810DEA KwUb 255.0 dez 0.00 255.0 FUNCTION_LIST DFPM_DVFZ IF_DATA DIM_X DIRECT 0x810DEA /end CHARACTERISTIC
/begin CHARACTERISTIC CLAWFS "Fehlerklasse: Wegfahrsperre" VALUE 0x810DEB KwUb 255.0 dez 0.00 255.0 FUNCTION_LIST DFPM_IMS IF_DATA DIM_X DIRECT 0x810DEB /end CHARACTERISTIC
/begin CHARACTERISTIC CLAWFSRC "Fehlerklasse: Wegfahrsperre RC-Glied" VALUE 0x810DEC KwUb 255.0 dez 0.00 255.0 FUNCTION_LIST DFPM_IMS IF_DATA DIM_X DIRECT 0x810DEC /end CHARACTERISTIC
/begin CHARACTERISTIC CLAZET1 "" VALUE 0x810DED KwUb 255.0 dez 0.00 255.0 FUNCTION_LIST DFPM_DEKON IF_DATA DIM_X DIRECT 0x810DED /end CHARACTERISTIC
/begin CHARACTERISTIC CLAZET2 "" VALUE 0x810DEE KwUb 255.0 dez 0.00 255.0 FUNCTION_LIST DFPM_DEKON IF_DATA DIM_X DIRECT 0x810DEE /end CHARACTERISTIC
/begin CHARACTERISTIC CLAZET3 "" VALUE 0x810DEF KwUb 255.0 dez 0.00 255.0 FUNCTION_LIST DFPM_DEKON IF_DATA DIM_X DIRECT 0x810DEF /end CHARACTERISTIC
/begin CHARACTERISTIC CLAZET4 "" VALUE 0x810DF0 KwUb 255.0 dez 0.00 255.0 FUNCTION_LIST DFPM_DEKON IF_DATA DIM_X DIRECT 0x810DF0 /end CHARACTERISTIC
/begin CHARACTERISTIC CLAZZZ "Dummy: Tabellenende" VALUE 0x810DF1 KwUb 255.0 dez 0.00 255.0 FUNCTION_LIST DFPM_DFPM IF_DATA DIM_X DIRECT 0x810DF1 /end CHARACTERISTIC
/begin CHARACTERISTIC CLDPAAV "Codewort Elektrisches AAV vorhanden" VALUE 0x812775 KwUb 255.0 dez 0.00 255.0 FUNCTION_LIST DLDP IF_DATA DIM_X DIRECT 0x812775 /end CHARACTERISTIC
/begin CHARACTERISTIC CLDPTVC "Codewort DLDP-TEV- Check" VALUE 0x81A78E KwUb 255.0 dez 0.00 255.0 FUNCTION_LIST DLDP IF_DATA DIM_X DIRECT 0x81A78E /end CHARACTERISTIC
/begin CHARACTERISTIC CLRS "Codewort für Betriebsmodi LRS" VALUE 0x812689 KwUb 255.0 dez 0.00 255.0 FUNCTION_LIST LRS LRSEB IF_DATA DIM_X DIRECT 0x812689 /end CHARACTERISTIC
/begin CHARACTERISTIC CLRSHK "Codewort für Freigabe LRSHK und Auswahl Initialisierung" VALUE 0x812713 KwUb 255.0 dez 0.00 255.0 FUNCTION_LIST LRSHK IF_DATA DIM_X DIRECT 0x812713 /end CHARACTERISTIC
/begin CHARACTERISTIC CLRSHKA "Codewort II für Freigabe LRSHK und Auswahl Initialisierung" VALUE 0x812714 KwUb 255.0 dez 0.00 255.0 FUNCTION_LIST LRSHK IF_DATA DIM_X DIRECT 0x812714 /end CHARACTERISTIC
/begin CHARACTERISTIC CLRSHKEB "Codewort für Freigabe LRSHKEB" VALUE 0x812715 KwUb 255.0 dez 0.00 255.0 FUNCTION_LIST LRSHK IF_DATA DIM_X DIRECT 0x812715 /end CHARACTERISTIC
/begin CHARACTERISTIC CLRSKA "Code-Wort Funktionsart Kat-Ausräumen" VALUE 0x81274D KwUb 255.0 dez 0.00 255.0 FUNCTION_LIST LRSKA IF_DATA DIM_X DIRECT 0x81274D /end CHARACTERISTIC
/begin CHARACTERISTIC CLRZWTMS "Codewort Zwangseinschaltung LR gemäß CARB-Forderung" VALUE 0x81A4A2 KwUb 255.0 dez 0.00 255.0 FUNCTION_LIST LRSEB IF_DATA DIM_X DIRECT 0x81A4A2 /end CHARACTERISTIC
/begin CHARACTERISTIC CLSDKH "Codewort für LSD-Abschaltung bei Kat. heizen" VALUE 0x8127A5 KwUb 255.0 dez 0.00 255.0 FUNCTION_LIST BBDLS IF_DATA DIM_X DIRECT 0x8127A5 /end CHARACTERISTIC
/begin CHARACTERISTIC CMSR_DAT_UC "" VAL_BLK 0x8122C3 KwbUb 99.61 rel_ub_q0p3906 0.00 99.61 NUMBER 16 FUNCTION_LIST URCEIN IF_DATA DIM_X DIRECT 0x8122C3 /end CHARACTERISTIC
/begin CHARACTERISTIC CMVKAT "Produkt aus Masse und Wärmekapazität des Frontkats" VALUE 0x8197EF KwUb 2720. qptemp_q10p667 0.00 2720. FUNCTION_LIST BBKHZ IF_DATA DIM_X DIRECT 0x8197EF /end CHARACTERISTIC
/begin CHARACTERISTIC CNFKUPPL "Konfigurationsflag für die Auswertung des Kuplg.schalters in der LLR" VALUE 0x811C9D KwUb 255.0 dez 0.00 255.0 FUNCTION_LIST LLRBB IF_DATA DIM_X DIRECT 0x811C9D /end CHARACTERISTIC
/begin CHARACTERISTIC CNFMDVER "Codewort zur Konfiguration von MDVER" VALUE 0x81A342 KwUb 255.0 dez 0.00 255.0 FUNCTION_LIST MDVER IF_DATA DIM_X DIRECT 0x81A342 /end CHARACTERISTIC
/begin CHARACTERISTIC CNFMDWAN "Codewort für die Einberechnung von MDWAN in der LLR" VALUE 0x811DAF KwUb 255.0 dez 0.00 255.0 FUNCTION_LIST MDWAN IF_DATA DIM_X DIRECT 0x811DAF /end CHARACTERISTIC
/begin CHARACTERISTIC CNOKT "Codewort Niederoktan-Kraftstoff" VALUE 0x81A922 KwUb 255.0 dez 0.00 255.0 FUNCTION_LIST ZWGRU IF_DATA DIM_X DIRECT 0x81A922 /end CHARACTERISTIC
/begin CHARACTERISTIC CNSDEF "Codewort für Solldrehzahlumschaltung (Defaultwert)" VALUE 0x811C4D KwUb 255.0 dez 0.00 255.0 FUNCTION_LIST TKMWL KRACT OBPC_71 IF_DATA DIM_X DIRECT 0x811C4D /end CHARACTERISTIC
/begin CHARACTERISTIC CNS_AOG "oberer Grenzwert Anpassung Codewort LL-Solldrehzahl-Umsch." VALUE 0x811C4E KwUb 255.0 dez 0.00 255.0 FUNCTION_LIST TKMWL KRACT IF_DATA DIM_X DIRECT 0x811C4E /end CHARACTERISTIC
/begin CHARACTERISTIC CNS_AUG "unterer Grenzwert Anpassung Codewort LL-Solldrehzahl-Umsch." VALUE 0x811C4F KwUb 255.0 dez 0.00 255.0 FUNCTION_LIST TKMWL KRACT IF_DATA DIM_X DIRECT 0x811C4F /end CHARACTERISTIC
/begin CHARACTERISTIC CORTINC "Wert der bei Zahnkorrektur aufaddiert wird" VALUE 0x810FA9 KwUb 255.0 dez 0.00 255.0 FUNCTION_LIST DDG IF_DATA DIM_X DIRECT 0x810FA9 /end CHARACTERISTIC
/begin CHARACTERISTIC CORTINIT "Initialisierungswert für Zähler Zahnkorrektur" VALUE 0x818488 KwUb 255.0 dez 0.00 255.0 FUNCTION_LIST DDG IF_DATA DIM_X DIRECT 0x818488 /end CHARACTERISTIC
/begin CHARACTERISTIC CORTMX "Maximal zulässiger Wert für den Zahnkorrekturzähler" VALUE 0x810FAA KwUb 255.0 dez 0.00 255.0 FUNCTION_LIST DDG IF_DATA DIM_X DIRECT 0x810FAA /end CHARACTERISTIC
/begin CHARACTERISTIC CPLRA "Codewort für Umschaltung DKVS von HFM- auf P-System" VALUE 0x819549 KwUb 255.0 dez 0.00 255.0 FUNCTION_LIST DKVS IF_DATA DIM_X DIRECT 0x819549 /end CHARACTERISTIC
/begin CHARACTERISTIC CREDSTU "Codewort für Reduzierstufe ein/aus" VALUE 0x81215C KwUb 255.0 dez 0.00 255.0 FUNCTION_LIST MDRED IF_DATA DIM_X DIRECT 0x81215C /end CHARACTERISTIC
/begin CHARACTERISTIC CSAIR "Soll-Checksumme der Airbagbotschaft" VALUE 0x81016C KwUb 255.0 DEZ 0.00 255.0 FUNCTION_LIST CAN IF_DATA DIM_X DIRECT 0x81016C /end CHARACTERISTIC
/begin CHARACTERISTIC CSGRA "Checksumme für GRA-Can-Botschaft" VALUE 0x81122E KwUb 255.0 DEZ 0.00 255.0 FUNCTION_LIST GGCGRA IF_DATA DIM_X DIRECT 0x81122E /end CHARACTERISTIC
/begin CHARACTERISTIC CUKA "Codewort ÜK-Adaption" VALUE 0x811BEE KwUb 255.0 dez 0.00 255.0 FUNCTION_LIST ESUKAS IF_DATA DIM_X DIRECT 0x811BEE /end CHARACTERISTIC
/begin CHARACTERISTIC CWADRES "Codewort für Adaptionswerte löschen bei FSP löschen" VALUE 0x8181B3 KwUb 255.0 dez 0.00 255.0 FUNCTION_LIST PROKON IF_DATA DIM_X DIRECT 0x8181B3 /end CHARACTERISTIC
/begin CHARACTERISTIC CWALE "Auslauferkennung aktiv" VALUE 0x810FB3 KwUb 255.0 dez 0.00 255.0 FUNCTION_LIST ALE IF_DATA DIM_X DIRECT 0x810FB3 /end CHARACTERISTIC
/begin CHARACTERISTIC CWANWSE "Codewort Funktion ANWSE" VALUE 0x81A8FC KwUb 255.0 dez 0.00 255.0 FUNCTION_LIST ANWSE IF_DATA DIM_X DIRECT 0x81A8FC /end CHARACTERISTIC
/begin CHARACTERISTIC CWARMD "Codewort Antiruckelfunktion" VALUE 0x811EF3 KwUb 255.0 dez 0.00 255.0 FUNCTION_LIST ARMD IF_DATA DIM_X DIRECT 0x811EF3 /end CHARACTERISTIC
/begin CHARACTERISTIC CWBAESEL "Codewort für Umschaltung Bergaberkennung usw." VALUE 0x812776 KwUb 255.0 dez 0.00 255.0 FUNCTION_LIST DLDP IF_DATA DIM_X DIRECT 0x812776 /end CHARACTERISTIC
/begin CHARACTERISTIC CWBBKD "Codewort für %BBKD" VALUE 0x81105A KwUb 255.0 dez 0.00 255.0 FUNCTION_LIST BBKD IF_DATA DIM_X DIRECT 0x81105A /end CHARACTERISTIC
/begin CHARACTERISTIC CWBGMSZS "Codewort für die BGMSZS" VALUE 0x81131B KwUb 255.0 DEZ 0.00 255.0 FUNCTION_LIST BGMSZS IF_DATA DIM_X DIRECT 0x81131B /end CHARACTERISTIC
/begin CHARACTERISTIC CWBGTABST "Codewort für Abstellzeitermittlung" VALUE 0x819540 KwUb 255.0 DEZ 0.00 255.0 FUNCTION_LIST BGTABST IF_DATA DIM_X DIRECT 0x819540 /end CHARACTERISTIC
/begin CHARACTERISTIC CWBGWPFGR "Codewort für %BGWPFGR" VALUE 0x81887A KwUb 255.0 dez 0.00 255.0 FUNCTION_LIST BGWPFGR IF_DATA DIM_X DIRECT 0x81887A /end CHARACTERISTIC
/begin CHARACTERISTIC CWBKV "Codewort für Bremskraftverstärker" VALUE 0x82B1E6 KwUw 65535.00 dez 0.00 65535.00 FUNCTION_LIST BKV IF_DATA DIM_X DIRECT 0x82B1E6 /end CHARACTERISTIC
/begin CHARACTERISTIC CWBWEEN "Codewort zur Deaktivierung der Bewegungserkennung" VALUE 0x811039 KwUb 255.0 dez 0.00 255.0 FUNCTION_LIST GGPED IF_DATA DIM_X DIRECT 0x811039 /end CHARACTERISTIC
/begin CHARACTERISTIC CWCANKBI "Codewort für automatische Kombi-Botschafts-Erkennung" VALUE 0x81016D KwUb 255.0 DEZ 0.00 255.0 FUNCTION_LIST CAN TKMWL IF_DATA DIM_X DIRECT 0x81016D /end CHARACTERISTIC
/begin CHARACTERISTIC CWCDCUM "Codewort zur Umschaltung der CDC's auf den jeweiligen Markt" VALUE 0x818487 KwUb 255.0 dez 0.00 255.0 FUNCTION_LIST DCDACC IF_DATA DIM_X DIRECT 0x818487 /end CHARACTERISTIC
/begin CHARACTERISTIC CWCKBI "Codewort zum Empfang der CAN-Botschaft Kombi1" VALUE 0x81ABF8 KwUb 255.0 dez 0.00 255.0 FUNCTION_LIST KVA IF_DATA DIM_X DIRECT 0x81ABF8 /end CHARACTERISTIC
/begin CHARACTERISTIC CWCS "Codewort für Auswertung der CAN-Crash-Info" VALUE 0x81AFD6 KwUb 255.0 DEZ 0.00 255.0 FUNCTION_LIST GGCS IF_DATA DIM_X DIRECT 0x81AFD6 /end CHARACTERISTIC
/begin CHARACTERISTIC CWDALA "Codewort DMDMIL Dauerlaufzähler" VALUE 0x810D2B KwUb 255.0 dez 0.00 255.0 FUNCTION_LIST DMDMIL IF_DATA DIM_X DIRECT 0x810D2B /end CHARACTERISTIC
/begin CHARACTERISTIC CWDEZWO "Konfiguration für AU621" VALUE 0x81AC0F KwUb 255.0 dez 0.00 255.0 FUNCTION_LIST KMTR IF_DATA DIM_X DIRECT 0x81AC0F /end CHARACTERISTIC
/begin CHARACTERISTIC CWDHFM "Codewort in DHFM" VALUE 0x811317 KwUb 255.0 dez 0.00 255.0 FUNCTION_LIST DHFM IF_DATA DIM_X DIRECT 0x811317 /end CHARACTERISTIC
/begin CHARACTERISTIC CWDHLSH "Codewort in DHLSHK" VALUE 0x81849D KwUb 255.0 dez 0.00 255.0 FUNCTION_LIST DHLSHK IF_DATA DIM_X DIRECT 0x81849D /end CHARACTERISTIC
/begin CHARACTERISTIC CWDKATSP "Codewort Katalysardiagnose, funktionsintern" VALUE 0x8186D7 KwUb 255.0 dez 0.00 255.0 FUNCTION_LIST DKATSP IF_DATA DIM_X DIRECT 0x8186D7 /end CHARACTERISTIC
/begin CHARACTERISTIC CWDKNOLU "" VALUE 0x818735 KwUb 255.0 dez 0.00 255.0 FUNCTION_LIST ADVE IF_DATA DIM_X DIRECT 0x818735 /end CHARACTERISTIC
/begin CHARACTERISTIC CWDKRNT "Codewort: KR-Diagnose Integratorsteigung" VALUE 0x811C44 KwUb 255.0 dez 0.00 255.0 FUNCTION_LIST DKRNT IF_DATA DIM_X DIRECT 0x811C44 /end CHARACTERISTIC
/begin CHARACTERISTIC CWDKROF "Codewort: KR-Diagnose Resetwert" VALUE 0x811C45 KwUb 255.0 dez 0.00 255.0 FUNCTION_LIST DKRNT IF_DATA DIM_X DIRECT 0x811C45 /end CHARACTERISTIC
/begin CHARACTERISTIC CWDKRTP "Codewort: KR-Diagnose Testimpuls" VALUE 0x811C49 KwUb 255.0 dez 0.00 255.0 FUNCTION_LIST DKRTP GGKS IF_DATA DIM_X DIRECT 0x811C49 /end CHARACTERISTIC
/begin CHARACTERISTIC CWDKS1 "Codewort: Klopfsensordiagnose Sensor1" VALUE 0x819CE7 KwUb 255.0 dez 0.00 255.0 FUNCTION_LIST DKRS IF_DATA DIM_X DIRECT 0x819CE7 /end CHARACTERISTIC
/begin CHARACTERISTIC CWDKS2 "Codewort: Klopfsensordiagnose Sensor 2" VALUE 0x819CE8 KwUb 255.0 dez 0.00 255.0 FUNCTION_LIST DKRS IF_DATA DIM_X DIRECT 0x819CE8 /end CHARACTERISTIC
/begin CHARACTERISTIC CWDKS3 "Codewort: Klopfsensordiagnose Sensor 3" VALUE 0x819CE9 KwUb 255.0 dez 0.00 255.0 FUNCTION_LIST DKRS IF_DATA DIM_X DIRECT 0x819CE9 /end CHARACTERISTIC
/begin CHARACTERISTIC CWDKS4 "Codewort: Klopfsensordiagnose Sensor 4" VALUE 0x819CEA KwUb 255.0 dez 0.00 255.0 FUNCTION_LIST DKRS IF_DATA DIM_X DIRECT 0x819CEA /end CHARACTERISTIC
/begin CHARACTERISTIC CWDKVSS "Codewort für Error in DKVS sperren, wenn andere Fehler vorliegen" VALUE 0x81954A KwUb 255.0 dez 0.00 255.0 FUNCTION_LIST DKVS IF_DATA DIM_X DIRECT 0x81954A /end CHARACTERISTIC
/begin CHARACTERISTIC CWDLDP "Codewort Leckdiagnose DLDP" VALUE 0x81A78F KwUb 255.0 dez 0.00 255.0 FUNCTION_LIST DLDP IF_DATA DIM_X DIRECT 0x81A78F /end CHARACTERISTIC
/begin CHARACTERISTIC CWDLDPTE "Codewort für DLDP in System Vorhanden" VALUE 0x81A71A KwUb 255.0 dez 0.00 255.0 FUNCTION_LIST DTEV IF_DATA DIM_X DIRECT 0x81A71A /end CHARACTERISTIC
/begin CHARACTERISTIC CWDLRIKL "" VALUE 0x811156 KwUb 255.0 dez 0.00 255.0 FUNCTION_LIST ADVE IF_DATA DIM_X DIRECT 0x811156 /end CHARACTERISTIC
/begin CHARACTERISTIC CWDLSAHK "Codewort CWDLSAHK für Alterung Sonde hinter KAT" VALUE 0x81866F KwUb 255.0 dez 0.00 255.0 FUNCTION_LIST DLSAHK IF_DATA DIM_X DIRECT 0x81866F /end CHARACTERISTIC
/begin CHARACTERISTIC CWDLSU "Codewort für DLSU" VALUE 0x8181B4 KwUb 255.0 dez 0.00 255.0 FUNCTION_LIST PROKON DLSU IF_DATA DIM_X DIRECT 0x8181B4 /end CHARACTERISTIC
/begin CHARACTERISTIC CWDMDE "Codewort für EOBD-Appl. DMDMIL (Heilung ohne Fensterabd.)" VALUE 0x818456 KwUb 255.0 dez 0.00 255.0 FUNCTION_LIST DMDMIL IF_DATA DIM_X DIRECT 0x818456 /end CHARACTERISTIC
/begin CHARACTERISTIC CWDMFAB_0_A "Codewort Sw-Schalter für Änderungsbegrenzung" VALUE 0x8170AE KwUb 255.0 DEZ 0.00 255.0 FUNCTION_LIST MDFAW IF_DATA DIM_X DIRECT 0x8170AE /end CHARACTERISTIC
/begin CHARACTERISTIC CWDMFAB_1_A "Codewort Sw-Schalter für Änderungsbegrenzung" VALUE 0x8170AF KwUb 255.0 DEZ 0.00 255.0 FUNCTION_LIST MDFAW IF_DATA DIM_X DIRECT 0x8170AF /end CHARACTERISTIC
/begin CHARACTERISTIC CWDSLSA "Codewort in der Diagnose Sekundärluftsystem" VALUE 0x818362 KwUb 255.0 dez 0.00 255.0 FUNCTION_LIST DSLSLRS IF_DATA DIM_X DIRECT 0x818362 /end CHARACTERISTIC
/begin CHARACTERISTIC CWDSLSAD "Codewort in der Diagnose der Sekundärluftsteuerung für aktiv Diagnose" VALUE 0x818363 KwUb 255.0 dez 0.00 255.0 FUNCTION_LIST DSLSLRS IF_DATA DIM_X DIRECT 0x818363 /end CHARACTERISTIC
/begin CHARACTERISTIC CWDSLSY "Codewort in der Diagnose Sekundärluftsystem" VALUE 0x818364 KwUb 255.0 dez 0.00 255.0 FUNCTION_LIST DSLSLRS IF_DATA DIM_X DIRECT 0x818364 /end CHARACTERISTIC
/begin CHARACTERISTIC CWDTEAPP "Applikationscodeword für DTEV immer aktiv und Umschaltung von HFM auf P-System" VALUE 0x81A71B KwUb 255.0 dez 0.00 255.0 FUNCTION_LIST DTEV IF_DATA DIM_X DIRECT 0x81A71B /end CHARACTERISTIC
/begin CHARACTERISTIC CWDTHM "Codewort DTHM-Funktion" VALUE 0x8197CD KwUb 255.0 dez 0.00 255.0 FUNCTION_LIST DTHM IF_DATA DIM_X DIRECT 0x8197CD /end CHARACTERISTIC
/begin CHARACTERISTIC CWDVEFO "Codeword öffnende Federprüfung" VALUE 0x81113D KwUb 255.0 dez 0.00 255.0 FUNCTION_LIST BGDVE IF_DATA DIM_X DIRECT 0x81113D /end CHARACTERISTIC
/begin CHARACTERISTIC CWERFIL "Codewort zur Auswahl Filtervar. für die Ausgabe von AS.-Fehler an das Scan Tool" VALUE 0x8181B5 KwUb 255.0 dez 0.00 255.0 FUNCTION_LIST PROKON IF_DATA DIM_X DIRECT 0x8181B5 /end CHARACTERISTIC
/begin CHARACTERISTIC CWESWEZ "Codewort Freigabe Kraftstoffmehrmenge bei Wiedereinsetzen" VALUE 0x818740 KwUb 255.0 dez 0.00 255.0 FUNCTION_LIST ACIFI IF_DATA DIM_X DIRECT 0x818740 /end CHARACTERISTIC
/begin CHARACTERISTIC CWFA107 "Codewort Kurztripanforderungen Anzeigegruppe 107" VALUE 0x826A28 KwUw 65535.00 dez 0.00 65535.00 FUNCTION_LIST TKMWL IF_DATA DIM_X DIRECT 0x826A28 /end CHARACTERISTIC
/begin CHARACTERISTIC CWFA107A "Ergänzung Codewort Kurztripanforderungen Anzeigegruppe 107" VALUE 0x826A2A KwUw 65535.00 dez 0.00 65535.00 FUNCTION_LIST TKMWL IF_DATA DIM_X DIRECT 0x826A2A /end CHARACTERISTIC
/begin CHARACTERISTIC CWFA108 "Codewort Kurztripanforderungen Anzeigegruppe 108" VALUE 0x826A2C KwUw 65535.00 dez 0.00 65535.00 FUNCTION_LIST TKMWL IF_DATA DIM_X DIRECT 0x826A2C /end CHARACTERISTIC
/begin CHARACTERISTIC CWFA108A "Ergänzung Codewort Kurztripanforderungen Anzeigegruppe 108" VALUE 0x826A2E KwUw 65535.00 dez 0.00 65535.00 FUNCTION_LIST TKMWL IF_DATA DIM_X DIRECT 0x826A2E /end CHARACTERISTIC
/begin CHARACTERISTIC CWFA109 "Codewort Kurztripanforderungen Anzeigegruppe 109" VALUE 0x826A30 KwUw 65535.00 dez 0.00 65535.00 FUNCTION_LIST TKMWL IF_DATA DIM_X DIRECT 0x826A30 /end CHARACTERISTIC
/begin CHARACTERISTIC CWFA109A "Ergänzung Codewort Kurztripanforderungen Anzeigegruppe 109" VALUE 0x826A32 KwUw 65535.00 dez 0.00 65535.00 FUNCTION_LIST TKMWL IF_DATA DIM_X DIRECT 0x826A32 /end CHARACTERISTIC
/begin CHARACTERISTIC CWFA130 "Codewort Kurztripanforderungen Anzeigegruppe 130" VALUE 0x826A34 KwUw 65535.00 dez 0.00 65535.00 FUNCTION_LIST TKMWL IF_DATA DIM_X DIRECT 0x826A34 /end CHARACTERISTIC
/begin CHARACTERISTIC CWFA130A "Ergänzung Codewort Kurztripanforderungen Anzeigegruppe 130" VALUE 0x826A36 KwUw 65535.00 dez 0.00 65535.00 FUNCTION_LIST TKMWL IF_DATA DIM_X DIRECT 0x826A36 /end CHARACTERISTIC
/begin CHARACTERISTIC CWFA140 "Codewort Kurztripanforderungen Anzeigegruppe 140" VALUE 0x826A38 KwUw 65535.00 dez 0.00 65535.00 FUNCTION_LIST TKMWL IF_DATA DIM_X DIRECT 0x826A38 /end CHARACTERISTIC
/begin CHARACTERISTIC CWFA140A "Ergänzung Codewort Kurztripanforderungen Anzeigegruppe 140" VALUE 0x826A3A KwUw 65535.00 dez 0.00 65535.00 FUNCTION_LIST TKMWL IF_DATA DIM_X DIRECT 0x826A3A /end CHARACTERISTIC
/begin CHARACTERISTIC CWFA145 "Codewort Kurztripanforderungen Anzeigegruppe 145" VALUE 0x826A3C KwUw 65535.00 dez 0.00 65535.00 FUNCTION_LIST TKMWL IF_DATA DIM_X DIRECT 0x826A3C /end CHARACTERISTIC
/begin CHARACTERISTIC CWFA145A "Ergänzung Codewort Kurztripanforderungen Anzeigegruppe 145" VALUE 0x826A3E KwUw 65535.00 dez 0.00 65535.00 FUNCTION_LIST TKMWL IF_DATA DIM_X DIRECT 0x826A3E /end CHARACTERISTIC
/begin CHARACTERISTIC CWFA146 "Codewort Kurztripanforderungen Anzeigegruppe 146" VALUE 0x826A40 KwUw 65535.00 dez 0.00 65535.00 FUNCTION_LIST TKMWL IF_DATA DIM_X DIRECT 0x826A40 /end CHARACTERISTIC
/begin CHARACTERISTIC CWFA146A "Ergänzung Codewort Kurztripanforderungen Anzeigegruppe 146" VALUE 0x826A42 KwUw 65535.00 dez 0.00 65535.00 FUNCTION_LIST TKMWL IF_DATA DIM_X DIRECT 0x826A42 /end CHARACTERISTIC
/begin CHARACTERISTIC CWFA147 "Codewort Kurztripanforderungen Anzeigegruppe 147" VALUE 0x826A44 KwUw 65535.00 dez 0.00 65535.00 FUNCTION_LIST TKMWL IF_DATA DIM_X DIRECT 0x826A44 /end CHARACTERISTIC
/begin CHARACTERISTIC CWFA147A "Ergänzung Codewort Kurztripanforderungen Anzeigegruppe 147" VALUE 0x826A46 KwUw 65535.00 dez 0.00 65535.00 FUNCTION_LIST TKMWL IF_DATA DIM_X DIRECT 0x826A46 /end CHARACTERISTIC
/begin CHARACTERISTIC CWFA152 "Codewort Kurztripanforderungen Anzeigegruppe 152" VALUE 0x826A48 KwUw 65535.00 dez 0.00 65535.00 FUNCTION_LIST TKMWL IF_DATA DIM_X DIRECT 0x826A48 /end CHARACTERISTIC
/begin CHARACTERISTIC CWFA152A "Ergänzung Codewort Kurztripanforderungen Anzeigegruppe 152" VALUE 0x826A4A KwUw 65535.00 dez 0.00 65535.00 FUNCTION_LIST TKMWL IF_DATA DIM_X DIRECT 0x826A4A /end CHARACTERISTIC
/begin CHARACTERISTIC CWFA162 "Codewort Kurztripanforderungen Anzeigegruppe 162" VALUE 0x826A4C KwUw 65535.00 dez 0.00 65535.00 FUNCTION_LIST TKMWL IF_DATA DIM_X DIRECT 0x826A4C /end CHARACTERISTIC
/begin CHARACTERISTIC CWFA162A "Ergänzung Codewort Kurztripanforderungen Anzeigegruppe 162" VALUE 0x826A4E KwUw 65535.00 dez 0.00 65535.00 FUNCTION_LIST TKMWL IF_DATA DIM_X DIRECT 0x826A4E /end CHARACTERISTIC
/begin CHARACTERISTIC CWFA163 "Codewort Kurztripanforderungen Anzeigegruppe 163" VALUE 0x826A50 KwUw 65535.00 dez 0.00 65535.00 FUNCTION_LIST TKMWL IF_DATA DIM_X DIRECT 0x826A50 /end CHARACTERISTIC
/begin CHARACTERISTIC CWFA163A "Ergänzung Codewort Kurztripanforderungen Anzeigegruppe 163" VALUE 0x826A52 KwUw 65535.00 dez 0.00 65535.00 FUNCTION_LIST TKMWL IF_DATA DIM_X DIRECT 0x826A52 /end CHARACTERISTIC
/begin CHARACTERISTIC CWFA190 "Codewort Kurztripanforderungen Anzeigegruppe 190" VALUE 0x826A54 KwUw 65535.00 dez 0.00 65535.00 FUNCTION_LIST TKMWL IF_DATA DIM_X DIRECT 0x826A54 /end CHARACTERISTIC
/begin CHARACTERISTIC CWFA190A "Ergänzung Codewort Kurztripanforderungen Anzeigegruppe 190" VALUE 0x826A56 KwUw 65535.00 dez 0.00 65535.00 FUNCTION_LIST TKMWL IF_DATA DIM_X DIRECT 0x826A56 /end CHARACTERISTIC
/begin CHARACTERISTIC CWFA191 "Codewort Kurztripanforderungen Anzeigegruppe 191" VALUE 0x826A58 KwUw 65535.00 dez 0.00 65535.00 FUNCTION_LIST TKMWL IF_DATA DIM_X DIRECT 0x826A58 /end CHARACTERISTIC
/begin CHARACTERISTIC CWFA191A "Ergänzung Codewort Kurztripanforderungen Anzeigegruppe 191" VALUE 0x826A5A KwUw 65535.00 dez 0.00 65535.00 FUNCTION_LIST TKMWL IF_DATA DIM_X DIRECT 0x826A5A /end CHARACTERISTIC
/begin CHARACTERISTIC CWFA192 "Codewort Kurztripanforderungen Anzeigegruppe 192" VALUE 0x826A5C KwUw 65535.00 dez 0.00 65535.00 FUNCTION_LIST TKMWL IF_DATA DIM_X DIRECT 0x826A5C /end CHARACTERISTIC
/begin CHARACTERISTIC CWFA192A "Ergänzung Codewort Kurztripanforderungen Anzeigegruppe 192" VALUE 0x826A5E KwUw 65535.00 dez 0.00 65535.00 FUNCTION_LIST TKMWL IF_DATA DIM_X DIRECT 0x826A5E /end CHARACTERISTIC
/begin CHARACTERISTIC CWFA193 "Codewort Kurztripanforderungen Anzeigegruppe 193" VALUE 0x826A60 KwUw 65535.00 dez 0.00 65535.00 FUNCTION_LIST TKMWL IF_DATA DIM_X DIRECT 0x826A60 /end CHARACTERISTIC
/begin CHARACTERISTIC CWFA193A "Ergänzung Codewort Kurztripanforderungen Anzeigegruppe 193" VALUE 0x826A62 KwUw 65535.00 dez 0.00 65535.00 FUNCTION_LIST TKMWL IF_DATA DIM_X DIRECT 0x826A62 /end CHARACTERISTIC
/begin CHARACTERISTIC CWFA194 "Codewort Kurztripanforderungen Anzeigegruppe 194" VALUE 0x826A64 KwUw 65535.00 dez 0.00 65535.00 FUNCTION_LIST TKMWL IF_DATA DIM_X DIRECT 0x826A64 /end CHARACTERISTIC
/begin CHARACTERISTIC CWFA194A "Ergänzung Codewort Kurztripanforderungen Anzeigegruppe 194" VALUE 0x826A66 KwUw 65535.00 dez 0.00 65535.00 FUNCTION_LIST TKMWL IF_DATA DIM_X DIRECT 0x826A66 /end CHARACTERISTIC
/begin CHARACTERISTIC CWFA195 "Codewort Kurztripanforderungen Anzeigegruppe 195" VALUE 0x826A68 KwUw 65535.00 dez 0.00 65535.00 FUNCTION_LIST TKMWL IF_DATA DIM_X DIRECT 0x826A68 /end CHARACTERISTIC
/begin CHARACTERISTIC CWFA195A "Ergänzung Codewort Kurztripanforderungen Anzeigegruppe 195" VALUE 0x826A6A KwUw 65535.00 dez 0.00 65535.00 FUNCTION_LIST TKMWL IF_DATA DIM_X DIRECT 0x826A6A /end CHARACTERISTIC
/begin CHARACTERISTIC CWFA196 "Codewort Kurztripanforderungen Anzeigegruppe 196" VALUE 0x826A6C KwUw 65535.00 dez 0.00 65535.00 FUNCTION_LIST TKMWL IF_DATA DIM_X DIRECT 0x826A6C /end CHARACTERISTIC
/begin CHARACTERISTIC CWFA196A "Ergänzung Codewort Kurztripanforderungen Anzeigegruppe 196" VALUE 0x826A6E KwUw 65535.00 dez 0.00 65535.00 FUNCTION_LIST TKMWL IF_DATA DIM_X DIRECT 0x826A6E /end CHARACTERISTIC
/begin CHARACTERISTIC CWFA197 "Codewort Kurztripanforderungen Anzeigegruppe 197" VALUE 0x826A70 KwUw 65535.00 dez 0.00 65535.00 FUNCTION_LIST TKMWL IF_DATA DIM_X DIRECT 0x826A70 /end CHARACTERISTIC
/begin CHARACTERISTIC CWFA197A "Ergänzung Codewort Kurztripanforderungen Anzeigegruppe 197" VALUE 0x826A72 KwUw 65535.00 dez 0.00 65535.00 FUNCTION_LIST TKMWL IF_DATA DIM_X DIRECT 0x826A72 /end CHARACTERISTIC
/begin CHARACTERISTIC CWFA198 "Codewort Kurztripanforderungen Anzeigegruppe 198" VALUE 0x826A74 KwUw 65535.00 dez 0.00 65535.00 FUNCTION_LIST TKMWL IF_DATA DIM_X DIRECT 0x826A74 /end CHARACTERISTIC
/begin CHARACTERISTIC CWFA198A "Ergänzung Codewort Kurztripanforderungen Anzeigegruppe 198" VALUE 0x826A76 KwUw 65535.00 dez 0.00 65535.00 FUNCTION_LIST TKMWL IF_DATA DIM_X DIRECT 0x826A76 /end CHARACTERISTIC
/begin CHARACTERISTIC CWFA199 "Codewort Kurztripanforderungen Anzeigegruppe 199" VALUE 0x826A78 KwUw 65535.00 dez 0.00 65535.00 FUNCTION_LIST TKMWL IF_DATA DIM_X DIRECT 0x826A78 /end CHARACTERISTIC
/begin CHARACTERISTIC CWFA199A "Ergänzung Codewort Kurztripanforderungen Anzeigegruppe 199" VALUE 0x826A7A KwUw 65535.00 dez 0.00 65535.00 FUNCTION_LIST TKMWL IF_DATA DIM_X DIRECT 0x826A7A /end CHARACTERISTIC
/begin CHARACTERISTIC CWFA201 "Codewort Kurztripanforderung Anzeigegruppe 201" VALUE 0x826A7C KwUw 65535.00 dez 0.00 65535.00 FUNCTION_LIST TKMWL IF_DATA DIM_X DIRECT 0x826A7C /end CHARACTERISTIC
/begin CHARACTERISTIC CWFA201A "Ergänzung Codewort Kurztripanforderungen Anzeigegruppe 201" VALUE 0x826A7E KwUw 65535.00 dez 0.00 65535.00 FUNCTION_LIST TKMWL IF_DATA DIM_X DIRECT 0x826A7E /end CHARACTERISTIC
/begin CHARACTERISTIC CWFA202 "Codewort Kurztripanforderung Anzeigegruppe 202" VALUE 0x826A80 KwUw 65535.00 dez 0.00 65535.00 FUNCTION_LIST TKMWL IF_DATA DIM_X DIRECT 0x826A80 /end CHARACTERISTIC
/begin CHARACTERISTIC CWFA202A "Ergänzung Codewort Kurztripanforderungen Anzeigegruppe 202" VALUE 0x826A82 KwUw 65535.00 dez 0.00 65535.00 FUNCTION_LIST TKMWL IF_DATA DIM_X DIRECT 0x826A82 /end CHARACTERISTIC
/begin CHARACTERISTIC CWFA203 "Codewort Kurztripanforderung Anzeigegruppe 203" VALUE 0x826A84 KwUw 65535.00 dez 0.00 65535.00 FUNCTION_LIST TKMWL IF_DATA DIM_X DIRECT 0x826A84 /end CHARACTERISTIC
/begin CHARACTERISTIC CWFA203A "Ergänzung Codewort Kurztripanforderungen Anzeigegruppe 203" VALUE 0x826A86 KwUw 65535.00 dez 0.00 65535.00 FUNCTION_LIST TKMWL IF_DATA DIM_X DIRECT 0x826A86 /end CHARACTERISTIC
/begin CHARACTERISTIC CWFA204 "Codewort Kurztripanforderung Anzeigegruppe 204" VALUE 0x826A88 KwUw 65535.00 dez 0.00 65535.00 FUNCTION_LIST TKMWL IF_DATA DIM_X DIRECT 0x826A88 /end CHARACTERISTIC
/begin CHARACTERISTIC CWFA204A "Ergänzung Codewort Kurztripanforderungen Anzeigegruppe 204" VALUE 0x826A8A KwUw 65535.00 dez 0.00 65535.00 FUNCTION_LIST TKMWL IF_DATA DIM_X DIRECT 0x826A8A /end CHARACTERISTIC
/begin CHARACTERISTIC CWFA205 "Codewort Kurztripanforderung Anzeigegruppe 205" VALUE 0x826A8C KwUw 65535.00 dez 0.00 65535.00 FUNCTION_LIST TKMWL IF_DATA DIM_X DIRECT 0x826A8C /end CHARACTERISTIC
/begin CHARACTERISTIC CWFA205A "Ergänzung Codewort Kurztripanforderungen Anzeigegruppe 205" VALUE 0x826A8E KwUw 65535.00 dez 0.00 65535.00 FUNCTION_LIST TKMWL IF_DATA DIM_X DIRECT 0x826A8E /end CHARACTERISTIC
/begin CHARACTERISTIC CWFA206 "Codewort Kurztripanforderung Anzeigegruppe 206" VALUE 0x826A90 KwUw 65535.00 dez 0.00 65535.00 FUNCTION_LIST TKMWL IF_DATA DIM_X DIRECT 0x826A90 /end CHARACTERISTIC
/begin CHARACTERISTIC CWFA206A "Ergänzung Codewort Kurztripanforderungen Anzeigegruppe 206" VALUE 0x826A92 KwUw 65535.00 dez 0.00 65535.00 FUNCTION_LIST TKMWL IF_DATA DIM_X DIRECT 0x826A92 /end CHARACTERISTIC
/begin CHARACTERISTIC CWFA207 "Codewort Kurztripanforderung Anzeigegruppe 207" VALUE 0x826A94 KwUw 65535.00 dez 0.00 65535.00 FUNCTION_LIST TKMWL IF_DATA DIM_X DIRECT 0x826A94 /end CHARACTERISTIC
/begin CHARACTERISTIC CWFA207A "Ergänzung Codewort Kurztripanforderungen Anzeigegruppe 207" VALUE 0x826A96 KwUw 65535.00 dez 0.00 65535.00 FUNCTION_LIST TKMWL IF_DATA DIM_X DIRECT 0x826A96 /end CHARACTERISTIC
/begin CHARACTERISTIC CWFA208 "Codewort Kurztripanforderung Anzeigegruppe 208" VALUE 0x826A98 KwUw 65535.00 dez 0.00 65535.00 FUNCTION_LIST TKMWL IF_DATA DIM_X DIRECT 0x826A98 /end CHARACTERISTIC
/begin CHARACTERISTIC CWFA208A "Ergänzung Codewort Kurztripanforderungen Anzeigegruppe 208" VALUE 0x826A9A KwUw 65535.00 dez 0.00 65535.00 FUNCTION_LIST TKMWL IF_DATA DIM_X DIRECT 0x826A9A /end CHARACTERISTIC
/begin CHARACTERISTIC CWFA209 "Codewort Kurztripanforderung Anzeigegruppe 209" VALUE 0x826A9C KwUw 65535.00 dez 0.00 65535.00 FUNCTION_LIST TKMWL IF_DATA DIM_X DIRECT 0x826A9C /end CHARACTERISTIC
/begin CHARACTERISTIC CWFA209A "Ergänzung Codewort Kurztripanforderungen Anzeigegruppe 209" VALUE 0x826A9E KwUw 65535.00 dez 0.00 65535.00 FUNCTION_LIST TKMWL IF_DATA DIM_X DIRECT 0x826A9E /end CHARACTERISTIC
/begin CHARACTERISTIC CWFA210 "Codewort Kurztripanforderung Anzeigegruppe 210" VALUE 0x826AA0 KwUw 65535.00 dez 0.00 65535.00 FUNCTION_LIST TKMWL IF_DATA DIM_X DIRECT 0x826AA0 /end CHARACTERISTIC
/begin CHARACTERISTIC CWFA210A "Ergänzung Codewort Kurztripanforderungen Anzeigegruppe 210" VALUE 0x826AA2 KwUw 65535.00 dez 0.00 65535.00 FUNCTION_LIST TKMWL IF_DATA DIM_X DIRECT 0x826AA2 /end CHARACTERISTIC
/begin CHARACTERISTIC CWFA211 "Codewort Kurztripanforderung Anzeigegruppe 211" VALUE 0x826AA4 KwUw 65535.00 dez 0.00 65535.00 FUNCTION_LIST TKMWL IF_DATA DIM_X DIRECT 0x826AA4 /end CHARACTERISTIC
/begin CHARACTERISTIC CWFA211A "Ergänzung Codewort Kurztripanforderungen Anzeigegruppe 211" VALUE 0x826AA6 KwUw 65535.00 dez 0.00 65535.00 FUNCTION_LIST TKMWL IF_DATA DIM_X DIRECT 0x826AA6 /end CHARACTERISTIC
/begin CHARACTERISTIC CWFA212 "Codewort Kurztripanforderung Anzeigegruppe 212" VALUE 0x826AA8 KwUw 65535.00 dez 0.00 65535.00 FUNCTION_LIST TKMWL IF_DATA DIM_X DIRECT 0x826AA8 /end CHARACTERISTIC
/begin CHARACTERISTIC CWFA212A "Ergänzung Codewort Kurztripanforderungen Anzeigegruppe 212" VALUE 0x826AAA KwUw 65535.00 dez 0.00 65535.00 FUNCTION_LIST TKMWL IF_DATA DIM_X DIRECT 0x826AAA /end CHARACTERISTIC
/begin CHARACTERISTIC CWFA213 "Codewort Kurtripanforderung Anzeigegruppe 213" VALUE 0x826AAC KwUw 65535.00 dez 0.00 65535.00 FUNCTION_LIST TKMWL IF_DATA DIM_X DIRECT 0x826AAC /end CHARACTERISTIC
/begin CHARACTERISTIC CWFA213A "Ergänzung Codewort Kurztripanforderungen Anzeigegruppe 213" VALUE 0x826AAE KwUw 65535.00 dez 0.00 65535.00 FUNCTION_LIST TKMWL IF_DATA DIM_X DIRECT 0x826AAE /end CHARACTERISTIC
/begin CHARACTERISTIC CWFA214 "Codewort Kurztripanforderung Anzeigegruppe 214" VALUE 0x826AB0 KwUw 65535.00 dez 0.00 65535.00 FUNCTION_LIST TKMWL IF_DATA DIM_X DIRECT 0x826AB0 /end CHARACTERISTIC
/begin CHARACTERISTIC CWFA214A "Ergänzung Codewort Kurztripanforderungen Anzeigegruppe 214" VALUE 0x826AB2 KwUw 65535.00 dez 0.00 65535.00 FUNCTION_LIST TKMWL IF_DATA DIM_X DIRECT 0x826AB2 /end CHARACTERISTIC
/begin CHARACTERISTIC CWFA215 "Codewort Kurztripanforderung Anzeigegruppe 215" VALUE 0x826AB4 KwUw 65535.00 dez 0.00 65535.00 FUNCTION_LIST TKMWL IF_DATA DIM_X DIRECT 0x826AB4 /end CHARACTERISTIC
/begin CHARACTERISTIC CWFA215A "Ergänzung Codewort Kurztripanforderungen Anzeigegruppe 215" VALUE 0x826AB6 KwUw 65535.00 dez 0.00 65535.00 FUNCTION_LIST TKMWL IF_DATA DIM_X DIRECT 0x826AB6 /end CHARACTERISTIC
/begin CHARACTERISTIC CWFA216 "Codewort Kurztripanforderung Anzeigegruppe 216" VALUE 0x826AB8 KwUw 65535.00 dez 0.00 65535.00 FUNCTION_LIST TKMWL IF_DATA DIM_X DIRECT 0x826AB8 /end CHARACTERISTIC
/begin CHARACTERISTIC CWFA216A "Ergänzung Codewort Kurztripanforderungen Anzeigegruppe 216" VALUE 0x826ABA KwUw 65535.00 dez 0.00 65535.00 FUNCTION_LIST TKMWL IF_DATA DIM_X DIRECT 0x826ABA /end CHARACTERISTIC
/begin CHARACTERISTIC CWFA217 "Codewort Kurztripanforderung Anzeigegruppe 217" VALUE 0x826ABC KwUw 65535.00 dez 0.00 65535.00 FUNCTION_LIST TKMWL IF_DATA DIM_X DIRECT 0x826ABC /end CHARACTERISTIC
/begin CHARACTERISTIC CWFA217A "Ergänzung Codewort Kurztripanforderungen Anzeigegruppe 217" VALUE 0x826ABE KwUw 65535.00 dez 0.00 65535.00 FUNCTION_LIST TKMWL IF_DATA DIM_X DIRECT 0x826ABE /end CHARACTERISTIC
/begin CHARACTERISTIC CWFA218 "Codewort Kurztripanforderung Anzeigegruppe 218" VALUE 0x826AC0 KwUw 65535.00 dez 0.00 65535.00 FUNCTION_LIST TKMWL IF_DATA DIM_X DIRECT 0x826AC0 /end CHARACTERISTIC
/begin CHARACTERISTIC CWFA218A "Ergänzung Codewort Kurztripanforderungen Anzeigegruppe 218" VALUE 0x826AC2 KwUw 65535.00 dez 0.00 65535.00 FUNCTION_LIST TKMWL IF_DATA DIM_X DIRECT 0x826AC2 /end CHARACTERISTIC
/begin CHARACTERISTIC CWFA219 "Codewort Kurztripanforderung Anzeigegruppe 219" VALUE 0x826AC4 KwUw 65535.00 dez 0.00 65535.00 FUNCTION_LIST TKMWL IF_DATA DIM_X DIRECT 0x826AC4 /end CHARACTERISTIC
/begin CHARACTERISTIC CWFA219A "Ergänzung Codewort Kurztripanforderungen Anzeigegruppe 219" VALUE 0x826AC6 KwUw 65535.00 dez 0.00 65535.00 FUNCTION_LIST TKMWL IF_DATA DIM_X DIRECT 0x826AC6 /end CHARACTERISTIC
/begin CHARACTERISTIC CWFA220 "Codewort Kurztripanforderung Anzeigegruppe 220" VALUE 0x826AC8 KwUw 65535.00 dez 0.00 65535.00 FUNCTION_LIST TKMWL IF_DATA DIM_X DIRECT 0x826AC8 /end CHARACTERISTIC
/begin CHARACTERISTIC CWFA220A "Ergänzung Codewort Kurztripanforderung Anzeigegruppe 220A" VALUE 0x826ACA KwUw 65535.00 dez 0.00 65535.00 FUNCTION_LIST TKMWL IF_DATA DIM_X DIRECT 0x826ACA /end CHARACTERISTIC
/begin CHARACTERISTIC CWFA221 "Codewort Kurztripanforderung Anzeigegruppe 221" VALUE 0x826ACC KwUw 65535.00 dez 0.00 65535.00 FUNCTION_LIST TKMWL IF_DATA DIM_X DIRECT 0x826ACC /end CHARACTERISTIC
/begin CHARACTERISTIC CWFA221A "Ergänzung Codewort Kurztripanforderung Anzeigegruppe 2221A" VALUE 0x826ACE KwUw 65535.00 dez 0.00 65535.00 FUNCTION_LIST TKMWL IF_DATA DIM_X DIRECT 0x826ACE /end CHARACTERISTIC
/begin CHARACTERISTIC CWFA222 "Codewort Kurztripanforderung Anzeigegruppe 222" VALUE 0x826AD0 KwUw 65535.00 dez 0.00 65535.00 FUNCTION_LIST TKMWL IF_DATA DIM_X DIRECT 0x826AD0 /end CHARACTERISTIC
/begin CHARACTERISTIC CWFA222A "Ergänzung Codewort Kurztripanforderung Anzeigegruppe 222A" VALUE 0x826AD2 KwUw 65535.00 dez 0.00 65535.00 FUNCTION_LIST TKMWL IF_DATA DIM_X DIRECT 0x826AD2 /end CHARACTERISTIC
/begin CHARACTERISTIC CWFA223 "Codewort Kurztripanforderung Anzeigegruppe 223" VALUE 0x826AD4 KwUw 65535.00 dez 0.00 65535.00 FUNCTION_LIST TKMWL IF_DATA DIM_X DIRECT 0x826AD4 /end CHARACTERISTIC
/begin CHARACTERISTIC CWFA223A "Ergänzung Codewort Kurztripanforderung Anzeigegruppe 223A" VALUE 0x826AD6 KwUw 65535.00 dez 0.00 65535.00 FUNCTION_LIST TKMWL IF_DATA DIM_X DIRECT 0x826AD6 /end CHARACTERISTIC
/begin CHARACTERISTIC CWFA224 "Codewort Kurztripanforderung Anzeigegruppe 224" VALUE 0x826AD8 KwUw 65535.00 dez 0.00 65535.00 FUNCTION_LIST TKMWL IF_DATA DIM_X DIRECT 0x826AD8 /end CHARACTERISTIC
/begin CHARACTERISTIC CWFA224A "Ergänzung Codewort Kurztripanforderung Anzeigegruppe 224A" VALUE 0x826ADA KwUw 65535.00 dez 0.00 65535.00 FUNCTION_LIST TKMWL IF_DATA DIM_X DIRECT 0x826ADA /end CHARACTERISTIC
/begin CHARACTERISTIC CWFA225 "Codewort Kurztripanforderung Anzeigegruppe 225" VALUE 0x826ADC KwUw 65535.00 dez 0.00 65535.00 FUNCTION_LIST TKMWL IF_DATA DIM_X DIRECT 0x826ADC /end CHARACTERISTIC
/begin CHARACTERISTIC CWFA225A "Ergänzung Codewort Kurztripanforderung Anzeigegruppe 225A" VALUE 0x826ADE KwUw 65535.00 dez 0.00 65535.00 FUNCTION_LIST TKMWL IF_DATA DIM_X DIRECT 0x826ADE /end CHARACTERISTIC
/begin CHARACTERISTIC CWFA226 "Codewort Kurztripanforderung Anzeigegruppe 226" VALUE 0x826AE0 KwUw 65535.00 dez 0.00 65535.00 FUNCTION_LIST TKMWL IF_DATA DIM_X DIRECT 0x826AE0 /end CHARACTERISTIC
/begin CHARACTERISTIC CWFA226A "Ergänzung Codewort Kurztripanforderung Anzeigegruppe 226A" VALUE 0x826AE2 KwUw 65535.00 dez 0.00 65535.00 FUNCTION_LIST TKMWL IF_DATA DIM_X DIRECT 0x826AE2 /end CHARACTERISTIC
/begin CHARACTERISTIC CWFA227 "Codewort Kurztripanforderung Anzeigegruppe 227" VALUE 0x826AE4 KwUw 65535.00 dez 0.00 65535.00 FUNCTION_LIST TKMWL IF_DATA DIM_X DIRECT 0x826AE4 /end CHARACTERISTIC
/begin CHARACTERISTIC CWFA227A "Ergänzung Codewort Kurztripanforderung Anzeigegruppe 227A" VALUE 0x826AE6 KwUw 65535.00 dez 0.00 65535.00 FUNCTION_LIST TKMWL IF_DATA DIM_X DIRECT 0x826AE6 /end CHARACTERISTIC
/begin CHARACTERISTIC CWFA228 "Codewort Kurztripanforderung Anzeigegruppe 228" VALUE 0x826AE8 KwUw 65535.00 dez 0.00 65535.00 FUNCTION_LIST TKMWL IF_DATA DIM_X DIRECT 0x826AE8 /end CHARACTERISTIC
/begin CHARACTERISTIC CWFA228A "Ergänzung Codewort Kurztripanforderung Anzeigegruppe 228A" VALUE 0x826AEA KwUw 65535.00 dez 0.00 65535.00 FUNCTION_LIST TKMWL IF_DATA DIM_X DIRECT 0x826AEA /end CHARACTERISTIC
/begin CHARACTERISTIC CWFA229 "Codewort Kurztripanforderung Anzeigegruppe 229" VALUE 0x826AEC KwUw 65535.00 dez 0.00 65535.00 FUNCTION_LIST TKMWL IF_DATA DIM_X DIRECT 0x826AEC /end CHARACTERISTIC
/begin CHARACTERISTIC CWFA229A "Ergänzung Codewort Kurztripanforderung Anzeigegruppe 229A" VALUE 0x826AEE KwUw 65535.00 dez 0.00 65535.00 FUNCTION_LIST TKMWL IF_DATA DIM_X DIRECT 0x826AEE /end CHARACTERISTIC
/begin CHARACTERISTIC CWFA230 "Codewort Kurztripanforderung Anzeigegruppe 230" VALUE 0x826AF0 KwUw 65535.00 dez 0.00 65535.00 FUNCTION_LIST TKMWL IF_DATA DIM_X DIRECT 0x826AF0 /end CHARACTERISTIC
/begin CHARACTERISTIC CWFA230A "Ergänzung Codewort Kurztripanforderung Anzeigegruppe 230A" VALUE 0x826AF2 KwUw 65535.00 dez 0.00 65535.00 FUNCTION_LIST TKMWL IF_DATA DIM_X DIRECT 0x826AF2 /end CHARACTERISTIC
/begin CHARACTERISTIC CWFA231 "Codewort Kurztripanforderung Anzeigegruppe 231" VALUE 0x826AF4 KwUw 65535.00 dez 0.00 65535.00 FUNCTION_LIST TKMWL IF_DATA DIM_X DIRECT 0x826AF4 /end CHARACTERISTIC
/begin CHARACTERISTIC CWFA231A "Ergänzung Codewort Kurztripanforderung Anzeigegruppe 231A" VALUE 0x826AF6 KwUw 65535.00 dez 0.00 65535.00 FUNCTION_LIST TKMWL IF_DATA DIM_X DIRECT 0x826AF6 /end CHARACTERISTIC
/begin CHARACTERISTIC CWFA232 "Codewort Kurztripanforderung Anzeigegruppe 232" VALUE 0x826AF8 KwUw 65535.00 dez 0.00 65535.00 FUNCTION_LIST TKMWL IF_DATA DIM_X DIRECT 0x826AF8 /end CHARACTERISTIC
/begin CHARACTERISTIC CWFA232A "Ergänzung Codewort Kurztripanforderung Anzeigegruppe 232A" VALUE 0x826AFA KwUw 65535.00 dez 0.00 65535.00 FUNCTION_LIST TKMWL IF_DATA DIM_X DIRECT 0x826AFA /end CHARACTERISTIC
/begin CHARACTERISTIC CWFA233 "Codewort Kurztripanforderung Anzeigegruppe 233" VALUE 0x826AFC KwUw 65535.00 dez 0.00 65535.00 FUNCTION_LIST TKMWL IF_DATA DIM_X DIRECT 0x826AFC /end CHARACTERISTIC
/begin CHARACTERISTIC CWFA233A "Ergänzung Codewort Kurztripanforderung Anzeigegruppe 233A" VALUE 0x826AFE KwUw 65535.00 dez 0.00 65535.00 FUNCTION_LIST TKMWL IF_DATA DIM_X DIRECT 0x826AFE /end CHARACTERISTIC
/begin CHARACTERISTIC CWFA234 "Codewort Kurztripanforderung Anzeigegruppe 234" VALUE 0x826B00 KwUw 65535.00 dez 0.00 65535.00 FUNCTION_LIST TKMWL IF_DATA DIM_X DIRECT 0x826B00 /end CHARACTERISTIC
/begin CHARACTERISTIC CWFA234A "Ergänzung Codewort Kurztripanforderung Anzeigegruppe 234A" VALUE 0x826B02 KwUw 65535.00 dez 0.00 65535.00 FUNCTION_LIST TKMWL IF_DATA DIM_X DIRECT 0x826B02 /end CHARACTERISTIC
/begin CHARACTERISTIC CWFA235 "Codewort Kurztripanforderung Anzeigegruppe 235" VALUE 0x826B04 KwUw 65535.00 dez 0.00 65535.00 FUNCTION_LIST TKMWL IF_DATA DIM_X DIRECT 0x826B04 /end CHARACTERISTIC
/begin CHARACTERISTIC CWFA235A "Ergänzung Codewort Kurztripanforderung Anzeigegruppe 235A" VALUE 0x826B06 KwUw 65535.00 dez 0.00 65535.00 FUNCTION_LIST TKMWL IF_DATA DIM_X DIRECT 0x826B06 /end CHARACTERISTIC
/begin CHARACTERISTIC CWFA236 "Codewort Kurztripanforderung Anzeigegruppe 236" VALUE 0x826B08 KwUw 65535.00 dez 0.00 65535.00 FUNCTION_LIST TKMWL IF_DATA DIM_X DIRECT 0x826B08 /end CHARACTERISTIC
/begin CHARACTERISTIC CWFA236A "Ergänzung Codewort Kurztripanforderung Anzeigegruppe 236A" VALUE 0x826B0A KwUw 65535.00 dez 0.00 65535.00 FUNCTION_LIST TKMWL IF_DATA DIM_X DIRECT 0x826B0A /end CHARACTERISTIC
/begin CHARACTERISTIC CWFA237 "Codewort Kurztripanforderung Anzeigegruppe 237" VALUE 0x826B0C KwUw 65535.00 dez 0.00 65535.00 FUNCTION_LIST TKMWL IF_DATA DIM_X DIRECT 0x826B0C /end CHARACTERISTIC
/begin CHARACTERISTIC CWFA237A "Ergänzung Codewort Kurztripanforderung Anzeigegruppe 237A" VALUE 0x826B0E KwUw 65535.00 dez 0.00 65535.00 FUNCTION_LIST TKMWL IF_DATA DIM_X DIRECT 0x826B0E /end CHARACTERISTIC
/begin CHARACTERISTIC CWFA238 "Codewort Kurztripanforderung Anzeigegruppe 238" VALUE 0x826B10 KwUw 65535.00 dez 0.00 65535.00 FUNCTION_LIST TKMWL IF_DATA DIM_X DIRECT 0x826B10 /end CHARACTERISTIC
/begin CHARACTERISTIC CWFA238A "Ergänzung Codewort Kurztripanforderung Anzeigegruppe 238A" VALUE 0x826B12 KwUw 65535.00 dez 0.00 65535.00 FUNCTION_LIST TKMWL IF_DATA DIM_X DIRECT 0x826B12 /end CHARACTERISTIC
/begin CHARACTERISTIC CWFA239 "Codewort Kurztripanforderung Anzeigegruppe 239" VALUE 0x826B14 KwUw 65535.00 dez 0.00 65535.00 FUNCTION_LIST TKMWL IF_DATA DIM_X DIRECT 0x826B14 /end CHARACTERISTIC
/begin CHARACTERISTIC CWFA239A "Ergänzung Codewort Kurztripanforderung Anzeigegruppe 239A" VALUE 0x826B16 KwUw 65535.00 dez 0.00 65535.00 FUNCTION_LIST TKMWL IF_DATA DIM_X DIRECT 0x826B16 /end CHARACTERISTIC
/begin CHARACTERISTIC CWFA240 "Codewort Kurztripanforderung Anzeigegruppe 240" VALUE 0x826B18 KwUw 65535.00 dez 0.00 65535.00 FUNCTION_LIST TKMWL IF_DATA DIM_X DIRECT 0x826B18 /end CHARACTERISTIC
/begin CHARACTERISTIC CWFA240A "Ergänzung Codewort Kurztripanforderung Anzeigegruppe 240A" VALUE 0x826B1A KwUw 65535.00 dez 0.00 65535.00 FUNCTION_LIST TKMWL IF_DATA DIM_X DIRECT 0x826B1A /end CHARACTERISTIC
/begin CHARACTERISTIC CWFA241 "Codewort Kurztripanforderung Anzeigegruppe 241" VALUE 0x826B1C KwUw 65535.00 dez 0.00 65535.00 FUNCTION_LIST TKMWL IF_DATA DIM_X DIRECT 0x826B1C /end CHARACTERISTIC
/begin CHARACTERISTIC CWFA241A "Ergänzung Codewort Kurztripanforderung Anzeigegruppe 241A" VALUE 0x826B1E KwUw 65535.00 dez 0.00 65535.00 FUNCTION_LIST TKMWL IF_DATA DIM_X DIRECT 0x826B1E /end CHARACTERISTIC
/begin CHARACTERISTIC CWFA242 "Codewort Kurztripanforderung Anzeigegruppe 242" VALUE 0x826B20 KwUw 65535.00 dez 0.00 65535.00 FUNCTION_LIST TKMWL IF_DATA DIM_X DIRECT 0x826B20 /end CHARACTERISTIC
/begin CHARACTERISTIC CWFA242A "Ergänzung Codewort Kurztripanforderung Anzeigegruppe 242A" VALUE 0x826B22 KwUw 65535.00 dez 0.00 65535.00 FUNCTION_LIST TKMWL IF_DATA DIM_X DIRECT 0x826B22 /end CHARACTERISTIC
/begin CHARACTERISTIC CWFA243 "Codewort Kurztripanforderung Anzeigegruppe 243" VALUE 0x826B24 KwUw 65535.00 dez 0.00 65535.00 FUNCTION_LIST TKMWL IF_DATA DIM_X DIRECT 0x826B24 /end CHARACTERISTIC
/begin CHARACTERISTIC CWFA243A "Ergänzung Codewort Kurztripanforderung Anzeigegruppe 243A" VALUE 0x826B26 KwUw 65535.00 dez 0.00 65535.00 FUNCTION_LIST TKMWL IF_DATA DIM_X DIRECT 0x826B26 /end CHARACTERISTIC
/begin CHARACTERISTIC CWFA244 "Codewort Kurztripanforderung Anzeigegruppe 244" VALUE 0x826B28 KwUw 65535.00 dez 0.00 65535.00 FUNCTION_LIST TKMWL IF_DATA DIM_X DIRECT 0x826B28 /end CHARACTERISTIC
/begin CHARACTERISTIC CWFA244A "Ergänzung Codewort Kurztripanforderung Anzeigegruppe 244A" VALUE 0x826B2A KwUw 65535.00 dez 0.00 65535.00 FUNCTION_LIST TKMWL IF_DATA DIM_X DIRECT 0x826B2A /end CHARACTERISTIC
/begin CHARACTERISTIC CWFA245 "Codewort Kurztripanforderung Anzeigegruppe 245" VALUE 0x826B2C KwUw 65535.00 dez 0.00 65535.00 FUNCTION_LIST TKMWL IF_DATA DIM_X DIRECT 0x826B2C /end CHARACTERISTIC
/begin CHARACTERISTIC CWFA245A "Ergänzung Codewort Kurztripanforderung Anzeigegruppe 245A" VALUE 0x826B2E KwUw 65535.00 dez 0.00 65535.00 FUNCTION_LIST TKMWL IF_DATA DIM_X DIRECT 0x826B2E /end CHARACTERISTIC
/begin CHARACTERISTIC CWFA246 "Codewort Kurztripanforderung Anzeigegruppe 246" VALUE 0x826B30 KwUw 65535.00 dez 0.00 65535.00 FUNCTION_LIST TKMWL IF_DATA DIM_X DIRECT 0x826B30 /end CHARACTERISTIC
/begin CHARACTERISTIC CWFA246A "Ergänzung Codewort Kurztripanforderung Anzeigegruppe 246A" VALUE 0x826B32 KwUw 65535.00 dez 0.00 65535.00 FUNCTION_LIST TKMWL IF_DATA DIM_X DIRECT 0x826B32 /end CHARACTERISTIC
/begin CHARACTERISTIC CWFA247 "Codewort Kurztripanforderung Anzeigegruppe 247" VALUE 0x826B34 KwUw 65535.00 dez 0.00 65535.00 FUNCTION_LIST TKMWL IF_DATA DIM_X DIRECT 0x826B34 /end CHARACTERISTIC
/begin CHARACTERISTIC CWFA247A "Ergänzung Codewort Kurztripanforderung Anzeigegruppe 247A" VALUE 0x826B36 KwUw 65535.00 dez 0.00 65535.00 FUNCTION_LIST TKMWL IF_DATA DIM_X DIRECT 0x826B36 /end CHARACTERISTIC
/begin CHARACTERISTIC CWFA248 "Codewort Kurztripanforderung Anzeigegruppe 248" VALUE 0x826B38 KwUw 65535.00 dez 0.00 65535.00 FUNCTION_LIST TKMWL IF_DATA DIM_X DIRECT 0x826B38 /end CHARACTERISTIC
/begin CHARACTERISTIC CWFA248A "Ergänzung Codewort Kurztripanforderung Anzeigegruppe 248A" VALUE 0x826B3A KwUw 65535.00 dez 0.00 65535.00 FUNCTION_LIST TKMWL IF_DATA DIM_X DIRECT 0x826B3A /end CHARACTERISTIC
/begin CHARACTERISTIC CWFA249 "Codewort Kurztripanforderung Anzeigegruppe 249" VALUE 0x826B3C KwUw 65535.00 dez 0.00 65535.00 FUNCTION_LIST TKMWL IF_DATA DIM_X DIRECT 0x826B3C /end CHARACTERISTIC
/begin CHARACTERISTIC CWFA249A "Ergänzung Codewort Kurztripanforderung Anzeigegruppe 249A" VALUE 0x826B3E KwUw 65535.00 dez 0.00 65535.00 FUNCTION_LIST TKMWL IF_DATA DIM_X DIRECT 0x826B3E /end CHARACTERISTIC
/begin CHARACTERISTIC CWFA250 "Codewort Kurztripanforderung Anzeigegruppe 250" VALUE 0x826B40 KwUw 65535.00 dez 0.00 65535.00 FUNCTION_LIST TKMWL IF_DATA DIM_X DIRECT 0x826B40 /end CHARACTERISTIC
/begin CHARACTERISTIC CWFA250A "Ergänzung Codewort Kurztripanforderung Anzeigegruppe 250A" VALUE 0x826B42 KwUw 65535.00 dez 0.00 65535.00 FUNCTION_LIST TKMWL IF_DATA DIM_X DIRECT 0x826B42 /end CHARACTERISTIC
/begin CHARACTERISTIC CWFA251 "Codewort Kurztripanforderung Anzeigegruppe 251" VALUE 0x826B44 KwUw 65535.00 dez 0.00 65535.00 FUNCTION_LIST TKMWL IF_DATA DIM_X DIRECT 0x826B44 /end CHARACTERISTIC
/begin CHARACTERISTIC CWFA251A "Ergänzung Codewort Kurztripanforderung Anzeigegruppe 251A" VALUE 0x826B46 KwUw 65535.00 dez 0.00 65535.00 FUNCTION_LIST TKMWL IF_DATA DIM_X DIRECT 0x826B46 /end CHARACTERISTIC
/begin CHARACTERISTIC CWFA252 "Codewort Kurztripanforderung Anzeigegruppe 252" VALUE 0x826B48 KwUw 65535.00 dez 0.00 65535.00 FUNCTION_LIST TKMWL IF_DATA DIM_X DIRECT 0x826B48 /end CHARACTERISTIC
/begin CHARACTERISTIC CWFA252A "Ergänzung Codewort Kurztripanforderung Anzeigegruppe 252A" VALUE 0x826B4A KwUw 65535.00 dez 0.00 65535.00 FUNCTION_LIST TKMWL IF_DATA DIM_X DIRECT 0x826B4A /end CHARACTERISTIC
/begin CHARACTERISTIC CWFA253 "Codewort Kurztripanforderung Anzeigegruppe 253" VALUE 0x826B4C KwUw 65535.00 dez 0.00 65535.00 FUNCTION_LIST TKMWL IF_DATA DIM_X DIRECT 0x826B4C /end CHARACTERISTIC
/begin CHARACTERISTIC CWFA253A "Ergänzung Codewort Kurztripanforderung Anzeigegruppe 253A" VALUE 0x826B4E KwUw 65535.00 dez 0.00 65535.00 FUNCTION_LIST TKMWL IF_DATA DIM_X DIRECT 0x826B4E /end CHARACTERISTIC
/begin CHARACTERISTIC CWFA254 "Codewort Kurztripanforderung Anzeigegruppe 254" VALUE 0x826BD0 KwUw 65535.00 dez 0.00 65535.00 FUNCTION_LIST TKMWL IF_DATA DIM_X DIRECT 0x826BD0 /end CHARACTERISTIC
/begin CHARACTERISTIC CWFA254A "Ergänzung Codewort Kurztripanforderung Anzeigegruppe 254A" VALUE 0x826BD2 KwUw 65535.00 dez 0.00 65535.00 FUNCTION_LIST TKMWL IF_DATA DIM_X DIRECT 0x826BD2 /end CHARACTERISTIC
/begin CHARACTERISTIC CWFA255 "Codewort Kurztripanforderung Anzeigegruppe 255" VALUE 0x826BD4 KwUw 65535.00 dez 0.00 65535.00 FUNCTION_LIST TKMWL IF_DATA DIM_X DIRECT 0x826BD4 /end CHARACTERISTIC
/begin CHARACTERISTIC CWFA255A "Ergänzung Codewort Kurztripanforderung Anzeigegruppe 255A" VALUE 0x826BD6 KwUw 65535.00 dez 0.00 65535.00 FUNCTION_LIST TKMWL IF_DATA DIM_X DIRECT 0x826BD6 /end CHARACTERISTIC
/begin CHARACTERISTIC CWFA28 "Codewort Kurztripanforderungen Anzeigegruppe 28" VALUE 0x826BD8 KwUw 65535.00 dez 0.00 65535.00 FUNCTION_LIST TKMWL IF_DATA DIM_X DIRECT 0x826BD8 /end CHARACTERISTIC
/begin CHARACTERISTIC CWFA28A "Ergänzung Codewort Kurztripanforderungen Anzeigegruppe 28" VALUE 0x826BDA KwUw 65535.00 dez 0.00 65535.00 FUNCTION_LIST TKMWL IF_DATA DIM_X DIRECT 0x826BDA /end CHARACTERISTIC
/begin CHARACTERISTIC CWFA34 "Codewort Kurztripanforderungen Anzeigegruppe 34" VALUE 0x826BDC KwUw 65535.00 dez 0.00 65535.00 FUNCTION_LIST TKMWL IF_DATA DIM_X DIRECT 0x826BDC /end CHARACTERISTIC
/begin CHARACTERISTIC CWFA34A "Ergänzung Codewort Kurztripanforderungen Anzeigegruppe 34" VALUE 0x826BDE KwUw 65535.00 dez 0.00 65535.00 FUNCTION_LIST TKMWL IF_DATA DIM_X DIRECT 0x826BDE /end CHARACTERISTIC
/begin CHARACTERISTIC CWFA35A "Ergänzung Codewort Kurztripanforderungen Anzeigegruppe 35" VALUE 0x826BE6 KwUw 65535.00 dez 0.00 65535.00 FUNCTION_LIST TKMWL IF_DATA DIM_X DIRECT 0x826BE6 /end CHARACTERISTIC
/begin CHARACTERISTIC CWFA36 "Codewort Kurztripanforderungen Anzeigegruppe 36" VALUE 0x826BE8 KwUw 65535.00 dez 0.00 65535.00 FUNCTION_LIST TKMWL IF_DATA DIM_X DIRECT 0x826BE8 /end CHARACTERISTIC
/begin CHARACTERISTIC CWFA36A "Ergänzung Codewort Kurztripanforderungen Anzeigegruppe 36" VALUE 0x826BEA KwUw 65535.00 dez 0.00 65535.00 FUNCTION_LIST TKMWL IF_DATA DIM_X DIRECT 0x826BEA /end CHARACTERISTIC
/begin CHARACTERISTIC CWFA37A "Ergänzung Codewort Kurztripanforderungen Anzeigegruppe 37" VALUE 0x826BEE KwUw 65535.00 dez 0.00 65535.00 FUNCTION_LIST TKMWL IF_DATA DIM_X DIRECT 0x826BEE /end CHARACTERISTIC
/begin CHARACTERISTIC CWFA38 "Codewort Kurztripanforderungen Anzeigegruppe 38" VALUE 0x826BF0 KwUw 65535.00 dez 0.00 65535.00 FUNCTION_LIST TKMWL IF_DATA DIM_X DIRECT 0x826BF0 /end CHARACTERISTIC
/begin CHARACTERISTIC CWFA38A "Ergänzung Codewort Kurztripanforderungen Anzeigegruppe 38" VALUE 0x826BF2 KwUw 65535.00 dez 0.00 65535.00 FUNCTION_LIST TKMWL IF_DATA DIM_X DIRECT 0x826BF2 /end CHARACTERISTIC
/begin CHARACTERISTIC CWFA39 "Codewort Kurztripanforderungen Anzeigegruppe 39" VALUE 0x826BF4 KwUw 65535.00 dez 0.00 65535.00 FUNCTION_LIST TKMWL IF_DATA DIM_X DIRECT 0x826BF4 /end CHARACTERISTIC
/begin CHARACTERISTIC CWFA44A "Ergänzung Codewort Kurztripanforderungen Anzeigegruppe 44" VALUE 0x826BFE KwUw 65535.00 dez 0.00 65535.00 FUNCTION_LIST TKMWL IF_DATA DIM_X DIRECT 0x826BFE /end CHARACTERISTIC
/begin CHARACTERISTIC CWFA46A "Ergänzung Codewort Kurztripanforderungen Anzeigegruppe 46" VALUE 0x826C02 KwUw 65535.00 dez 0.00 65535.00 FUNCTION_LIST TKMWL IF_DATA DIM_X DIRECT 0x826C02 /end CHARACTERISTIC
/begin CHARACTERISTIC CWFA47A "Ergänzung Codewort Kurztripanforderungen Anzeigegruppe 47" VALUE 0x826C16 KwUw 65535.00 dez 0.00 65535.00 FUNCTION_LIST TKMWL IF_DATA DIM_X DIRECT 0x826C16 /end CHARACTERISTIC
/begin CHARACTERISTIC CWFA48 "Codewort Kurztripanforderungen Anzeigegruppe 48" VALUE 0x826C18 KwUw 65535.00 dez 0.00 65535.00 FUNCTION_LIST TKMWL IF_DATA DIM_X DIRECT 0x826C18 /end CHARACTERISTIC
/begin CHARACTERISTIC CWFA49 "Codewort Kurztripanforderungen Anzeigegruppe 49" VALUE 0x826C1C KwUw 65535.00 dez 0.00 65535.00 FUNCTION_LIST TKMWL IF_DATA DIM_X DIRECT 0x826C1C /end CHARACTERISTIC
/begin CHARACTERISTIC CWFA70 "Codewort Kurztripanforderungen Anzeigegruppe 70" VALUE 0x826C20 KwUw 65535.00 dez 0.00 65535.00 FUNCTION_LIST TKMWL IF_DATA DIM_X DIRECT 0x826C20 /end CHARACTERISTIC
/begin CHARACTERISTIC CWFA70A "Ergänzung Codewort Kurztripanforderungen Anzeigegruppe 70" VALUE 0x826C22 KwUw 65535.00 dez 0.00 65535.00 FUNCTION_LIST TKMWL IF_DATA DIM_X DIRECT 0x826C22 /end CHARACTERISTIC
/begin CHARACTERISTIC CWFA75 "Codewort Kurztripanforderungen Anzeigegruppe 75" VALUE 0x826C28 KwUw 65535.00 dez 0.00 65535.00 FUNCTION_LIST TKMWL IF_DATA DIM_X DIRECT 0x826C28 /end CHARACTERISTIC
/begin CHARACTERISTIC CWFA75A "Ergänzung Codewort Kurztripanforderungen Anzeigegruppe 75" VALUE 0x826C2A KwUw 65535.00 dez 0.00 65535.00 FUNCTION_LIST TKMWL IF_DATA DIM_X DIRECT 0x826C2A /end CHARACTERISTIC
/begin CHARACTERISTIC CWFA77 "Codewort Kurztripanforderungen Anzeigegruppe 77" VALUE 0x826C2C KwUw 65535.00 dez 0.00 65535.00 FUNCTION_LIST TKMWL IF_DATA DIM_X DIRECT 0x826C2C /end CHARACTERISTIC
/begin CHARACTERISTIC CWFA77A "Ergänzung Codewort Kurztripanforderungen Anzeigegruppe 77" VALUE 0x826C2E KwUw 65535.00 dez 0.00 65535.00 FUNCTION_LIST TKMWL IF_DATA DIM_X DIRECT 0x826C2E /end CHARACTERISTIC
/begin CHARACTERISTIC CWFA78 "Codewort Kurztripanforderungen Anzeigegruppe 78" VALUE 0x826C30 KwUw 65535.00 dez 0.00 65535.00 FUNCTION_LIST TKMWL IF_DATA DIM_X DIRECT 0x826C30 /end CHARACTERISTIC
/begin CHARACTERISTIC CWFA78A "Ergänzung Codewort Kurztripanforderungen Anzeigegruppe 78" VALUE 0x826C32 KwUw 65535.00 dez 0.00 65535.00 FUNCTION_LIST TKMWL IF_DATA DIM_X DIRECT 0x826C32 /end CHARACTERISTIC
/begin CHARACTERISTIC CWFA94 "Codewort Kurztripanforderungen Anzeigegruppe 94" VALUE 0x826C34 KwUw 65535.00 dez 0.00 65535.00 FUNCTION_LIST TKMWL IF_DATA DIM_X DIRECT 0x826C34 /end CHARACTERISTIC
/begin CHARACTERISTIC CWFA94A "Ergänzung Codewort Kurztripanforderungen Anzeigegruppe 94" VALUE 0x826C36 KwUw 65535.00 dez 0.00 65535.00 FUNCTION_LIST TKMWL IF_DATA DIM_X DIRECT 0x826C36 /end CHARACTERISTIC
/begin CHARACTERISTIC CWFA96 "Codewort Kurztripanforderungen Anzeigegruppe 96" VALUE 0x826C38 KwUw 65535.00 dez 0.00 65535.00 FUNCTION_LIST TKMWL IF_DATA DIM_X DIRECT 0x826C38 /end CHARACTERISTIC
/begin CHARACTERISTIC CWFAN "Codewort Drehzahlanforderung für Bandendetest" VALUE 0x81A22D KwUb 255.0 dez 0.00 255.0 FUNCTION_LIST LLRNFA IF_DATA DIM_X DIRECT 0x81A22D /end CHARACTERISTIC
/begin CHARACTERISTIC CWFASL "Codewort: Testereingriff Sekundärluftdiagnose" VALUE 0x8182E6 KwUb 255.0 dez 0.00 255.0 FUNCTION_LIST SLS IF_DATA DIM_X DIRECT 0x8182E6 /end CHARACTERISTIC
/begin CHARACTERISTIC CWFGRFULO "Codewort FGRFULO" VALUE 0x8187F8 KwUb 255.0 dez 0.00 255.0 FUNCTION_LIST FGRFULO IF_DATA DIM_X DIRECT 0x8187F8 /end CHARACTERISTIC
/begin CHARACTERISTIC CWFGRREGL_0_A "Codewort FGRREGL" VALUE 0x81CEA6 KwUb 255.0 dez 0.00 255.0 FUNCTION_LIST FGRREGL IF_DATA DIM_X DIRECT 0x81CEA6 /end CHARACTERISTIC
/begin CHARACTERISTIC CWFGRREGL_1_A "Codewort FGRREGL" VALUE 0x81CEA7 KwUb 255.0 dez 0.00 255.0 FUNCTION_LIST FGRREGL IF_DATA DIM_X DIRECT 0x81CEA7 /end CHARACTERISTIC
/begin CHARACTERISTIC CWFKMSDKA "Codewort für Massenstromadaption aktiv" VALUE 0x81131C KwUb 255.0 dez 0.00 255.0 FUNCTION_LIST BGMSZS IF_DATA DIM_X DIRECT 0x81131C /end CHARACTERISTIC
/begin CHARACTERISTIC CWGALSV "Codewort für zurücksetzen von Adaptionswerte bei Error E_LSV" VALUE 0x819042 KwUb 255.0 dez 0.00 255.0 FUNCTION_LIST LRA IF_DATA DIM_X DIRECT 0x819042 /end CHARACTERISTIC
/begin CHARACTERISTIC CWGANG "Codewort Gangauswahl Dauerstrichregeleinrichtung (in RKTI/RKTE)" VALUE 0x818F73 KwUb 255.0 dez 0.00 255.0 FUNCTION_LIST RKTI IF_DATA DIM_X DIRECT 0x818F73 /end CHARACTERISTIC
/begin CHARACTERISTIC CWGC_0_A "Getriebe-Codierung (CAN)" VALUE 0x813D0E KwUb 255.0 DEZ 0.00 255.0 FUNCTION_LIST CAN IF_DATA DIM_X DIRECT 0x813D0E /end CHARACTERISTIC
/begin CHARACTERISTIC CWGC_1_A "Getriebe-Codierung (CAN)" VALUE 0x813D0F KwUb 255.0 DEZ 0.00 255.0 FUNCTION_LIST CAN IF_DATA DIM_X DIRECT 0x813D0F /end CHARACTERISTIC
/begin CHARACTERISTIC CWGC_2_A "Getriebe-Codierung (CAN)" VALUE 0x813D10 KwUb 255.0 DEZ 0.00 255.0 FUNCTION_LIST CAN IF_DATA DIM_X DIRECT 0x813D10 /end CHARACTERISTIC
/begin CHARACTERISTIC CWGC_3_A "Getriebe-Codierung (CAN)" VALUE 0x813D11 KwUb 255.0 DEZ 0.00 255.0 FUNCTION_LIST CAN IF_DATA DIM_X DIRECT 0x813D11 /end CHARACTERISTIC
/begin CHARACTERISTIC CWGC_4_A "Getriebe-Codierung (CAN)" VALUE 0x813D16 KwUb 255.0 DEZ 0.00 255.0 FUNCTION_LIST CAN IF_DATA DIM_X DIRECT 0x813D16 /end CHARACTERISTIC
/begin CHARACTERISTIC CWGC_5_A "Getriebe-Codierung (CAN)" VALUE 0x813D17 KwUb 255.0 DEZ 0.00 255.0 FUNCTION_LIST CAN IF_DATA DIM_X DIRECT 0x813D17 /end CHARACTERISTIC
/begin CHARACTERISTIC CWGC_6_A "Getriebe-Codierung (CAN)" VALUE 0x813D18 KwUb 255.0 DEZ 0.00 255.0 FUNCTION_LIST CAN IF_DATA DIM_X DIRECT 0x813D18 /end CHARACTERISTIC
/begin CHARACTERISTIC CWGC_7_A "Getriebe-Codierung (CAN)" VALUE 0x813D19 KwUb 255.0 DEZ 0.00 255.0 FUNCTION_LIST CAN IF_DATA DIM_X DIRECT 0x813D19 /end CHARACTERISTIC
/begin CHARACTERISTIC CWGGEGAS "Codewort für GGEGAS" VALUE 0x811207 KwUb 255.0 dez 0.00 255.0 FUNCTION_LIST GGEGAS IF_DATA DIM_X DIRECT 0x811207 /end CHARACTERISTIC
/begin CHARACTERISTIC CWGGFGRH "Codewort  GGFGRH" VALUE 0x811038 KwUb 255.0 dez 0.00 255.0 FUNCTION_LIST GGFGRH TKMWL IF_DATA DIM_X DIRECT 0x811038 /end CHARACTERISTIC
/begin CHARACTERISTIC CWGGLSH "Codeword für Ri-Auswertung für Sonde hinter KAT" VALUE 0x81866D KwUb 255.0 dez 0.00 255.0 FUNCTION_LIST GGLSH IF_DATA DIM_X DIRECT 0x81866D /end CHARACTERISTIC
/begin CHARACTERISTIC CWGGLSU "Codewort für GGLSU" VALUE 0x811020 KwUb 255.0 dez 0.00 255.0 FUNCTION_LIST GGLSU IF_DATA DIM_X DIRECT 0x811020 /end CHARACTERISTIC
/begin CHARACTERISTIC CWGGVFZG "Codewort für %GGVFZG" VALUE 0x81102E KwUb 255.0 dez 0.00 255.0 FUNCTION_LIST GGVFZG IF_DATA DIM_X DIRECT 0x81102E /end CHARACTERISTIC
/begin CHARACTERISTIC CWGRABH "Codewort für GRA-Bedienhebel" VALUE 0x8181B6 KwUb 255.0 dez 0.00 255.0 FUNCTION_LIST PROKON TKMWL UFFGRE IF_DATA DIM_X DIRECT 0x8181B6 /end CHARACTERISTIC
/begin CHARACTERISTIC CWHLSU "Codewort Heizung LSU" VALUE 0x81A457 KwUb 255.0 dez 0.00 255.0 FUNCTION_LIST HLSU IF_DATA DIM_X DIRECT 0x81A457 /end CHARACTERISTIC
/begin CHARACTERISTIC CWKATSLK "Codewort für B_lrka aktiv" VALUE 0x8186E2 KwUb 255.0 dez 0.00 255.0 FUNCTION_LIST DKATSPEB IF_DATA DIM_X DIRECT 0x8186E2 /end CHARACTERISTIC
/begin CHARACTERISTIC CWKHZ "Codewort für Katheizsteuerung" VALUE 0x8197F0 KwUb 255.0 dez 0.00 255.0 FUNCTION_LIST BBKHZ IF_DATA DIM_X DIRECT 0x8197F0 /end CHARACTERISTIC
/begin CHARACTERISTIC CWKHZW "Codewort für spätesten Zündwinkel bei Katheizen" VALUE 0x812873 KwUb 255.0 dez 0.00 255.0 FUNCTION_LIST ZWMIN IF_DATA DIM_X DIRECT 0x812873 /end CHARACTERISTIC
/begin CHARACTERISTIC CWKMMILSCT "Ausgabe ""Km bei MIL on""  für Scan Tool abschalten (0 = keine Ausgabe in PID $21)" VALUE 0x8181B7 KwUb 255.0 dez 0.00 255.0 FUNCTION_LIST PROKON IF_DATA DIM_X DIRECT 0x8181B7 /end CHARACTERISTIC
/begin CHARACTERISTIC CWKMTR "Codewort zur Konfiguration der Kühlmitteltemperaturregelung" VALUE 0x82B05A KwUw 65535.00 dez 0.00 65535.00 FUNCTION_LIST KMTR IF_DATA DIM_X DIRECT 0x82B05A /end CHARACTERISTIC
/begin CHARACTERISTIC CWKOC "Codewort: Konfiguration der Klimakompressorsteuerung" VALUE 0x812D7D KwUb 255.0 dez 0.00 255.0 FUNCTION_LIST KOS IF_DATA DIM_X DIRECT 0x812D7D /end CHARACTERISTIC
/begin CHARACTERISTIC CWKOCAN "Konfiguration für CAN und Klimakompressor" VALUE 0x812D7E KwUb 255.0 dez 0.00 255.0 FUNCTION_LIST KOS IF_DATA DIM_X DIRECT 0x812D7E /end CHARACTERISTIC
/begin CHARACTERISTIC CWKONABG "Codewort für Konfiguration Abgasbehandlung" VALUE 0x8181B8 KwUb 255.0 dez 0.00 255.0 FUNCTION_LIST PROKON IF_DATA DIM_X DIRECT 0x8181B8 /end CHARACTERISTIC
/begin CHARACTERISTIC CWKONFLS "Beschreibung der Lambdasondenposition hinter Katalysator im Abgasstrang" VALUE 0x8181B9 KwUb 255.0 dez 0.00 255.0 FUNCTION_LIST PROKON IF_DATA DIM_X DIRECT 0x8181B9 /end CHARACTERISTIC
/begin CHARACTERISTIC CWKONFZ1_0_A "Codewort für Konfiguration Fahrzeug" VALUE 0x81B010 KwUb 255.0 dez 0.00 255.0 FUNCTION_LIST PROKON IF_DATA DIM_X DIRECT 0x81B010 /end CHARACTERISTIC
/begin CHARACTERISTIC CWKONFZ1_1_A "Codewort für Konfiguration Fahrzeug" VALUE 0x81B011 KwUb 255.0 dez 0.00 255.0 FUNCTION_LIST PROKON IF_DATA DIM_X DIRECT 0x81B011 /end CHARACTERISTIC
/begin CHARACTERISTIC CWKONFZ1_2_A "Codewort für Konfiguration Fahrzeug" VALUE 0x81B012 KwUb 255.0 dez 0.00 255.0 FUNCTION_LIST PROKON IF_DATA DIM_X DIRECT 0x81B012 /end CHARACTERISTIC
/begin CHARACTERISTIC CWKONFZ1_3_A "Codewort für Konfiguration Fahrzeug" VALUE 0x81B013 KwUb 255.0 dez 0.00 255.0 FUNCTION_LIST PROKON IF_DATA DIM_X DIRECT 0x81B013 /end CHARACTERISTIC
/begin CHARACTERISTIC CWKONFZ1_4_A "Codewort für Konfiguration Fahrzeug" VALUE 0x81B014 KwUb 255.0 dez 0.00 255.0 FUNCTION_LIST PROKON IF_DATA DIM_X DIRECT 0x81B014 /end CHARACTERISTIC
/begin CHARACTERISTIC CWKONFZ1_5_A "Codewort für Konfiguration Fahrzeug" VALUE 0x81B015 KwUb 255.0 dez 0.00 255.0 FUNCTION_LIST PROKON IF_DATA DIM_X DIRECT 0x81B015 /end CHARACTERISTIC
/begin CHARACTERISTIC CWKONFZ1_6_A "Codewort für Konfiguration Fahrzeug" VALUE 0x81B016 KwUb 255.0 dez 0.00 255.0 FUNCTION_LIST PROKON IF_DATA DIM_X DIRECT 0x81B016 /end CHARACTERISTIC
/begin CHARACTERISTIC CWKONFZ1_7_A "Codewort für Konfiguration Fahrzeug" VALUE 0x81B017 KwUb 255.0 dez 0.00 255.0 FUNCTION_LIST PROKON IF_DATA DIM_X DIRECT 0x81B017 /end CHARACTERISTIC
/begin CHARACTERISTIC CWKONGTM "Codewort für Konfiguration Größe Temperatur Motor TMOT" VALUE 0x819763 KwUb 255.0 dez 0.00 255.0 FUNCTION_LIST GGTFM IF_DATA DIM_X DIRECT 0x819763 /end CHARACTERISTIC
/begin CHARACTERISTIC CWKONGTO "Codewort für Konfiguration Größe Temperatur (Motor-)Öl" VALUE 0x81A8AC KwUb 255.0 dez 0.00 255.0 FUNCTION_LIST BGTOL IF_DATA DIM_X DIRECT 0x81A8AC /end CHARACTERISTIC
/begin CHARACTERISTIC CWKONGTU "Codewort für Konfiguration Größe Temperatur Umgebung" VALUE 0x811BED KwUb 255.0 DEZ 0.00 255.0 FUNCTION_LIST BGTUMG IF_DATA DIM_X DIRECT 0x811BED /end CHARACTERISTIC
/begin CHARACTERISTIC CWKONLS "Codewort für Konfiguration Lambda Sonden" VALUE 0x8181BA KwUb 255.0 dez 0.00 255.0 FUNCTION_LIST PROKON IF_DATA DIM_X DIRECT 0x8181BA /end CHARACTERISTIC
/begin CHARACTERISTIC CWKOR "Konfiguration zur Leistungsreduzierung des Klimakompressors" VALUE 0x812D7F KwUb 255.0 dez 0.00 255.0 FUNCTION_LIST KOS IF_DATA DIM_X DIRECT 0x812D7F /end CHARACTERISTIC
/begin CHARACTERISTIC CWKRAPP "Codewort für Applikation KR" VALUE 0x819895 KwUb 255.0 dez 0.00 255.0 FUNCTION_LIST GGKS HWDIG75 IF_DATA DIM_X DIRECT 0x819895 /end CHARACTERISTIC
/begin CHARACTERISTIC CWKRDY "Codewort für Dynamikerkennung" VALUE 0x819BB2 KwUb 255.0 dez 0.00 255.0 FUNCTION_LIST KRDY IF_DATA DIM_X DIRECT 0x819BB2 /end CHARACTERISTIC
/begin CHARACTERISTIC CWKRLZFK "Codewort: Klopferkennung wird bei geführten Zylindern nicht abgeschaltet" VALUE 0x819A9B KwUb 255.0 dez 0.00 255.0 FUNCTION_LIST KRRA IF_DATA DIM_X DIRECT 0x819A9B /end CHARACTERISTIC
/begin CHARACTERISTIC CWKRNLR "Codewort Notlauf KR bei Abfall eines von zwei KS" VALUE 0x819A9C KwUb 255.0 dez 0.00 255.0 FUNCTION_LIST KRRA IF_DATA DIM_X DIRECT 0x819A9C /end CHARACTERISTIC
/begin CHARACTERISTIC CWKRRA "Codewort für die Funktion %KRRA" VALUE 0x819A9D KwUb 255.0 dez 0.00 255.0 FUNCTION_LIST KRRA IF_DATA DIM_X DIRECT 0x819A9D /end CHARACTERISTIC
/begin CHARACTERISTIC CWKRREF "Codewort: Verhalten Referenzpegelnachführung bei Drehzahldynamik" VALUE 0x8198F8 KwUb 1.000 dez 0.00 1.000 FUNCTION_LIST KRKE IF_DATA DIM_X DIRECT 0x8198F8 /end CHARACTERISTIC
/begin CHARACTERISTIC CWKUEKD "Codewort zur Konfiguration der Stellglieddiagnose Motorkühlung" VALUE 0x81FAAC KwUw 65535.00 dez 0.00 65535.00 FUNCTION_LIST TKSTA IF_DATA DIM_X DIRECT 0x81FAAC /end CHARACTERISTIC
/begin CHARACTERISTIC CWKUPPL "Codewort für Kupplung" VALUE 0x811E4F KwUb 255.0 dez 0.00 255.0 FUNCTION_LIST LLRMR IF_DATA DIM_X DIRECT 0x811E4F /end CHARACTERISTIC
/begin CHARACTERISTIC CWLAKH "Codewort für Funktion %LAKH" VALUE 0x81987F KwUb 255.0 dez 0.00 255.0 FUNCTION_LIST LAKH IF_DATA DIM_X DIRECT 0x81987F /end CHARACTERISTIC
/begin CHARACTERISTIC CWLAMBTS "Codewort: Lambda Bauteileschutz" VALUE 0x819558 KwUb 255.0 dez 0.00 255.0 FUNCTION_LIST LAMBTS IF_DATA DIM_X DIRECT 0x819558 /end CHARACTERISTIC
/begin CHARACTERISTIC CWLAMFAW "Codeword LAMFAW" VALUE 0x819200 KwUb 255.0 dez 0.00 255.0 FUNCTION_LIST LAMFAW IF_DATA DIM_X DIRECT 0x819200 /end CHARACTERISTIC
/begin CHARACTERISTIC CWLAMKH "Codewort Lambdakoordination bei Kat-heizen" VALUE 0x81160E KwUb 255.0 dez 0.00 255.0 FUNCTION_LIST LAMKO IF_DATA DIM_X DIRECT 0x81160E /end CHARACTERISTIC
/begin CHARACTERISTIC CWLDIMX "Codewort für Applikationsverfahren KFLDIMX/KFLDIOPU" VALUE 0x819CF1 KwUb 255.0 DEZ 0.00 255.0 FUNCTION_LIST LDRPID IF_DATA DIM_X DIRECT 0x819CF1 /end CHARACTERISTIC
/begin CHARACTERISTIC CWLDRPLS "Codewort für %LDRPLS" VALUE 0x819CF0 KwUb 255.0 DEZ 0.00 255.0 FUNCTION_LIST LDRPLS IF_DATA DIM_X DIRECT 0x819CF0 /end CHARACTERISTIC
/begin CHARACTERISTIC CWLLRPA "Codewort zur Auswahl des Parametersatzes des P-Anteils" VALUE 0x81A081 KwUb 255.0 dez 0.00 255.0 FUNCTION_LIST LLRRM IF_DATA DIM_X DIRECT 0x81A081 /end CHARACTERISTIC
/begin CHARACTERISTIC CWLRMS "Codewort Magerschutz" VALUE 0x81A494 KwUb 255.0 dez 0.00 255.0 FUNCTION_LIST LRS IF_DATA DIM_X DIRECT 0x81A494 /end CHARACTERISTIC
/begin CHARACTERISTIC CWLSHA "Codewort für Lambdasonden hinter KAT Alterung in %DLSAHK" VALUE 0x8181BB KwUb 255.0 dez 0.00 255.0 FUNCTION_LIST PROKON IF_DATA DIM_X DIRECT 0x8181BB /end CHARACTERISTIC
/begin CHARACTERISTIC CWLUEKO "Codewort Lüfterkonfiguration" VALUE 0x82B05C KwUw 65535.00 dez 0.00 65535.00 FUNCTION_LIST KMTR IF_DATA DIM_X DIRECT 0x82B05C /end CHARACTERISTIC
/begin CHARACTERISTIC CWM9CVNSUP "Codewort Support der VITs $05 und $06 (CVN-Ausgabe) im Mode/Service $09" VALUE 0x810FA5 KwUb 255.0 dez 0.00 255.0 FUNCTION_LIST TC9MOD IF_DATA DIM_X DIRECT 0x810FA5 /end CHARACTERISTIC
/begin CHARACTERISTIC CWMDAPP "Codewort Applikation ohne Drehmomentfunktionen" VALUE 0x8181BC KwUb 255.0 dez 0.00 255.0 FUNCTION_LIST PROKON BBNWS IF_DATA DIM_X DIRECT 0x8181BC /end CHARACTERISTIC
/begin CHARACTERISTIC CWMDBAS "Codewort Einrechnung der ZW-Korrektur für AGR-Betrieb" VALUE 0x811F5C KwUb 255.0 dez 0.00 255.0 FUNCTION_LIST MDBAS IF_DATA DIM_X DIRECT 0x811F5C /end CHARACTERISTIC
/begin CHARACTERISTIC CWMDFAW "Codewort für %MDFAW" VALUE 0x811F2D KwUb 255.0 DEZ 0.00 255.0 FUNCTION_LIST MDFAW IF_DATA DIM_X DIRECT 0x811F2D /end CHARACTERISTIC
/begin CHARACTERISTIC CWMDKOG "Codewort MDKOG: Zündwinkelspätverstellung bei Unterdruckbegrenzung" VALUE 0x811F54 KwUb 255.0 dez 0.00 255.0 FUNCTION_LIST MDKOG IF_DATA DIM_X DIRECT 0x811F54 /end CHARACTERISTIC
/begin CHARACTERISTIC CWMDKOL "Codeword MDKOL: Momentenbegrenzung" VALUE 0x811F5A KwUb 255.0 dez 0.00 255.0 FUNCTION_LIST MDKOL IF_DATA DIM_X DIRECT 0x811F5A /end CHARACTERISTIC
/begin CHARACTERISTIC CWMDMIN "Codewort MDMIN" VALUE 0x811EF2 KwUb 255.0 dez 0.00 255.0 FUNCTION_LIST MDMIN IF_DATA DIM_X DIRECT 0x811EF2 /end CHARACTERISTIC
/begin CHARACTERISTIC CWMSRCAN "Codewort für MSR/ASR über CAN" VALUE 0x810191 KwUb 255.0 DEZ 0.00 255.0 FUNCTION_LIST GGCASR IF_DATA DIM_X DIRECT 0x810191 /end CHARACTERISTIC
/begin CHARACTERISTIC CWNLPH "Freigabe der jeweiligen Phasengebernotlauffunktion" VALUE 0x810FB7 KwUb 255.0 dez 0.00 255.0 FUNCTION_LIST NLPH IF_DATA DIM_X DIRECT 0x810FB7 /end CHARACTERISTIC
/begin CHARACTERISTIC CWNMAXMD "Codeword Drehzahlbegrenzung" VALUE 0x81214B KwUb 255.0 dez 0.00 255.0 FUNCTION_LIST NMAXMD IF_DATA DIM_X DIRECT 0x81214B /end CHARACTERISTIC
/begin CHARACTERISTIC CWNOMIL "Codewort MIL-Ansteuerung nicht aktiv" VALUE 0x818460 KwUb 255.0 dez 0.00 255.0 FUNCTION_LIST DMIL IF_DATA DIM_X DIRECT 0x818460 /end CHARACTERISTIC
/begin CHARACTERISTIC CWNOSCAT "Codewort zum Abschalten der Scan Tool Kommunikation" VALUE 0x8183CA KwUb 3.000 dez 0.00 3.000 FUNCTION_LIST TCKOMUE IF_DATA DIM_X DIRECT 0x8183CA /end CHARACTERISTIC
/begin CHARACTERISTIC CWNSTAT "Codewort zur nstat-Filterung" VALUE 0x819F37 KwUb 255.0 dez 0.00 255.0 FUNCTION_LIST LLRNS IF_DATA DIM_X DIRECT 0x819F37 /end CHARACTERISTIC
/begin CHARACTERISTIC CWNWFW "Codewort für Umschaltung der Bildung Faktor Winkel Nockenwelle" VALUE 0x81A82A KwUb 255.0 dez 0.00 255.0 FUNCTION_LIST NWFW IF_DATA DIM_X DIRECT 0x81A82A /end CHARACTERISTIC
/begin CHARACTERISTIC CWNWREF "Nockenwellenverhalten im Start" VALUE 0x810FC2 KwUb 255.0 dez 0.00 255.0 FUNCTION_LIST GGDPG NLDG IF_DATA DIM_X DIRECT 0x810FC2 /end CHARACTERISTIC
/begin CHARACTERISTIC CWNWSE "Codewort Nockenwellensteuerung Einlass" VALUE 0x81A81F KwUb 255.0 dez 0.00 255.0 FUNCTION_LIST BBNWS IF_DATA DIM_X DIRECT 0x81A81F /end CHARACTERISTIC
/begin CHARACTERISTIC CWNWSG "Codewort Nockenwellensteuerung global" VALUE 0x81A820 KwUb 255.0 dez 0.00 255.0 FUNCTION_LIST BBNWS IF_DATA DIM_X DIRECT 0x81A820 /end CHARACTERISTIC
/begin CHARACTERISTIC CWOBD "Codewort für Konfiguration OBD Zertifikationsnachweis" VALUE 0x8181BD KwUb 255.0 dez 0.00 255.0 FUNCTION_LIST PROKON TC1MOD IF_DATA DIM_X DIRECT 0x8181BD /end CHARACTERISTIC
/begin CHARACTERISTIC CWPWF "Codewort Powerfail" VALUE 0x81A532 KwUb 255.0 dez 0.00 255.0 FUNCTION_LIST STARTUF IF_DATA DIM_X DIRECT 0x81A532 /end CHARACTERISTIC
/begin CHARACTERISTIC CWREFI "Codewort: Neuinitialisierung von rkr mit REFINI bei Dynamik" VALUE 0x8198F9 KwUb 1.000 dez 0.00 1.000 FUNCTION_LIST KRKE IF_DATA DIM_X DIRECT 0x8198F9 /end CHARACTERISTIC
/begin CHARACTERISTIC CWREGDS "Codewort Dauerstrichregelung" VALUE 0x818F75 KwUb 255.0 dez 0.00 255.0 FUNCTION_LIST RKTI IF_DATA DIM_X DIRECT 0x818F75 /end CHARACTERISTIC
/begin CHARACTERISTIC CWRLAPPL "Codewort Vorgabe rlsol_w während Applikationsphase" VALUE 0x81132B KwUb 255.0 dez 0.00 255.0 FUNCTION_LIST MDFUE IF_DATA DIM_X DIRECT 0x81132B /end CHARACTERISTIC
/begin CHARACTERISTIC CWRLMX "Codeword für LDRLMX (Ladedruckregelung)" VALUE 0x819DA2 KwUb 255.0 dez 0.00 255.0 FUNCTION_LIST LDRLMX IF_DATA DIM_X DIRECT 0x819DA2 /end CHARACTERISTIC
/begin CHARACTERISTIC CWSAWE "Codewort Schubabschalten - Wiedereinsetzen" VALUE 0x811C93 KwUb 255.0 dez 0.00 255.0 FUNCTION_LIST BBSAWE IF_DATA DIM_X DIRECT 0x811C93 /end CHARACTERISTIC
/begin CHARACTERISTIC CWSCTMDE "Codewort zum abschalten bestimmter Scan Tool Modes/Services (Bit=0 ->  Mode aus)" VALUE 0x8181BE KwUb 255.0 dez 0.00 255.0 FUNCTION_LIST PROKON IF_DATA DIM_X DIRECT 0x8181BE /end CHARACTERISTIC
/begin CHARACTERISTIC CWSLS "Codewort für Sekundärluftsystem" VALUE 0x8181BF KwUb 255.0 dez 0.00 255.0 FUNCTION_LIST PROKON SLS IF_DATA DIM_X DIRECT 0x8181BF /end CHARACTERISTIC
/begin CHARACTERISTIC CWSTADAP "Codewort Startadaption" VALUE 0x811613 KwUb 255.0 dez 0.00 255.0 FUNCTION_LIST STADAP IF_DATA DIM_X DIRECT 0x811613 /end CHARACTERISTIC
/begin CHARACTERISTIC CWSTADK "" VALUE 0x8186F0 KwUb 255.0 dez 0.00 255.0 FUNCTION_LIST STADK IF_DATA DIM_X DIRECT 0x8186F0 /end CHARACTERISTIC
/begin CHARACTERISTIC CWSTAKD "Codewort zur Konfiguration der Stellglieddiagnose" VALUE 0x81FAAE KwUw 65535.00 dez 0.00 65535.00 FUNCTION_LIST TKSTA IF_DATA DIM_X DIRECT 0x81FAAE /end CHARACTERISTIC
/begin CHARACTERISTIC CWSTAKD2 "Codewort 2 zur Konfiguration der Stellglieddiagnose" VALUE 0x81FAB0 KwUw 65535.00 dez 0.00 65535.00 FUNCTION_LIST TKSTA IF_DATA DIM_X DIRECT 0x81FAB0 /end CHARACTERISTIC
/begin CHARACTERISTIC CWSTEVKD "Codewort zur Freigabe der Stellglieddiagnose Einspritzventile" VALUE 0x826A26 KwUw 65535.00 dez 0.00 65535.00 FUNCTION_LIST TKSTA IF_DATA DIM_X DIRECT 0x826A26 /end CHARACTERISTIC
/begin CHARACTERISTIC CWTAF "Codewort für Testeranpassung: Anpassung frei" VALUE 0x826C3C KwUw 65535.00 dez 0.00 65535.00 FUNCTION_LIST TKMWL KRACT IF_DATA DIM_X DIRECT 0x826C3C /end CHARACTERISTIC
/begin CHARACTERISTIC CWTAK "Codewort für Testeranpassung: Anpassung für Kundendienst" VALUE 0x826C3E KwUw 65535.00 dez 0.00 65535.00 FUNCTION_LIST TKMWL KRACT IF_DATA DIM_X DIRECT 0x826C3E /end CHARACTERISTIC
/begin CHARACTERISTIC CWTAS "Codewort für Testeranpassung: Anpassung für Entwicklung" VALUE 0x826C40 KwUw 65535.00 dez 0.00 65535.00 FUNCTION_LIST TKMWL KRACT IF_DATA DIM_X DIRECT 0x826C40 /end CHARACTERISTIC
/begin CHARACTERISTIC CWTEACFG "ausserordentliche Konfiguration der Tankentlüftung" VALUE 0x81A541 KwUb 255.0 dez 0.00 255.0 FUNCTION_LIST TEBEB IF_DATA DIM_X DIRECT 0x81A541 /end CHARACTERISTIC
/begin CHARACTERISTIC CWTEMPK "Codeword für Adressierung FWFTBRTA (tans/evtmod)" VALUE 0x8188B1 KwUb 255.0 dez 0.00 255.0 FUNCTION_LIST BGTEMPK IF_DATA DIM_X DIRECT 0x8188B1 /end CHARACTERISTIC
/begin CHARACTERISTIC CWTEZW "Codewort Zündwinkeleingriff bei TEV-Prüfung" VALUE 0x811F55 KwUb 255.0 dez 0.00 255.0 FUNCTION_LIST MDKOG IF_DATA DIM_X DIRECT 0x811F55 /end CHARACTERISTIC
/begin CHARACTERISTIC CWTF "Codewort für Konfiguration Temperaturfühler" VALUE 0x8181C0 KwUb 255.0 dez 0.00 255.0 FUNCTION_LIST PROKON IF_DATA DIM_X DIRECT 0x8181C0 /end CHARACTERISTIC
/begin CHARACTERISTIC CWTIPIN "Codewort für Tip in - Funktion" VALUE 0x819BB3 KwUb 255.0 dez 0.00 255.0 FUNCTION_LIST KRDY IF_DATA DIM_X DIRECT 0x819BB3 /end CHARACTERISTIC
/begin CHARACTERISTIC CWTIPIN_G "Codewort für Tip in - Funktion Gangspezifisch" VALUE 0x819BB4 KwUb 255.0 dez 0.00 255.0 FUNCTION_LIST KRDY IF_DATA DIM_X DIRECT 0x819BB4 /end CHARACTERISTIC
/begin CHARACTERISTIC CWUHR "Codewort für Uhr" VALUE 0x8181C1 KwUb 255.0 dez 0.00 255.0 FUNCTION_LIST PROKON IF_DATA DIM_X DIRECT 0x8181C1 /end CHARACTERISTIC
/begin CHARACTERISTIC CWUM_ZDG "" VALUE 0x8197DB KwUb 20.00 dez 0.00 20.00 FUNCTION_LIST HWDIG75 IF_DATA DIM_X DIRECT 0x8197DB /end CHARACTERISTIC
/begin CHARACTERISTIC CWVSV "Codewort für Deaktivierung VS_VERST (CWVSV = 0: VS_VERST nicht aktiv)" VALUE 0x810168 KwUb 255.0 dez 0.00 255.0 FUNCTION_LIST VS_VERST MCMESS_PROT IF_DATA DIM_X DIRECT 0x810168 /end CHARACTERISTIC
/begin CHARACTERISTIC CWVWKNWS "Code Wort: Vorlagerungswinkelkorrektur bei NWS" VALUE 0x818F78 KwUb 255.0 dez 0.00 255.0 FUNCTION_LIST ESVW IF_DATA DIM_X DIRECT 0x818F78 /end CHARACTERISTIC
/begin CHARACTERISTIC CWWDKSPE "Codewort: prädizierende DK-Sollwertentjitterung aktiv" VALUE 0x811337 KwUb 255.0 dez 0.00 255.0 FUNCTION_LIST FUEDKSA IF_DATA DIM_X DIRECT 0x811337 /end CHARACTERISTIC
/begin CHARACTERISTIC CWWL "Codewort für Warmlaufsteuerung" VALUE 0x811BC7 KwUb 255.0 dez 0.00 255.0 FUNCTION_LIST LANSWL ESSTT GK IF_DATA DIM_X DIRECT 0x811BC7 /end CHARACTERISTIC
/begin CHARACTERISTIC CWZWVMX "Codewort Zündwinkeleingriff bei VMAX-Begrenzung" VALUE 0x811F56 KwUb 255.0 dez 0.00 255.0 FUNCTION_LIST MDKOG IF_DATA DIM_X DIRECT 0x811F56 /end CHARACTERISTIC
/begin CHARACTERISTIC CW_AZUE "Konfigurationscodewort Zündausgabe" VALUE 0x810057 KwUb 255.0 DEZ 0.00 255.0 FUNCTION_LIST AZUE IF_DATA DIM_X DIRECT 0x810057 /end CHARACTERISTIC
/begin CHARACTERISTIC CW_CAN_R_0___A "Codewort für CAN-Empfangskonfiguration" VALUE 0x813CEE KwUw 65535.00 DEZ 0.00 65535.00 FUNCTION_LIST CAN GGCASR TKMWL IF_DATA DIM_X DIRECT 0x813CEE /end CHARACTERISTIC
/begin CHARACTERISTIC CW_CAN_R_1___A "Codewort für CAN-Empfangskonfiguration" VALUE 0x813CF0 KwUw 65535.00 DEZ 0.00 65535.00 FUNCTION_LIST CAN GGCASR TKMWL IF_DATA DIM_X DIRECT 0x813CF0 /end CHARACTERISTIC
/begin CHARACTERISTIC CW_CAN_R_2___A "Codewort für CAN-Empfangskonfiguration" VALUE 0x813CF2 KwUw 65535.00 DEZ 0.00 65535.00 FUNCTION_LIST CAN GGCASR TKMWL IF_DATA DIM_X DIRECT 0x813CF2 /end CHARACTERISTIC
/begin CHARACTERISTIC CW_CAN_R_3___A "Codewort für CAN-Empfangskonfiguration" VALUE 0x813CF4 KwUw 65535.00 DEZ 0.00 65535.00 FUNCTION_LIST CAN GGCASR TKMWL IF_DATA DIM_X DIRECT 0x813CF4 /end CHARACTERISTIC
/begin CHARACTERISTIC CW_CAN_R_4___A "Codewort für CAN-Empfangskonfiguration" VALUE 0x813CF6 KwUw 65535.00 DEZ 0.00 65535.00 FUNCTION_LIST CAN GGCASR TKMWL IF_DATA DIM_X DIRECT 0x813CF6 /end CHARACTERISTIC
/begin CHARACTERISTIC CW_CAN_R_5___A "Codewort für CAN-Empfangskonfiguration" VALUE 0x813CF8 KwUw 65535.00 DEZ 0.00 65535.00 FUNCTION_LIST CAN GGCASR TKMWL IF_DATA DIM_X DIRECT 0x813CF8 /end CHARACTERISTIC
/begin CHARACTERISTIC CW_CAN_R_6___A "Codewort für CAN-Empfangskonfiguration" VALUE 0x813CFA KwUw 65535.00 DEZ 0.00 65535.00 FUNCTION_LIST CAN GGCASR TKMWL IF_DATA DIM_X DIRECT 0x813CFA /end CHARACTERISTIC
/begin CHARACTERISTIC CW_CAN_R_7___A "Codewort für CAN-Empfangskonfiguration" VALUE 0x813CFC KwUw 65535.00 DEZ 0.00 65535.00 FUNCTION_LIST CAN GGCASR TKMWL IF_DATA DIM_X DIRECT 0x813CFC /end CHARACTERISTIC
/begin CHARACTERISTIC CW_CAN_S_0___A "Codewort für CAN-Sendekonfiguration" VALUE 0x813CFE KwUw 65535.00 DEZ 0.00 65535.00 FUNCTION_LIST CAN GGCGRA IF_DATA DIM_X DIRECT 0x813CFE /end CHARACTERISTIC
/begin CHARACTERISTIC CW_CAN_S_1___A "Codewort für CAN-Sendekonfiguration" VALUE 0x813D00 KwUw 65535.00 DEZ 0.00 65535.00 FUNCTION_LIST CAN GGCGRA IF_DATA DIM_X DIRECT 0x813D00 /end CHARACTERISTIC
/begin CHARACTERISTIC CW_CAN_S_2___A "Codewort für CAN-Sendekonfiguration" VALUE 0x813D02 KwUw 65535.00 DEZ 0.00 65535.00 FUNCTION_LIST CAN GGCGRA IF_DATA DIM_X DIRECT 0x813D02 /end CHARACTERISTIC
/begin CHARACTERISTIC CW_CAN_S_3___A "Codewort für CAN-Sendekonfiguration" VALUE 0x813D04 KwUw 65535.00 DEZ 0.00 65535.00 FUNCTION_LIST CAN GGCGRA IF_DATA DIM_X DIRECT 0x813D04 /end CHARACTERISTIC
/begin CHARACTERISTIC CW_CAN_S_4___A "Codewort für CAN-Sendekonfiguration" VALUE 0x813D06 KwUw 65535.00 DEZ 0.00 65535.00 FUNCTION_LIST CAN GGCGRA IF_DATA DIM_X DIRECT 0x813D06 /end CHARACTERISTIC
/begin CHARACTERISTIC CW_CAN_S_5___A "Codewort für CAN-Sendekonfiguration" VALUE 0x813D08 KwUw 65535.00 DEZ 0.00 65535.00 FUNCTION_LIST CAN GGCGRA IF_DATA DIM_X DIRECT 0x813D08 /end CHARACTERISTIC
/begin CHARACTERISTIC CW_CAN_S_6___A "Codewort für CAN-Sendekonfiguration" VALUE 0x813D0A KwUw 65535.00 DEZ 0.00 65535.00 FUNCTION_LIST CAN GGCGRA IF_DATA DIM_X DIRECT 0x813D0A /end CHARACTERISTIC
/begin CHARACTERISTIC CW_CAN_S_7___A "Codewort für CAN-Sendekonfiguration" VALUE 0x813D0C KwUw 65535.00 DEZ 0.00 65535.00 FUNCTION_LIST CAN GGCGRA IF_DATA DIM_X DIRECT 0x813D0C /end CHARACTERISTIC
/begin CHARACTERISTIC CW_FUBND "Codewort für Funkenbandzündung" VALUE 0x81AA45 KwUb 255.0 dez 0.00 255.0 FUNCTION_LIST ZUESZ IF_DATA DIM_X DIRECT 0x81AA45 /end CHARACTERISTIC
/begin CHARACTERISTIC CW_NOROMCHKRESET "" VALUE 0x81267F KwUb 255.0 dez 0.00 255.0 FUNCTION_LIST URROM IF_DATA DIM_X DIRECT 0x81267F /end CHARACTERISTIC
/begin CHARACTERISTIC CW_SWE_0__A "" VALUE 0x81BD44 KwUw 65535.00 dez 0.00 65535.00 FUNCTION_LIST DMDSTP IF_DATA DIM_X DIRECT 0x81BD44 /end CHARACTERISTIC
/begin CHARACTERISTIC CW_SWE_1__A "" VALUE 0x81BD46 KwUw 65535.00 dez 0.00 65535.00 FUNCTION_LIST DMDSTP IF_DATA DIM_X DIRECT 0x81BD46 /end CHARACTERISTIC
/begin CHARACTERISTIC CW_TABST "" VALUE 0x819764 KwUb 255.0 dez 0.00 255.0 FUNCTION_LIST GGTFM IF_DATA DIM_X DIRECT 0x819764 /end CHARACTERISTIC
/begin CHARACTERISTIC DASA "Anzahl der SAS-Phasen zur Erkennung LLS Fehler" VALUE 0x81A227 KwUb 255.0 dez 0.00 255.0 FUNCTION_LIST DLLR IF_DATA DIM_X DIRECT 0x81A227 /end CHARACTERISTIC
/begin CHARACTERISTIC DASE_CMD "Codewort DMD-Ausblendbedingungen abschalten - nur für Testzwecke !!!" VALUE 0x81071E KwUb 7.000 dez 0.00 7.000 FUNCTION_LIST DMDSTP IF_DATA DIM_X DIRECT 0x81071E /end CHARACTERISTIC
/begin CHARACTERISTIC DBGRAMX_UM "Fehlerschwelle Botschaftszähler in GRA-Botschaft" VALUE 0x814007 KwUb 255.0 dez 0.00 255.0 FUNCTION_LIST UFFGRE IF_DATA DIM_X DIRECT 0x814007 /end CHARACTERISTIC
/begin CHARACTERISTIC DBGRA_T_UM "Fehlerentprellung Botschaftszähler in GRA-Botschaft" VALUE 0x814008 KwUb 10200.0 t40ms_ub_b10200 0.00 10200.0 FUNCTION_LIST UFFGRE IF_DATA DIM_X DIRECT 0x814008 /end CHARACTERISTIC
/begin CHARACTERISTIC DBZ_AIR "obere Grenze für Botschaftszählerdifferenz" VALUE 0x812DF3 KwUb 255.0 DEZ 0.00 255.0 FUNCTION_LIST GGCS IF_DATA DIM_X DIRECT 0x812DF3 /end CHARACTERISTIC
/begin CHARACTERISTIC DBZ_GRA "oberer Grenzwert für Botschaftszählerdifferenz GRA" VALUE 0x81122F KwUb 255.0 DEZ 0.00 255.0 FUNCTION_LIST GGCGRA IF_DATA DIM_X DIRECT 0x81122F /end CHARACTERISTIC
/begin CHARACTERISTIC DBZ_MN "kleinstes zulässiges Delta des Botschaftszählers in der Funktion" VALUE 0x810192 KwUb 255.0 DEZ 0.00 255.0 FUNCTION_LIST GGCASR IF_DATA DIM_X DIRECT 0x810192 /end CHARACTERISTIC
/begin CHARACTERISTIC DBZ_MN_UC "kleinstes zulässiges Delta des Botschaftszählers f. Befehlstest" VALUE 0x8124E5 KwUb 255.0 dez 0.00 255.0 FUNCTION_LIST URCMSRC IF_DATA DIM_X DIRECT 0x8124E5 /end CHARACTERISTIC
/begin CHARACTERISTIC DBZ_MN_UM "kleinstes zulässiges Delta des Botschaftszählers" VALUE 0x814075 KwUb 255.0 dez 0.00 255.0 FUNCTION_LIST UFMSRC IF_DATA DIM_X DIRECT 0x814075 /end CHARACTERISTIC
/begin CHARACTERISTIC DBZ_MX "Größtes zulässiges Delta des Botschaftszählers in der Funktion" VALUE 0x810193 KwUb 255.0 DEZ 0.00 255.0 FUNCTION_LIST GGCASR IF_DATA DIM_X DIRECT 0x810193 /end CHARACTERISTIC
/begin CHARACTERISTIC DBZ_MX_UC "größtes zulässiges Delta des Botschaftszählers f. Befehlstest" VALUE 0x8124E6 KwUb 255.0 dez 0.00 255.0 FUNCTION_LIST URCMSRC IF_DATA DIM_X DIRECT 0x8124E6 /end CHARACTERISTIC
/begin CHARACTERISTIC DBZ_MX_UM "größtes zulässiges Delta des Botschaftszählers" VALUE 0x814076 KwUb 255.0 dez 0.00 255.0 FUNCTION_LIST UFMSRC IF_DATA DIM_X DIRECT 0x814076 /end CHARACTERISTIC
/begin CHARACTERISTIC DDFUELSAN "Schwelle für Delta Füllungssensor alpha/n-system" VALUE 0x815476 KwUw 0.9999847 fak_uw_b1 0.00 0.9999847 FUNCTION_LIST BGMSZS IF_DATA DIM_X DIRECT 0x815476 /end CHARACTERISTIC
/begin CHARACTERISTIC DDRLDKZU "Deltadifferenz zwischen rl aus Haupt- und Nebenlastsignal" VALUE 0x815478 KwSw 1535.977 rel_sw_q0p0234 -768.0000 767.9766 FUNCTION_LIST BGMSZS IF_DATA DIM_X DIRECT 0x815478 /end CHARACTERISTIC
/begin CHARACTERISTIC DDWPEDMDK "delta Pedalgradient zur Sperrung des Verlustmomentfilters beim Kriechen (CVT)" VALUE 0x829334 KwUw 50.00000 rel_uw_b100 0.00 50.00000 FUNCTION_LIST MDVER IF_DATA DIM_X DIRECT 0x829334 /end CHARACTERISTIC
/begin CHARACTERISTIC DECKSTAI "Decrement-Step für STADAP-Faktor" CURVE 0x811614 KlAUbSstUbWSb 1.000 fak_sb_b1 -1.000 0.00 FUNCTION_LIST STADAP IF_DATA DIM_X DIRECT 0x811614 /begin AXIS_DESCR STD_AXIS tmadb dez 3 0.00 255.0 DEPOSIT ABSOLUT /end AXIS_DESCR /end CHARACTERISTIC
/begin CHARACTERISTIC DELRL "Delta relative Luftfüllung für Freigabe ZW-Eingriff" VALUE 0x811F57 KwUb 5.977 rel_uw_q0p0234 0.00 5.977 FUNCTION_LIST MDKOG IF_DATA DIM_X DIRECT 0x811F57 /end CHARACTERISTIC
/begin CHARACTERISTIC DELTATA "Delta  Ansauglufttemperatur zu Starttemperatur des Motors" VALUE 0x81A790 KwSb 191.3 temp_ub_q0p75 -96.00 95.25 FUNCTION_LIST DLDP IF_DATA DIM_X DIRECT 0x81A790 /end CHARACTERISTIC
/begin CHARACTERISTIC DEVTMAGR "Offset für evtmod abhängig von tsges_w bei hoher tans verursacht d. AGR" CURVE 0x81D646 KlASwSstSwWSw 49151.25 temp_sw_q0p75 -24576.00 24575.25 FUNCTION_LIST BGTEMPK IF_DATA DIM_X DIRECT 0x81D646
 /begin AXIS_DESCR STD_AXIS tsges_w temp_sw_q0p75 8 -24576.00 24575.25 DEPOSIT ABSOLUT /end AXIS_DESCR
/end CHARACTERISTIC
/begin CHARACTERISTIC DFAFRG "Aufreglungsfaktor nach Einschalten des Füllungsreglers" VALUE 0x818973 KwUb 0.9961 fak_ub_b1 0.00 0.9961 FUNCTION_LIST FUEREG IF_DATA DIM_X DIRECT 0x818973 /end CHARACTERISTIC
/begin CHARACTERISTIC DFEMPOS "Delta Schwelle für oberen Anschlag des mult. Anteils des Füllungsabgleichs" VALUE 0x81D73E KwUw 3.999939 fak_uw_b4 0.00 3.999939 FUNCTION_LIST DEGFE IF_DATA DIM_X DIRECT 0x81D73E /end CHARACTERISTIC
/begin CHARACTERISTIC DFEMPUS "Delta Schwelle für unteren Anschlag des mult. Anteils des Füllungsabgleichs" VALUE 0x81D740 KwUw 3.999939 fak_uw_b4 0.00 3.999939 FUNCTION_LIST DEGFE IF_DATA DIM_X DIRECT 0x81D740 /end CHARACTERISTIC
/begin CHARACTERISTIC DFKMSMN "Delta FKMSDKMN zum Rücksetzen von B_fkmsmn" VALUE 0x81547A KwUw 3.999939 fak_uw_b4 0.00 3.999939 FUNCTION_LIST BGMSZS IF_DATA DIM_X DIRECT 0x81547A /end CHARACTERISTIC
/begin CHARACTERISTIC DFKMSMX "Delta FKMSDKMX zum Rücksetzen von B_fkmsmx" VALUE 0x81547C KwUw 3.999939 fak_uw_b4 0.00 3.999939 FUNCTION_LIST BGMSZS IF_DATA DIM_X DIRECT 0x81547C /end CHARACTERISTIC
/begin CHARACTERISTIC DFKPVMN "Delta FKPVDKMN zum Rücksetzen von B_fkpvmn" VALUE 0x81D4CA KwUw 3.999939 fak_uw_b4 0.00 3.999939 FUNCTION_LIST BGMSZS IF_DATA DIM_X DIRECT 0x81D4CA /end CHARACTERISTIC
/begin CHARACTERISTIC DFKPVMX "Delta FKPVDKMX zum Rücksetzen von B_fkpvmx" VALUE 0x81D4CC KwUw 3.999939 fak_uw_b4 0.00 3.999939 FUNCTION_LIST BGMSZS IF_DATA DIM_X DIRECT 0x81D4CC /end CHARACTERISTIC
/begin CHARACTERISTIC DFPSLBIT "Selektionsbits für Kennzeichnung der aktivierten Fehlerpfade" VAL_BLK 0x81C200 KwbUw 65535.00 dez 0.00 65535.00 NUMBER 16 FUNCTION_LIST D2CTR IF_DATA DIM_X DIRECT 0x81C200 /end CHARACTERISTIC
/begin CHARACTERISTIC DFRAOS "Delta Schwelle für oberen Anschlag des mult. Anteils der Gemischadaption" VALUE 0x81D742 KwUw 3.999939 fak_uw_b4 0.00 3.999939 FUNCTION_LIST DEGFE IF_DATA DIM_X DIRECT 0x81D742 /end CHARACTERISTIC
/begin CHARACTERISTIC DFRAUS "Delta Schwelle für unteren Anschlag des mult. Anteils der Gemischadaption" VALUE 0x81D744 KwUw 3.999939 fak_uw_b4 0.00 3.999939 FUNCTION_LIST DEGFE IF_DATA DIM_X DIRECT 0x81D744 /end CHARACTERISTIC
/begin CHARACTERISTIC DFRMDSLS "Deltawert zu frmx für Freigabe der Diagnose der SLS" VALUE 0x81B20C KwUw 1.999969 fak_uw_b2 0.00 1.999969 FUNCTION_LIST DSLSLRS IF_DATA DIM_X DIRECT 0x81B20C /end CHARACTERISTIC
/begin CHARACTERISTIC DFRMDTEE "Delta-frm-Schwelle für Erkennung der eingeschwungenen Gemischkorrektur" VALUE 0x829CF4 KwUw 0.03125000 fak_uw_b2 0.00 0.03125000 FUNCTION_LIST DTEV IF_DATA DIM_X DIRECT 0x829CF4 /end CHARACTERISTIC
/begin CHARACTERISTIC DFRMDTEF "Regelhubschwelle für Fettkorrektur des fr für Prüfung i.O." VALUE 0x829CF6 KwSw 0.2000122 fak_sw_b1 -0.2000122 0.00 FUNCTION_LIST DTEV IF_DATA DIM_X DIRECT 0x829CF6 /end CHARACTERISTIC
/begin CHARACTERISTIC DFRMDTEM "Regelhubschwelle für Magerkorrektur des fr für Prüfung i.O." VALUE 0x829CF8 KwSw 0.2000122 fak_sw_b1 0.00 0.2000122 FUNCTION_LIST DTEV IF_DATA DIM_X DIRECT 0x829CF8 /end CHARACTERISTIC
/begin CHARACTERISTIC DFRMOFNML "frm-Offset-Schwelle (negativ) in Abhängigkeit vom Luftmassenfluß" CURVE 0x81B20E KlAUwSstUwWSw 1.999969 fak_sw_b1 -1.000000 0.9999695 FUNCTION_LIST DSLSLRS IF_DATA DIM_X DIRECT 0x81B20E /begin AXIS_DESCR STD_AXIS ml_w m_uw_b6553p5 6 0.00 6553.500 DEPOSIT ABSOLUT /end AXIS_DESCR /end CHARACTERISTIC
/begin CHARACTERISTIC DFRMOFNXKT "frm-Offset-Schwelle (negativ): Kontrolle Vorsteuerproblem (Kurztest)" VALUE 0x81B228 KwSw 1.999969 fak_sw_b1 -1.000000 0.9999695 FUNCTION_LIST DSLSLRS IF_DATA DIM_X DIRECT 0x81B228 /end CHARACTERISTIC
/begin CHARACTERISTIC DFRMOFPML "frm-Offset-Schwelle (positiv) in Abhängigkeit vom Luftmassenfluß" CURVE 0x81B22A KlAUwSstUwWSw 1.999969 fak_sw_b1 -1.000000 0.9999695 FUNCTION_LIST DSLSLRS IF_DATA DIM_X DIRECT 0x81B22A /begin AXIS_DESCR STD_AXIS ml_w m_uw_b6553p5 6 0.00 6553.500 DEPOSIT ABSOLUT /end AXIS_DESCR /end CHARACTERISTIC
/begin CHARACTERISTIC DFRMOFPXKT "frm-Offset-Schwelle (positiv): Kontrolle Vorsteuerproblem (Kurztest)" VALUE 0x81B244 KwSw 1.999969 fak_sw_b1 -1.000000 0.9999695 FUNCTION_LIST DSLSLRS IF_DATA DIM_X DIRECT 0x81B244 /end CHARACTERISTIC
/begin CHARACTERISTIC DFRMSLS "Schwelle für Einschwingkriterium des frm bei der Aktiv-Diagnose" VALUE 0x81B246 KwUw 1.999969 fak_uw_b2 0.00 1.999969 FUNCTION_LIST DSLSLRS IF_DATA DIM_X DIRECT 0x81B246 /end CHARACTERISTIC
/begin CHARACTERISTIC DFRMST "Delta frm-schwelle für Erkennung der eingeschwungenen Grundadaption" VALUE 0x81954B KwUb 1.992 fak_ub_b2 0.00 1.992 FUNCTION_LIST DKVS IF_DATA DIM_X DIRECT 0x81954B /end CHARACTERISTIC
/begin CHARACTERISTIC DFSEFO2N "drehzahlabh. max. plausible Abweichungen der FSE-Werte" CURVE 0x8101AA GklWSb 5.603 dtsegn_b11p25divZyl -2.813 2.791 FUNCTION_LIST DMDFON IF_DATA DIM_X DIRECT 0x8101AA
 /begin AXIS_DESCR COM_AXIS nmot nmot_ub_q40 8 0.00 10200. AXIS_PTS_REF SDZ08DMUB2 /end AXIS_DESCR
/end CHARACTERISTIC
/begin CHARACTERISTIC DFSEFO3N "drehzahlabh. max. plausible Abweichungen der FSE-Werte" CURVE 0x8101B2 GklWSb 5.603 dtsegn_b11p25divZyl -2.813 2.791 FUNCTION_LIST DMDFON IF_DATA DIM_X DIRECT 0x8101B2
 /begin AXIS_DESCR COM_AXIS nmot nmot_ub_q40 8 0.00 10200. AXIS_PTS_REF SDZ08DMUB3 /end AXIS_DESCR
/end CHARACTERISTIC
/begin CHARACTERISTIC DFSEFON "drehzahlabh. max. plausible Abweichungen der FSE-Werte" CURVE 0x8101BA GklWSb 5.603 dtsegn_b11p25divZyl -2.813 2.791 FUNCTION_LIST DMDFON IF_DATA DIM_X DIRECT 0x8101BA
 /begin AXIS_DESCR COM_AXIS nmot nmot_ub_q40 8 0.00 10200. AXIS_PTS_REF SDZ08DMUB /end AXIS_DESCR
/end CHARACTERISTIC
/begin CHARACTERISTIC DFSERES "Differenz der Adaptionswerte zum Auslösen eines Reset der fuel-on/-off adaption" VALUE 0x8101C2 KwUb 5.603 dtsegn_b11p25divZyl 0.00 5.603 FUNCTION_LIST DMDFON IF_DATA DIM_X DIRECT 0x8101C2 /end CHARACTERISTIC
/begin CHARACTERISTIC DFTEAHB "Schwelle Gemischanteil Tankentlüftung zum Setzen Bit ""Hohe Beladung""" VALUE 0x81A544 KwSb 1.992 fak_sb_b1 -1.000 0.9922 FUNCTION_LIST TEB IF_DATA DIM_X DIRECT 0x81A544 /end CHARACTERISTIC
/begin CHARACTERISTIC DFTEDS "Hysteresebreite Beladung für Umschaltung auf Dauertankentlüftung" VALUE 0x81E33A KwSw 127.9980 fak_sw_b64 -64.00000 63.99805 FUNCTION_LIST BBTEGA IF_DATA DIM_X DIRECT 0x81E33A /end CHARACTERISTIC
/begin CHARACTERISTIC DIFFMAX "max. zulässige Druckänderung während 100ms" VALUE 0x8178CC KwUw 2559.961 p_uw_q0p039 0.00 2559.961 FUNCTION_LIST BGPUK IF_DATA DIM_X DIRECT 0x8178CC /end CHARACTERISTIC
/begin CHARACTERISTIC DKL1DTEV "Zusätzliche Klimaanforderung für Lüfter 1 während Tankentlüftungsdiagnose" VALUE 0x81AC10 KwUb 191.3 temp_ub_q0p75_o48 -48.00 143.3 FUNCTION_LIST KMTR IF_DATA DIM_X DIRECT 0x81AC10 /end CHARACTERISTIC
/begin CHARACTERISTIC DKL2DTEV "Zusätzliche Klimaanforderung für Lüfter 2 während Tankentlüftungsdiagnose" VALUE 0x81AC11 KwUb 191.3 temp_ub_q0p75_o48 -48.00 143.3 FUNCTION_LIST KMTR IF_DATA DIM_X DIRECT 0x81AC11 /end CHARACTERISTIC
/begin CHARACTERISTIC DKLAGERT "zulässige Fehlerzeit für DK-Soll-/Istvergleich" VALUE 0x811157 KwUb 5.100 t20msxs_ub_b5p1 0.00 5.100 FUNCTION_LIST ADVE IF_DATA DIM_X DIRECT 0x811157 /end CHARACTERISTIC
/begin CHARACTERISTIC DKLDPN "Maximaler Drosselklappenwinkel bei Leckdiagnose" CURVE 0x812777 KlAUbSstUbWUb 100.0 relDK_ub_b100 0.00 100.0 FUNCTION_LIST DLDP IF_DATA DIM_X DIRECT 0x812777 /begin AXIS_DESCR STD_AXIS nmot nmot_ub_q40 6 0.00 10200. DEPOSIT ABSOLUT /end AXIS_DESCR /end CHARACTERISTIC
/begin CHARACTERISTIC DKRAMX "Maximale Anzahl Spätverstellungen für Klopfregelanschlag" VALUE 0x81610E KwUw 65535.00 dez 0.00 65535.00 FUNCTION_LIST DKRA IF_DATA DIM_X DIRECT 0x81610E /end CHARACTERISTIC
/begin CHARACTERISTIC DKRAZ "Zündungzähler für Klopfregelanschlag" VALUE 0x816110 KwUw 65535.00 dez 0.00 65535.00 FUNCTION_LIST DKRA IF_DATA DIM_X DIRECT 0x816110 /end CHARACTERISTIC
/begin CHARACTERISTIC DKROFN "Grenzwert der Integratorsteigung für Nulltest" CURVE 0x816116 KlAUwSstUwWUw 7323.536 tknockintgrad_sy 0.00 7323.536 FUNCTION_LIST DKRNT IF_DATA DIM_X DIRECT 0x816116
 /begin AXIS_DESCR STD_AXIS tmfln_w tknockcon_sy 6 0.00 0.1747600 DEPOSIT ABSOLUT /end AXIS_DESCR
/end CHARACTERISTIC
/begin CHARACTERISTIC DKROKD "Obere Drehzahlschwelle für Nulltest-Diagnose Klopfregelung" VALUE 0x819896 KwUb 10200. nmot_ub_q40 0.00 10200. FUNCTION_LIST GGKS DKRNT IF_DATA DIM_X DIRECT 0x819896 /end CHARACTERISTIC
/begin CHARACTERISTIC DKROKMX "Maximaler Offsetkompensationswert" VALUE 0x811BFD KwUb 4.980 spg_ub_b5 0.00 4.980 FUNCTION_LIST GGKS IF_DATA DIM_X DIRECT 0x811BFD /end CHARACTERISTIC
/begin CHARACTERISTIC DKROKO "Obere Drehzahlschwelle für Ermittlung Offsetkompensationswert" VALUE 0x819897 KwUb 10200. nmot_ub_q40 0.00 10200. FUNCTION_LIST GGKS IF_DATA DIM_X DIRECT 0x819897 /end CHARACTERISTIC
/begin CHARACTERISTIC DKROKU "Untere Drehzahlschwelle für Ermittlung Offsetkompensationswert" VALUE 0x811C46 KwUb 10200. nmot_ub_q40 0.00 10200. FUNCTION_LIST DKRNT IF_DATA DIM_X DIRECT 0x811C46 /end CHARACTERISTIC
/begin CHARACTERISTIC DKTLMT "Max. Dauer tL-/wdkbl- Grenzwertüberschreitung" CURVE 0x81A791 KlAUbSstUbWUb 255.0 t1sxs_ub_b255 0.00 255.0 FUNCTION_LIST DLDP IF_DATA DIM_X DIRECT 0x81A791 /begin AXIS_DESCR STD_AXIS tfpg t1sxs_ub_b255 6 0.00 255.0 DEPOSIT ABSOLUT /end AXIS_DESCR /end CHARACTERISTIC
/begin CHARACTERISTIC DLAHINI "Initwert Integrator dlahi der stetigen LRHK" VALUE 0x81750E KwSw 1.999969 fak_sw_b1 -1.000000 0.9999695 FUNCTION_LIST LRSHK IF_DATA DIM_X DIRECT 0x81750E /end CHARACTERISTIC
/begin CHARACTERISTIC DLAHISATO "obere Grenze für dlahisa, CARB-Tester, DLSSALRS" VALUE 0x818A0C KwUb 0.09961 fak_ub_b0p1_o0p05 -0.05000 0.04961 FUNCTION_LIST DLSSA TC5MOD IF_DATA DIM_X DIRECT 0x818A0C /end CHARACTERISTIC
/begin CHARACTERISTIC DLAHISATU "untere Grenze für dlahisa, CARB-Tester, DLSSALRS" VALUE 0x818A0D KwUb 0.09961 fak_ub_b0p1_o0p05 -0.05000 0.04961 FUNCTION_LIST DLSSA TC5MOD IF_DATA DIM_X DIRECT 0x818A0D /end CHARACTERISTIC
/begin CHARACTERISTIC DLAHPPLMN "minimale DLAHP-Schwelle zum Setzen des Plausfehlers ""B""" VALUE 0x81C768 KwSw 1.999969 fak_sw_b1 -1.000000 0.9999695 FUNCTION_LIST DLSU IF_DATA DIM_X DIRECT 0x81C768 /end CHARACTERISTIC
/begin CHARACTERISTIC DLAMFAW "Schwellwert für Aktivierung Anfettung über Fahrerwunsch" VALUE 0x819201 KwUb 1.992 fak_ub_b2 0.00 1.992 FUNCTION_LIST LAMFAW IF_DATA DIM_X DIRECT 0x819201 /end CHARACTERISTIC
/begin CHARACTERISTIC DLAMNSWL "max. Abweichung für lamnswl_w=1.0" VALUE 0x811BC8 KwUb 0.9961 fak_ub_b1 0.00 0.9961 FUNCTION_LIST LANSWL IF_DATA DIM_X DIRECT 0x811BC8 /end CHARACTERISTIC
/begin CHARACTERISTIC DLAMOB "Delta Lambda bei Overboost" CURVE 0x819202 GklWUb 1.992 fak_ub_b2 0.00 1.992 FUNCTION_LIST LAMFAW IF_DATA DIM_X DIRECT 0x819202
 /begin AXIS_DESCR COM_AXIS nmot nmot_ub_q40 6 0.00 10200. AXIS_PTS_REF SNM06GKUB /end AXIS_DESCR
/end CHARACTERISTIC
/begin CHARACTERISTIC DLAMTANS "Lufttemperaturabhängige Anfettung" CURVE 0x81E372 KlAUbSstUbWSb 1.992 fak_sb_b1 -1.000 0.9922 FUNCTION_LIST LAMFAW IF_DATA DIM_X DIRECT 0x81E372
 /begin AXIS_DESCR STD_AXIS tans temp_ub_q0p75_o48 4 -48.00 143.3 DEPOSIT ABSOLUT /end AXIS_DESCR
/end CHARACTERISTIC
/begin CHARACTERISTIC DLAMXSA "max Regeldifferenz, für die nach SA die LRS gesperrt bleibt" VALUE 0x8174D4 KwUw 15.99976 fak_uw_b16 0.00 15.99976 FUNCTION_LIST LRSEB IF_DATA DIM_X DIRECT 0x8174D4 /end CHARACTERISTIC
/begin CHARACTERISTIC DLBTSF "Delta Lambdasoll für Bauteileschutz (gefiltert)" VALUE 0x81E4EC KwUw 15.99976 fak_q0p000244 0.00 15.99976 FUNCTION_LIST LAMBTS IF_DATA DIM_X DIRECT 0x81E4EC /end CHARACTERISTIC
/begin CHARACTERISTIC DLRHAFTMN "min. notwendiger I-Anteil im Haftreibunsfall" VALUE 0x81C7D8 KwSw 100.0000 rel_q0p1957 -100.0000 0.00 FUNCTION_LIST ADVE IF_DATA DIM_X DIRECT 0x81C7D8 /end CHARACTERISTIC
/begin CHARACTERISTIC DLRHAFTST "max. Sollwertgradient zur Aktivierung der Haftreibunsroutine" VALUE 0x81C7DA KwSw 99.99847 relDK_q0p00152 -50.00000 49.99847 FUNCTION_LIST ADVE IF_DATA DIM_X DIRECT 0x81C7DA /end CHARACTERISTIC
/begin CHARACTERISTIC DLRIKLPAR "DLR, I-Klein Parameter" VALUE 0x811158 KwUb 15.94 relDK_q0p0625 0.00 15.94 FUNCTION_LIST ADVE IF_DATA DIM_X DIRECT 0x811158 /end CHARACTERISTIC
/begin CHARACTERISTIC DLRKDONLP0 "DLR, D-Parameter über NLP" VALUE 0x811159 KwUb 1020. relDK_q4 0.00 1020. FUNCTION_LIST ADVE IF_DATA DIM_X DIRECT 0x811159 /end CHARACTERISTIC
/begin CHARACTERISTIC DLRKDUNLP1 "DLR, D-Parameter unter NLP (mittel)" VALUE 0x81115B KwUb 1020. relDK_q4 0.00 1020. FUNCTION_LIST ADVE IF_DATA DIM_X DIRECT 0x81115B /end CHARACTERISTIC
/begin CHARACTERISTIC DLRKDUNLP2 "DLR, D-Parameter unter NLP (stark)" VALUE 0x81115C KwUb 1020. relDK_q4 0.00 1020. FUNCTION_LIST ADVE IF_DATA DIM_X DIRECT 0x81115C /end CHARACTERISTIC
/begin CHARACTERISTIC DLRKDUNLP3 "DLR, D-Parameter unter NLP (unverstärktes Poti)" VALUE 0x81115D KwUb 1020. relDK_q4 0.00 1020. FUNCTION_LIST ADVE IF_DATA DIM_X DIRECT 0x81115D /end CHARACTERISTIC
/begin CHARACTERISTIC DLRKIONLP0 "I-Anteil als f(abs(dwdkdlr_w)), über NLP" VAL_BLK 0x81115E KwbUb 15.94 relDK_q0p0625 0.00 15.94 NUMBER 32 FUNCTION_LIST ADVE IF_DATA DIM_X DIRECT 0x81115E /end CHARACTERISTIC
/begin CHARACTERISTIC DLRKIUNLP0 "I-Anteil als f(abs(dwdkdlr_w)), unter NLP (schwach)" VAL_BLK 0x81117E KwbUb 15.94 relDK_q0p0625 0.00 15.94 NUMBER 32 FUNCTION_LIST ADVE IF_DATA DIM_X DIRECT 0x81117E /end CHARACTERISTIC
/begin CHARACTERISTIC DLRKIUNLP1 "I-Anteil als f(abs(dwdkdlr_w)), unter NLP (mittel)" VAL_BLK 0x81119E KwbUb 15.94 relDK_q0p0625 0.00 15.94 NUMBER 32 FUNCTION_LIST ADVE IF_DATA DIM_X DIRECT 0x81119E /end CHARACTERISTIC
/begin CHARACTERISTIC DLRKIUNLP2 "I-Anteil als f(abs(dwdkdlr_w)), unter NLP (stark)" VAL_BLK 0x8111BE KwbUb 15.94 relDK_q0p0625 0.00 15.94 NUMBER 32 FUNCTION_LIST ADVE IF_DATA DIM_X DIRECT 0x8111BE /end CHARACTERISTIC
/begin CHARACTERISTIC DLRKIUNLP3 "I-Anteil als f(abs(dwdkdlr_w)), unter NLP (stark)" VAL_BLK 0x8111DE KwbUb 15.94 relDK_q0p0625 0.00 15.94 NUMBER 32 FUNCTION_LIST ADVE IF_DATA DIM_X DIRECT 0x8111DE /end CHARACTERISTIC
/begin CHARACTERISTIC DLRKPONLP0 "DLR, P-Parameter über NLP" VALUE 0x8111FE KwUb 255.0 relDK_q1 0.00 255.0 FUNCTION_LIST ADVE IF_DATA DIM_X DIRECT 0x8111FE /end CHARACTERISTIC
/begin CHARACTERISTIC DLRKPUNLP0 "DLR, P-Parameter unter NLP (schwach)" VALUE 0x8111FF KwUb 255.0 relDK_q1 0.00 255.0 FUNCTION_LIST ADVE IF_DATA DIM_X DIRECT 0x8111FF /end CHARACTERISTIC
/begin CHARACTERISTIC DLRKPUNLP1 "DLR, P-Parameter unter NLP (mittel)" VALUE 0x811200 KwUb 255.0 relDK_q1 0.00 255.0 FUNCTION_LIST ADVE IF_DATA DIM_X DIRECT 0x811200 /end CHARACTERISTIC
/begin CHARACTERISTIC DLRKPUNLP2 "DLR, P-Parameter unter NLP (stark)" VALUE 0x811201 KwUb 255.0 relDK_q1 0.00 255.0 FUNCTION_LIST ADVE IF_DATA DIM_X DIRECT 0x811201 /end CHARACTERISTIC
/begin CHARACTERISTIC DLRKREIS "DLR, Faktor Kreisverstärkung" VALUE 0x818736 KwUb 1.992 fak_ub_b2 0.00 1.992 FUNCTION_LIST ADVE IF_DATA DIM_X DIRECT 0x818736 /end CHARACTERISTIC
/begin CHARACTERISTIC DLRKREISST "DLR, Faktor Kreisverstärkung zur Zeit des Motorstarts" VALUE 0x818737 KwUb 1.992 fak_ub_b2 0.00 1.992 FUNCTION_LIST ADVE IF_DATA DIM_X DIRECT 0x818737 /end CHARACTERISTIC
/begin CHARACTERISTIC DLRUBSOLL "DLR, Batterie Normalspannung" VALUE 0x818738 KwUb 17.95 spg_ubatt 0.00 17.95 FUNCTION_LIST ADVE IF_DATA DIM_X DIRECT 0x818738 /end CHARACTERISTIC
/begin CHARACTERISTIC DLUL "Delta-Last für Überladeschutz-Reset" VALUE 0x819E4D KwSb 250.0 p_sb_q10 0.00 250.0 FUNCTION_LIST DLDR IF_DATA DIM_X DIRECT 0x819E4D /end CHARACTERISTIC
/begin CHARACTERISTIC DLURMIN_0_A "Drehzahlabh. Laufunruhe-Referenz-Minimalwert 1" CURVE 0x8104C0 GklWSb 172.5 luquant -86.57 85.89 FUNCTION_LIST DMDDLU IF_DATA DIM_X INDIRECT 0x8173BC
 /begin AXIS_DESCR COM_AXIS nmot nmot_ub_q40 8 0.00 10200. AXIS_PTS_REF SNM08DMUB /end AXIS_DESCR
/end CHARACTERISTIC
/begin CHARACTERISTIC DLURMIN_1_A "Drehzahlabh. Laufunruhe-Referenz-Minimalwert 1" CURVE 0x8104D0 GklWSb 172.5 luquant -86.57 85.89 FUNCTION_LIST DMDDLU IF_DATA DIM_X INDIRECT 0x8173BE
 /begin AXIS_DESCR COM_AXIS nmot nmot_ub_q40 8 0.00 10200. AXIS_PTS_REF SNM08DMUB /end AXIS_DESCR
/end CHARACTERISTIC
/begin CHARACTERISTIC DMADFK "Maximal adaptierbares Delta-Verlustmoment pro Adaptionsphase Fahrst.+Kompr." VALUE 0x81A0B8 KwUb 24.90 rel_ub_b24p9 0.00 24.90 FUNCTION_LIST MDVERAD IF_DATA DIM_X DIRECT 0x81A0B8 /end CHARACTERISTIC
/begin CHARACTERISTIC DMADFS "Maximal adaptierbares Delta-Verlustmoment pro Adaptionsphase mit Fahrstufe ein" VALUE 0x81A0B9 KwUb 24.90 rel_ub_b24p9 0.00 24.90 FUNCTION_LIST MDVERAD IF_DATA DIM_X DIRECT 0x81A0B9 /end CHARACTERISTIC
/begin CHARACTERISTIC DMADKO "Maximal adaptierbares Delta-Verlustmoment pro Adaptionsphase Kompr.ein" VALUE 0x81A0BA KwUb 24.90 rel_ub_b24p9 0.00 24.90 FUNCTION_LIST MDVERAD IF_DATA DIM_X DIRECT 0x81A0BA /end CHARACTERISTIC
/begin CHARACTERISTIC DMADLL "Maximal adaptierbares Delta-Verlustmoment pro Adaptionsphase ohne Last" VALUE 0x81A0BB KwUb 24.90 rel_ub_b24p9 0.00 24.90 FUNCTION_LIST MDVERAD IF_DATA DIM_X DIRECT 0x81A0BB /end CHARACTERISTIC
/begin CHARACTERISTIC DMADMNFK "Minimal adaptierbares Delta-Verlustmoment Fahrstufe eingelegt + Kompressor ein" VALUE 0x81A0BC KwUb 24.90 rel_ub_bn24p9 -24.90 0.00 FUNCTION_LIST MDVERAD IF_DATA DIM_X DIRECT 0x81A0BC /end CHARACTERISTIC
/begin CHARACTERISTIC DMADMNFS "Minimal adaptierbares Delta-Verlustmoment Fahrstufe eingelegt" VALUE 0x81A0BD KwUb 24.90 rel_ub_bn24p9 -24.90 0.00 FUNCTION_LIST MDVERAD IF_DATA DIM_X DIRECT 0x81A0BD /end CHARACTERISTIC
/begin CHARACTERISTIC DMADMNKO "Minimal adaptierbares Delta-Verlustmoment Klimakompressor ein" VALUE 0x81A0BE KwUb 24.90 rel_ub_bn24p9 -24.90 0.00 FUNCTION_LIST MDVERAD IF_DATA DIM_X DIRECT 0x81A0BE /end CHARACTERISTIC
/begin CHARACTERISTIC DMADMNLL "Minimal adaptierbares Delta-Verlustmoment ohne Last" VALUE 0x81A0BF KwUb 24.90 rel_ub_bn24p9 -24.90 0.00 FUNCTION_LIST MDVERAD IF_DATA DIM_X DIRECT 0x81A0BF /end CHARACTERISTIC
/begin CHARACTERISTIC DMADMXFK "Maximal adaptierbares Delta-Verlustmoment Farstufe + Klimakompressor ein" VALUE 0x81A0C0 KwUb 24.90 rel_ub_b24p9 0.00 24.90 FUNCTION_LIST MDVERAD IF_DATA DIM_X DIRECT 0x81A0C0 /end CHARACTERISTIC
/begin CHARACTERISTIC DMADMXFS "Maximal adaptierbares Delta-Verlustmoment Farstufe ein" VALUE 0x81A0C1 KwUb 24.90 rel_ub_b24p9 0.00 24.90 FUNCTION_LIST MDVERAD IF_DATA DIM_X DIRECT 0x81A0C1 /end CHARACTERISTIC
/begin CHARACTERISTIC DMADMXKO "Maximal adaptierbares Delta-Verlustmoment Klimakompressor ein" VALUE 0x81A0C2 KwUb 24.90 rel_ub_b24p9 0.00 24.90 FUNCTION_LIST MDVERAD IF_DATA DIM_X DIRECT 0x81A0C2 /end CHARACTERISTIC
/begin CHARACTERISTIC DMADMXLL "Maximal adaptierbares Delta-Verlustmoment ohne Last" VALUE 0x81A0C3 KwUb 24.90 rel_ub_b24p9 0.00 24.90 FUNCTION_LIST MDVERAD IF_DATA DIM_X DIRECT 0x81A0C3 /end CHARACTERISTIC
/begin CHARACTERISTIC DMARMX "Maximalbegrenzung des stationären Momenteneingriffs der Antiruckelfunktion" CURVE 0x82836A KlAUbSstUbWUw 99.99847 rel_uw_b100 0.00 99.99847 FUNCTION_LIST ARMD IF_DATA DIM_X DIRECT 0x82836A
 /begin AXIS_DESCR STD_AXIS tmot temp_ub_q0p75_o48 6 -48.00 143.3 DEPOSIT ABSOLUT /end AXIS_DESCR
/end CHARACTERISTIC
/begin CHARACTERISTIC DMDNSM "Delta Moment zur Nachstartkompensation" CURVE 0x81A343 KlAUbSstUbWUb 99.61 rel_ub_b99p6 0.00 99.61 FUNCTION_LIST MDVER IF_DATA DIM_X DIRECT 0x81A343
 /begin AXIS_DESCR STD_AXIS tmot temp_ub_q0p75_o48 8 -48.00 143.3 DEPOSIT ABSOLUT /end AXIS_DESCR
/end CHARACTERISTIC
/begin CHARACTERISTIC DMDPUG "delta Moment Dashpotende" CURVE 0x8167CA KlAUwSstSwWUw 99.99847 rel_uw_b100 0.00 99.99847 FUNCTION_LIST MDFAW IF_DATA DIM_X DIRECT 0x8167CA
 /begin AXIS_DESCR STD_AXIS mkfanb_w rel_sw_b100 8 -100.0000 99.99695 DEPOSIT ABSOLUT /end AXIS_DESCR
/end CHARACTERISTIC
/begin CHARACTERISTIC DMDWANK "delta Wandlermoment für Sperrung des Verlustmomentfilters beim Kriechen (CVT)" VALUE 0x829336 KwUw 99.99847 rel_uw_b100 0.00 99.99847 FUNCTION_LIST MDVER IF_DATA DIM_X DIRECT 0x829336 /end CHARACTERISTIC
/begin CHARACTERISTIC DMDWANMX "Begrenzung des Wandlermoments für Sicherheitskonzept" VALUE 0x811DB0 KwUb 100.0 rel_q0p392 0.00 100.0 FUNCTION_LIST MDWAN IF_DATA DIM_X DIRECT 0x811DB0 /end CHARACTERISTIC
/begin CHARACTERISTIC DMDWHYS "Hysterese für Bildung D-Anteil-Wandlermoment" VALUE 0x811DB1 KwUb 99.61 rel_ub_b99p6 0.00 99.61 FUNCTION_LIST MDWAN IF_DATA DIM_X DIRECT 0x811DB1 /end CHARACTERISTIC
/begin CHARACTERISTIC DMDWM "D-Anteil Wandlermoment bei Einlegen der Fahrstufe" CURVE 0x81A0CE GklWUb 99.61 rel_ub_b99p6 0.00 99.61 FUNCTION_LIST MDWAN IF_DATA DIM_X DIRECT 0x81A0CE
 /begin AXIS_DESCR COM_AXIS twnd temp_ub_q0p75_o48 8 -48.00 143.3 AXIS_PTS_REF STW08MDUB /end AXIS_DESCR
/end CHARACTERISTIC
/begin CHARACTERISTIC DMGETAFW "Korrektur des Getriebeausgangsmoments bei FGR-Initialisierung" CURVE 0x81CAA8 KlASwSstSwWSw 639.9902 rel_q0p009766 -320.0000 319.9902 FUNCTION_LIST FGRREGL IF_DATA DIM_X DIRECT 0x81CAA8
 /begin AXIS_DESCR STD_AXIS fawifgr_w rel_q0p249 6 -8159.232 8158.983 DEPOSIT ABSOLUT /end AXIS_DESCR
/end CHARACTERISTIC
/begin CHARACTERISTIC DMIFLSD_0_A "Delta-Moment für Initialisierung Filter Lastschlagdämpfung" VALUE 0x817062 KwUw 99.99847 rel_uw_b100 0.00 99.99847 FUNCTION_LIST MDFAW IF_DATA DIM_X DIRECT 0x817062 /end CHARACTERISTIC
/begin CHARACTERISTIC DMIFLSD_1_A "Delta-Moment für Initialisierung Filter Lastschlagdämpfung" VALUE 0x817064 KwUw 99.99847 rel_uw_b100 0.00 99.99847 FUNCTION_LIST MDFAW IF_DATA DIM_X DIRECT 0x817064 /end CHARACTERISTIC
/begin CHARACTERISTIC DMIZWMN "Offset auf indiziertes Motormoment bei spätestem Zündwinkel und ASR-Eingriff" VALUE 0x81215D KwUb 99.61 rel_ub_b99p6 0.00 99.61 FUNCTION_LIST MDRED IF_DATA DIM_X DIRECT 0x81215D /end CHARACTERISTIC
/begin CHARACTERISTIC DMLDTEFN "Schwelle Luftmassenstrom unplausibel für Erkennung Fehler in DTEV" VALUE 0x829CFA KwSw 2.000000 m_q0p0031 -2.000000 0.00 FUNCTION_LIST DTEV IF_DATA DIM_X DIRECT 0x829CFA /end CHARACTERISTIC
/begin CHARACTERISTIC DMLDTEFX "Luftmassenschwelle für Erkennung TEV defekt nicht mehr nötig" VALUE 0x829CFC KwSw 3.025000 m_q0p0031 0.00 3.025000 FUNCTION_LIST DTEV IF_DATA DIM_X DIRECT 0x829CFC /end CHARACTERISTIC
/begin CHARACTERISTIC DMLDTEMN "Untere Schwelle für Erkennung Luftmassenstrom unplausibel für Auswertung in DTEV" VALUE 0x829CFE KwSw 2.000000 m_q0p0031 -2.000000 0.00 FUNCTION_LIST DTEV IF_DATA DIM_X DIRECT 0x829CFE /end CHARACTERISTIC
/begin CHARACTERISTIC DMLDTEMX "Obere Schwelle für Erkennung Luftmassenstrom unplausibel für Auswertung in DTEV" VALUE 0x829D00 KwSw 2.000000 m_q0p0031 0.00 2.000000 FUNCTION_LIST DTEV IF_DATA DIM_X DIRECT 0x829D00 /end CHARACTERISTIC
/begin CHARACTERISTIC DMLKTDO "Obere Schwelle ml-Änderung in Kat-Diagnose" VALUE 0x81C706 KwUw 6553.500 m_uw_b6553p5 0.00 6553.500 FUNCTION_LIST DKATSPEB IF_DATA DIM_X DIRECT 0x81C706 /end CHARACTERISTIC
/begin CHARACTERISTIC DMLLNGEZ "LLR: D-Verstärkung abh. von ngasf für Luftpfad" MAP 0x816618 KfAxUbAyUbSstxSwSstyUbWSw 199.9841 rel_q0p00305 -99.99360 99.99055 FUNCTION_LIST LLRRM IF_DATA DIM_X DIRECT 0x816618
 /begin AXIS_DESCR STD_AXIS ngasf_w nmotg_sw_q0p39 6 -12800.16 12799.77 DEPOSIT ABSOLUT /end AXIS_DESCR
 /begin AXIS_DESCR STD_AXIS etazws rel_ub_b127p5 4 0.00 127.5 DEPOSIT ABSOLUT /end AXIS_DESCR
/end CHARACTERISTIC
/begin CHARACTERISTIC DMLLNGEZV "LLR: D-Verstärkung abh. von ngasf für Luftpfad" MAP 0x81665A KfAxUbAyUbSstxSwSstyUbWSw 199.9841 rel_q0p00305 -99.99360 99.99055 FUNCTION_LIST LLRRM IF_DATA DIM_X DIRECT 0x81665A
 /begin AXIS_DESCR STD_AXIS ngasf_w nmotg_sw_q0p39 6 -12800.16 12799.77 DEPOSIT ABSOLUT /end AXIS_DESCR
 /begin AXIS_DESCR STD_AXIS etazws rel_ub_b127p5 4 0.00 127.5 DEPOSIT ABSOLUT /end AXIS_DESCR
/end CHARACTERISTIC
/begin CHARACTERISTIC DMLLRLMNN "Untere Begrenzung für dmllrl" CURVE 0x811CCA GklWSb 50.00 rel_sb_q0p39 -50.00 0.00 FUNCTION_LIST LLRRM IF_DATA DIM_X DIRECT 0x811CCA
 /begin AXIS_DESCR COM_AXIS nmot_w nmot_uw_q0p25 6 0.00 16383.75 AXIS_PTS_REF SNM06LLUB /end AXIS_DESCR
/end CHARACTERISTIC
/begin CHARACTERISTIC DMLLRLMXN "Sicherheitskonzept: obere Begrenzung für dmllrl" CURVE 0x811CD0 GklWUb 99.61 rel_ub_b99p6 0.00 99.61 FUNCTION_LIST LLRRM IF_DATA DIM_X DIRECT 0x811CD0
 /begin AXIS_DESCR COM_AXIS nmot_w nmot_uw_q0p25 6 0.00 16383.75 AXIS_PTS_REF SNM06LLUB /end AXIS_DESCR
/end CHARACTERISTIC
/begin CHARACTERISTIC DMLLRMNN "Untere Begrenzung für dmllr_w" CURVE 0x811CD6 GklWSb 50.00 rel_sb_q0p39 -50.00 0.00 FUNCTION_LIST LLRRM IF_DATA DIM_X DIRECT 0x811CD6
 /begin AXIS_DESCR COM_AXIS nmot_w nmot_uw_q0p25 6 0.00 16383.75 AXIS_PTS_REF SNM06LLUB /end AXIS_DESCR
/end CHARACTERISTIC
/begin CHARACTERISTIC DMLLRMNNK "Untere Begrenzung für dmllr_w im Kurztrip" CURVE 0x811CDC GklWSb 50.00 rel_sb_q0p39 -50.00 0.00 FUNCTION_LIST LLRRM IF_DATA DIM_X DIRECT 0x811CDC
 /begin AXIS_DESCR COM_AXIS nmot_w nmot_uw_q0p25 6 0.00 16383.75 AXIS_PTS_REF SNM06LLUB /end AXIS_DESCR
/end CHARACTERISTIC
/begin CHARACTERISTIC DMLLRMXN "Sicherheitskonzept: obere Begrenzung für dmllr" CURVE 0x811CE2 GklWUb 99.61 rel_ub_b99p6 0.00 99.61 FUNCTION_LIST LLRRM IF_DATA DIM_X DIRECT 0x811CE2
 /begin AXIS_DESCR COM_AXIS nmot_w nmot_uw_q0p25 6 0.00 16383.75 AXIS_PTS_REF SNM06LLUB /end AXIS_DESCR
/end CHARACTERISTIC
/begin CHARACTERISTIC DMLLRMXNK "Sicherheitskonzept: obere Begrenzung für dmllr im Kurztrip" CURVE 0x811CE8 GklWUb 99.61 rel_ub_b99p6 0.00 99.61 FUNCTION_LIST LLRRM IF_DATA DIM_X DIRECT 0x811CE8
 /begin AXIS_DESCR COM_AXIS nmot_w nmot_uw_q0p25 6 0.00 16383.75 AXIS_PTS_REF SNM06LLUB /end AXIS_DESCR
/end CHARACTERISTIC
/begin CHARACTERISTIC DMLSDUG "Delta Moment Ende Lastschlagdämpfung" CURVE 0x81680E KlAUwSstSwWUw 99.99847 rel_uw_b100 0.00 99.99847 FUNCTION_LIST MDFAW IF_DATA DIM_X DIRECT 0x81680E
 /begin AXIS_DESCR STD_AXIS mkfanb_w rel_sw_b100 8 -100.0000 99.99695 DEPOSIT ABSOLUT /end AXIS_DESCR
/end CHARACTERISTIC
/begin CHARACTERISTIC DMRESLL "LLR: Abbaugeschwindigkeit der erhöhten Drehmomentreserve" VALUE 0x811E50 KwUb 0.3891 rel_ub_q0p00153 0.00 0.3891 FUNCTION_LIST LLRMR IF_DATA DIM_X DIRECT 0x811E50 /end CHARACTERISTIC
/begin CHARACTERISTIC DMRESNW "Schrittweite zum Reduzieren der Momentenreserve bei Nockenwellenverststellung" VALUE 0x811E51 KwUb 0.3891 rel_ub_q0p00153 0.00 0.3891 FUNCTION_LIST LLRMR IF_DATA DIM_X DIRECT 0x811E51 /end CHARACTERISTIC
/begin CHARACTERISTIC DMRESTM "Schrittweite zur Reduzierung der Momentenreserve nach Start" VALUE 0x811E52 KwUb 0.3891 rel_ub_q0p00153 0.00 0.3891 FUNCTION_LIST LLRMR IF_DATA DIM_X DIRECT 0x811E52 /end CHARACTERISTIC
/begin CHARACTERISTIC DMRFATE "Hysterese Hochlasterkennung" VALUE 0x8191CC KwUb 99.61 rel_ub_b99p6 0.00 99.61 FUNCTION_LIST BBTEGA IF_DATA DIM_X DIRECT 0x8191CC /end CHARACTERISTIC
/begin CHARACTERISTIC DMRFAWEN "Schwelle mrfa-Gradient für Deaktivierung PT1-Filter beim Wiedereinsetzen" CURVE 0x828520 KlAUwSstUwWUw 199.9969 rel_uw_b200 0.00 199.9969 FUNCTION_LIST MDFAW IF_DATA DIM_X DIRECT 0x828520
 /begin AXIS_DESCR STD_AXIS nmot_w nmot_uw_q0p25 4 0.00 16383.75 DEPOSIT ABSOLUT /end AXIS_DESCR
/end CHARACTERISTIC
/begin CHARACTERISTIC DMRKTDS_0_A "Momentenreserve für Katalysator-Diagnose" VALUE 0x81C702 KwUw 99.99847 rel_uw_b100 0.00 99.99847 FUNCTION_LIST DKATSP IF_DATA DIM_X DIRECT 0x81C702 /end CHARACTERISTIC
/begin CHARACTERISTIC DMRKTDS_1_A "Momentenreserve für Katalysator-Diagnose" VALUE 0x81C704 KwUw 99.99847 rel_uw_b100 0.00 99.99847 FUNCTION_LIST DKATSP IF_DATA DIM_X DIRECT 0x81C704 /end CHARACTERISTIC
/begin CHARACTERISTIC DMRLSV "Momentenreserve für Diagnose Lambdasonde vor Kat" VALUE 0x81C76A KwUw 99.99847 rel_uw_b100 0.00 99.99847 FUNCTION_LIST DLSU IF_DATA DIM_X DIRECT 0x81C76A /end CHARACTERISTIC
/begin CHARACTERISTIC DMSDRLTM "Delta-rl-Schwelle in Abhängigkeit von tmot für Sperre Bedingung B_dslmes" CURVE 0x81B248 KlAUbSstUbWUw 1535.977 rel_uw_q0p0234 0.00 1535.977 FUNCTION_LIST DSLSLRS IF_DATA DIM_X DIRECT 0x81B248
 /begin AXIS_DESCR STD_AXIS tmot temp_ub_q0p75_o48 4 -48.00 143.3 DEPOSIT ABSOLUT /end AXIS_DESCR
/end CHARACTERISTIC
/begin CHARACTERISTIC DMSLP "Begrenzung des Moments der Sekundärluftpumpe für Sicherheitskonzept" VALUE 0x81A124 KwUb 99.61 rel_ub_b100 0.00 99.61 FUNCTION_LIST MDVERB IF_DATA DIM_X DIRECT 0x81A124 /end CHARACTERISTIC
/begin CHARACTERISTIC DMSNTEMN "Minmale normierte Massenstromänderung TEV" VALUE 0x829D02 KwSw 3281.700 m_q0p1 -5.000000 3276.700 FUNCTION_LIST DTEV IF_DATA DIM_X DIRECT 0x829D02 /end CHARACTERISTIC
/begin CHARACTERISTIC DMSNTEMX "Maximale normierte Massenstromänderung TEV" VALUE 0x829D04 KwSw 3274.700 m_q0p1 2.000000 3276.700 FUNCTION_LIST DTEV IF_DATA DIM_X DIRECT 0x829D04 /end CHARACTERISTIC
/begin CHARACTERISTIC DMSTES "Kennlinie maximale Zunahme Massenstrom Tankentlüftung" CURVE 0x8177CE KlAUwSstUwWUw 3276.800 m_uw_q3p2 0.00 3276.800 FUNCTION_LIST TEB IF_DATA DIM_X DIRECT 0x8177CE
 /begin AXIS_DESCR STD_AXIS mstesoll_w m_uw_b25p6 6 0.00 25.59961 DEPOSIT ABSOLUT /end AXIS_DESCR
/end CHARACTERISTIC
/begin CHARACTERISTIC DMTSMN "Untere Regelschwelle Differenz Soll-Ist Motortemperatur" VALUE 0x81AC12 KwSb 191.3 temp_sb_q0p75 -96.00 95.25 FUNCTION_LIST KMTR IF_DATA DIM_X DIRECT 0x81AC12 /end CHARACTERISTIC
/begin CHARACTERISTIC DMTSMX "Obere Regelschwelle Differenz Soll-Ist Motortemperatur" VALUE 0x81AC13 KwSb 191.3 temp_sb_q0p75 -96.00 95.25 FUNCTION_LIST KMTR IF_DATA DIM_X DIRECT 0x81AC13 /end CHARACTERISTIC
/begin CHARACTERISTIC DMVERLMN "minimale Verlustmomentschwelle" VALUE 0x8172F0 KwUw 99.99847 rel_uw_b100 0.00 99.99847 FUNCTION_LIST MDVER IF_DATA DIM_X DIRECT 0x8172F0 /end CHARACTERISTIC
/begin CHARACTERISTIC DMVTEVDO "Schwelle Verlustadaption zur Unterscheidung min, max Fehler in DTEV" VALUE 0x829D06 KwSw 199.9969 rel_sw_b100 -100.0000 99.99695 FUNCTION_LIST DTEV IF_DATA DIM_X DIRECT 0x829D06 /end CHARACTERISTIC
/begin CHARACTERISTIC DMXRDL "Begrenzung bei max. Laufunruhe-Referenzwert-Änderung von dlurs" VALUE 0x8104D8 KwSb 85.89 luquant 0.00 85.89 FUNCTION_LIST DMDDLU IF_DATA DIM_X DIRECT 0x8104D8 /end CHARACTERISTIC
/begin CHARACTERISTIC DMXRFL "Begrenzung bei max. Filter-Laufunruhe-Referenzwert-Änderung" VALUE 0x810277 KwSb 85.89 luquant 0.00 85.89 FUNCTION_LIST DMDLUA IF_DATA DIM_X DIRECT 0x810277 /end CHARACTERISTIC
/begin CHARACTERISTIC DMXRLU "Begrenzung bei max. Laufunruhe-Referenzwert-Änderung" VALUE 0x810805 KwSb 85.89 luquant 0.00 85.89 FUNCTION_LIST DMDLU IF_DATA DIM_X DIRECT 0x810805 /end CHARACTERISTIC
/begin CHARACTERISTIC DN10BURN "Minimaler Drehzahlanstieg für ""Verbrennnung erfolgt""" VALUE 0x811656 KwUb 2550. nmot_ub_q10 0.00 2550. FUNCTION_LIST ESSTT IF_DATA DIM_X DIRECT 0x811656 /end CHARACTERISTIC
/begin CHARACTERISTIC DNABW "Drehzahldifferenz bei Motor abwürgen" VALUE 0x813FD0 KwSw 16383.75 nmot_sw_q0p25 -8192.000 8191.750 FUNCTION_LIST RDE IF_DATA DIM_X DIRECT 0x813FD0 /end CHARACTERISTIC
/begin CHARACTERISTIC DNBURN0 "Minimaler Drehzahlanstieg für erkannte Verbrennung im Bereich 0" CURVE 0x815C9C KlAUwSstUwWUw 4112.000 nmot_uw_q0p25 0.00 4112.000 FUNCTION_LIST STADAP IF_DATA DIM_X DIRECT 0x815C9C
 /begin AXIS_DESCR STD_AXIS nmot_w nmot_uw_q0p25 12 0.00 16383.75 DEPOSIT ABSOLUT /end AXIS_DESCR
/end CHARACTERISTIC
/begin CHARACTERISTIC DNBURN1 "Minimaler Drehzahlanstieg für erkannte Verbrennung im Bereich 1" CURVE 0x815CCE KlAUwSstUwWUw 4112.000 nmot_uw_q0p25 0.00 4112.000 FUNCTION_LIST STADAP IF_DATA DIM_X DIRECT 0x815CCE
 /begin AXIS_DESCR STD_AXIS nmot_w nmot_uw_q0p25 12 0.00 16383.75 DEPOSIT ABSOLUT /end AXIS_DESCR
/end CHARACTERISTIC
/begin CHARACTERISTIC DNBURN2 "Minimaler Drehzahlanstieg für erkannte Verbrennung im Bereich 2" CURVE 0x815D00 KlAUwSstUwWUw 4112.000 nmot_uw_q0p25 0.00 4112.000 FUNCTION_LIST STADAP IF_DATA DIM_X DIRECT 0x815D00
 /begin AXIS_DESCR STD_AXIS nmot_w nmot_uw_q0p25 12 0.00 16383.75 DEPOSIT ABSOLUT /end AXIS_DESCR
/end CHARACTERISTIC
/begin CHARACTERISTIC DNDLLRO "Maximale Drehzahlabweichung (Unterdrehzahl) für Diagnose LLR" VALUE 0x81A228 KwUb 1270. nmot_ub_q10 0.00 1270. FUNCTION_LIST DLLR IF_DATA DIM_X DIRECT 0x81A228 /end CHARACTERISTIC
/begin CHARACTERISTIC DNDLLRU "Maximale Drehzahlabweichung (Überdrehzahl) für Diagnose LLR" VALUE 0x81A229 KwSb 1280. nmot_ub_q10 -1280. 0.00 FUNCTION_LIST DLLR IF_DATA DIM_X DIRECT 0x81A229 /end CHARACTERISTIC
/begin CHARACTERISTIC DNDTEO "obere Nsoll-Nist-Schwelle für Abbruch Diagnose TEV" VALUE 0x81A71D KwSb 200.0 nmot_ub_q10 0.00 200.0 FUNCTION_LIST DTEV IF_DATA DIM_X DIRECT 0x81A71D /end CHARACTERISTIC
/begin CHARACTERISTIC DNDTEU "lower Nsoll-Nist-Schwelle für Abbruch Diagnose TEV" VALUE 0x81A71E KwSb 200.0 nmot_ub_q10 -200.0 0.00 FUNCTION_LIST DTEV IF_DATA DIM_X DIRECT 0x81A71E /end CHARACTERISTIC
/begin CHARACTERISTIC DNFILO "obere Schwelle für Gradient des Filterausgangs ndfil" VALUE 0x8167A4 KwSw 8191.750 nmot_sw_q0p25 0.00 8191.750 FUNCTION_LIST ARMD IF_DATA DIM_X DIRECT 0x8167A4 /end CHARACTERISTIC
/begin CHARACTERISTIC DNLLR "Drehzahlband oberhalb nstat für LLR-Freigabe" VALUE 0x811C9E KwUb 2550. nmot_ub_q10 0.00 2550. FUNCTION_LIST LLRBB IF_DATA DIM_X DIRECT 0x811C9E /end CHARACTERISTIC
/begin CHARACTERISTIC DNLLRES "LLR: Unterdrehzahlschwelle zur Erhöhung der Momentenreserve im LL" VALUE 0x811E53 KwSb 2550. nmotd_sb_q10 -1280. 1270. FUNCTION_LIST LLRMR IF_DATA DIM_X DIRECT 0x811E53 /end CHARACTERISTIC
/begin CHARACTERISTIC DNLLRIST "Überdrehzahlschwelle für Integratorreset" VALUE 0x811CEE KwSb 2550. nmotd_sb_q10 -1280. 1270. FUNCTION_LIST LLRRM IF_DATA DIM_X DIRECT 0x811CEE /end CHARACTERISTIC
/begin CHARACTERISTIC DNLLST "Drehzahlschwelle zum Deaktivieren der P-Verstärkung im Start" VALUE 0x811CEF KwUb 255.0 nmot_q1 0.00 255.0 FUNCTION_LIST LLRRM IF_DATA DIM_X DIRECT 0x811CEF /end CHARACTERISTIC
/begin CHARACTERISTIC DNMAX "Zulässige Verminderung der Maximaldrehzahl pro Rechenschritt" VALUE 0x8172F2 KwUw 16383.75 nmot_uw_q0p25 0.00 16383.75 FUNCTION_LIST NMAXMD IF_DATA DIM_X DIRECT 0x8172F2 /end CHARACTERISTIC
/begin CHARACTERISTIC DNMAXDZ "Delta-Drehzahl, Abregelung der Drehzahlgrenze bei doppelter Zündausgabe" VALUE 0x8172F4 KwUw 16383.75 nmot_uw_q0p25 0.00 16383.75 FUNCTION_LIST NMAXMD IF_DATA DIM_X DIRECT 0x8172F4 /end CHARACTERISTIC
/begin CHARACTERISTIC DNMAXH "Überschreitung der Maximaldrehzahl für Einspritzausblendung an allen Zylindern" VALUE 0x8172F6 KwUw 2550.000 nmot_uw_q0p25 0.00 2550.000 FUNCTION_LIST NMAXMD IF_DATA DIM_X DIRECT 0x8172F6 /end CHARACTERISTIC
/begin CHARACTERISTIC DNMNI "Kleinstmöglicher Wert für dn beim I-Anteil" VALUE 0x811CF0 KwSb 2550. nmotd_sb_q10 -1280. 1270. FUNCTION_LIST LLRRM IF_DATA DIM_X DIRECT 0x811CF0 /end CHARACTERISTIC
/begin CHARACTERISTIC DNNSOL "Drehzahlschwelle für Solldrehzahländerung während DTEV" VALUE 0x81A71F KwUb 200.0 nmot_ub_q10 0.00 200.0 FUNCTION_LIST DTEV IF_DATA DIM_X DIRECT 0x81A71F /end CHARACTERISTIC
/begin CHARACTERISTIC DNSAH_0_A "Delta n SA high bezogen auf nWE" VALUE 0x81660C KwUb 5080. nmot_ub_q40 0.00 5080. FUNCTION_LIST BBSAWE IF_DATA DIM_X DIRECT 0x81660C /end CHARACTERISTIC
/begin CHARACTERISTIC DNSAH_1_A "Delta n SA high bezogen auf nWE" VALUE 0x81660D KwUb 5080. nmot_ub_q40 0.00 5080. FUNCTION_LIST BBSAWE IF_DATA DIM_X DIRECT 0x81660D /end CHARACTERISTIC
/begin CHARACTERISTIC DNSAL_0_A "Delta n SA low bezogen auf nWE" VALUE 0x81660E KwUb 5080. nmot_ub_q40 0.00 5080. FUNCTION_LIST BBSAWE IF_DATA DIM_X DIRECT 0x81660E /end CHARACTERISTIC
/begin CHARACTERISTIC DNSAL_1_A "Delta n SA low bezogen auf nWE" VALUE 0x81660F KwUb 5080. nmot_ub_q40 0.00 5080. FUNCTION_LIST BBSAWE IF_DATA DIM_X DIRECT 0x81660F /end CHARACTERISTIC
/begin CHARACTERISTIC DNSATIP "Schubabschaltedrehzahlanhebung bei Tipgasse" VALUE 0x811C94 KwUb 10200. nmot_ub_q40 0.00 10200. FUNCTION_LIST BBSAWE IF_DATA DIM_X DIRECT 0x811C94 /end CHARACTERISTIC
/begin CHARACTERISTIC DNSIRES "Differenz Soll- und Istdrehzahl, Reset-Wert" VALUE 0x8172F8 KwSw 16383.75 nmot_sw_q0p25 -8192.000 8191.750 FUNCTION_LIST NMAXMD IF_DATA DIM_X DIRECT 0x8172F8 /end CHARACTERISTIC
/begin CHARACTERISTIC DNSLL_0_A "Schubabschalte-Hysterese bei WE im Leerlauf" VALUE 0x816610 KwUb 10200. nmot_ub_q40 0.00 10200. FUNCTION_LIST BBSAWE IF_DATA DIM_X DIRECT 0x816610 /end CHARACTERISTIC
/begin CHARACTERISTIC DNSLL_1_A "Schubabschalte-Hysterese bei WE im Leerlauf" VALUE 0x816611 KwUb 10200. nmot_ub_q40 0.00 10200. FUNCTION_LIST BBSAWE IF_DATA DIM_X DIRECT 0x816611 /end CHARACTERISTIC
/begin CHARACTERISTIC DNSLLK "Schubabschalte-Hysterese bei WE im Leerlauf und geöffneter Kupplung" VALUE 0x811C95 KwUb 10200. nmot_ub_q40 0.00 10200. FUNCTION_LIST BBSAWE IF_DATA DIM_X DIRECT 0x811C95 /end CHARACTERISTIC
/begin CHARACTERISTIC DNSNFST "Drehzahlschwelle für nsol-Begrenzung im Start" VALUE 0x819F38 KwUb 2550. nmot_ub_q10 0.00 2550. FUNCTION_LIST LLRNS IF_DATA DIM_X DIRECT 0x819F38 /end CHARACTERISTIC
/begin CHARACTERISTIC DNSNFX "Offset zur Bestimmung der oberen Grenze für die Solldrehzahlnachführung" VALUE 0x819F39 KwUb 2550. nmot_ub_q10 0.00 2550. FUNCTION_LIST LLRNS IF_DATA DIM_X DIRECT 0x819F39 /end CHARACTERISTIC
/begin CHARACTERISTIC DNTIPDYN "Einschaltschwelle Drehzahdynamik für Tip-In Offset auf spätesten Zündwinkel" VALUE 0x812874 KwSb 25500. nmotg_sb_q100 -12800. 12700. FUNCTION_LIST ZWMIN IF_DATA DIM_X DIRECT 0x812874 /end CHARACTERISTIC
/begin CHARACTERISTIC DNVSA "Schubabschaltedrehzahlanhebung bei kleiner Geschwindigkeit" VALUE 0x811C96 KwUb 10200. nmot_ub_q40 0.00 10200. FUNCTION_LIST BBSAWE IF_DATA DIM_X DIRECT 0x811C96 /end CHARACTERISTIC
/begin CHARACTERISTIC DNWEK "Delta n für WE bei Klima (AC)" VALUE 0x811C97 KwUb 10200. nmot_ub_q40 0.00 10200. FUNCTION_LIST BBSAWE IF_DATA DIM_X DIRECT 0x811C97 /end CHARACTERISTIC
/begin CHARACTERISTIC DNWEOFF "Drehzahloffset zu nstat für nwe" VALUE 0x811C98 KwUb 10200. nmot_ub_q40 0.00 10200. FUNCTION_LIST BBSAWE IF_DATA DIM_X DIRECT 0x811C98 /end CHARACTERISTIC
/begin CHARACTERISTIC DNZWMN "Drehzahloffset auf nstat für Abschalten des Tip-In ZW-Offsets" VALUE 0x812875 KwUb 10200. nmot_ub_q40 0.00 10200. FUNCTION_LIST ZWMIN IF_DATA DIM_X DIRECT 0x812875 /end CHARACTERISTIC
/begin CHARACTERISTIC DPBKVBBG "Faktor Druckgradient am Beginn einer Bremsung" VALUE 0x82B19E KwUw 7.999878 fak_uw_b8 0.00 7.999878 FUNCTION_LIST GGPBKV IF_DATA DIM_X DIRECT 0x82B19E /end CHARACTERISTIC
/begin CHARACTERISTIC DPBKVBSGV0 "Faktor Druckgradient während Bremsung bei v=0" VALUE 0x82B1A0 KwUw 7.999878 fak_uw_b8 0.00 7.999878 FUNCTION_LIST GGPBKV IF_DATA DIM_X DIRECT 0x82B1A0 /end CHARACTERISTIC
/begin CHARACTERISTIC DPBKVBSGVS "Faktor Druckgradient während Bremsung bei v>Schwelle" VALUE 0x82B1A2 KwUw 7.999878 fak_uw_b8 0.00 7.999878 FUNCTION_LIST GGPBKV IF_DATA DIM_X DIRECT 0x82B1A2 /end CHARACTERISTIC
/begin CHARACTERISTIC DPBKVEBG "Faktor Druckgradient am Ende einer Bremsung" VALUE 0x82B1A4 KwUw 7.999878 fak_uw_b8 0.00 7.999878 FUNCTION_LIST GGPBKV IF_DATA DIM_X DIRECT 0x82B1A4 /end CHARACTERISTIC
/begin CHARACTERISTIC DPBKVEBGVS "Faktor Druckgradient am Ende einer Bremsung bei vfzg>Schwelle" VALUE 0x82B1A6 KwUw 7.999878 fak_uw_b8 0.00 7.999878 FUNCTION_LIST GGPBKV IF_DATA DIM_X DIRECT 0x82B1A6 /end CHARACTERISTIC
/begin CHARACTERISTIC DPBKVEVK "Faktor Druckgradient während Evakuierung des Bremskraftverstärkers" VALUE 0x82B1A8 KwUw 15.99976 fak_uw_b16 0.00 15.99976 FUNCTION_LIST GGPBKV IF_DATA DIM_X DIRECT 0x82B1A8 /end CHARACTERISTIC
/begin CHARACTERISTIC DPBKVEVKEP "Fak. Druckgrad. während Evakuierung des Bremskraftverstärkers durch el. Pumpe" VALUE 0x82B1AA KwUw 15.99976 fak_uw_b16 0.00 15.99976 FUNCTION_LIST GGPBKV IF_DATA DIM_X DIRECT 0x82B1AA /end CHARACTERISTIC
/begin CHARACTERISTIC DPBKVEVKSP "Fak. Druckgrad. während Evakuierung des BKV durch Saugstrahlpumpe" VALUE 0x82B1AC KwUw 15.99976 fak_uw_b16 0.00 15.99976 FUNCTION_LIST GGPBKV IF_DATA DIM_X DIRECT 0x82B1AC /end CHARACTERISTIC
/begin CHARACTERISTIC DPBKVLE "zulässiger Druckanstieg bei Leckage" VALUE 0x82B2BE KwSw 2559.961 p_sw_q0p039 -1280.000 1279.961 FUNCTION_LIST DDSBKV IF_DATA DIM_X DIRECT 0x82B2BE /end CHARACTERISTIC
/begin CHARACTERISTIC DPBKVPMN "Toleranz von pubkv_w*FBKVP (min. Pump-Druck) und Toleranz Drucksensor im BKV" VALUE 0x82B2A4 KwUw 2559.961 p_uw_q0p039 0.00 2559.961 FUNCTION_LIST DBKVP IF_DATA DIM_X DIRECT 0x82B2A4 /end CHARACTERISTIC
/begin CHARACTERISTIC DPBKVRPD "Delta Druck für Rücksetzen von BKV Unterdruckpumpen Diagnose" VALUE 0x82B2B8 KwUw 2559.961 p_uw_q0p039 0.00 2559.961 FUNCTION_LIST DBKVP IF_DATA DIM_X DIRECT 0x82B2B8 /end CHARACTERISTIC
/begin CHARACTERISTIC DPBKVSPS "Delta Druck zw. Sollbremskraftverstärkerdruck und Saugrohrdruck" VALUE 0x82B1E8 KwUw 2559.961 p_uw_q0p039 0.00 2559.961 FUNCTION_LIST BKV IF_DATA DIM_X DIRECT 0x82B1E8 /end CHARACTERISTIC
/begin CHARACTERISTIC DPBKVSTG "Faktor Druckgradient durch Undichtigkeit des Bremskraftverstärkers" VALUE 0x82B1AE KwUw 7.999878 fak_uw_b8 0.00 7.999878 FUNCTION_LIST GGPBKV IF_DATA DIM_X DIRECT 0x82B1AE /end CHARACTERISTIC
/begin CHARACTERISTIC DPBKVUKKPU_0_A "min. zuläs. Druckdiff. zw. pbkv und pu für Kompressorabschaltung" CURVE 0x82B1EA KlAUwSstUwWUw 2559.961 p_uw_q0p039 0.00 2559.961 FUNCTION_LIST BKV IF_DATA DIM_X INDIRECT 0x817662
 /begin AXIS_DESCR STD_AXIS pubkv_w p_uw_q0p039 4 0.00 2559.961 DEPOSIT ABSOLUT /end AXIS_DESCR
/end CHARACTERISTIC
/begin CHARACTERISTIC DPBKVUKKPU_1_A "min. zuläs. Druckdiff. zw. pbkv und pu für Kompressorabschaltung" CURVE 0x82B1FC KlAUwSstUwWUw 2559.961 p_uw_q0p039 0.00 2559.961 FUNCTION_LIST BKV IF_DATA DIM_X INDIRECT 0x817666
 /begin AXIS_DESCR STD_AXIS pubkv_w p_uw_q0p039 4 0.00 2559.961 DEPOSIT ABSOLUT /end AXIS_DESCR
/end CHARACTERISTIC
/begin CHARACTERISTIC DPBKVUKP "min. zuläs. Druckdif. zwischen BKV-Druck und pu für Pumpenansteuerung" CURVE 0x82B244 KlAUwSstUwWUw 2559.961 p_uw_q0p039 0.00 2559.961 FUNCTION_LIST BKV IF_DATA DIM_X DIRECT 0x82B244
 /begin AXIS_DESCR STD_AXIS pubkv_w p_uw_q0p039 4 0.00 2559.961 DEPOSIT ABSOLUT /end AXIS_DESCR
/end CHARACTERISTIC
/begin CHARACTERISTIC DPBKVUKPU "min. zuläs. Druckdif. zw. BKV-Druck und pu ohne Betät. der Bremse abh. von pu" CURVE 0x82B256 KlAUwSstUwWUw 2559.961 p_uw_q0p039 0.00 2559.961 FUNCTION_LIST BKV IF_DATA DIM_X DIRECT 0x82B256
 /begin AXIS_DESCR STD_AXIS pubkv_w p_uw_q0p039 4 0.00 2559.961 DEPOSIT ABSOLUT /end AXIS_DESCR
/end CHARACTERISTIC
/begin CHARACTERISTIC DPBKVUS "gewünschte Druckdifferenz zwischen Bremskraftverstärker und Umgebungsdruck" VALUE 0x81AFE2 KwUb 1275. p_ub_q5 0.00 1275. FUNCTION_LIST BKV IF_DATA DIM_X DIRECT 0x81AFE2 /end CHARACTERISTIC
/begin CHARACTERISTIC DPDSVLU "Delta Druckwert für Signalvergleich Ladedruck mit Umgebungsdruck" VALUE 0x81D600 KwUw 2559.961 p_uw_q0p039 0.00 2559.961 FUNCTION_LIST GGDSAS IF_DATA DIM_X DIRECT 0x81D600 /end CHARACTERISTIC
/begin CHARACTERISTIC DPSBKV "Delta Druck für Plausibilität von Bremskraftverstärkerdruck mit Saugrohrdruck" VALUE 0x82B2C0 KwUw 2559.961 p_uw_q0p039 0.00 2559.961 FUNCTION_LIST DDSBKV IF_DATA DIM_X DIRECT 0x82B2C0 /end CHARACTERISTIC
/begin CHARACTERISTIC DPSKRAN "Erkennungsschwelle Lastdynamik für Stationäradaption" CURVE 0x81F7CC GklWSw 1279.961 p_sw_q0p039 0.00 1279.961 FUNCTION_LIST KRDY IF_DATA DIM_X DIRECT 0x81F7CC
 /begin AXIS_DESCR COM_AXIS nmot nmot_ub_q40 16 0.00 10200. AXIS_PTS_REF SNM16KRUB /end AXIS_DESCR
/end CHARACTERISTIC
/begin CHARACTERISTIC DPSLV "minimale Druckdifferenz Sekundärluftventi" VALUE 0x8182E7 KwUb 1275. p_ub_q5 0.00 1275. FUNCTION_LIST SLS IF_DATA DIM_X DIRECT 0x8182E7 /end CHARACTERISTIC
/begin CHARACTERISTIC DPSPBKVNPH "min. Druckdifferenz zw. ps und pbkv für Heilung npl-Fehler(Leckage)" VALUE 0x82B2C2 KwSw 2559.961 p_sw_q0p039 -1280.000 1279.961 FUNCTION_LIST DDSBKV IF_DATA DIM_X DIRECT 0x82B2C2 /end CHARACTERISTIC
/begin CHARACTERISTIC DPSPUBKVH "Delta zwischen Saugrohrdruck und Umgebungsdruck für DSBKV-Healing" VALUE 0x82B2C4 KwSw 2559.961 p_sw_q0p039 -1280.000 1279.961 FUNCTION_LIST DDSBKV IF_DATA DIM_X DIRECT 0x82B2C4 /end CHARACTERISTIC
/begin CHARACTERISTIC DPUBABMX "Maximale Schwelle Delta Umgebungsdruck für Bergaberkennung" VALUE 0x817846 KwSw 2559.961 p_uw_q0p039 -1280.000 1279.961 FUNCTION_LIST DLDP IF_DATA DIM_X DIRECT 0x817846 /end CHARACTERISTIC
/begin CHARACTERISTIC DPUFFMN "Minimale Schwelle für Delta-Umgebungsdruck, Bergauferkennung (0.5 mm - Diagnose)" VALUE 0x817848 KwSw 2559.961 p_uw_q0p039 -1280.000 1279.961 FUNCTION_LIST DLDP IF_DATA DIM_X DIRECT 0x817848 /end CHARACTERISTIC
/begin CHARACTERISTIC DPUFFMX "Maximale Schwelle für Delta-Umgebungsdruck, Bergaberkennung (0.5 mm - Diagnose)" VALUE 0x81784A KwSw 2559.961 p_uw_q0p039 -1280.000 1279.961 FUNCTION_LIST DLDP IF_DATA DIM_X DIRECT 0x81784A /end CHARACTERISTIC
/begin CHARACTERISTIC DPUFVMN "Spezifische Druckdifferenz für Saugrohrdrucküberwachung" VALUE 0x81784C KwSw 5119.922 p_uw_q0p078 -2560.000 2559.922 FUNCTION_LIST DLDP IF_DATA DIM_X DIRECT 0x81784C /end CHARACTERISTIC
/begin CHARACTERISTIC DPUFVSMN "Soll-Druckdifferenz für Saugrohrdrucküberwachung" VALUE 0x81784E KwSw 5119.922 p_uw_q0p078 -2560.000 2559.922 FUNCTION_LIST DLDP IF_DATA DIM_X DIRECT 0x81784E /end CHARACTERISTIC
/begin CHARACTERISTIC DPUPS "Druckdifferenz für Umschaltung Referenzdruck vor Drosselklappe" VALUE 0x811328 KwUb 2550. p_ub_q10 0.00 2550. FUNCTION_LIST FUEDK IF_DATA DIM_X DIRECT 0x811328 /end CHARACTERISTIC
/begin CHARACTERISTIC DPUPVDK "Differenzdruck pu-pvdk" CURVE 0x81D602 KlAUwSstUwWUw 2559.961 p_uw_q0p039 0.00 2559.961 FUNCTION_LIST GGDSAS IF_DATA DIM_X DIRECT 0x81D602 /begin AXIS_DESCR STD_AXIS ml_w m_uw_b6553p5 8 0.00 6553.500 DEPOSIT ABSOLUT /end AXIS_DESCR /end CHARACTERISTIC
/begin CHARACTERISTIC DQUEBERMN "Minimaler überschüssiger Wärmestrom" VALUE 0x81AC14 KwUb 191.3 temp_ub_q0p75_o48 -48.00 143.3 FUNCTION_LIST KMTR IF_DATA DIM_X DIRECT 0x81AC14 /end CHARACTERISTIC
/begin CHARACTERISTIC DQUEBERMX "Maximaler überschüssiger Wärmestrom" VALUE 0x81AC15 KwUb 191.3 temp_ub_q0p75_o48 -48.00 143.3 FUNCTION_LIST KMTR IF_DATA DIM_X DIRECT 0x81AC15 /end CHARACTERISTIC
/begin CHARACTERISTIC DQUEBMX "Maximaler Überschüssiger Wärmestrom" VALUE 0x81AC16 KwUb 143.3 temp_ub_q0p75_o48 0.00 143.3 FUNCTION_LIST KMTR IF_DATA DIM_X DIRECT 0x81AC16 /end CHARACTERISTIC
/begin CHARACTERISTIC DRLFFMX "Maximale Laständerung bei 0.5 mm - Diagnose" VALUE 0x817850 KwSw 767.9766 rel_sw_q0p0234 0.00 767.9766 FUNCTION_LIST DLDP IF_DATA DIM_X DIRECT 0x817850 /end CHARACTERISTIC
/begin CHARACTERISTIC DRLKRSTMX "maximales drl im KR-stationär Betrieb" VALUE 0x81610A KwSw 767.9766 rel_sw_q0p0234 0.00 767.9766 FUNCTION_LIST KRRA IF_DATA DIM_X DIRECT 0x81610A /end CHARACTERISTIC
/begin CHARACTERISTIC DRLMINDP "Offset auf rlmin für Abschaltung Dashpot" VALUE 0x816830 KwSw 1535.977 rel_sw_q0p0234 -768.0000 767.9766 FUNCTION_LIST MDFAW IF_DATA DIM_X DIRECT 0x816830 /end CHARACTERISTIC
/begin CHARACTERISTIC DRLMX "Schwelle für Laständerung" VALUE 0x8186F1 KwUb 191.3 rel_ub_q0p75 0.00 191.3 FUNCTION_LIST DLSU IF_DATA DIM_X DIRECT 0x8186F1 /end CHARACTERISTIC
/begin CHARACTERISTIC DRLSOLA_0_A "Misfire Detection : Schwelle Lastdynamik für Ausblendung" CURVE 0x813D42 GklWUw 767.9766 relNWU_q0p0234 0.00 767.9766 FUNCTION_LIST DMDSTP IF_DATA DIM_X INDIRECT 0x8173E0
 /begin AXIS_DESCR COM_AXIS rl rel_ub_q0p75 8 0.00 191.3 AXIS_PTS_REF SRL08DMUB /end AXIS_DESCR
/end CHARACTERISTIC
/begin CHARACTERISTIC DRLSOLA_1_A "Misfire Detection : Schwelle Lastdynamik für Ausblendung" CURVE 0x813D52 GklWUw 767.9766 relNWU_q0p0234 0.00 767.9766 FUNCTION_LIST DMDSTP IF_DATA DIM_X INDIRECT 0x8173E2
 /begin AXIS_DESCR COM_AXIS rl rel_ub_q0p75 8 0.00 191.3 AXIS_PTS_REF SRL08DMUB /end AXIS_DESCR
/end CHARACTERISTIC
/begin CHARACTERISTIC DRLSOLST_0_A "Misfire Detection : Schwelle Lastdynamik für Ausblendung nach Start" VALUE 0x813DA2 KwUw 767.9766 relNWU_q0p0234 0.00 767.9766 FUNCTION_LIST DMDSTP IF_DATA DIM_X DIRECT 0x813DA2 /end CHARACTERISTIC
/begin CHARACTERISTIC DRLSOLST_1_A "Misfire Detection : Schwelle Lastdynamik für Ausblendung nach Start" VALUE 0x813DA4 KwUw 767.9766 relNWU_q0p0234 0.00 767.9766 FUNCTION_LIST DMDSTP IF_DATA DIM_X DIRECT 0x813DA4 /end CHARACTERISTIC
/begin CHARACTERISTIC DSBGRAD "Gradient für Drucksensor Bremskraftverstärker" VALUE 0x82B1B0 KwUw 1023.984 fak_uw_b1024 0.00 1023.984 FUNCTION_LIST GGPBKV IF_DATA DIM_X DIRECT 0x82B1B0 /end CHARACTERISTIC
/begin CHARACTERISTIC DSBOFS "Offset Drucksensor Bremskraftverstärker" VALUE 0x82B1B2 KwSw 2559.961 p_sw_q0p039 -1280.000 1279.961 FUNCTION_LIST GGPBKV IF_DATA DIM_X DIRECT 0x82B1B2 /end CHARACTERISTIC
/begin CHARACTERISTIC DSLVFZMN "vfzg-Schwelle:  Aktivieren Phase 4 durch B_ll-Bedingung" VALUE 0x818365 KwUb 318.8 vfzg_ub_q1p25 0.00 318.8 FUNCTION_LIST DSLSLRS IF_DATA DIM_X DIRECT 0x818365 /end CHARACTERISTIC
/begin CHARACTERISTIC DSTEMIN "Minimalwert für Weitertransport in Totzeitglied Gemischtransport" VALUE 0x8177E8 KwUw 0.9999695 fak_uw_b2 0.00 0.9999695 FUNCTION_LIST TEB IF_DATA DIM_X DIRECT 0x8177E8 /end CHARACTERISTIC
/begin CHARACTERISTIC DSTGRAD "Gradient für Umrechnung Spannung -> Druck bei Tankdrucksensor" VALUE 0x81781A KwUw 127.9980 adb_uw_q0p00195 0.00 127.9980 FUNCTION_LIST GGDST IF_DATA DIM_X DIRECT 0x81781A /end CHARACTERISTIC
/begin CHARACTERISTIC DSTOFFS "Offset für Umrechnung Spannung -> Druck bei Tankdrucksensor" VALUE 0x81781C KwSw 330.0000 spg_sw_b5 -320.0000 10.00000 FUNCTION_LIST GGDST IF_DATA DIM_X DIRECT 0x81781C /end CHARACTERISTIC
/begin CHARACTERISTIC DSUGRAD "Gradient für Drucksensor Umgebung" VALUE 0x81D624 KwUw 1023.984 dgrad_uw_q0p015 0.00 1023.984 FUNCTION_LIST GGDSAS IF_DATA DIM_X DIRECT 0x81D624 /end CHARACTERISTIC
/begin CHARACTERISTIC DSUOFS "Offset Drucksensor Umgebung" VALUE 0x81D626 KwSw 2559.961 p_sw_q0p039 -1280.000 1279.961 FUNCTION_LIST GGDSAS IF_DATA DIM_X DIRECT 0x81D626 /end CHARACTERISTIC
/begin CHARACTERISTIC DTABOVF "Schwelle delta Abstellzeit für Überlauferkennung" VALUE 0x81E468 KwUw 65535.00 t1sxs_uw_q1 0.00 65535.00 FUNCTION_LIST BGTABST IF_DATA DIM_X DIRECT 0x81E468 /end CHARACTERISTIC
/begin CHARACTERISTIC DTABUNPL "Schwelle Abstellzeit unplausibel" VALUE 0x81E46A KwUw 65535.00 DEZ 0.00 65535.00 FUNCTION_LIST BGTABST IF_DATA DIM_X DIRECT 0x81E46A /end CHARACTERISTIC
/begin CHARACTERISTIC DTAHLL "Delta Ansauglufttemperatur für Abbruch erhöhte Solldrehzahl im Heiß-Leerlauf" VALUE 0x819F3A KwUb 191.3 temp_ub_b191p25 0.00 191.3 FUNCTION_LIST LLRNS IF_DATA DIM_X DIRECT 0x819F3A /end CHARACTERISTIC
/begin CHARACTERISTIC DTATMSTOL "Delta  Ansauglufttemperatur zu Starttemperatur des Motors" VALUE 0x81A8AD KwUb 191.3 temp_ub_b191p25 0.00 191.3 FUNCTION_LIST BGTOL IF_DATA DIM_X DIRECT 0x81A8AD /end CHARACTERISTIC
/begin CHARACTERISTIC DTBTS "Temperaturhysterese für Bauteileschutz" VALUE 0x81E4EE KwUw 1279.980 temp_uw_q0p0195 0.00 1279.980 FUNCTION_LIST LAMBTS IF_DATA DIM_X DIRECT 0x81E4EE /end CHARACTERISTIC
/begin CHARACTERISTIC DTIREL "Dti-Schwellwert für zweiten Nachspritzer" VALUE 0x81120A KwUb 99.61 rel_ub_b99p6 0.00 99.61 FUNCTION_LIST ACIFI IF_DATA DIM_X DIRECT 0x81120A /end CHARACTERISTIC
/begin CHARACTERISTIC DTKATMN "Hysterese Katalysatortemperaturregelschwelle für Kat warmhalten" VALUE 0x8197F2 KwUb 1275. temp_ub_q5_o50 -50.00 1225. FUNCTION_LIST BBKHZ IF_DATA DIM_X DIRECT 0x8197F2 /end CHARACTERISTIC
/begin CHARACTERISTIC DTKTDGRAX "Katdiagnose: Maximaler Temperaturgradient" VALUE 0x8186E3 KwUb 1275. temp_ub_q5 0.00 1275. FUNCTION_LIST DKATSPEB IF_DATA DIM_X DIRECT 0x8186E3 /end CHARACTERISTIC
/begin CHARACTERISTIC DTMABDTMN "Min. Differenz Motortemperatur zwischen Abstellen und Neustart für Diagnose TMOT" VALUE 0x819765 KwUb 191.3 temp_ub_b191p25 0.00 191.3 FUNCTION_LIST GGTFM IF_DATA DIM_X DIRECT 0x819765 /end CHARACTERISTIC
/begin CHARACTERISTIC DTMABSTOL "Delta  Motortemperatur nach Abstellen zu Start des Motors" VALUE 0x81A8AE KwUb 191.3 temp_ub_b191p25 0.00 191.3 FUNCTION_LIST BGTOL IF_DATA DIM_X DIRECT 0x81A8AE /end CHARACTERISTIC
/begin CHARACTERISTIC DTMDMA "Abstand Motortemperaturmodell zur Starttemperatur" VALUE 0x819766 KwUb 191.3 temp_ub_b191p25 0.00 191.3 FUNCTION_LIST GGTFM IF_DATA DIM_X DIRECT 0x819766 /end CHARACTERISTIC
/begin CHARACTERISTIC DTMDNPO "Abstand Motortemperaturmodell zur oberen Unplausibilitätsschwelle" VALUE 0x819767 KwUb 191.3 temp_ub_b191p25 0.00 191.3 FUNCTION_LIST GGTFM IF_DATA DIM_X DIRECT 0x819767 /end CHARACTERISTIC
/begin CHARACTERISTIC DTMDSLA "Temperaturdifferenz zwischen Abstellen und Neustart für Zusatzdiagnose" VALUE 0x818366 KwUb 191.3 temp_ub_b191p25 0.00 191.3 FUNCTION_LIST DSLSLRS IF_DATA DIM_X DIRECT 0x818366 /end CHARACTERISTIC
/begin CHARACTERISTIC DTMFFU "Differenz Abstelltemperatur - tmot im Start für 0.5 mm - Diagnose" VALUE 0x81A79E KwUb 191.3 temp_sb_q0p75 0.00 191.3 FUNCTION_LIST DLDP IF_DATA DIM_X DIRECT 0x81A79E /end CHARACTERISTIC
/begin CHARACTERISTIC DTMHLL "Delta Motortemperatur für Abbruch erhöhte Solldrehzahl im Heiß-Leerlauf" VALUE 0x819F3B KwUb 191.3 temp_ub_b191p25 0.00 191.3 FUNCTION_LIST LLRNS IF_DATA DIM_X DIRECT 0x819F3B /end CHARACTERISTIC
/begin CHARACTERISTIC DTMKI "Sicherheitsoffset zwischen Kühlmitteltemperatur aus Kombiinstrument und tmot" VALUE 0x8197D9 KwUb 191.3 temp_ub_b191p25 0.00 191.3 FUNCTION_LIST GGGTS IF_DATA DIM_X DIRECT 0x8197D9 /end CHARACTERISTIC
/begin CHARACTERISTIC DTMLDP "Differenz Motorabstelltemperatur - TMOT bei Start" VALUE 0x81A79F KwUb 191.3 temp_sb_q0p75 0.00 191.3 FUNCTION_LIST DLDP IF_DATA DIM_X DIRECT 0x81A79F /end CHARACTERISTIC
/begin CHARACTERISTIC DTMR "Hysterese für Einschaltschwelle" VALUE 0x8126F0 KwUb 191.3 temp_ub_b191p25 0.00 191.3 FUNCTION_LIST LRSEB IF_DATA DIM_X DIRECT 0x8126F0 /end CHARACTERISTIC
/begin CHARACTERISTIC DTMSRT "Delta Motortemp.zu Starttemp. f.Retrigg. Modelle (Blockheater-Erkennung)" VALUE 0x819768 KwUb 191.3 temp_ub_b191p25 0.00 191.3 FUNCTION_LIST GGTFM IF_DATA DIM_X DIRECT 0x819768 /end CHARACTERISTIC
/begin CHARACTERISTIC DTMTMRW "Temperaturdiff.-Schwelle für die Prüfung, ob Zwangseinschaltung LR nötig (CARB)" VALUE 0x81A4A3 KwSb 191.3 temp_sb_q0p75 -96.00 95.25 FUNCTION_LIST LRSEB IF_DATA DIM_X DIRECT 0x81A4A3 /end CHARACTERISTIC
/begin CHARACTERISTIC DTMTOLOFF "Delta  Motortemperatur für Initialisierung Öltemperaturberechnung" VALUE 0x81A8AF KwUb 191.3 temp_ub_b191p25 0.00 191.3 FUNCTION_LIST BGTOL IF_DATA DIM_X DIRECT 0x81A8AF /end CHARACTERISTIC
/begin CHARACTERISTIC DTMWUC "Delta Motortemperaturschwelle für Erfüllung 'warm up cycle'" VALUE 0x810FA2 KwUb 191.3 temp_ub_b191p25 0.00 191.3 FUNCTION_LIST DWUC IF_DATA DIM_X DIRECT 0x810FA2 /end CHARACTERISTIC
/begin CHARACTERISTIC DTPLDP "Delta-Periodendauer zur Berechnung des Fensters bei Leckdiagnose" VALUE 0x817852 KwUw 655.3500 t10msxs_uw_b655p35 0.00 655.3500 FUNCTION_LIST DLDP IF_DATA DIM_X DIRECT 0x817852 /end CHARACTERISTIC
/begin CHARACTERISTIC DTPSWE "Toleranz Periodendauer Schlechtwegsignal" VALUE 0x818458 KwUb 255.0 t100msxms_ub_b255 0.00 255.0 FUNCTION_LIST DSWEA IF_DATA DIM_X DIRECT 0x818458 /end CHARACTERISTIC
/begin CHARACTERISTIC DTPXF "Delta-Periodendauer zur Berechnung des Fensters bei 0.5 mm - Diagnose" VALUE 0x817854 KwUw 655.3500 t10msxs_uw_b655p35 0.00 655.3500 FUNCTION_LIST DLDP IF_DATA DIM_X DIRECT 0x817854 /end CHARACTERISTIC
/begin CHARACTERISTIC DTSDRL "Laständerungsgradientenschwelle für Lastdynamikauslösung" VALUE 0x817BD4 KwSw 1535.977 rel_sw_q0p0234 -768.0000 767.9766 FUNCTION_LIST ZUESZ IF_DATA DIM_X DIRECT 0x817BD4 /end CHARACTERISTIC
/begin CHARACTERISTIC DTUMTAT "Offset Ansauglufttemperatur -> Umgebungstemperatur" VALUE 0x8184A4 KwUb 191.3 temp_ub_b191p25 0.00 191.3 FUNCTION_LIST ATM IF_DATA DIM_X DIRECT 0x8184A4 /end CHARACTERISTIC
/begin CHARACTERISTIC DUBLBZ "Spannungsoffset für Ladebilanzberechnung" VALUE 0x818704 KwUb 17.95 spg_ubatt 0.00 17.95 FUNCTION_LIST BGLBZ IF_DATA DIM_X DIRECT 0x818704 /end CHARACTERISTIC
/begin CHARACTERISTIC DUBZS "Spannungsversatz zwischen SG und ZS" VALUE 0x81AA46 KwUb 17.95 spg_ubatt 0.00 17.95 FUNCTION_LIST ZUESZ IF_DATA DIM_X DIRECT 0x81AA46 /end CHARACTERISTIC
/begin CHARACTERISTIC DUDKPTMP "Delta eines Rampenschrittes bei der temp. UMA-Adaption" VALUE 0x81113E KwUb 0.3064 spg_q1p221_mV 0.004883 0.3113 FUNCTION_LIST BGDVE IF_DATA DIM_X DIRECT 0x81113E /end CHARACTERISTIC
/begin CHARACTERISTIC DUF_T "Zeit fürs Setzen der Zyklusflags der Funktionsüberwachungs-Diagnose" VALUE 0x812680 KwUb 25.50 t100msxs_ub_b25p5 0.00 25.50 FUNCTION_LIST DUF IF_DATA DIM_X DIRECT 0x812680 /end CHARACTERISTIC
/begin CHARACTERISTIC DUPW12 "Zulässige Spannungsabweichung zwischen PWG-Poti 1 und 2" VALUE 0x81103A KwUb 4.980 spg_ub_b5 0.00 4.980 FUNCTION_LIST GGPED IF_DATA DIM_X DIRECT 0x81103A /end CHARACTERISTIC
/begin CHARACTERISTIC DUPW12TG "Zulässige Spannungsabweichung zwischen PWG Poti 1 und  2 im Teilgasbereich" VALUE 0x81103B KwUb 4.980 spg_ub_b5 0.00 4.980 FUNCTION_LIST GGPED IF_DATA DIM_X DIRECT 0x81103B /end CHARACTERISTIC
/begin CHARACTERISTIC DUPW12VG "Zulässige Spannungsabweichung zwischen PWG-Poti 1 und 2 im Vollgasbereich" VALUE 0x81103C KwUb 4.980 spg_ub_b5 0.00 4.980 FUNCTION_LIST GGPED IF_DATA DIM_X DIRECT 0x81103C /end CHARACTERISTIC
/begin CHARACTERISTIC DVBABFF "Geschwindigkeitsdifferenz zur Bergaberkennung bei 0.5 mm - Diagnose" VALUE 0x81A7A0 KwSb 318.8 vfzg_ub_q1p25 -160.0 158.8 FUNCTION_LIST DLDP IF_DATA DIM_X DIRECT 0x81A7A0 /end CHARACTERISTIC
/begin CHARACTERISTIC DVEEST "Zeit für Heilungsversuch der DV-E-Endstufe" VALUE 0x811203 KwUb 2.550 t10msxs_ub_b2p55 0.00 2.550 FUNCTION_LIST ADVE IF_DATA DIM_X DIRECT 0x811203 /end CHARACTERISTIC
/begin CHARACTERISTIC DVFZAR "Hysterese fuer Geschwindigkeitsschwelle bei AR" VALUE 0x811EF4 KwUb 318.8 vfzg_ub_q1p25 0.00 318.8 FUNCTION_LIST ARMD IF_DATA DIM_X DIRECT 0x811EF4 /end CHARACTERISTIC
/begin CHARACTERISTIC DVFZBAB "Geschwindigkeitsdifferenz zur Bergaberkennung" VALUE 0x81A7A1 KwSb 318.8 vfzg_ub_q1p25 -160.0 158.8 FUNCTION_LIST DLDP IF_DATA DIM_X DIRECT 0x81A7A1 /end CHARACTERISTIC
/begin CHARACTERISTIC DVIVZTMX "Maximales Delta zw. Ist- und Zielgeschw. für Tip-Erlaubnis" VALUE 0x81C860 KwUw 511.9922 vfzg_uw_q0p0078125 0.00 511.9922 FUNCTION_LIST FGRFULO IF_DATA DIM_X DIRECT 0x81C860 /end CHARACTERISTIC
/begin CHARACTERISTIC DVNG "LLR: D-Verstärkung abh. von ngfil bei stehendem Fahrzeug" CURVE 0x811CF1 GklWUb 0.1245 rel_qn0p000488 -0.1245 0.00 FUNCTION_LIST LLRRM IF_DATA DIM_X DIRECT 0x811CF1
 /begin AXIS_DESCR COM_AXIS ngfil nmotg_sb_q100 6 -12800. 12700. AXIS_PTS_REF SNG06LLSB /end AXIS_DESCR
/end CHARACTERISTIC
/begin CHARACTERISTIC DVNGV "LLR: D-Verstärkung abh. von ngfil bei roolendem Fahrzeug" CURVE 0x811CF7 GklWUb 0.1245 rel_qn0p000488 -0.1245 0.00 FUNCTION_LIST LLRRM IF_DATA DIM_X DIRECT 0x811CF7
 /begin AXIS_DESCR COM_AXIS ngfil nmotg_sb_q100 6 -12800. 12700. AXIS_PTS_REF SNG06LLSB /end AXIS_DESCR
/end CHARACTERISTIC
/begin CHARACTERISTIC DVSA "delta Geschwindigkeitsschwelle für SA-Drehzahlanhebung" VALUE 0x811C99 KwUb 318.8 vfzg_ub_q1p25 0.00 318.8 FUNCTION_LIST BBSAWE IF_DATA DIM_X DIRECT 0x811C99 /end CHARACTERISTIC
/begin CHARACTERISTIC DVSKNBGA_0_A "Delta Geschwindigkeit für Setzwertkorrektur nach Beschleunigen" CURVE 0x81C862 KlAUbSstUbWUw 511.9922 vfzg_uw_q0p0078125 0.00 511.9922 FUNCTION_LIST FGRFULO IF_DATA DIM_X INDIRECT 0x813BBC /begin AXIS_DESCR STD_AXIS uevges fak_q0p1 8 0.00 25.50 DEPOSIT ABSOLUT /end AXIS_DESCR /end CHARACTERISTIC
/begin CHARACTERISTIC DVSKNBGA_1_A "Delta Geschwindigkeit für Setzwertkorrektur nach Beschleunigen" CURVE 0x81C87C KlAUbSstUbWUw 511.9922 vfzg_uw_q0p0078125 0.00 511.9922 FUNCTION_LIST FGRFULO IF_DATA DIM_X INDIRECT 0x813BC0 /begin AXIS_DESCR STD_AXIS uevges fak_q0p1 8 0.00 25.50 DEPOSIT ABSOLUT /end AXIS_DESCR /end CHARACTERISTIC
/begin CHARACTERISTIC DVSKNVGA_0_A "Delta Geschwindigkeit für Setzwertkorrektur nach Verzögern" CURVE 0x81C8B0 KlAUbSstUbWUw 511.9922 vfzg_uw_q0p0078125 0.00 511.9922 FUNCTION_LIST FGRFULO IF_DATA DIM_X INDIRECT 0x813BC4 /begin AXIS_DESCR STD_AXIS uevges fak_q0p1 8 0.00 25.50 DEPOSIT ABSOLUT /end AXIS_DESCR /end CHARACTERISTIC
/begin CHARACTERISTIC DVSKNVGA_1_A "Delta Geschwindigkeit für Setzwertkorrektur nach Verzögern" CURVE 0x81C8CA KlAUbSstUbWUw 511.9922 vfzg_uw_q0p0078125 0.00 511.9922 FUNCTION_LIST FGRFULO IF_DATA DIM_X INDIRECT 0x813BC8 /begin AXIS_DESCR STD_AXIS uevges fak_q0p1 8 0.00 25.50 DEPOSIT ABSOLUT /end AXIS_DESCR /end CHARACTERISTIC
/begin CHARACTERISTIC DVTIPUD "Änderung der Zielgeschwindigkeit bei Tip-Up oder Tip-Down" VALUE 0x81C8FE KwUw 511.9922 vfzg_uw_q0p0078125 0.00 511.9922 FUNCTION_LIST FGRFULO IF_DATA DIM_X DIRECT 0x81C8FE /end CHARACTERISTIC
/begin CHARACTERISTIC DVZVITMX "Maximales Delta zw. Ziel- und Istgeschw. für Tip-Erlaubnis" VALUE 0x81C900 KwUw 511.9922 vfzg_uw_q0p0078125 0.00 511.9922 FUNCTION_LIST FGRFULO IF_DATA DIM_X DIRECT 0x81C900 /end CHARACTERISTIC
/begin CHARACTERISTIC DVZVIWA "Delta zw. Ziel- und Istgeschw. für Übergang von Konstantfahrt in Wiederaufnahme" VALUE 0x81C902 KwUw 511.9922 vfzg_uw_q0p0078125 0.00 511.9922 FUNCTION_LIST FGRFULO IF_DATA DIM_X DIRECT 0x81C902 /end CHARACTERISTIC
/begin CHARACTERISTIC DWDK12O "Maximal zulässige Abweichung zwischen den DK-Winkeln aus Poti 1 und 2" VALUE 0x81105C KwUb 100.0 relDK_ub_b100 0.00 100.0 FUNCTION_LIST GGDVE IF_DATA DIM_X DIRECT 0x81105C /end CHARACTERISTIC
/begin CHARACTERISTIC DWDK13O "Maximal zulässige Abweichung zwischen DK-Winkel aus Poti 1 und Ersatzwert" VALUE 0x81105D KwUb 100.0 relDK_ub_b100 0.00 100.0 FUNCTION_LIST GGDVE IF_DATA DIM_X DIRECT 0x81105D /end CHARACTERISTIC
/begin CHARACTERISTIC DWDK23O "Maximal zulässige Abweichung zwischen DK-Winkel aus Poti 2 und Ersatzwert" VALUE 0x81105E KwUb 100.0 relDK_ub_b100 0.00 100.0 FUNCTION_LIST GGDVE IF_DATA DIM_X DIRECT 0x81105E /end CHARACTERISTIC
/begin CHARACTERISTIC DWEEMX "maximal zulässige Zunahme Winkel Einspritzende pro Syncro" VALUE 0x811505 KwUb 1530. zw_ub_q6 0.00 1530. FUNCTION_LIST ESVW IF_DATA DIM_X DIRECT 0x811505 /end CHARACTERISTIC
/begin CHARACTERISTIC DWKRMSN "delta Winkel KR Abstand zur gemittelten Spätverstellung" CURVE 0x819A9E GklWUb 191.3 zw_ub_qn0p75 -191.3 0.00 FUNCTION_LIST KRRA IF_DATA DIM_X DIRECT 0x819A9E
 /begin AXIS_DESCR COM_AXIS nmot nmot_ub_q40 16 0.00 10200. AXIS_PTS_REF SNM16KRUB /end AXIS_DESCR
/end CHARACTERISTIC
/begin CHARACTERISTIC DWPEDKOB "Gradient des norm. Fahrpedalwinkels für KOS-Auschalten" VALUE 0x812D80 KwSb 99.60 rel_sb_q0p39 -50.00 49.61 FUNCTION_LIST KOS IF_DATA DIM_X DIRECT 0x812D80 /end CHARACTERISTIC
/begin CHARACTERISTIC DWPEDMDK "minimaler Pedalgradient zur Sperr. des Verlustmomentfilters beim Kriechen (CVT)" VALUE 0x829338 KwSw 99.99847 rel_sw_b50 -50.00000 49.99847 FUNCTION_LIST MDVER IF_DATA DIM_X DIRECT 0x829338 /end CHARACTERISTIC
/begin CHARACTERISTIC DWPR "Delta Prädiktionswinkel ohne Nachspritzer/ti-Reduktion" VALUE 0x811500 KwSb 1530. kw_q6 -768.0 762.0 FUNCTION_LIST BGRLP IF_DATA DIM_X DIRECT 0x811500 /end CHARACTERISTIC
/begin CHARACTERISTIC DWPRNSP "Delta Prädiktionswinkel bei Nachspritzerfreigabe" VALUE 0x811501 KwSb 1530. kw_q6 -768.0 762.0 FUNCTION_LIST BGRLP IF_DATA DIM_X DIRECT 0x811501 /end CHARACTERISTIC
/begin CHARACTERISTIC DYADMXN "Max. Wert des add. Dynamikvorhalts" CURVE 0x811C38 FklWUb 20.25 zw_ub_qn0p75 -20.25 0.00 FUNCTION_LIST KRDY IF_DATA DIM_X DIRECT 0x811C38 /begin AXIS_DESCR FIX_AXIS stuetz dez 5 0.00 4.000 FIX_AXIS_PAR 0 0 5 /end AXIS_DESCR /end CHARACTERISTIC
/begin CHARACTERISTIC DYADS "Add. Spätverstellung pro Zyk. durch lern. Dyn." VALUE 0x811C3D KwUb 24.00 zw_ub_qn0p75 -24.00 0.00 FUNCTION_LIST KRDY IF_DATA DIM_X DIRECT 0x811C3D /end CHARACTERISTIC
/begin CHARACTERISTIC DYAFVS "Stufenhöhe für Abregelung des Dynamikvorhalts" VALUE 0x811C3E KwUb 20.25 zw_ub_q0p75 0.00 20.25 FUNCTION_LIST KRDY IF_DATA DIM_X DIRECT 0x811C3E /end CHARACTERISTIC
/begin CHARACTERISTIC DYAMNV "Min. Wert des add. Dynamikvorhalts" VALUE 0x811C3F KwUb 24.00 zw_ub_qn0p75 -24.00 0.00 FUNCTION_LIST KRDY IF_DATA DIM_X DIRECT 0x811C3F /end CHARACTERISTIC
/begin CHARACTERISTIC DYAVF "Abregelkonstante für Dynamikvorhalt" VALUE 0x811C40 KwUb 254.0 dez 1.000 255.0 FUNCTION_LIST KRDY IF_DATA DIM_X DIRECT 0x811C40 /end CHARACTERISTIC
/begin CHARACTERISTIC DYNLSUFA "Grenzwert für LSU-Dynamik bei Kurztest" VALUE 0x81C76C KwUw 15.99976 fak_uw_b16 0.00 15.99976 FUNCTION_LIST DLSU IF_DATA DIM_X DIRECT 0x81C76C /end CHARACTERISTIC
/begin CHARACTERISTIC DYNLSUMX "Grenzwert für LSU-Dynamik" VALUE 0x81C76E KwUw 15.99976 fak_uw_b16 0.00 15.99976 FUNCTION_LIST DLSU IF_DATA DIM_X DIRECT 0x81C76E /end CHARACTERISTIC
/begin CHARACTERISTIC DYNLSURD "reduzierter Grenzwert für LSU-Dynamik" VALUE 0x81C770 KwUw 15.99976 fak_uw_b16 0.00 15.99976 FUNCTION_LIST DLSU IF_DATA DIM_X DIRECT 0x81C770 /end CHARACTERISTIC
/begin CHARACTERISTIC DYNLSUTO "obere Grenze für dynlsusa, CARB-Tester, DLSSALRS" VALUE 0x818A0E KwUb 4.980 fak_q0p0195 0.00 4.980 FUNCTION_LIST DLSSA TC5MOD IF_DATA DIM_X DIRECT 0x818A0E /end CHARACTERISTIC
/begin CHARACTERISTIC DYNLSUTU "untere Grenze für dynlsusa, CARB-Tester, DLSSALRS" VALUE 0x818A0F KwUb 4.980 fak_q0p0195 0.00 4.980 FUNCTION_LIST DLSSA TC5MOD IF_DATA DIM_X DIRECT 0x818A0F /end CHARACTERISTIC
/begin CHARACTERISTIC DZUPHL "Zähldauer des Entprellzählers Heilung" VALUE 0x81121E KwUb 255.0 dez 0.00 255.0 FUNCTION_LIST DZUEET IF_DATA DIM_X DIRECT 0x81121E /end CHARACTERISTIC
/begin CHARACTERISTIC DZUPKSMS "Zähldauer des Entprellzählers KS nach Masse" VALUE 0x81121F KwUb 255.0 dez 0.00 255.0 FUNCTION_LIST DZUEET IF_DATA DIM_X DIRECT 0x81121F /end CHARACTERISTIC
/begin CHARACTERISTIC DZUPKSUB "Zähldauer des Entprellzählers KS nach Ub" VALUE 0x811220 KwUb 255.0 dez 0.00 255.0 FUNCTION_LIST DZUEET IF_DATA DIM_X DIRECT 0x811220 /end CHARACTERISTIC
/begin CHARACTERISTIC DZUPSIG "Zähldauer des Entprellzählers Leitungsabfall" VALUE 0x811221 KwUb 255.0 dez 0.00 255.0 FUNCTION_LIST DZUEET IF_DATA DIM_X DIRECT 0x811221 /end CHARACTERISTIC
/begin CHARACTERISTIC DZWAML "Auf/Abregelgeschwindigkeit zwischen den Begrenzungskennfeldern" CURVE 0x82AF20 KlAUbSstUbWSb 94.50 zw_sb_q0p75 0.7500 95.25 FUNCTION_LIST ZWMIN IF_DATA DIM_X DIRECT 0x82AF20 /begin AXIS_DESCR STD_AXIS ml m_ub_b1020 12 0.00 1020. DEPOSIT ABSOLUT /end AXIS_DESCR /end CHARACTERISTIC
/begin CHARACTERISTIC DZWDYN "Frühverschiebung des Brenngrenzenzündwinkels bei Tip-In" CURVE 0x81A916 GklWSb 191.3 zw_sb_q0p75 -96.00 95.25 FUNCTION_LIST ZWMIN IF_DATA DIM_X DIRECT 0x81A916
 /begin AXIS_DESCR COM_AXIS tmot temp_ub_q0p75_o48 6 -48.00 143.3 AXIS_PTS_REF STM06__UB /end AXIS_DESCR
/end CHARACTERISTIC
/begin CHARACTERISTIC DZWETA "Deltazündwinkel aus Wirkungsgrad" CURVE 0x8127AA FklWSb 191.3 zw_sb_q0p75 -96.00 95.25 FUNCTION_LIST MDZW IF_DATA DIM_X DIRECT 0x8127AA
 /begin AXIS_DESCR FIX_AXIS etazws rel_ub_b127p5 201 0.00 100.0 FIX_AXIS_PAR 0 0 201 /end AXIS_DESCR
/end CHARACTERISTIC
/begin CHARACTERISTIC DZWOLA "Lambda-Abhängigkeit des optimalen Zündwinkels bezogen auf Lambda 1" CURVE 0x817156 KlAUbSstUbWSb 191.3 zw_sb_q0p75 -96.00 95.25 FUNCTION_LIST MDBAS IF_DATA DIM_X DIRECT 0x817156 /begin AXIS_DESCR STD_AXIS lambas fak_ub_b2 10 0.00 1.992 DEPOSIT ABSOLUT /end AXIS_DESCR /end CHARACTERISTIC
/begin CHARACTERISTIC DZWOM "temperaturabhängiger Offset des optimalen ZW" CURVE 0x81716C KlAUbSstUbWSb 191.3 zw_sb_q0p75 -96.00 95.25 FUNCTION_LIST MDBAS IF_DATA DIM_X DIRECT 0x81716C
 /begin AXIS_DESCR STD_AXIS tmot temp_ub_q0p75_o48 5 -48.00 143.3 DEPOSIT ABSOLUT /end AXIS_DESCR
/end CHARACTERISTIC
/begin CHARACTERISTIC DZWSPM "Delta spätester Zündwinkel abhängig von Motortemperatur" CURVE 0x81A91C GklWSb 191.3 zw_sb_q0p75 -96.00 95.25 FUNCTION_LIST ZWMIN IF_DATA DIM_X DIRECT 0x81A91C
 /begin AXIS_DESCR COM_AXIS tmot temp_ub_q0p75_o48 6 -48.00 143.3 AXIS_PTS_REF STM06__UB /end AXIS_DESCR
/end CHARACTERISTIC
/begin CHARACTERISTIC DZWTIN "delta-Zündwinkel bei Tip in" CURVE 0x819BB5 GklWUb 20.25 zw_ub_qn0p75 -20.25 0.00 FUNCTION_LIST KRDY IF_DATA DIM_X DIRECT 0x819BB5
 /begin AXIS_DESCR COM_AXIS nmot nmot_ub_q40 16 0.00 10200. AXIS_PTS_REF SNM16KRUB /end AXIS_DESCR
/end CHARACTERISTIC
/begin CHARACTERISTIC DZW_AOG "oberer Grenzwert Anpassung Zündwinkel additiv" VALUE 0x811C50 KwSb 191.3 zw_sb_q0p75 -96.00 95.25 FUNCTION_LIST TKMWL KRACT IF_DATA DIM_X DIRECT 0x811C50 /end CHARACTERISTIC
/begin CHARACTERISTIC DZW_AUG "unterer Grenzwert Anpassung Zündwinkel additiv" VALUE 0x811C51 KwSb 191.3 zw_sb_q0p75 -96.00 95.25 FUNCTION_LIST TKMWL KRACT IF_DATA DIM_X DIRECT 0x811C51 /end CHARACTERISTIC
/begin CHARACTERISTIC DZZST "Anzahl Zähne bei Zahnunterdrückung im Start" VALUE 0x810FC3 KwUb 254.0 dez 0.00 254.0 FUNCTION_LIST GGDPG IF_DATA DIM_X DIRECT 0x810FC3 /end CHARACTERISTIC
/begin CHARACTERISTIC DZZSTNLP "Anzahl der Entprellzähne bei Notlauf-Phasengeber" VALUE 0x810FC4 KwUb 254.0 dez 0.00 254.0 FUNCTION_LIST GGDPG IF_DATA DIM_X DIRECT 0x810FC4 /end CHARACTERISTIC
/begin CHARACTERISTIC EBEN "Bypass-Hauptschalter" VALUE 0x810FA8 KwUb 255.0 default 0.00 255.0 FUNCTION_LIST DISTAB12 IF_DATA DIM_X DIRECT 0x810FA8 /end CHARACTERISTIC
/begin CHARACTERISTIC EBMISS_T "" VALUE 0x813FC4 KwUw 65535.00 default 0.00 65535.00 FUNCTION_LIST DISTAB12 IF_DATA DIM_X DIRECT 0x813FC4 /end CHARACTERISTIC
/begin CHARACTERISTIC EBMISS_Y "" VALUE 0x813FC6 KwUw 65535.00 default 0.00 65535.00 FUNCTION_LIST DISTAB12 IF_DATA DIM_X DIRECT 0x813FC6 /end CHARACTERISTIC
/begin CHARACTERISTIC EDLDRP "Schwelle Regelabweichung für Diagnose LDR-Regelabweichung positiv" VALUE 0x819E4E KwSb 1270. p_sb_q10 0.00 1270. FUNCTION_LIST DLDR IF_DATA DIM_X DIRECT 0x819E4E /end CHARACTERISTIC
/begin CHARACTERISTIC ELDOB "Regelabweichungsschwelle für Start Zeitzähler LDR-Overboost activ" VALUE 0x819D50 KwSb 1270. p_sb_q10 0.00 1270. FUNCTION_LIST LDOB IF_DATA DIM_X DIRECT 0x819D50 /end CHARACTERISTIC
/begin CHARACTERISTIC ENSAKHG "Freigabe Schubabschalten bei Katheizen gangabhaengig" VALUE 0x811C9A KwUb 255.0 dez 0.00 255.0 FUNCTION_LIST BBSAWE IF_DATA DIM_X DIRECT 0x811C9A /end CHARACTERISTIC
/begin CHARACTERISTIC ENTDKLL "Entjitterschwelle (Ink) für DK-Sollwert im Leerlauf (B_ll)" VALUE 0x811338 KwUb 20.00 dez 0.00 20.00 FUNCTION_LIST FUEDKSA IF_DATA DIM_X DIRECT 0x811338 /end CHARACTERISTIC
/begin CHARACTERISTIC ENTDKNLL "Entjitterschwelle (Ink) für DK-Sollwert außerhalb Leerlauf (!B_ll)" VALUE 0x811339 KwUb 20.00 dez 0.00 20.00 FUNCTION_LIST FUEDKSA IF_DATA DIM_X DIRECT 0x811339 /end CHARACTERISTIC
/begin CHARACTERISTIC ESKONF_0_A "Konfiguration Endstufen" VAL_BLK 0x811210 KwbUb 255.0 dez 0.00 255.0 NUMBER 7 FUNCTION_LIST DEKON DZUEET IF_DATA DIM_X INDIRECT 0x813B64 /end CHARACTERISTIC
/begin CHARACTERISTIC ETALAM "Lambda-Wirkungsgrad" CURVE 0x811FD5 KlAUbSstUbWUb 127.5 rel_ub_b127p5 0.00 127.5 FUNCTION_LIST MDBAS IF_DATA DIM_X DIRECT 0x811FD5 /begin AXIS_DESCR STD_AXIS lambas fak_ub_b2 10 0.00 1.992 DEPOSIT ABSOLUT /end AXIS_DESCR /end CHARACTERISTIC
/begin CHARACTERISTIC ETAZWTEN "minimale Zündwinkelwirkungsgrad Schwelle für DTEV" VALUE 0x81A720 KwUb 60.00 rel_ub_b127p5 0.00 60.00 FUNCTION_LIST DTEV IF_DATA DIM_X DIRECT 0x81A720 /end CHARACTERISTIC
/begin CHARACTERISTIC ETRIMN "Minimaler I-Anteil Tastverhältnis zur Ansteuerung elektr. Thermostatventil" VALUE 0x81AC17 KwSb 199.2 rel_sb_b100 -100.0 99.22 FUNCTION_LIST KMTR IF_DATA DIM_X DIRECT 0x81AC17 /end CHARACTERISTIC
/begin CHARACTERISTIC ETRIMX "Maximaler I-Anteil Tastverhältnis zur Ansteuerung elektr. Thermostatventil" VALUE 0x81AC18 KwSb 199.2 rel_sb_b100 -100.0 99.22 FUNCTION_LIST KMTR IF_DATA DIM_X DIRECT 0x81AC18 /end CHARACTERISTIC
/begin CHARACTERISTIC EVTMODMNDK "min. Temperatur bei der Offset nicht zu DK-Kennlinie bei nmot=0 addiert wird" VALUE 0x811329 KwUb 191.3 temp_ub_q0p75_o48 -48.00 143.3 FUNCTION_LIST FUEDK IF_DATA DIM_X DIRECT 0x811329 /end CHARACTERISTIC
/begin CHARACTERISTIC EVTMODO "Offset für evtmod abhängig von gefilterter Motortemperatur" CURVE 0x8188B2 KlAUbSstUbWUb 191.3 temp_ub_q0p75_o48 -48.00 143.3 FUNCTION_LIST BGTEMPK IF_DATA DIM_X DIRECT 0x8188B2
 /begin AXIS_DESCR STD_AXIS tmotfil temp_ub_q0p75_o48 12 -48.00 143.3 DEPOSIT ABSOLUT /end AXIS_DESCR
/end CHARACTERISTIC
/begin CHARACTERISTIC EVZ_DAT_UC "" VAL_BLK 0x8122D3 KwbUb 255.0 dez 0.00 255.0 NUMBER 16 FUNCTION_LIST URCEIN IF_DATA DIM_X DIRECT 0x8122D3 /end CHARACTERISTIC
/begin CHARACTERISTIC FABMDWA "Faktor zur Absteuerung des Wandlermoments abhängig von nturb/nsol" CURVE 0x811DB2 KlAUbSstUbWUb 0.9961 fak_ub_b1 0.00 0.9961 FUNCTION_LIST MDWAN IF_DATA DIM_X DIRECT 0x811DB2 /begin AXIS_DESCR STD_AXIS qntns fak_ub_b8 6 0.00 7.969 DEPOSIT ABSOLUT /end AXIS_DESCR /end CHARACTERISTIC
/begin CHARACTERISTIC FABSTT "Faktor Abstellzeit für Modelltemparatur" CURVE 0x81E632 KlAUwSstUwWUw 1.999969 fak_uw_b2 0.00 1.999969 FUNCTION_LIST GGTFM IF_DATA DIM_X DIRECT 0x81E632
 /begin AXIS_DESCR STD_AXIS tabst_w t1sxs_uw_q1 5 0.00 65535.00 DEPOSIT ABSOLUT /end AXIS_DESCR
/end CHARACTERISTIC
/begin CHARACTERISTIC FAINTEN "Anzahl Intervalle zur Freigabe Ti - Abschaltung" VALUE 0x818457 KwUb 255.0 dez 0.00 255.0 FUNCTION_LIST DMDMIL IF_DATA DIM_X DIRECT 0x818457 /end CHARACTERISTIC
/begin CHARACTERISTIC FAKTABGM "Wichtungsfaktor für tabgm (Abgastemperatur)  zur Berechnung der stat. Brennraumt" VALUE 0x8188CB KwUb 1.992 fak_ub_b2 0.00 1.992 FUNCTION_LIST BGTEMPK IF_DATA DIM_X DIRECT 0x8188CB /end CHARACTERISTIC
/begin CHARACTERISTIC FASKIV1 "Faktor für Verlängerung 1. KAT-Intervall, Aussetzererkennung" VALUE 0x810D2C KwUb 4.000 dez 1.000 5.000 FUNCTION_LIST DMDMIL IF_DATA DIM_X DIRECT 0x810D2C /end CHARACTERISTIC
/begin CHARACTERISTIC FATMRML "Faktor fuer die Aufteilung Abgas-/Abgas-Rohrwandtemperatur" CURVE 0x8184A5 GklWUb 0.9961 fak_ub_b1 0.00 0.9961 FUNCTION_LIST ATM IF_DATA DIM_X DIRECT 0x8184A5
 /begin AXIS_DESCR COM_AXIS ml_w m_uw_b6553p5 7 0.00 6553.500 AXIS_PTS_REF SML07TMUW /end AXIS_DESCR
/end CHARACTERISTIC
/begin CHARACTERISTIC FATRKRML "Faktor fuer die Aufteilung Abgas-/Abgas-Rohrwandtemperatur im Krümmer" CURVE 0x8184AC GklWUb 0.9961 fak_ub_b1 0.00 0.9961 FUNCTION_LIST ATM IF_DATA DIM_X DIRECT 0x8184AC
 /begin AXIS_DESCR COM_AXIS ml_w m_uw_b6553p5 7 0.00 6553.500 AXIS_PTS_REF SML07TMUW /end AXIS_DESCR
/end CHARACTERISTIC
/begin CHARACTERISTIC FBA_AOG "oberer Grenzwert Anpassung Faktor BA" VALUE 0x811C52 KwUb 1.992 fak_ub_b2 0.00 1.992 FUNCTION_LIST TKMWL KRACT IF_DATA DIM_X DIRECT 0x811C52 /end CHARACTERISTIC
/begin CHARACTERISTIC FBA_AUG "unterer Grenzwert Anpassung Faktor BA" VALUE 0x811C53 KwUb 1.992 fak_ub_b2 0.00 1.992 FUNCTION_LIST TKMWL KRACT IF_DATA DIM_X DIRECT 0x811C53 /end CHARACTERISTIC
/begin CHARACTERISTIC FBFGRSFW "Korrekturfaktor für FGR-Sollbeschleunigung" CURVE 0x81C904 KlAUbSstSbWUb 1.992 fak_ub_b2 0.00 1.992 FUNCTION_LIST FGRFULO IF_DATA DIM_X DIRECT 0x81C904 /begin AXIS_DESCR STD_AXIS fawifgr rel_q0p25 6 -32.00 31.75 DEPOSIT ABSOLUT /end AXIS_DESCR /end CHARACTERISTIC
/begin CHARACTERISTIC FBKVP "Faktor zur Berechnung des min. Pumpdrucks abhängig von Umgebungsdruck" VALUE 0x82B1B4 KwUw 1.999969 fak_uw_b2 0.00 1.999969 FUNCTION_LIST GGPBKV DBKVP IF_DATA DIM_X DIRECT 0x82B1B4 /end CHARACTERISTIC
/begin CHARACTERISTIC FBSTABGM "Faktor Bauteileschutz abhängig von model. Abgastemperatur" CURVE 0x81E4F0 KlAUwSstUwWUw 1.999969 fak_uw_b2 0.00 1.999969 FUNCTION_LIST LAMBTS IF_DATA DIM_X DIRECT 0x81E4F0
 /begin AXIS_DESCR STD_AXIS tabgbts_w temp_uw_q0p0195_o50 4 -50.00000 1229.980 DEPOSIT ABSOLUT /end AXIS_DESCR
/end CHARACTERISTIC
/begin CHARACTERISTIC FBSTMOT "Offset Bauteileschutz abhängig von Motor-Temperatur" CURVE 0x81E502 KlAUbSstUbWSb 1.992 fak_sb_b1 -1.000 0.9922 FUNCTION_LIST LAMBTS IF_DATA DIM_X DIRECT 0x81E502
 /begin AXIS_DESCR STD_AXIS tmot temp_ub_q0p75_o48 4 -48.00 143.3 DEPOSIT ABSOLUT /end AXIS_DESCR
/end CHARACTERISTIC
/begin CHARACTERISTIC FBTEB "Faktor Begrenzung Lerngeschwindigkeit für Beladung" CURVE 0x81A545 KlAUbSstUbWUb 0.9961 fak_ub_b1 0.00 0.9961 FUNCTION_LIST TEB IF_DATA DIM_X DIRECT 0x81A545
 /begin AXIS_DESCR STD_AXIS ftefvab fak_ub_b0p03125 6 0.00 0.03113 DEPOSIT ABSOLUT /end AXIS_DESCR
/end CHARACTERISTIC
/begin CHARACTERISTIC FBTEVA "Faktor ftefva-abhängige Lerngeschwindigkeit der Beladung" CURVE 0x81A552 KlAUbSstUbWUb 0.9961 fak_ub_b1 0.00 0.9961 FUNCTION_LIST TEB IF_DATA DIM_X DIRECT 0x81A552 /begin AXIS_DESCR STD_AXIS ftefva fak_ub_b0p5 6 0.00 0.4980 DEPOSIT ABSOLUT /end AXIS_DESCR /end CHARACTERISTIC
/begin CHARACTERISTIC FBWRMSL "Bewertungsfaktor für gleitende Mittelwertsbildung von rmsl" VALUE 0x818367 KwUb 0.9961 fak_ub_b1 0.00 0.9961 FUNCTION_LIST DSLSLRS IF_DATA DIM_X DIRECT 0x818367 /end CHARACTERISTIC
/begin CHARACTERISTIC FBZBTEML "Bewertungsfaktor Integrationsgeschwindigkeit Beladungsfaktor" CURVE 0x81A55F KlAUbSstUbWUb 0.9961 fak_ub_b1 0.00 0.9961 FUNCTION_LIST TEB IF_DATA DIM_X DIRECT 0x81A55F /begin AXIS_DESCR STD_AXIS abo dez 5 0.00 255.0 DEPOSIT ABSOLUT /end AXIS_DESCR /end CHARACTERISTIC
/begin CHARACTERISTIC FBZFRAT "Bewertungsfaktor für Integrationsgeschwindigkeit KFFRAT als f(abo)" CURVE 0x819043 KlAUbSstUbWUb 0.9961 fak_ub_b1 0.00 0.9961 FUNCTION_LIST LRA IF_DATA DIM_X DIRECT 0x819043 /begin AXIS_DESCR STD_AXIS abo dez 5 0.00 255.0 DEPOSIT ABSOLUT /end AXIS_DESCR /end CHARACTERISTIC
/begin CHARACTERISTIC FDDN "LLR: Gewichtungsfaktor für D-Verstärkung" CURVE 0x811CFD GklWUb 0.9961 fak_ub_b1 0.00 0.9961 FUNCTION_LIST LLRRM IF_DATA DIM_X DIRECT 0x811CFD
 /begin AXIS_DESCR COM_AXIS dns nmotd_sb_q10 6 -1280. 1270. AXIS_PTS_REF SNS06LLSB /end AXIS_DESCR
/end CHARACTERISTIC
/begin CHARACTERISTIC FDMDWAN "Wichtungsfaktor für Einrechnung D-Anteil in Wandlermoment" VALUE 0x811DBF KwUb 0.9961 fak_ub_b1 0.00 0.9961 FUNCTION_LIST MDWAN IF_DATA DIM_X DIRECT 0x811DBF /end CHARACTERISTIC
/begin CHARACTERISTIC FDNIKOR "Faktor für Korrektur auif I-Anteil über dn" VALUE 0x811D03 KwUb 1.992 fak_ub_b2 0.00 1.992 FUNCTION_LIST LLRRM IF_DATA DIM_X DIRECT 0x811D03 /end CHARACTERISTIC
/begin CHARACTERISTIC FDVANS "Temperaturfaktor für Drosselventildurchfluß" CURVE 0x8188CC KlAUbSstUbWUb 1.992 fak_ub_b2 0.00 1.992 FUNCTION_LIST BGTEMPK IF_DATA DIM_X DIRECT 0x8188CC
 /begin AXIS_DESCR STD_AXIS tans temp_ub_q0p75_o48 8 -48.00 143.3 DEPOSIT ABSOLUT /end AXIS_DESCR
/end CHARACTERISTIC
/begin AXIS_PTS SDZ08DMUB "SST-Verteilung in DMD, 8 Drehzahl-SST" 0x810234 nmot SstAUbSstUb 10200. nmot_ub_q40 8 0.00 10200. FUNCTION_LIST DMDFON DEPOSIT ABSOLUT IF_DATA DIM_X DIRECT 0x810234 /end AXIS_PTS
/begin AXIS_PTS SDZ08DMUB2 "SST-Verteilung in DMD, 8 Drehzahl-SST" 0x81023D nmot SstAUbSstUb 10200. nmot_ub_q40 8 0.00 10200. FUNCTION_LIST DMDFON DEPOSIT ABSOLUT IF_DATA DIM_X DIRECT 0x81023D /end AXIS_PTS
/begin AXIS_PTS SDZ08DMUB3 "SST-Verteilung in DMD, 8 Drehzahl-SST" 0x810246 nmot SstAUbSstUb 10200. nmot_ub_q40 8 0.00 10200. FUNCTION_LIST DMDFON DEPOSIT ABSOLUT IF_DATA DIM_X DIRECT 0x810246 /end AXIS_PTS
/begin AXIS_PTS SML07TMUW "Stützstellenverteilung, Luftmasse, 7 Stützstellen" 0x81B172 ml_w SstAUwSstUw 6553.500 m_uw_b6553p5 7 0.00 6553.500 FUNCTION_LIST SSTB ATM DEPOSIT ABSOLUT IF_DATA DIM_X DIRECT 0x81B172 /end AXIS_PTS
/begin AXIS_PTS SNG06LLSB "Stützstellenverteilung Drehzahlgradient, 6 Sst." 0x810075 ngfil SstAUbSstSb 25500. nmotg_sb_q100 6 -12800. 12700. FUNCTION_LIST SSTB LLRRM DEPOSIT ABSOLUT IF_DATA DIM_X DIRECT 0x810075 /end AXIS_PTS
/begin AXIS_PTS SNM06GKUB "Stützstellen KFLAMKR, DLAMOB" 0x8181F9 nmot SstAUbSstUb 10200. nmot_ub_q40 6 0.00 10200. FUNCTION_LIST SSTB LAMFAW DEPOSIT ABSOLUT IF_DATA DIM_X DIRECT 0x8181F9 /end AXIS_PTS
/begin AXIS_PTS SNM06LLUB "Sützstellenverteilung für Motordrehzahl" 0x813A6C nmot_w SstAUwSstUw 16383.75 nmot_uw_q0p25 6 0.00 16383.75 FUNCTION_LIST SSTB LLRMR LLRRM DEPOSIT ABSOLUT IF_DATA DIM_X DIRECT 0x813A6C /end AXIS_PTS
/begin AXIS_PTS SNM08DMUB "SST-Verteilung in DMD, 8 Drehzahl-SST" 0x81007C nmot SstAUbSstUb 10200. nmot_ub_q40 8 0.00 10200. FUNCTION_LIST SSTB DMDDLU DMDLU DMDLUA DMDMIL DMDSTP DEPOSIT ABSOLUT IF_DATA DIM_X DIRECT 0x81007C /end AXIS_PTS
/begin AXIS_PTS SNM16KRUB "Stützstellenverteilung Drehzahl, 16 Sst." 0x818250 nmot SstAUbSstUb 10200. nmot_ub_q40 16 0.00 10200. FUNCTION_LIST SSTB DKRS GGKS KRDY KRKE KRRA DEPOSIT ABSOLUT IF_DATA DIM_X DIRECT 0x818250 /end AXIS_PTS
/begin AXIS_PTS SNS06LLSB "Stützstellenvert., Solldrehzahlabw., 06 Sst., LL-Regel." 0x81A071 dns SstAUbSstSb 2550. nmotd_sb_q10 6 -1280. 1270. FUNCTION_LIST LLRNS LLRMR LLRRM DEPOSIT ABSOLUT IF_DATA DIM_X DIRECT 0x81A071 /end AXIS_PTS
/begin AXIS_PTS SRL08DMUB "SST-Verteilung in DMD, 8 Last-SST" 0x8100E3 rl SstAUbSstUb 191.3 rel_ub_q0p75 8 0.00 191.3 FUNCTION_LIST SSTB DMDDLU DMDLU DMDLUA DMDSTP DEPOSIT ABSOLUT IF_DATA DIM_X DIRECT 0x8100E3 /end AXIS_PTS
/begin AXIS_PTS STM06__UB "Stützstellenverteilung Motortemperatur, 6 Sst." 0x8182B0 tmot SstAUbSstUb 191.3 temp_ub_q0p75_o48 6 -48.00 143.3 FUNCTION_LIST SSTB ZWMIN DEPOSIT ABSOLUT IF_DATA DIM_X DIRECT 0x8182B0 /end AXIS_PTS
/begin AXIS_PTS STW08MDUB "Stützstellenverteilung  Temperatur des Drehmomentenwandlers" 0x81A0DE twnd SstAUbSstUb 191.3 temp_ub_q0p75_o48 8 -48.00 143.3 FUNCTION_LIST MDWAN DEPOSIT ABSOLUT IF_DATA DIM_X DIRECT 0x81A0DE /end AXIS_PTS
/begin COMPU_METHOD adb_uw_q0p00195 "" RAT_FUNC "%6.4" "hPa/V" COEFFS 0 65536 0 0 0 128 /end COMPU_METHOD
/begin COMPU_METHOD DEZ "1 : 1 Umrechnug (dez/hex)" RAT_FUNC "%6.2" "" COEFFS 0 1 0 0 0 1 /end COMPU_METHOD
/begin COMPU_METHOD dez "1 : 1 Umrechnug (dez/hex)" RAT_FUNC "%6.2" "" COEFFS 0 1 0 0 0 1 /end COMPU_METHOD
/begin COMPU_METHOD dgrad_uw_q0p015 "" RAT_FUNC "%6.4" "hPa/V" COEFFS 0 65536 0 0 0 1024 /end COMPU_METHOD
/begin COMPU_METHOD dtsegn_b11p25divZyl "" RAT_FUNC "%6.4" "grad/KW" COEFFS 0 45.5111 0 0 0 1 /end COMPU_METHOD
/begin COMPU_METHOD fak_q0p000244 "" RAT_FUNC "%6.5" "-" COEFFS 0 65536 0 0 0 16 /end COMPU_METHOD
/begin COMPU_METHOD fak_q0p0195 "" RAT_FUNC "%6.4" "-" COEFFS 0 256 0 0 0 5 /end COMPU_METHOD
/begin COMPU_METHOD fak_q0p1 "" RAT_FUNC "%6.3" "" COEFFS 0 1 0 0 0 0.1 /end COMPU_METHOD
/begin COMPU_METHOD fak_sb_b1 "" RAT_FUNC "%6.4" "-" COEFFS 0 256 0 0 0 2 /end COMPU_METHOD
/begin COMPU_METHOD fak_sw_b1 "" RAT_FUNC "%7.6" "-" COEFFS 0 65536 0 0 0 2 /end COMPU_METHOD
/begin COMPU_METHOD fak_sw_b64 "" RAT_FUNC "%6.4" "-" COEFFS 0 65536 0 0 0 128 /end COMPU_METHOD
/begin COMPU_METHOD fak_ub_b0p03125 "" RAT_FUNC "%6.5" "-" COEFFS 0 256 0 0 0 0.03125 /end COMPU_METHOD
/begin COMPU_METHOD fak_ub_b0p1_o0p05 "" RAT_FUNC "%8.7" "-" COEFFS 0 256 12.8 0 0 0.1 /end COMPU_METHOD
/begin COMPU_METHOD fak_ub_b0p5 "" RAT_FUNC "%6.4" "-" COEFFS 0 256 0 0 0 0.5 /end COMPU_METHOD
/begin COMPU_METHOD fak_ub_b1 "" RAT_FUNC "%6.4" "-" COEFFS 0 256 0 0 0 1 /end COMPU_METHOD
/begin COMPU_METHOD fak_ub_b2 "" RAT_FUNC "%6.4" "-" COEFFS 0 256 0 0 0 2 /end COMPU_METHOD
/begin COMPU_METHOD fak_ub_b8 "" RAT_FUNC "%6.4" "-" COEFFS 0 256 0 0 0 8 /end COMPU_METHOD
/begin COMPU_METHOD fak_uw_b1 "" RAT_FUNC "%7.6" "-" COEFFS 0 65536 0 0 0 1 /end COMPU_METHOD
/begin COMPU_METHOD fak_uw_b1024 "" RAT_FUNC "%6.4" "-" COEFFS 0 65536 0 0 0 1024 /end COMPU_METHOD
/begin COMPU_METHOD fak_uw_b16 "" RAT_FUNC "%6.5" "-" COEFFS 0 65536 0 0 0 16 /end COMPU_METHOD
/begin COMPU_METHOD fak_uw_b2 "" RAT_FUNC "%7.6" "-" COEFFS 0 65536 0 0 0 2 /end COMPU_METHOD
/begin COMPU_METHOD fak_uw_b4 "" RAT_FUNC "%7.6" "-" COEFFS 0 65536 0 0 0 4 /end COMPU_METHOD
/begin COMPU_METHOD fak_uw_b8 "" RAT_FUNC "%6.5" "-" COEFFS 0 65536 0 0 0 8 /end COMPU_METHOD
/begin COMPU_METHOD kw_q6 "" RAT_FUNC "%6.2" "°KW" COEFFS 0 1 0 0 0 6 /end COMPU_METHOD
/begin COMPU_METHOD luquant "Umrechnung Laufunruhe in DMD" RAT_FUNC "%6.3" "(Umdr./sec)^2" COEFFS 0 1.47862 0 0 0 1 /end COMPU_METHOD
/begin COMPU_METHOD m_q0p00277 "" RAT_FUNC "%6.4" "g" COEFFS 0 360 0 0 0 1 /end COMPU_METHOD
/begin COMPU_METHOD m_q0p0031 "" RAT_FUNC "%6.4" "kg/h" COEFFS 0 320 0 0 0 1 /end COMPU_METHOD
/begin COMPU_METHOD m_q0p004 "" RAT_FUNC "%6.4" "kg/h" COEFFS 0 250 0 0 0 1 /end COMPU_METHOD
/begin COMPU_METHOD m_q0p1 "" RAT_FUNC "%6.3" "kg/h" COEFFS 0 10 0 0 0 1 /end COMPU_METHOD
/begin COMPU_METHOD m_q2p71Em5_g "" RAT_FUNC "%7.6" "g" COEFFS 0 65536 0 0 0 1.77778 /end COMPU_METHOD
/begin COMPU_METHOD m_sw_q0p1 "" RAT_FUNC "%6.3" "kg/h" COEFFS 0 1 0 0 0 0.1 /end COMPU_METHOD
/begin COMPU_METHOD m_ub_b1020 "" RAT_FUNC "%6.2" "kg/h" COEFFS 0 1 0 0 0 4 /end COMPU_METHOD
/begin COMPU_METHOD m_ub_q0p4 "" RAT_FUNC "%6.3" "kg" COEFFS 0 1 0 0 0 0.4 /end COMPU_METHOD
/begin COMPU_METHOD m_uw_b25p6 "" RAT_FUNC "%6.5" "kg/h" COEFFS 0 65536 0 0 0 25.6 /end COMPU_METHOD
/begin COMPU_METHOD m_uw_b6553p5 "" RAT_FUNC "%6.3" "kg/h" COEFFS 0 1 0 0 0 0.1 /end COMPU_METHOD
/begin COMPU_METHOD m_uw_q0p0005 "" RAT_FUNC "%6.5" "kg/h" COEFFS 0 1 0 0 0 0.0005 /end COMPU_METHOD
/begin COMPU_METHOD m_uw_q3p2 "" RAT_FUNC "%6.2" "kg/h" COEFFS 0 1 0 0 0 3.2 /end COMPU_METHOD
/begin COMPU_METHOD nmotd_sb_q10 "" RAT_FUNC "%6.1" "U/min" COEFFS 0 1 0 0 0 10 /end COMPU_METHOD
/begin COMPU_METHOD nmotg_sb_q100 "" RAT_FUNC "%6.0" "U/min/s" COEFFS 0 1 0 0 0 100 /end COMPU_METHOD
/begin COMPU_METHOD nmotg_sw_q0p39 "" RAT_FUNC "%6.3" "U/min/s" COEFFS 0 1 0 0 0 0.39063 /end COMPU_METHOD
/begin COMPU_METHOD nmot_q0p1453421 "" RAT_FUNC "%6.3" "U/min" COEFFS 0 1 0 0 0 0.145342 /end COMPU_METHOD
/begin COMPU_METHOD nmot_q1 "" RAT_FUNC "%6.2" "U/min" COEFFS 0 1 0 0 0 1 /end COMPU_METHOD
/begin COMPU_METHOD nmot_sb_q10 "" RAT_FUNC "%6.1" "U/min" COEFFS 0 1 0 0 0 10 /end COMPU_METHOD
/begin COMPU_METHOD nmot_sw_q0p25 "" RAT_FUNC "%6.3" "U/min" COEFFS 0 1 0 0 0 0.25 /end COMPU_METHOD
/begin COMPU_METHOD nmot_ub_q0p25 "" RAT_FUNC "%6.3" "U/min" COEFFS 0 1 0 0 0 0.25 /end COMPU_METHOD
/begin COMPU_METHOD nmot_ub_q10 "" RAT_FUNC "%6.1" "U/min" COEFFS 0 1 0 0 0 10 /end COMPU_METHOD
/begin COMPU_METHOD nmot_ub_q40 "" RAT_FUNC "%6.1" "Upm" COEFFS 0 1 0 0 0 40 /end COMPU_METHOD
/begin COMPU_METHOD nmot_uw_q0p25 "" RAT_FUNC "%6.3" "U/min" COEFFS 0 1 0 0 0 0.25 /end COMPU_METHOD
/begin COMPU_METHOD nw_dmdstp_sy "" RAT_FUNC "%6.3" "NwU" COEFFS 0 4 0 0 0 1 /end COMPU_METHOD
/begin COMPU_METHOD perio_sw_b1p562 "" RAT_FUNC "%7.6" "1/s" COEFFS 0 65536 0 0 0 3.124 /end COMPU_METHOD
/begin COMPU_METHOD perio_sw_b6p125 "" RAT_FUNC "%6.5" "1/s" COEFFS 0 65536 0 0 0 12.25 /end COMPU_METHOD
/begin COMPU_METHOD pgrad_q0p039 "" RAT_FUNC "%6.4" "hPa/s" COEFFS 0 128 0 0 0 5 /end COMPU_METHOD
/begin COMPU_METHOD pgrad_q0p15625 "" RAT_FUNC "%6.3" "hPa/s" COEFFS 0 32 0 0 0 5 /end COMPU_METHOD
/begin COMPU_METHOD p_sb_q0p625 "" RAT_FUNC "%6.3" "hPa" COEFFS 0 128 0 0 0 80 /end COMPU_METHOD
/begin COMPU_METHOD p_sb_q10 "" RAT_FUNC "%6.1" "hPa" COEFFS 0 1 0 0 0 10 /end COMPU_METHOD
/begin COMPU_METHOD p_sw_q0p039 "" RAT_FUNC "%6.4" "hPa" COEFFS 0 256 0 0 0 10 /end COMPU_METHOD
/begin COMPU_METHOD p_sw_q0p078 "" RAT_FUNC "%6.4" "hPa" COEFFS 0 65536 0 0 0 5120 /end COMPU_METHOD
/begin COMPU_METHOD p_ub_q10 "" RAT_FUNC "%6.1" "hPa" COEFFS 0 1 0 0 0 10 /end COMPU_METHOD
/begin COMPU_METHOD p_ub_q5 "" RAT_FUNC "%6.2" "hPa" COEFFS 0 1 0 0 0 5 /end COMPU_METHOD
/begin COMPU_METHOD p_uw_b32 "" RAT_FUNC "%6.5" "hPa/%" COEFFS 0 65536 0 0 0 32 /end COMPU_METHOD
/begin COMPU_METHOD p_uw_q0p039 "" RAT_FUNC "%6.4" "hPa" COEFFS 0 256 0 0 0 10 /end COMPU_METHOD
/begin COMPU_METHOD p_uw_q0p078 "" RAT_FUNC "%6.4" "hpa" COEFFS 0 256 0 0 0 20 /end COMPU_METHOD
/begin COMPU_METHOD qptemp_q10p667 "" RAT_FUNC "%6.1" "J/K" COEFFS 0 3 0 0 0 32 /end COMPU_METHOD
/begin COMPU_METHOD q_q64 "" RAT_FUNC "%6.1" "J" COEFFS 0 1 0 0 0 64 /end COMPU_METHOD
/begin COMPU_METHOD relDK_q0p00152 "" RAT_FUNC "%6.4" "%DK" COEFFS 0 65536 0 0 0 100 /end COMPU_METHOD
/begin COMPU_METHOD relDK_q0p0625 "" RAT_FUNC "%6.4" "%PWM/%DK" COEFFS 0 16 0 0 0 1 /end COMPU_METHOD
/begin COMPU_METHOD relDK_q0p3922 "" RAT_FUNC "%6.3" "% DK" COEFFS 0 255 0 0 0 100 /end COMPU_METHOD
/begin COMPU_METHOD relDK_q1 "" RAT_FUNC "%6.2" "%PWM/%DK" COEFFS 0 1 0 0 0 1 /end COMPU_METHOD
/begin COMPU_METHOD relDK_q4 "" RAT_FUNC "%6.2" "%PWM/%DK" COEFFS 0 1 0 0 0 4 /end COMPU_METHOD
/begin COMPU_METHOD relDK_ub_b100 "" RAT_FUNC "%6.3" "% DK" COEFFS 0 255 0 0 0 100 /end COMPU_METHOD
/begin COMPU_METHOD relDK_uw_b100 "" RAT_FUNC "%6.4" "% DK" COEFFS 0 65535 0 0 0 100 /end COMPU_METHOD
/begin COMPU_METHOD relNWU_q0p0234 "" RAT_FUNC "%6.4" "%/NWU" COEFFS 0 32 0 0 0 0.75 /end COMPU_METHOD
/begin COMPU_METHOD rel_q0p00305 "" RAT_FUNC "%6.4" "%/(U/min)" COEFFS 0 256 0 0 0 0.7812 /end COMPU_METHOD
/begin COMPU_METHOD rel_q0p009766 "" RAT_FUNC "%6.4" "%" COEFFS 0 65536 0 0 0 640 /end COMPU_METHOD
/begin COMPU_METHOD rel_q0p1957 "" RAT_FUNC "%6.3" "%" COEFFS 0 511 0 0 0 100 /end COMPU_METHOD
/begin COMPU_METHOD rel_q0p249 "" RAT_FUNC "%6.3" "%" COEFFS 0 1 0 0 0 0.249 /end COMPU_METHOD
/begin COMPU_METHOD rel_q0p25 "" RAT_FUNC "%6.3" "%/V" COEFFS 0 1 0 0 0 0.25 /end COMPU_METHOD
/begin COMPU_METHOD rel_q0p392 "" RAT_FUNC "%6.3" "%" COEFFS 0 255 0 0 0 100 /end COMPU_METHOD
/begin COMPU_METHOD rel_qn0p000488 "" RAT_FUNC "%8.7" "(%*s)/(U/min)" COEFFS 0 -256 0 0 0 0.125 /end COMPU_METHOD
/begin COMPU_METHOD rel_sb_b100 "" RAT_FUNC "%6.3" "%" COEFFS 0 128 0 0 0 100 /end COMPU_METHOD
/begin COMPU_METHOD rel_sb_q0p39 "" RAT_FUNC "%6.3" "%" COEFFS 0 1 0 0 0 0.3906 /end COMPU_METHOD
/begin COMPU_METHOD rel_sw_b100 "" RAT_FUNC "%6.4" "%" COEFFS 0 32768 0 0 0 100 /end COMPU_METHOD
/begin COMPU_METHOD rel_sw_b50 "" RAT_FUNC "%6.4" "%" COEFFS 0 65536 0 0 0 100 /end COMPU_METHOD
/begin COMPU_METHOD rel_sw_q0p0234 "" RAT_FUNC "%6.4" "%/seg" COEFFS 0 32 0 0 0 0.75 /end COMPU_METHOD
/begin COMPU_METHOD rel_ub_b100 "" RAT_FUNC "%6.3" "%" COEFFS 0 256 0 0 0 100 /end COMPU_METHOD
/begin COMPU_METHOD rel_ub_b127p5 "" RAT_FUNC "%6.3" "%" COEFFS 0 2 0 0 0 1 /end COMPU_METHOD
/begin COMPU_METHOD rel_ub_b24p9 "" RAT_FUNC "%6.3" "%" COEFFS 0 255 0 0 0 24.9 /end COMPU_METHOD
/begin COMPU_METHOD rel_ub_b99p6 "" RAT_FUNC "%6.3" "%" COEFFS 0 256 0 0 0 100 /end COMPU_METHOD
/begin COMPU_METHOD rel_ub_bn24p9 "" RAT_FUNC "%6.5" "%" COEFFS 0 -255 0 0 0 24.9 /end COMPU_METHOD
/begin COMPU_METHOD rel_ub_q0p00153 "" RAT_FUNC "%6.4" "%" COEFFS 0 256 0 0 0 0.3906 /end COMPU_METHOD
/begin COMPU_METHOD rel_ub_q0p3906 "" RAT_FUNC "%6.3" "%" COEFFS 0 256 0 0 0 100 /end COMPU_METHOD
/begin COMPU_METHOD rel_ub_q0p75 "" RAT_FUNC "%6.3" "%" COEFFS 0 1 0 0 0 0.75 /end COMPU_METHOD
/begin COMPU_METHOD rel_uw_b100 "" RAT_FUNC "%6.4" "%" COEFFS 0 65536 0 0 0 100 /end COMPU_METHOD
/begin COMPU_METHOD rel_uw_b200 "" RAT_FUNC "%6.4" "%" COEFFS 0 65536 0 0 0 200 /end COMPU_METHOD
/begin COMPU_METHOD rel_uw_q0p0234 "" RAT_FUNC "%6.4" "%" COEFFS 0 32 0 0 0 0.75 /end COMPU_METHOD
/begin COMPU_METHOD spg_q1p221_mV "" RAT_FUNC "%6.4" "V" COEFFS 0 65536 0 0 0 80 /end COMPU_METHOD
/begin COMPU_METHOD spg_sw_b5 "" RAT_FUNC "%6.4" "V" COEFFS 0 1024 0 0 0 10 /end COMPU_METHOD
/begin COMPU_METHOD spg_ubatt "" RAT_FUNC "%6.4" "V" COEFFS 0 1 0 0 0 0.0704 /end COMPU_METHOD
/begin COMPU_METHOD spg_ub_b5 "" RAT_FUNC "%6.4" "V" COEFFS 0 256 0 0 0 5 /end COMPU_METHOD
/begin COMPU_METHOD t100msxms_ub_b255 "" RAT_FUNC "%6.2" "ms" COEFFS 0 1 0 0 0 1 /end COMPU_METHOD
/begin COMPU_METHOD t100msxs_ub_b25p5 "" RAT_FUNC "%6.3" "s" COEFFS 0 1 0 0 0 0.1 /end COMPU_METHOD
/begin COMPU_METHOD t10msxs_ub_b2p55 "" RAT_FUNC "%6.4" "s" COEFFS 0 1 0 0 0 0.01 /end COMPU_METHOD
/begin COMPU_METHOD t10msxs_uw_b655p35 "" RAT_FUNC "%6.4" "s" COEFFS 0 1 0 0 0 0.01 /end COMPU_METHOD
/begin COMPU_METHOD t1sxs_ub_b255 "" RAT_FUNC "%6.2" "s" COEFFS 0 1 0 0 0 1 /end COMPU_METHOD
/begin COMPU_METHOD t1sxs_uw_q1 "" RAT_FUNC "%6.2" "s" COEFFS 0 1 0 0 0 1 /end COMPU_METHOD
/begin COMPU_METHOD t20msxs_ub_b5p1 "" RAT_FUNC "%6.4" "s" COEFFS 0 1 0 0 0 0.02 /end COMPU_METHOD
/begin COMPU_METHOD t40ms_ub_b10200 "" RAT_FUNC "%7.2" "ms" COEFFS 0 1 0 0 0 40 /end COMPU_METHOD
/begin COMPU_METHOD temp_sb_q0p75 "" RAT_FUNC "%6.3" "Grad C" COEFFS 0 1 0 0 0 0.75 /end COMPU_METHOD
/begin COMPU_METHOD temp_sw_q0p75 "" RAT_FUNC "%6.3" "Grad C" COEFFS 0 4 0 0 0 3 /end COMPU_METHOD
/begin COMPU_METHOD temp_ub_b191p25 "" RAT_FUNC "%6.3" "Grad C" COEFFS 0 1 0 0 0 0.75 /end COMPU_METHOD
/begin COMPU_METHOD temp_ub_q0p75 "" RAT_FUNC "%6.3" "Grad C" COEFFS 0 1 7.31383e-307 0 0 0.75 /end COMPU_METHOD
/begin COMPU_METHOD temp_ub_q0p75_o48 "" RAT_FUNC "%6.2" "Grad C" COEFFS 0 1 48 0 0 0.75 /end COMPU_METHOD
/begin COMPU_METHOD temp_ub_q5 "" RAT_FUNC "%6.2" "Grad C" COEFFS 0 1 0 0 0 5 /end COMPU_METHOD
/begin COMPU_METHOD temp_ub_q5_o50 "" RAT_FUNC "%6.2" "Grad C" COEFFS 0 1 50 0 0 5 /end COMPU_METHOD
/begin COMPU_METHOD temp_uw_q0p0195 "" RAT_FUNC "%6.4" "Grad C" COEFFS 0 256 0 0 0 5 /end COMPU_METHOD
/begin COMPU_METHOD temp_uw_q0p0195_o50 "" RAT_FUNC "%6.2" "Grad C" COEFFS 0 256 12800 0 0 5 /end COMPU_METHOD
/begin COMPU_METHOD tknockcon_sy "" RAT_FUNC "%8.7" "s" COEFFS 0 375000 0 0 0 1 /end COMPU_METHOD
/begin COMPU_METHOD tknockintgrad_sy "" RAT_FUNC "%6.3" "V/s" COEFFS 0 8.94855 0 0 0 1 /end COMPU_METHOD
/begin COMPU_METHOD vfzg_ub_q1p25 "" RAT_FUNC "%6.2" "km/h" COEFFS 0 1 0 0 0 1.25 /end COMPU_METHOD
/begin COMPU_METHOD vfzg_uw_q0p0078125 "" RAT_FUNC "%6.4" "km/h" COEFFS 0 1 0 0 0 0.0078125 /end COMPU_METHOD
/begin COMPU_METHOD zw_sb_q0p75 "" RAT_FUNC "%6.3" "grad KW" COEFFS 0 255 0 0 0 191.25 /end COMPU_METHOD
/begin COMPU_METHOD zw_ub_q0p75 "" RAT_FUNC "%6.3" "Grad KW" COEFFS 0 255 0 0 0 191.25 /end COMPU_METHOD
/begin COMPU_METHOD zw_ub_q6 "" RAT_FUNC "%6.2" "Grad KW" COEFFS 0 255 0 0 0 1530 /end COMPU_METHOD
/begin COMPU_METHOD zw_ub_qn0p75 "" RAT_FUNC "%6.4" "grad KW" COEFFS 0 1 0 0 0 -0.75 /end COMPU_METHOD
/begin COMPU_METHOD default "" RAT_FUNC "%6.2" "" COEFFS 0 1 0 0 0 1 /end COMPU_METHOD
/begin RECORD_LAYOUT FklWSb FNC_VALUES 1 SBYTE COLUMN_DIR DIRECT /end RECORD_LAYOUT
/begin RECORD_LAYOUT FklWUb FNC_VALUES 1 UBYTE COLUMN_DIR DIRECT /end RECORD_LAYOUT
/begin RECORD_LAYOUT GklWSb FNC_VALUES 1 SBYTE COLUMN_DIR DIRECT /end RECORD_LAYOUT
/begin RECORD_LAYOUT GklWSw FNC_VALUES 1 SWORD COLUMN_DIR DIRECT /end RECORD_LAYOUT
/begin RECORD_LAYOUT GklWUb FNC_VALUES 1 UBYTE COLUMN_DIR DIRECT /end RECORD_LAYOUT
/begin RECORD_LAYOUT GklWUw FNC_VALUES 1 UWORD COLUMN_DIR DIRECT /end RECORD_LAYOUT
/begin RECORD_LAYOUT KfAxUbAyUbSstxSwSstyUbWSw NO_AXIS_PTS_X 1 UBYTE NO_AXIS_PTS_Y 2 UBYTE AXIS_PTS_X 3 SWORD INDEX_INCR DIRECT AXIS_PTS_Y 4 UBYTE INDEX_INCR DIRECT FNC_VALUES 5 SWORD COLUMN_DIR DIRECT /end RECORD_LAYOUT
/begin RECORD_LAYOUT KlASwSstSwWSw NO_AXIS_PTS_X 1 SWORD AXIS_PTS_X 2 SWORD INDEX_INCR DIRECT FNC_VALUES 3 SWORD COLUMN_DIR DIRECT /end RECORD_LAYOUT
/begin RECORD_LAYOUT KlAUbSstSbWUb NO_AXIS_PTS_X 1 UBYTE AXIS_PTS_X 2 SBYTE INDEX_INCR DIRECT FNC_VALUES 3 UBYTE COLUMN_DIR DIRECT /end RECORD_LAYOUT
/begin RECORD_LAYOUT KlAUbSstUbWSb NO_AXIS_PTS_X 1 UBYTE AXIS_PTS_X 2 UBYTE INDEX_INCR DIRECT FNC_VALUES 3 SBYTE COLUMN_DIR DIRECT /end RECORD_LAYOUT
/begin RECORD_LAYOUT KlAUbSstUbWUb NO_AXIS_PTS_X 1 UBYTE AXIS_PTS_X 2 UBYTE INDEX_INCR DIRECT FNC_VALUES 3 UBYTE COLUMN_DIR DIRECT /end RECORD_LAYOUT
/begin RECORD_LAYOUT KlAUbSstUbWUw NO_AXIS_PTS_X 1 UBYTE AXIS_PTS_X 2 UBYTE INDEX_INCR DIRECT FNC_VALUES 3 UWORD COLUMN_DIR DIRECT /end RECORD_LAYOUT
/begin RECORD_LAYOUT KlAUwSstSwWUw NO_AXIS_PTS_X 1 UWORD AXIS_PTS_X 2 SWORD INDEX_INCR DIRECT FNC_VALUES 3 UWORD COLUMN_DIR DIRECT /end RECORD_LAYOUT
/begin RECORD_LAYOUT KlAUwSstUwWSw NO_AXIS_PTS_X 1 UWORD AXIS_PTS_X 2 UWORD INDEX_INCR DIRECT FNC_VALUES 3 SWORD COLUMN_DIR DIRECT /end RECORD_LAYOUT
/begin RECORD_LAYOUT KlAUwSstUwWUw NO_AXIS_PTS_X 1 UWORD AXIS_PTS_X 2 UWORD INDEX_INCR DIRECT FNC_VALUES 3 UWORD COLUMN_DIR DIRECT /end RECORD_LAYOUT
/begin RECORD_LAYOUT KwbUb FNC_VALUES 1 UBYTE COLUMN_DIR DIRECT /end RECORD_LAYOUT
/begin RECORD_LAYOUT KwbUw FNC_VALUES 1 UWORD COLUMN_DIR DIRECT /end RECORD_LAYOUT
/begin RECORD_LAYOUT KwSb FNC_VALUES 1 SBYTE COLUMN_DIR DIRECT /end RECORD_LAYOUT
/begin RECORD_LAYOUT KwSw FNC_VALUES 1 SWORD COLUMN_DIR DIRECT /end RECORD_LAYOUT
/begin RECORD_LAYOUT KwUb FNC_VALUES 1 UBYTE COLUMN_DIR DIRECT /end RECORD_LAYOUT
/begin RECORD_LAYOUT KwUw FNC_VALUES 1 UWORD COLUMN_DIR DIRECT /end RECORD_LAYOUT
/begin RECORD_LAYOUT SstAUbSstSb NO_AXIS_PTS_X 1 UBYTE AXIS_PTS_X 2 SBYTE INDEX_INCR DIRECT /end RECORD_LAYOUT
/begin RECORD_LAYOUT SstAUbSstUb NO_AXIS_PTS_X 1 UBYTE AXIS_PTS_X 2 UBYTE INDEX_INCR DIRECT /end RECORD_LAYOUT
/begin RECORD_LAYOUT SstAUwSstUw NO_AXIS_PTS_X 1 UWORD AXIS_PTS_X 2 UWORD INDEX_INCR DIRECT /end RECORD_LAYOUT
/end MODULE
/end PROJECT
