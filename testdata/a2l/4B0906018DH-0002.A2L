/* 4B0906018DH 0002 (HW 0261207928, SW 1037363930, 24E/Dst02o) - VERIFIED map definition.
Built from 24EX_F4g.a2l (project 4016.32). Only objects whose address in this binary is
confirmed by two independent sources (or by the code in IDA) are kept.
KFPED/KFPEDR = coding variant 0, KFPED_VAR1/KFPEDR_VAR1 = coding variant 1 (4th digit 8).
MEASUREMENTs removed. Import into WinOLS with address offset 0x800000. */
/* Erstellt von DAMOS++ V1.17 */
/begin PROJECT X505S24EX "4016.32"
/begin HEADER "" VERSION "X505S24EX" PROJECT_NO X505S24EX /end HEADER
/begin MODULE DIM ""
/begin MOD_PAR "4016.32" VERSION "PrV = X24ex mit 5s" ADDR_EPK 0x810005 EPK "41/1/ME7.5/5/4016.32//X24ex/Dst5s/151101/" CUSTOMER_NO "5" USER "" PHONE_NO "" CPU_TYPE "S80166" ECU "ME7.5" MEMORY_LAYOUT PRG_CODE 0x800000 0x10000 -1 -1 -1 -1 -1 MEMORY_LAYOUT PRG_CODE 0x820000 0x6A00 -1 -1 -1 -1 -1 MEMORY_LAYOUT PRG_CODE 0x830000 0x50000 -1 -1 -1 -1 -1 MEMORY_LAYOUT PRG_CODE 0x880000 0x80000 -1 -1 -1 -1 -1 MEMORY_LAYOUT PRG_DATA 0x810000 0x10000 -1 -1 -1 -1 -1 MEMORY_LAYOUT PRG_DATA 0x826A00 0x9600 -1 -1 -1 -1 -1
 SYSTEM_CONSTANT "ANZ_VARTAB" "132"
 SYSTEM_CONSTANT "ANZ_VARTABC" "132"
 SYSTEM_CONSTANT "EPK_MAX_LEN" "80"
 SYSTEM_CONSTANT "FPPANZ" "28"
 SYSTEM_CONSTANT "SK_ME75" "1"
 SYSTEM_CONSTANT "SK_PECC650" "1"
 SYSTEM_CONSTANT "SK_UMHC05" "1"
 SYSTEM_CONSTANT "SWOFFDL_REQUEST_MASK" "8191"
 SYSTEM_CONSTANT "SY_2HFM" "0"
 SYSTEM_CONSTANT "SY_2SG" "0"
 SYSTEM_CONSTANT "SY_2SGHST" "0"
 SYSTEM_CONSTANT "SY_2SLS" "0"
 SYSTEM_CONSTANT "SY_2TEV" "0"
 SYSTEM_CONSTANT "SY_AAU" "0"
 SYSTEM_CONSTANT "SY_AAV" "0"
 SYSTEM_CONSTANT "SY_ABGKL" "0"
 SYSTEM_CONSTANT "SY_ABGY" "0"
 SYSTEM_CONSTANT "SY_ABGYVBP" "0"
 SYSTEM_CONSTANT "SY_ABMZND" "0"
 SYSTEM_CONSTANT "SY_ADR" "0"
 SYSTEM_CONSTANT "SY_AEKPBI" "0"
 SYSTEM_CONSTANT "SY_AFR" "0"
 SYSTEM_CONSTANT "SY_AGR" "0"
 SYSTEM_CONSTANT "SY_AGRGSTA" "0"
 SYSTEM_CONSTANT "SY_AGRKOMP" "0"
 SYSTEM_CONSTANT "SY_AGRVBP" "0"
 SYSTEM_CONSTANT "SY_AGR_DSS" "0"
 SYSTEM_CONSTANT "SY_AIRBAG" "1"
 SYSTEM_CONSTANT "SY_ALLRAD_NIVEAU" "0"
 SYSTEM_CONSTANT "SY_ASAP" "100"
 SYSTEM_CONSTANT "SY_ASG" "0"
 SYSTEM_CONSTANT "SY_ASICRUNTIME" "0"
 SYSTEM_CONSTANT "SY_ASM" "0"
 SYSTEM_CONSTANT "SY_ASR" "1"
 SYSTEM_CONSTANT "SY_ASTIKR" "0"
 SYSTEM_CONSTANT "SY_ASTIKR2" "0"
 SYSTEM_CONSTANT "SY_ASTNHK" "0"
 SYSTEM_CONSTANT "SY_ASTNHK2" "0"
 SYSTEM_CONSTANT "SY_ASTNTL" "0"
 SYSTEM_CONSTANT "SY_ASTNTL2" "0"
 SYSTEM_CONSTANT "SY_ASTNVK" "0"
 SYSTEM_CONSTANT "SY_ASTNVK2" "0"
 SYSTEM_CONSTANT "SY_ASTVHK" "0"
 SYSTEM_CONSTANT "SY_ASTVHK2" "0"
 SYSTEM_CONSTANT "SY_ASTVVK" "0"
 SYSTEM_CONSTANT "SY_ASTVVK2" "0"
 SYSTEM_CONSTANT "SY_ASV" "0"
 SYSTEM_CONSTANT "SY_ATLB" "0"
 SYSTEM_CONSTANT "SY_ATMLA" "0"
 SYSTEM_CONSTANT "SY_ATMST" "0"
 SYSTEM_CONSTANT "SY_ATMZA" "0"
 SYSTEM_CONSTANT "SY_ATR" "0"
 SYSTEM_CONSTANT "SY_AWUE" "0"
 SYSTEM_CONSTANT "SY_AZUESHF" "3"
 SYSTEM_CONSTANT "SY_BATTSG" "0"
 SYSTEM_CONSTANT "SY_BBPHSYN" "0"
 SYSTEM_CONSTANT "SY_BDE" "0"
 SYSTEM_CONSTANT "SY_BGSRM" "1"
 SYSTEM_CONSTANT "SY_BGVMX" "1"
 SYSTEM_CONSTANT "SY_BGVZS" "0"
 SYSTEM_CONSTANT "SY_BH" "0"
 SYSTEM_CONSTANT "SY_BKV" "2"
 SYSTEM_CONSTANT "SY_BKVP" "3"
 SYSTEM_CONSTANT "SY_BLOOP" "0"
 SYSTEM_CONSTANT "SY_BNWSX" "0"
 SYSTEM_CONSTANT "SY_BUKDIAG" "0"
 SYSTEM_CONSTANT "SY_C167CS" "0"
 SYSTEM_CONSTANT "SY_C167CS_IRAM" "0"
 SYSTEM_CONSTANT "SY_C167CS_XRAM" "0"
 SYSTEM_CONSTANT "SY_CAN" "1"
 SYSTEM_CONSTANT "SY_CANAC" "1"
 SYSTEM_CONSTANT "SY_CANALL" "0"
 SYSTEM_CONSTANT "SY_CANBR8" "0"
 SYSTEM_CONSTANT "SY_CANGRA" "5"
 SYSTEM_CONSTANT "SY_CANLHV" "0"
 SYSTEM_CONSTANT "SY_CANNIV" "0"
 SYSTEM_CONSTANT "SY_CANZAS" "0"
 SYSTEM_CONSTANT "SY_CAN_B" "0"
 SYSTEM_CONSTANT "SY_CAN_C" "0"
 SYSTEM_CONSTANT "SY_CAN_CONFIG" "14"
 SYSTEM_CONSTANT "SY_CDCSIZE" "4"
 SYSTEM_CONSTANT "SY_CDKSIZE" "4"
 SYSTEM_CONSTANT "SY_CDTSIZE" "1"
 SYSTEM_CONSTANT "SY_CHKPROC" "75023"
 SYSTEM_CONSTANT "SY_CJ120" "0"
 SYSTEM_CONSTANT "SY_CJ125" "0"
 SYSTEM_CONSTANT "SY_CJ830" "0"
 SYSTEM_CONSTANT "SY_CJ830RST" "0"
 SYSTEM_CONSTANT "SY_CKBI" "1"
 SYSTEM_CONSTANT "SY_CLASIZE" "1"
 SYSTEM_CONSTANT "SY_CNG" "0"
 SYSTEM_CONSTANT "SY_CONFSL" "1"
 SYSTEM_CONSTANT "SY_COPOTI" "0"
 SYSTEM_CONSTANT "SY_CRCTAB" "2"
 SYSTEM_CONSTANT "SY_CSBVAR" "0"
 SYSTEM_CONSTANT "SY_CVT" "1"
 SYSTEM_CONSTANT "SY_DAGRFC" "4"
 SYSTEM_CONSTANT "SY_DCDACC" "2"
 SYSTEM_CONSTANT "SY_DCSAVE" "0"
 SYSTEM_CONSTANT "SY_DDYLSU" "0"
 SYSTEM_CONSTANT "SY_DECOS" "0"
 SYSTEM_CONSTANT "SY_DEGFE" "2"
 SYSTEM_CONSTANT "SY_DELFCMS" "0"
 SYSTEM_CONSTANT "SY_DFPMENV" "2"
 SYSTEM_CONSTANT "SY_DFPMTIM" "4"
 SYSTEM_CONSTANT "SY_DFPMVAR" "3"
 SYSTEM_CONSTANT "SY_DFPM_DATA_FAR" "0"
 SYSTEM_CONSTANT "SY_DGANZ" "1"
 SYSTEM_CONSTANT "SY_DHELSU" "0"
 SYSTEM_CONSTANT "SY_DIADRL" "0"
 SYSTEM_CONSTANT "SY_DIBLKL" "0"
 SYSTEM_CONSTANT "SY_DIMONL" "0"
 SYSTEM_CONSTANT "SY_DIPRGL" "0"
 SYSTEM_CONSTANT "SY_DIVARL" "0"
 SYSTEM_CONSTANT "SY_DKAT" "2"
 SYSTEM_CONSTANT "SY_DKATEF" "0"
 SYSTEM_CONSTANT "SY_DKATLRS" "0"
 SYSTEM_CONSTANT "SY_DKATNO" "0"
 SYSTEM_CONSTANT "SY_DKATSP" "1"
 SYSTEM_CONSTANT "SY_DKATSPF" "0"
 SYSTEM_CONSTANT "SY_DKATTH" "0"
 SYSTEM_CONSTANT "SY_DKHZ" "0"
 SYSTEM_CONSTANT "SY_DLCKD" "40"
 SYSTEM_CONSTANT "SY_DLCPEN" "40"
 SYSTEM_CONSTANT "SY_DLDP" "1"
 SYSTEM_CONSTANT "SY_DLS" "1"
 SYSTEM_CONSTANT "SY_DLSFV" "0"
 SYSTEM_CONSTANT "SY_DLSHV" "0"
 SYSTEM_CONSTANT "SY_DLSU" "0"
 SYSTEM_CONSTANT "SY_DLSUV" "0"
 SYSTEM_CONSTANT "SY_DMDDVS" "0"
 SYSTEM_CONSTANT "SY_DMDVAR" "1"
 SYSTEM_CONSTANT "SY_DMDZAG" "0"
 SYSTEM_CONSTANT "SY_DMTL" "0"
 SYSTEM_CONSTANT "SY_DOPZW" "1"
 SYSTEM_CONSTANT "SY_DSKNO" "0"
 SYSTEM_CONSTANT "SY_DSKVND" "0"
 SYSTEM_CONSTANT "SY_DSL10MS" "0"
 SYSTEM_CONSTANT "SY_DSL2MS" "1"
 SYSTEM_CONSTANT "SY_DSM" "0"
 SYSTEM_CONSTANT "SY_DTANKL" "1"
 SYSTEM_CONSTANT "SY_DTES" "2"
 SYSTEM_CONSTANT "SY_DTHM" "0"
 SYSTEM_CONSTANT "SY_DVEADA" "1"
 SYSTEM_CONSTANT "SY_EEPROM_ADDRESS_MODE" "0"
 SYSTEM_CONSTANT "SY_EEPROM_SIZE" "512"
 SYSTEM_CONSTANT "SY_EGAS" "1"
 SYSTEM_CONSTANT "SY_EGFE" "13"
 SYSTEM_CONSTANT "SY_EKPRMK" "1"
 SYSTEM_CONSTANT "SY_ELKUP" "0"
 SYSTEM_CONSTANT "SY_ENVBLOK" "2"
 SYSTEM_CONSTANT "SY_EOLT" "0"
 SYSTEM_CONSTANT "SY_ERCOS_TIMER_INPUT_SEL" "5"
 SYSTEM_CONSTANT "SY_ESNWS" "0"
 SYSTEM_CONSTANT "SY_ESTZ" "0"
 SYSTEM_CONSTANT "SY_ESUKNGN" "0"
 SYSTEM_CONSTANT "SY_ETKBYP" "0"
 SYSTEM_CONSTANT "SY_ETRART" "0"
 SYSTEM_CONSTANT "SY_FANT" "0"
 SYSTEM_CONSTANT "SY_FARRAM_EN" "1"
 SYSTEM_CONSTANT "SY_FCMDISP" "0"
 SYSTEM_CONSTANT "SY_FCMIRD" "0"
 SYSTEM_CONSTANT "SY_FCMSIZE" "20"
 SYSTEM_CONSTANT "SY_FDTHM" "0"
 SYSTEM_CONSTANT "SY_FFCSIZE" "11"
 SYSTEM_CONSTANT "SY_FFESIZE" "0"
 SYSTEM_CONSTANT "SY_FFTSIZE" "2"
 SYSTEM_CONSTANT "SY_FFZ" "1"
 SYSTEM_CONSTANT "SY_FLASH_SIZE" "1024"
 SYSTEM_CONSTANT "SY_FLBOOT_V" "0"
 SYSTEM_CONSTANT "SY_FLUQ" "39"
 SYSTEM_CONSTANT "SY_FREQ_CPU" "24000"
 SYSTEM_CONSTANT "SY_FRROM_V" "1283"
 SYSTEM_CONSTANT "SY_FWFGR" "1"
 SYSTEM_CONSTANT "SY_GAP" "2"
 SYSTEM_CONSTANT "SY_GGGTS" "1"
 SYSTEM_CONSTANT "SY_GLST" "0"
 SYSTEM_CONSTANT "SY_GRDWOF" "0"
 SYSTEM_CONSTANT "SY_GRUNDWERT" "72"
 SYSTEM_CONSTANT "SY_HLA" "0"
 SYSTEM_CONSTANT "SY_HLCCARB" "4"
 SYSTEM_CONSTANT "SY_HLSFFET" "0"
 SYSTEM_CONSTANT "SY_HLSHFET" "0"
 SYSTEM_CONSTANT "SY_HWCONFIG_SLS" "1"
 SYSTEM_CONSTANT "SY_HWMSG" "0"
 SYSTEM_CONSTANT "SY_INGASOS" "6"
 SYSTEM_CONSTANT "SY_INI_OBD" "1"
 SYSTEM_CONSTANT "SY_INJTIM_PRE" "64"
 SYSTEM_CONSTANT "SY_INTFLASH_SIZE" "0"
 SYSTEM_CONSTANT "SY_ISOPROT" "0"
 SYSTEM_CONSTANT "SY_KHFMDY" "0"
 SYSTEM_CONSTANT "SY_KL50" "0"
 SYSTEM_CONSTANT "SY_KLDF" "1"
 SYSTEM_CONSTANT "SY_KMTR" "1"
 SYSTEM_CONSTANT "SY_KMTREG" "0"
 SYSTEM_CONSTANT "SY_KNWS" "0"
 SYSTEM_CONSTANT "SY_KOAC" "1"
 SYSTEM_CONSTANT "SY_KOBIDIR" "1"
 SYSTEM_CONSTANT "SY_KOEVAB" "0"
 SYSTEM_CONSTANT "SY_KOPWM" "0"
 SYSTEM_CONSTANT "SY_KORRZ" "1.23"
 SYSTEM_CONSTANT "SY_KRDY" "1"
 SYSTEM_CONSTANT "SY_KRMFTIM_PRE" "64"
 SYSTEM_CONSTANT "SY_KRNDY" "0"
 SYSTEM_CONSTANT "SY_KR_EXT" "0"
 SYSTEM_CONSTANT "SY_KR_INT" "1"
 SYSTEM_CONSTANT "SY_KS1" "0"
 SYSTEM_CONSTANT "SY_KS2" "2"
 SYSTEM_CONSTANT "SY_KS3" "1"
 SYSTEM_CONSTANT "SY_KS4" "3"
 SYSTEM_CONSTANT "SY_KSZA" "4"
 SYSTEM_CONSTANT "SY_KUPFGR" "0"
 SYSTEM_CONSTANT "SY_KUPOT" "0"
 SYSTEM_CONSTANT "SY_KWP2000VAG" "1"
 SYSTEM_CONSTANT "SY_KWP71" "0"
 SYSTEM_CONSTANT "SY_LAMBTS" "1"
 SYSTEM_CONSTANT "SY_LBK" "0"
 SYSTEM_CONSTANT "SY_LECK" "0"
 SYSTEM_CONSTANT "SY_LENKH" "1"
 SYSTEM_CONSTANT "SY_LENKHILFE_PORT" "0"
 SYSTEM_CONSTANT "SY_LFS" "3"
 SYSTEM_CONSTANT "SY_LLR" "0"
 SYSTEM_CONSTANT "SY_LOWRA" "0"
 SYSTEM_CONSTANT "SY_LRFKEF" "0"
 SYSTEM_CONSTANT "SY_LRHCAS" "0"
 SYSTEM_CONSTANT "SY_LRSEZ" "0"
 SYSTEM_CONSTANT "SY_LS" "0"
 SYSTEM_CONSTANT "SY_LSHV" "0"
 SYSTEM_CONSTANT "SY_LSUGR" "0"
 SYSTEM_CONSTANT "SY_LSUMRS" "0"
 SYSTEM_CONSTANT "SY_LUART" "0"
 SYSTEM_CONSTANT "SY_LUEFTKONF" "1072"
 SYSTEM_CONSTANT "SY_LUEKONF" "1072"
 SYSTEM_CONSTANT "SY_LUFIKL" "0"
 SYSTEM_CONSTANT "SY_LUR" "0"
 SYSTEM_CONSTANT "SY_LUV" "0"
 SYSTEM_CONSTANT "SY_LWS" "1"
 SYSTEM_CONSTANT "SY_LZ_SIZE100MS" "1"
 SYSTEM_CONSTANT "SY_LZ_SIZE10MS" "1"
 SYSTEM_CONSTANT "SY_LZ_SIZE1MS" "1"
 SYSTEM_CONSTANT "SY_LZ_SIZE1S" "1"
 SYSTEM_CONSTANT "SY_LZ_SIZE200MS" "1"
 SYSTEM_CONSTANT "SY_LZ_SIZE20MS" "1"
 SYSTEM_CONSTANT "SY_LZ_SIZE2MS" "1"
 SYSTEM_CONSTANT "SY_LZ_SIZE50MS" "1"
 SYSTEM_CONSTANT "SY_LZ_SIZE5MS" "1"
 SYSTEM_CONSTANT "SY_LZ_SIZESYN" "1"
 SYSTEM_CONSTANT "SY_LZ_SIZESYN2" "1"
 SYSTEM_CONSTANT "SY_M1I00A" "190"
 SYSTEM_CONSTANT "SY_M1I00B" "31"
 SYSTEM_CONSTANT "SY_M1I00C" "232"
 SYSTEM_CONSTANT "SY_M1I00D" "17"
 SYSTEM_CONSTANT "SY_M1I20A" "128"
 SYSTEM_CONSTANT "SY_M1I20B" "0"
 SYSTEM_CONSTANT "SY_M1I20C" "16"
 SYSTEM_CONSTANT "SY_M1I20D" "0"
 SYSTEM_CONSTANT "SY_M2I00A" "126"
 SYSTEM_CONSTANT "SY_M2I00B" "24"
 SYSTEM_CONSTANT "SY_M2I00C" "0"
 SYSTEM_CONSTANT "SY_M2I00D" "0"
 SYSTEM_CONSTANT "SY_M5IH00A" "195"
 SYSTEM_CONSTANT "SY_M5IH00B" "0"
 SYSTEM_CONSTANT "SY_M5IH00C" "0"
 SYSTEM_CONSTANT "SY_M5IH00D" "0"
 SYSTEM_CONSTANT "SY_M5IH20A" "0"
 SYSTEM_CONSTANT "SY_M5IH20B" "0"
 SYSTEM_CONSTANT "SY_M5IH20C" "0"
 SYSTEM_CONSTANT "SY_M5IH20D" "0"
 SYSTEM_CONSTANT "SY_M5IH40A" "0"
 SYSTEM_CONSTANT "SY_M5IH40B" "0"
 SYSTEM_CONSTANT "SY_M5IH40C" "0"
 SYSTEM_CONSTANT "SY_M5IH40D" "0"
 SYSTEM_CONSTANT "SY_M5IH60A" "0"
 SYSTEM_CONSTANT "SY_M5IH60B" "0"
 SYSTEM_CONSTANT "SY_M5IH60C" "0"
 SYSTEM_CONSTANT "SY_M5IH60D" "0"
 SYSTEM_CONSTANT "SY_M5IH80A" "0"
 SYSTEM_CONSTANT "SY_M5IH80B" "0"
 SYSTEM_CONSTANT "SY_M5IH80C" "0"
 SYSTEM_CONSTANT "SY_M5IH80D" "0"
 SYSTEM_CONSTANT "SY_M5IV00A" "0"
 SYSTEM_CONSTANT "SY_M5IV00B" "0"
 SYSTEM_CONSTANT "SY_M5IV00C" "0"
 SYSTEM_CONSTANT "SY_M5IV00D" "1"
 SYSTEM_CONSTANT "SY_M5IV20A" "0"
 SYSTEM_CONSTANT "SY_M5IV20B" "0"
 SYSTEM_CONSTANT "SY_M5IV20C" "0"
 SYSTEM_CONSTANT "SY_M5IV20D" "1"
 SYSTEM_CONSTANT "SY_M5IV40A" "0"
 SYSTEM_CONSTANT "SY_M5IV40B" "0"
 SYSTEM_CONSTANT "SY_M5IV40C" "0"
 SYSTEM_CONSTANT "SY_M5IV40D" "1"
 SYSTEM_CONSTANT "SY_M5IV60A" "0"
 SYSTEM_CONSTANT "SY_M5IV60B" "0"
 SYSTEM_CONSTANT "SY_M5IV60C" "0"
 SYSTEM_CONSTANT "SY_M5IV60D" "1"
 SYSTEM_CONSTANT "SY_M5IV80A" "240"
 SYSTEM_CONSTANT "SY_M5IV80B" "0"
 SYSTEM_CONSTANT "SY_M5IV80C" "0"
 SYSTEM_CONSTANT "SY_M5IV80D" "0"
 SYSTEM_CONSTANT "SY_M6I00A" "168"
 SYSTEM_CONSTANT "SY_M6I00B" "0"
 SYSTEM_CONSTANT "SY_M6I00C" "0"
 SYSTEM_CONSTANT "SY_M6I00D" "0"
 SYSTEM_CONSTANT "SY_M7VAR" "0"
 SYSTEM_CONSTANT "SY_M8I00B" "128"
 SYSTEM_CONSTANT "SY_M8I00C" "0"
 SYSTEM_CONSTANT "SY_M8I00D" "0"
 SYSTEM_CONSTANT "SY_M8I00E" "0"
 SYSTEM_CONSTANT "SY_M9I00A" "60"
 SYSTEM_CONSTANT "SY_M9I00B" "0"
 SYSTEM_CONSTANT "SY_M9I00C" "0"
 SYSTEM_CONSTANT "SY_M9I00D" "0"
 SYSTEM_CONSTANT "SY_MAGER" "0"
 SYSTEM_CONSTANT "SY_MAX_EV" "4"
 SYSTEM_CONSTANT "SY_MDZUL" "4"
 SYSTEM_CONSTANT "SY_MFCCMODE1" "1"
 SYSTEM_CONSTANT "SY_MOST" "0"
 SYSTEM_CONSTANT "SY_MWB19" "0"
 SYSTEM_CONSTANT "SY_NLDG" "1"
 SYSTEM_CONSTANT "SY_NOHK" "0"
 SYSTEM_CONSTANT "SY_NOHK2" "0"
 SYSTEM_CONSTANT "SY_NOXKAT" "0"
 SYSTEM_CONSTANT "SY_NWGA" "0"
 SYSTEM_CONSTANT "SY_NWGA2" "0"
 SYSTEM_CONSTANT "SY_NWGE" "1"
 SYSTEM_CONSTANT "SY_NWGE2" "0"
 SYSTEM_CONSTANT "SY_NWRA" "0"
 SYSTEM_CONSTANT "SY_NWRE" "1"
 SYSTEM_CONSTANT "SY_NWROI" "0"
 SYSTEM_CONSTANT "SY_NWS" "1"
 SYSTEM_CONSTANT "SY_NWSA" "0"
 SYSTEM_CONSTANT "SY_NWSTIM_PRE" "16"
 SYSTEM_CONSTANT "SY_NWVAR" "1"
 SYSTEM_CONSTANT "SY_NZUEB" "60"
 SYSTEM_CONSTANT "SY_OBDCERT" "0"
 SYSTEM_CONSTANT "SY_ONCHIP_ROMFLASH" "1"
 SYSTEM_CONSTANT "SY_OVERSIZE" "2"
 SYSTEM_CONSTANT "SY_PBRPW" "1"
 SYSTEM_CONSTANT "SY_PEDABS" "0"
 SYSTEM_CONSTANT "SY_PGRAD" "4"
 SYSTEM_CONSTANT "SY_PGRAD2" "0"
 SYSTEM_CONSTANT "SY_PGRAD3" "0"
 SYSTEM_CONSTANT "SY_PGRAD4" "0"
 SYSTEM_CONSTANT "SY_PGTPO" "0"
 SYSTEM_CONSTANT "SY_PH2OFST" "0"
 SYSTEM_CONSTANT "SY_PHTWIN" "0"
 SYSTEM_CONSTANT "SY_PROZESSLAUFZEIT" "0"
 SYSTEM_CONSTANT "SY_RDE" "1"
 SYSTEM_CONSTANT "SY_REDMX" "4"
 SYSTEM_CONSTANT "SY_REVTIM_PRE" "16"
 SYSTEM_CONSTANT "SY_RLAPP" "0"
 SYSTEM_CONSTANT "SY_SALSU" "0"
 SYSTEM_CONSTANT "SY_SCHICHT" "0"
 SYSTEM_CONSTANT "SY_SGANZ" "1"
 SYSTEM_CONSTANT "SY_SHK_OT" "1"
 SYSTEM_CONSTANT "SY_SLPANST" "0"
 SYSTEM_CONSTANT "SY_SLPANZ" "1"
 SYSTEM_CONSTANT "SY_SLS" "88"
 SYSTEM_CONSTANT "SY_SLSHK" "0"
 SYSTEM_CONSTANT "SY_SLVANST" "0"
 SYSTEM_CONSTANT "SY_SLVANZ" "1"
 SYSTEM_CONSTANT "SY_SLWG" "0"
 SYSTEM_CONSTANT "SY_SSPB" "0"
 SYSTEM_CONSTANT "SY_STA" "0"
 SYSTEM_CONSTANT "SY_STADAP" "1"
 SYSTEM_CONSTANT "SY_STARTPAKET" "1"
 SYSTEM_CONSTANT "SY_STERBTS" "0"
 SYSTEM_CONSTANT "SY_STEREO" "0"
 SYSTEM_CONSTANT "SY_STERFK" "0"
 SYSTEM_CONSTANT "SY_STERHK" "0"
 SYSTEM_CONSTANT "SY_STERSY" "0"
 SYSTEM_CONSTANT "SY_STERVK" "0"
 SYSTEM_CONSTANT "SY_STETLR" "1"
 SYSTEM_CONSTANT "SY_SU" "0"
 SYSTEM_CONSTANT "SY_SWEISR" "1"
 SYSTEM_CONSTANT "SY_SWE_B" "0"
 SYSTEM_CONSTANT "SY_SWE_C" "1"
 SYSTEM_CONSTANT "SY_SWE_K" "0"
 SYSTEM_CONSTANT "SY_SWE_S" "0"
 SYSTEM_CONSTANT "SY_T6MDTHM" "0"
 SYSTEM_CONSTANT "SY_TABST" "0"
 SYSTEM_CONSTANT "SY_TAGR" "0"
 SYSTEM_CONSTANT "SY_TCNS" "1"
 SYSTEM_CONSTANT "SY_TDZW" "1"
 SYSTEM_CONSTANT "SY_TEBF" "1"
 SYSTEM_CONSTANT "SY_TEETH" "60"
 SYSTEM_CONSTANT "SY_TEVE2" "0"
 SYSTEM_CONSTANT "SY_TFA" "0"
 SYSTEM_CONSTANT "SY_TFAOPL" "0"
 SYSTEM_CONSTANT "SY_TFBA" "1"
 SYSTEM_CONSTANT "SY_TFMA" "1"
 SYSTEM_CONSTANT "SY_TFMAP" "1"
 SYSTEM_CONSTANT "SY_TFMHST" "1"
 SYSTEM_CONSTANT "SY_TFMO" "0"
 SYSTEM_CONSTANT "SY_TFNS" "1"
 SYSTEM_CONSTANT "SY_TFOL" "0"
 SYSTEM_CONSTANT "SY_TFRK" "1"
 SYSTEM_CONSTANT "SY_TFST" "1"
 SYSTEM_CONSTANT "SY_TFUMG" "2"
 SYSTEM_CONSTANT "SY_TFVA" "1"
 SYSTEM_CONSTANT "SY_TFWL" "1"
 SYSTEM_CONSTANT "SY_THYDRO" "0"
 SYSTEM_CONSTANT "SY_TIMER1_PRESCALER" "16"
 SYSTEM_CONSTANT "SY_TIMER3_PRESCALER" "64"
 SYSTEM_CONSTANT "SY_TIMER8_PRESCALER" "64"
 SYSTEM_CONSTANT "SY_TKA" "1"
 SYSTEM_CONSTANT "SY_TKAT" "0"
 SYSTEM_CONSTANT "SY_TLDR" "0"
 SYSTEM_CONSTANT "SY_TLR" "1"
 SYSTEM_CONSTANT "SY_TLRASP" "0"
 SYSTEM_CONSTANT "SY_TN" "1"
 SYSTEM_CONSTANT "SY_TRLX" "0"
 SYSTEM_CONSTANT "SY_TSFSIZE" "1"
 SYSTEM_CONSTANT "SY_TUM" "0"
 SYSTEM_CONSTANT "SY_TUN" "2"
 SYSTEM_CONSTANT "SY_TUNKEY" "1"
 SYSTEM_CONSTANT "SY_TUNKEY1" "1"
 SYSTEM_CONSTANT "SY_TURBO" "1"
 SYSTEM_CONSTANT "SY_TVVR" "1"
 SYSTEM_CONSTANT "SY_TWAN" "0"
 SYSTEM_CONSTANT "SY_TWDKS" "0"
 SYSTEM_CONSTANT "SY_UB13V" "185"
 SYSTEM_CONSTANT "SY_UBDEDIS" "92"
 SYSTEM_CONSTANT "SY_UBDEEN" "106"
 SYSTEM_CONSTANT "SY_UBKL15" "0"
 SYSTEM_CONSTANT "SY_UBOKDIS" "87"
 SYSTEM_CONSTANT "SY_UBOKEN" "102"
 SYSTEM_CONSTANT "SY_UBR" "1"
 SYSTEM_CONSTANT "SY_UBRSQ_W" "1140"
 SYSTEM_CONSTANT "SY_UBSQ_W" "720"
 SYSTEM_CONSTANT "SY_UHR" "4"
 SYSTEM_CONSTANT "SY_UMALS" "0"
 SYSTEM_CONSTANT "SY_USOFF" "205"
 SYSTEM_CONSTANT "SY_VAR" "332"
 SYSTEM_CONSTANT "SY_VS" "0"
 SYSTEM_CONSTANT "SY_VVT" "0"
 SYSTEM_CONSTANT "SY_WDTINPUT_SEL" "1"
 SYSTEM_CONSTANT "SY_WFS" "3"
 SYSTEM_CONSTANT "SY_WMAX" "78"
 SYSTEM_CONSTANT "SY_WMIN" "-32"
 SYSTEM_CONSTANT "SY_WNBM" "6"
 SYSTEM_CONSTANT "SY_WSM" "0"
 SYSTEM_CONSTANT "SY_ZAS" "0"
 SYSTEM_CONSTANT "SY_ZIZWV" "0"
 SYSTEM_CONSTANT "SY_ZMS" "1"
 SYSTEM_CONSTANT "SY_ZNDAUS" "1"
 SYSTEM_CONSTANT "SY_ZP_LAMREG_EUII" "0"
 SYSTEM_CONSTANT "SY_ZYLZA" "4"
 SYSTEM_CONSTANT "SY_ZZBANK" "0"
 SYSTEM_CONSTANT "SY_ZZLAM" "0"
 SYSTEM_CONSTANT "TSROHRES" "1230"
 SYSTEM_CONSTANT "VARKOD" "1" /end MOD_PAR
/begin MOD_COMMON "" BYTE_ORDER BIG_ENDIAN S_REC_LAYOUT DAMOS /end MOD_COMMON
/* --- AgI-Objekt für DIM_X, Stand 0.1 12.7.96 --- */
/begin IF_DATA DIM_X TRGSEG_ADDRESS 0x383200 DAT_MOD 1 TRG_MOD 39 DISPLAY_TAB 12 ETK_CFG 0xf 0xf0 0xff 0x3 0xff 0xee 0xff 0x1 DISPLAY_PAR 0x817F50 10 0x381A46 0x383236 "Synchro" 0 DISPLAY_PAR 0x817F66 26 0x381A50 0x383238 "10ms" 10 DISPLAY_PAR 0x817F9C 30 0x381A6A 0x38323A "100ms" 100 /end IF_DATA
/* --- AgI-Objekt für ETK (ASAP V1.3B0), Stand 1.0 16.7.98 --- */
/begin IF_DATA ETK
 /begin TP_BLOB /*version:*/ 0x1000001 /*pba:*/ 0x0 /*reset_cfg:*/ 0xFFFFFF07
  /begin DISTAB_CFG /*dsptab:*/ 0xC /*dat_mod:*/ 0x1 /*rfg:*/ 0x2 /*trgsegad:*/ 0x383200 /*trg_cfg:*/ 0x1020100 TRG_MOD /*Id:*/ 0x0 /*trg_mod:*/ 0x27 0x0 0x0 0x0 /end DISTAB_CFG
  CODE_CHK /*prg_data:*/ 0x0 /*prg_length:*/ 0x0 /*prg_eram:*/ 0x0 /*prg_length:*/ 0x0 ETK_CFG 0xf 0xf0 0xff 0x3 0xff 0xee 0xff 0x1 /* EMU_RAM start_addr length CS offset >>>>> (multiple) */ /* EMU_DATA start_addr length CS offset >>>>> (multiple) */ /* EMU_CODE start_addr length CS offset >>>>> (multiple) */ /* RESERVED start_addr length CS offset >>>>> (multiple) */ RESERVED_DISTAB_MEMORY /*start_addr:*/ 0x817F50 /*length:*/ 0x144 EXTERN -1 -1 -1 -1 -1 ETK_MAILBOX /*pattern:*/ 0x55555555 /*page_ecu:*/ DATA /*ecu_adr:*/ 0x600000 /*..length:*/ 0x8000 /*page_am:*/ EXRAM /*am_adr:*/ 0x620000 /*..length:*/ 0x8000 /end TP_BLOB
 /begin SOURCE "Synchro" 103 1 QP_BLOB 1 0xA 0x817F50 0x381A46 0x383236 0 0 0 /end SOURCE
 /begin SOURCE "10ms" 4 1 QP_BLOB 2 0x1A 0x817F66 0x381A50 0x383238 10 0 0 /end SOURCE
 /begin SOURCE "100ms" 5 1 QP_BLOB 3 0x1E 0x817F9C 0x381A6A 0x38323A 100 0 0 /end SOURCE
/end IF_DATA
/begin IF_DATA KLEITUNG
 /begin APPL_PROT
  /begin MCMESS KOMKEN 13 /* Kommunikationskennung 1..255 */ MCTGT 0x1 /* Targetadresse im Steuergerät im KWP2000 */ MCINI MASSE /* Reizungstyp */ ZYLZNAME zzyl /* Name der Zylinderzählerramzelle */ ZYLZA 6 /* Zylinderanzahl */ ZYLREI "1,4,3,6,2,5" /* Zündreihenfolge */ XRAMOF 0 /* EXRAM-Offset: 0..255 */ WFSIDLE0 12 /* Wartezeit bevor Tester mit Reizung/Vorspann beginnt (quant. 10ms) */ WFSIDLE1 8 /* Retriggerzeit von WFSIDLE0 (10ms-Quantisierung) */ WFS5B 10 /* Wartezeit nach 5-Baud-Vorspann, bevor Tester mit der Protokoll-Einleitung beginnt (quant. 100ms) */
   /begin VS_DEF /* Verstellparameterzuordnung */ "VSW:vszw" "VSFG:vsfrk" "VSWV:vsvw" "VSNS:vsns" "VSWZ1:vszwkr_0_A" "VSWZ2:vszwkr_1_A" "VSWZ3:vszwkr_2_A" "VSWZ4:vszwkr_3_A" "VSWZ5:vszwkr_4_A" "VSWZ6:vszwkr_5_A" "VSWZ7:vszwkr_6_A" "VSWZ8:vszwkr_7_A" "VSKF:vske" "VSMFA:vsdmr" "VSMFL:vsfpses" "VSLDS:vsrlmx" "VSLUC:vsldtv" /end VS_DEF
  /end MCMESS
 /end APPL_PROT
/end IF_DATA
/begin CHARACTERISTIC A0 "Übertragungsfunktionskoeffizient" VALUE 0x81679A KwSw 0.1249981 fak_sw_b0p0625 -0.06250000 0.06249809 FUNCTION_LIST ARMD IF_DATA DIM_X DIRECT 0x81679A /end CHARACTERISTIC
/begin CHARACTERISTIC A1 "Übertragungsfunktionskoeffizient" VALUE 0x81679C KwSw 0.1249981 fak_sw_b0p0625 -0.06250000 0.06249809 FUNCTION_LIST ARMD IF_DATA DIM_X DIRECT 0x81679C /end CHARACTERISTIC
/begin CHARACTERISTIC A2 "Übertragungsfunktionskoeffizient" VALUE 0x81679E KwSw 0.1249981 fak_sw_b0p0625 -0.06250000 0.06249809 FUNCTION_LIST ARMD IF_DATA DIM_X DIRECT 0x81679E /end CHARACTERISTIC
/begin CHARACTERISTIC ABKKATTAB "Abkühlkurve in Abhängigkeit von der Abstellzeit" CURVE 0x81EA34 KlAUbSstUwWUb 0.9961 fak_ub_b1 0.00 0.9961 FUNCTION_LIST BBKHZ IF_DATA DIM_X DIRECT 0x81EA34
 /begin AXIS_DESCR STD_AXIS tabst_w t1sxs_uw_q1 6 0.00 65535.00 DEPOSIT ABSOLUT /end AXIS_DESCR
/end CHARACTERISTIC
/begin CHARACTERISTIC ABOINI "Init-Wert  Start-Zähler für Erkennung Benzin im Öl" VALUE 0x8196EA KwUb 255.0 dez 0.00 255.0 FUNCTION_LIST BBBO IF_DATA DIM_X DIRECT 0x8196EA /end CHARACTERISTIC
/begin CHARACTERISTIC ABOLRAR "Schwelle Anzahl Starts mit Benzin im Öl für reduzierte LRA" VALUE 0x8196EB KwUb 255.0 dez 0.00 255.0 FUNCTION_LIST BBBO IF_DATA DIM_X DIRECT 0x8196EB /end CHARACTERISTIC
/begin CHARACTERISTIC ABOMX "max. Anzahl Start-Zähler für Erkennung Benzin im Öl" VALUE 0x8196EC KwUb 255.0 dez 0.00 255.0 FUNCTION_LIST BBBO IF_DATA DIM_X DIRECT 0x8196EC /end CHARACTERISTIC
/begin CHARACTERISTIC ADCC_T_UM "Fehlerzeit bei zueinander unplausiblen ADC-Werten für sp1s" VALUE 0x81420F KwUb 2.550 t10msxs_ub_b2p55 0.00 2.550 FUNCTION_LIST URADCC IF_DATA DIM_X DIRECT 0x81420F /end CHARACTERISTIC
/begin CHARACTERISTIC ADRONLOGIN "Logincode zum Aktivieren ADR" VALUE 0x8161B2 KwUw 65535.00 dez 0.00 65535.00 FUNCTION_LIST TKMWL K71SR KDIAG KWPDATR IF_DATA DIM_X DIRECT 0x8161B2 /end CHARACTERISTIC
/begin CHARACTERISTIC AGANGW "Anzahl Gangwechsel für Diagnose Kupplungsschalter" VALUE 0x818717 KwUb 255.0 dez 0.00 255.0 FUNCTION_LIST DKUPPL IF_DATA DIM_X DIRECT 0x818717 /end CHARACTERISTIC
/begin CHARACTERISTIC AGRRMAX "maximal mögliche AGR-Rate" VALUE 0x811F5B KwUb 99.61 rel_ub_b99p6 0.00 99.61 FUNCTION_LIST MDBAS IF_DATA DIM_X DIRECT 0x811F5B /end CHARACTERISTIC
/begin CHARACTERISTIC AGR_AOG "oberer Grenzwert Anpassung AGR-Rate" VALUE 0x811C4B KwUb 1.992 fak_ub_b2 0.00 1.992 FUNCTION_LIST TKMWL KRACT IF_DATA DIM_X DIRECT 0x811C4B /end CHARACTERISTIC
/begin CHARACTERISTIC AGR_AUG "unterer Grenzwert Anpassung AGR-Rate" VALUE 0x811C4C KwUb 1.992 fak_ub_b2 0.00 1.992 FUNCTION_LIST TKMWL KRACT IF_DATA DIM_X DIRECT 0x811C4C /end CHARACTERISTIC
/begin CHARACTERISTIC AHEARV "Aussetzerhäufigkeit zum Erreichen der Ausblendung weiterer Funktionen" VALUE 0x813DD2 KwUw 65535.00 dez 0.00 65535.00 FUNCTION_LIST DMDMIL IF_DATA DIM_X DIRECT 0x813DD2 /end CHARACTERISTIC
/begin CHARACTERISTIC AHEKA "Aussetzerhäufigkeit zum Erreichen einer Kraftstoffabschaltung" VALUE 0x813DD4 KwUw 65535.00 dez 0.00 65535.00 FUNCTION_LIST DMDMIL IF_DATA DIM_X DIRECT 0x813DD4 /end CHARACTERISTIC
/begin CHARACTERISTIC AHEKS1B1 "Aussetzerhäufigkeit zum Erreichen einer Katschädigung im 1. Intervall Bank 1" VALUE 0x813DD6 KwUw 65535.00 dez 0.00 65535.00 FUNCTION_LIST DMDMIL IF_DATA DIM_X DIRECT 0x813DD6 /end CHARACTERISTIC
/begin CHARACTERISTIC AHEKS1B2 "Aussetzerhäufigkeit zum Erreichen einer Katschädigung im 1. Intervall Bank 2" VALUE 0x813DD8 KwUw 65535.00 dez 0.00 65535.00 FUNCTION_LIST DMDMIL IF_DATA DIM_X DIRECT 0x813DD8 /end CHARACTERISTIC
/begin CHARACTERISTIC AHEKSB1 "Aussetzerhäufigkeit zum Erreichen einer Katalysatorschädigung Bank 1" VALUE 0x813DDA KwUw 65535.00 dez 0.00 65535.00 FUNCTION_LIST DMDMIL IF_DATA DIM_X DIRECT 0x813DDA /end CHARACTERISTIC
/begin CHARACTERISTIC AHEKSB2 "Aussetzerhäufigkeit zum Erreichen einer Katalysatorschädigung Bank 2" VALUE 0x813DDC KwUw 65535.00 dez 0.00 65535.00 FUNCTION_LIST DMDMIL IF_DATA DIM_X DIRECT 0x813DDC /end CHARACTERISTIC
/begin CHARACTERISTIC AINTKAN "Anzahl Intervalle mit Katschädigung für Ti-Abschaltung" CURVE 0x81844E GklWUb 255.0 dez 0.00 255.0 FUNCTION_LIST DMDMIL IF_DATA DIM_X DIRECT 0x81844E
 /begin AXIS_DESCR COM_AXIS nmot nmot_ub_q40 8 0.00 10200. AXIS_PTS_REF SNM08DMUB /end AXIS_DESCR
/end CHARACTERISTIC
/begin CHARACTERISTIC AKUPPLB "Anzahl Kupplung betätigt für Diagnose Kupplungsschalter" VALUE 0x818718 KwUb 255.0 dez 0.00 255.0 FUNCTION_LIST DKUPPL IF_DATA DIM_X DIRECT 0x818718 /end CHARACTERISTIC
/begin CHARACTERISTIC ALFO "Anfangswert für Lernfilter bei fuel-on/fuel-off Adaption" VALUE 0x813D32 KwUw 359.9945 dtsegn_b720divZyl 0.00 359.9945 FUNCTION_LIST DMDFON IF_DATA DIM_X DIRECT 0x813D32 /end CHARACTERISTIC
/begin CHARACTERISTIC ANALUN_0_A "Anzahl Verbrennungen für Ausblendungen nach erkanntem Auss., drehzahlabhängig" CURVE 0x8107F4 GklWUb 255.0 dez 0.00 255.0 FUNCTION_LIST DMDLU IF_DATA DIM_X INDIRECT 0x8173B8
 /begin AXIS_DESCR COM_AXIS nmot nmot_ub_q40 8 0.00 10200. AXIS_PTS_REF SNM08DMUB /end AXIS_DESCR
/end CHARACTERISTIC
/begin CHARACTERISTIC ANALUN_1_A "Anzahl Verbrennungen für Ausblendungen nach erkanntem Auss., drehzahlabhängig" CURVE 0x8107FC GklWUb 255.0 dez 0.00 255.0 FUNCTION_LIST DMDLU IF_DATA DIM_X INDIRECT 0x8173BA
 /begin AXIS_DESCR COM_AXIS nmot nmot_ub_q40 8 0.00 10200. AXIS_PTS_REF SNM08DMUB /end AXIS_DESCR
/end CHARACTERISTIC
/begin CHARACTERISTIC ANALUST "Anzahl Verbrennungen für Ausblendungen nach erkanntem Auss., nach Start" VALUE 0x810804 KwUb 255.0 dez 0.00 255.0 FUNCTION_LIST DMDLU IF_DATA DIM_X DIRECT 0x810804 /end CHARACTERISTIC
/begin CHARACTERISTIC ANRZUEMX "Zündungszähler-Schwelle bis zu der STADAP aktiv" VALUE 0x811612 KwUb 255.0 dez 0.00 255.0 FUNCTION_LIST STADAP IF_DATA DIM_X DIRECT 0x811612 /end CHARACTERISTIC
/begin CHARACTERISTIC ANWFOHE "Anzahl NW-Umdr. für Heilung" VALUE 0x8101A7 KwUb 255.0 dez 0.00 255.0 FUNCTION_LIST DMDFON IF_DATA DIM_X DIRECT 0x8101A7 /end CHARACTERISTIC
/begin CHARACTERISTIC ANWFOST "Anzahl NW-Umdr. für Reaktivierung fuel-on/-off Adaption nach Ausblendung" VALUE 0x8101A8 KwUb 255.0 dez 0.00 255.0 FUNCTION_LIST DMDFON IF_DATA DIM_X DIRECT 0x8101A8 /end CHARACTERISTIC
/begin CHARACTERISTIC ANZDYNSH "Anzahl der Dynamikmessungen für Schwingungsprüfung Sonde hinter KAT" VALUE 0x81866E KwUb 255.0 dez 0.00 255.0 FUNCTION_LIST DLSAHK IF_DATA DIM_X DIRECT 0x81866E /end CHARACTERISTIC
/begin CHARACTERISTIC ANZEAUS "Anzahl der auszublendenden Einspritzungen" VALUE 0x810FB6 KwUb 3.000 dez 4.000 7.000 FUNCTION_LIST NLPH IF_DATA DIM_X DIRECT 0x810FB6 /end CHARACTERISTIC
/begin CHARACTERISTIC ANZEKPVLMX "Max. Anzahl EKP Vorläufe ohne Erreichen von Startende" VALUE 0x81ABFC KwUb 255.0 dez 0.00 255.0 FUNCTION_LIST AEKP IF_DATA DIM_X DIRECT 0x81ABFC /end CHARACTERISTIC
/begin CHARACTERISTIC ANZFEHLER "Anzahl der Fehler, bis Eintrag in Fehlerspeicher erfolgt" VALUE 0x8187ED KwUb 255.0 DEZ 0.00 255.0 FUNCTION_LIST DKMTR IF_DATA DIM_X DIRECT 0x8187ED /end CHARACTERISTIC
/begin CHARACTERISTIC ANZRIBEH "Anzahl der Ri-Berechnungen hinter KAT" VALUE 0x811016 KwUb 255.0 dez 0.00 255.0 FUNCTION_LIST GGLSH IF_DATA DIM_X DIRECT 0x811016 /end CHARACTERISTIC
/begin CHARACTERISTIC ANZTPMX "Maximale Anzahl von hintereinander erlaubten Tips" VALUE 0x8187F7 KwUb 255.0 dez 0.00 255.0 FUNCTION_LIST FGRFULO IF_DATA DIM_X DIRECT 0x8187F7 /end CHARACTERISTIC
/begin CHARACTERISTIC APDTEFRE "Anzahl Vergleiche Gradient fr für Erkennen fr-eingeschwungen in DTEV" VALUE 0x81A717 KwUb 50.00 dez 0.00 50.00 FUNCTION_LIST DTEV IF_DATA DIM_X DIRECT 0x81A717 /end CHARACTERISTIC
/begin CHARACTERISTIC APDTEVX "max. Anzahl Prüfungen bei erkanntem Fehler" VALUE 0x81A718 KwUb 10.00 dez 0.00 10.00 FUNCTION_LIST DTEV IF_DATA DIM_X DIRECT 0x81A718 /end CHARACTERISTIC
/begin CHARACTERISTIC APKTDI "Anzahl der internen Prüfungen bei Katdiagnose" VALUE 0x8186D0 KwUb 254.0 dez 1.000 255.0 FUNCTION_LIST DKATSP IF_DATA DIM_X DIRECT 0x8186D0 /end CHARACTERISTIC
/begin CHARACTERISTIC APKTDIT "Anzahl der internen Prüfungen bei Katdiagnose bei Testerbetrieb" VALUE 0x8186D1 KwUb 254.0 dez 1.000 255.0 FUNCTION_LIST DKATSP IF_DATA DIM_X DIRECT 0x8186D1 /end CHARACTERISTIC
/begin CHARACTERISTIC APKTDX "Maximale Anzahl der Prüfungen bei Katdiagnose" VALUE 0x8186D2 KwUb 255.0 dez 0.00 255.0 FUNCTION_LIST DKATSP IF_DATA DIM_X DIRECT 0x8186D2 /end CHARACTERISTIC
/begin CHARACTERISTIC APULSMX "Maximale Anzahl Impulse bei Einzelimpulsansteuerung" VALUE 0x812774 KwUb 255.0 dez 0.00 255.0 FUNCTION_LIST DLDP IF_DATA DIM_X DIRECT 0x812774 /end CHARACTERISTIC
/begin CHARACTERISTIC ASRL_DAT_UC "" VAL_BLK 0x812243 KwbUb 99.61 rel_ub_q0p3906 0.00 99.61 NUMBER 16 FUNCTION_LIST URCEIN IF_DATA DIM_X DIRECT 0x812243 /end CHARACTERISTIC
/begin CHARACTERISTIC ASRS_DAT_UC "" VAL_BLK 0x812253 KwbUb 99.61 rel_ub_q0p3906 0.00 99.61 NUMBER 16 FUNCTION_LIST URCEIN IF_DATA DIM_X DIRECT 0x812253 /end CHARACTERISTIC
/begin CHARACTERISTIC ATISLATM "Anzti-Schwelle zur Umschaltung von lamns_w auf lamwl_w" CURVE 0x81E07E GklWUw 65535.00 dez 0.00 65535.00 FUNCTION_LIST LANSWL IF_DATA DIM_X DIRECT 0x81E07E
 /begin AXIS_DESCR COM_AXIS tmst temp_ub_q0p75_o48 12 -48.00 143.3 AXIS_PTS_REF STS12ESUB /end AXIS_DESCR
/end CHARACTERISTIC
/begin CHARACTERISTIC ATIWKSTM "Anzti-Schwelle zur Umschaltung von lamns_w auf lamwl_w bei Wiederholkaltstart" CURVE 0x81E096 GklWUw 65535.00 dez 0.00 65535.00 FUNCTION_LIST LANSWL IF_DATA DIM_X DIRECT 0x81E096
 /begin AXIS_DESCR COM_AXIS tmst temp_ub_q0p75_o48 12 -48.00 143.3 AXIS_PTS_REF STS12ESUB /end AXIS_DESCR
/end CHARACTERISTIC
/begin CHARACTERISTIC ATVFETTO "obere Grenze für atvfett, CARB-Tester, DLSSA" VALUE 0x81015C KwUb 1.330 spg_ub_b1p33 0.00 1.330 FUNCTION_LIST DUMMY IF_DATA DIM_X DIRECT 0x81015C /end CHARACTERISTIC
/begin CHARACTERISTIC ATVFETTU "untere Grenze für atvfett, CARB-Tester, DLSSA" VALUE 0x81015D KwUb 1.330 spg_ub_b1p33 0.00 1.330 FUNCTION_LIST DUMMY IF_DATA DIM_X DIRECT 0x81015D /end CHARACTERISTIC
/begin CHARACTERISTIC ATVMAGO "obere Grenze für atvmager, CARB-Tester, DLSSA" VALUE 0x81015E KwUb 1.330 spg_ub_b1p33 0.00 1.330 FUNCTION_LIST DUMMY IF_DATA DIM_X DIRECT 0x81015E /end CHARACTERISTIC
/begin CHARACTERISTIC ATVMAGU "untere Grenze für atvmager, CARB-Tester, DLSSA" VALUE 0x81015F KwUb 1.330 spg_ub_b1p33 0.00 1.330 FUNCTION_LIST DUMMY IF_DATA DIM_X DIRECT 0x81015F /end CHARACTERISTIC
/begin CHARACTERISTIC AUFW10MS "" VALUE 0x812241 KwUb 5100. t20usxus_q20 0.00 5100. FUNCTION_LIST RUNTIME IF_DATA DIM_X DIRECT 0x812241 /end CHARACTERISTIC
/begin CHARACTERISTIC AUFWSYNC "" VALUE 0x812242 KwUb 5100. t20usxus_q20 0.00 5100. FUNCTION_LIST RUNTIME IF_DATA DIM_X DIRECT 0x812242 /end CHARACTERISTIC
/begin CHARACTERISTIC AUSC_A_UM "zulässige Anzahl von Prüfungen auf nicht angezogenes Hauptrelais in %UMAUSC" VALUE 0x817466 KwUw 65530.00 dez 5.000000 65535.00 FUNCTION_LIST UMKOM IF_DATA DIM_X DIRECT 0x817466 /end CHARACTERISTIC
/begin CHARACTERISTIC AUSGH_T_UM "Heilungszeit für Fehler in der zyklischen RAM-Prüfung der Funktionsüberwachung" VALUE 0x814213 KwUb 10200.0 t40ms_ub_b10200 0.00 10200.0 FUNCTION_LIST URAUSG IF_DATA DIM_X DIRECT 0x814213 /end CHARACTERISTIC
/begin CHARACTERISTIC AUSG_T_UM "Fehlertoleranzschwelle für zyklische RAM-Prüfung in der Funktionsüberwachung" VALUE 0x814214 KwUb 255.0 dezsub1 1.000 256.0 FUNCTION_LIST URAUSG IF_DATA DIM_X DIRECT 0x814214 /end CHARACTERISTIC
/begin CHARACTERISTIC AUSZH_T_UM "Heilungszeit für Fehler in der zyklischen ROM-Prüfung der Funktionsüberwachung" VALUE 0x814215 KwUb 10200.0 t40ms_ub_b10200 0.00 10200.0 FUNCTION_LIST URAUSG IF_DATA DIM_X DIRECT 0x814215 /end CHARACTERISTIC
/begin CHARACTERISTIC AUSZ_T_UM "Fehlertoleranzschwelle für zyklische ROM-Prüfung in der Funktionsüberwachung" VALUE 0x814216 KwUb 255.0 dezsub1 1.000 256.0 FUNCTION_LIST URAUSG IF_DATA DIM_X DIRECT 0x814216 /end CHARACTERISTIC
/begin CHARACTERISTIC AVDTEVX "max. Anzahl Prüfversuche DTEV" VALUE 0x81A719 KwUb 20.00 dez 0.00 20.00 FUNCTION_LIST DTEV IF_DATA DIM_X DIRECT 0x81A719 /end CHARACTERISTIC
/begin CHARACTERISTIC AVKATFS "Setztwert für AVKATF wenn Powerfail" VALUE 0x8186D3 KwUb 0.9961 fak_ub_b1 0.00 0.9961 FUNCTION_LIST DKATSP IF_DATA DIM_X DIRECT 0x8186D3 /end CHARACTERISTIC
/begin CHARACTERISTIC AZKELDYN "Zündungen pro Zylinder bei KR-Lastdynamik => Klopferkennung" CURVE 0x819B82 GklWUb 254.0 dez 1.000 255.0 FUNCTION_LIST KRDY IF_DATA DIM_X DIRECT 0x819B82
 /begin AXIS_DESCR COM_AXIS nmot nmot_ub_q40 16 0.00 10200. AXIS_PTS_REF SNM16KRUB /end AXIS_DESCR
/end CHARACTERISTIC
/begin CHARACTERISTIC AZKRLDYN "Anzahl Zündungen pro Zyl. bei KR-Lastdynamik" CURVE 0x819B92 GklWUb 254.0 dez 1.000 255.0 FUNCTION_LIST KRDY IF_DATA DIM_X DIRECT 0x819B92
 /begin AXIS_DESCR COM_AXIS nmot nmot_ub_q40 16 0.00 10200. AXIS_PTS_REF SNM16KRUB /end AXIS_DESCR
/end CHARACTERISTIC
/begin CHARACTERISTIC AZKRNDYN "Anzahl Zündungen für KR-Drehzahldynamik" CURVE 0x819BA2 GklWUb 254.0 dez 1.000 255.0 FUNCTION_LIST KRDY IF_DATA DIM_X DIRECT 0x819BA2
 /begin AXIS_DESCR COM_AXIS nmot nmot_ub_q40 16 0.00 10200. AXIS_PTS_REF SNM16KRUB /end AXIS_DESCR
/end CHARACTERISTIC
/begin CHARACTERISTIC AZYTIAB "Maximale Anzahl von Zylindern mit Ti-Abschaltung aufgrund von Aussetzern" VALUE 0x810D2A KwUb 255.0 dez 0.00 255.0 FUNCTION_LIST DMDMIL IF_DATA DIM_X DIRECT 0x810D2A /end CHARACTERISTIC
/begin CHARACTERISTIC B1 "Übertragungsfunktionskoeffizient" VALUE 0x8167A0 KwSw 3.999939 fak_sw_b2 -2.000000 1.999939 FUNCTION_LIST ARMD IF_DATA DIM_X DIRECT 0x8167A0 /end CHARACTERISTIC
/begin CHARACTERISTIC B2 "Übertragungsfunktionskoeffizient" VALUE 0x8167A2 KwSw 3.999939 fak_sw_b2 -2.000000 1.999939 FUNCTION_LIST ARMD IF_DATA DIM_X DIRECT 0x8167A2 /end CHARACTERISTIC
/begin CHARACTERISTIC BFGR_DAT_UC "" VAL_BLK 0x812263 KwbUb 255.0 dez 0.00 255.0 NUMBER 16 FUNCTION_LIST URCEIN IF_DATA DIM_X DIRECT 0x812263 /end CHARACTERISTIC
/begin CHARACTERISTIC BGRA_T_UM "Fehlerentprellung: Botschaftsfehler GRA" VALUE 0x814003 KwUb 10200.0 t40ms_ub_b10200 0.00 10200.0 FUNCTION_LIST UFFGRE IF_DATA DIM_X DIRECT 0x814003 /end CHARACTERISTIC
/begin CHARACTERISTIC BLDPMX "Max. Fahrzeugbeschleunigung bei 0.5 mm - Diagnose" VALUE 0x829D3E KwSw 13.8899313 bfzg_sw_q4p239Em4 0.00 13.8899313 FUNCTION_LIST DLDP IF_DATA DIM_X DIRECT 0x829D3E /end CHARACTERISTIC
/begin CHARACTERISTIC BNOMSR_DAT_UC "" VAL_BLK 0x812273 KwbUb 255.0 dez 0.00 255.0 NUMBER 16 FUNCTION_LIST URCEIN IF_DATA DIM_X DIRECT 0x812273 /end CHARACTERISTIC
/begin CHARACTERISTIC BRABEVI_0_A "Beschleunigung bei Rampe Beschleunigen" CURVE 0x81C7F8 KlAUwSstUwWUw 27.7802865 bfzg_sw_q4p239Em4 0.00 27.7802865 FUNCTION_LIST FGRFULO IF_DATA DIM_X INDIRECT 0x813BB4
 /begin AXIS_DESCR STD_AXIS vfgr_w vfzg_uw_b512 8 0.00 511.9922 DEPOSIT ABSOLUT /end AXIS_DESCR
/end CHARACTERISTIC
/begin CHARACTERISTIC BRABEVI_1_A "Beschleunigung bei Rampe Beschleunigen" CURVE 0x81C81A KlAUwSstUwWUw 27.7802865 bfzg_sw_q4p239Em4 0.00 27.7802865 FUNCTION_LIST FGRFULO IF_DATA DIM_X INDIRECT 0x813BB8
 /begin AXIS_DESCR STD_AXIS vfgr_w vfzg_uw_b512 8 0.00 511.9922 DEPOSIT ABSOLUT /end AXIS_DESCR
/end CHARACTERISTIC
/begin CHARACTERISTIC BRACC_T_UM "Entprellzeit für betätigte Bremse in der Funktionsüberwachung für ACC" VALUE 0x814004 KwUb 10200.0 t40ms_ub_b10200 0.00 10200.0 FUNCTION_LIST UFFGRE IF_DATA DIM_X DIRECT 0x814004 /end CHARACTERISTIC
/begin CHARACTERISTIC BRATD "Beschleunigung (Betrag) bei Rampe Tip-Down" VALUE 0x81C83C KwUw 27.7802865 bfzg_sw_q4p239Em4 0.00 27.7802865 FUNCTION_LIST FGRFULO IF_DATA DIM_X DIRECT 0x81C83C /end CHARACTERISTIC
/begin CHARACTERISTIC BRATU "Beschleunigung bei Rampe Tip-Up" VALUE 0x81C85E KwUw 27.7802865 bfzg_sw_q4p239Em4 0.00 27.7802865 FUNCTION_LIST FGRFULO IF_DATA DIM_X DIRECT 0x81C85E /end CHARACTERISTIC
/begin CHARACTERISTIC BREMS_T_UM "Entprellzeit für betätigte Bremse in der Funktionsüberwachung" VALUE 0x814005 KwUb 10200.0 t40ms_ub_b10200 0.00 10200.0 FUNCTION_LIST UFFGRE IF_DATA DIM_X DIRECT 0x814005 /end CHARACTERISTIC
/begin CHARACTERISTIC BRESP_T_UM "Entprellzeit für betätigte Bremse in der Funktionsüberw. (ext. Bremseingriff)" VALUE 0x814006 KwUb 10200.0 t40ms_ub_b10200 0.00 10200.0 FUNCTION_LIST UFFGRE IF_DATA DIM_X DIRECT 0x814006 /end CHARACTERISTIC
/begin CHARACTERISTIC BTRKHTMS "Kennline zur Freigabe B_trkh" CURVE 0x8197DE KlAUbSstUbWUb 0.9961 fak_ub_b1 0.00 0.9961 FUNCTION_LIST BBKHZ IF_DATA DIM_X DIRECT 0x8197DE
 /begin AXIS_DESCR STD_AXIS tmst temp_ub_q0p75_o48 8 -48.00 143.3 DEPOSIT ABSOLUT /end AXIS_DESCR
/end CHARACTERISTIC
/begin CHARACTERISTIC BZMSRA_DAT_UC "" VAL_BLK 0x812283 KwbUb 255.0 dez 0.00 255.0 NUMBER 16 FUNCTION_LIST URCEIN IF_DATA DIM_X DIRECT 0x812283 /end CHARACTERISTIC
/begin CHARACTERISTIC BZMSR_DAT_UC "" VAL_BLK 0x812293 KwbUb 255.0 dez 0.00 255.0 NUMBER 16 FUNCTION_LIST URCEIN IF_DATA DIM_X DIRECT 0x812293 /end CHARACTERISTIC
/begin CHARACTERISTIC BZ_MSR_UC "" VALUE 0x8124E4 KwUb 255.0 dez 0.00 255.0 FUNCTION_LIST URCMSRC IF_DATA DIM_X DIRECT 0x8124E4 /end CHARACTERISTIC
/begin CHARACTERISTIC BZ_MSR_UM "" VALUE 0x814074 KwUb 255.0 dez 0.00 255.0 FUNCTION_LIST UFMSRC IF_DATA DIM_X DIRECT 0x814074 /end CHARACTERISTIC
/begin CHARACTERISTIC BZ_ST_DAT_UC "" VAL_BLK 0x8122A3 KwbUb 255.0 dez 0.00 255.0 NUMBER 16 FUNCTION_LIST URCEIN IF_DATA DIM_X DIRECT 0x8122A3 /end CHARACTERISTIC
/begin CHARACTERISTIC CBGRLP "Codewort Konfiguration Funktion BGRLP" VALUE 0x8114FF KwUb 255.0 dez 0.00 255.0 FUNCTION_LIST BGRLP IF_DATA DIM_X DIRECT 0x8114FF /end CHARACTERISTIC
/begin CHARACTERISTIC CBIT_DAT_UC "" VAL_BLK 0x8122B3 KwbUb 255.0 dez 0.00 255.0 NUMBER 16 FUNCTION_LIST URCEIN IF_DATA DIM_X DIRECT 0x8122B3 /end CHARACTERISTIC
/begin CHARACTERISTIC CCMKBI "Kombiausgabe Hubraum" VALUE 0x8183CB KwUb 25.50 vol_q0p1_l 0.00 25.50 FUNCTION_LIST CAN IF_DATA DIM_X DIRECT 0x8183CB /end CHARACTERISTIC
/begin CHARACTERISTIC CDAGR "Codewort DAGR abschalten (EURO-Codierung), CD..=0 -> keine Diagnose" VALUE 0x818194 KwUb 255.0 dez 0.00 255.0 FUNCTION_LIST PROKON IF_DATA DIM_X DIRECT 0x818194 /end CHARACTERISTIC
/begin CHARACTERISTIC CDAGRL "Codewort Diagnose Lagesensor abschalten (EURO-Codierung), CD..=0 -> keine Diag." VALUE 0x818195 KwUb 255.0 dez 0.00 255.0 FUNCTION_LIST PROKON IF_DATA DIM_X DIRECT 0x818195 /end CHARACTERISTIC
/begin CHARACTERISTIC CDATR "Konfigurationsbyte Diagnose Abgastemperaturregelung" VALUE 0x818196 KwUb 255.0 dez 0.00 255.0 FUNCTION_LIST PROKON IF_DATA DIM_X DIRECT 0x818196 /end CHARACTERISTIC
/begin CHARACTERISTIC CDATS "Konfigurationsbyte Diagnose Abgastemperatursensor" VALUE 0x818197 KwUb 255.0 dez 0.00 255.0 FUNCTION_LIST PROKON IF_DATA DIM_X DIRECT 0x818197 /end CHARACTERISTIC
/begin CHARACTERISTIC CDCAAA "Dummy: Tabellenanfang" VAL_BLK 0x814254 KwbUw 65535.00 dez 0.00 65535.00 NUMBER 4 FUNCTION_LIST DFPM_DFPM IF_DATA DIM_X DIRECT 0x814254 /end CHARACTERISTIC
/begin CHARACTERISTIC CDCAATUN "Codewort CARB: Tuningschutz" VAL_BLK 0x81425C KwbUw 65535.00 dez 0.00 65535.00 NUMBER 4 FUNCTION_LIST DFPM_TUNING IF_DATA DIM_X DIRECT 0x81425C /end CHARACTERISTIC
/begin CHARACTERISTIC CDCAGRE "Codewort CARB:	Überwachung AGR-Endstufe" VAL_BLK 0x814264 KwbUw 65535.00 dez 0.00 65535.00 NUMBER 4 FUNCTION_LIST DFPM_DEKON IF_DATA DIM_X DIRECT 0x814264 /end CHARACTERISTIC
/begin CHARACTERISTIC CDCAGRF "Codewort CARB: Überwachung AGR-FLOW" VAL_BLK 0x81426C KwbUw 65535.00 dez 0.00 65535.00 NUMBER 4 FUNCTION_LIST DFPM_DUMMY_D IF_DATA DIM_X DIRECT 0x81426C /end CHARACTERISTIC
/begin CHARACTERISTIC CDCBREMS "Codewort CARB: Bremspedalgeber" VAL_BLK 0x81428C KwbUw 65535.00 dez 0.00 65535.00 NUMBER 4 FUNCTION_LIST DFPM_GGEGAS IF_DATA DIM_X DIRECT 0x81428C /end CHARACTERISTIC
/begin CHARACTERISTIC CDCBWF "Codewort CARB: PWG Bewegung" VAL_BLK 0x814294 KwbUw 65535.00 dez 0.00 65535.00 NUMBER 4 FUNCTION_LIST DFPM_GGPED IF_DATA DIM_X DIRECT 0x814294 /end CHARACTERISTIC
/begin CHARACTERISTIC CDCCAIR "Codewort CARB: Airbag-Botschaft" VAL_BLK 0x81429C KwbUw 65535.00 dez 0.00 65535.00 NUMBER 4 FUNCTION_LIST DFPM_CAIR IF_DATA DIM_X DIRECT 0x81429C /end CHARACTERISTIC
/begin CHARACTERISTIC CDCCAIRP "Codewort CARB: unpl. Airbag-Botschaft" VAL_BLK 0x8142A4 KwbUw 65535.00 dez 0.00 65535.00 NUMBER 4 FUNCTION_LIST DFPM_GGCS IF_DATA DIM_X DIRECT 0x8142A4 /end CHARACTERISTIC
/begin CHARACTERISTIC CDCCAS "Codewort CARB: CAN-Schnittstelle, Timeout ASC" VAL_BLK 0x8142AC KwbUw 65535.00 dez 0.00 65535.00 NUMBER 4 FUNCTION_LIST DFPM_CAS IF_DATA DIM_X DIRECT 0x8142AC /end CHARACTERISTIC
/begin CHARACTERISTIC CDCCAT "Codewort CARB: CAN-Schnittstelle, Timeout ASR" VAL_BLK 0x8142B4 KwbUw 65535.00 dez 0.00 65535.00 NUMBER 4 FUNCTION_LIST DFPM_CAT IF_DATA DIM_X DIRECT 0x8142B4 /end CHARACTERISTIC
/begin CHARACTERISTIC CDCCGE "Codewort CARB: CAN-Schnittstelle, Timeout EGS" VAL_BLK 0x8142BC KwbUw 65535.00 dez 0.00 65535.00 NUMBER 4 FUNCTION_LIST DFPM_CGE IF_DATA DIM_X DIRECT 0x8142BC /end CHARACTERISTIC
/begin CHARACTERISTIC CDCCGRA "Codewort CARB: GRA-Botschaft (Empfang)" VAL_BLK 0x8142C4 KwbUw 65535.00 dez 0.00 65535.00 NUMBER 4 FUNCTION_LIST DFPM_CGRA IF_DATA DIM_X DIRECT 0x8142C4 /end CHARACTERISTIC
/begin CHARACTERISTIC CDCCIF "Codewort CARB: CAN-Schnittstelle, interner Fehler" VAL_BLK 0x8142CC KwbUw 65535.00 dez 0.00 65535.00 NUMBER 4 FUNCTION_LIST DFPM_CIF IF_DATA DIM_X DIRECT 0x8142CC /end CHARACTERISTIC
/begin CHARACTERISTIC CDCCINS "Codewort CARB: CAN-Schnittstelle, Timeout Instrument" VAL_BLK 0x8142D4 KwbUw 65535.00 dez 0.00 65535.00 NUMBER 4 FUNCTION_LIST DFPM_CINS IF_DATA DIM_X DIRECT 0x8142D4 /end CHARACTERISTIC
/begin CHARACTERISTIC CDCCKLA "Codewort CARB: CAN-Schnittstelle, Timeout Klima" VAL_BLK 0x8142DC KwbUw 65535.00 dez 0.00 65535.00 NUMBER 4 FUNCTION_LIST DFPM_CKLA IF_DATA DIM_X DIRECT 0x8142DC /end CHARACTERISTIC
/begin CHARACTERISTIC CDCCLWS "Codewort CARB: CAN-Schnittstelle, Timeout Botschaft Lenkwinkelsensor" VAL_BLK 0x8142E4 KwbUw 65535.00 dez 0.00 65535.00 NUMBER 4 FUNCTION_LIST DFPM_CLWS IF_DATA DIM_X DIRECT 0x8142E4 /end CHARACTERISTIC
/begin CHARACTERISTIC CDCDK "Codewort CARB:	DK - Potentiometer" VAL_BLK 0x8142F4 KwbUw 65535.00 dez 0.00 65535.00 NUMBER 4 FUNCTION_LIST DFPM_DDVE IF_DATA DIM_X DIRECT 0x8142F4 /end CHARACTERISTIC
/begin CHARACTERISTIC CDCDK1P "Codewort CARB: Drosselklappe 1. Poti" VAL_BLK 0x8142FC KwbUw 65535.00 dez 0.00 65535.00 NUMBER 4 FUNCTION_LIST DFPM_DDVE IF_DATA DIM_X DIRECT 0x8142FC /end CHARACTERISTIC
/begin CHARACTERISTIC CDCDK2P "Codewort CARB: Drosselklappe 2. Poti" VAL_BLK 0x814304 KwbUw 65535.00 dez 0.00 65535.00 NUMBER 4 FUNCTION_LIST DFPM_DDVE IF_DATA DIM_X DIRECT 0x814304 /end CHARACTERISTIC
/begin CHARACTERISTIC CDCDPL "Codewort CARB:	Dauerplus" VAL_BLK 0x81430C KwbUw 65535.00 dez 0.00 65535.00 NUMBER 4 FUNCTION_LIST DFPM_DPL IF_DATA DIM_X DIRECT 0x81430C /end CHARACTERISTIC
/begin CHARACTERISTIC CDCDSBKV "Codewort CARB: BKV" VAL_BLK 0x814314 KwbUw 65535.00 dez 0.00 65535.00 NUMBER 4 FUNCTION_LIST DFPM_DSBKV IF_DATA DIM_X DIRECT 0x814314 /end CHARACTERISTIC
/begin CHARACTERISTIC CDCDSL "Codewort CARB: Drucksensor Ladedruck" VAL_BLK 0x81431C KwbUw 65535.00 dez 0.00 65535.00 NUMBER 4 FUNCTION_LIST DFPM_GGDSAS IF_DATA DIM_X DIRECT 0x81431C /end CHARACTERISTIC
/begin CHARACTERISTIC CDCDSU "Codewort CARB: Drucksensor Umgebung" VAL_BLK 0x814324 KwbUw 65535.00 dez 0.00 65535.00 NUMBER 4 FUNCTION_LIST DFPM_GGDSAS IF_DATA DIM_X DIRECT 0x814324 /end CHARACTERISTIC
/begin CHARACTERISTIC CDCDSVLU "Codewort CARB: Drucksensorsignalvergleich (DS-L DS-U)" VAL_BLK 0x81432C KwbUw 65535.00 dez 0.00 65535.00 NUMBER 4 FUNCTION_LIST DFPM_GGDSAS IF_DATA DIM_X DIRECT 0x81432C /end CHARACTERISTIC
/begin CHARACTERISTIC CDCDVEE "Codewort CARB: DV-E Endstufe" VAL_BLK 0x814334 KwbUw 65535.00 dez 0.00 65535.00 NUMBER 4 FUNCTION_LIST DFPM_DDVE IF_DATA DIM_X DIRECT 0x814334 /end CHARACTERISTIC
/begin CHARACTERISTIC CDCDVEF "Codewort CARB: DV-E Fehler bei Federprüfung" VAL_BLK 0x81433C KwbUw 65535.00 dez 0.00 65535.00 NUMBER 4 FUNCTION_LIST DFPM_DDVE IF_DATA DIM_X DIRECT 0x81433C /end CHARACTERISTIC
/begin CHARACTERISTIC CDCDVEFO "" VAL_BLK 0x814344 KwbUw 65535.00 dez 0.00 65535.00 NUMBER 4 FUNCTION_LIST DFPM_DDVE IF_DATA DIM_X DIRECT 0x814344 /end CHARACTERISTIC
/begin CHARACTERISTIC CDCDVEL "Codewort CARB: DV-E Lageabweichung" VAL_BLK 0x81434C KwbUw 65535.00 dez 0.00 65535.00 NUMBER 4 FUNCTION_LIST DFPM_DDVE IF_DATA DIM_X DIRECT 0x81434C /end CHARACTERISTIC
/begin CHARACTERISTIC CDCDVEN "Codewort CARB: DV-E Fehler bei Prüfung Notluftposition" VAL_BLK 0x814354 KwbUw 65535.00 dez 0.00 65535.00 NUMBER 4 FUNCTION_LIST DFPM_DDVE IF_DATA DIM_X DIRECT 0x814354 /end CHARACTERISTIC
/begin CHARACTERISTIC CDCDVER "Codewort CARB: DV-E Regelbereich" VAL_BLK 0x81435C KwbUw 65535.00 dez 0.00 65535.00 NUMBER 4 FUNCTION_LIST DFPM_DDVE IF_DATA DIM_X DIRECT 0x81435C /end CHARACTERISTIC
/begin CHARACTERISTIC CDCDVET "" VAL_BLK 0x814364 KwbUw 65535.00 dez 0.00 65535.00 NUMBER 4 FUNCTION_LIST DFPM_DDVE IF_DATA DIM_X DIRECT 0x814364 /end CHARACTERISTIC
/begin CHARACTERISTIC CDCDVEU "Codewort CARB: DV-E Fehler beim UMA-Lernen" VAL_BLK 0x81436C KwbUw 65535.00 dez 0.00 65535.00 NUMBER 4 FUNCTION_LIST DFPM_DDVE IF_DATA DIM_X DIRECT 0x81436C /end CHARACTERISTIC
/begin CHARACTERISTIC CDCDVEUB "" VAL_BLK 0x814374 KwbUw 65535.00 dez 0.00 65535.00 NUMBER 4 FUNCTION_LIST DFPM_DDVE IF_DATA DIM_X DIRECT 0x814374 /end CHARACTERISTIC
/begin CHARACTERISTIC CDCDVEUW "" VAL_BLK 0x81437C KwbUw 65535.00 dez 0.00 65535.00 NUMBER 4 FUNCTION_LIST DFPM_DDVE IF_DATA DIM_X DIRECT 0x81437C /end CHARACTERISTIC
/begin CHARACTERISTIC CDCDVEV "Codewort CARB: DV-E Fehler bei Verstärkerabgleich" VAL_BLK 0x814384 KwbUw 65535.00 dez 0.00 65535.00 NUMBER 4 FUNCTION_LIST DFPM_DDVE IF_DATA DIM_X DIRECT 0x814384 /end CHARACTERISTIC
/begin CHARACTERISTIC CDCEGFE "Codewort CARB: Lasterfassung" VAL_BLK 0x81438C KwbUw 65535.00 dez 0.00 65535.00 NUMBER 4 FUNCTION_LIST DFPM_DEGFE IF_DATA DIM_X DIRECT 0x81438C /end CHARACTERISTIC
/begin CHARACTERISTIC CDCENWS "Codewort Carb: Nockenwellensteuerung Einlass Nockenwelle" VAL_BLK 0x814394 KwbUw 65535.00 dez 0.00 65535.00 NUMBER 4 FUNCTION_LIST DFPM_DENWS IF_DATA DIM_X DIRECT 0x814394 /end CHARACTERISTIC
/begin CHARACTERISTIC CDCETRE "Codeword CARB: El. Thermostat-Endstufe" VAL_BLK 0x8143A4 KwbUw 65535.00 dez 0.00 65535.00 NUMBER 4 FUNCTION_LIST DFPM_DEKON IF_DATA DIM_X DIRECT 0x8143A4 /end CHARACTERISTIC
/begin CHARACTERISTIC CDCEV1 "Codewort CARB: EV von Zyl. 1" VAL_BLK 0x8143AC KwbUw 65535.00 dez 0.00 65535.00 NUMBER 4 FUNCTION_LIST DFPM_DEKON IF_DATA DIM_X DIRECT 0x8143AC /end CHARACTERISTIC
/begin CHARACTERISTIC CDCEV2 "Codewort CARB: EV von Zyl. 2" VAL_BLK 0x8143B4 KwbUw 65535.00 dez 0.00 65535.00 NUMBER 4 FUNCTION_LIST DFPM_DEKON IF_DATA DIM_X DIRECT 0x8143B4 /end CHARACTERISTIC
/begin CHARACTERISTIC CDCEV3 "Codewort CARB: EV von Zyl. 3" VAL_BLK 0x8143BC KwbUw 65535.00 dez 0.00 65535.00 NUMBER 4 FUNCTION_LIST DFPM_DEKON IF_DATA DIM_X DIRECT 0x8143BC /end CHARACTERISTIC
/begin CHARACTERISTIC CDCEV4 "Codewort CARB: EV von Zyl. 4" VAL_BLK 0x8143C4 KwbUw 65535.00 dez 0.00 65535.00 NUMBER 4 FUNCTION_LIST DFPM_DEKON IF_DATA DIM_X DIRECT 0x8143C4 /end CHARACTERISTIC
/begin CHARACTERISTIC CDCFP1P "Codewort CARB: Poti 1, Fahrpedal" VAL_BLK 0x8143CC KwbUw 65535.00 dez 0.00 65535.00 NUMBER 4 FUNCTION_LIST DFPM_GGPED IF_DATA DIM_X DIRECT 0x8143CC /end CHARACTERISTIC
/begin CHARACTERISTIC CDCFP2P "Codewort CARB: Poti 2, Fahrpedal" VAL_BLK 0x8143D4 KwbUw 65535.00 dez 0.00 65535.00 NUMBER 4 FUNCTION_LIST DFPM_GGPED IF_DATA DIM_X DIRECT 0x8143D4 /end CHARACTERISTIC
/begin CHARACTERISTIC CDCFPP "Codewort CARB: Fahrpedal" VAL_BLK 0x8143DC KwbUw 65535.00 dez 0.00 65535.00 NUMBER 4 FUNCTION_LIST DFPM_GGPED IF_DATA DIM_X DIRECT 0x8143DC /end CHARACTERISTIC
/begin CHARACTERISTIC CDCFRAO "Codewort CARB: LR-Adaption obere multiplikativ" VAL_BLK 0x8143E4 KwbUw 65535.00 dez 0.00 65535.00 NUMBER 4 FUNCTION_LIST DFPM_DKVS IF_DATA DIM_X DIRECT 0x8143E4 /end CHARACTERISTIC
/begin CHARACTERISTIC CDCFRAU "Codewort CARB: LR-Adaption untere multiplikativ" VAL_BLK 0x8143EC KwbUw 65535.00 dez 0.00 65535.00 NUMBER 4 FUNCTION_LIST DFPM_DKVS IF_DATA DIM_X DIRECT 0x8143EC /end CHARACTERISTIC
/begin CHARACTERISTIC CDCFRST "Codewort CARB: LR-Abweichung" VAL_BLK 0x8143F4 KwbUw 65535.00 dez 0.00 65535.00 NUMBER 4 FUNCTION_LIST DFPM_DKVS IF_DATA DIM_X DIRECT 0x8143F4 /end CHARACTERISTIC
/begin CHARACTERISTIC CDCGECOD "Codewort CARB: Getriebecodierung CAN" VAL_BLK 0x8143FC KwbUw 65535.00 dez 0.00 65535.00 NUMBER 4 FUNCTION_LIST DFPM_GECOD IF_DATA DIM_X DIRECT 0x8143FC /end CHARACTERISTIC
/begin CHARACTERISTIC CDCGRBH "Codewort CARB: GRA Bedienhebelfehler" VAL_BLK 0x814404 KwbUw 65535.00 dez 0.00 65535.00 NUMBER 4 FUNCTION_LIST DFPM_GGFGRH IF_DATA DIM_X DIRECT 0x814404 /end CHARACTERISTIC
/begin CHARACTERISTIC CDCHLA "Codewort CARB: Heizleistungsanforderung" VAL_BLK 0x81440C KwbUw 65535.00 dez 0.00 65535.00 NUMBER 4 FUNCTION_LIST DFPM_GGHLA IF_DATA DIM_X DIRECT 0x81440C /end CHARACTERISTIC
/begin CHARACTERISTIC CDCHRE "" VAL_BLK 0x814414 KwbUw 65535.00 dez 0.00 65535.00 NUMBER 4 FUNCTION_LIST DFPM_HRE IF_DATA DIM_X DIRECT 0x814414 /end CHARACTERISTIC
/begin CHARACTERISTIC CDCHSH "Codewort CARB:	Lambdasonden-Heizung hinter Katalysator" VAL_BLK 0x81441C KwbUw 65535.00 dez 0.00 65535.00 NUMBER 4 FUNCTION_LIST DFPM_DHLSHK IF_DATA DIM_X DIRECT 0x81441C /end CHARACTERISTIC
/begin CHARACTERISTIC CDCHSHE "Codewort CARB: Endstufe Heizung Sonde hinter Kat." VAL_BLK 0x81442C KwbUw 65535.00 dez 0.00 65535.00 NUMBER 4 FUNCTION_LIST DFPM_DEKON IF_DATA DIM_X DIRECT 0x81442C /end CHARACTERISTIC
/begin CHARACTERISTIC CDCHSV "Codewort CARB:	Lambdasonden-Heizung vor Katalysator" VAL_BLK 0x814434 KwbUw 65535.00 dez 0.00 65535.00 NUMBER 4 FUNCTION_LIST DFPM_DHLSU IF_DATA DIM_X DIRECT 0x814434 /end CHARACTERISTIC
/begin CHARACTERISTIC CDCHSVSA "Codewort CARB:	Lambdasonden-Heizung vor Katalysator" VAL_BLK 0x814444 KwbUw 65535.00 dez 0.00 65535.00 NUMBER 4 FUNCTION_LIST DFPM_DHLSU IF_DATA DIM_X DIRECT 0x814444 /end CHARACTERISTIC
/begin CHARACTERISTIC CDCHSVSA2 "Codewort CARB:	Lambdasonden-Heizung 2 vor Katalysator" VAL_BLK 0x81444C KwbUw 65535.00 dez 0.00 65535.00 NUMBER 4 FUNCTION_LIST DFPM_DHLSU IF_DATA DIM_X DIRECT 0x81444C /end CHARACTERISTIC
/begin CHARACTERISTIC CDCKAT "Codewort CARB:	Katalysator-Konvertierung" VAL_BLK 0x814454 KwbUw 65535.00 dez 0.00 65535.00 NUMBER 4 FUNCTION_LIST DFPM_DKATSP IF_DATA DIM_X DIRECT 0x814454 /end CHARACTERISTIC
/begin CHARACTERISTIC CDCKPE "Codewort CARB: EKP-Relais Endstufe" VAL_BLK 0x81445C KwbUw 65535.00 dez 0.00 65535.00 NUMBER 4 FUNCTION_LIST DFPM_DEKON IF_DATA DIM_X DIRECT 0x81445C /end CHARACTERISTIC
/begin CHARACTERISTIC CDCKRA01 "Codewort CARB: Klopfregelanschlag Zylinder 1" VAL_BLK 0x814464 KwbUw 65535.00 dez 0.00 65535.00 NUMBER 4 FUNCTION_LIST DFPM_DKRA IF_DATA DIM_X DIRECT 0x814464 /end CHARACTERISTIC
/begin CHARACTERISTIC CDCKRA02 "Codewort CARB: Klopfregelanschlag Zylinder 2" VAL_BLK 0x81446C KwbUw 65535.00 dez 0.00 65535.00 NUMBER 4 FUNCTION_LIST DFPM_DKRA IF_DATA DIM_X DIRECT 0x81446C /end CHARACTERISTIC
/begin CHARACTERISTIC CDCKRA03 "Codewort CARB: Klopfregelanschlag Zylinder 3" VAL_BLK 0x814474 KwbUw 65535.00 dez 0.00 65535.00 NUMBER 4 FUNCTION_LIST DFPM_DKRA IF_DATA DIM_X DIRECT 0x814474 /end CHARACTERISTIC
/begin CHARACTERISTIC CDCKRA04 "Codewort CARB: Klopfregelanschlag Zylinder 4" VAL_BLK 0x81447C KwbUw 65535.00 dez 0.00 65535.00 NUMBER 4 FUNCTION_LIST DFPM_DKRA IF_DATA DIM_X DIRECT 0x81447C /end CHARACTERISTIC
/begin CHARACTERISTIC CDCKRNT "Codewort CARB:	Klopfregelung Nulltest" VAL_BLK 0x814484 KwbUw 65535.00 dez 0.00 65535.00 NUMBER 4 FUNCTION_LIST DFPM_DKRNT IF_DATA DIM_X DIRECT 0x814484 /end CHARACTERISTIC
/begin CHARACTERISTIC CDCKROF "Codewort CARB: Klopfregelung Offset" VAL_BLK 0x81448C KwbUw 65535.00 dez 0.00 65535.00 NUMBER 4 FUNCTION_LIST DFPM_DKRNT IF_DATA DIM_X DIRECT 0x81448C /end CHARACTERISTIC
/begin CHARACTERISTIC CDCKRTP "Codewort CARB: Klopfregelung Testimpulse" VAL_BLK 0x814494 KwbUw 65535.00 dez 0.00 65535.00 NUMBER 4 FUNCTION_LIST DFPM_DKRTP IF_DATA DIM_X DIRECT 0x814494 /end CHARACTERISTIC
/begin CHARACTERISTIC CDCKS1 "Codewort CARB:	Klopfsensor 1" VAL_BLK 0x81449C KwbUw 65535.00 dez 0.00 65535.00 NUMBER 4 FUNCTION_LIST DFPM_DKRS IF_DATA DIM_X DIRECT 0x81449C /end CHARACTERISTIC
/begin CHARACTERISTIC CDCKS2 "Codewort CARB:	Klopfsensor 2" VAL_BLK 0x8144A4 KwbUw 65535.00 dez 0.00 65535.00 NUMBER 4 FUNCTION_LIST DFPM_DKRS IF_DATA DIM_X DIRECT 0x8144A4 /end CHARACTERISTIC
/begin CHARACTERISTIC CDCKS3 "Codewort CARB:	Klopfsensor 3" VAL_BLK 0x8144AC KwbUw 65535.00 dez 0.00 65535.00 NUMBER 4 FUNCTION_LIST DFPM_DKRS IF_DATA DIM_X DIRECT 0x8144AC /end CHARACTERISTIC
/begin CHARACTERISTIC CDCKS4 "Codewort CARB:	Klopfsensor 4" VAL_BLK 0x8144B4 KwbUw 65535.00 dez 0.00 65535.00 NUMBER 4 FUNCTION_LIST DFPM_DKRS IF_DATA DIM_X DIRECT 0x8144B4 /end CHARACTERISTIC
/begin CHARACTERISTIC CDCKUPPL "Codewort CARB: Kupplungspedalwertgeber" VAL_BLK 0x8144BC KwbUw 65535.00 dez 0.00 65535.00 NUMBER 4 FUNCTION_LIST DFPM_DKUPPL IF_DATA DIM_X DIRECT 0x8144BC /end CHARACTERISTIC
/begin CHARACTERISTIC CDCLASH "Codewort CARB:	Lambda-Sondenalterung hinter Kat." VAL_BLK 0x8144C4 KwbUw 65535.00 dez 0.00 65535.00 NUMBER 4 FUNCTION_LIST DFPM_DLSAHK IF_DATA DIM_X DIRECT 0x8144C4 /end CHARACTERISTIC
/begin CHARACTERISTIC CDCLDE "Codewort CARB: Ladedrucksteuerventil (Endstufe)" VAL_BLK 0x8144CC KwbUw 65535.00 dez 0.00 65535.00 NUMBER 4 FUNCTION_LIST DFPM_DEKON IF_DATA DIM_X DIRECT 0x8144CC /end CHARACTERISTIC
/begin CHARACTERISTIC CDCLDO "Codewort CARB:	Ladedruckkennlinie; oberer Wert überschritten" VAL_BLK 0x8144D4 KwbUw 65535.00 dez 0.00 65535.00 NUMBER 4 FUNCTION_LIST DFPM_DLDR IF_DATA DIM_X DIRECT 0x8144D4 /end CHARACTERISTIC
/begin CHARACTERISTIC CDCLDP "Codewort CARB: Leckdiagnosepumpe" VAL_BLK 0x8144DC KwbUw 65535.00 dez 0.00 65535.00 NUMBER 4 FUNCTION_LIST DFPM_DLDP IF_DATA DIM_X DIRECT 0x8144DC /end CHARACTERISTIC
/begin CHARACTERISTIC CDCLDPE "Codewort CARB: Leckdiagnosepumpe Endstufe" VAL_BLK 0x8144E4 KwbUw 65535.00 dez 0.00 65535.00 NUMBER 4 FUNCTION_LIST DFPM_LDPE IF_DATA DIM_X DIRECT 0x8144E4 /end CHARACTERISTIC
/begin CHARACTERISTIC CDCLDRA "Codewort CARB:	Ladedruckregelabweichung" VAL_BLK 0x8144EC KwbUw 65535.00 dez 0.00 65535.00 NUMBER 4 FUNCTION_LIST DFPM_DLDR IF_DATA DIM_X DIRECT 0x8144EC /end CHARACTERISTIC
/begin CHARACTERISTIC CDCLDUV "Codewort CARB: Schubumluftventil-Endstufe" VAL_BLK 0x8144F4 KwbUw 65535.00 dez 0.00 65535.00 NUMBER 4 FUNCTION_LIST DFPM_DLDUV IF_DATA DIM_X DIRECT 0x8144F4 /end CHARACTERISTIC
/begin CHARACTERISTIC CDCLKVDK "Codewort CARB: Leck vor Drosselklappe" VAL_BLK 0x8144FC KwbUw 65535.00 dez 0.00 65535.00 NUMBER 4 FUNCTION_LIST DFPM_DLDR IF_DATA DIM_X DIRECT 0x8144FC /end CHARACTERISTIC
/begin CHARACTERISTIC CDCLLR "Codewort CARB: Leerlaufregelung am Anschlag" VAL_BLK 0x814504 KwbUw 65535.00 dez 0.00 65535.00 NUMBER 4 FUNCTION_LIST DFPM_DLLR IF_DATA DIM_X DIRECT 0x814504 /end CHARACTERISTIC
/begin CHARACTERISTIC CDCLM "Codewort CARB:	LMM/HLM/HFM" VAL_BLK 0x81450C KwbUw 65535.00 dez 0.00 65535.00 NUMBER 4 FUNCTION_LIST DFPM_DSELHFS IF_DATA DIM_X DIRECT 0x81450C /end CHARACTERISTIC
/begin CHARACTERISTIC CDCLSH "Codewort CARB:	Lambda-Sonde hinter Kat" VAL_BLK 0x814514 KwbUw 65535.00 dez 0.00 65535.00 NUMBER 4 FUNCTION_LIST DFPM_DLSH IF_DATA DIM_X DIRECT 0x814514 /end CHARACTERISTIC
/begin CHARACTERISTIC CDCLSV "Codewort CARB: Lambda-Sonde vor Kat" VAL_BLK 0x81451C KwbUw 65535.00 dez 0.00 65535.00 NUMBER 4 FUNCTION_LIST DFPM_DLSU IF_DATA DIM_X DIRECT 0x81451C /end CHARACTERISTIC
/begin CHARACTERISTIC CDCLUE1 "" VAL_BLK 0x814524 KwbUw 65535.00 DEZ 0.00 65535.00 NUMBER 4 FUNCTION_LIST DFPM_dkmtr IF_DATA DIM_X DIRECT 0x814524 /end CHARACTERISTIC
/begin CHARACTERISTIC CDCLUES1E "Codeword CARB: Endstufe Lüftersteuerung 1" VAL_BLK 0x81452C KwbUw 65535.00 dez 0.00 65535.00 NUMBER 4 FUNCTION_LIST DFPM_DEKON IF_DATA DIM_X DIRECT 0x81452C /end CHARACTERISTIC
/begin CHARACTERISTIC CDCMD "Codewort CARB: Aussetzer, Summenfehler (multiple)" VAL_BLK 0x814534 KwbUw 65535.00 dez 0.00 65535.00 NUMBER 4 FUNCTION_LIST DFPM_DMDMIL IF_DATA DIM_X DIRECT 0x814534 /end CHARACTERISTIC
/begin CHARACTERISTIC CDCMD00 "Codewort CARB: Aussetzer Zyl. 0" VAL_BLK 0x81453C KwbUw 65535.00 dez 0.00 65535.00 NUMBER 4 FUNCTION_LIST DFPM_DMDMIL IF_DATA DIM_X DIRECT 0x81453C /end CHARACTERISTIC
/begin CHARACTERISTIC CDCMD01 "Codewort CARB: Aussetzer Zyl. 1" VAL_BLK 0x814544 KwbUw 65535.00 dez 0.00 65535.00 NUMBER 4 FUNCTION_LIST DFPM_DMDMIL IF_DATA DIM_X DIRECT 0x814544 /end CHARACTERISTIC
/begin CHARACTERISTIC CDCMD02 "Codewort CARB: Aussetzer Zylinder 2" VAL_BLK 0x81454C KwbUw 65535.00 dez 0.00 65535.00 NUMBER 4 FUNCTION_LIST DFPM_DMDMIL IF_DATA DIM_X DIRECT 0x81454C /end CHARACTERISTIC
/begin CHARACTERISTIC CDCMD03 "Codewort CARB: Aussetzer Zylinder 3" VAL_BLK 0x814554 KwbUw 65535.00 dez 0.00 65535.00 NUMBER 4 FUNCTION_LIST DFPM_DMDMIL IF_DATA DIM_X DIRECT 0x814554 /end CHARACTERISTIC
/begin CHARACTERISTIC CDCMDB "Codewort CARB: Momentbegrenzung Sollmoment" VAL_BLK 0x81455C KwbUw 65535.00 dez 0.00 65535.00 NUMBER 4 FUNCTION_LIST DFPM_MDKOG IF_DATA DIM_X DIRECT 0x81455C /end CHARACTERISTIC
/begin CHARACTERISTIC CDCN "Codewort CARB: Drehzahlsignalgeber" VAL_BLK 0x81456C KwbUw 65535.00 dez 0.00 65535.00 NUMBER 4 FUNCTION_LIST DFPM_DDG IF_DATA DIM_X DIRECT 0x81456C /end CHARACTERISTIC
/begin CHARACTERISTIC CDCNWKW "Codewort CARB: Zuordnung Nockenwelle zu Kurbelwelle" VAL_BLK 0x814574 KwbUw 65535.00 dez 0.00 65535.00 NUMBER 4 FUNCTION_LIST DFPM_DNWKW IF_DATA DIM_X DIRECT 0x814574 /end CHARACTERISTIC
/begin CHARACTERISTIC CDCNWSE "Codewort CARB: Nockenwellensteuerungsventil Endstufe" VAL_BLK 0x81457C KwbUw 65535.00 dez 0.00 65535.00 NUMBER 4 FUNCTION_LIST DFPM_DEKON IF_DATA DIM_X DIRECT 0x81457C /end CHARACTERISTIC
/begin CHARACTERISTIC CDCNX "Codewort CARB:	NMAX - Überschreitung" VAL_BLK 0x814584 KwbUw 65535.00 dez 0.00 65535.00 NUMBER 4 FUNCTION_LIST DFPM_DNMAX IF_DATA DIM_X DIRECT 0x814584 /end CHARACTERISTIC
/begin CHARACTERISTIC CDCPH "Codewort CARB: Phasensensor" VAL_BLK 0x81458C KwbUw 65535.00 dez 0.00 65535.00 NUMBER 4 FUNCTION_LIST DFPM_DPH IF_DATA DIM_X DIRECT 0x81458C /end CHARACTERISTIC
/begin CHARACTERISTIC CDCPWM "" VAL_BLK 0x814594 KwbUw 65535.00 dez 0.00 65535.00 NUMBER 4 FUNCTION_LIST DFPM_DSWEA IF_DATA DIM_X DIRECT 0x814594 /end CHARACTERISTIC
/begin CHARACTERISTIC CDCRKAT "Codewort CARB: LR-Adaption QL-additiv" VAL_BLK 0x81459C KwbUw 65535.00 dez 0.00 65535.00 NUMBER 4 FUNCTION_LIST DFPM_DKVS IF_DATA DIM_X DIRECT 0x81459C /end CHARACTERISTIC
/begin CHARACTERISTIC CDCRKAZ "Codewort CARB: LR-Adaption ti-additiv" VAL_BLK 0x8145A4 KwbUw 65535.00 dez 0.00 65535.00 NUMBER 4 FUNCTION_LIST DFPM_DKVS IF_DATA DIM_X DIRECT 0x8145A4 /end CHARACTERISTIC
/begin CHARACTERISTIC CDCSCR "Codewort CARB: Überwachung Crashsignal" VAL_BLK 0x8145AC KwbUw 65535.00 dez 0.00 65535.00 NUMBER 4 FUNCTION_LIST DFPM_GGCS IF_DATA DIM_X DIRECT 0x8145AC /end CHARACTERISTIC
/begin CHARACTERISTIC CDCSGEEP "Codewort CARB:	Steuergerät defekt (EEPROM)" VAL_BLK 0x8145B4 KwbUw 65535.00 dez 0.00 65535.00 NUMBER 4 FUNCTION_LIST DFPM_DSGEEP IF_DATA DIM_X DIRECT 0x8145B4 /end CHARACTERISTIC
/begin CHARACTERISTIC CDCSGEEW "Codewort CARB: Steuergerät defekt (EEPROM WFS-Bereich)" VAL_BLK 0x8145BC KwbUw 65535.00 dez 0.00 65535.00 NUMBER 4 FUNCTION_LIST DFPM_IMS IF_DATA DIM_X DIRECT 0x8145BC /end CHARACTERISTIC
/begin CHARACTERISTIC CDCSLPE "Codewort CARB: Sekundärluftpumpe (Endstufe)" VAL_BLK 0x8145C4 KwbUw 65535.00 dez 0.00 65535.00 NUMBER 4 FUNCTION_LIST DFPM_DEKON IF_DATA DIM_X DIRECT 0x8145C4 /end CHARACTERISTIC
/begin CHARACTERISTIC CDCSLS "Codewort CARB: Sekundärluft-System" VAL_BLK 0x8145CC KwbUw 65535.00 dez 0.00 65535.00 NUMBER 4 FUNCTION_LIST DFPM_DSLSLRS IF_DATA DIM_X DIRECT 0x8145CC /end CHARACTERISTIC
/begin CHARACTERISTIC CDCSLV "Codewort CARB: Sekundärluftventil" VAL_BLK 0x8145D4 KwbUw 65535.00 dez 0.00 65535.00 NUMBER 4 FUNCTION_LIST DFPM_DSLSLRS IF_DATA DIM_X DIRECT 0x8145D4 /end CHARACTERISTIC
/begin CHARACTERISTIC CDCSLVE "Codewort CARB: Sekundärluftventil (Endstufe)" VAL_BLK 0x8145DC KwbUw 65535.00 dez 0.00 65535.00 NUMBER 4 FUNCTION_LIST DFPM_DEKON IF_DATA DIM_X DIRECT 0x8145DC /end CHARACTERISTIC
/begin CHARACTERISTIC CDCT2STC "" VAL_BLK 0x8145E4 KwbUw 65535.00 dez 0.00 65535.00 NUMBER 4 FUNCTION_LIST DFPM_DT2STC IF_DATA DIM_X DIRECT 0x8145E4 /end CHARACTERISTIC
/begin CHARACTERISTIC CDCTA "Codewort CARB: TANS" VAL_BLK 0x8145EC KwbUw 65535.00 dez 0.00 65535.00 NUMBER 4 FUNCTION_LIST DFPM_GGTFA IF_DATA DIM_X DIRECT 0x8145EC /end CHARACTERISTIC
/begin CHARACTERISTIC CDCTANKL "Codewort CARB: OBDII Fehler auf Grund eines leeren Tanks" VAL_BLK 0x8145F4 KwbUw 65535.00 dez 0.00 65535.00 NUMBER 4 FUNCTION_LIST DFPM_DTANKL IF_DATA DIM_X DIRECT 0x8145F4 /end CHARACTERISTIC
/begin CHARACTERISTIC CDCTES "Codewort CARB: Tankentlüftungssystem" VAL_BLK 0x8145FC KwbUw 65535.00 dez 0.00 65535.00 NUMBER 4 FUNCTION_LIST DFPM_DTEV IF_DATA DIM_X DIRECT 0x8145FC /end CHARACTERISTIC
/begin CHARACTERISTIC CDCTESF "Codewort CARB: Tankentlüftungssystem Feinleck" VAL_BLK 0x814604 KwbUw 65535.00 dez 0.00 65535.00 NUMBER 4 FUNCTION_LIST DFPM_DLDP IF_DATA DIM_X DIRECT 0x814604 /end CHARACTERISTIC
/begin CHARACTERISTIC CDCTESG "Codewort CARB: Tankentlüftungssystem Grobleck" VAL_BLK 0x81460C KwbUw 65535.00 dez 0.00 65535.00 NUMBER 4 FUNCTION_LIST DFPM_DLDP IF_DATA DIM_X DIRECT 0x81460C /end CHARACTERISTIC
/begin CHARACTERISTIC CDCTEVE "Codewort CARB:	Tankentlüftungsventil Endstufe" VAL_BLK 0x814614 KwbUw 65535.00 dez 0.00 65535.00 NUMBER 4 FUNCTION_LIST DFPM_DEKON IF_DATA DIM_X DIRECT 0x814614 /end CHARACTERISTIC
/begin CHARACTERISTIC CDCTEVE2 "Codewort CARB:	Tankentlüftungsventil Endstufe  Bank2" VAL_BLK 0x81461C KwbUw 65535.00 dez 0.00 65535.00 NUMBER 4 FUNCTION_LIST DFPM_DUMMY_D IF_DATA DIM_X DIRECT 0x81461C /end CHARACTERISTIC
/begin CHARACTERISTIC CDCTHM "Codewort CARB: Thermostat-Diagnose THM" VAL_BLK 0x814624 KwbUw 65535.00 dez 0.00 65535.00 NUMBER 4 FUNCTION_LIST DFPM_DTHM IF_DATA DIM_X DIRECT 0x814624 /end CHARACTERISTIC
/begin CHARACTERISTIC CDCTKA "Codewort CARB: Temperatur Kühlerausgang" VAL_BLK 0x81462C KwbUw 65535.00 dez 0.00 65535.00 NUMBER 4 FUNCTION_LIST DFPM_GGTKA IF_DATA DIM_X DIRECT 0x81462C /end CHARACTERISTIC
/begin CHARACTERISTIC CDCTM "Codewort CARB: Motortemperatur TMOT" VAL_BLK 0x814634 KwbUw 65535.00 dez 0.00 65535.00 NUMBER 4 FUNCTION_LIST DFPM_GGTFM IF_DATA DIM_X DIRECT 0x814634 /end CHARACTERISTIC
/begin CHARACTERISTIC CDCTMKI "Codewort CARB: Motortemperatur aus Kombiinstrument TMKI" VAL_BLK 0x81463C KwbUw 65535.00 dez 0.00 65535.00 NUMBER 4 FUNCTION_LIST DFPM_GGGTS IF_DATA DIM_X DIRECT 0x81463C /end CHARACTERISTIC
/begin CHARACTERISTIC CDCTOL "Codewort CARB: Öltemperatur" VAL_BLK 0x814644 KwbUw 65535.00 dez 0.00 65535.00 NUMBER 4 FUNCTION_LIST DFPM_BGTOL IF_DATA DIM_X DIRECT 0x814644 /end CHARACTERISTIC
/begin CHARACTERISTIC CDCTUM "Codewort CARB: Umgebungs(-luft)-Temperatur TUM" VAL_BLK 0x81464C KwbUw 65535.00 dez 0.00 65535.00 NUMBER 4 FUNCTION_LIST DFPM_BGTUMG IF_DATA DIM_X DIRECT 0x81464C /end CHARACTERISTIC
/begin CHARACTERISTIC CDCUB "Codewort CARB: Batteriespannung UB (Bordnetz)" VAL_BLK 0x814654 KwbUw 65535.00 dez 0.00 65535.00 NUMBER 4 FUNCTION_LIST DFPM_GGUB IF_DATA DIM_X DIRECT 0x814654 /end CHARACTERISTIC
/begin CHARACTERISTIC CDCUBR "Codewort CARB: UBR Bordnetzspannung über Hauptrelais" VAL_BLK 0x81465C KwbUw 65535.00 dez 0.00 65535.00 NUMBER 4 FUNCTION_LIST DFPM_GGUBR IF_DATA DIM_X DIRECT 0x81465C /end CHARACTERISTIC
/begin CHARACTERISTIC CDCUFMV "Codewort CARB: Funktionsüberwachung: Momentenvergleich" VAL_BLK 0x814664 KwbUw 65535.00 dez 0.00 65535.00 NUMBER 4 FUNCTION_LIST DFPM_DUF IF_DATA DIM_X DIRECT 0x814664 /end CHARACTERISTIC
/begin CHARACTERISTIC CDCUFSKA "Codewort CARB: Funktionsüberwachung: Sicherheits-Kraftstoff-Abschaltung" VAL_BLK 0x81466C KwbUw 65535.00 dez 0.00 65535.00 NUMBER 4 FUNCTION_LIST DFPM_DUF IF_DATA DIM_X DIRECT 0x81466C /end CHARACTERISTIC
/begin CHARACTERISTIC CDCURRAM "Codewort CARB: Rechnerüberwachung: RAM" VAL_BLK 0x814674 KwbUw 65535.00 dez 0.00 65535.00 NUMBER 4 FUNCTION_LIST DFPM_DUR IF_DATA DIM_X DIRECT 0x814674 /end CHARACTERISTIC
/begin CHARACTERISTIC CDCURROM "Codewort CARB: Rechnerüberwachung: ROM" VAL_BLK 0x81467C KwbUw 65535.00 dez 0.00 65535.00 NUMBER 4 FUNCTION_LIST DFPM_DUR IF_DATA DIM_X DIRECT 0x81467C /end CHARACTERISTIC
/begin CHARACTERISTIC CDCURRST "Codewort CARB: Rechnerüberwachung: Reset" VAL_BLK 0x814684 KwbUw 65535.00 dez 0.00 65535.00 NUMBER 4 FUNCTION_LIST DFPM_DUR IF_DATA DIM_X DIRECT 0x814684 /end CHARACTERISTIC
/begin CHARACTERISTIC CDCUVSE "Codewort CARB: Umluftventil-Steuerung Endstufe" VAL_BLK 0x81468C KwbUw 65535.00 dez 0.00 65535.00 NUMBER 4 FUNCTION_LIST DFPM_DEKON IF_DATA DIM_X DIRECT 0x81468C /end CHARACTERISTIC
/begin CHARACTERISTIC CDCVFZ "Codewort CARB: Fahrzeug-Geschwindigkeit" VAL_BLK 0x814694 KwbUw 65535.00 dez 0.00 65535.00 NUMBER 4 FUNCTION_LIST DFPM_DVFZ IF_DATA DIM_X DIRECT 0x814694 /end CHARACTERISTIC
/begin CHARACTERISTIC CDCWFS "Codewort CARB: Wegfahrsperre" VAL_BLK 0x81469C KwbUw 65535.00 dez 0.00 65535.00 NUMBER 4 FUNCTION_LIST DFPM_IMS IF_DATA DIM_X DIRECT 0x81469C /end CHARACTERISTIC
/begin CHARACTERISTIC CDCWFSRC "Codewort CARB: Wegfahrsperre RC-Glied" VAL_BLK 0x8146A4 KwbUw 65535.00 dez 0.00 65535.00 NUMBER 4 FUNCTION_LIST DFPM_IMS IF_DATA DIM_X DIRECT 0x8146A4 /end CHARACTERISTIC
/begin CHARACTERISTIC CDCZET1 "" VAL_BLK 0x8146AC KwbUw 65535.00 dez 0.00 65535.00 NUMBER 4 FUNCTION_LIST DFPM_DEKON IF_DATA DIM_X DIRECT 0x8146AC /end CHARACTERISTIC
/begin CHARACTERISTIC CDCZET2 "" VAL_BLK 0x8146B4 KwbUw 65535.00 dez 0.00 65535.00 NUMBER 4 FUNCTION_LIST DFPM_DEKON IF_DATA DIM_X DIRECT 0x8146B4 /end CHARACTERISTIC
/begin CHARACTERISTIC CDCZET3 "" VAL_BLK 0x8146BC KwbUw 65535.00 dez 0.00 65535.00 NUMBER 4 FUNCTION_LIST DFPM_DEKON IF_DATA DIM_X DIRECT 0x8146BC /end CHARACTERISTIC
/begin CHARACTERISTIC CDCZET4 "" VAL_BLK 0x8146C4 KwbUw 65535.00 dez 0.00 65535.00 NUMBER 4 FUNCTION_LIST DFPM_DEKON IF_DATA DIM_X DIRECT 0x8146C4 /end CHARACTERISTIC
/begin CHARACTERISTIC CDCZZZ "Dummy: Tabellenende" VAL_BLK 0x8146CC KwbUw 65535.00 dez 0.00 65535.00 NUMBER 4 FUNCTION_LIST DFPM_DFPM IF_DATA DIM_X DIRECT 0x8146CC /end CHARACTERISTIC
/begin CHARACTERISTIC CDDST "Codewort Tankdrucksensor-Diagnose abschalten (EURO-Codierung)" VALUE 0x818198 KwUb 255.0 dez 0.00 255.0 FUNCTION_LIST PROKON IF_DATA DIM_X DIRECT 0x818198 /end CHARACTERISTIC
/begin CHARACTERISTIC CDEGFE "Codewort Diagnose Eingangsgrößen Füllungserfassung" VALUE 0x818199 KwUb 255.0 dez 0.00 255.0 FUNCTION_LIST PROKON IF_DATA DIM_X DIRECT 0x818199 /end CHARACTERISTIC
/begin CHARACTERISTIC CDEHFM "Codewort zum Aktivieren der %DHFM" VALUE 0x81819A KwUb 255.0 dez 0.00 255.0 FUNCTION_LIST PROKON IF_DATA DIM_X DIRECT 0x81819A /end CHARACTERISTIC
/begin CHARACTERISTIC CDFO "Codewort zum Ausschalten und Rücksetzen der Adaption" VALUE 0x8101A9 KwUb 255.0 dez 0.00 255.0 FUNCTION_LIST DMDFON IF_DATA DIM_X DIRECT 0x8101A9 /end CHARACTERISTIC
/begin CHARACTERISTIC CDGGGTS "Codewort GGGTS (Kühlwassertemperatur über Kombi)" VALUE 0x81819B KwUb 255.0 dez 0.00 255.0 FUNCTION_LIST PROKON IF_DATA DIM_X DIRECT 0x81819B /end CHARACTERISTIC
/begin CHARACTERISTIC CDHSH "Codewort Heizerdiagnose hinter Kat (CDHSH = 0  => keine Diagnose)" VALUE 0x81819C KwUb 255.0 dez 0.00 255.0 FUNCTION_LIST PROKON IF_DATA DIM_X DIRECT 0x81819C /end CHARACTERISTIC
/begin CHARACTERISTIC CDHSHE "Eurobit für Diagnose Entstufe Lambdasondenheizung hinter Kat" VALUE 0x81819D KwUb 255.0 dez 0.00 255.0 FUNCTION_LIST PROKON IF_DATA DIM_X DIRECT 0x81819D /end CHARACTERISTIC
/begin CHARACTERISTIC CDHSV "Codewort Heizerdiagnose vor Kat im (CDHSV = 0  => keine Diagnose)" VALUE 0x81819E KwUb 255.0 dez 0.00 255.0 FUNCTION_LIST PROKON IF_DATA DIM_X DIRECT 0x81819E /end CHARACTERISTIC
/begin CHARACTERISTIC CDHSVE "Codewort DHLSE Heizer Endstufe diagnose vor Kat" VALUE 0x81819F KwUb 255.0 dez 0.00 255.0 FUNCTION_LIST PROKON IF_DATA DIM_X DIRECT 0x81819F /end CHARACTERISTIC
/begin CHARACTERISTIC CDHSVSA "Codewort Heizerdiagnose vor Kat im Schub (CDHSVsa = 0  => keine Diagnose)" VALUE 0x8181A0 KwUb 255.0 dez 0.00 255.0 FUNCTION_LIST PROKON IF_DATA DIM_X DIRECT 0x8181A0 /end CHARACTERISTIC
/begin CHARACTERISTIC CDKAAA "Dummy: Tabellenanfang" VAL_BLK 0x8146D4 KwbUw 65535.00 dez 0.00 65535.00 NUMBER 4 FUNCTION_LIST DFPM_DFPM IF_DATA DIM_X DIRECT 0x8146D4 /end CHARACTERISTIC
/begin CHARACTERISTIC CDKAATUN "" VAL_BLK 0x8146DC KwbUw 65535.00 dez 0.00 65535.00 NUMBER 4 FUNCTION_LIST DFPM_TUNING IF_DATA DIM_X DIRECT 0x8146DC /end CHARACTERISTIC
/begin CHARACTERISTIC CDKAGRE "Codewort Kunde: Überwachung AGR-Endstufe" VAL_BLK 0x8146E4 KwbUw 65535.00 dez 0.00 65535.00 NUMBER 4 FUNCTION_LIST DFPM_DEKON IF_DATA DIM_X DIRECT 0x8146E4 /end CHARACTERISTIC
/begin CHARACTERISTIC CDKAT "Codewort Katalysator-Diagnose im OBDII-Mode (invers: Europa-Mode)" VALUE 0x8181A1 KwUb 255.0 dez 0.00 255.0 FUNCTION_LIST PROKON IF_DATA DIM_X DIRECT 0x8181A1 /end CHARACTERISTIC
/begin CHARACTERISTIC CDKATSP "Codewort Katalysator-Diagnose im OBDII-Mode (invers: Europa-Mode)" VALUE 0x8181A2 KwUb 255.0 dez 0.00 255.0 FUNCTION_LIST PROKON IF_DATA DIM_X DIRECT 0x8181A2 /end CHARACTERISTIC
/begin CHARACTERISTIC CDKATSPF "Katdiagnose, Freigabe" VALUE 0x8181A3 KwUb 255.0 dez 0.00 255.0 FUNCTION_LIST PROKON IF_DATA DIM_X DIRECT 0x8181A3 /end CHARACTERISTIC
/begin CHARACTERISTIC CDKBKVP "" VAL_BLK 0x8146F4 KwbUw 65535.00 dez 0.00 65535.00 NUMBER 4 FUNCTION_LIST DFPM_DBKVP IF_DATA DIM_X DIRECT 0x8146F4 /end CHARACTERISTIC
/begin CHARACTERISTIC CDKBKVPE "" VAL_BLK 0x8146FC KwbUw 65535.00 dez 0.00 65535.00 NUMBER 4 FUNCTION_LIST DFPM_DEKON IF_DATA DIM_X DIRECT 0x8146FC /end CHARACTERISTIC
/begin CHARACTERISTIC CDKBM "Codewort Kunde: Bezugsmarkengeber" VAL_BLK 0x814704 KwbUw 65535.00 dez 0.00 65535.00 NUMBER 4 FUNCTION_LIST DFPM_DDG IF_DATA DIM_X DIRECT 0x814704 /end CHARACTERISTIC
/begin CHARACTERISTIC CDKBREMS "Codewort Kunde: BREMS (Bremsschalter)" VAL_BLK 0x81470C KwbUw 65535.00 dez 0.00 65535.00 NUMBER 4 FUNCTION_LIST DFPM_GGEGAS IF_DATA DIM_X DIRECT 0x81470C /end CHARACTERISTIC
/begin CHARACTERISTIC CDKBWF "Codewort Kunde: PWG Bewegung" VAL_BLK 0x814714 KwbUw 65535.00 dez 0.00 65535.00 NUMBER 4 FUNCTION_LIST DFPM_GGPED IF_DATA DIM_X DIRECT 0x814714 /end CHARACTERISTIC
/begin CHARACTERISTIC CDKCAIR "Codewort Kunde: Airbag-Botschaft" VAL_BLK 0x81471C KwbUw 65535.00 dez 0.00 65535.00 NUMBER 4 FUNCTION_LIST DFPM_CAIR IF_DATA DIM_X DIRECT 0x81471C /end CHARACTERISTIC
/begin CHARACTERISTIC CDKCAIRP "Codewort Kunde: unpl. Airbag-Botschaft" VAL_BLK 0x814724 KwbUw 65535.00 dez 0.00 65535.00 NUMBER 4 FUNCTION_LIST DFPM_GGCS IF_DATA DIM_X DIRECT 0x814724 /end CHARACTERISTIC
/begin CHARACTERISTIC CDKCAS "Codewort Kunde: CAN-Schnittstelle, Timeout ASC" VAL_BLK 0x81472C KwbUw 65535.00 dez 0.00 65535.00 NUMBER 4 FUNCTION_LIST DFPM_CAS IF_DATA DIM_X DIRECT 0x81472C /end CHARACTERISTIC
/begin CHARACTERISTIC CDKCAT "Codewort Kunde: CAN-Schnittstelle, Timeout ASR" VAL_BLK 0x814734 KwbUw 65535.00 dez 0.00 65535.00 NUMBER 4 FUNCTION_LIST DFPM_CAT IF_DATA DIM_X DIRECT 0x814734 /end CHARACTERISTIC
/begin CHARACTERISTIC CDKCGE "Codewort Kunde: CAN-Schnittstelle, Timeout EGS" VAL_BLK 0x81473C KwbUw 65535.00 dez 0.00 65535.00 NUMBER 4 FUNCTION_LIST DFPM_CGE IF_DATA DIM_X DIRECT 0x81473C /end CHARACTERISTIC
/begin CHARACTERISTIC CDKCGRA "Codewort Kunde: GRA-Botschaft (Empfang)" VAL_BLK 0x814744 KwbUw 65535.00 dez 0.00 65535.00 NUMBER 4 FUNCTION_LIST DFPM_CGRA IF_DATA DIM_X DIRECT 0x814744 /end CHARACTERISTIC
/begin CHARACTERISTIC CDKCIF "Codewort Kunde: CAN-Schnittstelle, interner Fehler" VAL_BLK 0x81474C KwbUw 65535.00 dez 0.00 65535.00 NUMBER 4 FUNCTION_LIST DFPM_CIF IF_DATA DIM_X DIRECT 0x81474C /end CHARACTERISTIC
/begin CHARACTERISTIC CDKCINS "Codewort Kunde: CAN- timeout, Instrumente" VAL_BLK 0x814754 KwbUw 65535.00 dez 0.00 65535.00 NUMBER 4 FUNCTION_LIST DFPM_CINS IF_DATA DIM_X DIRECT 0x814754 /end CHARACTERISTIC
/begin CHARACTERISTIC CDKCKLA "Codewort Kunde: CAN-Schnittstelle, Timeout Klima" VAL_BLK 0x81475C KwbUw 65535.00 dez 0.00 65535.00 NUMBER 4 FUNCTION_LIST DFPM_CKLA IF_DATA DIM_X DIRECT 0x81475C /end CHARACTERISTIC
/begin CHARACTERISTIC CDKCLWS "Codewort Kunde: CAN-Schnittstelle, Timeout Botschaft Lenkwinkelsensor" VAL_BLK 0x814764 KwbUw 65535.00 dez 0.00 65535.00 NUMBER 4 FUNCTION_LIST DFPM_CLWS IF_DATA DIM_X DIRECT 0x814764 /end CHARACTERISTIC
/begin CHARACTERISTIC CDKDK "Codewort Kunde: DK - Potentiometer" VAL_BLK 0x814774 KwbUw 65535.00 dez 0.00 65535.00 NUMBER 4 FUNCTION_LIST DFPM_DDVE IF_DATA DIM_X DIRECT 0x814774 /end CHARACTERISTIC
/begin CHARACTERISTIC CDKDK1P "Codewort Kunde: Drosselklappe 1. Poti" VAL_BLK 0x81477C KwbUw 65535.00 dez 0.00 65535.00 NUMBER 4 FUNCTION_LIST DFPM_DDVE IF_DATA DIM_X DIRECT 0x81477C /end CHARACTERISTIC
/begin CHARACTERISTIC CDKDK2P "Codewort Kunde: Drosselklappenpotentiometer 2" VAL_BLK 0x814784 KwbUw 65535.00 dez 0.00 65535.00 NUMBER 4 FUNCTION_LIST DFPM_DDVE IF_DATA DIM_X DIRECT 0x814784 /end CHARACTERISTIC
/begin CHARACTERISTIC CDKDPL "Codewort Kunde: Dauerplus" VAL_BLK 0x81478C KwbUw 65535.00 dez 0.00 65535.00 NUMBER 4 FUNCTION_LIST DFPM_DPL IF_DATA DIM_X DIRECT 0x81478C /end CHARACTERISTIC
/begin CHARACTERISTIC CDKDSBKV "Codewort Kunde: Bremskraftverstärker" VAL_BLK 0x814794 KwbUw 65535.00 dez 0.00 65535.00 NUMBER 4 FUNCTION_LIST DFPM_DSBKV IF_DATA DIM_X DIRECT 0x814794 /end CHARACTERISTIC
/begin CHARACTERISTIC CDKDSL "Codewort Kunde: Drucksensor Ladedruck" VAL_BLK 0x81479C KwbUw 65535.00 dez 0.00 65535.00 NUMBER 4 FUNCTION_LIST DFPM_GGDSAS IF_DATA DIM_X DIRECT 0x81479C /end CHARACTERISTIC
/begin CHARACTERISTIC CDKDSU "Codewort Kunde: Drucksensor Umgebung" VAL_BLK 0x8147A4 KwbUw 65535.00 dez 0.00 65535.00 NUMBER 4 FUNCTION_LIST DFPM_GGDSAS IF_DATA DIM_X DIRECT 0x8147A4 /end CHARACTERISTIC
/begin CHARACTERISTIC CDKDSVLU "Codewort Kunde: Drucksensorsignalvergleich (DS-L DS-U)" VAL_BLK 0x8147AC KwbUw 65535.00 dez 0.00 65535.00 NUMBER 4 FUNCTION_LIST DFPM_GGDSAS IF_DATA DIM_X DIRECT 0x8147AC /end CHARACTERISTIC
/begin CHARACTERISTIC CDKDVEE "Codewort Kunde: DV-E Endstufe" VAL_BLK 0x8147B4 KwbUw 65535.00 dez 0.00 65535.00 NUMBER 4 FUNCTION_LIST DFPM_DDVE IF_DATA DIM_X DIRECT 0x8147B4 /end CHARACTERISTIC
/begin CHARACTERISTIC CDKDVEF "Codewort Kunde: DV-E Fehler bei Federprüfung" VAL_BLK 0x8147BC KwbUw 65535.00 dez 0.00 65535.00 NUMBER 4 FUNCTION_LIST DFPM_DDVE IF_DATA DIM_X DIRECT 0x8147BC /end CHARACTERISTIC
/begin CHARACTERISTIC CDKDVEFO "" VAL_BLK 0x8147C4 KwbUw 65535.00 dez 0.00 65535.00 NUMBER 4 FUNCTION_LIST DFPM_DDVE IF_DATA DIM_X DIRECT 0x8147C4 /end CHARACTERISTIC
/begin CHARACTERISTIC CDKDVEL "Codewort Kunde: DV-E Lageabweichung" VAL_BLK 0x8147CC KwbUw 65535.00 dez 0.00 65535.00 NUMBER 4 FUNCTION_LIST DFPM_DDVE IF_DATA DIM_X DIRECT 0x8147CC /end CHARACTERISTIC
/begin CHARACTERISTIC CDKDVEN "Codewort Kunde: DV-E Fehler bei Prüfung Notlufposition" VAL_BLK 0x8147D4 KwbUw 65535.00 dez 0.00 65535.00 NUMBER 4 FUNCTION_LIST DFPM_DDVE IF_DATA DIM_X DIRECT 0x8147D4 /end CHARACTERISTIC
/begin CHARACTERISTIC CDKDVER "Codewort Kunde: DV-E Regelbereich" VAL_BLK 0x8147DC KwbUw 65535.00 dez 0.00 65535.00 NUMBER 4 FUNCTION_LIST DFPM_DDVE IF_DATA DIM_X DIRECT 0x8147DC /end CHARACTERISTIC
/begin CHARACTERISTIC CDKDVET "" VAL_BLK 0x8147E4 KwbUw 65535.00 dez 0.00 65535.00 NUMBER 4 FUNCTION_LIST DFPM_DDVE IF_DATA DIM_X DIRECT 0x8147E4 /end CHARACTERISTIC
/begin CHARACTERISTIC CDKDVEU "Codewort Kunde: DV-E Fehler beim UMA-Lernen" VAL_BLK 0x8147EC KwbUw 65535.00 dez 0.00 65535.00 NUMBER 4 FUNCTION_LIST DFPM_DDVE IF_DATA DIM_X DIRECT 0x8147EC /end CHARACTERISTIC
/begin CHARACTERISTIC CDKDVEUB "" VAL_BLK 0x8147F4 KwbUw 65535.00 dez 0.00 65535.00 NUMBER 4 FUNCTION_LIST DFPM_DDVE IF_DATA DIM_X DIRECT 0x8147F4 /end CHARACTERISTIC
/begin CHARACTERISTIC CDKDVEUW "" VAL_BLK 0x8147FC KwbUw 65535.00 dez 0.00 65535.00 NUMBER 4 FUNCTION_LIST DFPM_DDVE IF_DATA DIM_X DIRECT 0x8147FC /end CHARACTERISTIC
/begin CHARACTERISTIC CDKDVEV "Codewort Kunde: DV-E Fehler bei Verstärkerabgleich" VAL_BLK 0x814804 KwbUw 65535.00 dez 0.00 65535.00 NUMBER 4 FUNCTION_LIST DFPM_DDVE IF_DATA DIM_X DIRECT 0x814804 /end CHARACTERISTIC
/begin CHARACTERISTIC CDKEGFE "Codewort Kunde: Lasterfassung" VAL_BLK 0x81480C KwbUw 65535.00 dez 0.00 65535.00 NUMBER 4 FUNCTION_LIST DFPM_DEGFE IF_DATA DIM_X DIRECT 0x81480C /end CHARACTERISTIC
/begin CHARACTERISTIC CDKENWS "Codewort Kunde: Nockenwellensteuerung Einlass Nockenwelle" VAL_BLK 0x814814 KwbUw 65535.00 dez 0.00 65535.00 NUMBER 4 FUNCTION_LIST DFPM_DENWS IF_DATA DIM_X DIRECT 0x814814 /end CHARACTERISTIC
/begin CHARACTERISTIC CDKETRE "" VAL_BLK 0x814824 KwbUw 65535.00 dez 0.00 65535.00 NUMBER 4 FUNCTION_LIST DFPM_DEKON IF_DATA DIM_X DIRECT 0x814824 /end CHARACTERISTIC
/begin CHARACTERISTIC CDKEV1 "Codewort Kunde: EV von Zyl. 1" VAL_BLK 0x81482C KwbUw 65535.00 dez 0.00 65535.00 NUMBER 4 FUNCTION_LIST DFPM_DEKON IF_DATA DIM_X DIRECT 0x81482C /end CHARACTERISTIC
/begin CHARACTERISTIC CDKEV2 "Codewort Kunde: EV von Zyl. 2" VAL_BLK 0x814834 KwbUw 65535.00 dez 0.00 65535.00 NUMBER 4 FUNCTION_LIST DFPM_DEKON IF_DATA DIM_X DIRECT 0x814834 /end CHARACTERISTIC
/begin CHARACTERISTIC CDKEV3 "Codewort Kunde: EV von Zyl. 3" VAL_BLK 0x81483C KwbUw 65535.00 dez 0.00 65535.00 NUMBER 4 FUNCTION_LIST DFPM_DEKON IF_DATA DIM_X DIRECT 0x81483C /end CHARACTERISTIC
/begin CHARACTERISTIC CDKEV4 "Codewort Kunde: EV von Zyl. 4" VAL_BLK 0x814844 KwbUw 65535.00 dez 0.00 65535.00 NUMBER 4 FUNCTION_LIST DFPM_DEKON IF_DATA DIM_X DIRECT 0x814844 /end CHARACTERISTIC
/begin CHARACTERISTIC CDKFP1P "Codewort Kunde: Poti 1, Fahrpedal" VAL_BLK 0x81484C KwbUw 65535.00 dez 0.00 65535.00 NUMBER 4 FUNCTION_LIST DFPM_GGPED IF_DATA DIM_X DIRECT 0x81484C /end CHARACTERISTIC
/begin CHARACTERISTIC CDKFP2P "Codewort Kunde: Poti 2, Fahrpedal" VAL_BLK 0x814854 KwbUw 65535.00 dez 0.00 65535.00 NUMBER 4 FUNCTION_LIST DFPM_GGPED IF_DATA DIM_X DIRECT 0x814854 /end CHARACTERISTIC
/begin CHARACTERISTIC CDKFPP "Codewort Kunde: Poti Fahrpedal" VAL_BLK 0x81485C KwbUw 65535.00 dez 0.00 65535.00 NUMBER 4 FUNCTION_LIST DFPM_GGPED IF_DATA DIM_X DIRECT 0x81485C /end CHARACTERISTIC
/begin CHARACTERISTIC CDKFRAO "Codewort Kunde: LR- Adaption multi. obere Schwelle" VAL_BLK 0x814864 KwbUw 65535.00 dez 0.00 65535.00 NUMBER 4 FUNCTION_LIST DFPM_DKVS IF_DATA DIM_X DIRECT 0x814864 /end CHARACTERISTIC
/begin CHARACTERISTIC CDKFRAU "Codewort Kunde: LR- Adaption multi. untere Schwelle" VAL_BLK 0x81486C KwbUw 65535.00 dez 0.00 65535.00 NUMBER 4 FUNCTION_LIST DFPM_DKVS IF_DATA DIM_X DIRECT 0x81486C /end CHARACTERISTIC
/begin CHARACTERISTIC CDKFRST "Codewort Kunde: LR- Abweichung" VAL_BLK 0x814874 KwbUw 65535.00 dez 0.00 65535.00 NUMBER 4 FUNCTION_LIST DFPM_DKVS IF_DATA DIM_X DIRECT 0x814874 /end CHARACTERISTIC
/begin CHARACTERISTIC CDKGECOD "Codewort Kunde: Getriebecodierung CAN" VAL_BLK 0x81487C KwbUw 65535.00 dez 0.00 65535.00 NUMBER 4 FUNCTION_LIST DFPM_GECOD IF_DATA DIM_X DIRECT 0x81487C /end CHARACTERISTIC
/begin CHARACTERISTIC CDKGRBH "Codewort Kunde: GRA Bedienhebelfehler" VAL_BLK 0x814884 KwbUw 65535.00 dez 0.00 65535.00 NUMBER 4 FUNCTION_LIST DFPM_GGFGRH IF_DATA DIM_X DIRECT 0x814884 /end CHARACTERISTIC
/begin CHARACTERISTIC CDKHLA "Codeword Kunde: Heizleistungsanforderung" VAL_BLK 0x81488C KwbUw 65535.00 dez 0.00 65535.00 NUMBER 4 FUNCTION_LIST DFPM_GGHLA IF_DATA DIM_X DIRECT 0x81488C /end CHARACTERISTIC
/begin CHARACTERISTIC CDKHRE "" VAL_BLK 0x814894 KwbUw 65535.00 dez 0.00 65535.00 NUMBER 4 FUNCTION_LIST DFPM_HRE IF_DATA DIM_X DIRECT 0x814894 /end CHARACTERISTIC
/begin CHARACTERISTIC CDKHSH "Codewort Kunde:Lambdasonden-Heizung hinter Katalysator" VAL_BLK 0x81489C KwbUw 65535.00 dez 0.00 65535.00 NUMBER 4 FUNCTION_LIST DFPM_DHLSHK IF_DATA DIM_X DIRECT 0x81489C /end CHARACTERISTIC
/begin CHARACTERISTIC CDKHSH2 "Codewort Kunde:	Lambdasonden-Heizung hinter Katalysator, Bank 2" VAL_BLK 0x8148A4 KwbUw 65535.00 dez 0.00 65535.00 NUMBER 4 FUNCTION_LIST DFPM_DHLSHK IF_DATA DIM_X DIRECT 0x8148A4 /end CHARACTERISTIC
/begin CHARACTERISTIC CDKHSHE "Codewort Kunde: Endstufe Heizung Sonde hinter Kat." VAL_BLK 0x8148AC KwbUw 65535.00 dez 0.00 65535.00 NUMBER 4 FUNCTION_LIST DFPM_DEKON IF_DATA DIM_X DIRECT 0x8148AC /end CHARACTERISTIC
/begin CHARACTERISTIC CDKHSV "Codewort Kunde: Lambdasonden-Heizung vor Katalysator" VAL_BLK 0x8148B4 KwbUw 65535.00 dez 0.00 65535.00 NUMBER 4 FUNCTION_LIST DFPM_DHLSU IF_DATA DIM_X DIRECT 0x8148B4 /end CHARACTERISTIC
/begin CHARACTERISTIC CDKHSV2 "Codewort Kunde:	Lambdasonden-Heizung vor Katalysator, Bank 2" VAL_BLK 0x8148BC KwbUw 65535.00 dez 0.00 65535.00 NUMBER 4 FUNCTION_LIST DFPM_DHLSU IF_DATA DIM_X DIRECT 0x8148BC /end CHARACTERISTIC
/begin CHARACTERISTIC CDKHSVSA "" VAL_BLK 0x8148C4 KwbUw 65535.00 dez 0.00 65535.00 NUMBER 4 FUNCTION_LIST DFPM_DHLSU IF_DATA DIM_X DIRECT 0x8148C4 /end CHARACTERISTIC
/begin CHARACTERISTIC CDKHSVSA2 "" VAL_BLK 0x8148CC KwbUw 65535.00 dez 0.00 65535.00 NUMBER 4 FUNCTION_LIST DFPM_DHLSU IF_DATA DIM_X DIRECT 0x8148CC /end CHARACTERISTIC
/begin CHARACTERISTIC CDKKAT "Codewort Kunde:	Katalysator-Konvertierung" VAL_BLK 0x8148D4 KwbUw 65535.00 dez 0.00 65535.00 NUMBER 4 FUNCTION_LIST DFPM_DKATSP IF_DATA DIM_X DIRECT 0x8148D4 /end CHARACTERISTIC
/begin CHARACTERISTIC CDKKPE "Codewort Kunde: EKP-Relais Endstufe" VAL_BLK 0x8148DC KwbUw 65535.00 dez 0.00 65535.00 NUMBER 4 FUNCTION_LIST DFPM_DEKON IF_DATA DIM_X DIRECT 0x8148DC /end CHARACTERISTIC
/begin CHARACTERISTIC CDKKRA01 "Codewort Kunde: Klopfregelanschlag Zylinder 1" VAL_BLK 0x8148E4 KwbUw 65535.00 dez 0.00 65535.00 NUMBER 4 FUNCTION_LIST DFPM_DKRA IF_DATA DIM_X DIRECT 0x8148E4 /end CHARACTERISTIC
/begin CHARACTERISTIC CDKKRA02 "Codewort Kunde: Klopfregelanschlag Zylinder 2" VAL_BLK 0x8148EC KwbUw 65535.00 dez 0.00 65535.00 NUMBER 4 FUNCTION_LIST DFPM_DKRA IF_DATA DIM_X DIRECT 0x8148EC /end CHARACTERISTIC
/begin CHARACTERISTIC CDKKRA03 "Codewort Kunde: Klopfregelanschlag Zylinder 3" VAL_BLK 0x8148F4 KwbUw 65535.00 dez 0.00 65535.00 NUMBER 4 FUNCTION_LIST DFPM_DKRA IF_DATA DIM_X DIRECT 0x8148F4 /end CHARACTERISTIC
/begin CHARACTERISTIC CDKKRA04 "Codewort Kunde: Klopfregelanschlag Zylinder 4" VAL_BLK 0x8148FC KwbUw 65535.00 dez 0.00 65535.00 NUMBER 4 FUNCTION_LIST DFPM_DKRA IF_DATA DIM_X DIRECT 0x8148FC /end CHARACTERISTIC
/begin CHARACTERISTIC CDKKRNT "Codewort Kunde:	Klopfregelung Nulltest" VAL_BLK 0x814904 KwbUw 65535.00 dez 0.00 65535.00 NUMBER 4 FUNCTION_LIST DFPM_DKRNT IF_DATA DIM_X DIRECT 0x814904 /end CHARACTERISTIC
/begin CHARACTERISTIC CDKKROF "Codewort Kunde:	Klopfregelung Offset" VAL_BLK 0x81490C KwbUw 65535.00 dez 0.00 65535.00 NUMBER 4 FUNCTION_LIST DFPM_DKRNT IF_DATA DIM_X DIRECT 0x81490C /end CHARACTERISTIC
/begin CHARACTERISTIC CDKKRTP "Codewort Kunde: Klopfregelung Testimpuls" VAL_BLK 0x814914 KwbUw 65535.00 dez 0.00 65535.00 NUMBER 4 FUNCTION_LIST DFPM_DKRTP IF_DATA DIM_X DIRECT 0x814914 /end CHARACTERISTIC
/begin CHARACTERISTIC CDKKS1 "Codewort Kunde:	Klopfsensor 1" VAL_BLK 0x81491C KwbUw 65535.00 dez 0.00 65535.00 NUMBER 4 FUNCTION_LIST DFPM_DKRS IF_DATA DIM_X DIRECT 0x81491C /end CHARACTERISTIC
/begin CHARACTERISTIC CDKKS2 "Codewort Kunde:	Klopfsensor 2" VAL_BLK 0x814924 KwbUw 65535.00 dez 0.00 65535.00 NUMBER 4 FUNCTION_LIST DFPM_DKRS IF_DATA DIM_X DIRECT 0x814924 /end CHARACTERISTIC
/begin CHARACTERISTIC CDKKS3 "Codewort Kunde:	Klopfsensor 3" VAL_BLK 0x81492C KwbUw 65535.00 dez 0.00 65535.00 NUMBER 4 FUNCTION_LIST DFPM_DKRS IF_DATA DIM_X DIRECT 0x81492C /end CHARACTERISTIC
/begin CHARACTERISTIC CDKKS4 "Codewort Kunde:	Klopfsensor 4" VAL_BLK 0x814934 KwbUw 65535.00 dez 0.00 65535.00 NUMBER 4 FUNCTION_LIST DFPM_DKRS IF_DATA DIM_X DIRECT 0x814934 /end CHARACTERISTIC
/begin CHARACTERISTIC CDKKUPPL "Codewort Kunde: Pedalwertgeber Kupplung" VAL_BLK 0x81493C KwbUw 65535.00 dez 0.00 65535.00 NUMBER 4 FUNCTION_LIST DFPM_DKUPPL IF_DATA DIM_X DIRECT 0x81493C /end CHARACTERISTIC
/begin CHARACTERISTIC CDKLASH "Codewort Kunde: Lambda-Sondenalterung hinter Kat." VAL_BLK 0x814944 KwbUw 65535.00 dez 0.00 65535.00 NUMBER 4 FUNCTION_LIST DFPM_DLSAHK IF_DATA DIM_X DIRECT 0x814944 /end CHARACTERISTIC
/begin CHARACTERISTIC CDKLDE "Codeword Kunde: Ladedrucksteuerventil (Endstufe)" VAL_BLK 0x81494C KwbUw 65535.00 dez 0.00 65535.00 NUMBER 4 FUNCTION_LIST DFPM_DEKON IF_DATA DIM_X DIRECT 0x81494C /end CHARACTERISTIC
/begin CHARACTERISTIC CDKLDP "Codewort Kunde: Leckdiagnosepumpe" VAL_BLK 0x81495C KwbUw 65535.00 dez 0.00 65535.00 NUMBER 4 FUNCTION_LIST DFPM_DLDP IF_DATA DIM_X DIRECT 0x81495C /end CHARACTERISTIC
/begin CHARACTERISTIC CDKLDPE "Codewort Kunde: Leckdiagnosepumpe Endstufe" VAL_BLK 0x814964 KwbUw 65535.00 dez 0.00 65535.00 NUMBER 4 FUNCTION_LIST DFPM_LDPE IF_DATA DIM_X DIRECT 0x814964 /end CHARACTERISTIC
/begin CHARACTERISTIC CDKLDRA "Codewort Kunde:	Ladedruckregelabweichung" VAL_BLK 0x81496C KwbUw 65535.00 dez 0.00 65535.00 NUMBER 4 FUNCTION_LIST DFPM_DLDR IF_DATA DIM_X DIRECT 0x81496C /end CHARACTERISTIC
/begin CHARACTERISTIC CDKLDUV "Codewort Kunde: Schubumluftventil-Endstufe" VAL_BLK 0x814974 KwbUw 65535.00 dez 0.00 65535.00 NUMBER 4 FUNCTION_LIST DFPM_DLDUV IF_DATA DIM_X DIRECT 0x814974 /end CHARACTERISTIC
/begin CHARACTERISTIC CDKLKVDK "Codewort Kunde: Leck vor Drosselklappe" VAL_BLK 0x81497C KwbUw 65535.00 dez 0.00 65535.00 NUMBER 4 FUNCTION_LIST DFPM_DLDR IF_DATA DIM_X DIRECT 0x81497C /end CHARACTERISTIC
/begin CHARACTERISTIC CDKLLR "Codewort Kunde: Leerlaufregelung am Anschlag" VAL_BLK 0x814984 KwbUw 65535.00 dez 0.00 65535.00 NUMBER 4 FUNCTION_LIST DFPM_DLLR IF_DATA DIM_X DIRECT 0x814984 /end CHARACTERISTIC
/begin CHARACTERISTIC CDKLM "Codewort Kunde:	LMM/HLM/HFM" VAL_BLK 0x81498C KwbUw 65535.00 dez 0.00 65535.00 NUMBER 4 FUNCTION_LIST DFPM_DSELHFS IF_DATA DIM_X DIRECT 0x81498C /end CHARACTERISTIC
/begin CHARACTERISTIC CDKLSH "Codewort Kunde: Lambda-Sonde hinter Kat" VAL_BLK 0x814994 KwbUw 65535.00 dez 0.00 65535.00 NUMBER 4 FUNCTION_LIST DFPM_DLSH IF_DATA DIM_X DIRECT 0x814994 /end CHARACTERISTIC
/begin CHARACTERISTIC CDKLSV "Codewort Kunde:	Lambda-Sonde vor Kat" VAL_BLK 0x81499C KwbUw 65535.00 dez 0.00 65535.00 NUMBER 4 FUNCTION_LIST DFPM_DLSU IF_DATA DIM_X DIRECT 0x81499C /end CHARACTERISTIC
/begin CHARACTERISTIC CDKLUE1 "" VAL_BLK 0x8149A4 KwbUw 65535.00 DEZ 0.00 65535.00 NUMBER 4 FUNCTION_LIST DFPM_dkmtr IF_DATA DIM_X DIRECT 0x8149A4 /end CHARACTERISTIC
/begin CHARACTERISTIC CDKLUES1E "" VAL_BLK 0x8149AC KwbUw 65535.00 dez 0.00 65535.00 NUMBER 4 FUNCTION_LIST DFPM_DEKON IF_DATA DIM_X DIRECT 0x8149AC /end CHARACTERISTIC
/begin CHARACTERISTIC CDKMD "Codewort Kunde: Aussetzer, Summenfehler (multiple)" VAL_BLK 0x8149B4 KwbUw 65535.00 dez 0.00 65535.00 NUMBER 4 FUNCTION_LIST DFPM_DMDMIL IF_DATA DIM_X DIRECT 0x8149B4 /end CHARACTERISTIC
/begin CHARACTERISTIC CDKMD00 "Codewort Kunde: Aussetzer Zyl. 0" VAL_BLK 0x8149BC KwbUw 65535.00 dez 0.00 65535.00 NUMBER 4 FUNCTION_LIST DFPM_DMDMIL IF_DATA DIM_X DIRECT 0x8149BC /end CHARACTERISTIC
/begin CHARACTERISTIC CDKMD01 "Codewort Kunde: Aussetzer Zyl. 1" VAL_BLK 0x8149C4 KwbUw 65535.00 dez 0.00 65535.00 NUMBER 4 FUNCTION_LIST DFPM_DMDMIL IF_DATA DIM_X DIRECT 0x8149C4 /end CHARACTERISTIC
/begin CHARACTERISTIC CDKMD02 "Codewort Kunde: Aussetzer Zylinder 2" VAL_BLK 0x8149CC KwbUw 65535.00 dez 0.00 65535.00 NUMBER 4 FUNCTION_LIST DFPM_DMDMIL IF_DATA DIM_X DIRECT 0x8149CC /end CHARACTERISTIC
/begin CHARACTERISTIC CDKMD03 "Codewort Kunde: Aussetzer Zylinder 3" VAL_BLK 0x8149D4 KwbUw 65535.00 dez 0.00 65535.00 NUMBER 4 FUNCTION_LIST DFPM_DMDMIL IF_DATA DIM_X DIRECT 0x8149D4 /end CHARACTERISTIC
/begin CHARACTERISTIC CDKMDB "Codewort Kunde: Momentbegrenzung Sollmoment" VAL_BLK 0x8149DC KwbUw 65535.00 dez 0.00 65535.00 NUMBER 4 FUNCTION_LIST DFPM_MDKOG IF_DATA DIM_X DIRECT 0x8149DC /end CHARACTERISTIC
/begin CHARACTERISTIC CDKMFA "Codewort Kunde: MIL-fremdbestimmt" VAL_BLK 0x8149E4 KwbUw 65535.00 dez 0.00 65535.00 NUMBER 4 FUNCTION_LIST DFPM_DMFB IF_DATA DIM_X DIRECT 0x8149E4 /end CHARACTERISTIC
/begin CHARACTERISTIC CDKN "Codewort Kunde: Drehzahlsignalgeber" VAL_BLK 0x8149EC KwbUw 65535.00 dez 0.00 65535.00 NUMBER 4 FUNCTION_LIST DFPM_DDG IF_DATA DIM_X DIRECT 0x8149EC /end CHARACTERISTIC
/begin CHARACTERISTIC CDKNWKW "Codewort Kunde: Zuordnung Nockwelle zu Kurbelwelle" VAL_BLK 0x8149F4 KwbUw 65535.00 dez 0.00 65535.00 NUMBER 4 FUNCTION_LIST DFPM_DNWKW IF_DATA DIM_X DIRECT 0x8149F4 /end CHARACTERISTIC
/begin CHARACTERISTIC CDKNWSE "Codewort Kunde: Nockenwellensteuerungsventil Endstufe" VAL_BLK 0x8149FC KwbUw 65535.00 dez 0.00 65535.00 NUMBER 4 FUNCTION_LIST DFPM_DEKON IF_DATA DIM_X DIRECT 0x8149FC /end CHARACTERISTIC
/begin CHARACTERISTIC CDKNX "Codewort Kunde:	NMAX - Überschreitung" VAL_BLK 0x814A04 KwbUw 65535.00 dez 0.00 65535.00 NUMBER 4 FUNCTION_LIST DFPM_DNMAX IF_DATA DIM_X DIRECT 0x814A04 /end CHARACTERISTIC
/begin CHARACTERISTIC CDKPH "Codewort Kunde: Phasensensor" VAL_BLK 0x814A0C KwbUw 65535.00 dez 0.00 65535.00 NUMBER 4 FUNCTION_LIST DFPM_DPH IF_DATA DIM_X DIRECT 0x814A0C /end CHARACTERISTIC
/begin CHARACTERISTIC CDKPWM "" VAL_BLK 0x814A14 KwbUw 65535.00 dez 0.00 65535.00 NUMBER 4 FUNCTION_LIST DFPM_DSWEA IF_DATA DIM_X DIRECT 0x814A14 /end CHARACTERISTIC
/begin CHARACTERISTIC CDKRKAT "Codewort Kunde: LR- Adaption pro Zeit" VAL_BLK 0x814A1C KwbUw 65535.00 dez 0.00 65535.00 NUMBER 4 FUNCTION_LIST DFPM_DKVS IF_DATA DIM_X DIRECT 0x814A1C /end CHARACTERISTIC
/begin CHARACTERISTIC CDKRKAZ "Codewort Kunde: LR- Adaption additiv pro Zündung" VAL_BLK 0x814A24 KwbUw 65535.00 dez 0.00 65535.00 NUMBER 4 FUNCTION_LIST DFPM_DKVS IF_DATA DIM_X DIRECT 0x814A24 /end CHARACTERISTIC
/begin CHARACTERISTIC CDKSCR "Codewort Kunde: CRAS-Signal" VAL_BLK 0x814A2C KwbUw 65535.00 dez 0.00 65535.00 NUMBER 4 FUNCTION_LIST DFPM_GGCS IF_DATA DIM_X DIRECT 0x814A2C /end CHARACTERISTIC
/begin CHARACTERISTIC CDKSGEEP "Codewort Kunde:	Steuergerät defekt (EEPROM)" VAL_BLK 0x814A34 KwbUw 65535.00 dez 0.00 65535.00 NUMBER 4 FUNCTION_LIST DFPM_DSGEEP IF_DATA DIM_X DIRECT 0x814A34 /end CHARACTERISTIC
/begin CHARACTERISTIC CDKSGEEW "Codewort Kunde: Steuergerät defekt (EEPROM WFS-Bereich)" VAL_BLK 0x814A3C KwbUw 65535.00 dez 0.00 65535.00 NUMBER 4 FUNCTION_LIST DFPM_IMS IF_DATA DIM_X DIRECT 0x814A3C /end CHARACTERISTIC
/begin CHARACTERISTIC CDKSLPE "Codewort Kunde: Sekundärluftpumpe  (Endstufe)" VAL_BLK 0x814A44 KwbUw 65535.00 dez 0.00 65535.00 NUMBER 4 FUNCTION_LIST DFPM_DEKON IF_DATA DIM_X DIRECT 0x814A44 /end CHARACTERISTIC
/begin CHARACTERISTIC CDKSLS "Codewort Kunde: Sekundärluft-System" VAL_BLK 0x814A4C KwbUw 65535.00 dez 0.00 65535.00 NUMBER 4 FUNCTION_LIST DFPM_DSLSLRS IF_DATA DIM_X DIRECT 0x814A4C /end CHARACTERISTIC
/begin CHARACTERISTIC CDKSLV "Codewort Kunde:	Sekundärluftventil" VAL_BLK 0x814A54 KwbUw 65535.00 dez 0.00 65535.00 NUMBER 4 FUNCTION_LIST DFPM_DSLSLRS IF_DATA DIM_X DIRECT 0x814A54 /end CHARACTERISTIC
/begin CHARACTERISTIC CDKSLVE "Codewort Kunde:	Sekundärluftventil (Endstufe)" VAL_BLK 0x814A5C KwbUw 65535.00 dez 0.00 65535.00 NUMBER 4 FUNCTION_LIST DFPM_DEKON IF_DATA DIM_X DIRECT 0x814A5C /end CHARACTERISTIC
/begin CHARACTERISTIC CDKT2STC "" VAL_BLK 0x814A64 KwbUw 65535.00 dez 0.00 65535.00 NUMBER 4 FUNCTION_LIST DFPM_DT2STC IF_DATA DIM_X DIRECT 0x814A64 /end CHARACTERISTIC
/begin CHARACTERISTIC CDKTA "Codewort Kunde:	TANS" VAL_BLK 0x814A6C KwbUw 65535.00 dez 0.00 65535.00 NUMBER 4 FUNCTION_LIST DFPM_GGTFA IF_DATA DIM_X DIRECT 0x814A6C /end CHARACTERISTIC
/begin CHARACTERISTIC CDKTANKL "Codewort Kunde: OBDII Fehler auf Grund eines leeren Tanks" VAL_BLK 0x814A74 KwbUw 65535.00 dez 0.00 65535.00 NUMBER 4 FUNCTION_LIST DFPM_DTANKL IF_DATA DIM_X DIRECT 0x814A74 /end CHARACTERISTIC
/begin CHARACTERISTIC CDKTES "Codewort Kunde: Tankentlüftungssystem" VAL_BLK 0x814A7C KwbUw 65535.00 dez 0.00 65535.00 NUMBER 4 FUNCTION_LIST DFPM_DTEV IF_DATA DIM_X DIRECT 0x814A7C /end CHARACTERISTIC
/begin CHARACTERISTIC CDKTESF "Codewort Kunde: Tankentlüftungssystem Feinleck" VAL_BLK 0x814A84 KwbUw 65535.00 dez 0.00 65535.00 NUMBER 4 FUNCTION_LIST DFPM_DLDP IF_DATA DIM_X DIRECT 0x814A84 /end CHARACTERISTIC
/begin CHARACTERISTIC CDKTESG "Codewort Kunde:	Tankentlüftungssystem Grobleck" VAL_BLK 0x814A8C KwbUw 65535.00 dez 0.00 65535.00 NUMBER 4 FUNCTION_LIST DFPM_DLDP IF_DATA DIM_X DIRECT 0x814A8C /end CHARACTERISTIC
/begin CHARACTERISTIC CDKTEVE "Codewort Kunde:	Tankentlüftungsventil Endstufe" VAL_BLK 0x814A94 KwbUw 65535.00 dez 0.00 65535.00 NUMBER 4 FUNCTION_LIST DFPM_DEKON IF_DATA DIM_X DIRECT 0x814A94 /end CHARACTERISTIC
/begin CHARACTERISTIC CDKTEVE2 "Codewort Kunde: Tankentlüftungsventil Endstufe Bank 2" VAL_BLK 0x814A9C KwbUw 65535.00 dez 0.00 65535.00 NUMBER 4 FUNCTION_LIST DFPM_DUMMY_D IF_DATA DIM_X DIRECT 0x814A9C /end CHARACTERISTIC
/begin CHARACTERISTIC CDKTHM "Codewort Kunde: Thermostat-Diagnose THM" VAL_BLK 0x814AA4 KwbUw 65535.00 dez 0.00 65535.00 NUMBER 4 FUNCTION_LIST DFPM_DTHM IF_DATA DIM_X DIRECT 0x814AA4 /end CHARACTERISTIC
/begin CHARACTERISTIC CDKTKA "Codewort Kunde: Temperatur am Kühlerausgang" VAL_BLK 0x814AAC KwbUw 65535.00 dez 0.00 65535.00 NUMBER 4 FUNCTION_LIST DFPM_GGTKA IF_DATA DIM_X DIRECT 0x814AAC /end CHARACTERISTIC
/begin CHARACTERISTIC CDKTM "Codewort Kunde: TMOT" VAL_BLK 0x814AB4 KwbUw 65535.00 dez 0.00 65535.00 NUMBER 4 FUNCTION_LIST DFPM_GGTFM IF_DATA DIM_X DIRECT 0x814AB4 /end CHARACTERISTIC
/begin CHARACTERISTIC CDKTMKI "Codewort Kunde: Motortemperatur aus Kombiinstrument TMKI" VAL_BLK 0x814ABC KwbUw 65535.00 dez 0.00 65535.00 NUMBER 4 FUNCTION_LIST DFPM_GGGTS IF_DATA DIM_X DIRECT 0x814ABC /end CHARACTERISTIC
/begin CHARACTERISTIC CDKTOL "Codewort Kunde: Öltemperatur" VAL_BLK 0x814AC4 KwbUw 65535.00 dez 0.00 65535.00 NUMBER 4 FUNCTION_LIST DFPM_BGTOL IF_DATA DIM_X DIRECT 0x814AC4 /end CHARACTERISTIC
/begin CHARACTERISTIC CDKTUM "Codewort Kunde: Umgebungstemperatur" VAL_BLK 0x814ACC KwbUw 65535.00 dez 0.00 65535.00 NUMBER 4 FUNCTION_LIST DFPM_BGTUMG IF_DATA DIM_X DIRECT 0x814ACC /end CHARACTERISTIC
/begin CHARACTERISTIC CDKUB "Codewort Kunde:	UB" VAL_BLK 0x814AD4 KwbUw 65535.00 dez 0.00 65535.00 NUMBER 4 FUNCTION_LIST DFPM_GGUB IF_DATA DIM_X DIRECT 0x814AD4 /end CHARACTERISTIC
/begin CHARACTERISTIC CDKUBR "" VAL_BLK 0x814ADC KwbUw 65535.00 dez 0.00 65535.00 NUMBER 4 FUNCTION_LIST DFPM_GGUBR IF_DATA DIM_X DIRECT 0x814ADC /end CHARACTERISTIC
/begin CHARACTERISTIC CDKUFMV "Codewort Kunde: Funktionsüberwachung: Momentenvergleich" VAL_BLK 0x814AE4 KwbUw 65535.00 dez 0.00 65535.00 NUMBER 4 FUNCTION_LIST DFPM_DUF IF_DATA DIM_X DIRECT 0x814AE4 /end CHARACTERISTIC
/begin CHARACTERISTIC CDKUFSKA "Codewort Kunde: Funktionsüberwachung: Sicherheits-Kraftstoff-Abschaltung" VAL_BLK 0x814AEC KwbUw 65535.00 dez 0.00 65535.00 NUMBER 4 FUNCTION_LIST DFPM_DUF IF_DATA DIM_X DIRECT 0x814AEC /end CHARACTERISTIC
/begin CHARACTERISTIC CDKURRAM "Codewort Kunde: Rechnerüberwachung: RAM" VAL_BLK 0x814AF4 KwbUw 65535.00 dez 0.00 65535.00 NUMBER 4 FUNCTION_LIST DFPM_DUR IF_DATA DIM_X DIRECT 0x814AF4 /end CHARACTERISTIC
/begin CHARACTERISTIC CDKURROM "Codewort Kunde: Rechnerüberwachung: ROM" VAL_BLK 0x814AFC KwbUw 65535.00 dez 0.00 65535.00 NUMBER 4 FUNCTION_LIST DFPM_DUR IF_DATA DIM_X DIRECT 0x814AFC /end CHARACTERISTIC
/begin CHARACTERISTIC CDKURRST "Codewort Kunde: Rechnerüberwachung: Reset" VAL_BLK 0x814B04 KwbUw 65535.00 dez 0.00 65535.00 NUMBER 4 FUNCTION_LIST DFPM_DUR IF_DATA DIM_X DIRECT 0x814B04 /end CHARACTERISTIC
/begin CHARACTERISTIC CDKUVSE "Codeword Kunde: Endstufe Umluftventil turbo" VAL_BLK 0x814B0C KwbUw 65535.00 dez 0.00 65535.00 NUMBER 4 FUNCTION_LIST DFPM_DEKON IF_DATA DIM_X DIRECT 0x814B0C /end CHARACTERISTIC
/begin CHARACTERISTIC CDKVFZ "Codewort Kunde:	Fahrzeug-Geschwindigkeit" VAL_BLK 0x814B14 KwbUw 65535.00 dez 0.00 65535.00 NUMBER 4 FUNCTION_LIST DFPM_DVFZ IF_DATA DIM_X DIRECT 0x814B14 /end CHARACTERISTIC
/begin CHARACTERISTIC CDKVS "Codeword DKVS aktiv/inaktiv, CD..=0 -> keine Diagnose" VALUE 0x8181A4 KwUb 255.0 dez 0.00 255.0 FUNCTION_LIST PROKON IF_DATA DIM_X DIRECT 0x8181A4 /end CHARACTERISTIC
/begin CHARACTERISTIC CDKWFS "Codewort Kunde: Wegfahrsperre" VAL_BLK 0x814B1C KwbUw 65535.00 dez 0.00 65535.00 NUMBER 4 FUNCTION_LIST DFPM_IMS IF_DATA DIM_X DIRECT 0x814B1C /end CHARACTERISTIC
/begin CHARACTERISTIC CDKWFSRC "Codewort Kunde: Wegfahrsperre RC-Glied" VAL_BLK 0x814B24 KwbUw 65535.00 dez 0.00 65535.00 NUMBER 4 FUNCTION_LIST DFPM_IMS IF_DATA DIM_X DIRECT 0x814B24 /end CHARACTERISTIC
/begin CHARACTERISTIC CDKZET1 "" VAL_BLK 0x814B2C KwbUw 65535.00 dez 0.00 65535.00 NUMBER 4 FUNCTION_LIST DFPM_DEKON IF_DATA DIM_X DIRECT 0x814B2C /end CHARACTERISTIC
/begin CHARACTERISTIC CDKZET2 "" VAL_BLK 0x814B34 KwbUw 65535.00 dez 0.00 65535.00 NUMBER 4 FUNCTION_LIST DFPM_DEKON IF_DATA DIM_X DIRECT 0x814B34 /end CHARACTERISTIC
/begin CHARACTERISTIC CDKZET3 "" VAL_BLK 0x814B3C KwbUw 65535.00 dez 0.00 65535.00 NUMBER 4 FUNCTION_LIST DFPM_DEKON IF_DATA DIM_X DIRECT 0x814B3C /end CHARACTERISTIC
/begin CHARACTERISTIC CDKZET4 "" VAL_BLK 0x814B44 KwbUw 65535.00 dez 0.00 65535.00 NUMBER 4 FUNCTION_LIST DFPM_DEKON IF_DATA DIM_X DIRECT 0x814B44 /end CHARACTERISTIC
/begin CHARACTERISTIC CDKZZZ "Dummy: Tabellenendeng" VAL_BLK 0x814B4C KwbUw 65535.00 dez 0.00 65535.00 NUMBER 4 FUNCTION_LIST DFPM_DFPM IF_DATA DIM_X DIRECT 0x814B4C /end CHARACTERISTIC
/begin CHARACTERISTIC CDLASH "Codewort Lambdasondenalterungsdiagnose (SHK) im OBDII-Mode (invers: Europa-Mode)" VALUE 0x8181A5 KwUb 255.0 dez 0.00 255.0 FUNCTION_LIST PROKON IF_DATA DIM_X DIRECT 0x8181A5 /end CHARACTERISTIC
/begin CHARACTERISTIC CDLATP "Codewort Lambdasondenalterungsdiagnose (TP) im OBDII-Mode (invers: Europa-Mode)" VALUE 0x8181A6 KwUb 255.0 dez 0.00 255.0 FUNCTION_LIST PROKON IF_DATA DIM_X DIRECT 0x8181A6 /end CHARACTERISTIC
/begin CHARACTERISTIC CDLATV "Codewort Lambdasondenalterungsdiagnose (tv) im OBDII-Mode (invers: Europa-Mode)" VALUE 0x8181A7 KwUb 255.0 dez 0.00 255.0 FUNCTION_LIST PROKON IF_DATA DIM_X DIRECT 0x8181A7 /end CHARACTERISTIC
/begin CHARACTERISTIC CDLDP "Codewort LDP-Diagnose im OBDII-Modus (invers: Europa-Modus), CD..=0 -> keine Dia" VALUE 0x8181A8 KwUb 255.0 dez 0.00 255.0 FUNCTION_LIST PROKON IF_DATA DIM_X DIRECT 0x8181A8 /end CHARACTERISTIC
/begin CHARACTERISTIC CDLLR "Codewort DLLR abschalten (EURO-Codierung), CD..=0 -> keine Diagnose" VALUE 0x8181A9 KwUb 255.0 dez 0.00 255.0 FUNCTION_LIST PROKON IF_DATA DIM_X DIRECT 0x8181A9 /end CHARACTERISTIC
/begin CHARACTERISTIC CDLSA "Codewort Lambdasondenalterungsdiagnose, Konfig.-byte, für Applikationszwecke" VALUE 0x8181AA KwUb 255.0 dez 0.00 255.0 FUNCTION_LIST PROKON IF_DATA DIM_X DIRECT 0x8181AA /end CHARACTERISTIC
/begin CHARACTERISTIC CDLSH "Codewort Sondendiagnose hinter Kat im OBDII-Mode (invers: Europa-Mode)" VALUE 0x8181AB KwUb 255.0 dez 0.00 255.0 FUNCTION_LIST PROKON IF_DATA DIM_X DIRECT 0x8181AB /end CHARACTERISTIC
/begin CHARACTERISTIC CDLSV "Codewort Sondendiagnose vor KAT im OBDII-Mode" VALUE 0x8181AC KwUb 255.0 dez 0.00 255.0 FUNCTION_LIST PROKON IF_DATA DIM_X DIRECT 0x8181AC /end CHARACTERISTIC
/begin CHARACTERISTIC CDLSVV "Codewort Diagnose vertauschte Sonden vor Kat im OBDII-Mode (invers: Europa-Mode)" VALUE 0x8181AD KwUb 255.0 dez 0.00 255.0 FUNCTION_LIST PROKON IF_DATA DIM_X DIRECT 0x8181AD /end CHARACTERISTIC
/begin CHARACTERISTIC CDMD "Codewort DMD abschalten (EURO-Codierung), CD..=0 -> keine Diagnose" VALUE 0x8181AE KwUb 255.0 dez 0.00 255.0 FUNCTION_LIST PROKON IF_DATA DIM_X DIRECT 0x8181AE /end CHARACTERISTIC
/begin CHARACTERISTIC CDNWS "Codewort DNWS abschalten (EURO-Codierung), CD..=0 -> keine Diagnose" VALUE 0x8181AF KwUb 255.0 dez 0.00 255.0 FUNCTION_LIST PROKON IF_DATA DIM_X DIRECT 0x8181AF /end CHARACTERISTIC
/begin CHARACTERISTIC CDPCV "Code wort PCV -Ventil vorhanden" VALUE 0x8196ED KwUb 255.0 dez 0.00 255.0 FUNCTION_LIST BBBO IF_DATA DIM_X DIRECT 0x8196ED /end CHARACTERISTIC
/begin CHARACTERISTIC CDSLS "Euro-Byte für Diagnose Sekundärluft-System" VALUE 0x8181B0 KwUb 255.0 dez 0.00 255.0 FUNCTION_LIST PROKON IF_DATA DIM_X DIRECT 0x8181B0 /end CHARACTERISTIC
/begin CHARACTERISTIC CDTANKL "Codewort DTANKL abschalten (EURO-Codierung), CD..=0 -> keine Diagnose" VALUE 0x8181B1 KwUb 255.0 dez 0.00 255.0 FUNCTION_LIST PROKON IF_DATA DIM_X DIRECT 0x8181B1 /end CHARACTERISTIC
/begin CHARACTERISTIC CDTBKVP "" VALUE 0x814B5C KwUw 65535.00 dez 0.00 65535.00 FUNCTION_LIST DFPM_DBKVP IF_DATA DIM_X DIRECT 0x814B5C /end CHARACTERISTIC
/begin CHARACTERISTIC CDTBKVPE "" VALUE 0x814B5E KwUw 65535.00 dez 0.00 65535.00 FUNCTION_LIST DFPM_DEKON IF_DATA DIM_X DIRECT 0x814B5E /end CHARACTERISTIC
/begin CHARACTERISTIC CDTBM "Codewort Tester: Bezugsmarkengeber" VALUE 0x814B60 KwUw 65535.00 dez 0.00 65535.00 FUNCTION_LIST DFPM_DDG IF_DATA DIM_X DIRECT 0x814B60 /end CHARACTERISTIC
/begin CHARACTERISTIC CDTBREMS "Fehlerpfadcode: BREMS (Bremsschalter)" VALUE 0x814B62 KwUw 65535.00 dez 0.00 65535.00 FUNCTION_LIST DFPM_GGEGAS IF_DATA DIM_X DIRECT 0x814B62 /end CHARACTERISTIC
/begin CHARACTERISTIC CDTBWF "Codewort Tester: PWG Bewegung" VALUE 0x814B64 KwUw 65535.00 dez 0.00 65535.00 FUNCTION_LIST DFPM_GGPED IF_DATA DIM_X DIRECT 0x814B64 /end CHARACTERISTIC
/begin CHARACTERISTIC CDTCAIR "Codewort Tester: Airbag-Botschaft" VALUE 0x814B66 KwUw 65535.00 dez 0.00 65535.00 FUNCTION_LIST DFPM_CAIR IF_DATA DIM_X DIRECT 0x814B66 /end CHARACTERISTIC
/begin CHARACTERISTIC CDTCAIRP "Codewort Tester: unpl. Airbag-Botschaft" VALUE 0x814B68 KwUw 65535.00 dez 0.00 65535.00 FUNCTION_LIST DFPM_GGCS IF_DATA DIM_X DIRECT 0x814B68 /end CHARACTERISTIC
/begin CHARACTERISTIC CDTCAS "Codewort Tester: CAN-Schnittstelle, Timeout ASC" VALUE 0x814B6A KwUw 65535.00 dez 0.00 65535.00 FUNCTION_LIST DFPM_CAS IF_DATA DIM_X DIRECT 0x814B6A /end CHARACTERISTIC
/begin CHARACTERISTIC CDTCAT "" VALUE 0x814B6C KwUw 65535.00 dez 0.00 65535.00 FUNCTION_LIST DFPM_CAT IF_DATA DIM_X DIRECT 0x814B6C /end CHARACTERISTIC
/begin CHARACTERISTIC CDTCGE "Codewort Tester: CAN-Schnittstelle, Timeout EGS" VALUE 0x814B6E KwUw 65535.00 dez 0.00 65535.00 FUNCTION_LIST DFPM_CGE IF_DATA DIM_X DIRECT 0x814B6E /end CHARACTERISTIC
/begin CHARACTERISTIC CDTCGRA "Codewort Tester: GRA-Botschaft (Empfang)" VALUE 0x814B70 KwUw 65535.00 dez 0.00 65535.00 FUNCTION_LIST DFPM_CGRA IF_DATA DIM_X DIRECT 0x814B70 /end CHARACTERISTIC
/begin CHARACTERISTIC CDTCIF "Codewort Tester: CAN-Schnittstelle, interner Fehler" VALUE 0x814B72 KwUw 65535.00 dez 0.00 65535.00 FUNCTION_LIST DFPM_CIF IF_DATA DIM_X DIRECT 0x814B72 /end CHARACTERISTIC
/begin CHARACTERISTIC CDTCINS "Codewort Tester: CAN-Timeout, Instrumente" VALUE 0x814B74 KwUw 65535.00 dez 0.00 65535.00 FUNCTION_LIST DFPM_CINS IF_DATA DIM_X DIRECT 0x814B74 /end CHARACTERISTIC
/begin CHARACTERISTIC CDTCKLA "Codewort Tester: CAN-Schnittstelle, Timeout Klima" VALUE 0x814B76 KwUw 65535.00 dez 0.00 65535.00 FUNCTION_LIST DFPM_CKLA IF_DATA DIM_X DIRECT 0x814B76 /end CHARACTERISTIC
/begin CHARACTERISTIC CDTCLWS "Codewort Tester: Lenkwinkel-Botschaft" VALUE 0x814B78 KwUw 65535.00 dez 0.00 65535.00 FUNCTION_LIST DFPM_CLWS IF_DATA DIM_X DIRECT 0x814B78 /end CHARACTERISTIC
/begin CHARACTERISTIC CDTDPL "Codewort Tester: Dauerplus" VALUE 0x814B82 KwUw 65535.00 dez 0.00 65535.00 FUNCTION_LIST DFPM_DPL IF_DATA DIM_X DIRECT 0x814B82 /end CHARACTERISTIC
/begin CHARACTERISTIC CDTDSBKV "Codewort Tester: BKV" VALUE 0x814B84 KwUw 65535.00 dez 0.00 65535.00 FUNCTION_LIST DFPM_DSBKV IF_DATA DIM_X DIRECT 0x814B84 /end CHARACTERISTIC
/begin CHARACTERISTIC CDTDSL "Codewort Tester: Drucksensor Ladedruck" VALUE 0x814B86 KwUw 65535.00 dez 0.00 65535.00 FUNCTION_LIST DFPM_GGDSAS IF_DATA DIM_X DIRECT 0x814B86 /end CHARACTERISTIC
/begin CHARACTERISTIC CDTDSU "Codewort Tester: Drucksensor Umgebung" VALUE 0x814B88 KwUw 65535.00 dez 0.00 65535.00 FUNCTION_LIST DFPM_GGDSAS IF_DATA DIM_X DIRECT 0x814B88 /end CHARACTERISTIC
/begin CHARACTERISTIC CDTDSVLU "Codewort Tester: Drucksensorsignalvergleich (DS-L DS-U)" VALUE 0x814B8A KwUw 65535.00 dez 0.00 65535.00 FUNCTION_LIST DFPM_GGDSAS IF_DATA DIM_X DIRECT 0x814B8A /end CHARACTERISTIC
/begin CHARACTERISTIC CDTDVEE "Codewort Tester: DV-E Endstufe" VALUE 0x814B8C KwUw 65535.00 dez 0.00 65535.00 FUNCTION_LIST DFPM_DDVE IF_DATA DIM_X DIRECT 0x814B8C /end CHARACTERISTIC
/begin CHARACTERISTIC CDTDVEF "Codewort Tester: DV-E Fehler bei Federprüfung" VALUE 0x814B8E KwUw 65535.00 dez 0.00 65535.00 FUNCTION_LIST DFPM_DDVE IF_DATA DIM_X DIRECT 0x814B8E /end CHARACTERISTIC
/begin CHARACTERISTIC CDTDVEFO "" VALUE 0x814B90 KwUw 65535.00 dez 0.00 65535.00 FUNCTION_LIST DFPM_DDVE IF_DATA DIM_X DIRECT 0x814B90 /end CHARACTERISTIC
/begin CHARACTERISTIC CDTDVEL "Codewort Tester: DV-E Lageabweichung" VALUE 0x814B92 KwUw 65535.00 dez 0.00 65535.00 FUNCTION_LIST DFPM_DDVE IF_DATA DIM_X DIRECT 0x814B92 /end CHARACTERISTIC
/begin CHARACTERISTIC CDTDVEN "Codewort Tester: DV-E Fehler bei Prüfung Notlufposition" VALUE 0x814B94 KwUw 65535.00 dez 0.00 65535.00 FUNCTION_LIST DFPM_DDVE IF_DATA DIM_X DIRECT 0x814B94 /end CHARACTERISTIC
/begin CHARACTERISTIC CDTDVER "Codewort Tester: DV-E Regelbereich" VALUE 0x814B96 KwUw 65535.00 dez 0.00 65535.00 FUNCTION_LIST DFPM_DDVE IF_DATA DIM_X DIRECT 0x814B96 /end CHARACTERISTIC
/begin CHARACTERISTIC CDTDVET "" VALUE 0x814B98 KwUw 65535.00 dez 0.00 65535.00 FUNCTION_LIST DFPM_DDVE IF_DATA DIM_X DIRECT 0x814B98 /end CHARACTERISTIC
/begin CHARACTERISTIC CDTDVEU "Codewort Tester: DV-E Fehler beim UMA-Lernen" VALUE 0x814B9A KwUw 65535.00 dez 0.00 65535.00 FUNCTION_LIST DFPM_DDVE IF_DATA DIM_X DIRECT 0x814B9A /end CHARACTERISTIC
/begin CHARACTERISTIC CDTDVEUB "" VALUE 0x814B9C KwUw 65535.00 dez 0.00 65535.00 FUNCTION_LIST DFPM_DDVE IF_DATA DIM_X DIRECT 0x814B9C /end CHARACTERISTIC
/begin CHARACTERISTIC CDTDVEUW "" VALUE 0x814B9E KwUw 65535.00 dez 0.00 65535.00 FUNCTION_LIST DFPM_DDVE IF_DATA DIM_X DIRECT 0x814B9E /end CHARACTERISTIC
/begin CHARACTERISTIC CDTDVEV "Codewort Tester: DV-E Fehler bei Verstärkerabgleich" VALUE 0x814BA0 KwUw 65535.00 dez 0.00 65535.00 FUNCTION_LIST DFPM_DDVE IF_DATA DIM_X DIRECT 0x814BA0 /end CHARACTERISTIC
/begin CHARACTERISTIC CDTEGFE "Codeowort Tester: Eingangsgröße Füllungserfassung" VALUE 0x814BA2 KwUw 65535.00 dez 0.00 65535.00 FUNCTION_LIST DFPM_DEGFE IF_DATA DIM_X DIRECT 0x814BA2 /end CHARACTERISTIC
/begin CHARACTERISTIC CDTENWS "Codewort Tester: Nockenwellensteuerung Einlass Nockenwelle" VALUE 0x814BA4 KwUw 65535.00 dez 0.00 65535.00 FUNCTION_LIST DFPM_DENWS IF_DATA DIM_X DIRECT 0x814BA4 /end CHARACTERISTIC
/begin CHARACTERISTIC CDTENWSE "Codewort Tester: Einlaßnockenwelle- Endstufe" VALUE 0x814BA6 KwUw 65535.00 dez 0.00 65535.00 FUNCTION_LIST DFPM_DEKON IF_DATA DIM_X DIRECT 0x814BA6 /end CHARACTERISTIC
/begin CHARACTERISTIC CDTES "Codewort Tankentlüftungsdiagnose abschalten (EURO-Codierung), CD..=0 ->keine Dia" VALUE 0x8181B2 KwUb 255.0 dez 0.00 255.0 FUNCTION_LIST PROKON IF_DATA DIM_X DIRECT 0x8181B2 /end CHARACTERISTIC
/begin CHARACTERISTIC CDTEV1 "Codewort Tester: EV von Zyl. 1" VALUE 0x814BAA KwUw 65535.00 dez 0.00 65535.00 FUNCTION_LIST DFPM_DEKON IF_DATA DIM_X DIRECT 0x814BAA /end CHARACTERISTIC
/begin CHARACTERISTIC CDTEV2 "Codewort Tester: EV von Zyl. 2" VALUE 0x814BAC KwUw 65535.00 dez 0.00 65535.00 FUNCTION_LIST DFPM_DEKON IF_DATA DIM_X DIRECT 0x814BAC /end CHARACTERISTIC
/begin CHARACTERISTIC CDTEV3 "Codewort Tester: EV von Zyl. 3" VALUE 0x814BAE KwUw 65535.00 dez 0.00 65535.00 FUNCTION_LIST DFPM_DEKON IF_DATA DIM_X DIRECT 0x814BAE /end CHARACTERISTIC
/begin CHARACTERISTIC CDTEV4 "Codewort Tester: EV von Zyl. 4" VALUE 0x814BB0 KwUw 65535.00 dez 0.00 65535.00 FUNCTION_LIST DFPM_DEKON IF_DATA DIM_X DIRECT 0x814BB0 /end CHARACTERISTIC
/begin CHARACTERISTIC CDTFP1P "Codewort Tester: Poti 1, Fahrpedal" VALUE 0x814BB2 KwUw 65535.00 dez 0.00 65535.00 FUNCTION_LIST DFPM_GGPED IF_DATA DIM_X DIRECT 0x814BB2 /end CHARACTERISTIC
/begin CHARACTERISTIC CDTFP2P "Codewort Tester: Poti 2, Fahrpedal" VALUE 0x814BB4 KwUw 65535.00 dez 0.00 65535.00 FUNCTION_LIST DFPM_GGPED IF_DATA DIM_X DIRECT 0x814BB4 /end CHARACTERISTIC
/begin CHARACTERISTIC CDTFPP "Codewort Tester: Poti Fahrpedal" VALUE 0x814BB6 KwUw 65535.00 dez 0.00 65535.00 FUNCTION_LIST DFPM_GGPED IF_DATA DIM_X DIRECT 0x814BB6 /end CHARACTERISTIC
/begin CHARACTERISTIC CDTFRAO "Codewort Tester: LR-Adaption multiplikativ obere Schwelle" VALUE 0x814BB8 KwUw 65535.00 dez 0.00 65535.00 FUNCTION_LIST DFPM_DKVS IF_DATA DIM_X DIRECT 0x814BB8 /end CHARACTERISTIC
/begin CHARACTERISTIC CDTFRAU "Codewort Tester: LR-Adaption multiplikativ untere Schwelle" VALUE 0x814BBA KwUw 65535.00 dez 0.00 65535.00 FUNCTION_LIST DFPM_DKVS IF_DATA DIM_X DIRECT 0x814BBA /end CHARACTERISTIC
/begin CHARACTERISTIC CDTFRST "Codewort Tester: LR-Abweichung" VALUE 0x814BBC KwUw 65535.00 dez 0.00 65535.00 FUNCTION_LIST DFPM_DKVS IF_DATA DIM_X DIRECT 0x814BBC /end CHARACTERISTIC
/begin CHARACTERISTIC CDTGECOD "Codewort Tester: Getriebecodierung CAN" VALUE 0x814BBE KwUw 65535.00 dez 0.00 65535.00 FUNCTION_LIST DFPM_GECOD IF_DATA DIM_X DIRECT 0x814BBE /end CHARACTERISTIC
/begin CHARACTERISTIC CDTGRBH "Codewort Tester: GRA Bedienhebel" VALUE 0x814BC0 KwUw 65535.00 dez 0.00 65535.00 FUNCTION_LIST DFPM_GGFGRH IF_DATA DIM_X DIRECT 0x814BC0 /end CHARACTERISTIC
/begin CHARACTERISTIC CDTHLA "Codeword Tester: Heizleistungsanforderung" VALUE 0x814BC2 KwUw 65535.00 dez 0.00 65535.00 FUNCTION_LIST DFPM_GGHLA IF_DATA DIM_X DIRECT 0x814BC2 /end CHARACTERISTIC
/begin CHARACTERISTIC CDTHRE "" VALUE 0x814BC4 KwUw 65535.00 dez 0.00 65535.00 FUNCTION_LIST DFPM_HRE IF_DATA DIM_X DIRECT 0x814BC4 /end CHARACTERISTIC
/begin CHARACTERISTIC CDTHSH "Codewort Tester: Lambdasonden-Heizung hinter Katalysator" VALUE 0x814BC6 KwUw 65535.00 dez 0.00 65535.00 FUNCTION_LIST DFPM_DHLSHK IF_DATA DIM_X DIRECT 0x814BC6 /end CHARACTERISTIC
/begin CHARACTERISTIC CDTHSH2 "Codewort Tester: Lambdasonden-Heizung hinter Kat., Bank 2" VALUE 0x814BC8 KwUw 65535.00 dez 0.00 65535.00 FUNCTION_LIST DFPM_DHLSHK IF_DATA DIM_X DIRECT 0x814BC8 /end CHARACTERISTIC
/begin CHARACTERISTIC CDTHSHE "Codewort Tester: Endstufe Lambdasonden-Heizung hinter Katalysator" VALUE 0x814BCA KwUw 65535.00 dez 0.00 65535.00 FUNCTION_LIST DFPM_DEKON IF_DATA DIM_X DIRECT 0x814BCA /end CHARACTERISTIC
/begin CHARACTERISTIC CDTHSV "Codewort Tester: Lambdasonden-Heizung vor Katalysator" VALUE 0x814BCC KwUw 65535.00 dez 0.00 65535.00 FUNCTION_LIST DFPM_DHLSU IF_DATA DIM_X DIRECT 0x814BCC /end CHARACTERISTIC
/begin CHARACTERISTIC CDTHSV2 "Codewort Tester: Lambdasonden-Heizung vor Kat., Bank 2" VALUE 0x814BCE KwUw 65535.00 dez 0.00 65535.00 FUNCTION_LIST DFPM_DHLSU IF_DATA DIM_X DIRECT 0x814BCE /end CHARACTERISTIC
/begin CHARACTERISTIC CDTHSVSA "Codewort Tester: Lambdasonden-Heizung vor Katalysator" VALUE 0x814BD0 KwUw 65535.00 dez 0.00 65535.00 FUNCTION_LIST DFPM_DHLSU IF_DATA DIM_X DIRECT 0x814BD0 /end CHARACTERISTIC
/begin CHARACTERISTIC CDTHSVSA2 "Codewort Tester: Lambdasonden-Heizung vor Kat., Bank 2" VALUE 0x814BD2 KwUw 65535.00 dez 0.00 65535.00 FUNCTION_LIST DFPM_DHLSU IF_DATA DIM_X DIRECT 0x814BD2 /end CHARACTERISTIC
/begin CHARACTERISTIC CDTKAT "Codewort Tester: Katalysator-Konvertierung" VALUE 0x814BD4 KwUw 65535.00 dez 0.00 65535.00 FUNCTION_LIST DFPM_DKATSP IF_DATA DIM_X DIRECT 0x814BD4 /end CHARACTERISTIC
/begin CHARACTERISTIC CDTKPE "Codewort Tester: EKP-Relais Endstufe" VALUE 0x814BD6 KwUw 65535.00 dez 0.00 65535.00 FUNCTION_LIST DFPM_DEKON IF_DATA DIM_X DIRECT 0x814BD6 /end CHARACTERISTIC
/begin CHARACTERISTIC CDTKRA01 "" VALUE 0x814BD8 KwUw 65535.00 dez 0.00 65535.00 FUNCTION_LIST DFPM_DKRA IF_DATA DIM_X DIRECT 0x814BD8 /end CHARACTERISTIC
/begin CHARACTERISTIC CDTKRA02 "" VALUE 0x814BDA KwUw 65535.00 dez 0.00 65535.00 FUNCTION_LIST DFPM_DKRA IF_DATA DIM_X DIRECT 0x814BDA /end CHARACTERISTIC
/begin CHARACTERISTIC CDTKRA03 "" VALUE 0x814BDC KwUw 65535.00 dez 0.00 65535.00 FUNCTION_LIST DFPM_DKRA IF_DATA DIM_X DIRECT 0x814BDC /end CHARACTERISTIC
/begin CHARACTERISTIC CDTKRA04 "" VALUE 0x814BDE KwUw 65535.00 dez 0.00 65535.00 FUNCTION_LIST DFPM_DKRA IF_DATA DIM_X DIRECT 0x814BDE /end CHARACTERISTIC
/begin CHARACTERISTIC CDTKRNT "Codewort Tester: Klopfregelung Nulltest" VALUE 0x814BE0 KwUw 65535.00 dez 0.00 65535.00 FUNCTION_LIST DFPM_DKRNT IF_DATA DIM_X DIRECT 0x814BE0 /end CHARACTERISTIC
/begin CHARACTERISTIC CDTKROF "Codewort Tester: Klopfregelung Offset" VALUE 0x814BE2 KwUw 65535.00 dez 0.00 65535.00 FUNCTION_LIST DFPM_DKRNT IF_DATA DIM_X DIRECT 0x814BE2 /end CHARACTERISTIC
/begin CHARACTERISTIC CDTKRTP "Codewort Tester: Klopfregelung Testimpuls" VALUE 0x814BE4 KwUw 65535.00 dez 0.00 65535.00 FUNCTION_LIST DFPM_DKRTP IF_DATA DIM_X DIRECT 0x814BE4 /end CHARACTERISTIC
/begin CHARACTERISTIC CDTKS1 "Codewort Tester: Klopfsensor 1" VALUE 0x814BE6 KwUw 65535.00 dez 0.00 65535.00 FUNCTION_LIST DFPM_DKRS IF_DATA DIM_X DIRECT 0x814BE6 /end CHARACTERISTIC
/begin CHARACTERISTIC CDTKS2 "Codewort Tester: Klopfsensor 2" VALUE 0x814BE8 KwUw 65535.00 dez 0.00 65535.00 FUNCTION_LIST DFPM_DKRS IF_DATA DIM_X DIRECT 0x814BE8 /end CHARACTERISTIC
/begin CHARACTERISTIC CDTKS3 "Codewort Tester: Klopfsensor 3" VALUE 0x814BEA KwUw 65535.00 dez 0.00 65535.00 FUNCTION_LIST DFPM_DKRS IF_DATA DIM_X DIRECT 0x814BEA /end CHARACTERISTIC
/begin CHARACTERISTIC CDTKS4 "Codewort Tester: Klopfsensor 4" VALUE 0x814BEC KwUw 65535.00 dez 0.00 65535.00 FUNCTION_LIST DFPM_DKRS IF_DATA DIM_X DIRECT 0x814BEC /end CHARACTERISTIC
/begin CHARACTERISTIC CDTKUPPL "Fehlerpfadcode: Pedalwertgeber Kupplung" VALUE 0x814BEE KwUw 65535.00 dez 0.00 65535.00 FUNCTION_LIST DFPM_DKUPPL IF_DATA DIM_X DIRECT 0x814BEE /end CHARACTERISTIC
/begin CHARACTERISTIC CDTLASH "Codewort Tester: Lambda-Sondenalterung hinter Kat" VALUE 0x814BF0 KwUw 65535.00 dez 0.00 65535.00 FUNCTION_LIST DFPM_DLSAHK IF_DATA DIM_X DIRECT 0x814BF0 /end CHARACTERISTIC
/begin CHARACTERISTIC CDTLDE "Codewort Tester: Ladedrucksteuerventil (Endstufe)" VALUE 0x814BF2 KwUw 65535.00 dez 0.00 65535.00 FUNCTION_LIST DFPM_DEKON IF_DATA DIM_X DIRECT 0x814BF2 /end CHARACTERISTIC
/begin CHARACTERISTIC CDTLDO "Codewort Tester: Ladedruck; oberer Wert überschritten" VALUE 0x814BF4 KwUw 65535.00 dez 0.00 65535.00 FUNCTION_LIST DFPM_DLDR IF_DATA DIM_X DIRECT 0x814BF4 /end CHARACTERISTIC
/begin CHARACTERISTIC CDTLDP "Codewort Tester: Tankentlüftung; Leckdiagnosepumpe" VALUE 0x814BF6 KwUw 65535.00 dez 0.00 65535.00 FUNCTION_LIST DFPM_DLDP IF_DATA DIM_X DIRECT 0x814BF6 /end CHARACTERISTIC
/begin CHARACTERISTIC CDTLDPE "Codewort Tester: Leckdiagnosepumpe Endstufe" VALUE 0x814BF8 KwUw 65535.00 dez 0.00 65535.00 FUNCTION_LIST DFPM_LDPE IF_DATA DIM_X DIRECT 0x814BF8 /end CHARACTERISTIC
/begin CHARACTERISTIC CDTLDRA "Codewort Tester: Ladedruckregelabweichung" VALUE 0x814BFA KwUw 65535.00 dez 0.00 65535.00 FUNCTION_LIST DFPM_DLDR IF_DATA DIM_X DIRECT 0x814BFA /end CHARACTERISTIC
/begin CHARACTERISTIC CDTN "Codewort Tester: Drehzahlsignalgeber" VALUE 0x814C1A KwUw 65535.00 dez 0.00 65535.00 FUNCTION_LIST DFPM_DDG IF_DATA DIM_X DIRECT 0x814C1A /end CHARACTERISTIC
/begin CHARACTERISTIC CDTNWKW "Codewort Tester: Zuordnung Nockenwelle zu Kurbelwelle" VALUE 0x814C1C KwUw 65535.00 dez 0.00 65535.00 FUNCTION_LIST DFPM_DNWKW IF_DATA DIM_X DIRECT 0x814C1C /end CHARACTERISTIC
/begin CHARACTERISTIC CDTNWSE "Codewort Tester: Nockenwellensteuerungsventil Endstufe" VALUE 0x814C1E KwUw 65535.00 dez 0.00 65535.00 FUNCTION_LIST DFPM_DEKON IF_DATA DIM_X DIRECT 0x814C1E /end CHARACTERISTIC
/begin CHARACTERISTIC CDTNX "Codewort Tester: NMAX - Überschreitung" VALUE 0x814C20 KwUw 65535.00 dez 0.00 65535.00 FUNCTION_LIST DFPM_DNMAX IF_DATA DIM_X DIRECT 0x814C20 /end CHARACTERISTIC
/begin CHARACTERISTIC CDTPWM "" VALUE 0x814C24 KwUw 65535.00 dez 0.00 65535.00 FUNCTION_LIST DFPM_DSWEA IF_DATA DIM_X DIRECT 0x814C24 /end CHARACTERISTIC
/begin CHARACTERISTIC CDTRKAT "Codewort Tester: LR-Adaption additiv pro Zeit" VALUE 0x814C26 KwUw 65535.00 dez 0.00 65535.00 FUNCTION_LIST DFPM_DKVS IF_DATA DIM_X DIRECT 0x814C26 /end CHARACTERISTIC
/begin CHARACTERISTIC CDTRKAZ "Codewort Tester: LR-Adaption additiv pro Zündung" VALUE 0x814C28 KwUw 65535.00 dez 0.00 65535.00 FUNCTION_LIST DFPM_DKVS IF_DATA DIM_X DIRECT 0x814C28 /end CHARACTERISTIC
/begin CHARACTERISTIC CDTSCR "Codewort Tester: Überwachung Crashsignal" VALUE 0x814C2A KwUw 65535.00 dez 0.00 65535.00 FUNCTION_LIST DFPM_GGCS IF_DATA DIM_X DIRECT 0x814C2A /end CHARACTERISTIC
/begin CHARACTERISTIC CDTSGEEP "Codewort Tester: Steuergerät defekt (EEPROM)" VALUE 0x814C2C KwUw 65535.00 dez 0.00 65535.00 FUNCTION_LIST DFPM_DSGEEP IF_DATA DIM_X DIRECT 0x814C2C /end CHARACTERISTIC
/begin CHARACTERISTIC CDTSGEEW "Codewort Tester: Steuergerät defekt (EEPROM WFS-Bereich)" VALUE 0x814C2E KwUw 65535.00 dez 0.00 65535.00 FUNCTION_LIST DFPM_IMS IF_DATA DIM_X DIRECT 0x814C2E /end CHARACTERISTIC
/begin CHARACTERISTIC CDTSLPE "Codewort Tester: Sekundärluftpumpe (Endstufe)" VALUE 0x814C30 KwUw 65535.00 dez 0.00 65535.00 FUNCTION_LIST DFPM_DEKON IF_DATA DIM_X DIRECT 0x814C30 /end CHARACTERISTIC
/begin CHARACTERISTIC CDTSLS "Codewort Tester: Sekundärluft-System" VALUE 0x814C32 KwUw 65535.00 dez 0.00 65535.00 FUNCTION_LIST DFPM_DSLSLRS IF_DATA DIM_X DIRECT 0x814C32 /end CHARACTERISTIC
/begin CHARACTERISTIC CDTSLV "Codewort Tester: Sekundärluftventil" VALUE 0x814C34 KwUw 65535.00 dez 0.00 65535.00 FUNCTION_LIST DFPM_DSLSLRS IF_DATA DIM_X DIRECT 0x814C34 /end CHARACTERISTIC
/begin CHARACTERISTIC CDTSLVE "Codewort Tester: Sekundärluftventil (Endstufe)" VALUE 0x814C36 KwUw 65535.00 dez 0.00 65535.00 FUNCTION_LIST DFPM_DEKON IF_DATA DIM_X DIRECT 0x814C36 /end CHARACTERISTIC
/begin CHARACTERISTIC CDTSWE "Codewort Tester: Beschleunigungssensor Schlechtwegeerk." VALUE 0x814C38 KwUw 65535.00 dez 0.00 65535.00 FUNCTION_LIST DFPM_DSWEA IF_DATA DIM_X DIRECT 0x814C38 /end CHARACTERISTIC
/begin CHARACTERISTIC CDTTA "Codewort Tester: TANS" VALUE 0x814C3A KwUw 65535.00 dez 0.00 65535.00 FUNCTION_LIST DFPM_GGTFA IF_DATA DIM_X DIRECT 0x814C3A /end CHARACTERISTIC
/begin CHARACTERISTIC CDTTANKL "Codewort Tester: OBDII Fehler auf Grund eines leeren Tanks" VALUE 0x814C3C KwUw 65535.00 dez 0.00 65535.00 FUNCTION_LIST DFPM_DTANKL IF_DATA DIM_X DIRECT 0x814C3C /end CHARACTERISTIC
/begin CHARACTERISTIC CDTTES "Codewort Tester: Tankentlüftungssystem" VALUE 0x814C3E KwUw 65535.00 dez 0.00 65535.00 FUNCTION_LIST DFPM_DTEV IF_DATA DIM_X DIRECT 0x814C3E /end CHARACTERISTIC
/begin CHARACTERISTIC CDTTESF "Codewort Tester: Tankentlüftungssystem Feinleck" VALUE 0x814C40 KwUw 65535.00 dez 0.00 65535.00 FUNCTION_LIST DFPM_DLDP IF_DATA DIM_X DIRECT 0x814C40 /end CHARACTERISTIC
/begin CHARACTERISTIC CDTTESG "Codewort Tester: Tankentlüftungssystem Grobleck" VALUE 0x814C42 KwUw 65535.00 dez 0.00 65535.00 FUNCTION_LIST DFPM_DLDP IF_DATA DIM_X DIRECT 0x814C42 /end CHARACTERISTIC
/begin CHARACTERISTIC CDTTEVE "Codewort Tester: Tankentlüftungsventil Endstufe" VALUE 0x814C44 KwUw 65535.00 dez 0.00 65535.00 FUNCTION_LIST DFPM_DEKON IF_DATA DIM_X DIRECT 0x814C44 /end CHARACTERISTIC
/begin CHARACTERISTIC CDTTEVE2 "Codewort Tester: Tankentlüftungsventil Endstufe Bank 2" VALUE 0x814C46 KwUw 65535.00 dez 0.00 65535.00 FUNCTION_LIST DFPM_DUMMY_D IF_DATA DIM_X DIRECT 0x814C46 /end CHARACTERISTIC
/begin CHARACTERISTIC CDTTHM "Codewort Tester: Thermostat-Diagnose THM" VALUE 0x814C48 KwUw 65535.00 dez 0.00 65535.00 FUNCTION_LIST DFPM_DTHM IF_DATA DIM_X DIRECT 0x814C48 /end CHARACTERISTIC
/begin CHARACTERISTIC CDTTM "Codewort Tester: TMOT" VALUE 0x814C4C KwUw 65535.00 dez 0.00 65535.00 FUNCTION_LIST DFPM_GGTFM IF_DATA DIM_X DIRECT 0x814C4C /end CHARACTERISTIC
/begin CHARACTERISTIC CDTTMKI "Codewort Tester: Motortemperatur aus Kombiinstrument TMKI" VALUE 0x814C4E KwUw 65535.00 dez 0.00 65535.00 FUNCTION_LIST DFPM_GGGTS IF_DATA DIM_X DIRECT 0x814C4E /end CHARACTERISTIC
/begin CHARACTERISTIC CDTTOL "Codewort Tester: Öltemperatur" VALUE 0x814C50 KwUw 65535.00 dez 0.00 65535.00 FUNCTION_LIST DFPM_BGTOL IF_DATA DIM_X DIRECT 0x814C50 /end CHARACTERISTIC
/begin CHARACTERISTIC CDTTUM "Codewort Tester: Umgebungstemperatur TUM" VALUE 0x814C52 KwUw 65535.00 dez 0.00 65535.00 FUNCTION_LIST DFPM_BGTUMG IF_DATA DIM_X DIRECT 0x814C52 /end CHARACTERISTIC
/begin CHARACTERISTIC CDTUB "Codewort Tester: UB" VALUE 0x814C54 KwUw 65535.00 dez 0.00 65535.00 FUNCTION_LIST DFPM_GGUB IF_DATA DIM_X DIRECT 0x814C54 /end CHARACTERISTIC
/begin CHARACTERISTIC CDTUBR "Codewort Tester: UBR Bordnetzspannung über Hauptrelais" VALUE 0x814C56 KwUw 65535.00 dez 0.00 65535.00 FUNCTION_LIST DFPM_GGUBR IF_DATA DIM_X DIRECT 0x814C56 /end CHARACTERISTIC
/begin CHARACTERISTIC CDTUFMV "Codewort Tester: Funktionsüberwachung: Momentenvergleich" VALUE 0x814C58 KwUw 65535.00 dez 0.00 65535.00 FUNCTION_LIST DFPM_DUF IF_DATA DIM_X DIRECT 0x814C58 /end CHARACTERISTIC
/begin CHARACTERISTIC CDTUFSKA "Codewort Tester: Funktionsüberwachung: Sicherheits-Kraftstoff-Abschaltung" VALUE 0x814C5A KwUw 65535.00 dez 0.00 65535.00 FUNCTION_LIST DFPM_DUF IF_DATA DIM_X DIRECT 0x814C5A /end CHARACTERISTIC
/begin CHARACTERISTIC CDTURRAM "Codewort Tester: Rechnerüberwachung: RAM" VALUE 0x814C5C KwUw 65535.00 dez 0.00 65535.00 FUNCTION_LIST DFPM_DUR IF_DATA DIM_X DIRECT 0x814C5C /end CHARACTERISTIC
/begin CHARACTERISTIC CDTURROM "Codewort Tester: Rechnerüberwachung: ROM" VALUE 0x814C5E KwUw 65535.00 dez 0.00 65535.00 FUNCTION_LIST DFPM_DUR IF_DATA DIM_X DIRECT 0x814C5E /end CHARACTERISTIC
/begin CHARACTERISTIC CDTURRST "Codewort Tester: Rechnerüberwachung: Reset" VALUE 0x814C60 KwUw 65535.00 dez 0.00 65535.00 FUNCTION_LIST DFPM_DUR IF_DATA DIM_X DIRECT 0x814C60 /end CHARACTERISTIC
/begin CHARACTERISTIC CDTUVSE "Codewort Tester: Endstufe Umluftventil Turbo" VALUE 0x814C62 KwUw 65535.00 dez 0.00 65535.00 FUNCTION_LIST DFPM_DEKON IF_DATA DIM_X DIRECT 0x814C62 /end CHARACTERISTIC
/begin CHARACTERISTIC CDTVFZ "Codewort Tester: Fahrzeug-Geschwindigkeit" VALUE 0x814C64 KwUw 65535.00 dez 0.00 65535.00 FUNCTION_LIST DFPM_DVFZ IF_DATA DIM_X DIRECT 0x814C64 /end CHARACTERISTIC
/begin CHARACTERISTIC CDTWFS "Codewort Tester: Wegfahrsperre" VALUE 0x814C66 KwUw 65535.00 dez 0.00 65535.00 FUNCTION_LIST DFPM_IMS IF_DATA DIM_X DIRECT 0x814C66 /end CHARACTERISTIC
/begin CHARACTERISTIC CDTWFSRC "Codewort Tester: Wegfahrsperre RC-Glied" VALUE 0x814C68 KwUw 65535.00 dez 0.00 65535.00 FUNCTION_LIST DFPM_IMS IF_DATA DIM_X DIRECT 0x814C68 /end CHARACTERISTIC
/begin CHARACTERISTIC CDTZET1 "" VALUE 0x814C6A KwUw 65535.00 dez 0.00 65535.00 FUNCTION_LIST DFPM_DEKON IF_DATA DIM_X DIRECT 0x814C6A /end CHARACTERISTIC
/begin CHARACTERISTIC CDTZET2 "" VALUE 0x814C6C KwUw 65535.00 dez 0.00 65535.00 FUNCTION_LIST DFPM_DEKON IF_DATA DIM_X DIRECT 0x814C6C /end CHARACTERISTIC
/begin CHARACTERISTIC CDTZET3 "" VALUE 0x814C6E KwUw 65535.00 dez 0.00 65535.00 FUNCTION_LIST DFPM_DEKON IF_DATA DIM_X DIRECT 0x814C6E /end CHARACTERISTIC
/begin CHARACTERISTIC CDTZET4 "" VALUE 0x814C70 KwUw 65535.00 dez 0.00 65535.00 FUNCTION_LIST DFPM_DEKON IF_DATA DIM_X DIRECT 0x814C70 /end CHARACTERISTIC
/begin CHARACTERISTIC CDTZZZ "Dummy: Tabellenende" VALUE 0x814C72 KwUw 65535.00 dez 0.00 65535.00 FUNCTION_LIST DFPM_DFPM IF_DATA DIM_X DIRECT 0x814C72 /end CHARACTERISTIC
/begin CHARACTERISTIC CDWGANG_0_A "Gangerkennung für Kompressorabschalten bei Vollgas" VALUE 0x817C04 KwUb 255.0 dez 0.00 255.0 FUNCTION_LIST KOS IF_DATA DIM_X DIRECT 0x817C04 /end CHARACTERISTIC
/begin CHARACTERISTIC CDWGANG_1_A "Gangerkennung für Kompressorabschalten bei Vollgas" VALUE 0x817C05 KwUb 255.0 dez 0.00 255.0 FUNCTION_LIST KOS IF_DATA DIM_X DIRECT 0x817C05 /end CHARACTERISTIC
/begin CHARACTERISTIC CDWGANGB_0_A "Gangerkennung bei Beschleunigung" VALUE 0x817C06 KwUb 255.0 dez 0.00 255.0 FUNCTION_LIST KOS IF_DATA DIM_X DIRECT 0x817C06 /end CHARACTERISTIC
/begin CHARACTERISTIC CDWGANGB_1_A "Gangerkennung bei Beschleunigung" VALUE 0x817C07 KwUb 255.0 dez 0.00 255.0 FUNCTION_LIST KOS IF_DATA DIM_X DIRECT 0x817C07 /end CHARACTERISTIC
/begin CHARACTERISTIC CDWKOB_0_A "Codewort : Auswahl zur Gangerkennung für KO-Auschalten ( gangi oder nmot/vfzw)" VALUE 0x817C08 KwUb 255.0 dez 0.00 255.0 FUNCTION_LIST KOS IF_DATA DIM_X DIRECT 0x817C08 /end CHARACTERISTIC
/begin CHARACTERISTIC CDWKOB_1_A "Codewort : Auswahl zur Gangerkennung für KO-Auschalten ( gangi oder nmot/vfzw)" VALUE 0x817C09 KwUb 255.0 dez 0.00 255.0 FUNCTION_LIST KOS IF_DATA DIM_X DIRECT 0x817C09 /end CHARACTERISTIC
/begin CHARACTERISTIC CIDKATSP "Component ID für Kat-Diagnose" VALUE 0x8186D4 KwUb 127.0 dez 0.00 127.0 FUNCTION_LIST DKATSP IF_DATA DIM_X DIRECT 0x8186D4 /end CHARACTERISTIC
/begin CHARACTERISTIC CIDKATSPI "Component ID für Kat-Diagnose" VALUE 0x8186D5 KwUb 127.0 dez 0.00 127.0 FUNCTION_LIST DKATSP IF_DATA DIM_X DIRECT 0x8186D5 /end CHARACTERISTIC
/begin CHARACTERISTIC CIDKATSPT "Component ID für Kat-Diagnose bei Testerbetrieb" VALUE 0x8186D6 KwUb 127.0 dez 0.00 127.0 FUNCTION_LIST DKATSP IF_DATA DIM_X DIRECT 0x8186D6 /end CHARACTERISTIC
/begin CHARACTERISTIC CL30LINE "30. Linie der Klassentabelle" VAL_BLK 0x81C1A4 KwbUb 255.0 dez 0.00 255.0 NUMBER 14 FUNCTION_LIST DCLA IF_DATA DIM_X DIRECT 0x81C1A4 /end CHARACTERISTIC
/begin CHARACTERISTIC CL31LINE "31. Linie der Klassentabelle" VAL_BLK 0x81C182 KwbUb 255.0 dez 0.00 255.0 NUMBER 14 FUNCTION_LIST DCLA IF_DATA DIM_X DIRECT 0x81C182 /end CHARACTERISTIC
/begin CHARACTERISTIC CL32LINE "32. Linie der Klassentabelle" VAL_BLK 0x81C190 KwbUb 255.0 dez 0.00 255.0 NUMBER 14 FUNCTION_LIST DCLA IF_DATA DIM_X DIRECT 0x81C190 /end CHARACTERISTIC
/begin CHARACTERISTIC CL35LINE "35. Linie der Klassentabelle" VAL_BLK 0x81C1BA KwbUb 255.0 dez 0.00 255.0 NUMBER 14 FUNCTION_LIST DCLA IF_DATA DIM_X DIRECT 0x81C1BA /end CHARACTERISTIC
/begin CHARACTERISTIC CL36LINE "36. Linie der Klassentabelle" VAL_BLK 0x81C1C8 KwbUb 255.0 dez 0.00 255.0 NUMBER 14 FUNCTION_LIST DCLA IF_DATA DIM_X DIRECT 0x81C1C8 /end CHARACTERISTIC
/begin CHARACTERISTIC CL37LINE "37. Linie der Klassentabelle" VAL_BLK 0x81C1D6 KwbUb 255.0 dez 0.00 255.0 NUMBER 14 FUNCTION_LIST DCLA IF_DATA DIM_X DIRECT 0x81C1D6 /end CHARACTERISTIC
/begin CHARACTERISTIC CL38LINE "38. Linie der Klassentabelle" VAL_BLK 0x81C1E4 KwbUb 255.0 dez 0.00 255.0 NUMBER 14 FUNCTION_LIST DCLA IF_DATA DIM_X DIRECT 0x81C1E4 /end CHARACTERISTIC
/begin CHARACTERISTIC CL39LINE "39. Linie der Klassentabelle" VAL_BLK 0x81C1F2 KwbUb 255.0 dez 0.00 255.0 NUMBER 14 FUNCTION_LIST DCLA IF_DATA DIM_X DIRECT 0x81C1F2 /end CHARACTERISTIC
/begin CHARACTERISTIC CLAAAA "Dummy: Tabellenanfang" VALUE 0x810D62 KwUb 255.0 dez 0.00 255.0 FUNCTION_LIST DFPM_DFPM IF_DATA DIM_X DIRECT 0x810D62 /end CHARACTERISTIC
/begin CHARACTERISTIC CLABKVP "" VALUE 0x810D66 KwUb 255.0 dez 0.00 255.0 FUNCTION_LIST DFPM_DBKVP IF_DATA DIM_X DIRECT 0x810D66 /end CHARACTERISTIC
/begin CHARACTERISTIC CLABKVPE "" VALUE 0x810D67 KwUb 255.0 dez 0.00 255.0 FUNCTION_LIST DFPM_DEKON IF_DATA DIM_X DIRECT 0x810D67 /end CHARACTERISTIC
/begin CHARACTERISTIC CLABM "Fehlerklasse: Bezugsmarkengeber" VALUE 0x810D68 KwUb 255.0 dez 0.00 255.0 FUNCTION_LIST DFPM_DDG IF_DATA DIM_X DIRECT 0x810D68 /end CHARACTERISTIC
/begin CHARACTERISTIC CLABREMS "Fehlerklasse: BREMS (Bremsschalter)" VALUE 0x810D69 KwUb 255.0 dez 0.00 255.0 FUNCTION_LIST DFPM_GGEGAS IF_DATA DIM_X DIRECT 0x810D69 /end CHARACTERISTIC
/begin CHARACTERISTIC CLABWF "Fehlerklasse:  PWG Bewegung" VALUE 0x810D6A KwUb 255.0 dez 0.00 255.0 FUNCTION_LIST DFPM_GGPED IF_DATA DIM_X DIRECT 0x810D6A /end CHARACTERISTIC
/begin CHARACTERISTIC CLACAIR "Fehlerklasse: Airbag-Botschaft" VALUE 0x810D6B KwUb 255.0 dez 0.00 255.0 FUNCTION_LIST DFPM_CAIR IF_DATA DIM_X DIRECT 0x810D6B /end CHARACTERISTIC
/begin CHARACTERISTIC CLACAIRP "Fehlerklasse: unpl. Airbag-Botschaft" VALUE 0x810D6C KwUb 255.0 dez 0.00 255.0 FUNCTION_LIST DFPM_GGCS IF_DATA DIM_X DIRECT 0x810D6C /end CHARACTERISTIC
/begin CHARACTERISTIC CLACAS "Fehlerklasse: CAN-Timeout ASC-Botschaft" VALUE 0x810D6D KwUb 255.0 dez 0.00 255.0 FUNCTION_LIST DFPM_CAS IF_DATA DIM_X DIRECT 0x810D6D /end CHARACTERISTIC
/begin CHARACTERISTIC CLACAT "Fehlerklasse: CAN-Schnittstelle, Timeout ASR" VALUE 0x810D6E KwUb 255.0 dez 0.00 255.0 FUNCTION_LIST DFPM_CAT IF_DATA DIM_X DIRECT 0x810D6E /end CHARACTERISTIC
/begin CHARACTERISTIC CLACGE "Fehlerklasse: CAN-Timeout EGS-Botschaft" VALUE 0x810D6F KwUb 255.0 dez 0.00 255.0 FUNCTION_LIST DFPM_CGE IF_DATA DIM_X DIRECT 0x810D6F /end CHARACTERISTIC
/begin CHARACTERISTIC CLACGRA "Fehlerklasse: GRA-Botschaft (Empfang)" VALUE 0x810D70 KwUb 255.0 dez 0.00 255.0 FUNCTION_LIST DFPM_CGRA IF_DATA DIM_X DIRECT 0x810D70 /end CHARACTERISTIC
/begin CHARACTERISTIC CLACIF "Fehlerklasse: CAN-Schnittstelle, interner Fehler" VALUE 0x810D71 KwUb 255.0 dez 0.00 255.0 FUNCTION_LIST DFPM_CIF IF_DATA DIM_X DIRECT 0x810D71 /end CHARACTERISTIC
/begin CHARACTERISTIC CLACINS "Fehlerklasse: CAN-Timeout Botschaft Kombiinstrument" VALUE 0x810D72 KwUb 255.0 dez 0.00 255.0 FUNCTION_LIST DFPM_CINS IF_DATA DIM_X DIRECT 0x810D72 /end CHARACTERISTIC
/begin CHARACTERISTIC CLACKLA "" VALUE 0x810D73 KwUb 255.0 dez 0.00 255.0 FUNCTION_LIST DFPM_CKLA IF_DATA DIM_X DIRECT 0x810D73 /end CHARACTERISTIC
/begin AXIS_PTS SNM08DMUB "SST-Verteilung in DMD, 8 Drehzahl-SST" 0x81007C nmot SstAUbSstUb 10200. nmot_ub_q40 8 0.00 10200. FUNCTION_LIST SSTB DMDDLU DMDLU DMDLUA DMDMIL DMDSTP DEPOSIT ABSOLUT IF_DATA DIM_X DIRECT 0x81007C /end AXIS_PTS
/begin AXIS_PTS SNM16KRUB "Stützstellenverteilung Drehzahl, 16 Sst." 0x818250 nmot SstAUbSstUb 10200. nmot_ub_q40 16 0.00 10200. FUNCTION_LIST SSTB DKRS GGKS KRDY KRKE KRRA DEPOSIT ABSOLUT IF_DATA DIM_X DIRECT 0x818250 /end AXIS_PTS
/begin AXIS_PTS STS12ESUB "SST-Verteilung für Motorstarttemperatur" 0x810146 tmst SstAUbSstUb 191.3 temp_ub_q0p75_o48 12 -48.00 143.3 FUNCTION_LIST SSTB ESNSWL LANSWL DEPOSIT ABSOLUT IF_DATA DIM_X DIRECT 0x810146 /end AXIS_PTS
/begin FUNCTION ABKVP "1.80      Ansteuerung Bremskraftverstärker-Pumpe" /end FUNCTION
/begin FUNCTION ACIFI "9.90      Ausgabe für zylinderindividuelle Einspritzung" /end FUNCTION
/begin FUNCTION ADC "" /end FUNCTION
/begin FUNCTION ADVE "3.70      Ansteuerung der DV-E mit dem DLR" /end FUNCTION
/begin FUNCTION AEKP "8.20      Ausgabe EKP-Ansteuerung" /end FUNCTION
/begin FUNCTION AEVAB "6.60      Ausgabe Einspritzung Ev-Ausblendung" /end FUNCTION
/begin FUNCTION AEVABU "1.10      Ausgabe EV-Abschaltung durch Überwachungsfunktionen bei EGAS" /end FUNCTION
/begin FUNCTION AEVABZK "1.30      Ausgabe Ev-Abschaltung %MDRED + Komplettabschaltung durch Überwachungsfunktionen" /end FUNCTION
/begin FUNCTION ALE "6.30      Auslauferkennung" /end FUNCTION
/begin FUNCTION ALUEFT "1.10      Luefteransteuerung" /end FUNCTION
/begin FUNCTION ANWSE "1.30      Ansteuerung Nockenwellensteller geschaltet Einlass" /end FUNCTION
/begin FUNCTION ARMD "10.80     Momentenbasierte Antiruckelfunktion" /end FUNCTION
/begin FUNCTION ASC0F "" /end FUNCTION
/begin FUNCTION ATEV "4.40      Ansteuerung Tankentlüftungsventil (Periodendauer)" /end FUNCTION
/begin FUNCTION ATM "33.70     Abgastemperaturmodell" /end FUNCTION
/begin FUNCTION AZUE "5.60      Ausgabe Zündung" /end FUNCTION
/begin FUNCTION BBBO "3.30      Betriebsbereich Erkennung Benzin im Öl" /end FUNCTION
/begin FUNCTION BBDLS "1.10      Betriebsbereich digitale Leerlaufstabilisierung" /end FUNCTION
/begin FUNCTION BBDNWS "1.60      Betriebsbereitschaft Diagnose Nockenwelle" /end FUNCTION
/begin FUNCTION BBGANG "14.50     Betriebsbereich Gang" /end FUNCTION
/begin FUNCTION BBKD "1.20      Berechnung der Kick-Down-Information" /end FUNCTION
/begin FUNCTION BBKHZ "18.280    Betriebsbereich motorisches Katheizen" /end FUNCTION
/begin FUNCTION BBLDR "3.20      Betriebsbedingungen LDR" /end FUNCTION
/begin FUNCTION BBNWS "2.60      Betriebsbedingungen zur Freigabe der NWS" /end FUNCTION
/begin FUNCTION BBSAWE "18.200    Betriebsbereich Schubabschalten/Wiedereinsetzen" /end FUNCTION
/begin FUNCTION BBSTT "11.20     Betriebsbereich: Start" /end FUNCTION
/begin FUNCTION BBTEGA "3.130     Phasensteuerung für Tankentlüftung und Gemischadaption" /end FUNCTION
/begin FUNCTION BBZMS "1.40      Betriebsbereich ZMS-Schutz" /end FUNCTION
/begin FUNCTION BGARNW "2.20      Berechnete Größe Anforderung Nockenwellenadaption" /end FUNCTION
/begin FUNCTION BGBN "1.10      Berechnete Größe Bordnetzversorgung" /end FUNCTION
/begin FUNCTION BGCVN "6.10      Berechnete Größe Calibration Verification Number CVN" /end FUNCTION
/begin FUNCTION BGDVE "3.150     Größen für DV-E-Ansteuerung aus Lern- und Prüfroutinen" /end FUNCTION
/begin FUNCTION BGEVAB "1.40      Berechnung der tatsächlichen Reduzierstufe durch EV-Abschaltung" /end FUNCTION
/begin FUNCTION BGGNSOL "1.30      Berechnete Größe Getriebesolldrehzahlbeeinflussung" /end FUNCTION
/begin FUNCTION BGKMST "2.30      Berechnete Größe: Kilometerstand" /end FUNCTION
/begin FUNCTION BGLBZ "6.20      Berechnete Größe Ladebilanz der Batterie" /end FUNCTION
/begin FUNCTION BGMSABG "2.30      Berechnung Abgasmassenstrom - bankabhängig" /end FUNCTION
/begin FUNCTION BGMSZS "25.60     Berechnungsgröße Massenströme zum Saugrohr" /end FUNCTION
/begin FUNCTION BGNG "5.20      Berechnete Größe Drehzahlgradient" /end FUNCTION
/begin FUNCTION BGNMOT "5.60      Berechnete Größe Drehzahl" /end FUNCTION
/begin FUNCTION BGPLGU "1.10      Berechnung Grundladedruck beim Turbomotor" /end FUNCTION
/begin FUNCTION BGPUK "1.20      Berechnungsgröße Umgebungsdruck korrigiert (Bergabfahrterkennung)" /end FUNCTION
/begin FUNCTION BGRLG "1.10      Berechnete Größe RL-GRADIENT" /end FUNCTION
/begin FUNCTION BGRLP "4.70      Berechnungsgröße rlp prädizierte Luftfüllung" /end FUNCTION
/begin FUNCTION BGRML "1.20      Berechnungsgröße relative Luftmasse nach SAE J1979 Mode $01 + $02 PID $04" /end FUNCTION
/begin FUNCTION BGSRM "17.50     Füllungserfassung Saugrohrmodell" /end FUNCTION
/begin FUNCTION BGTABSA "1.30      Adapter für Abstellzeitberechnung" /end FUNCTION
/begin FUNCTION BGTABST "11.40     Berechnete Größe Abstellzeit" /end FUNCTION
/begin FUNCTION BGTEMPK "10.40     Füllungserfassung Berechnung Temperaturkompensation" /end FUNCTION
/begin FUNCTION BGTEV "2.70      Berechnungsgröße Massenstrom TEV" /end FUNCTION
/begin FUNCTION BGTOL "4.10      Berechnete Größe (Motor-)Öltemperatur" /end FUNCTION
/begin FUNCTION BGTUMG "7.10      Berechnete Größe Umgebungstemperatur" /end FUNCTION
/begin FUNCTION BGVMAX "1.40      Berechnungsgröße Maximalgeschwindigkeit für VMAX-Regelung" /end FUNCTION
/begin FUNCTION BGWDKM "1.10      Berechnung Dk-Winkel Modell" /end FUNCTION
/begin FUNCTION BGWPFGR "2.20      Berechnungsgröße rückgerechneter Pedalwert bei FGR" /end FUNCTION
/begin FUNCTION BKV "2.90      Drucksteuerung für Bremskraftverstärker" /end FUNCTION
/begin FUNCTION CAN "111.20    CAN-Signalliste" /end FUNCTION
/begin FUNCTION CAN_DST "" /end FUNCTION
/begin FUNCTION D2CTR "2.40      Diagnose; Ereigniscounter für Systembeobachtung" /end FUNCTION
/begin FUNCTION DBKVP "2.10      Diagnose Bremskraftverstärker-Pumpe" /end FUNCTION
/begin FUNCTION DBKVPE "1.10      Endstufendiagnose Bremskraftverstärker-Pumpe" /end FUNCTION
/begin FUNCTION DCDACC "2.10      Diagnose; Zugriff auf Testerdaten" /end FUNCTION
/begin FUNCTION DCLA "7.10      OBDII; Klassentabelle" /end FUNCTION
/begin FUNCTION DDCY "15.10     OBDII; Erfüllung Bedingung 'driving cycle'" /end FUNCTION
/begin FUNCTION DDG "10.50     Diagnose Drehzahlgeber" /end FUNCTION
/begin FUNCTION DDPL "9.20      Diagnose; Plausibilitätsprüfung Dauerversorgung (OBDII)" /end FUNCTION
/begin FUNCTION DDSBKV "1.110     Diagnose Drucksensor im Bremskraftverstärker" /end FUNCTION
/begin FUNCTION DDVE "7.30      Diagnose: EGAS-Steller DV-E" /end FUNCTION
/begin FUNCTION DECJ "14.30     Diagnose; Endstufe CJ4x/9x" /end FUNCTION
/begin FUNCTION DEGFE "6.60      Diagnose der Eingangsgrößen Füllungserfassung" /end FUNCTION
/begin FUNCTION DEKON "Konfiguration der Endstufendiagnose" /end FUNCTION
/begin FUNCTION DEKPE "11.20     Diagnose; Elektrokraftstoffpumpe Endstufe" /end FUNCTION
/begin FUNCTION DEPCL "1.20      Diagnose; Elektronik Powertrain Control Lampe" /end FUNCTION
/begin FUNCTION DETRE "1.10      Diagnose Endstufenprüfung elektrische Thermostatregelung" /end FUNCTION
/begin FUNCTION DEVE "6.40      Diagnose; Einspritzventil - Endstufe" /end FUNCTION
/begin FUNCTION DFFT "1.80      Diagnose; Freeze Frame Auswahltabelle" /end FUNCTION
/begin FUNCTION DFFTCNV "3.60      Diagnose; Freeze Frame Tabelle, Konvertierung zu Bytes" /end FUNCTION
/begin FUNCTION DFFTK "9.10      Diagnose; Kundenspezifische Auswahlliste für Freeze Frame-Werte" /end FUNCTION
/begin FUNCTION DFPM "3.40      OBDII; Fehlerpfadmanager" /end FUNCTION
/begin FUNCTION DFPMEEP "3.50      Diagnose; Fehlerpfadmanager, EEPROM-Speicherung" /end FUNCTION
/begin FUNCTION DFPMNL "2.10      Diagnose Fehlerpfadmanagement im Nachlauf" /end FUNCTION
/begin FUNCTION DFPMOVF "2.10      Diagnose Fehlerpfadmanagement, Memory Overflow" /end FUNCTION
/begin FUNCTION DFPMPWF "1.10      Diagnose Fehlerpfadmanagement; Erkennung Powerfail" /end FUNCTION
/begin FUNCTION DFPM_BGTOL "" /end FUNCTION
/begin FUNCTION DFPM_BGTUMG "" /end FUNCTION
/begin FUNCTION DFPM_CAIR "" /end FUNCTION
/begin FUNCTION DFPM_CALL "" /end FUNCTION
/begin FUNCTION DFPM_CAS "" /end FUNCTION
/begin FUNCTION DFPM_CAT "" /end FUNCTION
/begin FUNCTION DFPM_CBSG "" /end FUNCTION
/begin FUNCTION DFPM_CGE "" /end FUNCTION
/begin FUNCTION DFPM_CGRA "" /end FUNCTION
/begin FUNCTION DFPM_CIF "" /end FUNCTION
/begin FUNCTION DFPM_CINS "" /end FUNCTION
/begin FUNCTION DFPM_CKLA "" /end FUNCTION
/begin FUNCTION DFPM_CLWS "" /end FUNCTION
/begin FUNCTION DFPM_CNIV "" /end FUNCTION
/begin FUNCTION DFPM_CNOX "" /end FUNCTION
/begin FUNCTION DFPM_CZAS "" /end FUNCTION
/begin FUNCTION DFPM_DBKVP "" /end FUNCTION
/begin FUNCTION DFPM_DDG "" /end FUNCTION
/begin FUNCTION DFPM_DDVE "" /end FUNCTION
/begin FUNCTION DFPM_DEGFE "" /end FUNCTION
/begin FUNCTION DFPM_DEKON "" /end FUNCTION
/begin FUNCTION DFPM_DENWS "" /end FUNCTION
/begin FUNCTION DFPM_DFPM "" /end FUNCTION
/begin FUNCTION DFPM_DHFM "" /end FUNCTION
/begin FUNCTION DFPM_DHLSHK "" /end FUNCTION
/begin FUNCTION DFPM_DHLSU "" /end FUNCTION
/begin FUNCTION DFPM_DKATSP "" /end FUNCTION
/begin FUNCTION DFPM_dkmtr "dkmtr." /end FUNCTION
/begin FUNCTION DFPM_DKRA "" /end FUNCTION
/begin FUNCTION DFPM_DKRNT "" /end FUNCTION
/begin FUNCTION DFPM_DKRS "" /end FUNCTION
/begin FUNCTION DFPM_DKRTP "" /end FUNCTION
/begin FUNCTION DFPM_DKUPPL "" /end FUNCTION
/begin FUNCTION DFPM_DKVS "" /end FUNCTION
/begin FUNCTION DFPM_DLDP "" /end FUNCTION
/begin FUNCTION DFPM_DLDR "DLDR." /end FUNCTION
/begin FUNCTION DFPM_DLDUV "1.40" /end FUNCTION
/begin FUNCTION DFPM_DLLR "" /end FUNCTION
/begin FUNCTION DFPM_DLSAHK "" /end FUNCTION
/begin FUNCTION DFPM_DLSH "" /end FUNCTION
/begin FUNCTION DFPM_DLSU "" /end FUNCTION
/begin FUNCTION DFPM_DMDMIL "" /end FUNCTION
/begin FUNCTION DFPM_DMFB "" /end FUNCTION
/begin FUNCTION DFPM_DNMAX "" /end FUNCTION
/begin FUNCTION DFPM_DNWKW "" /end FUNCTION
/begin FUNCTION DFPM_DPH "" /end FUNCTION
/begin FUNCTION DFPM_DPL "" /end FUNCTION
/begin FUNCTION DFPM_DSBKV "" /end FUNCTION
/begin FUNCTION DFPM_DSELHFS "" /end FUNCTION
/begin FUNCTION DFPM_DSGEEP "" /end FUNCTION
/begin FUNCTION DFPM_DSLSLRS "" /end FUNCTION
/begin FUNCTION DFPM_DSWEA "" /end FUNCTION
/begin FUNCTION DFPM_DT2STC "" /end FUNCTION
/begin FUNCTION DFPM_DTANKL "" /end FUNCTION
/begin FUNCTION DFPM_DTEV "" /end FUNCTION
/begin FUNCTION DFPM_DTHM "" /end FUNCTION
/begin FUNCTION DFPM_DUF "" /end FUNCTION
/begin FUNCTION DFPM_DUMMY_D "" /end FUNCTION
/begin FUNCTION DFPM_DUR "" /end FUNCTION
/begin FUNCTION DFPM_DVFZ "" /end FUNCTION
/begin FUNCTION DFPM_GECOD "" /end FUNCTION
/begin FUNCTION DFPM_GGCS "" /end FUNCTION
/begin FUNCTION DFPM_GGDSAS "" /end FUNCTION
/begin FUNCTION DFPM_GGEGAS "" /end FUNCTION
/begin FUNCTION DFPM_GGFGRH "" /end FUNCTION
/begin FUNCTION DFPM_GGGTS "" /end FUNCTION
/begin FUNCTION DFPM_GGHLA "" /end FUNCTION
/begin FUNCTION DFPM_GGPED "" /end FUNCTION
/begin FUNCTION DFPM_GGTFA "" /end FUNCTION
/begin FUNCTION DFPM_GGTFM "" /end FUNCTION
/begin FUNCTION DFPM_GGTKA "" /end FUNCTION
/begin FUNCTION DFPM_GGUB "" /end FUNCTION
/begin FUNCTION DFPM_GGUBR "" /end FUNCTION
/begin FUNCTION DFPM_HRE "" /end FUNCTION
/begin FUNCTION DFPM_IMS "" /end FUNCTION
/begin FUNCTION DFPM_LDPE "" /end FUNCTION
/begin FUNCTION DFPM_MDKOG "" /end FUNCTION
/begin FUNCTION DFPM_TUNING "" /end FUNCTION
/begin FUNCTION DFRZ "20.20     OBDII; Beschreibung 'freeze frame'" /end FUNCTION
/begin FUNCTION DHFM "77.20     Diagnose; Plausibilitätsprüfung HFM" /end FUNCTION
/begin FUNCTION DHLSHK "4.90      Diagnose Sondenheizung hinter Kat" /end FUNCTION
/begin FUNCTION DHLSHKE "1.10      Diagnose Endstufe Sondenheizung hinter Kat" /end FUNCTION
/begin FUNCTION DHLSU "2.170     Diagnose Heizung LSU" /end FUNCTION
/begin FUNCTION DHR "2.20      Diagnose; Hauptrelais" /end FUNCTION
/begin FUNCTION DIAVALVE "" /end FUNCTION
/begin FUNCTION DIMCA "1.10      Diagnose; Inspection Maintenance Code, allgemein" /end FUNCTION
/begin FUNCTION DIMCAGR "1.10      Diagnose; Inspection Maintenance Code, Abgasrückführsystem-Überwachung" /end FUNCTION
/begin FUNCTION DIMCHLS "1.20      Diagnose; Inspection Maintenance Code, LS-Heizungsüberwachung" /end FUNCTION
/begin FUNCTION DIMCKAT "1.10      Diagnose; Inspection maintenance Code, Katalysatorüberwachung" /end FUNCTION
/begin FUNCTION DIMCLSV "1.10      Diagnose; Inspection Maintenance Code, Lambdasonden-Überwachung" /end FUNCTION
/begin FUNCTION DIMCSLS "1.10      Diagnose; Inspection Maintenance Code, Sekundärluftsystem-Überwachung" /end FUNCTION
/begin FUNCTION DIMCTES "1.10      Diagnose; Inspection-Maintenance Code, Tankentlüftungssystem" /end FUNCTION
/begin FUNCTION DISTAB12 "" /end FUNCTION
/begin FUNCTION DKATSP "1.160     Katalysatordiagnose durch Gemischsprung" /end FUNCTION
/begin FUNCTION DKATSPEB "1.20      Einschaltbedingungen der Katalysatordiagnose" /end FUNCTION
/begin FUNCTION DKMTR "1.50      Diagnose Kühlmittel-Temperatur-Regelung" /end FUNCTION
/begin FUNCTION DKRA "6.40      Diagnose; Klopfregelanschlag" /end FUNCTION
/begin FUNCTION DKRNT "11.10     Diagnose; Klopfregelung, Nulltest (OBDII)" /end FUNCTION
/begin FUNCTION DKRS "30.20     Diagnose; Klopfsensor (OBDII)" /end FUNCTION
/begin FUNCTION DKRTP "11.10     Diagnose; Klopfregelung, Testimpuls (OBDII)" /end FUNCTION
/begin FUNCTION DKUPPL "1.40      Diagnose Kupplungsschalter" /end FUNCTION
/begin FUNCTION DKVS "17.100    Diagnose; Plausibilitätsprüfung Kraftstoffversorgungssysteme" /end FUNCTION
/begin FUNCTION DLDE "7.10      Diagnose LDR-Endstufe" /end FUNCTION
/begin FUNCTION DLDP "19.80     OBD II, Tankentlüftungsdiagnosemodul" /end FUNCTION
/begin FUNCTION DLDPE "5.50      Endstufendiagnose; Überdruckpumpe der Tank-Leck-Diagnose" /end FUNCTION
/begin FUNCTION DLDR "2.140     Diagnose LDR" /end FUNCTION
/begin FUNCTION DLDUV "1.40      Diagnose Schubumluftventil beim Turbomotor" /end FUNCTION
/begin FUNCTION DLDUVSE "2.10      Diagnose Endstufe Umluftventil Turbo" /end FUNCTION
/begin FUNCTION DLLR "28.120    Diagnose: Leerlaufregelung Erkennung blockierter Steller" /end FUNCTION
/begin FUNCTION DLSAHK "12.80     Lambdasondenalterungsüberwachung hinter KAT" /end FUNCTION
/begin FUNCTION DLSH "26.200    Diagnose; Sondenbetriebsbereitschaft hinter Kat" /end FUNCTION
/begin FUNCTION DLSSA "14.90     Signalausgabe Lambdasonden" /end FUNCTION
/begin FUNCTION DLSU "4.180     Diagnose stetige Lambdasonde LSU" /end FUNCTION
/begin FUNCTION DLUES1E "1.30      Endstufendiagnose Lüftersteuerung 1" /end FUNCTION
/begin FUNCTION DMDDLU "Diagnose Misfire Detection Differenzbildung der Laufunruhe" /end FUNCTION
/begin FUNCTION DMDFON "Diagnosis Misfire Detection Fuel-on Adaptation" /end FUNCTION
/begin FUNCTION DMDLAD "Logic and Delay; Log. Verknüpfung versch. Blöcke zur Aussetzererkennung" /end FUNCTION
/begin FUNCTION DMDLU "Diagnose misfire detection; Laufunruhe" /end FUNCTION
/begin FUNCTION DMDLUA "Diagnose Misfire Detection Laufunruhe Abstandsmass" /end FUNCTION
/begin FUNCTION DMDLU_C "" /end FUNCTION
/begin FUNCTION DMDMIL "3.90      Fehlerbehandlung der Aussetzererkennung, Ansteuerung der MIL und Heilung" /end FUNCTION
/begin FUNCTION DMDMON "2.10      Diagnose misfire detection Monitor Funktion" /end FUNCTION
/begin FUNCTION DMDSTP "9.100     Diagnose Misfire Detection; Stopbedingungen" /end FUNCTION
/begin FUNCTION DMDSTP_C "" /end FUNCTION
/begin FUNCTION DMDSYK "" /end FUNCTION
/begin FUNCTION DMDTSB "6.20      Diagnosis Misfire Detection Segmentzeitbildung" /end FUNCTION
/begin FUNCTION DMDUE "9.190     Diagnose Misfire Detection Overview (Übersicht)" /end FUNCTION
/begin FUNCTION DMFB "11.30     OBDII; MIL fremdbestimmt" /end FUNCTION
/begin FUNCTION DMIL "26.50     OBDII; MIL-Ansteuerung" /end FUNCTION
/begin FUNCTION DNMAX "4.20      Diagnose; Plausibilitätsprüfung Maximaldrehzahl Überschreitung" /end FUNCTION
/begin FUNCTION DNWKW "5.30      Diagnose Zuordnung der Nockenwelle zur Kurbelwelle" /end FUNCTION
/begin FUNCTION DNWSEEIN "1.30      Diagnose der Nockenwellenendstufe (einlaßseitig)" /end FUNCTION
/begin FUNCTION DNWSEIN "1.70      Diagnose Nockenwellensteuerung (Einlaßseitig)" /end FUNCTION
/begin FUNCTION DNWSZF "1.10      Diagnose Nockenwellensteuerung Fehlerzusammenfassung" /end FUNCTION
/begin FUNCTION DPH "22.20     Diagnose; Plausibilitätsprüfung Phasensensor" /end FUNCTION
/begin FUNCTION DSELHFS "1.50      Selektion Diagnose Hauptfüllungssensor" /end FUNCTION
/begin FUNCTION DSGEEP "20.10     Diagnose; Plausibilitätsprüfung SG-EEPROM" /end FUNCTION
/begin FUNCTION DSLPE "9.20      Diagnose; Sekundärluftpumpe Endstufe" /end FUNCTION
/begin FUNCTION DSLSLRS "4.310     Diagnose Sekundärluftsystem mit stetiger Lambdaregelung" /end FUNCTION
/begin FUNCTION DSLVE "11.10     Diagnose; Plausibilitätsprüfung Sekundärluftventil-Endstufe" /end FUNCTION
/begin FUNCTION DSWEA "2.40      Schlechtwegerkennung durch Abfrage eines vom ABS SG generierten Status" /end FUNCTION
/begin FUNCTION DT2STC "1.10      Diagnose; Testerkommunikation Start Kommunikation" /end FUNCTION
/begin FUNCTION DTANKL "3.20      Diagnose OBDII Fehler auf Grund eines leeren Tanks" /end FUNCTION
/begin FUNCTION DTEV "32.130    Diagnose Tankentlüftungsventil (OBDII)" /end FUNCTION
/begin FUNCTION DTEVE "9.30      Diagnose; Tankentlüftungsventil - Endstufe" /end FUNCTION
/begin FUNCTION DTHM "7.10      Diagnose Thermostat Motor-Kühlmittel" /end FUNCTION
/begin FUNCTION DTIP "1.30      OBDII; Tester-Interface Package" /end FUNCTION
/begin FUNCTION DTOP "1.10      Diagnose; Betriebszeit" /end FUNCTION
/begin FUNCTION DTRIG "1.10      OBDII; Auswählbare Trigger für Fehlerpfad-Management" /end FUNCTION
/begin FUNCTION DUF "6.30      Diagnose aus der Funktionsüberwachung" /end FUNCTION
/begin FUNCTION DUMMY "DUMMY SEKTION" /end FUNCTION
/begin FUNCTION DUMWEX "4.10      Diagose; Erweiterte Umweltbedingumgen" /end FUNCTION
/begin FUNCTION DUR "1.20      Diagnose aus der Rechnerüberwachung" /end FUNCTION
/begin FUNCTION DVFZ "17.10     Diagnose: Plausibilitätsprüfung Fahrzeuggeschwindigkeit" /end FUNCTION
/begin FUNCTION DWUC "14.20     OBDII; Erfüllung Bedingung 'warm up cycle'" /end FUNCTION
/begin FUNCTION DZUEET "1.30      Diagnose Zuendendstufentreiber" /end FUNCTION
/begin FUNCTION _EEPROM "11.30     EEPROM-Behandlung" /end FUNCTION
/begin FUNCTION ESGRU "23.30     Grundeinspritzungen" /end FUNCTION
/begin FUNCTION ESNSWL "3.20      Einspritzung Nachstart und Warmlauf" /end FUNCTION
/begin FUNCTION ESSTT "22.50     Einspritzzeit Start" /end FUNCTION
/begin FUNCTION ESUK "9.80      Einspritzung Übergangskompensation" /end FUNCTION
/begin FUNCTION ESUKAS "5.50      Adaption der Übergangskompensation (mit stetiger Lambda-Regelung)" /end FUNCTION
/begin FUNCTION ESVW "3.60      Einspritzung: Berechnung der Vorlagerungswinkel" /end FUNCTION
/begin FUNCTION ESWE "1.90      Einspritzung Schubabschalten Wiedereinsetzen" /end FUNCTION
/begin FUNCTION EVI "1.20      Interruptserviceroutinen bei Einspritzausgabe" /end FUNCTION
/begin FUNCTION FE "3.10      Füllungseingriffe" /end FUNCTION
/begin FUNCTION FGRABED "1.70      Abschaltbedingungen Fahrgeschwindigkeitsregler" /end FUNCTION
/begin FUNCTION FGRBESI "1.20      Bediensignale Fahrgeschwindigkeitsregler" /end FUNCTION
/begin FUNCTION FGRFULO "1.20      Funktionslogik Fahrgeschwindigkeitsregler" /end FUNCTION
/begin FUNCTION FGRREGL "1.20      Regelalgorithmus Fahrgeschwindigkeitsregler" /end FUNCTION
/begin FUNCTION FUEDK "21.100    Füllungssteuerung (Berechnung DK-Sollwinkel)" /end FUNCTION
/begin FUNCTION FUEDKSA "1.20      Füllungsbeeinflussung über DK, Sollwertaufbereitung" /end FUNCTION
/begin FUNCTION FUEREG "4.80      Füllungsregelung" /end FUNCTION
/begin FUNCTION GGCASR "1.50      Gebergöße CAN-Signale für ASR/MSR" /end FUNCTION
/begin FUNCTION GGCGRA "1.40      Gebergröße GRA-Bedienhebel mit CAN" /end FUNCTION
/begin FUNCTION GGCS "1.70      Gebergröße Crash-Sensor" /end FUNCTION
/begin FUNCTION GGCTOL "1.10      Gebergröße Öltemperatur über CAN" /end FUNCTION
/begin FUNCTION GGCTUM "1.10      Gebergröße Umgebungstemperatur über CAN" /end FUNCTION
/begin FUNCTION GGDPG "14.50     Gebergröße: Drehzahlgeber und Phasengeber" /end FUNCTION
/begin FUNCTION GGDSAS "4.80      Gebergröße Drucksensoren außerhalb Saugrohr" /end FUNCTION
/begin FUNCTION GGDST "3.10      Gebergröße Drucksensor Tank" /end FUNCTION
/begin FUNCTION GGDVE "2.50      Gebergrößen Drosselklappensteller" /end FUNCTION
/begin FUNCTION GGEGAS "9.60      Gebergröße Brems- und Kupplungsschalter" /end FUNCTION
/begin FUNCTION GGFGRH "1.90      Gebergrößen Bedienhebel für Fahrgeschwindigkeitsregler" /end FUNCTION
/begin FUNCTION GGFST "11.30     Gebergröße Tankfüllstand" /end FUNCTION
/begin FUNCTION GGGTS "2.30      Gebergröße genaues Temperatursignal" /end FUNCTION
/begin FUNCTION GGHFM "65.20     Gebersignal HFM" /end FUNCTION
/begin FUNCTION GGHLA "1.10      Gebergröße Heizleistungsanforderung" /end FUNCTION
/begin FUNCTION GGKLDF "1.10      Gebergröße Klemme DFM des Generators" /end FUNCTION
/begin FUNCTION GGKS "4.40      Gebergröße Klopfsensor" /end FUNCTION
/begin FUNCTION GGKS_MF "" /end FUNCTION
/begin FUNCTION GGLSH "3.30      Gebergröße Lambdasondensignal (Nernst-Type) hinter Kat" /end FUNCTION
/begin FUNCTION GGLSU "5.40      Gebersignal LSU" /end FUNCTION
/begin FUNCTION GGNW "1.30      Winkeladaption der Nockenwelle zur Kurbelwelle" /end FUNCTION
/begin FUNCTION GGPBKV "2.60      Gebergröße Druck für Bremskraftverstärker" /end FUNCTION
/begin FUNCTION GGPED "8.70      Gebergröße Fahrpedal" /end FUNCTION
/begin FUNCTION GGSWEA "1.10      Gebergröße-Schlechtwegerkennung-PWM-Signal" /end FUNCTION
/begin FUNCTION GGTFA "18.20     Gebergröße TFA Temperaturfühler Ansaugluft" /end FUNCTION
/begin FUNCTION GGTFM "44.40     Gebergröße TFM Temperaturfühler Motor (/-Kühlmittel)" /end FUNCTION
/begin FUNCTION GGTKA "5.10      Gebergröße TKA Temperatur Kühlerausgang" /end FUNCTION
/begin FUNCTION GGUB "11.30     Gebergröße Batteriespannung, inkl.Diagnose" /end FUNCTION
/begin FUNCTION GGUBR "1.80      Gebergröße und Diagnose Bordnetzspannung über Hauptrelais" /end FUNCTION
/begin FUNCTION GGVFZG "14.70     Gebergröße Fahrzeuggeschwindigkeit" /end FUNCTION
/begin FUNCTION GGZDGON "1.30      Gebergröße Klemme 15" /end FUNCTION
/begin FUNCTION GK "13.20     Gemischkontrolle" /end FUNCTION
/begin FUNCTION Hash "" /end FUNCTION
/begin FUNCTION HLSHK "3.30      Sondenheizung hinter Kat" /end FUNCTION
/begin FUNCTION HLSU "3.90      Heizung stetige Lambdasonde LSU" /end FUNCTION
/begin FUNCTION HWDIG75 "" /end FUNCTION
/begin FUNCTION HWTEV "Komponententreiber für Tankentlüftungsventil (TEV)" /end FUNCTION
/begin FUNCTION ims_501 "" /end FUNCTION
/begin FUNCTION INDEX_BGTOL "" /end FUNCTION
/begin FUNCTION INDEX_BGTUMG "" /end FUNCTION
/begin FUNCTION INDEX_CAIR "" /end FUNCTION
/begin FUNCTION INDEX_CALL "" /end FUNCTION
/begin FUNCTION INDEX_CAS "" /end FUNCTION
/begin FUNCTION INDEX_CAT "" /end FUNCTION
/begin FUNCTION INDEX_CBSG "" /end FUNCTION
/begin FUNCTION INDEX_CGE "" /end FUNCTION
/begin FUNCTION INDEX_CGRA "" /end FUNCTION
/begin FUNCTION INDEX_CIF "" /end FUNCTION
/begin FUNCTION INDEX_CINS "" /end FUNCTION
/begin FUNCTION INDEX_CKLA "" /end FUNCTION
/begin FUNCTION INDEX_CLWS "" /end FUNCTION
/begin FUNCTION INDEX_CNIV "" /end FUNCTION
/begin FUNCTION INDEX_CNOX "" /end FUNCTION
/begin FUNCTION INDEX_CZAS "" /end FUNCTION
/begin FUNCTION INDEX_DBKVP "" /end FUNCTION
/begin FUNCTION INDEX_DDG "" /end FUNCTION
/begin FUNCTION INDEX_DDVE "" /end FUNCTION
/begin FUNCTION INDEX_DEGFE "" /end FUNCTION
/begin FUNCTION INDEX_DEKON "" /end FUNCTION
/begin FUNCTION INDEX_DENWS "" /end FUNCTION
/begin FUNCTION INDEX_DFPM "" /end FUNCTION
/begin FUNCTION INDEX_DHFM "" /end FUNCTION
/begin FUNCTION INDEX_DHLSHK "" /end FUNCTION
/begin FUNCTION INDEX_DHLSU "" /end FUNCTION
/begin FUNCTION INDEX_DKATSP "" /end FUNCTION
/begin FUNCTION INDEX_dkmtr "dkmtr." /end FUNCTION
/begin FUNCTION INDEX_DKRA "" /end FUNCTION
/begin FUNCTION INDEX_DKRNT "" /end FUNCTION
/begin FUNCTION INDEX_DKRS "" /end FUNCTION
/begin FUNCTION INDEX_DKRTP "" /end FUNCTION
/begin FUNCTION INDEX_DKUPPL "" /end FUNCTION
/begin FUNCTION INDEX_DKVS "" /end FUNCTION
/begin FUNCTION INDEX_DLDP "" /end FUNCTION
/begin FUNCTION INDEX_DLDR "DLDR." /end FUNCTION
/begin FUNCTION INDEX_DLDUV "1.40" /end FUNCTION
/begin FUNCTION INDEX_DLLR "" /end FUNCTION
/begin FUNCTION INDEX_DLSAHK "" /end FUNCTION
/begin FUNCTION INDEX_DLSH "" /end FUNCTION
/begin FUNCTION INDEX_DLSU "" /end FUNCTION
/begin FUNCTION INDEX_DMDMIL "" /end FUNCTION
/begin FUNCTION INDEX_DMFB "" /end FUNCTION
/begin FUNCTION INDEX_DNMAX "" /end FUNCTION
/begin FUNCTION INDEX_DNWKW "" /end FUNCTION
/begin FUNCTION INDEX_DPH "" /end FUNCTION
/begin FUNCTION INDEX_DPL "" /end FUNCTION
/begin FUNCTION INDEX_DSBKV "" /end FUNCTION
/begin FUNCTION INDEX_DSELHFS "" /end FUNCTION
/begin FUNCTION INDEX_DSGEEP "" /end FUNCTION
/begin FUNCTION INDEX_DSLSLRS "" /end FUNCTION
/begin FUNCTION INDEX_DSWEA "" /end FUNCTION
/begin FUNCTION INDEX_DT2STC "" /end FUNCTION
/begin FUNCTION INDEX_DTANKL "" /end FUNCTION
/begin FUNCTION INDEX_DTEV "" /end FUNCTION
/begin FUNCTION INDEX_DTHM "" /end FUNCTION
/begin FUNCTION INDEX_DUF "" /end FUNCTION
/begin FUNCTION INDEX_DUMMY_D "" /end FUNCTION
/begin FUNCTION INDEX_DUR "" /end FUNCTION
/begin FUNCTION INDEX_DVFZ "" /end FUNCTION
/begin FUNCTION INDEX_GECOD "" /end FUNCTION
/begin FUNCTION INDEX_GGCS "" /end FUNCTION
/begin FUNCTION INDEX_GGDSAS "" /end FUNCTION
/begin FUNCTION INDEX_GGEGAS "" /end FUNCTION
/begin FUNCTION INDEX_GGFGRH "" /end FUNCTION
/begin FUNCTION INDEX_GGGTS "" /end FUNCTION
/begin FUNCTION INDEX_GGHLA "" /end FUNCTION
/begin FUNCTION INDEX_GGPED "" /end FUNCTION
/begin FUNCTION INDEX_GGTFA "" /end FUNCTION
/begin FUNCTION INDEX_GGTFM "" /end FUNCTION
/begin FUNCTION INDEX_GGTKA "" /end FUNCTION
/begin FUNCTION INDEX_GGUB "" /end FUNCTION
/begin FUNCTION INDEX_GGUBR "" /end FUNCTION
/begin FUNCTION INDEX_HRE "" /end FUNCTION
/begin FUNCTION INDEX_IMS "" /end FUNCTION
/begin FUNCTION INDEX_LDPE "" /end FUNCTION
/begin FUNCTION INDEX_MDKOG "" /end FUNCTION
/begin FUNCTION INDEX_TUNING "" /end FUNCTION
/begin FUNCTION K71EXT "" /end FUNCTION
/begin FUNCTION K71MN "" /end FUNCTION
/begin FUNCTION K71SR "" /end FUNCTION
/begin FUNCTION KDIAG "" /end FUNCTION
/begin FUNCTION keycheck "" /end FUNCTION
/begin FUNCTION KHMD "1.100     Berechnung Reservemoment für Katheizen" /end FUNCTION
/begin FUNCTION KMTR "3.300     Kühlmitteltemperaturregelung" /end FUNCTION
/begin FUNCTION KOS "113.180   Klimakompressor - Steuerung" /end FUNCTION
/begin FUNCTION KRACT "" /end FUNCTION
/begin FUNCTION KRDY "31.30     Klopfregelung Dynamik" /end FUNCTION
/begin FUNCTION KRKE "16.30     Klopferkennung" /end FUNCTION
/begin FUNCTION KRRA "15.130    Klopfregelung mit Adaption der zylinderindividuellen Spätverstellung" /end FUNCTION
/begin FUNCTION KVA "41.40     Ausgangssignal: Kraftstoff-Verbrauchs-Anzeige" /end FUNCTION
/begin FUNCTION KWP2000F "" /end FUNCTION
/begin FUNCTION KWPDATR "" /end FUNCTION
/begin FUNCTION KWPDIAG "" /end FUNCTION
/begin FUNCTION KWPSTDA "" /end FUNCTION
/begin FUNCTION KWPSTDAA "" /end FUNCTION
/begin FUNCTION LAKH "4.80      Lambda-Koordination bei Katheizen" /end FUNCTION
/begin FUNCTION LAMBTS "11.20     Lambda Bauteileschutz" /end FUNCTION
/begin FUNCTION LAMFAW "13.20     Lambda Fahrerwunsch" /end FUNCTION
/begin FUNCTION LAMKO "9.90      Lambdakoordination" /end FUNCTION
/begin FUNCTION LANSWL "2.20      Lambda Nachstart / Warmlauf" /end FUNCTION
/begin FUNCTION LDOB "31.30     LDR Overboost" /end FUNCTION
/begin FUNCTION LDRLMX "8.30      Berechnung LDR Maximalfuellung rlmax" /end FUNCTION
/begin FUNCTION LDRPID "25.10     LDR PID-Regler" /end FUNCTION
/begin FUNCTION LDRPLS "2.50      Berechnung Soll-Ladedruck" /end FUNCTION
/begin FUNCTION LDTVMA "21.10     Aufbereitung und Ausgabe Tastverhältnis" /end FUNCTION
/begin FUNCTION LDUVST "2.90      LDR-Schubumluftventilsteuerung" /end FUNCTION
/begin FUNCTION LLRBB "505.10    Leerlaufregelung Betriebsbedingungen" /end FUNCTION
/begin FUNCTION LLRMR "12.110    Momentenreserve Leerlaufregelung" /end FUNCTION
/begin FUNCTION LLRNFA "1.140     Solldrehzahlanhebung bei Kurztrip" /end FUNCTION
/begin FUNCTION LLRNS "541.130   Leerlaufregelung-Solldrehzahl" /end FUNCTION
/begin FUNCTION LLRRM "11.110    Leerlaufregelung Reglereingriff Drehmoment" /end FUNCTION
/begin FUNCTION LRA "93.110    Adaptive Vorsteuerung für Lambdaregelung" /end FUNCTION
/begin FUNCTION LRAEB "4.120     Einschaltbedingungen Gemischadaption" /end FUNCTION
/begin FUNCTION LRS "15.120    Stetige Lambdaregelung" /end FUNCTION
/begin FUNCTION LRSEB "10.160    Einschaltbedingungen stetige Lambdaregelung" /end FUNCTION
/begin FUNCTION LRSHK "9.60      Lambdaregelung (stetig) hinter Katalysator" /end FUNCTION
/begin FUNCTION LRSINI "1.10      Stetige Lambdaregelung, Koordination der Initialisierung" /end FUNCTION
/begin FUNCTION LRSKA "6.50      Stetige Lambdaregelung Zusatzfunktion Katalysator-Ausräumen" /end FUNCTION
/begin FUNCTION MCMESS_PROT "" /end FUNCTION
/begin FUNCTION MDAUTG "2.70      Berechnung des Istmomentes für die Getriebesteuerung" /end FUNCTION
/begin FUNCTION MDBAS "8.30      Berechnung der Basisgrößen für Momentenschnittstelle" /end FUNCTION
/begin FUNCTION MDBGRG "5.40      Momentenbegrenzung nach oben" /end FUNCTION
/begin FUNCTION MDFAW "12.260    Fahrerwunschmoment" /end FUNCTION
/begin FUNCTION MDFUE "8.60      Sollwertvorgabe für Luftmasse aus Sollmoment" /end FUNCTION
/begin FUNCTION MDIST "10.10     Motormomentenberechnung" /end FUNCTION
/begin FUNCTION MDKOG "14.70     Drehmomentenkoordination für Gesamteingriffe" /end FUNCTION
/begin FUNCTION MDKOL "10.130    Momentenkoordination auf Füllungsebene" /end FUNCTION
/begin FUNCTION MDMAX "1.40      Berechnung maximales indiziertes Motormoment" /end FUNCTION
/begin FUNCTION MDMIN "10.40     Minimales Motormoment Koordination" /end FUNCTION
/begin FUNCTION MDNSTAB "1.40      Drehmoment: Drehzahlstabilisierung" /end FUNCTION
/begin FUNCTION MDRED "4.50      Berechnung Reduzierstufe aus Momentenanforderung" /end FUNCTION
/begin FUNCTION MDTRIP "1.30      Berechnung der Momentenreserve im Kurztrip" /end FUNCTION
/begin FUNCTION MDVER "5.120     Motor-Verlustmoment" /end FUNCTION
/begin FUNCTION MDVERAD "12.30     Adaption Verlustmoment" /end FUNCTION
/begin FUNCTION MDVERB "12.290    Momentenbedarf der Nebenaggregate (z.B. Klimaanlage, sonst. Verbraucher)" /end FUNCTION
/begin FUNCTION MDWAN "6.110     Drehmomentaufnahme des Wandlers" /end FUNCTION
/begin FUNCTION MDZUL "4.20      Maximal zulässiges Moment" /end FUNCTION
/begin FUNCTION MDZW "1.120     Berechnung Moment in Sollzündwinkel" /end FUNCTION
/begin FUNCTION MOTAUS "5.70      Motor-Abstellen" /end FUNCTION
/begin FUNCTION NLDG "2.70      Notlauf Drehzahlgeber" /end FUNCTION
/begin FUNCTION NLPH "5.20      Notlauf Phasengeber" /end FUNCTION
/begin FUNCTION NMAXMD "4.80      Drehzahlbegrenzung" /end FUNCTION
/begin FUNCTION NWEVO "1.10      Nockenwelle: eingeschränkte Verstellmöglichkeiten wegen Öldruck" /end FUNCTION
/begin FUNCTION NWFW "2.30      Berechnung Faktor Winkel Nockenwelle" /end FUNCTION
/begin FUNCTION NWSFAT "1.10      Nockenwellensteuerung, Sollwertvorgabe durch Tester" /end FUNCTION
/begin FUNCTION NWSOLLE "2.50      Sollwertvorgabe NWS (Einlaßseitig)" /end FUNCTION
/begin FUNCTION NWSYVAR "2.20      Nockenwellen-Systemvarianten" /end FUNCTION
/begin FUNCTION NWWUE "5.20      Berechnung der Nockenwellenüberschneidung" /end FUNCTION
/begin FUNCTION OBPC_71 "" /end FUNCTION
/begin FUNCTION OBP_CAN "" /end FUNCTION
/begin FUNCTION OBP_EEP "" /end FUNCTION
/begin FUNCTION obp_t "" /end FUNCTION
/begin FUNCTION PHAS "Phaseninterrupt" /end FUNCTION
/begin FUNCTION PK "" /end FUNCTION
/begin FUNCTION POWERFA "" /end FUNCTION
/begin FUNCTION PROKON "4.20      Projektkonfiguration" /end FUNCTION
/begin FUNCTION RDE "1.40      Rückdreherkennung" /end FUNCTION
/begin FUNCTION RKTI "11.60     Einspritzdauerberechnung ti aus relativer Kraftstoffmasse rk" /end FUNCTION
/begin FUNCTION RSA "" /end FUNCTION
/begin FUNCTION RSTMON "2.10      Reset Monitor" /end FUNCTION
/begin FUNCTION RUNTIME "" /end FUNCTION
/begin FUNCTION SCATT "20.90     SCAN TOOL-Testerschnittstelle" /end FUNCTION
/begin FUNCTION SLS "118.20    Sekundärluftsteuerung" /end FUNCTION
/begin FUNCTION SREAKT "7.70      EGAS: Sicherheitskonzept, Fehlerreaktionen" /end FUNCTION
/begin FUNCTION SSTB "" /end FUNCTION
/begin FUNCTION STACKMON "" /end FUNCTION
/begin FUNCTION STADAP "6.80      Startmengen-Adaption" /end FUNCTION
/begin FUNCTION STADK "1.20      ." /end FUNCTION
/begin FUNCTION STARTUF "" /end FUNCTION
/begin FUNCTION SWADP "Software-Adapter" /end FUNCTION
/begin FUNCTION SWEISR "" /end FUNCTION
/begin FUNCTION SYK051 "" /end FUNCTION
/begin FUNCTION SYNC71 "" /end FUNCTION
/begin FUNCTION SYSYNC "System-Synchronisation" /end FUNCTION
/begin FUNCTION SY_DFPM3 "" /end FUNCTION
/begin FUNCTION T71XXX_T "" /end FUNCTION
/begin FUNCTION TC1MOD "20.120    Testerkommunikation CARB; Mode 1" /end FUNCTION
/begin FUNCTION TC2MOD "20.71     Testerkommunikation CARB; Mode 2" /end FUNCTION
/begin FUNCTION TC5MOD "20.30     Testerkommunikation CARB; Mode 5, Ausgabe Sondenmeßwerte" /end FUNCTION
/begin FUNCTION TC6MOD "20.100    Testerkommunikation CARB/EOBD; Mode/Service 6, Ausgabe Prüfschwellen" /end FUNCTION
/begin FUNCTION TC8MOD "21.50     Testerkommunikation CARB; Mode 8, Funktionsaktivierungen" /end FUNCTION
/begin FUNCTION TC9MOD "8.20      Testerkommunikation CARB; Mode 9, Request Vehicle Information" /end FUNCTION
/begin FUNCTION TCKOMUE "2.10      Testerkommunikation CARB; Kommunikationsaufbau Übersicht" /end FUNCTION
/begin FUNCTION TCSORT "3.30      Testerkommunikation CARB; Sortierfunktion" /end FUNCTION
/begin FUNCTION TEB "95.120    Tankentlüftung beladungsabhängig" /end FUNCTION
/begin FUNCTION TEBEB "4.140     Einschaltbedingungen Tankentlüftung" /end FUNCTION
/begin FUNCTION TEMPKON "3.40      Temperatur-Konvertermodul" /end FUNCTION
/begin FUNCTION TIMEV_OV "" /end FUNCTION
/begin FUNCTION TIMU "1.20      Timerumschaltung im Start bei Einspritzausgabe" /end FUNCTION
/begin FUNCTION TKMWL "22.330    Testerkommunikation; Meßwerte lesen" /end FUNCTION
/begin FUNCTION TKSTA "3.150     Testerkommunikation; Stellgliedansteuerung" /end FUNCTION
/begin FUNCTION TN "3.20      Drehzahlmesser Signal" /end FUNCTION
/begin FUNCTION TNOT "" /end FUNCTION
/begin FUNCTION TREV_OV "" /end FUNCTION
/begin FUNCTION TUNING "Tuningschutz" /end FUNCTION
/begin FUNCTION UFACCC "1.10      EGAS Überwachungskonzept: ACC Eingangssignalüberwachung der Funktionüberwachung" /end FUNCTION
/begin FUNCTION UFEING "13.10     EGAS Überwachungskonzept: Eingangssignalübernahme für Funktionsüberwachung" /end FUNCTION
/begin FUNCTION UFEINS "" /end FUNCTION
/begin FUNCTION UFFGRC "5.10      EGAS Überwachungskonzept: FGR-Überwachung der Funktionsüberwachung" /end FUNCTION
/begin FUNCTION UFFGRE "14.20     EGAS Überwachungskonzept: FGR-Eingangsinfos für die Funktionsüberwachung" /end FUNCTION
/begin FUNCTION UFMIST "2.10      EGAS Überwachungskonzept: Ist-Moment der Funktionsüberwachung" /end FUNCTION
/begin FUNCTION UFMSRC "5.20      EGAS Überwachungskonzept: MSR-Eingriff-Überwachung für die Funktionsüberwachung" /end FUNCTION
/begin FUNCTION UFMVER "2.10      EGAS Überwachungskonzept: Momentenvergleich der Funktionsüberwachung" /end FUNCTION
/begin FUNCTION UFMZF "1.10      EGAS Überwachungskonzept: Momentenfilter für die Funktionsüberwachung" /end FUNCTION
/begin FUNCTION UFMZUL "12.20     EGAS Überwachungskonzept: zulässiges Moment der Funktionsüberwachung" /end FUNCTION
/begin FUNCTION UFNC "3.20      EGAS Überwachungskonzept: N-Überwachung für die Funktionsüberwachung" /end FUNCTION
/begin FUNCTION UFNSC "2.10      EGAS Überwachungskonzept: Nachstartüberwachung für die Funktionsüberwachung" /end FUNCTION
/begin FUNCTION UFREAC "4.20      EGAS Überwachungskonzept: Fehlerreaktionsüberw.d.Funktionsüberwachung" /end FUNCTION
/begin FUNCTION UFRLC "5.10      EGAS Überwachungskonzept: Lastsignalüberw. für Funktionsüberwachung" /end FUNCTION
/begin FUNCTION UFSGSC "3.10      EGAS Überwachungskonzept: SGS-Eingriff-Überwachung für die Funktionsübersicht" /end FUNCTION
/begin FUNCTION UFSPSC "2.30      EGAS Überwachungskonzept: Pedal-Sollwert-Ü. für Funktionsüberwachung" /end FUNCTION
/begin FUNCTION UFURAM "" /end FUNCTION
/begin FUNCTION UFZWC "2.20      EGAS Überwachungskonzept: ZW-Überwachung für Funktionsüberwachung" /end FUNCTION
/begin FUNCTION UMKOM "7.20      EGAS Überwachungskonzept: Frage/Antwort-Kommunikation zw. UM und FR" /end FUNCTION
/begin FUNCTION URADCC "2.20      EGAS Überwachungskonzept: AD-Wandler-Test" /end FUNCTION
/begin FUNCTION URAUSG "" /end FUNCTION
/begin FUNCTION URCAUS "" /end FUNCTION
/begin FUNCTION URCEIN "" /end FUNCTION
/begin FUNCTION URCEINS "" /end FUNCTION
/begin FUNCTION URCFGRC "" /end FUNCTION
/begin FUNCTION URCMIST "" /end FUNCTION
/begin FUNCTION URCMSRC "" /end FUNCTION
/begin FUNCTION URCMVER "" /end FUNCTION
/begin FUNCTION URCMZF "" /end FUNCTION
/begin FUNCTION URCMZUL "" /end FUNCTION
/begin FUNCTION URCRAM "" /end FUNCTION
/begin FUNCTION URCREAC "" /end FUNCTION
/begin FUNCTION URCREF "" /end FUNCTION
/begin FUNCTION URCSGSC "" /end FUNCTION
/begin FUNCTION URDELAY "" /end FUNCTION
/begin FUNCTION URMEM "3.10      EGAS Überwachungskonzept: Zyklischer Speichertest" /end FUNCTION
/begin FUNCTION URRAM "2.10      EGAS Überwachungskonzept: RAM-Test" /end FUNCTION
/begin FUNCTION URROM "2.20      EGAS Überwachungskonzept: ROM-Test" /end FUNCTION
/begin FUNCTION VAR "332.90    Variantencodierung" /end FUNCTION
/begin FUNCTION VAR_DST "" /end FUNCTION
/begin FUNCTION VMAXMD "5.10      Drehmomentanforderung von VMAX-Regelung" /end FUNCTION
/begin FUNCTION VS_VERST "Verstellparameter für McMess" /end FUNCTION
/begin FUNCTION WDKSOM "2.40      Berechnung Drosselklappensollwinkel ohne Momentenstruktur" /end FUNCTION
/begin FUNCTION ZUE "282.130   Grundfunktion - Zündung" /end FUNCTION
/begin FUNCTION ZUESZ "3.50      Zündung, Berechnung Schließzeit" /end FUNCTION
/begin FUNCTION ZWGRU "23.130    Grundzündwinkel" /end FUNCTION
/begin FUNCTION ZWMIN "3.160     Berechnung des spätest erlaubten Zündwinkels" /end FUNCTION
/begin FUNCTION ZWOB "4.10      Zündwinkel - Overboost" /end FUNCTION
/begin FUNCTION ZWSTT "4.30      Zündung im Start" /end FUNCTION
/begin FUNCTION ZWWL "5.40      Warmlauf Zündwinkel" /end FUNCTION
/begin COMPU_METHOD bfgrsc_ub_q0p024_o3p984 "" RAT_FUNC "%6.3" "m/s^2" COEFFS 0 1 3.984 0 0 0.024 /end COMPU_METHOD
/begin COMPU_METHOD bfzg_sb_q0p217 "" RAT_FUNC "%6.3" "m/s^2" COEFFS 0 1 0 0 0 0.217 /end COMPU_METHOD
/begin COMPU_METHOD bfzg_sw_q4p239Em4 "" RAT_FUNC "%10.7" "m/s^2" COEFFS 0 1 0 0 0 0.0004239 /end COMPU_METHOD
/begin COMPU_METHOD B_TRUE "boolsche Zustände, positive Logik" TAB_VERB "%6.3" "" COMPU_TAB_REF B_TRUE /end COMPU_METHOD
/begin COMPU_VTAB B_TRUE "boolsche Zustände, positive Logik" TAB_VERB 2 0 "----" 1 "TRUE" /end COMPU_VTAB
/begin COMPU_METHOD DEZ "1 : 1 Umrechnug (dez/hex)" RAT_FUNC "%6.2" "" COEFFS 0 1 0 0 0 1 /end COMPU_METHOD
/begin COMPU_METHOD dez "1 : 1 Umrechnug (dez/hex)" RAT_FUNC "%6.2" "" COEFFS 0 1 0 0 0 1 /end COMPU_METHOD
/begin COMPU_METHOD DEZL "Dezimalzahl in 16-Bit-Hexzahl" RAT_FUNC "%6.2" "" COEFFS 0 1 0 0 0 1 /end COMPU_METHOD
/begin COMPU_METHOD dezsub1 "" RAT_FUNC "%6.2" "-" COEFFS 0 1 -1 0 0 1 /end COMPU_METHOD
/begin COMPU_METHOD dist_uw_q0p1 "" RAT_FUNC "%6.3" "-" COEFFS 0 10 0 0 0 1 /end COMPU_METHOD
/begin COMPU_METHOD dtsegno_b11p25divZyl "" RAT_FUNC "%6.5" "grad/KW" COEFFS 0 45.5111 128 0 0 1 /end COMPU_METHOD
/begin COMPU_METHOD dtsegn_b720divZyl "" RAT_FUNC "%6.4" "grad/KW" COEFFS 0 182.044 0 0 0 1 /end COMPU_METHOD
/begin COMPU_METHOD dtsegn_b720divZylP5 "" RAT_FUNC "%6.1" "grad/KW" COEFFS 0 182.044 32768 0 0 1 /end COMPU_METHOD
/begin COMPU_METHOD fak_sb_q0p5 "" RAT_FUNC "%6.3" "-" COEFFS 0 256 0 0 0 128 /end COMPU_METHOD
/begin COMPU_METHOD fak_sw_b0p0625 "" RAT_FUNC "%8.7" "-" COEFFS 0 65536 0 0 0 0.125 /end COMPU_METHOD
/begin COMPU_METHOD fak_sw_b2 "" RAT_FUNC "%7.6" "-" COEFFS 0 65536 0 0 0 4 /end COMPU_METHOD
/begin COMPU_METHOD fak_sw_b256 "" RAT_FUNC "%6.4" "-" COEFFS 0 65536 0 0 0 512 /end COMPU_METHOD
/begin COMPU_METHOD fak_sw_b8 "" RAT_FUNC "%6.5" "-" COEFFS 0 65536 0 0 0 16 /end COMPU_METHOD
/begin COMPU_METHOD fak_ub_b1 "" RAT_FUNC "%6.4" "-" COEFFS 0 256 0 0 0 1 /end COMPU_METHOD
/begin COMPU_METHOD fak_ub_b2 "" RAT_FUNC "%6.4" "-" COEFFS 0 256 0 0 0 2 /end COMPU_METHOD
/begin COMPU_METHOD fak_ub_q0p01 "" RAT_FUNC "%6.4" "-" COEFFS 0 1 0 0 0 0.01 /end COMPU_METHOD
/begin COMPU_METHOD fak_uw_b0p5 "" RAT_FUNC "%8.7" "-" COEFFS 0 65536 0 0 0 0.5 /end COMPU_METHOD
/begin COMPU_METHOD fak_uw_b32 "" RAT_FUNC "%6.5" "-" COEFFS 0 65536 0 0 0 32 /end COMPU_METHOD
/begin COMPU_METHOD freq_ub_b0p05 "" RAT_FUNC "%6.5" "1/s" COEFFS 0 256 0 0 0 0.05 /end COMPU_METHOD
/begin COMPU_METHOD i_q0p0039_mA "" RAT_FUNC "%6.4" "mA" COEFFS 0 65536 0 0 0 256 /end COMPU_METHOD
/begin COMPU_METHOD kw_q0p0078 "" RAT_FUNC "%6.4" "°KW" COEFFS 0 256 0 0 0 2 /end COMPU_METHOD
/begin COMPU_METHOD kw_q0p03125 "" RAT_FUNC "%6.4" "°KW" COEFFS 0 32 0 0 0 1 /end COMPU_METHOD
/begin COMPU_METHOD kw_q0p5 "" RAT_FUNC "%6.3" "°KW" COEFFS 0 2 0 0 0 1 /end COMPU_METHOD
/begin COMPU_METHOD kw_uw_q0p0078 "" RAT_FUNC "%6.4" "°KW" COEFFS 0 128 0 0 0 1 /end COMPU_METHOD
/begin COMPU_METHOD leit_q3p125Em6 "" RAT_FUNC "%6.4" "mS [mSiemens]" COEFFS 0 65536 0 0 0 204.8 /end COMPU_METHOD
/begin COMPU_METHOD luquant_w "Umrechnung Laufunruhe Word-Größen in DMD" RAT_FUNC "%6.4" "(Umdr./sec)^2" COEFFS 0 378.528 0 0 0 1 /end COMPU_METHOD
/begin COMPU_METHOD md_q0p25 "" RAT_FUNC "%6.3" "Nm" COEFFS 0 65536 0 0 0 16384 /end COMPU_METHOD
/begin COMPU_METHOD mk_q1p56Em3 "" RAT_FUNC "%6.4" "kg/h*s" COEFFS 0 65536 0 0 0 102.4 /end COMPU_METHOD
/begin COMPU_METHOD m_q0p00014 "" RAT_FUNC "%6.5" "kg/s" COEFFS 0 714678 0 0 0 100 /end COMPU_METHOD
/begin COMPU_METHOD nmot_ub_q40 "" RAT_FUNC "%6.1" "Upm" COEFFS 0 1 0 0 0 40 /end COMPU_METHOD
/begin COMPU_METHOD rel_ub_b99p6 "" RAT_FUNC "%6.3" "%" COEFFS 0 256 0 0 0 100 /end COMPU_METHOD
/begin COMPU_METHOD rel_ub_q0p3906 "" RAT_FUNC "%6.3" "%" COEFFS 0 256 0 0 0 100 /end COMPU_METHOD
/begin COMPU_METHOD spg_ub_b1p33 "" RAT_FUNC "%6.4" "V" COEFFS 0 255 0 0 0 1.33 /end COMPU_METHOD
/begin COMPU_METHOD t10msxs_ub_b2p55 "" RAT_FUNC "%6.4" "s" COEFFS 0 1 0 0 0 0.01 /end COMPU_METHOD
/begin COMPU_METHOD t1sxs_uw_q1 "" RAT_FUNC "%6.2" "s" COEFFS 0 1 0 0 0 1 /end COMPU_METHOD
/begin COMPU_METHOD t20usxus_q20 "" RAT_FUNC "%6.1" "us" COEFFS 0 1 0 0 0 20 /end COMPU_METHOD
/begin COMPU_METHOD t40ms_ub_b10200 "" RAT_FUNC "%7.2" "ms" COEFFS 0 1 0 0 0 40 /end COMPU_METHOD
/begin COMPU_METHOD temp_ub_q0p75_o48 "" RAT_FUNC "%6.2" "Grad C" COEFFS 0 1 48 0 0 0.75 /end COMPU_METHOD
/begin COMPU_METHOD vfzg_uw_b512 "" RAT_FUNC "%6.4" "km/h" COEFFS 0 65536 0 0 0 512 /end COMPU_METHOD
/begin COMPU_METHOD vol_q0p1_l "" RAT_FUNC "%6.3" "L" COEFFS 0 1 0 0 0 0.1 /end COMPU_METHOD
/begin RECORD_LAYOUT GklWUb FNC_VALUES 1 UBYTE COLUMN_DIR DIRECT /end RECORD_LAYOUT
/begin RECORD_LAYOUT GklWUw FNC_VALUES 1 UWORD COLUMN_DIR DIRECT /end RECORD_LAYOUT
/begin RECORD_LAYOUT KlAUbSstUbWUb NO_AXIS_PTS_X 1 UBYTE AXIS_PTS_X 2 UBYTE INDEX_INCR DIRECT FNC_VALUES 3 UBYTE COLUMN_DIR DIRECT /end RECORD_LAYOUT
/begin RECORD_LAYOUT KlAUbSstUwWUb NO_AXIS_PTS_X 1 UWORD AXIS_PTS_X 2 UWORD INDEX_INCR DIRECT FNC_VALUES 3 UBYTE COLUMN_DIR DIRECT /end RECORD_LAYOUT
/begin RECORD_LAYOUT KlAUwSstUwWUw NO_AXIS_PTS_X 1 UWORD AXIS_PTS_X 2 UWORD INDEX_INCR DIRECT FNC_VALUES 3 UWORD COLUMN_DIR DIRECT /end RECORD_LAYOUT
/begin RECORD_LAYOUT KwbUb FNC_VALUES 1 UBYTE COLUMN_DIR DIRECT /end RECORD_LAYOUT
/begin RECORD_LAYOUT KwbUw FNC_VALUES 1 UWORD COLUMN_DIR DIRECT /end RECORD_LAYOUT
/begin RECORD_LAYOUT KwSw FNC_VALUES 1 SWORD COLUMN_DIR DIRECT /end RECORD_LAYOUT
/begin RECORD_LAYOUT KwUb FNC_VALUES 1 UBYTE COLUMN_DIR DIRECT /end RECORD_LAYOUT
/begin RECORD_LAYOUT KwUw FNC_VALUES 1 UWORD COLUMN_DIR DIRECT /end RECORD_LAYOUT
/begin RECORD_LAYOUT SstAUbSstUb NO_AXIS_PTS_X 1 UBYTE AXIS_PTS_X 2 UBYTE INDEX_INCR DIRECT /end RECORD_LAYOUT
/end MODULE
/end PROJECT
